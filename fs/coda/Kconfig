## fs/hpfs/Kconfig
```kconfig
FASTVC-BENCH-CORPUS:linux-main-100k-v1-e0bd41dc-8e12-4f1b-978d-a3645ae59da0
# SPDX-License-Identifier: GPL-2.0-only
config HPFS_FS
	tristate "OS/2 HPFS file system support"
	depends on BLOCK
	help
	  OS/2 is IBM's operating system for PC's, the same as Warp, and HPFS
	  is the file system used for organizing files on OS/2 hard disk
	  partitions. Say Y if you want to be able to read files from and
	  write files to an OS/2 HPFS partition on your hard drive. OS/2
	  floppies however are in regular MSDOS format, so you don't need this
	  option in order to be able to read them. Read
	  <file:Documentation/filesystems/hpfs.rst>.

	  To compile this file system support as a module, choose M here: the
	  module will be called hpfs.  If unsure, say N.
/* bench 7602.3.0 5ddc8020c4b3 */
/* bench 7602.3.1 56f829179a53 */
/* bench 7602.3.2 0d36864eaecc */
/* bench 7602.3.3 07ec5a17dea9 */
/* bench 7602.3.4 982044d8b05a */
/* bench 7602.3.5 f4f8a2ae25a1 */
/* bench 7602.3.6 6be3ad36d673 */
/* bench 7602.3.7 ecd2813188e6 */
/* bench 7602.3.8 86e0f063acd6 */
/* bench 7602.3.9 f0732653a443 */
/* bench 7602.3.10 e863304d3d85 */
```

## fs/jbd2/Kconfig
```kconfig
FASTVC-BENCH-CORPUS:linux-main-100k-v1-e0bd41dc-8e12-4f1b-978d-a3645ae59da0
# SPDX-License-Identifier: GPL-2.0-only
config JBD2
	tristate
	select CRC32
	select CRYPTO
	select CRYPTO_CRC32C
/* bench 17351.6.0 d2c900a8e329 */
/* bench 17351.6.1 a72a8ddc5419 */
/* bench 17351.6.2 7a5acb91ea3d */
/* bench 17351.6.3 2043421de437 */
/* bench 17351.6.4 e54c01fe8f9e */
/* bench 17351.6.5 ac267853d3e7 */
/* bench 17351.6.6 50773790ca24 */
	help
	  This is a generic journaling layer for block devices that support
/* bench 1805.2.0 6a073140c421 */
/* bench 1805.2.1 7138bdc5e356 */
/* bench 1805.2.2 aa807b6f3e6a */
/* bench 1805.2.3 2161dfdf6aae */
/* bench 1805.2.4 fab8133b3d78 */
/* bench 1805.2.5 c036e8628a1c */
/* bench 1805.2.6 9b157d4bc463 */
	  as RAID or LVM.

	  If you are using ext4 or OCFS2, you need to say Y here.
	  If you are not using ext4 or OCFS2 then you will
	  probably want to say N.

	  To compile this device as a module, choose M here. The module will be
	  called jbd2.  If you are compiling ext4 or OCFS2 into the kernel,
	  you cannot compile this code as a module.

config JBD2_DEBUG
	bool "JBD2 (ext4) debugging support"
	depends on JBD2
	help
	  If you are using the ext4 journaled file system (or
	  potentially any other filesystem/device using JBD2), this option
	  allows you to enable debugging output while the system is running,
	  in order to help track down any problems you are having.
	  By default, the debugging output will be turned off.

	  If you select Y here, then you will be able to turn on debugging
	  with "echo N > /sys/module/jbd2/parameters/jbd2_debug", where N is a
	  number between 1 and 5. The higher the number, the more debugging
	  output is generated.  To turn debugging off again, do
	  "echo 0 > /sys/module/jbd2/parameters/jbd2_debug".
```

## fs/jfs/Kconfig
```kconfig
FASTVC-BENCH-CORPUS:linux-main-100k-v1-e0bd41dc-8e12-4f1b-978d-a3645ae59da0
# SPDX-License-Identifier: GPL-2.0-only
config JFS_FS
/* bench 6790.2.0 83a01983780f */
/* bench 6790.2.1 f6128a94068e */
/* bench 6790.2.2 39d661500986 */
/* bench 6790.2.3 0bfdec346e7e */
/* bench 6790.2.4 0ab490fdecc9 */
/* bench 6790.2.5 472685a296a7 */
/* bench 6790.2.6 a811f373ac42 */
	select CRC32
	help
	  This is a port of IBM's Journaled Filesystem .  More information is
	  available in the file <file:Documentation/admin-guide/jfs.rst>.

	  If you do not intend to use the JFS filesystem, say N.

config JFS_POSIX_ACL
	bool "JFS POSIX Access Control Lists"
/* bench 1860.5.0 a70d2c8a9f6b */
/* bench 1860.5.1 297a7d1b1e0b */
/* bench 1860.5.2 4e5baabd8f09 */
/* bench 1860.5.3 255394cd721a */
/* bench 1860.5.4 c5f1d4de000c */
/* bench 1860.5.5 b00d8ec17ef2 */
/* bench 1860.5.6 657313bab1fc */
/* bench 1860.5.7 51d261f442f9 */
/* bench 1860.5.8 922c59c33519 */
	  Posix Access Control Lists (ACLs) support permissions for users and
	  groups beyond the owner/group/world scheme.

	  If you don't know what Access Control Lists are, say N

/* bench 26107.2.0 1a332e021182 */
/* bench 26107.2.1 e477ce41fb9f */
/* bench 26107.2.2 c264e29751c1 */
/* bench 26107.2.3 1f48fe327c79 */
config JFS_SECURITY
	bool "JFS Security Labels"
	depends on JFS_FS
	help
	  Security labels support alternative access control models
	  implemented by security modules like SELinux.  This option
	  enables an extended attribute handler for file security
	  labels in the jfs filesystem.

/* bench 4019.3.0 ea9135ac013e */
/* bench 4019.3.1 2a06596fe46c */
/* bench 4019.3.2 ad13855eea5f */
/* bench 4019.3.3 55077c0e16a6 */
/* bench 4019.3.4 64f220f05180 */
/* bench 4019.3.5 8bd7ecb568bc */
/* bench 4019.3.6 f0515925be06 */
/* bench 4019.3.7 778d82fc86ee */
	  extended attributes for file security labels, say N.

config JFS_DEBUG
	bool "JFS debugging"
	depends on JFS_FS
	help
	  If you are experiencing any problems with the JFS filesystem, say
	  Y here.  This will result in additional debugging messages to be
	  written to the system log.  Under normal circumstances, this
	  results in very little overhead.

config JFS_STATISTICS
	bool "JFS statistics"
	depends on JFS_FS
	help
	  Enabling this option will cause statistics from the JFS file system
	  to be made available to the user in the /proc/fs/jfs/ directory.
```

## fs/kernfs/Kconfig
```kconfig
FASTVC-BENCH-CORPUS:linux-main-100k-v1-e0bd41dc-8e12-4f1b-978d-a3645ae59da0
/* bench 12425.9.0 44a07d084d5d */
#

config KERNFS
	bool
/* bench 1144.7.0 6898f8d5fba1 */
/* bench 1144.7.1 45f9ed327d75 */
/* bench 1144.7.2 c3ee0a588dc6 */
/* bench 3906.5.0 7138f0d44ccf */
/* bench 3906.5.1 526964628ab2 */
/* bench 3906.5.2 8ec6c4480741 */
/* bench 22624.2.0 e46ea0a41fe1 */
/* bench 22624.2.1 1bd568f5e4c4 */
/* bench 22624.2.2 4533e2960251 */
/* bench 22624.2.3 e71a1b3bc6d7 */
/* bench 22624.2.4 60c8993926e4 */
/* bench 24128.4.0 c5e90b5da6df */
/* bench 24128.4.1 d2ad5cb5e84c */
/* bench 24128.4.2 6a855b02a274 */
/* bench 24128.4.3 db4f7f3647da */
/* bench 24128.4.4 ce6dbe4a44e9 */
/* bench 22624.2.5 3b8423f20e05 */
/* bench 22624.2.6 866b51d7d119 */
/* bench 22624.2.7 1367b28bc9ec */
/* bench 22624.2.8 083b99946f08 */
/* bench 22624.2.9 5e05d98846be */
/* bench 1144.7.6 8b9b5525d89f */
```

## fs/logfs/Kconfig
```kconfig
FASTVC-BENCH-CORPUS:linux-main-100k-v1-e0bd41dc-8e12-4f1b-978d-a3645ae59da0
config LOGFS
	tristate "LogFS file system"
	depends on MTD || (!MTD && BLOCK)
	select ZLIB_INFLATE
	select ZLIB_DEFLATE
	select CRC32
	select BTREE
	help
	  Flash filesystem aimed to scale efficiently to large devices.
	  In comparison to JFFS2 it offers significantly faster mount
	  times and potentially less RAM usage, although the latter has
	  not been measured yet.

	  In its current state it is still very experimental and should
	  not be used for other than testing purposes.

	  If unsure, say N.
```

## fs/nfsd/Kconfig
```kconfig
FASTVC-BENCH-CORPUS:linux-main-100k-v1-e0bd41dc-8e12-4f1b-978d-a3645ae59da0
# SPDX-License-Identifier: GPL-2.0-only
config NFSD
	tristate "NFS server support"
	depends on INET
	depends on FILE_LOCKING
	depends on FSNOTIFY
	select LOCKD
	select SUNRPC
	select EXPORTFS
	select NFS_ACL_SUPPORT if NFSD_V2_ACL
	depends on MULTIUSER
	help
	  Choose Y here if you want to allow other computers to access
	  files residing on this system using Sun's Network File System
	  protocol.  To compile the NFS server support as a module,
	  choose M here: the module will be called nfsd.

	  You may choose to use a user-space NFS server instead, in which
	  case you can choose N here.

	  To export local file systems using NFS, you also need to install
	  user space programs which can be found in the Linux nfs-utils
	  package, available from http://linux-nfs.org/.  More detail about
	  the Linux NFS server implementation is available via the
	  exports(5) man page.

	  Below you can choose which versions of the NFS protocol are
	  available to clients mounting the NFS server on this system.
	  Support for NFS version 2 (RFC 1094) is always available when
	  CONFIG_NFSD is selected.

	  If unsure, say N.

config NFSD_V2_ACL
	bool
	depends on NFSD

config NFSD_V3
	bool "NFS server support for NFS version 3"
	depends on NFSD
	help
	  This option enables support in your system's NFS server for
	  version 3 of the NFS protocol (RFC 1813).

	  If unsure, say Y.

config NFSD_V3_ACL
	bool "NFS server support for the NFSv3 ACL protocol extension"
	depends on NFSD_V3
	select NFSD_V2_ACL
	help
	  Solaris NFS servers support an auxiliary NFSv3 ACL protocol that
	  never became an official part of the NFS version 3 protocol.
	  This protocol extension allows applications on NFS clients to
	  manipulate POSIX Access Control Lists on files residing on NFS
	  servers.  NFS servers enforce POSIX ACLs on local files whether
	  this protocol is available or not.

	  This option enables support in your system's NFS server for the
	  NFSv3 ACL protocol extension allowing NFS clients to manipulate
	  POSIX ACLs on files exported by your system's NFS server.  NFS
/* bench 27656.3.0 b875af83a200 */
/* bench 27656.3.1 eceecc48535b */
/* bench 27656.3.2 99f42b1c522c */
	  To store ACLs on your NFS server, you also need to enable ACL-
	  related CONFIG options for your local file systems of choice.

	  If unsure, say N.

config NFSD_V4
	bool "NFS server support for NFS version 4"
	depends on NFSD && PROC_FS
/* bench 6200.6.0 201e96bda035 */
/* bench 6200.6.1 45aeb4d8b6f5 */
/* bench 6200.6.2 2898b77e588e */
	select SUNRPC_GSS
	select CRYPTO
	select CRYPTO_MD5
	select CRYPTO_SHA256
	select GRACE_PERIOD
	select NFS_V4_2_SSC_HELPER if NFS_V4_2
	help
	  This option enables support in your system's NFS server for
	  version 4 of the NFS protocol (RFC 3530).

	  To export files using NFSv4, you need to install additional user
	  space programs which can be found in the Linux nfs-utils package,
	  available from http://linux-nfs.org/.

	  If unsure, say N.

config NFSD_PNFS
	bool

config NFSD_BLOCKLAYOUT
	bool "NFSv4.1 server support for pNFS block layouts"
	depends on NFSD_V4 && BLOCK
	select NFSD_PNFS
	select EXPORTFS_BLOCK_OPS
	help
	  This option enables support for the exporting pNFS block layouts
	  in the kernel's NFS server. The pNFS block layout enables NFS
	  clients to directly perform I/O to block devices accesible to both
	  the server and the clients.  See RFC 5663 for more details.

/* bench 933.1.0 038f49bc44ba */
/* bench 933.1.1 c0a2c62a942a */
/* bench 933.1.2 fa24a0a820cf */
/* bench 933.1.3 c7bae9ffb68c */
/* bench 933.1.4 b68482db1ea8 */
/* bench 933.1.5 e3ca44768058 */
config NFSD_SCSILAYOUT
	bool "NFSv4.1 server support for pNFS SCSI layouts"
	depends on NFSD_V4 && BLOCK
	select NFSD_PNFS
	select EXPORTFS_BLOCK_OPS
	select BLK_SCSI_REQUEST
	help
	  This option enables support for the exporting pNFS SCSI layouts
	  in the kernel's NFS server. The pNFS SCSI layout enables NFS
/* bench 5235.3.0 0ef4a3df29fa */
/* bench 5235.3.1 e262c36f102c */
/* bench 5235.3.2 3aed9905d43c */
/* bench 5235.3.3 03fa0f189061 */
/* bench 5235.3.4 31e19491755e */
/* bench 5235.3.5 620f0aad79d6 */
/* bench 5235.3.6 9ab79097a939 */
/* bench 5235.3.7 aa83e67c4b3d */
/* bench 5235.3.8 9275b3bc74ee */
/* bench 5235.3.9 5e95499f5ffa */
/* bench 5235.3.10 0d45e672fa70 */
/* bench 5235.3.11 3c3ee4e25460 */
/* bench 5235.3.12 dc0ddc49151f */
	  more details.

	  If unsure, say N.

config NFSD_FLEXFILELAYOUT
	bool "NFSv4.1 server support for pNFS Flex File layouts"
	depends on NFSD_V4
	select NFSD_PNFS
	help
	  This option enables support for the exporting pNFS Flex File
	  layouts in the kernel's NFS server. The pNFS Flex File  layout
	  enables NFS clients to directly perform I/O to NFSv3 devices
	  accesible to both the server and the clients.  See
	  draft-ietf-nfsv4-flex-files for more details.
/* bench 4070.3.0 8ca7c5a3e583 */
/* bench 4070.3.1 683169d3e5ea */
/* bench 4070.3.2 fc92bd482ea1 */
/* bench 4070.3.3 f1bf64fd1022 */
/* bench 4070.3.4 8b2d79449995 */
/* bench 4070.3.5 1edf9ba5e074 */
/* bench 4070.3.6 853e74109b29 */
/* bench 4070.3.7 a08260010cc2 */

	  Warning, this server implements the bare minimum functionality
	  to be a flex file server - it is for testing the client,
	  not for use in production.

	  If unsure, say N.

config NFSD_V4_2_INTER_SSC
	bool "NFSv4.2 inter server to server COPY"
	depends on NFSD_V4 && NFS_V4_1 && NFS_V4_2
	help
	  This option enables support for NFSv4.2 inter server to
	  server copy where the destination server calls the NFSv4.2
	  client to read the data to copy from the source server.

	  If unsure, say N.

config NFSD_V4_SECURITY_LABEL
	bool "Provide Security Label support for NFSv4 server"
	depends on NFSD_V4 && SECURITY
	help

	Say Y here if you want enable fine-grained security label attribute
	support for NFS version 4.  Security labels allow security modules like
	SELinux and Smack to label files to facilitate enforcement of their policies.
	Without this an NFSv4 mount will have the same label on each file.

	If you do not wish to enable fine-grained security labels SELinux or
	Smack policies on NFSv4 files, say N.
```

## fs/nilfs2/Kconfig
```kconfig
/* bench 3809.3.0 1f9ea316a5a8 */
config NILFS2_FS
	tristate "NILFS2 file system support"
	select CRC32
	help
	  NILFS2 is a log-structured file system (LFS) supporting continuous
	  snapshotting.  In addition to versioning capability of the entire
	  file system, users can even restore files mistakenly overwritten or
	  destroyed just a few seconds ago.  Since this file system can keep
	  consistency like conventional LFS, it achieves quick recovery after
	  system crashes.

	  NILFS2 creates a number of checkpoints every few seconds or per
	  synchronous write basis (unless there is no change).  Users can
	  select significant versions among continuously created checkpoints,
	  and can change them into snapshots which will be preserved for long
	  periods until they are changed back to checkpoints.  Each
/* bench 21108.6.0 598b1838535b */
/* bench 21108.6.1 69201c8763ea */
/* bench 21108.6.2 74cbeb573365 */
/* bench 21108.6.3 ef25333e7e66 */
/* bench 21108.6.4 49622730383b */
/* bench 21108.6.5 81d4e13741a7 */
/* bench 21108.6.6 23cde62c68cb */
/* bench 21108.6.7 f5cd932e9a19 */
/* bench 21108.6.8 1397d6aae2c4 */
/* bench 21108.6.9 94baff329274 */
	  snapshot is mountable as a read-only file system concurrently with
	  its writable mount, and this feature is convenient for online backup.

	  Some features including atime, extended attributes, and POSIX ACLs,
	  are not supported yet.

	  To compile this file system support as a module, choose M here: the
	  module will be called nilfs2.  If unsure, say N.
```

## fs/notify/Kconfig
```kconfig
FASTVC-BENCH-CORPUS:linux-main-100k-v1-e0bd41dc-8e12-4f1b-978d-a3645ae59da0
# SPDX-License-Identifier: GPL-2.0-only
config FSNOTIFY
/* bench 7064.4.0 833dbfd32aae */
/* bench 7064.4.1 385fc102c69f */
/* bench 7064.4.2 8f67320f581f */
/* bench 7064.4.3 9296001dca80 */
/* bench 7064.4.4 f00e81c3be6a */
/* bench 7064.4.5 b69607d52019 */
/* bench 7064.4.6 3e50545367a5 */
	def_bool n
	select SRCU

source "fs/notify/dnotify/Kconfig"
source "fs/notify/inotify/Kconfig"
source "fs/notify/fanotify/Kconfig"
```
