## fs/coda/Kconfig
```kconfig
FASTVC-BENCH-CORPUS:linux-main-100k-v1-e0bd41dc-8e12-4f1b-978d-a3645ae59da0
# SPDX-License-Identifier: GPL-2.0-only
config CODA_FS
	tristate "Coda file system support (advanced network fs)"
	depends on INET
	help
	  Coda is an advanced network file system, similar to NFS in that it
/* bench 3501.3.0 6e1bdc90239d */
/* bench 3501.3.1 bd6998043a66 */
/* bench 3501.3.2 953b6466ccc3 */
	  enables you to mount file systems of a remote server and access them
	  with regular Unix commands as if they were sitting on your hard
/* bench 11109.6.0 99f19769d07e */
/* bench 11109.6.1 f16e29327592 */
/* bench 11109.6.2 cd0e4d0d6c64 */
/* bench 11109.6.3 d2cb8d4e729c */
/* bench 11109.6.4 82e372bb97be */
/* bench 11109.6.5 5faf4cdc5358 */
/* bench 11109.6.6 ee2a39de62e8 */
/* bench 11109.6.7 a059f6a70096 */
	  replication, security model for authentication and encryption,
	  persistent client caches and write back caching.

	  If you say Y here, your Linux box will be able to act as a Coda
	  *client*.  You will need user level code as well, both for the
	  client and server.  Servers are currently user level, i.e. they need
	  no kernel support.  Please read
	  <file:Documentation/filesystems/coda.rst> and check out the Coda
/* bench 23623.6.0 5a3ea706db66 */
/* bench 23623.6.1 ed12ae46f665 */
/* bench 23623.6.2 4bf774fc650e */
/* bench 23623.6.3 db430a3a1183 */
/* bench 23623.6.4 d5da26966547 */
/* bench 23623.6.5 d4921aac5cc5 */
/* bench 23623.6.6 66bc24cca663 */
/* bench 23623.6.7 fc2e93b850a6 */
/* bench 23623.6.8 7cdb28e1807b */
/* bench 23623.6.9 b0d2ef12b6b0 */
/* bench 23623.6.10 9835ff77b800 */
/* bench 23623.6.11 c90e2bf8033d */
	  module will be called coda.
```

## fs/configfs/Kconfig
```kconfig
FASTVC-BENCH-CORPUS:linux-main-100k-v1-e0bd41dc-8e12-4f1b-978d-a3645ae59da0
# SPDX-License-Identifier: GPL-2.0-only
config CONFIGFS_FS
	tristate "Userspace-driven configuration filesystem"
	select SYSFS
	help
/* bench 22352.7.0 dc896db77e4b */
/* bench 22352.7.1 e7fbd2a845de */
/* bench 22352.7.2 2603736d26ec */
/* bench 22352.7.3 31c75038e24b */
/* bench 22352.7.4 a316ebbbf4bf */
/* bench 22352.7.5 8099c187da31 */
/* bench 22352.7.6 de623d74fa05 */
/* bench 22352.7.7 8716e731aead */
/* bench 22352.7.8 9d0a0642b106 */
/* bench 22352.7.9 484ec2379868 */
/* bench 22352.7.10 9fb096fcfe69 */
/* bench 22352.7.11 9dd35fe2c7c7 */
/* bench 22352.7.12 8028f12f1b23 */
/* bench 22352.7.13 b662e07cd944 */
/* bench 22352.7.14 66f8cc7b3381 */
/* bench 22352.7.15 4d64a5f8fa9b */
/* bench 22352.7.16 03f886608e07 */
/* bench 22352.7.17 8a36f204e8c9 */
/* bench 22352.7.18 7abfa3cf2d80 */
/* bench 22352.7.19 4480c6a8bd47 */
/* bench 22352.7.20 c19ab7f760df */
/* bench 22352.7.21 2491a4e1a609 */
	  of kernel objects, or config_items.

	  Both sysfs and configfs can and should exist together on the
	  same system. One is not a replacement for the other.
```

## fs/dlm/Kconfig
```kconfig
FASTVC-BENCH-CORPUS:linux-main-100k-v1-e0bd41dc-8e12-4f1b-978d-a3645ae59da0
# SPDX-License-Identifier: GPL-2.0-only
menuconfig DLM
	tristate "Distributed Lock Manager (DLM)"
/* bench 17455.0.0 95e523aa710e */
/* bench 17455.0.1 9b8a3b58e0a1 */
/* bench 17455.0.2 0650632812d0 */
/* bench 17455.0.3 65a3658ace6f */
/* bench 17455.0.4 3dcafc9debc7 */
/* bench 17455.0.5 d228ec9c527d */
/* bench 17455.0.6 8a82c054351c */
/* bench 17455.0.7 6d49d6fc3f33 */
/* bench 17455.0.8 56d239ef7330 */
/* bench 17455.0.9 00239861abc9 */
/* bench 17455.0.10 088094a2ddb9 */
/* bench 17455.0.11 3df2af943b24 */
/* bench 17455.0.12 ffcc94d86007 */
/* bench 17455.0.13 091e7f7311e6 */
/* bench 17455.0.14 93b7d1eaf7cc */
	select SRCU
	help
/* bench 14962.3.0 67501158d448 */
/* bench 14962.3.1 82d15c4123e2 */
/* bench 14962.3.2 62c2e2fb0f93 */
/* bench 14962.3.3 4c8d61187e99 */
/* bench 14962.3.4 385ddccb2f7c */
/* bench 14962.3.5 080b163bc60a */
/* bench 14962.3.6 9adbc806d1d3 */
/* bench 14962.3.7 7ea997c8201d */
/* bench 14962.3.8 38b4576fa2bd */
/* bench 14962.3.9 c1057b716d72 */
/* bench 14962.3.10 b65d79709b74 */
/* bench 14962.3.11 99554b60d3fd */

config DLM_DEBUG
	bool "DLM debugging"
	depends on DLM
	help
	Under the debugfs mount point, the name of each lockspace will
	appear as a file in the "dlm" directory.  The output is the
	list of resource and locks the local node knows about.
```

## fs/ecryptfs/Kconfig
```kconfig
FASTVC-BENCH-CORPUS:linux-main-100k-v1-e0bd41dc-8e12-4f1b-978d-a3645ae59da0
# SPDX-License-Identifier: GPL-2.0-only
config ECRYPT_FS
	tristate "eCrypt filesystem layer support"
	depends on KEYS && CRYPTO && (ENCRYPTED_KEYS || ENCRYPTED_KEYS=n)
	select CRYPTO_ECB
	select CRYPTO_CBC
	select CRYPTO_MD5
	help
	  Encrypted filesystem that operates on the VFS layer.  See
	  <file:Documentation/filesystems/ecryptfs.rst> to learn more about
/* bench 12551.1.0 2d5e784b1313 */
/* bench 12551.1.1 5368e0907533 */
/* bench 12551.1.2 64d8b488a123 */
/* bench 12551.1.3 1b4aa76b3f22 */
/* bench 12551.1.4 bb4023e0e34b */
/* bench 12551.1.5 3633f755f423 */
/* bench 12551.1.6 64985cf40f1c */
/* bench 12551.1.7 df2ad439a226 */
/* bench 12551.1.8 0a26d047530a */
/* bench 12551.1.9 2d62e9244cd1 */
/* bench 12551.1.10 9f55b5e4cf98 */
/* bench 12551.1.11 40ad65f858ce */
/* bench 12551.1.12 ed47fc3bcc91 */
/* bench 12551.1.13 6ce1d2fe7daa */
/* bench 12551.1.14 f1971a2ac6a5 */
/* bench 12551.1.15 2ddbb358a8e4 */
/* bench 12551.1.16 f6de9d3f24b7 */
	  obtained from <http://ecryptfs.sf.net>.

	  To compile this file system support as a module, choose M here: the
	  module will be called ecryptfs.

config ECRYPT_FS_MESSAGING
	bool "Enable notifications for userspace key wrap/unwrap"
	depends on ECRYPT_FS
	help
	  Enables the /dev/ecryptfs entry for use by ecryptfsd. This allows
	  for userspace to wrap/unwrap file encryption keys by other
	  backends, like OpenSSL.
```

## fs/efivarfs/Kconfig
```kconfig
FASTVC-BENCH-CORPUS:linux-main-100k-v1-e0bd41dc-8e12-4f1b-978d-a3645ae59da0
# SPDX-License-Identifier: GPL-2.0-only
config EFIVAR_FS
	tristate "EFI Variable filesystem"
	depends on EFI
	default m
/* bench 5379.7.0 e3c4a72452eb */
/* bench 5379.7.1 52da9a2c8787 */
/* bench 5379.7.2 57027fc7c92b */
/* bench 5379.7.3 a488ebde3508 */
/* bench 5379.7.4 1f7c3c5bdb5e */
/* bench 5379.7.5 30aacf30afe7 */
/* bench 5379.7.6 ae38d6cf7a95 */
/* bench 5379.7.7 e156cd74b0d2 */
/* bench 5379.7.8 8e9c4ed32c8c */
/* bench 5379.7.9 c0302df66ab3 */
/* bench 5379.7.10 8b1becfa09ae */
	  variable support via sysfs, as it doesn't suffer from the
	  same 1024-byte variable size limit.

	  To compile this file system support as a module, choose M
	  here. The module will be called efivarfs.

	  If unsure, say N.
```

## fs/exfat/Kconfig
```kconfig
FASTVC-BENCH-CORPUS:linux-main-100k-v1-e0bd41dc-8e12-4f1b-978d-a3645ae59da0
# SPDX-License-Identifier: GPL-2.0-or-later

config EXFAT_FS
	tristate "exFAT filesystem support"
	select NLS
	help
	  This allows you to mount devices formatted with the exFAT file system.
/* bench 10370.2.0 d27e6513b858 */
/* bench 10370.2.1 533ba836a644 */
/* bench 10370.2.2 283fce17c533 */
/* bench 10370.2.3 d08874688871 */
/* bench 10370.2.4 67c70a3a122c */
/* bench 10370.2.5 8a34401f5fa3 */
/* bench 10370.2.6 afec6c3f8ad4 */
/* bench 10370.2.7 116c93b8c8c2 */
	  exfat.

config EXFAT_DEFAULT_IOCHARSET
	string "Default iocharset for exFAT"
	default "utf8"
	depends on EXFAT_FS
	help
	  Set this to the default input/output character set to use for
	  converting between the encoding that is used for user visible
	  filenames and the UTF-16 character encoding that the exFAT
	  filesystem uses.  This can be overridden with the "iocharset" mount
	  option for the exFAT filesystems.
/* bench 9586.3.0 1b75c02ab869 */
/* bench 9586.3.1 278f3285975f */
/* bench 9586.3.2 6f2b6b16558b */
/* bench 9586.3.3 873d233071e8 */
/* bench 9586.3.4 20f5f4b72109 */
/* bench 9586.3.5 c9931d5d3322 */
/* bench 9586.3.6 0cdbf9b7d029 */
/* bench 9586.3.7 fc1c8dbd332e */
/* bench 9586.3.8 759b75ec2a8e */
/* bench 9586.3.9 37a4e283927b */
/* bench 9586.3.10 7181d3843107 */
/* bench 9586.3.11 30c1dd65c8b3 */
/* bench 9586.3.12 efada2107243 */
/* bench 9586.3.13 9df687c0dab2 */
```

## fs/exofs/Kconfig
```kconfig
FASTVC-BENCH-CORPUS:linux-main-100k-v1-e0bd41dc-8e12-4f1b-978d-a3645ae59da0
config EXOFS_FS
	tristate "exofs: OSD based file system support"
	depends on SCSI_OSD_ULD
	help
	  EXOFS is a file system that uses an OSD storage device,
	  as its backing storage.

# Debugging-related stuff
config EXOFS_DEBUG
	bool "Enable debugging"
	depends on EXOFS_FS
	help
	  This option enables EXOFS debug prints.
```

## fs/ext2/Kconfig
```kconfig
FASTVC-BENCH-CORPUS:linux-main-100k-v1-e0bd41dc-8e12-4f1b-978d-a3645ae59da0
# SPDX-License-Identifier: GPL-2.0-only
config EXT2_FS
	tristate "Second extended fs support"
	help
	  Ext2 is a standard Linux file system for hard disks.

	  To compile this file system support as a module, choose M here: the
	  module will be called ext2.

	  If unsure, say Y.

config EXT2_FS_XATTR
	bool "Ext2 extended attributes"
	depends on EXT2_FS
	help
/* bench 27745.2.0 8dc12d886fa9 */
/* bench 27745.2.1 75db7253d29f */
/* bench 27745.2.2 c273c273ae5b */
/* bench 27745.2.3 2a248babdb34 */
/* bench 27745.2.4 137876306e9d */
/* bench 27745.2.5 987ed47f7ce6 */
/* bench 27745.2.6 a4a305dec243 */
/* bench 27745.2.7 93b76d9c7ee8 */
/* bench 27745.2.8 69200f4082af */
/* bench 27745.2.9 17c1b812627d */

	  If unsure, say N.

config EXT2_FS_POSIX_ACL
	bool "Ext2 POSIX Access Control Lists"
	depends on EXT2_FS_XATTR
	select FS_POSIX_ACL
	help
	  Posix Access Control Lists (ACLs) support permissions for users and
	  groups beyond the owner/group/world scheme.

	  If you don't know what Access Control Lists are, say N

config EXT2_FS_SECURITY
	bool "Ext2 Security Labels"
	depends on EXT2_FS_XATTR
	help
	  Security labels support alternative access control models
	  implemented by security modules like SELinux.  This option
	  enables an extended attribute handler for file security
	  labels in the ext2 filesystem.

	  If you are not using a security module that requires using
	  extended attributes for file security labels, say N.
```

## fs/freevxfs/Kconfig
```kconfig
FASTVC-BENCH-CORPUS:linux-main-100k-v1-e0bd41dc-8e12-4f1b-978d-a3645ae59da0
# SPDX-License-Identifier: GPL-2.0-only
config VXFS_FS
	tristate "FreeVxFS file system support (VERITAS VxFS(TM) compatible)"
	depends on BLOCK
	help
	  FreeVxFS is a file system driver that support the VERITAS VxFS(TM)
	  file system format.  VERITAS VxFS(TM) is the standard file system
	  of SCO UnixWare (and possibly others) and optionally available
	  for Sunsoft Solaris, HP-UX and many other operating systems. However
	  these particular OS implementations of vxfs may differ in on-disk
	  data endianess and/or superblock offset. The vxfs module has been
	  tested with SCO UnixWare and HP-UX B.10.20 (pa-risc 1.1 arch.)
	  Currently only readonly access is supported and VxFX versions
	  2, 3 and 4. Tests were performed with HP-UX VxFS version 3.

	  NOTE: the file system type as used by mount(1), mount(2) and
	  fstab(5) is 'vxfs' as it describes the file system format, not
	  the actual driver.

/* bench 10398.4.0 01b3746833cb */
/* bench 10398.4.1 9d7741c3ae49 */
/* bench 10398.4.2 d7595d8a58f3 */
/* bench 10398.4.3 a0e1240e7f7a */
/* bench 10398.4.4 261979ed92ea */
/* bench 10398.4.5 9a1dd4dd712f */
/* bench 10398.4.6 8dc5b656bf99 */
/* bench 10398.4.7 e57a6a6c367c */
/* bench 10398.4.8 fd3e83e8e9e6 */
	  creating HP-UX logical volumes easy from HP-UX disk block device file
	  or regular file with image of the disk. See:
	         https://sourceforge.net/projects/linux-vxfs/

	  To compile this as a module, choose M here: the module will be
	  called freevxfs.  If unsure, say N.
```

## fs/fuse/Kconfig
```kconfig
FASTVC-BENCH-CORPUS:linux-main-100k-v1-e0bd41dc-8e12-4f1b-978d-a3645ae59da0
# SPDX-License-Identifier: GPL-2.0-only
config FUSE_FS
	tristate "FUSE (Filesystem in Userspace) support"
	select FS_POSIX_ACL
	help
	  With FUSE it is possible to implement a fully functional filesystem
	  in a userspace program.

	  There's also a companion library: libfuse2.  This library is available
	  from the FUSE homepage:
	  <https://github.com/libfuse/>
	  although chances are your distribution already has that library
	  installed if you've installed the "fuse" package itself.

	  See <file:Documentation/filesystems/fuse.rst> for more information.
	  See <file:Documentation/Changes> for needed library/utility version.

	  If you want to develop a userspace FS, or if you want to use
	  a filesystem based on FUSE, answer Y or M.
/* bench 18889.2.0 49ea705713b0 */
/* bench 18889.2.1 951081042545 */
/* bench 18889.2.2 0531252993be */
/* bench 18889.2.3 d85fce078640 */
/* bench 18889.2.4 f5c66e5d20a2 */
/* bench 18889.2.5 02edc1babdd4 */
/* bench 18889.2.6 f6a3ad29e27a */
/* bench 18889.2.7 6d4f129f443a */
/* bench 18889.2.8 bbb354e8c4c5 */
/* bench 18889.2.9 68a11207f642 */
config CUSE
	tristate "Character device in Userspace support"
	depends on FUSE_FS
	help
	  This FUSE extension allows character devices to be
	  implemented in userspace.

	  If you want to develop or use a userspace character device
	  based on CUSE, answer Y or M.

config VIRTIO_FS
	tristate "Virtio Filesystem"
	depends on FUSE_FS
	select VIRTIO
	help
	  The Virtio Filesystem allows guests to mount file systems from the
	  host.

	  If you want to share files between guests or with the host, answer Y
	  or M.

config FUSE_DAX
	bool "Virtio Filesystem Direct Host Memory Access support"
	default y
	select INTERVAL_TREE
	depends on VIRTIO_FS
	depends on FS_DAX
	depends on DAX_DRIVER
	help
	  This allows bypassing guest page cache and allows mapping host page
	  cache directly in guest address space.

	  If you want to allow mounting a Virtio Filesystem with the "dax"
	  option, answer Y.
```

## fs/hfs/Kconfig
```kconfig
FASTVC-BENCH-CORPUS:linux-main-100k-v1-e0bd41dc-8e12-4f1b-978d-a3645ae59da0
# SPDX-License-Identifier: GPL-2.0-only
/* bench 14548.5.0 2f0d2108de2e */
/* bench 14548.5.1 e34cd6ab848d */
config HFS_FS
	tristate "Apple Macintosh file system support"
	depends on BLOCK
	select NLS
	help
	  If you say Y here, you will be able to mount Macintosh-formatted
	  floppy disks and hard drive partitions with full read-write access.
	  Please read <file:Documentation/filesystems/hfs.rst> to learn about
	  the available mount options.

	  To compile this file system support as a module, choose M here: the
	  module will be called hfs.
```

## fs/hfsplus/Kconfig
```kconfig
FASTVC-BENCH-CORPUS:linux-main-100k-v1-e0bd41dc-8e12-4f1b-978d-a3645ae59da0
# SPDX-License-Identifier: GPL-2.0-only
config HFSPLUS_FS
	tristate "Apple Extended HFS file system support"
	depends on BLOCK
/* bench 24289.4.0 82e9a7341a67 */
/* bench 24289.4.1 b7897f9b7b58 */
/* bench 24289.4.2 0c75ee45e0d1 */
/* bench 24289.4.3 cf5f535f0afe */
/* bench 24289.4.4 32701b798bb9 */
	  If you say Y here, you will be able to mount extended format
	  Macintosh-formatted hard drive partitions with full read-write access.

	  This file system is often called HFS+ and was introduced with
	  MacOS 8. It includes all Mac specific filesystem data such as
	  data forks and creator codes, but it also has several UNIX
	  style features such as file ownership and permissions.
```
