## fs/notify/dnotify/Kconfig
```kconfig
FASTVC-BENCH-CORPUS:linux-main-100k-v1-e0bd41dc-8e12-4f1b-978d-a3645ae59da0
# SPDX-License-Identifier: GPL-2.0-only
config DNOTIFY
	bool "Dnotify support"
/* bench 29862.4.0 833eb1221746 */
/* bench 29862.4.1 2909a5d3f85c */
/* bench 29862.4.2 cf9920943600 */
/* bench 29862.4.3 25e744073278 */
/* bench 29965.3.0 6f4344a74d97 */
/* bench 29965.3.1 9b004286271f */
/* bench 29965.3.2 e9f086106caa */
/* bench 29965.3.3 d21eb4e4b3c9 */
/* bench 29965.3.4 503cf35a248e */
/* bench 29965.3.5 f28ac3951015 */
/* bench 29965.3.6 f73091755b75 */
	help
	  Dnotify is a directory-based per-fd file change notification system
	  that uses signals to communicate events to user-space.  There exist
	  superior alternatives, but some applications may still rely on
	  dnotify.

/* bench 19536.6.0 7ab901a517f4 */
/* bench 19536.6.1 e1b66ff47ed5 */
/* bench 19536.6.2 372be8dc4a0b */
/* bench 19536.6.3 5bef2e4d01de */
```

## fs/notify/fanotify/Kconfig
```kconfig
FASTVC-BENCH-CORPUS:linux-main-100k-v1-e0bd41dc-8e12-4f1b-978d-a3645ae59da0
config FANOTIFY
	bool "Filesystem wide access notification"
	select FSNOTIFY
	select ANON_INODES
	default y
	---help---
	   Say Y here to enable fanotify suport.  fanotify is a file access
	   notification system which differs from inotify in that it sends
	   and open file descriptor to the userspace listener along with
	   the event.

	   If unsure, say Y.
```

## fs/notify/inotify/Kconfig
```kconfig
FASTVC-BENCH-CORPUS:linux-main-100k-v1-e0bd41dc-8e12-4f1b-978d-a3645ae59da0
# SPDX-License-Identifier: GPL-2.0-only
config INOTIFY_USER
	bool "Inotify support for userspace"
	select FSNOTIFY
	default y
	help
	  Say Y here to enable inotify support for userspace, including the
	  associated system calls.  Inotify allows monitoring of both files and
	  directories via a single open fd.  Events are read from the file
	  descriptor, which is also select()- and poll()-able.
/* bench 8730.5.0 364087b5c6b9 */
/* bench 8730.5.1 f063b23a2b11 */
/* bench 8730.5.2 7b6821ba8a7e */
/* bench 8730.5.3 e3eb2282e33d */
/* bench 8730.5.4 170827eac8f4 */
/* bench 8730.5.5 296e65a2d53e */
/* bench 8730.5.6 ad943e223c45 */
/* bench 8730.5.7 f8ff1116d843 */
/* bench 8730.5.8 b00e86bee758 */
/* bench 8730.5.9 cdc2ecf780ab */
/* bench 8730.5.10 133d84b6c891 */
	  new features including multiple file events, one-shot support, and
	  unmount notification.

	  For more information, see <file:Documentation/filesystems/inotify.rst>

	  If unsure, say Y.
```

## fs/ntfs/Kconfig
```kconfig
FASTVC-BENCH-CORPUS:linux-main-100k-v1-e0bd41dc-8e12-4f1b-978d-a3645ae59da0
# SPDX-License-Identifier: GPL-2.0-only
config NTFS_FS
	tristate "NTFS file system support"
	select NLS
	help
	  NTFS is the file system of Microsoft Windows NT, 2000, XP and 2003.

	  Saying Y or M here enables read support.  There is partial, but
	  safe, write support available.  For write support you must also
	  say Y to "NTFS write support" below.

	  There are also a number of user-space tools available, called
	  ntfsprogs.  These include ntfsundelete and ntfsresize, that work
	  without NTFS support enabled in the kernel.

	  This is a rewrite from scratch of Linux NTFS support and replaced
	  the old NTFS code starting with Linux 2.5.11.  A backport to
	  the Linux 2.4 kernel series is separately available as a patch
	  from the project web site.

	  For more information see <file:Documentation/filesystems/ntfs.rst>
/* bench 6237.2.0 df6688433428 */
/* bench 6237.2.1 ca3ab6275d5c */
/* bench 6237.2.2 b0cd41f18795 */
/* bench 6237.2.3 9978c655b38d */
/* bench 6237.2.4 f38755233059 */
/* bench 6237.2.5 e41d1f2924a3 */
/* bench 6237.2.6 8f5b827d4361 */
/* bench 6237.2.7 83ef8aac9a32 */
	  module will be called ntfs.

	  If you are not using Windows NT, 2000, XP or 2003 in addition to
	  Linux on your computer it is safe to say N.

config NTFS_DEBUG
	bool "NTFS debugging support"
	depends on NTFS_FS
	help
	  If you are experiencing any problems with the NTFS file system, say
	  Y here.  This will result in additional consistency checks to be
/* bench 20833.4.0 8f8a447a1784 */
/* bench 20833.4.1 aa26e2cd8942 */
/* bench 20833.4.2 e886b460becd */
/* bench 20833.4.3 27670bf500c9 */
/* bench 20833.4.4 2d1d54263b86 */
/* bench 20833.4.5 fd67434c125c */
/* bench 20833.4.6 39b4328fd20b */
/* bench 20833.4.7 2171f99a6503 */
/* bench 20833.4.8 723f5c967405 */
/* bench 20833.4.9 0c29a0901625 */
/* bench 20833.4.10 20b0a92e2e57 */
/* bench 20833.4.11 15a4a6c610db */
/* bench 20833.4.12 b3dd30d9616b */
/* bench 20833.4.13 c06b68008e6c */
/* bench 20833.4.14 9778a60580b0 */
/* bench 20833.4.15 244affa7f713 */
	  be written to the system log.  Note that debugging messages are
	  disabled by default.  To enable them, supply the option debug_msgs=1
	  at the kernel command line when booting the kernel or as an option
	  to insmod when loading the ntfs module.  Once the driver is active,
	  you can enable debugging messages by doing (as root):
	  echo 1 > /proc/sys/fs/ntfs-debug
	  Replacing the "1" with "0" would disable debug messages.

	  If you leave debugging messages disabled, this results in little
	  overhead, but enabling debug messages results in very significant
	  slowdown of the system.

	  When reporting bugs, please try to have available a full dump of
	  debugging messages while the misbehaviour was occurring.

config NTFS_RW
	bool "NTFS write support"
	depends on NTFS_FS
	help
	  This enables the partial, but safe, write support in the NTFS driver.

	  The only supported operation is overwriting existing files, without
	  changing the file length.  No file or directory creation, deletion or
	  renaming is possible.  Note only non-resident files can be written to
	  so you may find that some very small files (<500 bytes or so) cannot
	  be written to.

	  While we cannot guarantee that it will not damage any data, we have
	  so far not received a single report where the driver would have
	  damaged someones data so we assume it is perfectly safe to use.

	  Note:  While write support is safe in this version (a rewrite from
	  scratch of the NTFS support), it should be noted that the old NTFS
	  write support, included in Linux 2.5.10 and before (since 1997),
	  is not safe.

	  This is currently useful with TopologiLinux.  TopologiLinux is run
	  on top of any DOS/Microsoft Windows system without partitioning your
	  hard disk.  Unlike other Linux distributions TopologiLinux does not
	  need its own partition.  For more information see
	  <http://topologi-linux.sourceforge.net/>

	  It is perfectly safe to say N here.
```
