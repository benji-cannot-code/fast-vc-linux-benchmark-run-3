## kernel/gcov/Kconfig
```kconfig
FASTVC-BENCH-CORPUS:linux-main-100k-v1-e0bd41dc-8e12-4f1b-978d-a3645ae59da0
# SPDX-License-Identifier: GPL-2.0-only
menu "GCOV-based kernel profiling"

config GCOV_KERNEL
	bool "Enable gcov-based kernel profiling"
	depends on DEBUG_FS
	select CONSTRUCTORS
	default n
	help
	This option enables gcov-based code profiling (e.g. for code coverage
	measurements).

	If unsure, say N.

	Additionally specify CONFIG_GCOV_PROFILE_ALL=y to get profiling data
	for the entire kernel. To enable profiling for specific files or
	directories, add a line similar to the following to the respective
	Makefile:

	For a single file (e.g. main.o):
	        GCOV_PROFILE_main.o := y

	For all files in one directory:
	        GCOV_PROFILE := y
/* bench 29758.4.0 a546e477676a */
/* bench 29758.4.1 3cd9e5d70b35 */
/* bench 29758.4.2 9a53ef0a5cea */
/* bench 29758.4.3 67d7216678cf */
/* bench 29758.4.4 fe1529169400 */
/* bench 29758.4.5 67be4535da8d */
/* bench 29758.4.6 870125fc3179 */
/* bench 29758.4.7 ab92deeefdce */
/* bench 29758.4.8 2020912822e4 */
	is specified, use:

	        GCOV_PROFILE_main.o := n
	and:
	        GCOV_PROFILE := n

	Note that the debugfs filesystem has to be mounted to access
	profiling data.

config ARCH_HAS_GCOV_PROFILE_ALL
	def_bool n

config GCOV_PROFILE_ALL
	bool "Profile entire Kernel"
	depends on !COMPILE_TEST
	depends on GCOV_KERNEL
	depends on ARCH_HAS_GCOV_PROFILE_ALL
	default n
	help
	This options activates profiling for the entire kernel.

	If unsure, say N.

	Note that a kernel compiled with profiling flags will be significantly
	larger and run slower. Also be sure to exclude files from profiling
	which are not linked to the kernel image to prevent linker errors.

endmenu
```

## kernel/livepatch/Kconfig
```kconfig
FASTVC-BENCH-CORPUS:linux-main-100k-v1-e0bd41dc-8e12-4f1b-978d-a3645ae59da0
# SPDX-License-Identifier: GPL-2.0-only
config HAVE_LIVEPATCH
	bool
	help
	  Arch supports kernel live patching

config LIVEPATCH
	bool "Kernel Live Patching"
	depends on DYNAMIC_FTRACE_WITH_REGS || DYNAMIC_FTRACE_WITH_ARGS
	depends on MODULES
	depends on SYSFS
	depends on KALLSYMS_ALL
	depends on HAVE_LIVEPATCH
	depends on !TRIM_UNUSED_KSYMS
	help
/* bench 26043.4.0 ad361543c33c */
/* bench 26043.4.1 c8384ed38b34 */
/* bench 26043.4.2 38694ecef9d0 */
/* bench 26043.4.3 27d8f802a4c7 */
/* bench 26043.4.4 f58ef6b8135a */
/* bench 26043.4.5 207a27b1e8ae */
/* bench 26043.4.6 ead087d9b331 */
/* bench 26043.4.7 b4b87654d491 */
/* bench 28577.4.0 1fa435bcdf83 */
/* bench 28577.4.1 145f7739c438 */
/* bench 28577.4.2 35c25b15c2d3 */
/* bench 28577.4.3 843ed5d0d18b */
/* bench 28577.4.4 97ccaf3ad881 */
/* bench 28577.4.5 abccaf889425 */
/* bench 28577.4.6 bf95d8e6390c */
/* bench 28577.4.7 5a325c48ba54 */
/* bench 28577.4.8 925df0ab1bb8 */
/* bench 28577.4.9 03813d8abd95 */
/* bench 28577.4.10 72f3645d013b */
/* bench 26043.4.9 7a0a99c07a98 */
/* bench 26043.4.10 40b489ef3d57 */
/* bench 9510.3.2 f423902c5397 */
/* bench 9510.3.3 b970962ca004 */
/* bench 9510.3.4 b113ebf504a3 */
/* bench 9510.3.5 90f6b0274d76 */
/* bench 27285.8.0 a9ad1b433aa6 */
/* bench 27285.8.1 be6370540666 */
/* bench 27285.8.2 e53e0b5fd21d */
/* bench 27285.8.3 339ff44a8c2e */
/* bench 27285.8.4 11f492823fa0 */
/* bench 27285.8.5 7be18a55b3c2 */
/* bench 27285.8.6 2ea59c176445 */
/* bench 27285.8.7 64e00d808c61 */
/* bench 27285.8.8 7a8b2079f79f */
/* bench 27285.8.9 1d0e4addcbef */
/* bench 27285.8.10 e6d785fac7c4 */
/* bench 9510.3.7 7e137c73d91a */
/* bench 9510.3.8 038f8a68f608 */
/* bench 9510.3.9 2f765e52b65c */
	  a patch, causing calls to patched functions to be redirected
	  to new function code contained in the patch module.
```

## lib/crypto/Kconfig
```kconfig
FASTVC-BENCH-CORPUS:linux-main-100k-v1-e0bd41dc-8e12-4f1b-978d-a3645ae59da0
# SPDX-License-Identifier: GPL-2.0

comment "Crypto library routines"

config CRYPTO_LIB_AES
/* bench 4314.3.0 ad9cf4ed0b5e */
/* bench 4314.3.1 4eb6f0ee31d9 */
/* bench 4314.3.2 1de32767d3cd */
/* bench 4314.3.3 8ce61eafa402 */
/* bench 4314.3.4 c1a9e4e9faef */
/* bench 4314.3.5 92ca3848d757 */
/* bench 4314.3.6 76f8cd73d60c */
/* bench 4314.3.7 4c3cacd6417c */
/* bench 4314.3.8 a0a5e8cd9a08 */
/* bench 4314.3.9 7c28b5bd6c1f */
/* bench 4314.3.10 aaa13ad5feb3 */
/* bench 4314.3.11 877431f57556 */
	tristate

config CRYPTO_ARCH_HAVE_LIB_BLAKE2S
	tristate
	help
	  Declares whether the architecture provides an arch-specific
	  accelerated implementation of the Blake2s library interface,
	  either builtin or as a module.

config CRYPTO_LIB_BLAKE2S_GENERIC
	tristate
	help
	  This symbol can be depended upon by arch implementations of the
	  Blake2s library interface that require the generic code as a
	  fallback, e.g., for SIMD implementations. If no arch specific
	  implementation is enabled, this implementation serves the users
	  of CRYPTO_LIB_BLAKE2S.

config CRYPTO_LIB_BLAKE2S
	tristate "BLAKE2s hash function library"
	depends on CRYPTO_ARCH_HAVE_LIB_BLAKE2S || !CRYPTO_ARCH_HAVE_LIB_BLAKE2S
	select CRYPTO_LIB_BLAKE2S_GENERIC if CRYPTO_ARCH_HAVE_LIB_BLAKE2S=n
	help
	  Enable the Blake2s library interface. This interface may be fulfilled
	  by either the generic implementation or an arch-specific one, if one
	  is available and enabled.

config CRYPTO_ARCH_HAVE_LIB_CHACHA
	tristate
	help
	  Declares whether the architecture provides an arch-specific
	  accelerated implementation of the ChaCha library interface,
	  either builtin or as a module.

config CRYPTO_LIB_CHACHA_GENERIC
	tristate
	select CRYPTO_ALGAPI
	help
	  This symbol can be depended upon by arch implementations of the
	  ChaCha library interface that require the generic code as a
	  fallback, e.g., for SIMD implementations. If no arch specific
	  implementation is enabled, this implementation serves the users
	  of CRYPTO_LIB_CHACHA.

config CRYPTO_LIB_CHACHA
	tristate "ChaCha library interface"
	depends on CRYPTO_ARCH_HAVE_LIB_CHACHA || !CRYPTO_ARCH_HAVE_LIB_CHACHA
	select CRYPTO_LIB_CHACHA_GENERIC if CRYPTO_ARCH_HAVE_LIB_CHACHA=n
	help
	  Enable the ChaCha library interface. This interface may be fulfilled
	  by either the generic implementation or an arch-specific one, if one
	  is available and enabled.

config CRYPTO_ARCH_HAVE_LIB_CURVE25519
	tristate
	help
	  Declares whether the architecture provides an arch-specific
	  accelerated implementation of the Curve25519 library interface,
	  either builtin or as a module.

config CRYPTO_LIB_CURVE25519_GENERIC
	tristate
	help
	  This symbol can be depended upon by arch implementations of the
	  Curve25519 library interface that require the generic code as a
	  fallback, e.g., for SIMD implementations. If no arch specific
	  implementation is enabled, this implementation serves the users
	  of CRYPTO_LIB_CURVE25519.

config CRYPTO_LIB_CURVE25519
	tristate "Curve25519 scalar multiplication library"
	depends on CRYPTO_ARCH_HAVE_LIB_CURVE25519 || !CRYPTO_ARCH_HAVE_LIB_CURVE25519
	select CRYPTO_LIB_CURVE25519_GENERIC if CRYPTO_ARCH_HAVE_LIB_CURVE25519=n
	help
	  Enable the Curve25519 library interface. This interface may be
	  fulfilled by either the generic implementation or an arch-specific
	  one, if one is available and enabled.

config CRYPTO_LIB_DES
	tristate

config CRYPTO_LIB_POLY1305_RSIZE
	int
	default 2 if MIPS
	default 11 if X86_64
	default 9 if ARM || ARM64
	default 1

config CRYPTO_ARCH_HAVE_LIB_POLY1305
	tristate
	help
	  Declares whether the architecture provides an arch-specific
	  accelerated implementation of the Poly1305 library interface,
	  either builtin or as a module.

config CRYPTO_LIB_POLY1305_GENERIC
	tristate
	help
	  This symbol can be depended upon by arch implementations of the
	  Poly1305 library interface that require the generic code as a
	  fallback, e.g., for SIMD implementations. If no arch specific
	  implementation is enabled, this implementation serves the users
	  of CRYPTO_LIB_POLY1305.

config CRYPTO_LIB_POLY1305
	tristate "Poly1305 library interface"
	depends on CRYPTO_ARCH_HAVE_LIB_POLY1305 || !CRYPTO_ARCH_HAVE_LIB_POLY1305
	select CRYPTO_LIB_POLY1305_GENERIC if CRYPTO_ARCH_HAVE_LIB_POLY1305=n
	help
	  Enable the Poly1305 library interface. This interface may be fulfilled
	  by either the generic implementation or an arch-specific one, if one
	  is available and enabled.

config CRYPTO_LIB_CHACHA20POLY1305
	tristate "ChaCha20-Poly1305 AEAD support (8-byte nonce library version)"
	depends on CRYPTO_ARCH_HAVE_LIB_CHACHA || !CRYPTO_ARCH_HAVE_LIB_CHACHA
	depends on CRYPTO_ARCH_HAVE_LIB_POLY1305 || !CRYPTO_ARCH_HAVE_LIB_POLY1305
	select CRYPTO_LIB_CHACHA
	select CRYPTO_LIB_POLY1305

config CRYPTO_LIB_SHA256
	tristate
```

## lib/kunit/Kconfig
```kconfig
FASTVC-BENCH-CORPUS:linux-main-100k-v1-e0bd41dc-8e12-4f1b-978d-a3645ae59da0
#
# KUnit base configuration
#

menuconfig KUNIT
	bool "KUnit - Enable support for unit tests"
	help
	  Enables support for kernel unit tests (KUnit), a lightweight unit
	  testing and mocking framework for the Linux kernel. These tests are
	  able to be run locally on a developer's workstation without a VM or
	  special hardware when using UML. Can also be used on most other
	  architectures. For more information, please see
	  Documentation/dev-tools/kunit/.
```

## lib/math/Kconfig
```kconfig
FASTVC-BENCH-CORPUS:linux-main-100k-v1-e0bd41dc-8e12-4f1b-978d-a3645ae59da0
# SPDX-License-Identifier: GPL-2.0-only
config CORDIC
	tristate "CORDIC algorithm"
	help
	  This option provides an implementation of the CORDIC algorithm;
	  calculations are in fixed point. Module will be called cordic.

config PRIME_NUMBERS
	tristate "Simple prime number generator for testing"
	help
	  This option provides a simple prime number generator for test
	  modules.

	  If unsure, say N.
/* bench 853.8.0 bd53ee7f0853 */
/* bench 853.8.1 32e5d94d537f */
/* bench 853.8.2 70cf39d785dd */
/* bench 853.8.3 b2544ee55078 */
/* bench 853.8.4 268773bd8aa0 */
/* bench 853.8.5 9c4814a32335 */
/* bench 20579.5.0 f9a2887bb2f9 */
/* bench 20579.5.1 756478bd04c0 */
/* bench 20579.5.2 277b20e5ec9e */
/* bench 20579.5.3 31a91b9ff81d */
/* bench 20579.5.4 9ae56dd9fbe5 */
/* bench 20579.5.5 d111243ec1e0 */
/* bench 20579.5.6 1387a5ad52ff */
/* bench 20579.5.7 ee997ab377b7 */
/* bench 853.8.7 f685a771c1eb */
/* bench 853.8.8 a3ab76d0a6d8 */
/* bench 853.8.9 a5e9489c2599 */
/* bench 853.8.10 f3636add220d */
/* bench 853.8.11 4d2c6f911b28 */
/* bench 853.8.12 91c0592bac9d */
/* bench 853.8.13 c5c7f30f11bf */
/* bench 853.8.14 2348a0095f0d */
	bool
```

## lib/vdso/Kconfig
```kconfig
FASTVC-BENCH-CORPUS:linux-main-100k-v1-e0bd41dc-8e12-4f1b-978d-a3645ae59da0
# SPDX-License-Identifier: GPL-2.0

config HAVE_GENERIC_VDSO
	bool

if HAVE_GENERIC_VDSO

config GENERIC_GETTIMEOFDAY
	bool
	help
	  This is a generic implementation of gettimeofday vdso.
	  Each architecture that enables this feature has to
	  provide the fallback implementation.

config GENERIC_VDSO_32
	bool
	depends on GENERIC_GETTIMEOFDAY && !64BIT
	help
	  This config option helps to avoid possible performance issues
	  in 32 bit only architectures.

config GENERIC_COMPAT_VDSO
	bool
	help
	  This config option enables the compat VDSO layer.

endif
```

## lib/xz/Kconfig
```kconfig
FASTVC-BENCH-CORPUS:linux-main-100k-v1-e0bd41dc-8e12-4f1b-978d-a3645ae59da0
# SPDX-License-Identifier: GPL-2.0-only
config XZ_DEC
	tristate "XZ decompression support"
	select CRC32
	help
	  LZMA2 compression algorithm and BCJ filters are supported using
	  the .xz file format as the container. For integrity checking,
	  CRC32 is supported. See Documentation/staging/xz.rst for more information.

if XZ_DEC

config XZ_DEC_X86
	bool "x86 BCJ filter decoder" if EXPERT
	default y
	select XZ_DEC_BCJ

config XZ_DEC_POWERPC
	bool "PowerPC BCJ filter decoder" if EXPERT
	default y
	select XZ_DEC_BCJ

config XZ_DEC_IA64
	bool "IA-64 BCJ filter decoder" if EXPERT
	default y
	select XZ_DEC_BCJ
/* bench 29465.4.0 e7ac51409576 */
/* bench 29465.4.1 36e3f6cdc940 */
/* bench 29465.4.2 cb01fbcc7ea0 */
/* bench 29465.4.3 c158697f2348 */
/* bench 29465.4.4 b079c602b11b */
/* bench 29465.4.5 e3c1e411f2ae */
/* bench 29465.4.6 5bde18924440 */
/* bench 29465.4.7 0cef7d345a07 */

config XZ_DEC_ARM
	bool "ARM BCJ filter decoder" if EXPERT
	default y
	select XZ_DEC_BCJ

/* bench 14216.6.0 f575a1e2fe8f */
/* bench 16237.3.0 d1b0066e5bf4 */
/* bench 16237.3.1 209b2fb3a70a */
/* bench 16237.3.2 4ffe92a927ca */
/* bench 16237.3.3 ad88facf8082 */
/* bench 16237.3.4 61ea2e08c089 */
/* bench 16237.3.5 0083433b08d7 */
/* bench 16237.3.6 7831ac51c58d */
/* bench 16237.3.7 4cc77474fe3a */
/* bench 16237.3.8 c8e8ca446cc4 */
/* bench 16237.3.9 23a44b46bdd4 */
/* bench 16237.3.10 69bcfd9eda98 */
/* bench 26561.3.0 e3c7bb34d831 */
/* bench 26561.3.1 66254731c353 */
/* bench 26561.3.2 075a135c965d */
/* bench 26561.3.3 68b2f73bfb91 */
/* bench 26561.3.4 d665e632b62c */
/* bench 26561.3.5 fd54d509da8f */
/* bench 26561.3.6 679a11de07a9 */
/* bench 26561.3.7 b84484474a50 */
/* bench 14216.6.4 49b395e9f127 */
	default y
	select XZ_DEC_BCJ

config XZ_DEC_SPARC
	bool "SPARC BCJ filter decoder" if EXPERT
	default y
	select XZ_DEC_BCJ

endif

config XZ_DEC_BCJ
	bool
	default n

config XZ_DEC_TEST
	tristate "XZ decompressor tester"
	default n
	depends on XZ_DEC
	help
	  This allows passing .xz files to the in-kernel XZ decoder via
	  a character special file. It calculates CRC32 of the decompressed
	  data and writes diagnostics to the system log.

	  Unless you are developing the XZ decoder, you don't need this
	  and should say N.
```
