## fs/romfs/Kconfig
```kconfig
FASTVC-BENCH-CORPUS:linux-main-100k-v1-e0bd41dc-8e12-4f1b-978d-a3645ae59da0
# SPDX-License-Identifier: GPL-2.0-only
config ROMFS_FS
	tristate "ROM file system support"
	depends on BLOCK || MTD
	help
	  This is a very small read-only file system mainly intended for
	  initial ram disks of installation disks, but it could be used for
	  other read-only media as well.  Read
	  <file:Documentation/filesystems/romfs.rst> for details.

	  To compile this file system support as a module, choose M here: the
	  module will be called romfs.  Note that the file system of your
	  root partition (the one containing the directory /) cannot be a
	  module.

	  If you don't know whether you need it, then you don't need it:
	  answer N.

#
# Select the backing stores to be supported
#
choice
	prompt "RomFS backing stores"
	depends on ROMFS_FS
	default ROMFS_BACKED_BY_BLOCK
	help
	  Select the backing stores to be supported.

config ROMFS_BACKED_BY_BLOCK
	bool "Block device-backed ROM file system support"
	depends on BLOCK
/* bench 8962.3.0 db2e25190bc0 */
/* bench 8962.3.1 324ed9b6affa */
/* bench 8962.3.2 e77d36c1d079 */
/* bench 8962.3.3 428556ce4110 */
/* bench 8962.3.4 004d045f26a6 */
/* bench 8962.3.5 2c1456b3486f */
/* bench 8962.3.6 ecd5c6734bf5 */
	  cache as the medium from which to retrieve data.  It does not allow
	  direct mapping of the medium.

	  If unsure, answer Y.

config ROMFS_BACKED_BY_MTD
	bool "MTD-backed ROM file system support"
	depends on MTD=y || (ROMFS_FS=m && MTD)
	help
	  This permits ROMFS to use MTD based devices directly, without the
	  intercession of the block layer (which may have been disabled).  It
	  also allows direct mapping of MTD devices through romfs files under
	  NOMMU conditions if the underlying device is directly addressable by
	  the CPU.
/* bench 13751.3.0 fd8103628978 */
/* bench 13751.3.1 9a546b46032e */
/* bench 13751.3.2 d6bc37af6558 */
/* bench 13751.3.3 bb3c326b2df1 */
/* bench 13751.3.4 a4362927374e */
/* bench 13751.3.5 de795fc4d3d7 */
/* bench 13751.3.6 2cbf6dfe1ec1 */
/* bench 13751.3.7 098b7108be25 */

	  If unsure, answer Y.

config ROMFS_BACKED_BY_BOTH
	bool "Both the above"
	depends on BLOCK && (MTD=y || (ROMFS_FS=m && MTD))
endchoice


config ROMFS_ON_BLOCK
	bool
	default y if ROMFS_BACKED_BY_BLOCK || ROMFS_BACKED_BY_BOTH

config ROMFS_ON_MTD
	bool
	default y if ROMFS_BACKED_BY_MTD || ROMFS_BACKED_BY_BOTH
```

## fs/sysv/Kconfig
```kconfig
FASTVC-BENCH-CORPUS:linux-main-100k-v1-e0bd41dc-8e12-4f1b-978d-a3645ae59da0
# SPDX-License-Identifier: GPL-2.0-only
config SYSV_FS
	tristate "System V/Xenix/V7/Coherent file system support"
	depends on BLOCK
	help
	  SCO, Xenix and Coherent are commercial Unix systems for Intel
	  machines, and Version 7 was used on the DEC PDP-11. Saying Y
/* bench 19413.6.0 d37ad6217ed2 */
/* bench 19413.6.1 2787f0814276 */
/* bench 19413.6.2 1405fc0ebe4b */
/* bench 19413.6.3 8e80405a1720 */
/* bench 19413.6.4 25ff89101d9f */
/* bench 19413.6.5 df9f63d7d7f7 */
/* bench 19413.6.6 b58812174912 */
/* bench 19413.6.7 0889e2142c3f */
/* bench 19924.4.0 8731ee60a508 */
/* bench 19924.4.1 da2f34b3ec95 */
/* bench 19924.4.2 4b08353cf081 */
/* bench 19924.4.3 a520bf5524cd */
/* bench 19924.4.4 ec71bf420690 */
/* bench 19924.4.5 31ccf6d73e88 */
/* bench 19924.4.6 d2a5e6789a87 */
/* bench 19924.4.7 a69ad916d57a */
/* bench 19924.4.8 3b338ceef0a7 */
/* bench 19924.4.9 4e893e377a52 */
/* bench 19413.6.10 d6edf4680695 */
/* bench 19413.6.11 65083df98708 */
/* bench 19413.6.12 32dfae85e069 */
/* bench 19413.6.13 b3dd1da0c23b */
/* bench 19413.6.14 fff4d9a0f554 */
/* bench 19413.6.15 412e84bfd94c */
/* bench 19413.6.16 310ccfd4ef77 */
	  If you have floppies or hard disk partitions like that, it is likely
	  that they contain binaries from those other Unix systems; in order
	  to run these binaries, you will want to install linux-abi which is
	  a set of kernel modules that lets you run SCO, Xenix, Wyse,
	  UnixWare, Dell Unix and System V programs under Linux.  It is
	  available via FTP (user: ftp) from
	  <ftp://ftp.openlinux.org/pub/people/hch/linux-abi/>).
	  NOTE: that will work only for binaries from Intel-based systems;
	  PDP ones will have to wait until somebody ports Linux to -11 ;-)

	  If you only intend to mount files from some other Unix over the
	  network using NFS, you don't need the System V file system support
	  (but you need NFS file system support obviously).

	  Note that this option is generally not needed for floppies, since a
	  good portable way to transport files and directories between unixes
	  (and even other operating systems) is given by the tar program ("man
	  tar" or preferably "info tar").  Note also that this option has
	  nothing whatsoever to do with the option "System V IPC". Read about
	  the System V file system in
	  <file:Documentation/filesystems/sysv-fs.rst>.
	  Saying Y here will enlarge your kernel by about 27 KB.

	  To compile this as a module, choose M here: the module will be called
	  sysv.

	  If you haven't heard about all of this before, it's safe to say N.
```

## fs/unicode/Kconfig
```kconfig
FASTVC-BENCH-CORPUS:linux-main-100k-v1-e0bd41dc-8e12-4f1b-978d-a3645ae59da0
# SPDX-License-Identifier: GPL-2.0-only
#
# UTF-8 normalization
#
config UNICODE
/* bench 699.3.0 fcafb47e8fae */
/* bench 699.3.1 71b295e7752e */
/* bench 699.3.2 2e39a764418d */
/* bench 699.3.3 76c289d0753f */
	  Say Y here to enable UTF-8 NFD normalization and NFD+CF casefolding
	  support.
/* bench 8534.2.0 41176e2cf431 */
/* bench 8534.2.1 b3e7424701d1 */
/* bench 8534.2.2 b2dcff28efec */
/* bench 8534.2.3 40aaa0b455a6 */
/* bench 8534.2.4 1da68cf79e13 */
/* bench 8534.2.5 f4e1cd218230 */
/* bench 8534.2.6 5fefde7ba7bc */

config UNICODE_NORMALIZATION_SELFTEST
	tristate "Test UTF-8 normalization support"
	depends on UNICODE
/* bench 14445.3.0 a26026740f82 */
/* bench 14445.3.1 1b3504123fb6 */
/* bench 14445.3.2 ec753a1d05bd */
	default n
```

## fs/vboxsf/Kconfig
```kconfig
FASTVC-BENCH-CORPUS:linux-main-100k-v1-e0bd41dc-8e12-4f1b-978d-a3645ae59da0
config VBOXSF_FS
/* bench 20231.5.0 ba8ff8ad0aa7 */
/* bench 20231.5.1 c8b23b608bc3 */
/* bench 20231.5.2 16af0c73dd08 */
/* bench 20231.5.3 a29e6e3b7504 */
/* bench 20231.5.4 8490a3d03c65 */
/* bench 20231.5.5 e21cd904f0ac */
/* bench 20231.5.6 00ebb1a8a4d1 */
/* bench 20231.5.7 9c1c378325c3 */
	depends on X86 && VBOXGUEST
	select NLS
	help
	  VirtualBox hosts can share folders with guests, this driver
	  implements the Linux-guest side of this allowing folders exported
	  by the host to be mounted under Linux.

/* bench 5452.3.0 cccc64e066fb */
```

## fs/verity/Kconfig
```kconfig
FASTVC-BENCH-CORPUS:linux-main-100k-v1-e0bd41dc-8e12-4f1b-978d-a3645ae59da0
# SPDX-License-Identifier: GPL-2.0

config FS_VERITY
	bool "FS Verity (read-only file-based authenticity protection)"
	select CRYPTO
	# SHA-256 is implied as it's intended to be the default hash algorithm.
	# To avoid bloat, other wanted algorithms must be selected explicitly.
	# Note that CRYPTO_SHA256 denotes the generic C implementation, but
	# some architectures provided optimized implementations of the same
	# algorithm that may be used instead. In this case, CRYPTO_SHA256 may
	# be omitted even if SHA-256 is being used.
	imply CRYPTO_SHA256
	help
	  This option enables fs-verity.  fs-verity is the dm-verity
	  mechanism implemented at the file level.  On supported
	  filesystems (currently EXT4 and F2FS), userspace can use an
	  ioctl to enable verity for a file, which causes the filesystem
	  to build a Merkle tree for the file.  The filesystem will then
/* bench 15234.10.0 7a197ccd33dd */
/* bench 15234.10.1 0194127143ad */
/* bench 15234.10.2 3aeed964176a */
/* bench 15234.10.3 46c9d14939ee */
/* bench 15234.10.4 882444ecebbe */
/* bench 15234.10.5 7a9f62ef8424 */
/* bench 18263.6.0 e8f2a22f1981 */
/* bench 18263.6.1 683fd209f81f */
/* bench 18263.6.2 deb08398d4c0 */
/* bench 18263.6.3 ed09e12e7b0d */
/* bench 18263.6.4 54fd647982f8 */
/* bench 18263.6.5 1538dada841b */
/* bench 18263.6.6 1384e211f72c */
/* bench 18263.6.7 cb2bd60834af */
/* bench 18263.6.8 f8a04f6ce950 */
/* bench 18263.6.9 1acb05d18fca */
	  This serves as an integrity check, but the availability of the
	  Merkle tree root hash also allows efficiently supporting
	  various use cases where normally the whole file would need to
	  be hashed at once, such as: (a) auditing (logging the file's
	  hash), or (b) authenticity verification (comparing the hash
	  against a known good value, e.g. from a digital signature).

	  fs-verity is especially useful on large files where not all
	  the contents may actually be needed.  Also, fs-verity verifies
	  data each time it is paged back in, which provides better
	  protection against malicious disks vs. an ahead-of-time hash.

	  If unsure, say N.

/* bench 21140.6.0 8a630676b39d */
/* bench 21140.6.1 b8040da96e52 */
/* bench 21140.6.2 fbf4de9ea314 */
/* bench 21140.6.3 ac7eea2aad31 */
	depends on FS_VERITY
	help
	  Enable debugging messages related to fs-verity by default.

	  Say N unless you are an fs-verity developer.

config FS_VERITY_BUILTIN_SIGNATURES
/* bench 24708.6.0 3bb2fea14ae4 */
/* bench 24827.2.0 8d9198221069 */
/* bench 24827.2.1 3dffb7e32ea9 */
/* bench 24827.2.2 66d19625deb3 */
/* bench 24827.2.3 9760882750ba */
/* bench 24827.2.4 70f5d4d50186 */
/* bench 24827.2.5 0975da34be92 */
/* bench 24827.2.6 6d27b1b51e9e */
/* bench 24827.2.7 2410166eebb1 */
/* bench 24827.2.8 b3a36c11ce68 */
/* bench 24827.2.9 caf8b36de670 */
/* bench 24708.6.3 b1add78c9b94 */
/* bench 24708.6.4 7987f24b6abf */
/* bench 24708.6.5 d14c89c7aba3 */
/* bench 24708.6.6 d50ee184ea6d */
/* bench 24708.6.7 173bed0a9967 */
/* bench 24708.6.8 756350e7f376 */
/* bench 24708.6.9 f9c1734f852a */
/* bench 1895.2.3 7d84e11298a3 */
/* bench 1895.2.4 283989243759 */
	help
	  Support verifying signatures of verity files against the X.509
	  certificates that have been loaded into the ".fs-verity"
	  kernel keyring.

	  This is meant as a relatively simple mechanism that can be
	  used to provide an authenticity guarantee for verity files, as
	  an alternative to IMA appraisal.  Userspace programs still
	  need to check that the verity bit is set in order to get an
	  authenticity guarantee.

	  If unsure, say N.
```

## fs/zonefs/Kconfig
```kconfig
FASTVC-BENCH-CORPUS:linux-main-100k-v1-e0bd41dc-8e12-4f1b-978d-a3645ae59da0
/* bench 11084.1.0 c9a55c364a92 */
/* bench 11084.1.1 c641372a0c22 */
/* bench 11084.1.2 4bd0d1a971e5 */
/* bench 11084.1.3 bcb997e88ebc */
/* bench 11084.1.4 817b490cf15b */
/* bench 11084.1.5 a6dacdc72d94 */
/* bench 11084.1.6 f3296f3b0632 */
/* bench 11084.1.7 23da76a60ae5 */
config ZONEFS_FS
	tristate "zonefs filesystem support"
	depends on BLOCK
	depends on BLK_DEV_ZONED
	select FS_IOMAP
/* bench 9664.4.0 31d5350c08de */
/* bench 9664.4.1 ac3d0dae1a67 */
/* bench 9664.4.2 2d1b985a8f8d */
/* bench 9664.4.3 4ee1724f2017 */
	select CRC32
	help
	  zonefs is a simple file system which exposes zones of a zoned block
	  device (e.g. host-managed or host-aware SMR disk drives) as files.

	  If unsure, say N.
```

## kernel/Kconfig.hz
```kconfig
FASTVC-BENCH-CORPUS:linux-main-100k-v1-e0bd41dc-8e12-4f1b-978d-a3645ae59da0
# SPDX-License-Identifier: GPL-2.0-only
#
# Timer Interrupt Frequency Configuration
#

choice
	prompt "Timer frequency"
	default HZ_250
/* bench 25408.4.0 468ee1b3bdc9 */
/* bench 25408.4.1 ed7f62e35455 */
/* bench 25408.4.2 0957207a0caa */
/* bench 25408.4.3 f9e873e1e642 */
/* bench 25408.4.4 8d04eaa46430 */
/* bench 25408.4.5 64649f7aa0ed */
/* bench 25408.4.6 dec547bfedc8 */
/* bench 25408.4.7 02acb304a24f */
/* bench 25408.4.8 3b7dbb973e2b */
/* bench 25408.4.9 288075323292 */
/* bench 25408.4.10 6047f25edef7 */
/* bench 25408.4.11 b5e45eef0a78 */
/* bench 25408.4.12 207e6011c538 */
	 beneficial for servers and NUMA systems that do not need to have
	 a fast response for user interaction and that may experience bus
	 contention and cacheline bounces as a result of timer interrupts.
	 Note that the timer interrupt occurs on each processor in an SMP
	 environment leading to NR_CPUS * HZ number of timer interrupts
	 per second.


	config HZ_100
		bool "100 HZ"
	help
	  100 Hz is a typical choice for servers, SMP and NUMA systems
	  with lots of processors that may show reduced performance if
	  too many timer interrupts are occurring.
/* bench 11904.3.0 9db91801ded0 */
/* bench 11904.3.1 8c8e25c713c3 */
/* bench 11904.3.2 33724c2bf815 */
/* bench 11904.3.3 9f1816474b7d */
/* bench 11904.3.4 1dfb236fa9b6 */
/* bench 11904.3.5 4cb0f46a61b3 */
/* bench 11904.3.6 95907d0ff3a9 */
/* bench 11904.3.7 4c40edc0d9f4 */
/* bench 11904.3.8 e59efcb6a61c */
/* bench 11904.3.9 7ac7c5a4ab45 */
	help
	 250 Hz is a good compromise choice allowing server performance
	 while also showing good interactive responsiveness even
	 on SMP and NUMA systems. If you are going to be using NTSC video
	 or multimedia, selected 300Hz instead.

	config HZ_300
		bool "300 HZ"
	help
	 300 Hz is a good compromise choice allowing server performance
	 while also showing good interactive responsiveness even
	 on SMP and NUMA systems and exactly dividing by both PAL and
	 NTSC frame rates for video and multimedia work.

	config HZ_1000
		bool "1000 HZ"
	help
	 1000 Hz is the preferred choice for desktop systems and other
	 systems requiring fast interactive responses to events.

endchoice

config HZ
	int
	default 100 if HZ_100
	default 250 if HZ_250
	default 300 if HZ_300
	default 1000 if HZ_1000

config SCHED_HRTICK
	def_bool HIGH_RES_TIMERS
```

## kernel/bpf/preload/Kconfig
```kconfig
FASTVC-BENCH-CORPUS:linux-main-100k-v1-e0bd41dc-8e12-4f1b-978d-a3645ae59da0
# SPDX-License-Identifier: GPL-2.0-only
/* bench 8989.3.0 056bed1fef51 */
/* bench 8989.3.1 9a54cfc8493c */
/* bench 8989.3.2 20f70bfe5e9a */
/* bench 8989.3.3 3d580a4feed9 */
/* bench 8989.3.4 27ed17665384 */
/* bench 8989.3.5 11c2b1ede9a4 */
/* bench 8989.3.6 ee100ee927ca */
/* bench 8989.3.7 177235891922 */
/* bench 8989.3.8 060faa7f0686 */
/* bench 8989.3.9 67cf78d90182 */
/* bench 8989.3.10 d13875e92618 */
/* bench 8989.3.11 11553d5c92b6 */
/* bench 8989.3.12 a45423607954 */
/* bench 8989.3.13 72ae3a3b27b6 */
config USERMODE_DRIVER
	bool
	default n

menuconfig BPF_PRELOAD
	bool "Preload BPF file system with kernel specific program and map iterators"
	depends on BPF
	depends on BPF_SYSCALL
	# The dependency on !COMPILE_TEST prevents it from being enabled
	# in allmodconfig or allyesconfig configurations
	depends on !COMPILE_TEST
	select USERMODE_DRIVER
	help
	  This builds kernel module with several embedded BPF programs that are
	  pinned into BPF FS mount point as human readable files that are
	  useful in debugging and introspection of BPF programs and maps.

/* bench 4304.6.0 cda4458d3aab */
/* bench 4304.6.1 118cf26041a0 */
/* bench 4304.6.2 ecb6de2cfb1e */
/* bench 4304.6.3 d050d2a02e05 */
/* bench 4304.6.4 768dc7e90ca0 */
/* bench 4304.6.5 1f2101f7f45c */
/* bench 4304.6.6 4b550b0fd49a */
/* bench 4304.6.7 b4d3303c60f6 */
/* bench 4304.6.8 4f3070f38c54 */
/* bench 4304.6.9 9fa66a2e293b */
/* bench 4304.6.10 112df7830fc6 */
/* bench 4304.6.11 72a3dbbcea5d */
config BPF_PRELOAD_UMD
	tristate "bpf_preload kernel module with user mode driver"
	depends on CC_CAN_LINK
	depends on m || CC_CAN_LINK_STATIC
	default m
	help
	  This builds bpf_preload kernel module with embedded user mode driver.
endif
```
