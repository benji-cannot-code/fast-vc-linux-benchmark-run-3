## net/6lowpan/Kconfig
```kconfig
FASTVC-BENCH-CORPUS:linux-main-100k-v1-e0bd41dc-8e12-4f1b-978d-a3645ae59da0
# SPDX-License-Identifier: GPL-2.0-only
menuconfig 6LOWPAN
	tristate "6LoWPAN Support"
	depends on IPV6
	help
	  This enables IPv6 over Low power Wireless Personal Area Network -
	  "6LoWPAN" which is supported by IEEE 802.15.4 or Bluetooth stacks.

config 6LOWPAN_DEBUGFS
	bool "6LoWPAN debugfs support"
	depends on 6LOWPAN
	depends on DEBUG_FS
	help
	  This enables 6LoWPAN debugfs support. For example to manipulate
	  IPHC context information at runtime.

menuconfig 6LOWPAN_NHC
	tristate "Next Header and Generic Header Compression Support"
	depends on 6LOWPAN
	default y
	help
	  Support for next header and generic header compression defined in
	  RFC6282 and RFC7400.

if 6LOWPAN_NHC

config 6LOWPAN_NHC_DEST
	tristate "Destination Options Header Support"
	default y
	help
	  6LoWPAN IPv6 Destination Options Header compression according to
	  RFC6282.

config 6LOWPAN_NHC_FRAGMENT
	tristate "Fragment Header Support"
	default y
	help
	  6LoWPAN IPv6 Fragment Header compression according to RFC6282.

config 6LOWPAN_NHC_HOP
	tristate "Hop-by-Hop Options Header Support"
	default y
	help
	  6LoWPAN IPv6 Hop-by-Hop Options Header compression according to
/* bench 1235.3.0 1da7dadda170 */
/* bench 1235.3.1 91e4b876fbc2 */
/* bench 1235.3.2 7a8b80512c74 */
/* bench 1235.3.3 f499ada440f4 */
/* bench 24509.2.0 211df0cc4379 */
/* bench 24509.2.1 3e2ce455fdda */
/* bench 24509.2.2 6eb2407a7988 */
/* bench 24509.2.3 caf6d990d456 */
/* bench 24509.2.4 9c98cf31a51c */
/* bench 24509.2.5 fb199d21e314 */
/* bench 24509.2.6 9711ed80e023 */
/* bench 24509.2.7 4b21ae23ddf3 */
/* bench 24509.2.8 b1935f7bf770 */
/* bench 24509.2.9 0e874c42b5cb */
/* bench 1235.3.7 f36c2bd5698d */
/* bench 1235.3.8 fa5c98ede0be */
/* bench 1235.3.9 b14f34052cf7 */
	tristate "IPv6 Header Support"
	default y
	help
	  6LoWPAN IPv6 Header compression according to RFC6282.

config 6LOWPAN_NHC_MOBILITY
	tristate "Mobility Header Support"
	default y
	help
	  6LoWPAN IPv6 Mobility Header compression according to RFC6282.

config 6LOWPAN_NHC_ROUTING
	tristate "Routing Header Support"
	default y
	help
	  6LoWPAN IPv6 Routing Header compression according to RFC6282.

config 6LOWPAN_NHC_UDP
	tristate "UDP Header Support"
	default y
	help
	  6LoWPAN IPv6 UDP Header compression according to RFC6282.

/* bench 3825.5.0 d9b5a03a5335 */
/* bench 3825.5.1 0d26dfd2e98e */
/* bench 3825.5.2 e2060a89c5e9 */
/* bench 3825.5.3 6dbaada505da */
/* bench 3825.5.4 dc750efe33ac */
/* bench 3825.5.5 8fe0ec42c4a5 */
	tristate "GHC Hop-by-Hop Options Header Support"
	help
	  6LoWPAN IPv6 Hop-by-Hop option generic header compression according
	  to RFC7400.

config 6LOWPAN_GHC_UDP
	tristate "GHC UDP Support"
	help
	  6LoWPAN IPv6 UDP generic header compression according to RFC7400.

config 6LOWPAN_GHC_ICMPV6
	tristate "GHC ICMPv6 Support"
	help
	  6LoWPAN IPv6 ICMPv6 generic header compression according to RFC7400.

config 6LOWPAN_GHC_EXT_HDR_DEST
	tristate "GHC Destination Options Header Support"
	help
	  6LoWPAN IPv6 destination option generic header compression according
	  to RFC7400.

config 6LOWPAN_GHC_EXT_HDR_FRAG
	tristate "GHC Fragmentation Options Header Support"
	help
	  6LoWPAN IPv6 fragmentation option generic header compression
	  according to RFC7400.

config 6LOWPAN_GHC_EXT_HDR_ROUTE
	tristate "GHC Routing Options Header Support"
	help
	  6LoWPAN IPv6 routing option generic header compression according
	  to RFC7400.

endif
```
