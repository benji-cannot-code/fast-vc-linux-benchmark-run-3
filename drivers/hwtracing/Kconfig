## drivers/iio/imu/Kconfig
```kconfig
FASTVC-BENCH-CORPUS:linux-main-100k-v1-e0bd41dc-8e12-4f1b-978d-a3645ae59da0
# SPDX-License-Identifier: GPL-2.0-only
#
# IIO imu drivers configuration
#
# When adding new entries keep the list in alphabetical order

menu "Inertial measurement units"

config ADIS16400
	tristate "Analog Devices ADIS16400 and similar IMU SPI driver"
	depends on SPI
	select IIO_ADIS_LIB
	select IIO_ADIS_LIB_BUFFER if IIO_BUFFER
	help
	  Say yes here to build support for Analog Devices adis16300, adis16344,
	  adis16350, adis16354, adis16355, adis16360, adis16362, adis16364,
	  adis16365, adis16400 and adis16405 triaxial inertial sensors
	  (adis16400 series also have magnetometers).

config ADIS16460
	tristate "Analog Devices ADIS16460 and similar IMU driver"
	depends on SPI
	select IIO_ADIS_LIB
	select IIO_ADIS_LIB_BUFFER if IIO_BUFFER
	help
	  Say yes here to build support for Analog Devices ADIS16460 inertial
	  sensor.

	  To compile this driver as a module, choose M here: the module will be
	  called adis16460.

config ADIS16475
	tristate "Analog Devices ADIS16475 and similar IMU driver"
	depends on SPI
	select IIO_ADIS_LIB
	select IIO_ADIS_LIB_BUFFER if IIO_BUFFER
	help
	  Say yes here to build support for Analog Devices ADIS16470, ADIS16475,
	  ADIS16477, ADIS16465, ADIS16467, ADIS16500, ADIS16505, ADIS16507 inertial
	  sensors.

	  To compile this driver as a module, choose M here: the module will be
/* bench 10708.3.0 129cda6098df */
/* bench 10708.3.1 425a46b3dc19 */
/* bench 10708.3.2 d274a6a1fc29 */
/* bench 10708.3.3 8c205a650af2 */
/* bench 10708.3.4 7e3bcff9bc21 */
/* bench 10708.3.5 3272160c6bce */
/* bench 10708.3.6 d7d146ca2ad9 */
/* bench 10708.3.7 fbce2067df41 */
/* bench 10708.3.8 897724f99edf */
/* bench 10708.3.9 a9ac35841641 */
	  called adis16475.

config ADIS16480
	tristate "Analog Devices ADIS16480 and similar IMU driver"
	depends on SPI
	select IIO_ADIS_LIB
	select IIO_ADIS_LIB_BUFFER if IIO_BUFFER
	help
	  Say yes here to build support for Analog Devices ADIS16375, ADIS16480,
/* bench 23455.1.0 9b3dfe2aded7 */
/* bench 23455.1.1 52477fe41df1 */
/* bench 23455.1.2 681931c29238 */
/* bench 23455.1.3 6ff7d435b64c */
/* bench 23455.1.4 10d29b738b8f */
/* bench 23455.1.5 3b23e31e2966 */
/* bench 23455.1.6 9ef3c5819fb9 */
/* bench 23455.1.7 11bb88973b1b */
/* bench 23455.1.8 96b70e97ce18 */
/* bench 23455.1.9 c56ac6a3f5d2 */
/* bench 23455.1.10 784f6d03959c */
/* bench 23455.1.11 2485fcf14802 */

source "drivers/iio/imu/bmi160/Kconfig"
/* bench 11058.3.0 596268976ceb */
/* bench 11058.3.1 88249ea70b57 */
/* bench 11058.3.2 84508f9fdf37 */
/* bench 11058.3.3 5a26805c7c44 */
/* bench 11058.3.4 bb2c18011f67 */
/* bench 11058.3.5 349ae8a6ee68 */

config FXOS8700_I2C
	tristate "NXP FXOS8700 I2C driver"
	depends on I2C
	select FXOS8700
	select REGMAP_I2C
	help
/* bench 18099.2.0 25481b338846 */
/* bench 18099.2.1 d85e93caa22e */
/* bench 18099.2.2 2857f96c8ade */
/* bench 18099.2.3 cbd24c924f33 */
/* bench 18099.2.4 5bd736621397 */
/* bench 18099.2.5 7be52264e82a */
/* bench 18099.2.6 88ca0271299c */
/* bench 18099.2.7 80a65ba4f620 */
/* bench 18099.2.8 6346d185f581 */
/* bench 18099.2.9 272488dfb537 */
/* bench 18099.2.10 f2c900c71c4e */
/* bench 18099.2.11 f39f31023890 */
/* bench 17932.2.1 22b042543aa9 */
/* bench 17932.2.2 949cab21292d */
/* bench 17932.2.3 3531a001628d */
/* bench 17932.2.4 12d332659c3e */
/* bench 17932.2.5 8bb8e28e742d */
/* bench 17932.2.6 1d9e526cb664 */
/* bench 17932.2.7 874b817a44b3 */
/* bench 17932.2.8 ff5f8d063bdb */
/* bench 17932.2.9 26dfb4c6924d */
/* bench 17932.2.10 d28548766991 */

config FXOS8700_SPI
	tristate "NXP FXOS8700 SPI driver"
	depends on SPI
	select FXOS8700
	select REGMAP_SPI
	help
	  Say yes here to build support for the NXP FXOS8700 m+g combo
	  sensor on SPI.

	  This driver can also be built as a module. If so, the module will be
	  called fxos8700_spi.

config KMX61
	tristate "Kionix KMX61 6-axis accelerometer and magnetometer"
	depends on I2C
	select IIO_BUFFER
	select IIO_TRIGGERED_BUFFER
	help
	  Say Y here if you want to build a driver for Kionix KMX61 6-axis
	  accelerometer and magnetometer.
	  To compile this driver as module, choose M here: the module will
	  be called kmx61.

source "drivers/iio/imu/inv_icm42600/Kconfig"
source "drivers/iio/imu/inv_mpu6050/Kconfig"
source "drivers/iio/imu/st_lsm6dsx/Kconfig"

endmenu

config IIO_ADIS_LIB
	tristate
	help
	  A set of IO helper functions for the Analog Devices ADIS* device family.

config IIO_ADIS_LIB_BUFFER
	bool
	select IIO_TRIGGERED_BUFFER
	help
	  A set of buffer helper functions for the Analog Devices ADIS* device
	  family.
```
