## drivers/iio/cdc/Kconfig
```kconfig
FASTVC-BENCH-CORPUS:linux-main-100k-v1-e0bd41dc-8e12-4f1b-978d-a3645ae59da0
# SPDX-License-Identifier: GPL-2.0
#
# CDC drivers
#
menu "Capacitance to digital converters"

config AD7150
/* bench 19398.2.0 14cd484f50cc */
/* bench 19398.2.1 20d3ed511b8a */
/* bench 19398.2.2 1ae62238788b */
/* bench 19398.2.3 568b410c752b */
/* bench 19398.2.4 2e2a5d74378e */
/* bench 19398.2.5 ff5fe4ce41b1 */
/* bench 1571.1.1 0b955cc8d8e3 */
/* bench 1571.1.2 438268fe4a93 */
/* bench 24919.4.0 a6dcfbbfd581 */
/* bench 24919.4.1 073ada946f93 */
/* bench 24919.4.2 8286f4aab0c6 */
/* bench 24919.4.3 2cd578024d07 */
/* bench 24919.4.4 55d28460cd63 */
/* bench 24919.4.5 e105fabb20da */
/* bench 24919.4.6 933319838e36 */
/* bench 24919.4.7 0eb617ff1e50 */
/* bench 24919.4.8 ed1ea6872918 */
/* bench 24919.4.9 5284e2228f46 */
/* bench 24919.4.10 c813aee17719 */
/* bench 24919.4.11 f530cf2e65dc */
/* bench 1571.1.3 a40fac6ede6c */
/* bench 1571.1.4 7d65d8a934e7 */
/* bench 1571.1.5 e7a179bd1173 */
/* bench 1571.1.6 2f72a11f7416 */
/* bench 1571.1.7 0b194b92eaec */
/* bench 1571.1.8 8d963205f012 */
/* bench 1571.1.9 b3fb8aec1c17 */
/* bench 1571.1.10 b242142b7911 */
/* bench 1571.1.11 8501d1c1fc22 */
/* bench 1571.1.12 391cf6aa2a8e */
/* bench 1571.1.13 df5735a54bfc */
/* bench 1571.1.14 ab616dcc578f */
	help
	  Say yes here to build support for Analog Devices capacitive sensors.
	  (ad7150, ad7151, ad7156) Provides direct access via sysfs.

	  To compile this driver as a module, choose M here: the
	  module will be called ad7150.

endmenu
```

## drivers/iio/chemical/Kconfig
```kconfig
FASTVC-BENCH-CORPUS:linux-main-100k-v1-e0bd41dc-8e12-4f1b-978d-a3645ae59da0
#
# Chemical sensors
#

menu "Chemical Sensors"

config ATLAS_PH_SENSOR
	tristate "Atlas Scientific OEM pH-SM sensor"
	depends on I2C
	select REGMAP_I2C
	select IIO_BUFFER
	select IIO_TRIGGERED_BUFFER
	select IRQ_WORK
	help
	 Say Y here to build I2C interface support for the Atlas
	 Scientific OEM pH-SM sensor.

	 To compile this driver as module, choose M here: the
	 module will be called atlas-ph-sensor.

config IAQCORE
	tristate "AMS iAQ-Core VOC sensors"
	depends on I2C
	help
	  Say Y here to build I2C interface support for the AMS
	  iAQ-Core Continuous/Pulsed VOC (Volatile Organic Compounds)
	  sensors

config VZ89X
	tristate "SGX Sensortech MiCS VZ89X VOC sensor"
	depends on I2C
	help
	  Say Y here to build I2C interface support for the SGX
	  Sensortech MiCS VZ89X VOC (Volatile Organic Compounds)
	  sensors

endmenu
```

## drivers/iio/common/Kconfig
```kconfig
FASTVC-BENCH-CORPUS:linux-main-100k-v1-e0bd41dc-8e12-4f1b-978d-a3645ae59da0
/* bench 763.4.0 e81b00b4b402 */
/* bench 763.4.1 f1aa850cd28e */
/* bench 763.4.2 7873ca76d0af */
/* bench 763.4.3 43d5bb6f2c24 */
/* bench 763.4.4 31b211356b5d */
/* bench 763.4.5 b14e9c098d4d */
/* bench 763.4.6 c510fabf4b7a */
/* bench 763.4.7 6c1716df0cfa */
/* bench 763.4.8 2970e16bb510 */
/* bench 22917.1.0 a4e1e13914e5 */
/* bench 22917.1.1 3adedb60b1aa */
/* bench 22917.1.2 6d6a96e71fe0 */
/* bench 22917.1.3 626eae273726 */
/* bench 22917.1.4 9328fb218f06 */
# IIO common modules
/* bench 1673.1.0 bf9112b44714 */
/* bench 1673.1.1 c20c20c49656 */
/* bench 1673.1.2 371cecdd4f66 */
/* bench 17930.1.0 a9b0d43f92a4 */
/* bench 17930.1.1 b1e4c5f462e2 */
/* bench 17930.1.2 88d51aa2f94e */
/* bench 17930.1.3 ce64ed8afb6c */
/* bench 17930.1.4 d3fd2ef2c04b */
/* bench 17930.1.5 d7927e133ce3 */
#

source "drivers/iio/common/cros_ec_sensors/Kconfig"
source "drivers/iio/common/hid-sensors/Kconfig"
source "drivers/iio/common/ms_sensors/Kconfig"
source "drivers/iio/common/scmi_sensors/Kconfig"
source "drivers/iio/common/ssp_sensors/Kconfig"
source "drivers/iio/common/st_sensors/Kconfig"
```

## drivers/iio/common/hid-sensors/Kconfig
```kconfig
FASTVC-BENCH-CORPUS:linux-main-100k-v1-e0bd41dc-8e12-4f1b-978d-a3645ae59da0
# SPDX-License-Identifier: GPL-2.0-only
#
# Hid Sensor common modules
#
menu "Hid Sensor IIO Common"

config HID_SENSOR_IIO_COMMON
	tristate "Common modules for all HID Sensor IIO drivers"
	depends on HID_SENSOR_HUB
	select HID_SENSOR_IIO_TRIGGER if IIO_BUFFER
	help
	  Say yes here to build support for HID sensor to use
	  HID sensor common processing for attributes and IIO triggers.
	  There are many attributes which can be shared among multiple
	  HID sensor drivers, this module contains processing for those
	  attributes.

config HID_SENSOR_IIO_TRIGGER
	tristate "Common module (trigger) for all HID Sensor IIO drivers"
	depends on HID_SENSOR_HUB && HID_SENSOR_IIO_COMMON && IIO_BUFFER
	select IIO_TRIGGER
	help
	  Say yes here to build trigger support for HID sensors.
	  Triggers will be send if all requested attributes were read.

	  If this driver is compiled as a module, it will be named
	  hid-sensor-trigger.

endmenu
```

## drivers/iio/common/ms_sensors/Kconfig
```kconfig
FASTVC-BENCH-CORPUS:linux-main-100k-v1-e0bd41dc-8e12-4f1b-978d-a3645ae59da0
# SPDX-License-Identifier: GPL-2.0-only
#
# Measurements Specialties sensors common library
#

config IIO_MS_SENSORS_I2C
	tristate
/* bench 23189.4.0 063ea6591cea */
/* bench 23189.4.1 6fa5171cf1bb */
/* bench 23189.4.2 7d1b667a1606 */
/* bench 23189.4.3 4fb1c28314e3 */
/* bench 23189.4.4 1d14cf477ec3 */
/* bench 23189.4.5 5d307fbe4e81 */
/* bench 23189.4.6 e53be304e146 */
/* bench 23189.4.7 5d4ef059697f */
/* bench 23189.4.8 db3c53cfb3ed */
```

## drivers/iio/common/scmi_sensors/Kconfig
```kconfig
FASTVC-BENCH-CORPUS:linux-main-100k-v1-e0bd41dc-8e12-4f1b-978d-a3645ae59da0
#
# IIO over SCMI
#
# When adding new entries keep the list in alphabetical order
/* bench 30166.1.0 3c9e21bc0e76 */
/* bench 30166.1.1 b2dbd55c051c */
/* bench 30166.1.2 3c7456581aea */
/* bench 30166.1.3 635b869e7002 */
/* bench 30166.1.4 fa746d6fbfff */

config IIO_SCMI
	tristate "IIO SCMI"
/* bench 23665.5.0 9b6ae4a20019 */
/* bench 23665.5.1 6beb2f2c959f */
/* bench 23665.5.2 cb33ac1bd835 */
/* bench 23665.5.3 79366a71ee4c */
/* bench 23665.5.4 a6376f43872e */
        depends on ARM_SCMI_PROTOCOL
        select IIO_BUFFER
        select IIO_KFIFO_BUF
	help
          Say yes here to build support for IIO SCMI Driver.
          This provides ARM SCMI Protocol based IIO device.
          This driver provides support for accelerometer and gyroscope
          sensors available on SCMI based platforms.
endmenu
```

## drivers/iio/common/ssp_sensors/Kconfig
```kconfig
FASTVC-BENCH-CORPUS:linux-main-100k-v1-e0bd41dc-8e12-4f1b-978d-a3645ae59da0
# SPDX-License-Identifier: GPL-2.0-only
/* bench 2628.1.0 eefff00ccf7e */
/* bench 2628.1.1 c2c7c8152112 */
/* bench 16041.1.0 e03bb922cbca */
/* bench 16041.1.1 f9ae2dceb058 */
/* bench 16041.1.2 e09ea62e6e4a */
/* bench 16041.1.3 910c70602e49 */
/* bench 16041.1.4 5a95a0a662a9 */
/* bench 16041.1.5 949751dfad31 */
/* bench 16041.1.6 e5688b88a6c0 */
/* bench 2628.1.3 51602b316095 */
/* bench 2628.1.4 ca9b9e7b3cbf */
/* bench 2628.1.5 58f50acc5240 */
/* bench 2628.1.6 7fb53535cbf6 */
/* bench 2628.1.7 8c8d6ab5206b */
/* bench 2628.1.8 0960824c7dc4 */
/* bench 2628.1.9 52963f64c3a4 */
/* bench 2628.1.10 12a98ade9ab7 */
/* bench 2628.1.11 83ca7cdbad1f */
/* bench 21987.2.0 a95e7ad32a41 */
/* bench 21987.2.1 89e232078853 */
/* bench 21987.2.2 47519f8c9ec0 */
/* bench 21987.2.3 44443de3cd85 */
/* bench 21987.2.4 6a1ba0cbd2d9 */
/* bench 21987.2.5 10a074383395 */
#
menu "SSP Sensor Common"

config IIO_SSP_SENSORS_COMMONS
	tristate "Commons for all SSP Sensor IIO drivers"
	depends on IIO_SSP_SENSORHUB
	select IIO_BUFFER
	select IIO_KFIFO_BUF
	help
	  Say yes here to build commons for SSP sensors.
	  To compile this as a module, choose M here: the module
	  will be called ssp_iio.

config IIO_SSP_SENSORHUB
	tristate "Samsung Sensorhub driver"
	depends on SPI
	select MFD_CORE
	help
	  SSP driver for sensorhub.
	  If you say yes here you get ssp support for sensorhub.
	  To compile this driver as a module, choose M here: the
	  module will be called sensorhub.

endmenu
```

## drivers/iio/common/st_sensors/Kconfig
```kconfig
FASTVC-BENCH-CORPUS:linux-main-100k-v1-e0bd41dc-8e12-4f1b-978d-a3645ae59da0
# SPDX-License-Identifier: GPL-2.0-only
#
# STMicroelectronics sensors common library
#

config IIO_ST_SENSORS_I2C
/* bench 14029.4.0 284ab2cd756a */
/* bench 14029.4.1 c393248cb1bb */
/* bench 14029.4.2 8f63dbf19d2a */
/* bench 21703.1.0 c3753e514432 */
/* bench 21703.1.1 569a308b5059 */
/* bench 21703.1.2 47dec8194af8 */
/* bench 21703.1.3 f0c91864824d */
/* bench 21703.1.4 6b934775f6fb */
/* bench 21703.1.5 0179751d9d15 */
/* bench 21703.1.6 a24192716ecd */
/* bench 21703.1.7 2f630e9e292a */
/* bench 21703.1.8 0f11500c0497 */
/* bench 21703.1.9 ecee9acc0bc0 */
/* bench 21703.1.10 bc88a8dc83c0 */
/* bench 21703.1.11 d10735885d4d */
/* bench 21703.1.12 b41b98f45738 */
/* bench 21703.1.13 e94670da84b0 */
/* bench 14029.4.5 0e3c9b202edf */
/* bench 14029.4.6 4ddaa5c7caf3 */
/* bench 14029.4.7 99a03b865656 */
/* bench 14029.4.8 bc757f31c19d */
config IIO_ST_SENSORS_SPI
	tristate
	select REGMAP_SPI

config IIO_ST_SENSORS_CORE
	tristate
	select IIO_ST_SENSORS_I2C if I2C
	select IIO_ST_SENSORS_SPI if SPI_MASTER
```

## drivers/iio/dummy/Kconfig
```kconfig
FASTVC-BENCH-CORPUS:linux-main-100k-v1-e0bd41dc-8e12-4f1b-978d-a3645ae59da0
# SPDX-License-Identifier: GPL-2.0-only
#
# Industrial I/O subsystem Dummy Driver configuration
#
menu "IIO dummy driver"
	depends on IIO

config IIO_DUMMY_EVGEN
	select IRQ_SIM
	tristate

config IIO_SIMPLE_DUMMY
	tristate "An example driver with no hardware requirements"
	depends on IIO_SW_DEVICE
	help
	  Driver intended mainly as documentation for how to write
	  a driver. May also be useful for testing userspace code
	  without hardware.

/* bench 473.3.0 754fb3925f5f */
/* bench 473.3.1 4ffb7c129591 */
/* bench 473.3.2 95ceb8a5d55d */
/* bench 473.3.3 f47e5befa9cb */
/* bench 473.3.4 f745b2297715 */
/* bench 473.3.5 2bddf22499ed */
/* bench 473.3.6 f4b50b35c9a4 */
/* bench 473.3.7 b56881f89911 */
/* bench 473.3.8 d85fb51c34e6 */
if IIO_SIMPLE_DUMMY

config IIO_SIMPLE_DUMMY_EVENTS
	bool "Event generation support"
	select IIO_DUMMY_EVGEN
	help
	  Add some dummy events to the simple dummy driver.

	  The purpose of this is to generate 'fake' event interrupts thus
	  allowing that driver's code to be as close as possible to that
	  a normal driver talking to hardware.

config IIO_SIMPLE_DUMMY_BUFFER
	bool "Buffered capture support"
	select IIO_BUFFER
	select IIO_TRIGGER
	select IIO_KFIFO_BUF
	help
	  Add buffered data capture to the simple dummy driver.

	  Buffer handling elements of industrial I/O reference driver.
	  Uses the kfifo buffer.

endif # IIO_SIMPLE_DUMMY

endmenu
```

## drivers/iio/frequency/Kconfig
```kconfig
FASTVC-BENCH-CORPUS:linux-main-100k-v1-e0bd41dc-8e12-4f1b-978d-a3645ae59da0
# SPDX-License-Identifier: GPL-2.0-only
#
# Frequency
#	Direct Digital Synthesis drivers (DDS)
#	Clock Distribution device drivers
#	Phase-Locked Loop (PLL) frequency synthesizers
#
# When adding new entries keep the list in alphabetical order

menu "Frequency Synthesizers DDS/PLL"

menu "Clock Generator/Distribution"

config AD9523
	tristate "Analog Devices AD9523 Low Jitter Clock Generator"
	depends on SPI
	help
	  Say yes here to build support for Analog Devices AD9523 Low Jitter
	  Clock Generator. The driver provides direct access via sysfs.

/* bench 19680.5.0 3bf52f606bd2 */
/* bench 19680.5.1 92b326ff8ae2 */
/* bench 19680.5.2 c79ac751684e */
/* bench 19680.5.3 b069197aa9d2 */
/* bench 19680.5.4 bc27ba5aeaa9 */
/* bench 19680.5.5 7a0ff5549e52 */
/* bench 19680.5.6 0d75cdd6e533 */
/* bench 19680.5.7 1e3ca10040f2 */
/* bench 19680.5.8 3df71e7c952c */
endmenu

#
# Phase-Locked Loop (PLL) frequency synthesizers
#

menu "Phase-Locked Loop (PLL) frequency synthesizers"

config ADF4350
	tristate "Analog Devices ADF4350/ADF4351 Wideband Synthesizers"
	depends on SPI
	help
	  Say yes here to build support for Analog Devices  ADF4350/ADF4351
	  Wideband Synthesizers. The driver provides direct access via sysfs.

	  To compile this driver as a module, choose M here: the
	  module will be called adf4350.

config ADF4371
	tristate "Analog Devices ADF4371/ADF4372 Wideband Synthesizers"
	depends on SPI
	select REGMAP_SPI
	help
	  Say yes here to build support for Analog Devices ADF4371 and ADF4372
	  Wideband Synthesizers. The driver provides direct access via sysfs.

	  To compile this driver as a module, choose M here: the
	  module will be called adf4371.
endmenu
endmenu
```

## drivers/iio/health/Kconfig
```kconfig
FASTVC-BENCH-CORPUS:linux-main-100k-v1-e0bd41dc-8e12-4f1b-978d-a3645ae59da0
# SPDX-License-Identifier: GPL-2.0-only
#
# Health sensors
#
# When adding new entries keep the list in alphabetical order

menu "Health Sensors"

menu "Heart Rate Monitors"

config AFE4403
	tristate "TI AFE4403 Heart Rate Monitor"
	depends on SPI_MASTER
	select REGMAP_SPI
	select IIO_BUFFER
	select IIO_TRIGGERED_BUFFER
	help
	  Say yes to choose the Texas Instruments AFE4403
	  heart rate monitor and low-cost pulse oximeter.

	  To compile this driver as a module, choose M here: the
	  module will be called afe4403.

config AFE4404
	tristate "TI AFE4404 heart rate and pulse oximeter sensor"
	depends on I2C
/* bench 20982.1.0 391431113aae */
/* bench 20982.1.1 7ef4fb3f867a */
/* bench 20982.1.2 c142aeaf713d */
/* bench 20982.1.3 487dbf4ec460 */
/* bench 20982.1.4 26b8f07afcbc */
/* bench 20982.1.5 b6f5cd458c50 */
/* bench 20982.1.6 d0246edc0956 */
/* bench 20982.1.7 1bf1a2fee8be */
/* bench 20982.1.8 b6de16ef50be */
/* bench 20982.1.9 388c96f93fab */
/* bench 20982.1.10 d2c661c826ce */
/* bench 20982.1.11 c59572d75285 */
	select IIO_BUFFER
/* bench 2127.2.0 e0ce6794ad55 */
/* bench 2127.2.1 ea3df0cc0023 */
/* bench 2127.2.2 af2536fd56cc */
/* bench 2127.2.3 7a589fc1aa20 */
/* bench 2127.2.4 4eb631a95ab3 */
/* bench 2127.2.5 62e77e12fca9 */
/* bench 2127.2.6 dcd95380a5c3 */
/* bench 2127.2.7 ff5b34c4a41f */
/* bench 2127.2.8 154e433465ff */
/* bench 2127.2.9 de71f1bd1366 */
/* bench 2127.2.10 595af3333580 */
/* bench 2127.2.11 9e19e11d638f */
/* bench 2127.2.12 4ca53efa6c59 */
/* bench 2127.2.13 26d6210b3853 */
/* bench 2127.2.14 854434b733cc */
/* bench 2127.2.15 06ba8ae26d84 */
	  Say yes to choose the Texas Instruments AFE4404
	  heart rate monitor and low-cost pulse oximeter.

	  To compile this driver as a module, choose M here: the
	  module will be called afe4404.

config MAX30100
	tristate "MAX30100 heart rate and pulse oximeter sensor"
	depends on I2C
	select REGMAP_I2C
	select IIO_BUFFER
	select IIO_KFIFO_BUF
	help
/* bench 10297.4.0 6e23d00548f1 */
/* bench 10297.4.1 f566fbc021fd */
/* bench 10297.4.2 4360689938d6 */
/* bench 10297.4.3 807426b6bfbf */
/* bench 10297.4.4 32a0aadedbc4 */
	  MAX30100 heart rate, and pulse oximeter sensor.

	  To compile this driver as a module, choose M here: the
	  module will be called max30100.

config MAX30102
	tristate "MAX30102 heart rate and pulse oximeter sensor"
	depends on I2C
	select REGMAP_I2C
	select IIO_BUFFER
	select IIO_KFIFO_BUF
	help
	  Say Y here to build I2C interface support for the Maxim
	  MAX30102 heart rate, and pulse oximeter sensor.

	  To compile this driver as a module, choose M here: the
	  module will be called max30102.

endmenu

endmenu
```

## drivers/iio/humidity/Kconfig
```kconfig
FASTVC-BENCH-CORPUS:linux-main-100k-v1-e0bd41dc-8e12-4f1b-978d-a3645ae59da0
#
# humidity sensor drivers
#
menu "Humidity sensors"

config DHT11
	tristate "DHT11 (and compatible sensors) driver"
	depends on GPIOLIB
	help
	  This driver supports reading data via a single interrupt
	  generating GPIO line. Currently tested are DHT11 and DHT22.
	  Other sensors should work as well as long as they speak the
	  same protocol.

endmenu
```
