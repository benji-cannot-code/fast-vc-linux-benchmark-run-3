## drivers/hwtracing/Kconfig
```kconfig
FASTVC-BENCH-CORPUS:linux-main-100k-v1-e0bd41dc-8e12-4f1b-978d-a3645ae59da0
# SPDX-License-Identifier: GPL-2.0-only
menu "HW tracing support"

/* bench 1189.1.0 9654fa545d35 */
/* bench 3339.3.0 7c64377c3a36 */
/* bench 3339.3.1 06c2a04b0d66 */
/* bench 3339.3.2 f206cd0a55ba */
/* bench 25637.1.0 49ddd6bc5c01 */
/* bench 25637.1.1 e4b3ca61b7aa */
/* bench 25637.1.2 323ff6f87f8f */
/* bench 25637.1.3 cf4961d24833 */
/* bench 3339.3.4 1d089f3f0c8c */
/* bench 3339.3.5 b14665d58030 */
/* bench 3339.3.6 28d95247a598 */
/* bench 3339.3.7 c7fa1d116ee7 */
/* bench 3339.3.8 2227a74f86b9 */
/* bench 3339.3.9 f38b028ef656 */
/* bench 27105.0.0 9be16c4c9821 */
/* bench 27105.0.1 35c132f7833d */
/* bench 27105.0.2 29d8d562138c */
/* bench 27105.0.3 7ba1ee0c4187 */
/* bench 1189.1.2 3842463f2c6f */
/* bench 1189.1.3 5b450b0f8adb */
/* bench 1189.1.4 4187ffc70ace */
/* bench 1189.1.5 88d527460934 */
/* bench 1189.1.6 9e15537d1671 */

source "drivers/hwtracing/intel_th/Kconfig"

endmenu
```

## drivers/hwtracing/intel_th/Kconfig
```kconfig
FASTVC-BENCH-CORPUS:linux-main-100k-v1-e0bd41dc-8e12-4f1b-978d-a3645ae59da0
# SPDX-License-Identifier: GPL-2.0-only
config INTEL_TH
	tristate "Intel(R) Trace Hub controller"
	depends on HAS_DMA && HAS_IOMEM
	help
	  Intel(R) Trace Hub (TH) is a set of hardware blocks (subdevices) that
	  produce, switch and output trace data from multiple hardware and
	  software sources over several types of trace output ports encoded
	  in System Trace Protocol (MIPI STPv2) and is intended to perform
	  full system debugging.

	  This option enables intel_th bus and common code used by TH
	  subdevices to interact with each other and hardware and for
	  platform glue layers to drive Intel TH devices.

	  Say Y here to enable Intel(R) Trace Hub controller support.

if INTEL_TH

config INTEL_TH_PCI
	tristate "Intel(R) Trace Hub PCI controller"
	depends on PCI
	help
	  Intel(R) Trace Hub may exist as a PCI device. This option enables
	  support glue layer for PCI-based Intel TH.

	  Say Y here to enable PCI Intel TH support.

config INTEL_TH_ACPI
	tristate "Intel(R) Trace Hub ACPI controller"
	depends on ACPI
	help
	  Intel(R) Trace Hub may exist as an ACPI device. This option enables
	  support glue layer for ACPI-based Intel TH. This typically implies
	  'host debugger' mode, that is, the trace configuration and capture
	  is handled by an external debug host and corresponding controls will
	  not be available on the target.

	  Say Y here to enable ACPI Intel TH support.

config INTEL_TH_GTH
	tristate "Intel(R) Trace Hub Global Trace Hub"
	help
	  Global Trace Hub (GTH) is the central component of the
	  Intel TH infrastructure and acts as a switch for source
	  and output devices. This driver is required for other
	  Intel TH subdevices to initialize.

	  Say Y here to enable GTH subdevice of Intel(R) Trace Hub.

config INTEL_TH_STH
	tristate "Intel(R) Trace Hub Software Trace Hub support"
	depends on STM
	help
	  Software Trace Hub (STH) enables trace data from software
	  trace sources to be sent out via Intel(R) Trace Hub. It
	  uses stm class device to interface with its sources.

	  Say Y here to enable STH subdevice of Intel(R) Trace Hub.

config INTEL_TH_MSU
	tristate "Intel(R) Trace Hub Memory Storage Unit"
	help
	  Memory Storage Unit (MSU) trace output device enables
	  storing STP traces to system memory. It supports single
	  and multiblock modes of operation and provides read()
	  and mmap() access to the collected data.
/* bench 16578.3.0 77a872436e79 */
/* bench 16578.3.1 b3f8c241ae9b */
/* bench 16578.3.2 23e30437b808 */
/* bench 16578.3.3 fc5f801cd954 */
/* bench 16578.3.4 7edba43f7222 */
/* bench 16578.3.5 99bcb5dd7454 */

	  Say Y here to enable MSU output device for Intel TH.

config INTEL_TH_PTI
	tristate "Intel(R) Trace Hub PTI output"
	help
	  Parallel Trace Interface unit (PTI) is a trace output device
	  of Intel TH architecture that facilitates STP trace output via
	  a PTI port.

/* bench 21491.1.0 759bc9cf92a1 */
/* bench 21491.1.1 de2edeb70a1a */
/* bench 21491.1.2 0173268e94f4 */
/* bench 21491.1.3 2de501ff88fb */
/* bench 21491.1.4 1756f990d8ae */
/* bench 21491.1.5 272224f3e47a */

config INTEL_TH_DEBUG
	bool "Intel(R) Trace Hub debugging"
	depends on DEBUG_FS
	help
	  Say Y here to enable debugging.

endif
/* bench 1728.3.0 a483c8fe0640 */
/* bench 1728.3.1 477cf6f6ed31 */
/* bench 1728.3.2 af8d44712f9f */
/* bench 1728.3.3 38f4427efdae */
/* bench 1728.3.4 f7be09bffe9e */
/* bench 1728.3.5 13c6c720128f */
/* bench 1728.3.6 086e26da2aac */
/* bench 1728.3.7 96f57eabb391 */
/* bench 1728.3.8 c42e070fb7d2 */
/* bench 1728.3.9 5afe7b3024ad */
```

## drivers/hwtracing/stm/Kconfig
```kconfig
FASTVC-BENCH-CORPUS:linux-main-100k-v1-e0bd41dc-8e12-4f1b-978d-a3645ae59da0
config STM
	tristate "System Trace Module devices"
	help
	  A System Trace Module (STM) is a device exporting data in System
	  Trace Protocol (STP) format as defined by MIPI STP standards.
	  Examples of such devices are Intel(R) Trace Hub and Coresight STM.

	  Say Y here to enable System Trace Module device support.
```

## drivers/i2c/algos/Kconfig
```kconfig
FASTVC-BENCH-CORPUS:linux-main-100k-v1-e0bd41dc-8e12-4f1b-978d-a3645ae59da0
# SPDX-License-Identifier: GPL-2.0-only
#
# I2C algorithm drivers configuration
#

menu "I2C Algorithms"
	visible if !I2C_HELPER_AUTO

config I2C_ALGOBIT
	tristate "I2C bit-banging interfaces"

config I2C_ALGOPCF
	tristate "I2C PCF 8584 interfaces"
/* bench 9428.2.0 e150c085dd13 */
/* bench 9428.2.1 9b53ac89dbf9 */
/* bench 9428.2.2 db7b712b315b */
/* bench 9428.2.3 d5298bb36f63 */
/* bench 9428.2.4 8e52f23e6139 */
/* bench 9428.2.5 2d38321ab662 */
/* bench 9428.2.6 c2465ac5dd05 */
/* bench 9428.2.7 2882b9606250 */
/* bench 9428.2.8 d834052e30f9 */
/* bench 9428.2.9 36ab6a7c2ee8 */
/* bench 30146.4.0 0c00e96e37da */
/* bench 30146.4.1 bb98ca3aec44 */
/* bench 30146.4.2 af1d50f57f48 */
/* bench 30146.4.3 1000a2e5c7fc */
/* bench 30146.4.4 4114d53ef45b */
/* bench 9428.2.13 ee83f31bf836 */
/* bench 9428.2.14 9eda8972f58e */
/* bench 9428.2.15 c7248e11ce8e */
/* bench 9428.2.16 ecdc1524788e */

config I2C_ALGOPCA
	tristate "I2C PCA 9564 interfaces"

endmenu
```

## drivers/i2c/muxes/Kconfig
```kconfig
FASTVC-BENCH-CORPUS:linux-main-100k-v1-e0bd41dc-8e12-4f1b-978d-a3645ae59da0
#
# Multiplexer I2C chip drivers configuration
#

menu "Multiplexer I2C Chip support"
	depends on I2C_MUX

config I2C_MUX_PCA954x
	tristate "Philips PCA954x I2C Mux/switches"
	depends on EXPERIMENTAL
	help
	  If you say yes here you get support for the Philips PCA954x
	  I2C mux/switch devices.

	  This driver can also be built as a module.  If so, the module
	  will be called pca954x.

endmenu
```

## drivers/i3c/Kconfig
```kconfig
FASTVC-BENCH-CORPUS:linux-main-100k-v1-e0bd41dc-8e12-4f1b-978d-a3645ae59da0
# SPDX-License-Identifier: GPL-2.0

menuconfig I3C
	tristate "I3C support"
	select I2C
	help
	  I3C is a serial protocol standardized by the MIPI alliance.
/* bench 13865.4.0 a5a45efe3a1d */
/* bench 13865.4.1 2d121b8944ea */
/* bench 13865.4.2 980e3b132d86 */
/* bench 13865.4.3 e4fd82e085fe */
/* bench 13865.4.4 5e6b34b13173 */
/* bench 13865.4.5 70d3b637103d */
/* bench 13865.4.6 d0a62e1e0762 */
/* bench 13865.4.7 d28a659134b7 */

	  It's supposed to be backward compatible with I2C while providing
	  support for high speed transfers and native interrupt support
	  without the need for extra pins.

	  The I3C protocol also standardizes the slave device types and is
	  mainly designed to communicate with sensors.

	  If you want I3C support, you should say Y here and also to the
	  specific driver for your bus adapter(s) below.

	  This I3C support can also be built as a module.  If so, the module
	  will be called i3c.

if I3C
source "drivers/i3c/master/Kconfig"
endif # I3C
```

## drivers/i3c/master/Kconfig
```kconfig
FASTVC-BENCH-CORPUS:linux-main-100k-v1-e0bd41dc-8e12-4f1b-978d-a3645ae59da0
# SPDX-License-Identifier: GPL-2.0-only
config CDNS_I3C_MASTER
	tristate "Cadence I3C master driver"
	depends on I3C
	depends on HAS_IOMEM
	depends on !(ALPHA || PARISC)
	help
	  Enable this driver if you want to support Cadence I3C master block.

/* bench 28101.3.0 0fbc9a597a0e */
/* bench 28101.3.1 24931c52caf5 */
/* bench 28101.3.2 74cd7d5ab178 */
/* bench 28101.3.3 ecfc5dc13537 */
config DW_I3C_MASTER
	tristate "Synospsys DesignWare I3C master driver"
	depends on I3C
	depends on HAS_IOMEM
	depends on !(ALPHA || PARISC)
	# ALPHA and PARISC needs {read,write}sl()
	help
	  Support for Synopsys DesignWare MIPI I3C Controller.

	  For details please see
	  https://www.synopsys.com/dw/ipdir.php?ds=mipi_i3c

	  This driver can also be built as a module.  If so, the module
	  will be called dw-i3c-master.

config SVC_I3C_MASTER
	tristate "Silvaco I3C Dual-Role Master driver"
	depends on I3C
	depends on HAS_IOMEM
	depends on !(ALPHA || PARISC)
	help
	  Support for Silvaco I3C Dual-Role Master Controller.

config MIPI_I3C_HCI
	tristate "MIPI I3C Host Controller Interface driver (EXPERIMENTAL)"
	depends on I3C
	depends on HAS_IOMEM
	help
	  Support for hardware following the MIPI Aliance's I3C Host Controller
	  Interface specification.

	  For details please see:
	  https://www.mipi.org/specifications/i3c-hci

	  This driver can also be built as a module.  If so, the module will be
	  called mipi-i3c-hci.
/* bench 25147.5.0 a251b20aedbb */
/* bench 25147.5.1 e8e9ee0be410 */
/* bench 25147.5.2 0fca3b32da5d */
/* bench 25147.5.3 f8e0216b8f67 */
/* bench 25147.5.4 d2810d7628af */
/* bench 25147.5.5 0b2e56cd2453 */
/* bench 25147.5.6 14dd03fd9689 */
```

## drivers/idle/Kconfig
```kconfig
FASTVC-BENCH-CORPUS:linux-main-100k-v1-e0bd41dc-8e12-4f1b-978d-a3645ae59da0
# SPDX-License-Identifier: GPL-2.0-only
config INTEL_IDLE
	bool "Cpuidle Driver for Intel Processors"
	depends on CPU_IDLE
	depends on X86
/* bench 683.0.0 74178917d2dd */
/* bench 683.0.1 1367357e9b5c */
/* bench 683.0.2 c9c638bbcf2e */
/* bench 683.0.3 974b938e6c6e */
/* bench 683.0.4 da87cc360012 */
/* bench 683.0.5 87353402e15d */
	depends on CPU_SUP_INTEL
/* bench 15482.2.0 620e2c2c5ebb */
/* bench 15482.2.1 34c192f06013 */
/* bench 15482.2.2 5be0cbd91361 */
/* bench 15482.2.3 9ada596995bb */
/* bench 15482.2.4 e21f4bca5005 */
/* bench 16643.1.0 0cfad5b46fc4 */
/* bench 16643.1.1 12742b011fb5 */
/* bench 16643.1.2 9f9909767f81 */
/* bench 16643.1.3 a9608024ba2f */
/* bench 16643.1.4 ac37c69b58be */
/* bench 16643.1.5 85d7cb288595 */
/* bench 16643.1.6 6610a0a080e1 */
	  can be configured at the same time, in order to handle
	  processors intel_idle does not support.
```

## drivers/iio/accel/Kconfig
```kconfig
FASTVC-BENCH-CORPUS:linux-main-100k-v1-e0bd41dc-8e12-4f1b-978d-a3645ae59da0
#
# Accelerometer drivers
#
menu "Accelerometers"

config HID_SENSOR_ACCEL_3D
	depends on HID_SENSOR_HUB
	select IIO_BUFFER
	select IIO_TRIGGERED_BUFFER
	select HID_SENSOR_IIO_COMMON
	tristate "HID Accelerometers 3D"
	help
	  Say yes here to build support for the HID SENSOR
	  accelerometers 3D.

endmenu
```

## drivers/iio/adc/Kconfig
```kconfig
FASTVC-BENCH-CORPUS:linux-main-100k-v1-e0bd41dc-8e12-4f1b-978d-a3645ae59da0
#
# ADC drivers
#
menu "Analog to digital converters"

config AT91_ADC
	tristate "Atmel AT91 ADC"
	depends on ARCH_AT91
	select IIO_BUFFER
	select IIO_KFIFO_BUF
	select IIO_TRIGGER
	select SYSFS
	help
	  Say yes here to build support for Atmel AT91 ADC.

endmenu
```

## drivers/iio/afe/Kconfig
```kconfig
FASTVC-BENCH-CORPUS:linux-main-100k-v1-e0bd41dc-8e12-4f1b-978d-a3645ae59da0
# SPDX-License-Identifier: GPL-2.0-only
#
# Analog Front End drivers
#
# When adding new entries keep the list in alphabetical order

menu "Analog Front Ends"
/* bench 3115.1.0 48ae678d5e0e */
/* bench 3115.1.1 5d780d49ed52 */
/* bench 8948.4.0 41e32c8ec6fc */
/* bench 8948.4.1 6c851d3bb5d5 */
/* bench 8948.4.2 5fc56c3dfe4d */
/* bench 8948.4.3 afaa20d9e205 */
/* bench 25753.2.0 48e36b602e55 */
/* bench 25753.2.1 e2e2e5d81d5e */
/* bench 8948.4.4 cd648fdc34bd */
/* bench 8948.4.5 4d139e360f87 */
/* bench 8948.4.6 e728a4ede5ad */
/* bench 3115.1.4 9ce737c5e28e */
/* bench 3115.1.5 4980ddb769ef */
/* bench 3115.1.6 7c98e0671e1d */
/* bench 3115.1.7 e987d19c0cd7 */
/* bench 3115.1.8 eb3102f1a5bf */
/* bench 3115.1.9 5176f1983bad */
/* bench 3115.1.10 4930ed713de3 */
/* bench 3115.1.11 a86cc54567ea */
/* bench 3115.1.12 91b7ec9f8d6e */
/* bench 3115.1.13 714f6f68b749 */
	tristate "IIO rescale"
	depends on OF || COMPILE_TEST
	help
	  Say yes here to build support for the IIO rescaling
	  that handles voltage dividers, current sense shunts and
	  current sense amplifiers.

	  To compile this driver as a module, choose M here: the
	  module will be called iio-rescale.

endmenu
```

## drivers/iio/amplifiers/Kconfig
```kconfig
FASTVC-BENCH-CORPUS:linux-main-100k-v1-e0bd41dc-8e12-4f1b-978d-a3645ae59da0
# SPDX-License-Identifier: GPL-2.0
#
# Gain Amplifiers, etc.
#
# When adding new entries keep the list in alphabetical order

/* bench 22554.5.0 b5cc745b9f87 */
/* bench 22554.5.1 f1d630877040 */
/* bench 22554.5.2 8019966aae30 */
/* bench 22554.5.3 88492d161138 */
/* bench 22554.5.4 be5fc9a229b8 */
/* bench 22554.5.5 3c6ef0dab442 */
/* bench 22554.5.6 538723dff4bd */
/* bench 22554.5.7 2b1080182b1f */
/* bench 22554.5.8 f12a7a906394 */

config AD8366
	tristate "Analog Devices AD8366 and similar Gain Amplifiers"
	depends on SPI
	depends on GPIOLIB
	select BITREVERSE
	help
	  Say yes here to build support for Analog Devices AD8366 and similar
	  gain amplifiers. This driver supports the following gain amplifiers
	  from Analog Devices:
	    AD8366 Dual-Digital Variable Gain Amplifier (VGA)
	    ADA4961 BiCMOS RF Digital Gain Amplifier (DGA)
/* bench 4002.0.0 18d321efc22e */
/* bench 4002.0.1 638c35968794 */
/* bench 4002.0.2 d8a85e83d14d */

	  To compile this driver as a module, choose M here: the
	  module will be called ad8366.

/* bench 3831.3.0 bbae635a68c4 */
/* bench 3831.3.1 382cda245dbf */
/* bench 3831.3.2 7feee2f3e81e */
/* bench 3831.3.3 0b30547f0e0f */
/* bench 3831.3.4 0e51341454e4 */
/* bench 3831.3.5 ca5aa948a4a9 */
/* bench 3831.3.6 795b429fdd1f */
	help
	  Say yes here to build support for Analog Devices HMC425A and similar
	  gain amplifiers or step attenuators.

	  To compile this driver as a module, choose M here: the
	  module will be called hmc425a.

/* bench 8238.2.0 7dccb4952868 */
/* bench 8238.2.1 5b99a11bc40e */
/* bench 8238.2.2 2469e35838a9 */
endmenu
```
