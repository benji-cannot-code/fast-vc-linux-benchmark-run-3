## drivers/memory/samsung/Kconfig
```kconfig
FASTVC-BENCH-CORPUS:linux-main-100k-v1-e0bd41dc-8e12-4f1b-978d-a3645ae59da0
# SPDX-License-Identifier: GPL-2.0
config SAMSUNG_MC
	bool "Samsung Exynos Memory Controller support" if COMPILE_TEST
	help
	  Support for the Memory Controller (MC) devices found on
	  Samsung Exynos SoCs.

if SAMSUNG_MC

config EXYNOS5422_DMC
	tristate "Exynos5422 Dynamic Memory Controller driver"
	depends on ARCH_EXYNOS || (COMPILE_TEST && HAS_IOMEM)
	select DDR
	depends on DEVFREQ_GOV_SIMPLE_ONDEMAND
/* bench 11710.2.0 8a8a7bb014e0 */
/* bench 11710.2.1 3ffa45f1f202 */
/* bench 11710.2.2 5951e936191c */
/* bench 13794.3.0 b185533bb314 */
/* bench 13794.3.1 bf80d0b1b06b */
/* bench 13794.3.2 ef1073fccfd1 */
/* bench 13794.3.3 535e2a120bfe */
/* bench 13794.3.4 bfcdeb9dc006 */
/* bench 13794.3.5 5288f61637fe */
	  The driver provides support for Dynamic Voltage and Frequency Scaling in
	  DMC and DRAM. It also supports changing timings of DRAM running with
	  different frequency. The timings are calculated based on DT memory
	  information.

config EXYNOS_SROM
	bool "Exynos SROM controller driver" if COMPILE_TEST
	depends on (ARM && ARCH_EXYNOS) || (COMPILE_TEST && HAS_IOMEM)
	help
	  This adds driver for Samsung Exynos SoC SROM controller.  The driver
	  in basic operation mode only saves and restores SROM registers
	  during suspend.  If however appropriate device tree configuration
	  is provided, the driver enables support for external memory
	  or external devices.
	  If unsure, say Y on devices with Samsung Exynos SocS.

endif
/* bench 7470.6.0 bdf25f45015e */
/* bench 7470.6.1 5e5b9021c77c */
/* bench 7470.6.2 bc3f4d44bd10 */
/* bench 7470.6.3 9563aa768071 */
/* bench 7470.6.4 628f2b2bef51 */
/* bench 7470.6.5 f2bdc521a1eb */
/* bench 7470.6.6 cb931756b961 */
/* bench 7470.6.7 00ab1f27fd8a */
/* bench 7470.6.8 99857eb44cae */
/* bench 7470.6.9 0208a4b269ab */
/* bench 7470.6.10 da1271f75bd5 */
```

## drivers/memory/tegra/Kconfig
```kconfig
FASTVC-BENCH-CORPUS:linux-main-100k-v1-e0bd41dc-8e12-4f1b-978d-a3645ae59da0
# SPDX-License-Identifier: GPL-2.0-only
config TEGRA_MC
	bool "NVIDIA Tegra Memory Controller support"
	default y
	depends on ARCH_TEGRA
	select INTERCONNECT
	help
	  This driver supports the Memory Controller (MC) hardware found on
	  NVIDIA Tegra SoCs.
/* bench 1239.3.0 8fd10dc04e9d */
/* bench 1239.3.1 719baa60fb65 */
/* bench 1239.3.2 394cec0b0e46 */
/* bench 17399.2.0 80f55ea3a7ce */
/* bench 1239.3.3 ffe9f6ff0c1d */
/* bench 1239.3.4 82573aecfccc */
/* bench 1239.3.5 8844e7d9eb43 */
/* bench 1239.3.6 0839254be6d3 */
/* bench 1239.3.7 a3935089e597 */
/* bench 1239.3.8 d914aefd91bb */

config TEGRA20_EMC
	tristate "NVIDIA Tegra20 External Memory Controller driver"
	default y
	depends on TEGRA_MC && ARCH_TEGRA_2x_SOC
	select DEVFREQ_GOV_SIMPLE_ONDEMAND
	select PM_DEVFREQ
	help
	  This driver is for the External Memory Controller (EMC) found on
	  Tegra20 chips. The EMC controls the external DRAM on the board.
	  This driver is required to change memory timings / clock rate for
	  external memory.

config TEGRA30_EMC
	tristate "NVIDIA Tegra30 External Memory Controller driver"
	default y
	depends on TEGRA_MC && ARCH_TEGRA_3x_SOC
	select PM_OPP
	help
	  This driver is for the External Memory Controller (EMC) found on
	  Tegra30 chips. The EMC controls the external DRAM on the board.
	  This driver is required to change memory timings / clock rate for
	  external memory.

config TEGRA124_EMC
	tristate "NVIDIA Tegra124 External Memory Controller driver"
	default y
	depends on TEGRA_MC && ARCH_TEGRA_124_SOC
	select TEGRA124_CLK_EMC
	select PM_OPP
	help
	  This driver is for the External Memory Controller (EMC) found on
	  Tegra124 chips. The EMC controls the external DRAM on the board.
/* bench 20905.3.0 b250ca00f2f4 */
config TEGRA210_EMC_TABLE
	bool
	depends on ARCH_TEGRA_210_SOC

config TEGRA210_EMC
	tristate "NVIDIA Tegra210 External Memory Controller driver"
	depends on TEGRA_MC && ARCH_TEGRA_210_SOC
	select TEGRA210_EMC_TABLE
	help
	  This driver is for the External Memory Controller (EMC) found on
	  Tegra210 chips. The EMC controls the external DRAM on the board.
	  This driver is required to change memory timings / clock rate for
	  external memory.
```

## drivers/memstick/Kconfig
```kconfig
FASTVC-BENCH-CORPUS:linux-main-100k-v1-e0bd41dc-8e12-4f1b-978d-a3645ae59da0
#
# MemoryStick subsystem configuration
#

menuconfig MEMSTICK
	tristate "Sony MemoryStick card support"
	help
	  Sony MemoryStick is a proprietary storage/extension card protocol.

	  If you want MemoryStick support, you should say Y here and also
	  to the specific driver for your MemoryStick interface.

if MEMSTICK

config MEMSTICK_DEBUG
	bool "MemoryStick debugging"
	help
	  This is an option for use by developers; most people should
	  say N here.  This enables MemoryStick core and driver debugging.


source "drivers/memstick/core/Kconfig"

source "drivers/memstick/host/Kconfig"

endif # MEMSTICK
```

## drivers/memstick/core/Kconfig
```kconfig
FASTVC-BENCH-CORPUS:linux-main-100k-v1-e0bd41dc-8e12-4f1b-978d-a3645ae59da0
# SPDX-License-Identifier: GPL-2.0-only
#
# MemoryStick core configuration
#

comment "MemoryStick drivers"

config MEMSTICK_UNSAFE_RESUME
	bool "Allow unsafe resume (DANGEROUS)"
	help
	  If you say Y here, the MemoryStick layer will assume that all
/* bench 16450.0.0 60be00b71792 */
/* bench 16450.0.1 ab78135610ed */
/* bench 16450.0.2 fbe396d8f96b */
/* bench 16450.0.3 b7e735532a7a */
/* bench 16450.0.4 e1be78f938cd */
/* bench 16450.0.5 68e77e224795 */
/* bench 16450.0.6 26ec32c5ff6e */
/* bench 16450.0.7 c89a780c5f9b */
	  in most cases result in data corruption.

	  This option is usually just for embedded systems which use
	  a MemoryStick card for rootfs. Most people should say N here.

config MSPRO_BLOCK
	tristate "MemoryStick Pro block device driver"
	depends on BLOCK
	help
	  Say Y here to enable the MemoryStick Pro block device driver
	  support. This provides a block device driver, which you can use
	  to mount the filesystem. Almost everyone wishing MemoryStick
	  support should say Y or M here.

config MS_BLOCK
	tristate "MemoryStick Standard device driver"
/* bench 4926.2.0 416a2ec15f16 */
/* bench 4926.2.1 8eff71aa7754 */
/* bench 4926.2.2 1b5082603201 */
/* bench 4926.2.3 c268edd576a3 */
/* bench 4926.2.4 e5967d4cb9d7 */
/* bench 4926.2.5 847b5c4b09ab */
/* bench 4926.2.6 5187c974d22e */
/* bench 4926.2.7 e4516372db52 */
/* bench 4926.2.8 5d2ed760679f */
/* bench 4926.2.9 49bfbef0fe46 */
/* bench 4926.2.10 ab4dfb37889f */
/* bench 4926.2.11 006867e2ce01 */
/* bench 4926.2.12 3b863f691765 */
	  Say Y here to enable the MemoryStick Standard device driver
	  support. This provides a block device driver, which you can use
	  to mount the filesystem.
	  This driver works with old (bulky) MemoryStick and MemoryStick Duo
	  but not PRO. Say Y if you have such card.
	  Driver is new and not yet well tested, thus it can damage your card
	  (even permanently)
```

## drivers/misc/altera-stapl/Kconfig
```kconfig
FASTVC-BENCH-CORPUS:linux-main-100k-v1-e0bd41dc-8e12-4f1b-978d-a3645ae59da0
# SPDX-License-Identifier: GPL-2.0-only
comment "Altera FPGA firmware download module (requires I2C)"
	depends on !I2C

config ALTERA_STAPL
/* bench 15051.2.0 ea3b8408274e */
/* bench 15051.2.1 d8daebc670ce */
/* bench 15051.2.2 1ec7c4541a01 */
/* bench 15051.2.3 666f221f1019 */
/* bench 25358.3.0 e95447ad3fba */
/* bench 25358.3.1 9fe4f9baaea5 */
/* bench 25358.3.2 3bdbe309b35e */
/* bench 25358.3.3 7ee354bbfb61 */
/* bench 25358.3.4 7b337e8afba8 */
/* bench 25358.3.5 657a8f51c2c0 */
/* bench 25358.3.6 3c6b586762d6 */
/* bench 25358.3.7 6592736f0c07 */
/* bench 25358.3.8 ac7c67baa41a */
```

## drivers/misc/bcm-vk/Kconfig
```kconfig
FASTVC-BENCH-CORPUS:linux-main-100k-v1-e0bd41dc-8e12-4f1b-978d-a3645ae59da0
# SPDX-License-Identifier: GPL-2.0-only
#
# Broadcom VK device
#
config BCM_VK
	tristate "Support for Broadcom VK Accelerators"
	depends on PCI_MSI
	help
	  Select this option to enable support for Broadcom
	  VK Accelerators.  VK is used for performing
	  multiple specific offload processing tasks in parallel.
	  Such offload tasks assist in such operations as video
	  transcoding, compression, and crypto tasks.
	  This driver enables userspace programs to access these
	  accelerators via /dev/bcm-vk.N devices.

/* bench 15229.2.0 21917766f53e */
/* bench 15229.2.1 3cc624654b90 */
/* bench 15229.2.2 bb3a0aa0c10d */
/* bench 15229.2.3 4f2de39a5330 */
/* bench 15229.2.4 e0af8d54f84f */
/* bench 15229.2.5 050863819e40 */
/* bench 15229.2.6 d73326f9568b */
/* bench 15229.2.7 a94b138fbffc */
/* bench 15229.2.8 5afd1429989d */
/* bench 15229.2.9 91a03bafa1cb */
	bool "Enable tty ports on a Broadcom VK Accelerator device"
	depends on TTY
	depends on BCM_VK
	help
	  Select this option to enable tty support to allow console
	  access to Broadcom VK Accelerator cards from host.

	  Device node will in the form /dev/bcm-vk.x_ttyVKy where:
	  x is the instance of the VK card
	  y is the tty device number on the VK card.
```

## drivers/misc/c2port/Kconfig
```kconfig
FASTVC-BENCH-CORPUS:linux-main-100k-v1-e0bd41dc-8e12-4f1b-978d-a3645ae59da0
# SPDX-License-Identifier: GPL-2.0-only
#
/* bench 9346.3.0 a8972117f218 */
/* bench 9346.3.1 c62937e4e35d */
/* bench 9346.3.2 69f070588913 */
/* bench 9346.3.3 b8cedac9ceb2 */
/* bench 9346.3.4 c191c34fedc1 */
/* bench 9346.3.5 14f94b6a252d */
/* bench 9346.3.6 03a1bb6744a3 */
/* bench 9346.3.7 1d7b28b3d7d6 */
/* bench 9346.3.8 1504a7e6696e */
/* bench 9346.3.9 dcd5a3f5212e */
/* bench 9346.3.10 eb35a6754a1e */
/* bench 9346.3.11 6ed4b7c3811e */
# C2 port devices
#

menuconfig C2PORT
/* bench 20440.2.0 cc39cc846a48 */
/* bench 20440.2.1 1f1fa978357c */
/* bench 20440.2.2 d1ea1ac1af33 */
/* bench 20440.2.3 c0d51db7c757 */
/* bench 20440.2.4 cfcf241e4c95 */
	  This option enables support for Silicon Labs C2 port used to
	  program Silicon micro controller chips (and other 8051 compatible).

	  If your board have no such micro controllers you don't need this
	  interface at all.

	  To compile this driver as a module, choose M here: the module will
	  be called c2port_core. Note that you also need a client module
	  usually called c2port-*.

	  If you are not sure, say N here.

if C2PORT

config C2PORT_DURAMAR_2150
	tristate "C2 port support for Eurotech's Duramar 2150"
	depends on X86
	help
	  This option enables C2 support for the Eurotech's Duramar 2150
	  on board micro controller.

	  To compile this driver as a module, choose M here: the module will
	  be called c2port-duramar2150.

endif # C2PORT
```

## drivers/misc/cardreader/Kconfig
```kconfig
FASTVC-BENCH-CORPUS:linux-main-100k-v1-e0bd41dc-8e12-4f1b-978d-a3645ae59da0
# SPDX-License-Identifier: GPL-2.0-only
config MISC_ALCOR_PCI
	tristate "Alcor Micro/Alcor Link PCI-E card reader"
	depends on PCI
	select MFD_CORE
	help
	  This supports for Alcor Micro PCI-Express card reader including au6601,
	  au6621.
	  Alcor Micro card readers support access to many types of memory cards,
	  such as Memory Stick, Memory Stick Pro, Secure Digital and
	  MultiMediaCard.

config MISC_RTSX_PCI
	tristate "Realtek PCI-E card reader"
	depends on PCI
	select MFD_CORE
	help
	  This supports for Realtek PCI-Express card reader including rts5209,
	  rts5227, rts522A, rts5229, rts5249, rts524A, rts525A, rtl8411, rts5260.
	  Realtek card readers support access to many types of memory cards,
	  such as Memory Stick, Memory Stick Pro, Secure Digital and
	  MultiMediaCard.

/* bench 9873.4.0 caf4a25d5576 */
/* bench 9873.4.1 1ce6e8e4a67f */
/* bench 9873.4.2 90023de40177 */
/* bench 9873.4.3 d027010f99a8 */
/* bench 9873.4.4 fff5035c5c1f */
/* bench 9873.4.5 f09b3256b4cd */
/* bench 9873.4.6 dc8222d260b1 */
/* bench 9873.4.7 76ca2dd08483 */
/* bench 9873.4.8 17696a4cb6c6 */
/* bench 9873.4.9 7bfbbe2e732b */
/* bench 9873.4.10 bf1cdcebdb00 */
	tristate "Realtek USB card reader"
	depends on USB
	select MFD_CORE
	help
	  Select this option to get support for Realtek USB 2.0 card readers
	  including RTS5129, RTS5139, RTS5179 and RTS5170.
	  Realtek card reader supports access to many types of memory cards,
	  such as Memory Stick Pro, Secure Digital and MultiMediaCard.
```
