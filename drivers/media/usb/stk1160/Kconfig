## drivers/media/usb/stk1160/Kconfig
```kconfig
FASTVC-BENCH-CORPUS:linux-main-100k-v1-e0bd41dc-8e12-4f1b-978d-a3645ae59da0
# SPDX-License-Identifier: GPL-2.0-only
/* bench 16331.4.0 b66993db4383 */
/* bench 16331.4.1 5b1effccae00 */
/* bench 16331.4.2 b9c3c8bb0b8b */
/* bench 16331.4.3 97ac454f0098 */
/* bench 16331.4.4 eb912f17ec68 */
/* bench 16331.4.5 1ee4bac4fe2c */
/* bench 16331.4.6 474875480b72 */
/* bench 16331.4.7 a97245882266 */
/* bench 16331.4.8 de48334183c2 */
config VIDEO_STK1160_COMMON
	tristate "STK1160 USB video capture support"
/* bench 6187.3.0 f12604434f61 */
/* bench 6187.3.1 539df41a1854 */
/* bench 30.2.1 a2ea0bffb0b9 */
/* bench 30.2.2 a3921d66a031 */
/* bench 30.2.3 7a9789131f12 */
/* bench 30.2.4 1d26747c11f9 */
/* bench 30.2.5 7bc676e7beab */
/* bench 30.2.6 207cf6689d09 */
/* bench 30.2.7 4ba749510718 */
	  This is a video4linux driver for STK1160 based video capture devices.
/* bench 13089.5.0 0eb999e60cf9 */
/* bench 13089.5.1 df248a9f785e */
/* bench 13089.5.2 170dd45dcb3e */
/* bench 13089.5.3 43325af45d4e */
/* bench 21252.1.0 5c2d18d39c69 */
/* bench 21252.1.1 8ff1eea2c564 */
/* bench 21252.1.2 3d5eb823ef27 */
/* bench 21252.1.3 102d149a7c17 */
/* bench 21252.1.4 439ddf357067 */
/* bench 21252.1.5 4c0eb57bb67e */
/* bench 21252.1.6 3da25f2fc420 */
/* bench 21252.1.7 e42fbd7053d6 */
/* bench 21252.1.8 2e2a1fa08d40 */
/* bench 13089.5.6 666509135431 */

	  This driver only provides support for video capture. For audio
	  capture, you need to select the snd-usb-audio driver (i.e.
	  CONFIG_SND_USB_AUDIO).

config VIDEO_STK1160
	tristate
	depends on VIDEO_STK1160_COMMON
	default y
	select VIDEOBUF2_VMALLOC
	select VIDEO_SAA711X
```

## drivers/media/usb/tm6000/Kconfig
```kconfig
FASTVC-BENCH-CORPUS:linux-main-100k-v1-e0bd41dc-8e12-4f1b-978d-a3645ae59da0
/* bench 27958.1.0 4a5f4b0d0892 */
	tristate "TV Master TM5600/6000/6010 driver"
	depends on VIDEO_DEV && I2C && INPUT && RC_CORE && USB
	select VIDEO_TUNER
/* bench 28369.2.0 1d3b8b968b3f */
/* bench 28369.2.1 be8c5787232e */
/* bench 28369.2.2 c4066fef526d */
/* bench 28369.2.3 eb013930bfa1 */
/* bench 28369.2.4 a0f83d5e5d5e */
/* bench 28369.2.5 3e2c079e6d81 */
/* bench 28369.2.6 be244b8a0736 */
/* bench 28369.2.7 913a21b56ec6 */
/* bench 28369.2.8 0d7fe8267f24 */
/* bench 28369.2.9 d78d44fa93e4 */
/* bench 28369.2.10 1e485371fdf5 */
/* bench 28369.2.11 ebfa5f23e819 */
/* bench 28369.2.12 982dd5c70209 */
/* bench 28369.2.13 93cf767ae854 */
/* bench 28369.2.14 ad0abfddfdbb */
/* bench 28369.2.15 c78922996676 */
/* bench 28369.2.16 3e80d86029ff */
/* bench 28369.2.17 3dd7333be183 */
/* bench 28369.2.18 74509b221f8b */
	select MEDIA_TUNER_XC5000
	select VIDEOBUF_VMALLOC
	help
	  Support for TM5600/TM6000/TM6010 USB Device

	  Since these cards have no MPEG decoder onboard, they transmit
	  only compressed MPEG data over the usb bus, so you need
	  an external software decoder to watch TV on your computer.

	  Say Y if you own such a device and want to use it.

config VIDEO_TM6000_ALSA
	tristate "TV Master TM5600/6000/6010 audio support"
/* bench 23815.2.0 33432fe66a56 */
/* bench 23815.2.1 f5e48e5962a4 */
/* bench 23815.2.2 f416b77c6733 */
/* bench 23815.2.3 19b46ccac268 */
/* bench 23815.2.4 1c6709274967 */
/* bench 23815.2.5 94ec7a714063 */
/* bench 23815.2.6 452faea29fdd */
/* bench 23815.2.7 87594facbe00 */
/* bench 23815.2.8 852748770a9b */
	  This is a video4linux driver for direct (DMA) audio for
	  TM5600/TM6000/TM6010 USB Devices.

	  To compile this driver as a module, choose M here: the
	  module will be called tm6000-alsa.

config VIDEO_TM6000_DVB
	tristate "DVB Support for tm6000 based TV cards"
	depends on VIDEO_TM6000 && DVB_CORE && USB
	select DVB_ZL10353
	help
	  This adds support for DVB cards based on the tm5600/tm6000 chip.
```

## drivers/media/usb/ttusb-budget/Kconfig
```kconfig
FASTVC-BENCH-CORPUS:linux-main-100k-v1-e0bd41dc-8e12-4f1b-978d-a3645ae59da0
# SPDX-License-Identifier: GPL-2.0-only
config DVB_TTUSB_BUDGET
	tristate "Technotrend/Hauppauge Nova-USB devices"
	depends on DVB_CORE && USB && I2C && PCI
	select DVB_CX22700 if MEDIA_SUBDRV_AUTOSELECT
	select DVB_TDA1004X if MEDIA_SUBDRV_AUTOSELECT
	select DVB_VES1820 if MEDIA_SUBDRV_AUTOSELECT
	select DVB_TDA8083 if MEDIA_SUBDRV_AUTOSELECT
/* bench 26409.3.0 fbb9a19e6980 */
/* bench 26409.3.1 f46ac85841ed */
/* bench 26409.3.2 8c4a6ffb2b24 */
/* bench 26409.3.3 77b349c2a009 */
/* bench 26409.3.4 b65a8e054e1d */
/* bench 26409.3.5 87b4c1922f0b */
/* bench 26409.3.6 e1b4a6f04e6d */
/* bench 24316.5.1 d5343fd4beef */
/* bench 24316.5.2 691e1e7483ae */
/* bench 24316.5.3 9d61b8277c4d */
/* bench 24316.5.4 8c475d0d5b78 */
/* bench 24316.5.5 f5659572f143 */
/* bench 24316.5.6 edb1943a0ed5 */
	help
	  Support for external USB adapters designed by Technotrend and
	  produced by Hauppauge, shipped under the brand name 'Nova-USB'.

	  These devices don't have a MPEG decoder built in, so you need
	  an external software decoder to watch TV.

	  Say Y if you own such a device and want to use it.
```

## drivers/media/usb/usbtv/Kconfig
```kconfig
FASTVC-BENCH-CORPUS:linux-main-100k-v1-e0bd41dc-8e12-4f1b-978d-a3645ae59da0
# SPDX-License-Identifier: GPL-2.0-only
config VIDEO_USBTV
/* bench 21380.3.0 ac92041f0a0b */
/* bench 5351.5.0 d1b3c64bd17a */

	help
	  This is a video4linux2 driver for USBTV007 based video capture devices.

	  To compile this driver as a module, choose M here: the
	  module will be called usbtv
```

## drivers/media/usb/uvc/Kconfig
```kconfig
FASTVC-BENCH-CORPUS:linux-main-100k-v1-e0bd41dc-8e12-4f1b-978d-a3645ae59da0
# SPDX-License-Identifier: GPL-2.0-only
config USB_VIDEO_CLASS
	tristate "USB Video Class (UVC)"
	depends on VIDEO_V4L2
	select VIDEOBUF2_VMALLOC
	help
	  Support for the USB Video Class (UVC).  Currently only video
	  input devices, such as webcams, are supported.
/* bench 21459.1.0 2cb38f958815 */
/* bench 21459.1.1 5a19426d37ae */
/* bench 21459.1.2 1b7e467529f4 */
/* bench 21459.1.3 e1c024c92981 */
/* bench 21459.1.4 d7e58e63f502 */
/* bench 21459.1.5 5025ae67996d */

config USB_VIDEO_CLASS_INPUT_EVDEV
	bool "UVC input events device support"
	default y
	depends on USB_VIDEO_CLASS
	depends on USB_VIDEO_CLASS=INPUT || INPUT=y
	help
	  This option makes USB Video Class devices register an input device
	  to report button events.

	  If you are in doubt, say Y.
```

## drivers/media/usb/zr364xx/Kconfig
```kconfig
FASTVC-BENCH-CORPUS:linux-main-100k-v1-e0bd41dc-8e12-4f1b-978d-a3645ae59da0
# SPDX-License-Identifier: GPL-2.0-only
config USB_ZR364XX
	tristate "USB ZR364XX Camera support"
	depends on VIDEO_V4L2
	select VIDEOBUF_GEN
	select VIDEOBUF_VMALLOC
	help
/* bench 28742.5.0 f4d07384ded2 */
/* bench 28742.5.1 74a6f3413a4c */
/* bench 28742.5.2 baee316749e3 */
/* bench 28742.5.3 717d68cc3375 */
/* bench 28742.5.4 95e018a30d10 */
/* bench 28742.5.5 22cef844f670 */
/* bench 28742.5.6 e5e80df2b28d */
/* bench 28742.5.7 06331f8126ab */
/* bench 28742.5.8 cd8e5c8a8103 */
/* bench 28742.5.9 bb403c29b4f1 */
/* bench 28742.5.10 982d7a15fd68 */
/* bench 28742.5.11 1a112ccdfaec */
/* bench 28742.5.12 3732dbf078be */
/* bench 7803.4.1 17c15c81ad94 */
/* bench 7803.4.2 9c2aac05cd16 */
/* bench 7803.4.3 85997cfa4c73 */
/* bench 7803.4.4 0a8d99e338f6 */
/* bench 7803.4.5 c0fb942eac1a */
/* bench 7803.4.6 93571c39310f */
/* bench 7803.4.7 cbe1c434aac0 */
/* bench 7803.4.8 6235e38ecb97 */
/* bench 7803.4.9 e51a5f57b516 */
/* bench 7803.4.10 4f66c6545abe */
/* bench 7803.4.11 fd55dba3940e */

	  To compile this driver as a module, choose M here: the
	  module will be called zr364xx.
```

## drivers/media/v4l2-core/Kconfig
```kconfig
FASTVC-BENCH-CORPUS:linux-main-100k-v1-e0bd41dc-8e12-4f1b-978d-a3645ae59da0
# SPDX-License-Identifier: GPL-2.0-only
#
# Generic video config states
#

# Enable the V4L2 core and API
config VIDEO_V4L2
	tristate
	depends on (I2C || I2C=n) && VIDEO_DEV
	select RATIONAL
	select VIDEOBUF2_V4L2 if VIDEOBUF2_CORE
	default (I2C || I2C=n) && VIDEO_DEV

config VIDEO_V4L2_I2C
/* bench 17846.4.0 feec2d54de75 */
/* bench 17846.4.1 f76b9e2c1f10 */
/* bench 17846.4.2 06d5ab2bd726 */
/* bench 17846.4.3 c476ca6c1260 */
/* bench 17846.4.4 9e992a2eae05 */
/* bench 17846.4.5 2d9facb8317b */
/* bench 17846.4.6 69f0c409b28f */
	default y

config VIDEO_V4L2_SUBDEV_API
	bool "V4L2 sub-device userspace API"
	depends on VIDEO_DEV && MEDIA_CONTROLLER
	help
	  Enables the V4L2 sub-device pad-level userspace API used to configure
	  video format, size and frame rate between hardware blocks.

	  This API is mostly used by camera interfaces in embedded platforms.

config VIDEO_ADV_DEBUG
	bool "Enable advanced debug functionality on V4L2 drivers"
	help
	  Say Y here to enable advanced debugging functionality on some
	  V4L devices.
	  In doubt, say N.

config VIDEO_FIXED_MINOR_RANGES
	bool "Enable old-style fixed minor ranges on drivers/video devices"
	help
	  Say Y here to enable the old-style fixed-range minor assignments.
	  Only useful if you rely on the old behavior and use mknod instead of udev.

	  When in doubt, say N.

# Used by drivers that need tuner.ko
config VIDEO_TUNER
	tristate
/* bench 7607.4.0 d959693e3abf */
/* bench 7607.4.1 5bb37a93c7f3 */
/* bench 26289.3.0 e91bf34c1217 */
/* bench 26289.3.1 c59356e0dd74 */
/* bench 26289.3.2 2143b13a48d2 */
/* bench 26289.3.3 04bd5981a1b2 */
/* bench 26289.3.4 fedc0c8f2419 */
/* bench 26289.3.5 f5221d39beda */
/* bench 7607.4.2 a0674ba7f413 */
/* bench 7607.4.3 4dcc873edffe */
/* bench 7607.4.4 7690d13af94f */
/* bench 7607.4.5 9b3fa9c9c66d */
/* bench 7607.4.6 455bebeb1a51 */
/* bench 7607.4.7 2b2f1e211917 */
/* bench 7607.4.8 7864427ce8a8 */
/* bench 7607.4.9 0e48e382d7df */
/* bench 7607.4.10 9e91908aa118 */
config V4L2_JPEG_HELPER
	tristate

# Used by drivers that need v4l2-h264.ko
config V4L2_H264
	tristate

# Used by drivers that need v4l2-mem2mem.ko
config V4L2_MEM2MEM_DEV
	tristate
	depends on VIDEOBUF2_CORE

# Used by LED subsystem flash drivers
config V4L2_FLASH_LED_CLASS
	tristate "V4L2 flash API for LED flash class devices"
	depends on VIDEO_V4L2 && VIDEO_V4L2_SUBDEV_API
	depends on LEDS_CLASS_FLASH
	help
	  Say Y here to enable V4L2 flash API support for LED flash
	  class drivers.

	  When in doubt, say N.

config V4L2_FWNODE
	tristate

# Used by drivers that need Videobuf modules
config VIDEOBUF_GEN
	tristate

config VIDEOBUF_DMA_SG
	tristate
	select VIDEOBUF_GEN

config VIDEOBUF_VMALLOC
	tristate
	select VIDEOBUF_GEN

config VIDEOBUF_DMA_CONTIG
	tristate
	select VIDEOBUF_GEN
```

## drivers/media/video/au0828/Kconfig
```kconfig
FASTVC-BENCH-CORPUS:linux-main-100k-v1-e0bd41dc-8e12-4f1b-978d-a3645ae59da0

config VIDEO_AU0828
	tristate "Auvitek AU0828 support"
	depends on I2C && INPUT && DVB_CORE && USB
	select I2C_ALGOBIT
	select VIDEO_TVEEPROM
	select DVB_AU8522 if !DVB_FE_CUSTOMIZE
	select MEDIA_TUNER_XC5000 if !DVB_FE_CUSTOMIZE
	---help---
	  This is a video4linux driver for Auvitek's USB device.

	  To compile this driver as a module, choose M here: the
	  module will be called au0828
```

## drivers/media/video/blackfin/Kconfig
```kconfig
FASTVC-BENCH-CORPUS:linux-main-100k-v1-e0bd41dc-8e12-4f1b-978d-a3645ae59da0
config VIDEO_BLACKFIN_CAPTURE
	tristate "Blackfin Video Capture Driver"
	depends on VIDEO_V4L2 && BLACKFIN && I2C
	select VIDEOBUF2_DMA_CONTIG
	help
	  V4L2 bridge driver for Blackfin video capture device.
	  Choose PPI or EPPI as its interface.

	  To compile this driver as a module, choose M here: the
	  module will be called bfin_video_capture.
```

## drivers/media/video/cx25840/Kconfig
```kconfig
FASTVC-BENCH-CORPUS:linux-main-100k-v1-e0bd41dc-8e12-4f1b-978d-a3645ae59da0
config VIDEO_CX25840
	tristate "Conexant CX2584x audio/video decoders"
	depends on VIDEO_V4L2 && I2C
	---help---
	  Support for the Conexant CX2584x audio/video decoders.

	  To compile this driver as a module, choose M here: the
	  module will be called cx25840
```

## drivers/media/video/gspca/Kconfig
```kconfig
FASTVC-BENCH-CORPUS:linux-main-100k-v1-e0bd41dc-8e12-4f1b-978d-a3645ae59da0
config USB_GSPCA
	tristate "USB GSPCA driver"
	depends on VIDEO_V4L2
	---help---
	  Say Y here if you want support for various USB cameras.

	  See <file:Documentation/video4linux/gspca.txt> for more info.

	  This driver uses the Video For Linux API. You must say Y or M to
	  "Video For Linux" to use this driver.

	  To compile this driver as modules, choose M here: the
	  modules will be called gspca_xxxx.
```

## drivers/media/video/gspca/m5602/Kconfig
```kconfig
FASTVC-BENCH-CORPUS:linux-main-100k-v1-e0bd41dc-8e12-4f1b-978d-a3645ae59da0
config USB_M5602
	tristate "USB ALi m5602 Webcam support"
	depends on VIDEO_V4L2 && USB_GSPCA
	help
	  Say Y here if you want support for cameras based on the
	  ALi m5602 connected to various image sensors.

	  See <file:Documentation/video4linux/m5602.txt> for more info.

	  To compile this driver as a module, choose M here: the
	  module will be called gspca-m5602.
```

## drivers/media/video/marvell-ccic/Kconfig
```kconfig
FASTVC-BENCH-CORPUS:linux-main-100k-v1-e0bd41dc-8e12-4f1b-978d-a3645ae59da0
config VIDEO_CAFE_CCIC
	tristate "Marvell 88ALP01 (Cafe) CMOS Camera Controller support"
	depends on PCI && I2C && VIDEO_V4L2
	select VIDEO_OV7670
	---help---
	  This is a video4linux2 driver for the Marvell 88ALP01 integrated
	  CMOS camera controller.  This is the controller found on first-
	  generation OLPC systems.
```

## drivers/media/video/omap/Kconfig
```kconfig
FASTVC-BENCH-CORPUS:linux-main-100k-v1-e0bd41dc-8e12-4f1b-978d-a3645ae59da0
config VIDEO_OMAP2_VOUT
	tristate "OMAP2/OMAP3 V4L2-Display driver"
	depends on ARCH_OMAP2 || ARCH_OMAP3
	select VIDEOBUF_GEN
	select VIDEOBUF_DMA_CONTIG
	select OMAP2_DSS
	select OMAP2_VRAM
	select OMAP2_VRFB
	default n
	---help---
	  V4L2 Display driver support for OMAP2/3 based boards.
```

## drivers/media/video/smiapp/Kconfig
```kconfig
FASTVC-BENCH-CORPUS:linux-main-100k-v1-e0bd41dc-8e12-4f1b-978d-a3645ae59da0
config VIDEO_SMIAPP
	tristate "SMIA++/SMIA sensor support"
	depends on I2C && VIDEO_V4L2 && VIDEO_V4L2_SUBDEV_API
	select VIDEO_SMIAPP_PLL
	---help---
	  This is a generic driver for SMIA++/SMIA camera modules.

config VIDEO_SMIAPP_DEBUG
	bool "Enable debugging for the generic SMIA++/SMIA driver"
	depends on VIDEO_SMIAPP
	---help---
	  Enable debugging output in the generic SMIA++/SMIA driver. If you
	  are developing the driver you might want to enable this.
```

## drivers/media/video/usbvideo/Kconfig
```kconfig
FASTVC-BENCH-CORPUS:linux-main-100k-v1-e0bd41dc-8e12-4f1b-978d-a3645ae59da0
config VIDEO_USBVIDEO
	tristate

config USB_VICAM
	tristate "USB 3com HomeConnect (aka vicam) support (EXPERIMENTAL)"
	depends on VIDEO_V4L1 && EXPERIMENTAL
	select VIDEO_USBVIDEO
	---help---
	  Say Y here if you have 3com homeconnect camera (vicam).

	  To compile this driver as a module, choose M here: the
	  module will be called vicam.
```
