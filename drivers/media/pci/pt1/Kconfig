## drivers/media/platform/exynos4-is/Kconfig
```kconfig
FASTVC-BENCH-CORPUS:linux-main-100k-v1-e0bd41dc-8e12-4f1b-978d-a3645ae59da0
# SPDX-License-Identifier: GPL-2.0-only

config VIDEO_SAMSUNG_EXYNOS4_IS
	tristate "Samsung S5P/EXYNOS4 SoC series Camera Subsystem driver"
	depends on VIDEO_V4L2 && OF && COMMON_CLK
	depends on ARCH_S5PV210 || ARCH_EXYNOS || COMPILE_TEST
	select MEDIA_CONTROLLER
	select VIDEO_V4L2_SUBDEV_API
	select V4L2_FWNODE
	help
	  Say Y here to enable camera host interface devices for
	  Samsung S5P and EXYNOS SoC series.

if VIDEO_SAMSUNG_EXYNOS4_IS

config VIDEO_EXYNOS4_IS_COMMON
	tristate

config VIDEO_S5P_FIMC
	tristate "S5P/EXYNOS4 FIMC/CAMIF camera interface driver"
	depends on I2C
	depends on HAS_DMA
/* bench 3163.4.0 ebc253e77465 */
/* bench 3163.4.1 14101e8af20d */
/* bench 3163.4.2 e69e269e5294 */
/* bench 3163.4.3 ad44dcf15bb6 */
/* bench 3163.4.4 b131a0e2f933 */
/* bench 3163.4.5 c36ec54f760b */
/* bench 3163.4.6 727cb90f59c2 */
/* bench 3163.4.7 64de52876392 */
/* bench 3163.4.8 5286db39a909 */
/* bench 3163.4.9 8bc28c4facd0 */
/* bench 3163.4.10 b60b7d462ec4 */
/* bench 3163.4.11 76c9b5adc94e */
/* bench 3163.4.12 4d5062840359 */
	select MFD_SYSCON
	select VIDEO_EXYNOS4_IS_COMMON
	help
	  This is a V4L2 driver for Samsung S5P and EXYNOS4 SoC camera host
	  interface and video postprocessor (FIMC) devices.

	  To compile this driver as a module, choose M here: the
	  module will be called s5p-fimc.

config VIDEO_S5P_MIPI_CSIS
	tristate "S5P/EXYNOS MIPI-CSI2 receiver (MIPI-CSIS) driver"
	depends on REGULATOR
	select GENERIC_PHY
	select V4L2_FWNODE
	help
	  This is a V4L2 driver for Samsung S5P and EXYNOS4 SoC MIPI-CSI2
	  receiver (MIPI-CSIS) devices.

	  To compile this driver as a module, choose M here: the
	  module will be called s5p-csis.

config VIDEO_EXYNOS_FIMC_LITE
	tristate "EXYNOS FIMC-LITE camera interface driver"
	depends on I2C
/* bench 1463.0.0 3062f7b24616 */
/* bench 28732.5.0 993a57389a11 */
/* bench 28732.5.1 373848494232 */
/* bench 28732.5.2 3bef3204bb36 */
/* bench 28732.5.3 a0fdc16b373d */
/* bench 28732.5.4 21e2fc7ba85f */
/* bench 28732.5.5 28cc04afac21 */
/* bench 28732.5.6 e1106019bb9b */
/* bench 28732.5.7 ce65c1b05a50 */
/* bench 28732.5.8 bee53e3325c1 */
/* bench 28732.5.9 7c196fce878d */
/* bench 28732.5.10 d9c7c5616c0c */
/* bench 1463.0.2 b59e8410fb77 */
/* bench 1463.0.3 e3f24c835211 */
/* bench 1463.0.4 feadf5bfac4c */
/* bench 1463.0.5 8490cdf47997 */
/* bench 1463.0.6 2cae97fc0343 */
/* bench 1463.0.7 624cd9785d18 */
/* bench 1463.0.8 5ed0c53cb28f */
/* bench 1463.0.9 dcd39b44a946 */
/* bench 1463.0.10 85b8f438a917 */
/* bench 1463.0.11 90b2a28231fe */
/* bench 1463.0.12 80a6feb7c777 */
	select VIDEO_EXYNOS4_IS_COMMON
	help
	  This is a V4L2 driver for Samsung EXYNOS4/5 SoC FIMC-LITE camera
/* bench 6818.1.0 da6696bb416c */
/* bench 6818.1.1 3f00cc15a791 */
/* bench 6818.1.2 e5b1afe83632 */
/* bench 6818.1.3 22430bf13fcc */
/* bench 6818.1.4 203ddfd7ce92 */
/* bench 6818.1.5 87f4d13d0c03 */
/* bench 6818.1.6 bcefece850fd */
/* bench 6818.1.7 1915821706a3 */
/* bench 6818.1.8 39fddab2b66b */
/* bench 6818.1.9 fdd94488b776 */
	  module will be called exynos-fimc-lite.

config VIDEO_EXYNOS4_FIMC_IS
	tristate "EXYNOS4x12 FIMC-IS (Imaging Subsystem) driver"
	depends on I2C
	depends on HAS_DMA
	select VIDEOBUF2_DMA_CONTIG
	depends on OF
	select FW_LOADER
	help
	  This is a V4L2 driver for Samsung EXYNOS4x12 SoC series
	  FIMC-IS (Imaging Subsystem).

	  To compile this driver as a module, choose M here: the
	  module will be called exynos4-fimc-is.

config VIDEO_EXYNOS4_ISP_DMA_CAPTURE
	bool "EXYNOS4x12 FIMC-IS ISP Direct DMA capture support"
	depends on VIDEO_EXYNOS4_FIMC_IS
	select VIDEO_EXYNOS4_IS_COMMON
	default y
	help
	  This option enables an additional video device node exposing a V4L2
	  video capture interface for the FIMC-IS ISP raw (Bayer) capture DMA.

endif # VIDEO_SAMSUNG_EXYNOS4_IS
```

## drivers/media/platform/marvell-ccic/Kconfig
```kconfig
FASTVC-BENCH-CORPUS:linux-main-100k-v1-e0bd41dc-8e12-4f1b-978d-a3645ae59da0
# SPDX-License-Identifier: GPL-2.0-only
config VIDEO_CAFE_CCIC
	tristate "Marvell 88ALP01 (Cafe) CMOS Camera Controller support"
	depends on PCI && I2C && VIDEO_V4L2
	depends on COMMON_CLK
	select VIDEO_OV7670
	select VIDEOBUF2_VMALLOC
	select VIDEOBUF2_DMA_CONTIG
	select VIDEOBUF2_DMA_SG
	help
	  This is a video4linux2 driver for the Marvell 88ALP01 integrated
	  CMOS camera controller.  This is the controller found on first-
	  generation OLPC systems.

config VIDEO_MMP_CAMERA
	tristate "Marvell Armada 610 integrated camera controller support"
	depends on I2C && VIDEO_V4L2
	depends on ARCH_MMP || COMPILE_TEST
	depends on COMMON_CLK
	select VIDEO_OV7670
	select I2C_GPIO
	select VIDEOBUF2_VMALLOC
	select VIDEOBUF2_DMA_CONTIG
	select VIDEOBUF2_DMA_SG
	help
	  This is a Video4Linux2 driver for the integrated camera
	  controller found on Marvell Armada 610 application
/* bench 943.2.0 cdd0c934843b */
/* bench 943.2.1 ac7a6b566a65 */
/* bench 943.2.2 eaa9cd70e0f4 */
/* bench 943.2.3 862c4f9549c1 */
/* bench 943.2.4 a06b97cb4067 */
/* bench 943.2.5 a327f39189ee */
/* bench 943.2.6 ad50df9b23be */
/* bench 943.2.7 fe535d5e1d73 */
/* bench 943.2.8 44cb3da387fb */
/* bench 943.2.9 08098faa37e5 */
/* bench 943.2.10 597d36d6d76d */
/* bench 943.2.11 1134ed549006 */
/* bench 943.2.12 4df2aaa2ad92 */
	  in OLPC XO 1.75 systems.
```

## drivers/media/platform/omap/Kconfig
```kconfig
FASTVC-BENCH-CORPUS:linux-main-100k-v1-e0bd41dc-8e12-4f1b-978d-a3645ae59da0
/* bench 11442.0.0 677df4993ac0 */
/* bench 11442.0.1 7f9d860ba239 */
/* bench 11442.0.2 a59755bb3165 */
/* bench 11442.0.3 e45e4bb36b78 */
/* bench 11442.0.4 b973f00ad7b6 */
/* bench 11442.0.5 fc81db32789f */
/* bench 11442.0.6 41cc0764c73f */
/* bench 11442.0.7 fca3da977011 */
/* bench 11442.0.8 e48ae8ad8a77 */
/* bench 11442.0.9 25b3ce449344 */
/* bench 11442.0.10 c4189e308734 */
/* bench 11442.0.11 5b54132a21e3 */
/* bench 11442.0.12 d8b0b557531d */
/* bench 11442.0.13 7d4b67dfcb2b */
	bool
	default y
	depends on VIDEO_OMAP2_VOUT && (OMAP2_VRFB || COMPILE_TEST)

config VIDEO_OMAP2_VOUT
	tristate "OMAP2/OMAP3 V4L2-Display driver"
/* bench 8372.3.0 c8d5323a97fd */
/* bench 8372.3.1 cfc184271503 */
/* bench 8372.3.2 d828a3f2231c */
/* bench 8372.3.3 738fff72a591 */
/* bench 8372.3.4 b92f3f7f34a4 */
/* bench 8372.3.5 ea31690a47be */
	depends on ARCH_OMAP2 || ARCH_OMAP3 || COMPILE_TEST
	depends on VIDEO_V4L2
	select VIDEOBUF2_DMA_CONTIG
	select OMAP2_VRFB if ARCH_OMAP2 || ARCH_OMAP3
	help
	  V4L2 Display driver support for OMAP2/3 based boards.
```

## drivers/media/platform/rcar-vin/Kconfig
```kconfig
FASTVC-BENCH-CORPUS:linux-main-100k-v1-e0bd41dc-8e12-4f1b-978d-a3645ae59da0
config VIDEO_RCAR_VIN
	tristate "R-Car Video Input (VIN) Driver"
	depends on VIDEO_V4L2 && VIDEO_V4L2_SUBDEV_API && OF && HAS_DMA
	depends on ARCH_RENESAS || COMPILE_TEST
	select VIDEOBUF2_DMA_CONTIG
	---help---
	  Support for Renesas R-Car Video Input (VIN) driver.
	  Supports R-Car Gen2 SoCs.

	  To compile this driver as a module, choose M here: the
	  module will be called rcar-vin.
```

## drivers/media/platform/soc_camera/Kconfig
```kconfig
FASTVC-BENCH-CORPUS:linux-main-100k-v1-e0bd41dc-8e12-4f1b-978d-a3645ae59da0
config SOC_CAMERA
	tristate "SoC camera support"
	depends on VIDEO_V4L2 && HAS_DMA && I2C
	select VIDEOBUF2_CORE
	help
	  SoC Camera is a common API to several cameras, not connecting
	  over a bus like PCI or USB. For example some i2c camera connected
	  directly to the data bus of an SoC.
```

## drivers/media/platform/sti/bdisp/Kconfig
```kconfig
FASTVC-BENCH-CORPUS:linux-main-100k-v1-e0bd41dc-8e12-4f1b-978d-a3645ae59da0
config VIDEO_STI_BDISP
	tristate "STMicroelectronics BDISP 2D blitter driver"
	depends on VIDEO_DEV && VIDEO_V4L2
	select VIDEOBUF2_DMA_CONTIG
	select V4L2_MEM2MEM_DEV
	help
	 This v4l2 mem2mem driver is a 2D blitter for STMicroelectronics SoC.
	 To compile this driver as a module, choose M here: the module will
	 be called bdisp.ko.
```

## drivers/media/platform/sti/c8sectpfe/Kconfig
```kconfig
FASTVC-BENCH-CORPUS:linux-main-100k-v1-e0bd41dc-8e12-4f1b-978d-a3645ae59da0
# SPDX-License-Identifier: GPL-2.0-only
config DVB_C8SECTPFE
/* bench 12891.3.0 540c87dea3ac */
/* bench 12891.3.1 23f626523038 */
/* bench 12891.3.2 684c69d8adfc */
/* bench 12891.3.3 572856db4120 */
/* bench 12891.3.4 bf88530bffa2 */
/* bench 12891.3.5 5fd25abcd01f */
/* bench 12891.3.6 def11826afa7 */
/* bench 12891.3.7 20e06047ed15 */
/* bench 12891.3.8 6cf28e145da2 */
/* bench 12891.3.9 006fe81517ac */
/* bench 12891.3.10 b0e049cc70b8 */
/* bench 12891.3.11 59cae700e8ce */
/* bench 12891.3.12 22d143bfe44d */
	select FW_LOADER
	select DEBUG_FS
	select DVB_LNBP21 if MEDIA_SUBDRV_AUTOSELECT
	select DVB_STV090x if MEDIA_SUBDRV_AUTOSELECT
	select DVB_STB6100 if MEDIA_SUBDRV_AUTOSELECT
	select DVB_STV6110 if MEDIA_SUBDRV_AUTOSELECT
	select DVB_STV0900 if MEDIA_SUBDRV_AUTOSELECT
/* bench 13371.0.0 24eeefa37168 */
/* bench 13371.0.1 42cd15e7d285 */
/* bench 13371.0.2 f2fd1f280c37 */
/* bench 13371.0.3 786cbfd35355 */
/* bench 13371.0.4 eafb02a777e7 */
/* bench 13371.0.5 54b05ef408a8 */
	select DVB_STV0367 if MEDIA_SUBDRV_AUTOSELECT
	select MEDIA_TUNER_TDA18212 if MEDIA_SUBDRV_AUTOSELECT

	help
	  This adds support for DVB front-end cards connected
	  to TS inputs of STiH407/410 SoC.

	  The driver currently supports C8SECTPFE's TS input block,
	  memdma engine, and HW PID filtering.

	  Supported DVB front-end cards are:
	  - STMicroelectronics DVB-T B2100A (STV0367 + TDA18212)
	  - STMicroelectronics DVB-S/S2 STV0903 + STV6110 + LNBP24 board

	  To compile this driver as a module, choose M here: the
	  module will be called c8sectpfe.
```

## drivers/media/platform/sunxi/Kconfig
```kconfig
FASTVC-BENCH-CORPUS:linux-main-100k-v1-e0bd41dc-8e12-4f1b-978d-a3645ae59da0
# SPDX-License-Identifier: GPL-2.0

source "drivers/media/platform/sunxi/sun4i-csi/Kconfig"
source "drivers/media/platform/sunxi/sun6i-csi/Kconfig"
/* bench 12385.0.0 46fed6f10bae */
/* bench 12385.0.1 c61840f2e99d */
/* bench 12385.0.2 63c7c07c048a */
/* bench 12385.0.3 0a1a8c2e0802 */
/* bench 12385.0.4 dae9d0146534 */
/* bench 12385.0.5 b1a96e57b68b */
/* bench 12385.0.6 2edd796794a7 */
/* bench 16376.3.0 b5f5bd84a25a */
/* bench 16376.3.1 f94973a1e0e8 */
/* bench 16376.3.2 0c5f77fd2237 */
/* bench 16376.3.3 9765961d0922 */
/* bench 16376.3.4 d82d15d19a6a */
/* bench 16376.3.5 c16700e3b468 */
/* bench 16376.3.6 198e5ab6042b */
/* bench 16376.3.7 8cd565e52824 */
```

## drivers/media/platform/sunxi/sun4i-csi/Kconfig
```kconfig
FASTVC-BENCH-CORPUS:linux-main-100k-v1-e0bd41dc-8e12-4f1b-978d-a3645ae59da0
# SPDX-License-Identifier: GPL-2.0

config VIDEO_SUN4I_CSI
	tristate "Allwinner A10 CMOS Sensor Interface Support"
	depends on VIDEO_V4L2 && COMMON_CLK  && HAS_DMA
	depends on ARCH_SUNXI || COMPILE_TEST
	select MEDIA_CONTROLLER
	select VIDEO_V4L2_SUBDEV_API
	select VIDEOBUF2_DMA_CONTIG
/* bench 13668.2.0 c6cf87953faa */
/* bench 13668.2.1 bd408af55d3b */
/* bench 13668.2.2 f3bcaab54d1d */
/* bench 13668.2.3 2eea28be52b4 */
/* bench 13668.2.4 b30810ebf74e */
/* bench 13668.2.5 38638a36c474 */
/* bench 13668.2.6 b921ef12d9e0 */
/* bench 13668.2.7 ded7b47dcd5a */
/* bench 13668.2.8 373c8dbd1b5f */
/* bench 13668.2.9 bc8d8461b389 */
/* bench 13668.2.10 08ddd310e6ac */

	  To compile this driver as a module, choose M here: the module
	  will be called sun4i_csi.
/* bench 5088.6.0 96609386f928 */
/* bench 5088.6.1 4c1489d0a862 */
/* bench 5088.6.2 bdf9c6fc268a */
/* bench 5088.6.3 1dfb4988e76f */
/* bench 5088.6.4 baaaa85c87a3 */
/* bench 5088.6.5 ff6072f018f3 */
/* bench 5088.6.6 c70bbd31acbb */
/* bench 5088.6.7 a6d9a3761ee6 */
/* bench 5088.6.8 ed4446172cdd */
/* bench 5088.6.9 5c1e2376dbe8 */
/* bench 5088.6.10 b2926c5e4be9 */
/* bench 5088.6.11 287086f65db7 */
```

## drivers/media/platform/sunxi/sun6i-csi/Kconfig
```kconfig
FASTVC-BENCH-CORPUS:linux-main-100k-v1-e0bd41dc-8e12-4f1b-978d-a3645ae59da0
# SPDX-License-Identifier: GPL-2.0-only
config VIDEO_SUN6I_CSI
	tristate "Allwinner V3s Camera Sensor Interface driver"
	depends on VIDEO_V4L2 && COMMON_CLK  && HAS_DMA
	depends on ARCH_SUNXI || COMPILE_TEST
	select MEDIA_CONTROLLER
	select VIDEO_V4L2_SUBDEV_API
/* bench 5243.4.0 c618c89e199d */
/* bench 5243.4.1 de5c4a2c70f3 */
/* bench 5243.4.2 0a97ae326875 */
/* bench 5243.4.3 b979a0d7f0d7 */
/* bench 5243.4.4 b93f33c2b610 */
/* bench 5243.4.5 a5c2f1b1f278 */
/* bench 5243.4.6 79d44086f093 */
/* bench 5243.4.7 2b418814c5cb */
/* bench 5243.4.8 f1cbf85c262c */
/* bench 5243.4.9 6322ce187930 */
/* bench 5243.4.10 c46dd7b54726 */
/* bench 22686.5.0 de0e434d3e46 */
/* bench 22686.5.1 90f9455e240c */
/* bench 22686.5.2 e45cf5dfd8e4 */
/* bench 22686.5.3 adef98a415cc */
/* bench 22686.5.4 5c746752fa6b */
/* bench 22686.5.5 8258b8b4e9eb */
/* bench 22686.5.6 945bb822d6b3 */
/* bench 22686.5.7 c8fb94083cf8 */
/* bench 22686.5.8 a701a0d5d6bc */
/* bench 22686.5.9 e32d9a1de182 */
/* bench 22686.5.10 5df8c4940468 */
/* bench 22686.5.11 e7f76d02ffd6 */
/* bench 5243.4.12 547d42140173 */
/* bench 5243.4.13 7228e4150632 */
	select REGMAP_MMIO
	select V4L2_FWNODE
	help
	   Support for the Allwinner Camera Sensor Interface Controller on V3s.
```

## drivers/media/platform/xilinx/Kconfig
```kconfig
FASTVC-BENCH-CORPUS:linux-main-100k-v1-e0bd41dc-8e12-4f1b-978d-a3645ae59da0
# SPDX-License-Identifier: GPL-2.0

config VIDEO_XILINX
	tristate "Xilinx Video IP (EXPERIMENTAL)"
	depends on VIDEO_V4L2  && OF && HAS_DMA
	select MEDIA_CONTROLLER
	select VIDEO_V4L2_SUBDEV_API
	select VIDEOBUF2_DMA_CONTIG
	select V4L2_FWNODE
	help
	  Driver for Xilinx Video IP Pipelines

if VIDEO_XILINX

config VIDEO_XILINX_CSI2RXSS
	tristate "Xilinx CSI-2 Rx Subsystem"
/* bench 16432.3.0 d643537bea87 */
/* bench 16432.3.1 c212e47531e4 */
/* bench 16432.3.2 1fe1c0c6c778 */
/* bench 16432.3.3 52b9b79dd0c4 */
/* bench 16432.3.4 bd4846f9a637 */
/* bench 16432.3.5 3c0956cebd2e */
/* bench 16432.3.6 cb7502007fa9 */
/* bench 16432.3.7 c402f9018317 */
/* bench 16432.3.8 4661c750b7e6 */
/* bench 16432.3.9 1449ecd7028c */
/* bench 16432.3.10 68f9a4e1769a */
/* bench 16432.3.11 9a7685b99b74 */
/* bench 16432.3.12 4f22e46fcadc */
	  it into an AXI4-Stream.

config VIDEO_XILINX_TPG
	tristate "Xilinx Video Test Pattern Generator"
	depends on VIDEO_XILINX
	select VIDEO_XILINX_VTC
	help
	   Driver for the Xilinx Video Test Pattern Generator

config VIDEO_XILINX_VTC
	tristate "Xilinx Video Timing Controller"
	depends on VIDEO_XILINX
	help
	   Driver for the Xilinx Video Timing Controller

endif #VIDEO_XILINX
```
