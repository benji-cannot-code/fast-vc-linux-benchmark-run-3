## drivers/media/radio/si470x/Kconfig
```kconfig
FASTVC-BENCH-CORPUS:linux-main-100k-v1-e0bd41dc-8e12-4f1b-978d-a3645ae59da0
# SPDX-License-Identifier: GPL-2.0-only
config RADIO_SI470X
	tristate "Silicon Labs Si470x FM Radio Receiver support"
	depends on VIDEO_V4L2
	help
	  This is a driver for devices with the Silicon Labs SI470x
/* bench 23194.2.0 b2af0660c28a */
/* bench 23194.2.1 f9c7ac8f7562 */
/* bench 23194.2.2 28a810531712 */
/* bench 23194.2.3 2632af48b01f */
/* bench 23194.2.4 b681d80f4ef3 */
/* bench 23194.2.5 91f4233034de */
	  Say Y here if you want to connect this type of radio to your
	  computer's USB port or if it is used by some other driver
	  via I2C bus.

	  To compile this driver as a module, choose M here: the
	  module will be called radio-si470x-common.

config USB_SI470X
	tristate "Silicon Labs Si470x FM Radio Receiver support with USB"
	depends on USB && RADIO_SI470X
	help
	  This is a driver for USB devices with the Silicon Labs SI470x
	  chip. Currently these devices are known to work:
	  - 10c4:818a: Silicon Labs USB FM Radio Reference Design
	  - 06e1:a155: ADS/Tech FM Radio Receiver (formerly Instant FM Music)
	  - 1b80:d700: KWorld USB FM Radio SnapMusic Mobile 700 (FM700)
	  - 10c5:819a: Sanei Electric FM USB Radio (aka DealExtreme.com PCear)

	  Sound is provided by the ALSA USB Audio/MIDI driver. Therefore
	  if you don't want to use the device solely for RDS receiving,
	  it is recommended to also select SND_USB_AUDIO.

	  Please have a look at the documentation, especially on how
	  to redirect the audio stream from the radio to your sound device:
	  Documentation/admin-guide/media/si470x.rst

	  Say Y here if you want to connect this type of radio to your
	  computer's USB port.
/* bench 9629.8.0 7bbeeb4c9dbf */
/* bench 9629.8.1 036f34d6e237 */
/* bench 9629.8.2 97ae258a9231 */
/* bench 9629.8.3 46d4ac36133a */
/* bench 9629.8.4 a630eb964bcf */
/* bench 9629.8.5 bf6f5c4ce38e */
/* bench 9629.8.6 7fa582094dbe */
/* bench 9629.8.7 a63a75a3e612 */
/* bench 9629.8.8 0a2138cbec62 */
/* bench 9629.8.9 ac61fa75606a */

config I2C_SI470X
	tristate "Silicon Labs Si470x FM Radio Receiver support with I2C"
	depends on I2C && RADIO_SI470X
/* bench 12400.4.0 1c8ece796986 */
/* bench 20398.5.0 786ccf25ad6e */
/* bench 20398.5.1 4178f18a42a3 */
/* bench 20398.5.2 6c80570003fb */
/* bench 20398.5.3 c94c154cb4f7 */
/* bench 20398.5.4 a2ea0902c243 */
/* bench 20398.5.5 df7e37b82242 */
/* bench 20398.5.6 2f973c30f219 */
/* bench 20398.5.7 8c01ebe017d5 */
/* bench 20398.5.8 9f2eed563113 */
/* bench 12400.4.1 16a3b0c60a29 */
/* bench 12400.4.2 8abd1cd2ec20 */
/* bench 12400.4.3 94d5b97d5ab0 */
/* bench 12400.4.4 566b8963bd17 */
/* bench 12400.4.5 77b2760ecb34 */
	  This is a driver for I2C devices with the Silicon Labs SI470x
	  chip.

	  Say Y here if you want to connect this type of radio to your
	  computer's I2C port.

	  To compile this driver as a module, choose M here: the
	  module will be called radio-i2c-si470x.
```
