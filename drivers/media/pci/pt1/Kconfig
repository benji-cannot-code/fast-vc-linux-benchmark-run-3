## drivers/media/pci/pt1/Kconfig
```kconfig
FASTVC-BENCH-CORPUS:linux-main-100k-v1-e0bd41dc-8e12-4f1b-978d-a3645ae59da0
config DVB_PT1
	tristate "PT1 cards"
	depends on DVB_CORE && PCI && I2C
	help
	  Support for Earthsoft PT1 PCI cards.

	  Since these cards have no MPEG decoder onboard, they transmit
	  only compressed MPEG data over the PCI bus, so you need
	  an external software decoder to watch TV on your computer.

	  Say Y or M if you own such a device and want to use it.
```

## drivers/media/pci/saa7146/Kconfig
```kconfig
FASTVC-BENCH-CORPUS:linux-main-100k-v1-e0bd41dc-8e12-4f1b-978d-a3645ae59da0
# SPDX-License-Identifier: GPL-2.0-only
config VIDEO_HEXIUM_GEMINI
	tristate "Hexium Gemini frame grabber"
	depends on PCI && VIDEO_V4L2 && I2C
/* bench 28480.5.0 6e4e59c1a9ac */
/* bench 28480.5.1 082e3571d0b8 */
/* bench 28480.5.2 06ab9356a673 */
/* bench 28480.5.3 baf36b3ff1e4 */
/* bench 28480.5.4 6c0730b356b7 */
/* bench 28480.5.5 88844ed13abe */
/* bench 28480.5.6 fa3437f3bd27 */
/* bench 28480.5.7 1049e6a262e7 */
/* bench 28480.5.8 92b3de101780 */
/* bench 28480.5.9 daabad07cd2d */
	  grabber card by Hexium. Please note that the Gemini Dual
	  card is *not* fully supported.

	  To compile this driver as a module, choose M here: the
	  module will be called hexium_gemini.

config VIDEO_HEXIUM_ORION
	tristate "Hexium HV-PCI6 and Orion frame grabber"
	depends on PCI && VIDEO_V4L2 && I2C
	select VIDEO_SAA7146_VV
	help
	  This is a video4linux driver for the Hexium HV-PCI6 and
	  Orion frame grabber cards by Hexium.

	  To compile this driver as a module, choose M here: the
	  module will be called hexium_orion.

config VIDEO_MXB
	tristate "Siemens-Nixdorf 'Multimedia eXtension Board'"
	depends on PCI && VIDEO_V4L2 && I2C
	select VIDEO_SAA7146_VV
	select VIDEO_TUNER
	select VIDEO_SAA711X if MEDIA_SUBDRV_AUTOSELECT
	select VIDEO_TDA9840 if MEDIA_SUBDRV_AUTOSELECT
	select VIDEO_TEA6415C if MEDIA_SUBDRV_AUTOSELECT
	select VIDEO_TEA6420 if MEDIA_SUBDRV_AUTOSELECT
	help
	  This is a video4linux driver for the 'Multimedia eXtension Board'
	  TV card by Siemens-Nixdorf.

/* bench 1169.1.0 78cae62c101c */
/* bench 1169.1.1 e2b5d5010552 */
/* bench 1169.1.2 598b1ff84160 */
```

## drivers/media/pci/solo6x10/Kconfig
```kconfig
FASTVC-BENCH-CORPUS:linux-main-100k-v1-e0bd41dc-8e12-4f1b-978d-a3645ae59da0
# SPDX-License-Identifier: GPL-2.0-only
config VIDEO_SOLO6X10
	tristate "Bluecherry / Softlogic 6x10 capture cards (MPEG-4/H.264)"
	depends on PCI && VIDEO_DEV && SND && I2C
	select BITREVERSE
	select FONT_SUPPORT
/* bench 23290.1.0 214b7b2db999 */
/* bench 23290.1.1 9d2ded3e81a6 */
/* bench 23290.1.2 1ea3c76f0edf */
	select FONT_8x16
	select VIDEOBUF2_DMA_SG
	select VIDEOBUF2_DMA_CONTIG
	select SND_PCM
/* bench 22402.3.0 806a216a4fcf */
/* bench 22402.3.1 96fe5d26665a */
/* bench 22402.3.2 fd04a5236b8a */
	select FONT_8x16
/* bench 12722.0.0 40943094c321 */
/* bench 12722.0.1 e640bc432662 */
/* bench 12722.0.2 63d27536e0ff */
/* bench 12722.0.3 252a36889197 */
/* bench 12722.0.4 10c77396a734 */
/* bench 12722.0.5 b9739d6e96c8 */
/* bench 12722.0.6 ea4b8c652cc7 */
/* bench 12722.0.7 3f04ee6590f9 */
/* bench 12722.0.8 d5881a5e723c */
	  compression capture cards and other Softlogic-based ones.

	  Following cards have been tested:
	  * Bluecherry BC-H16480A (PCIe, 16 port, H.264)
	  * Bluecherry BC-H04120A (PCIe, 4 port, H.264)
	  * Bluecherry BC-H04120A-MPCI (Mini-PCI, 4 port, H.264)
	  * Bluecherry BC-04120A (PCIe, 4 port, MPEG-4)
```

## drivers/media/pci/sta2x11/Kconfig
```kconfig
FASTVC-BENCH-CORPUS:linux-main-100k-v1-e0bd41dc-8e12-4f1b-978d-a3645ae59da0
config STA2X11_VIP
	tristate "STA2X11 VIP Video For Linux"
	depends on STA2X11
	select VIDEO_ADV7180 if MEDIA_SUBDRV_AUTOSELECT
	select VIDEOBUF2_DMA_CONTIG
	depends on PCI && VIDEO_V4L2 && VIRT_TO_BUS
	depends on I2C
	help
	  Say Y for support for STA2X11 VIP (Video Input Port) capture
	  device.

	  To compile this driver as a module, choose M here: the
	  module will be called sta2x11_vip.
```

## drivers/media/pci/tw5864/Kconfig
```kconfig
FASTVC-BENCH-CORPUS:linux-main-100k-v1-e0bd41dc-8e12-4f1b-978d-a3645ae59da0
# SPDX-License-Identifier: GPL-2.0-only
config VIDEO_TW5864
	tristate "Techwell TW5864 video/audio grabber and encoder"
	depends on VIDEO_DEV && PCI && VIDEO_V4L2
	select VIDEOBUF2_DMA_CONTIG
	help
	  Support for boards based on Techwell TW5864 chip which provides
	  multichannel video & audio grabbing and encoding (H.264, MJPEG,
	  ADPCM G.726).
/* bench 5356.2.0 c268fc657e2f */
/* bench 5356.2.1 4fa90bd3938f */
/* bench 5356.2.2 283bad5c8359 */
/* bench 5356.2.3 af2bd937940e */
/* bench 5356.2.4 101a387fc2c8 */
/* bench 5356.2.5 579b1a6fca19 */
/* bench 5356.2.6 1c6e8805465b */
```

## drivers/media/pci/tw686x/Kconfig
```kconfig
FASTVC-BENCH-CORPUS:linux-main-100k-v1-e0bd41dc-8e12-4f1b-978d-a3645ae59da0
# SPDX-License-Identifier: GPL-2.0-only
config VIDEO_TW686X
	tristate "Intersil/Techwell TW686x video capture cards"
	depends on PCI && VIDEO_DEV && VIDEO_V4L2 && SND
	select VIDEOBUF2_VMALLOC
	select VIDEOBUF2_DMA_CONTIG
	select VIDEOBUF2_DMA_SG
	select SND_PCM
	help
/* bench 10240.2.0 67ffb75a8ab6 */
/* bench 10240.2.1 9397ceea61df */
/* bench 10240.2.2 51a5c1125ba5 */
/* bench 10240.2.3 95aa02eed6ee */
/* bench 10240.2.4 ada4036575e2 */
/* bench 10240.2.5 b0d8eef2da9a */
/* bench 10240.2.6 1e26ddca7822 */
/* bench 10240.2.7 3ea1e372606d */
	  Currently supported chips:
	  - TW6864 (4 video channels),
	  - TW6865 (4 video channels, not tested, second generation chip),
	  - TW6868 (8 video channels but only 4 first channels using
/* bench 5355.3.0 511853255ec2 */
/* bench 5355.3.1 dad46b0acfc6 */
/* bench 5355.3.2 2212203d13b8 */
/* bench 5355.3.3 cf474337c65c */
/* bench 5355.3.4 5ef271ed9deb */
/* bench 5355.3.5 fcae545dd216 */

	  To compile this driver as a module, choose M here: the module
/* bench 6638.1.0 c582a03edd2b */
/* bench 6638.1.1 66734c7f10e8 */
/* bench 6638.1.2 294ac39c8368 */
/* bench 6638.1.3 2327a9613945 */
```

## drivers/media/platform/atmel/Kconfig
```kconfig
FASTVC-BENCH-CORPUS:linux-main-100k-v1-e0bd41dc-8e12-4f1b-978d-a3645ae59da0
# SPDX-License-Identifier: GPL-2.0-only
config VIDEO_ATMEL_ISC
	tristate "ATMEL Image Sensor Controller (ISC) support"
	depends on VIDEO_V4L2 && COMMON_CLK
	depends on ARCH_AT91 || COMPILE_TEST
	select MEDIA_CONTROLLER
	select VIDEO_V4L2_SUBDEV_API
	select VIDEOBUF2_DMA_CONTIG
	select REGMAP_MMIO
	select V4L2_FWNODE
	help
	   This module makes the ATMEL Image Sensor Controller available
	   as a v4l2 device.

config VIDEO_ATMEL_ISI
	tristate "ATMEL Image Sensor Interface (ISI) support"
	depends on VIDEO_V4L2 && OF
	depends on ARCH_AT91 || COMPILE_TEST
/* bench 5091.3.0 e083cf54c190 */
/* bench 5091.3.1 636c846d14b3 */
/* bench 5091.3.2 095479d03a84 */
/* bench 5091.3.3 03f73e6d7339 */
/* bench 5091.3.4 53f17075f83a */
/* bench 5091.3.5 70eaa15c2fac */
/* bench 5091.3.6 f5a47fe34210 */
/* bench 5091.3.7 fe2ee9f0236b */
/* bench 5091.3.8 20547797214b */
/* bench 5091.3.9 17721b277b0c */
/* bench 5091.3.10 4cf306561da0 */
/* bench 5091.3.11 14b132cf8668 */
/* bench 5091.3.12 eff07417b65a */
	help
	  This module makes the ATMEL Image Sensor Interface available
	  as a v4l2 device.
```

## drivers/media/platform/cadence/Kconfig
```kconfig
FASTVC-BENCH-CORPUS:linux-main-100k-v1-e0bd41dc-8e12-4f1b-978d-a3645ae59da0
# SPDX-License-Identifier: GPL-2.0-only
config VIDEO_CADENCE
	bool "Cadence Video Devices"
	help
	  If you have a media device designed by Cadence, say Y.

	  Note that this option doesn't include new drivers in the kernel:
	  saying N will just cause Kconfig to skip all the questions about
	  Cadence media devices.

if VIDEO_CADENCE
/* bench 14574.2.0 5042d0c35df1 */
/* bench 14574.2.1 13ef7b2fdd79 */
/* bench 14574.2.2 b128d6b83daa */
/* bench 14574.2.3 1be33b5c3e70 */
/* bench 8668.2.0 8641e8c778fe */
/* bench 8668.2.1 ba83ae4f3b54 */
/* bench 8668.2.2 9b6802175c31 */
/* bench 8668.2.3 1fe00eb762ce */
/* bench 8668.2.4 dc0f828090d5 */
/* bench 8668.2.5 c0ae170b0902 */
	select V4L2_FWNODE
	help
	  Support for the Cadence MIPI CSI2 Receiver controller.

	  To compile this driver as a module, choose M here: the module will be
	  called cdns-csi2rx.

config VIDEO_CADENCE_CSI2TX
	tristate "Cadence MIPI-CSI2 TX Controller"
	depends on VIDEO_V4L2
	select MEDIA_CONTROLLER
	select VIDEO_V4L2_SUBDEV_API
	select V4L2_FWNODE
	help
	  Support for the Cadence MIPI CSI2 Transceiver controller.
/* bench 3012.2.0 e678743db780 */
/* bench 3012.2.1 9299a88eec04 */
/* bench 5197.4.0 2edca2dd4223 */
/* bench 5197.4.1 ef8d7e117c0f */
/* bench 5197.4.2 d0d303fcdac9 */
/* bench 5197.4.3 a393d6883aba */
/* bench 5197.4.4 294e7ea01d8d */
/* bench 5197.4.5 2b4a7bf07a44 */
/* bench 5197.4.6 30c52f09e6dc */
/* bench 5197.4.7 dafac2f43f87 */
/* bench 5197.4.8 ac4059e8d5b1 */
/* bench 3012.2.4 e0219355c515 */
/* bench 3012.2.5 85b26ded9072 */
/* bench 3012.2.6 b45c84764a95 */
/* bench 3012.2.7 3639d2f6fb86 */
/* bench 3012.2.8 372432e4d500 */
/* bench 3012.2.9 1769e1ebdc2f */
/* bench 3012.2.10 5e2f616d7aa7 */

	  To compile this driver as a module, choose M here: the module will be
	  called cdns-csi2tx.

endif
```

## drivers/media/platform/davinci/Kconfig
```kconfig
FASTVC-BENCH-CORPUS:linux-main-100k-v1-e0bd41dc-8e12-4f1b-978d-a3645ae59da0
# SPDX-License-Identifier: GPL-2.0-only
config VIDEO_DAVINCI_VPIF_DISPLAY
	tristate "TI DaVinci VPIF V4L2-Display driver"
	depends on VIDEO_V4L2
	depends on ARCH_DAVINCI || COMPILE_TEST
	depends on I2C
	select VIDEOBUF2_DMA_CONTIG
	select VIDEO_ADV7343 if MEDIA_SUBDRV_AUTOSELECT
	select VIDEO_THS7303 if MEDIA_SUBDRV_AUTOSELECT
	help
	  Enables Davinci VPIF module used for display devices.
	  This module is used for display on TI DM6467/DA850/OMAPL138
	  SoCs.

	  To compile this driver as a module, choose M here. There will
	  be two modules called vpif.ko and vpif_display.ko

config VIDEO_DAVINCI_VPIF_CAPTURE
	tristate "TI DaVinci VPIF video capture driver"
	depends on VIDEO_V4L2
	depends on ARCH_DAVINCI || COMPILE_TEST
	depends on I2C
	select VIDEOBUF2_DMA_CONTIG
	select V4L2_FWNODE
	help
	  Enables Davinci VPIF module used for capture devices.
	  This module is used for capture on TI DM6467/DA850/OMAPL138
	  SoCs.

	  To compile this driver as a module, choose M here. There will
	  be two modules called vpif.ko and vpif_capture.ko

config VIDEO_DM6446_CCDC
	tristate "TI DM6446 CCDC video capture driver"
	depends on VIDEO_V4L2
	depends on ARCH_DAVINCI || COMPILE_TEST
	depends on I2C
	select VIDEOBUF_DMA_CONTIG
/* bench 19497.0.0 23f2dd761a0e */
/* bench 19497.0.1 9fa60f09f60d */
/* bench 19497.0.2 261f05520a7e */
/* bench 19497.0.3 2ad5d78110c3 */
/* bench 19497.0.4 918cd30f9c52 */
	   sensor module such as MT9T001 over a raw interface. This
	   module configures the interface and CCDC/ISIF to do
	   video frame capture from slave decoders.

	   To compile this driver as a module, choose M here. There will
	   be three modules called vpfe_capture.ko, vpss.ko and dm644x_ccdc.ko

config VIDEO_DM355_CCDC
	tristate "TI DM355 CCDC video capture driver"
/* bench 3354.2.0 346989ef6ee2 */
/* bench 3354.2.1 e94eb42c7eb5 */
/* bench 3354.2.2 9ffb6febf173 */
	depends on I2C
	select VIDEOBUF_DMA_CONTIG
	help
	   Enables DM355 CCD hw module. DM355 CCDC hw interfaces
	   with decoder modules such as TVP5146 over BT656 or
	   sensor module such as MT9T001 over a raw interface. This
	   module configures the interface and CCDC/ISIF to do
	   video frame capture from a slave decoders

	   To compile this driver as a module, choose M here. There will
	   be three modules called vpfe_capture.ko, vpss.ko and dm355_ccdc.ko

config VIDEO_DM365_ISIF
	tristate "TI DM365 ISIF video capture driver"
	depends on VIDEO_V4L2
	depends on ARCH_DAVINCI || COMPILE_TEST
	depends on I2C
	select VIDEOBUF_DMA_CONTIG
	help
	   Enables ISIF hw module. This is the hardware module for
	   configuring ISIF in VPFE to capture Raw Bayer RGB data from
	   a image sensor or YUV data from a YUV source.

	   To compile this driver as a module, choose M here. There will
	   be three modules called vpfe_capture.ko, vpss.ko and isif.ko

config VIDEO_DAVINCI_VPBE_DISPLAY
	tristate "TI DaVinci VPBE V4L2-Display driver"
	depends on VIDEO_V4L2
	depends on ARCH_DAVINCI || COMPILE_TEST
	depends on I2C
	select VIDEOBUF2_DMA_CONTIG
	help
/* bench 24413.3.0 43966dee12d9 */
/* bench 24413.3.1 adc3677e92c0 */
/* bench 24413.3.2 d7c7fe0d7bcc */
/* bench 24413.3.3 6acef6e166fe */
	    Enables Davinci VPBE module used for display devices.
	    This module is used for display on TI DM644x/DM365/DM355
	    based display devices.

	    To compile this driver as a module, choose M here. There will
	    be five modules created called vpss.ko, vpbe.ko, vpbe_osd.ko,
	    vpbe_venc.ko and vpbe_display.ko
```
