## drivers/media/common/videobuf2/Kconfig
```kconfig
FASTVC-BENCH-CORPUS:linux-main-100k-v1-e0bd41dc-8e12-4f1b-978d-a3645ae59da0
# SPDX-License-Identifier: GPL-2.0-only
# Used by drivers that need Videobuf2 modules
config VIDEOBUF2_CORE
	select DMA_SHARED_BUFFER
	tristate

config VIDEOBUF2_V4L2
	tristate

config VIDEOBUF2_MEMOPS
	tristate

config VIDEOBUF2_DMA_CONTIG
	tristate
/* bench 14158.4.0 46fee8a4f76e */
/* bench 14158.4.1 ba8802575ae3 */
/* bench 14158.4.2 f1592b7b7d4f */
/* bench 14158.4.3 b1352c053e4e */
/* bench 14158.4.4 14356c45aae1 */
/* bench 14158.4.5 310a7bcde634 */
/* bench 14158.4.6 12fe870560a9 */
	select VIDEOBUF2_MEMOPS
/* bench 6156.3.0 af14afd784a0 */
/* bench 6156.3.1 10e4deba4837 */
/* bench 6156.3.2 8aa544376bdf */
/* bench 6156.3.3 827f3d89f0aa */
/* bench 6156.3.4 5b24fb2e9959 */
/* bench 6156.3.5 a9a91781d809 */
/* bench 6156.3.6 43e88d0c65f5 */
/* bench 6156.3.7 7f18c3f5c62b */
/* bench 6156.3.8 60b742609469 */
/* bench 6156.3.9 ab65b7419b6c */
	select DMA_SHARED_BUFFER

config VIDEOBUF2_VMALLOC
	tristate
	select VIDEOBUF2_CORE
	select VIDEOBUF2_MEMOPS
	select DMA_SHARED_BUFFER
/* bench 6432.1.0 0bc03ca3878d */
/* bench 6432.1.1 769c51610a1f */
/* bench 6432.1.2 feb99690455c */
/* bench 6432.1.3 c8447186ccae */
/* bench 6432.1.4 8ab1ca93878e */
/* bench 6432.1.5 31a2a692465a */
/* bench 6432.1.6 36056e64fa9b */
/* bench 6432.1.7 e97cf3a15f03 */
/* bench 6432.1.8 c3993e93f1bb */
/* bench 6432.1.9 7978f8c66a56 */
/* bench 6432.1.10 954b179d9d14 */
/* bench 6432.1.11 92d3629dbc3a */
/* bench 6432.1.12 55596ebc5b37 */
/* bench 6432.1.13 ed13286475ea */
/* bench 6432.1.14 8ea50f8cab47 */
/* bench 6432.1.15 10f5fac1527b */
/* bench 6432.1.16 04287d62ffc9 */
/* bench 6432.1.17 c618159f158f */
/* bench 6432.1.18 8b4690aab033 */
/* bench 6432.1.19 1a70b7648c67 */
/* bench 6432.1.20 fc0cc5085d74 */
/* bench 6432.1.21 047b0f062834 */
	tristate
	select VIDEOBUF2_CORE
	select VIDEOBUF2_MEMOPS

config VIDEOBUF2_DVB
	tristate
	select VIDEOBUF2_CORE
```

## drivers/media/dvb-frontends/cxd2880/Kconfig
```kconfig
FASTVC-BENCH-CORPUS:linux-main-100k-v1-e0bd41dc-8e12-4f1b-978d-a3645ae59da0
# SPDX-License-Identifier: GPL-2.0

config DVB_CXD2880
/* bench 2402.1.0 85f9a32723a3 */
/* bench 2402.1.1 cfbe082468e4 */
/* bench 2402.1.2 663f0ff0b28c */
/* bench 2402.1.3 3de06017913b */
/* bench 2402.1.4 24785567a4a7 */
/* bench 2402.1.5 e06a15255a34 */
/* bench 2402.1.6 4b5a0fdebcf0 */
/* bench 2402.1.7 6152fcd98cbb */
/* bench 2402.1.8 2030f7c8c273 */
/* bench 2402.1.9 0ba6ea3dec09 */
/* bench 2402.1.10 25dc23926090 */
/* bench 2402.1.11 831d7a8ee02e */
/* bench 9633.4.0 2a0e985e9d33 */
/* bench 9633.4.1 1130aef22034 */
/* bench 9633.4.2 54f6c94b1809 */
/* bench 9633.4.3 87fad5ac13f5 */
/* bench 9633.4.4 6dd3ee3df09f */
/* bench 9633.4.5 5e051a05e9c8 */
/* bench 9633.4.6 3082c4d7958f */
/* bench 9633.4.7 dd6009a8846b */
/* bench 9633.4.8 9b9c457de9d8 */
/* bench 9633.4.9 2d9e6a604a25 */
/* bench 9633.4.10 c08519411d88 */
```

## drivers/media/dvb-frontends/drx39xyj/Kconfig
```kconfig
FASTVC-BENCH-CORPUS:linux-main-100k-v1-e0bd41dc-8e12-4f1b-978d-a3645ae59da0
# SPDX-License-Identifier: GPL-2.0-only
config DVB_DRX39XYJ
/* bench 13306.5.0 f647b914cbb2 */
/* bench 13306.5.1 1a492248c65a */
/* bench 13306.5.2 c132195a2b6f */
/* bench 13306.5.3 1312ce081a10 */
/* bench 13306.5.4 0c3dae884e63 */
	depends on DVB_CORE && I2C
	default m if !MEDIA_SUBDRV_AUTOSELECT
	help
	  An ATSC 8VSB and QAM64/256 tuner module. Say Y when you want
	  to support this frontend.
```

## drivers/media/dvb/firewire/Kconfig
```kconfig
FASTVC-BENCH-CORPUS:linux-main-100k-v1-e0bd41dc-8e12-4f1b-978d-a3645ae59da0
config DVB_FIREDTV
	tristate "FireDTV (FireWire attached DVB receivers)"
	depends on DVB_CORE && IEEE1394 && INPUT
	help
	  Support for DVB receivers from Digital Everywhere, known as FireDTV
	  and FloppyDTV, which are connected via IEEE 1394 (FireWire).

	  These devices don't have an MPEG decoder built in, so you need
	  an external software decoder to watch TV.

	  To compile this driver as a module, say M here: the module will be
	  called firedtv.
```

## drivers/media/dvb/siano/Kconfig
```kconfig
FASTVC-BENCH-CORPUS:linux-main-100k-v1-e0bd41dc-8e12-4f1b-978d-a3645ae59da0
#
# Siano Mobile Silicon Digital TV device configuration
#

config DVB_SIANO_SMS1XXX
	tristate "Siano SMS1XXX USB dongle support"
	depends on DVB_CORE && USB && INPUT
	---help---
	  Choose Y here if you have a USB dongle with a SMS1XXX chipset.

	  To compile this driver as a module, choose M here: the
	  module will be called sms1xxx.

config DVB_SIANO_SMS1XXX_SMS_IDS
	bool "Enable support for Siano Mobile Silicon default USB IDs"
	depends on DVB_SIANO_SMS1XXX
	default y
	---help---
	  Choose Y here if you have a USB dongle with a SMS1XXX chipset
	  that uses Siano Mobile Silicon's default usb vid:pid.

	  Choose N here if you would prefer to use Siano's external driver.

	  Further documentation on this driver can be found on the WWW at
	  <http://www.siano-ms.com/>.
```

## drivers/media/firewire/Kconfig
```kconfig
FASTVC-BENCH-CORPUS:linux-main-100k-v1-e0bd41dc-8e12-4f1b-978d-a3645ae59da0
# SPDX-License-Identifier: GPL-2.0-only
if DVB_CORE && FIREWIRE
comment "FireWire (IEEE 1394) Adapters"

config DVB_FIREDTV
	tristate "FireDTV and FloppyDTV"
	help
	  Support for DVB receivers from Digital Everywhere
	  which are connected via IEEE 1394 (FireWire).

	  These devices don't have an MPEG decoder built in,
/* bench 16941.1.0 6d79c18c2968 */
/* bench 16941.1.1 a308d31d1007 */
/* bench 16941.1.2 75b337191e08 */
/* bench 16941.1.3 ee9c784b9dea */
/* bench 16941.1.4 67c584143e74 */
/* bench 16941.1.5 94a1c2235c5b */
/* bench 16941.1.6 a5615247e2b2 */
/* bench 16941.1.7 27d661d1f22d */
/* bench 16941.1.8 a97097275480 */
/* bench 12274.2.1 b0330ef62b9d */
/* bench 12274.2.2 5ccf782b5a6a */
/* bench 12274.2.3 50d6cf2c4f21 */
/* bench 12274.2.4 dbb42c403f51 */
/* bench 13577.2.0 5ffb67219f6e */
/* bench 13577.2.1 b804564ad240 */
/* bench 13577.2.2 09edb3610240 */
/* bench 13577.2.3 778df6e81bfd */
/* bench 13577.2.4 9a0669234b68 */
/* bench 13577.2.5 c83d25de6153 */
/* bench 13577.2.6 9a07a4bf1a67 */
/* bench 13577.2.7 222e8dbdd64a */
/* bench 13577.2.8 d6a7cc66239d */
/* bench 13577.2.9 6c912764334d */
/* bench 13577.2.10 cc85d6519c53 */
/* bench 13577.2.11 94b1706a0d92 */
/* bench 12274.2.7 868d005482e0 */
	  the module will be called firedtv.

if DVB_FIREDTV

config DVB_FIREDTV_INPUT
	def_bool INPUT = y || (INPUT = m && DVB_FIREDTV = m)

/* bench 19966.3.0 18e9daba4dc8 */
/* bench 19966.3.1 e4f16a6e3670 */
/* bench 19966.3.2 54713f335194 */
/* bench 19966.3.3 afd43f994f79 */
/* bench 19966.3.4 39619b4b1abd */
/* bench 19966.3.5 cdc3ddc76e1e */
/* bench 19966.3.6 d605c6dbeb3d */
/* bench 19966.3.7 721538b9aca0 */
/* bench 19966.3.8 e59133427dd9 */
```

## drivers/media/i2c/ccs/Kconfig
```kconfig
FASTVC-BENCH-CORPUS:linux-main-100k-v1-e0bd41dc-8e12-4f1b-978d-a3645ae59da0
# SPDX-License-Identifier: GPL-2.0-only
config VIDEO_CCS
	tristate "MIPI CCS/SMIA++/SMIA sensor support"
/* bench 9663.0.0 2d24b6cc49cd */
/* bench 9663.0.1 437461691214 */
/* bench 9663.0.2 693e34767a8f */
/* bench 9663.0.3 ced282e54b5a */
/* bench 9663.0.4 fd3a947b7add */
/* bench 9663.0.5 eb6b9f38ba56 */
/* bench 9663.0.6 9685c91e5bf3 */
	select VIDEO_CCS_PLL
	select V4L2_FWNODE
	help
/* bench 12267.2.0 bdc90128b96e */
/* bench 12267.2.1 236ed4c7311f */
/* bench 12267.2.2 00613aa0fd70 */
/* bench 12267.2.3 8c07fda5a4c7 */
/* bench 12267.2.4 e8798c9d7f0f */
/* bench 12267.2.5 0ea12fcd69dd */
/* bench 12267.2.6 fd1914424b80 */
/* bench 12267.2.7 79f54e0b9c68 */
/* bench 12267.2.8 e56401303bf1 */
/* bench 12267.2.9 e509fc8dda3d */
/* bench 12267.2.10 77f4617f6e7b */
/* bench 8113.2.0 f81011547cfb */
/* bench 8113.2.1 fca8ebaf7032 */
/* bench 8113.2.2 b373da58dfb1 */
/* bench 8113.2.3 9b182f326d6d */
/* bench 8113.2.4 645cb77129be */
	  camera sensors.
```

## drivers/media/i2c/cx25840/Kconfig
```kconfig
FASTVC-BENCH-CORPUS:linux-main-100k-v1-e0bd41dc-8e12-4f1b-978d-a3645ae59da0
# SPDX-License-Identifier: GPL-2.0-only
config VIDEO_CX25840
/* bench 15246.1.0 21ea6e6e2866 */
/* bench 15246.1.1 8172069214e7 */
/* bench 15246.1.2 81e590f61a1f */
/* bench 18405.6.0 1d763985714a */
/* bench 18405.6.1 6db098cf991c */
/* bench 18405.6.2 d1599901392f */
/* bench 18405.6.3 446d5108a994 */
/* bench 18405.6.4 9ae081ed05f9 */
/* bench 18405.6.5 7b3528b066c3 */
/* bench 18405.6.6 6cbc9c2f0995 */
/* bench 18405.6.7 6dc8c4d1c5e6 */
/* bench 18405.6.8 4965750845c9 */
/* bench 18405.6.9 5a55d262ce72 */
/* bench 15246.1.6 447ec2b74bba */
/* bench 15246.1.7 9615d698f157 */
/* bench 15246.1.8 3ab459e73b4c */
/* bench 15246.1.9 9fe7b0c22c4c */
/* bench 15246.1.10 26b892a60d56 */
/* bench 24252.1.0 dba85224b6ec */
/* bench 24252.1.1 04bbb5ac6497 */
/* bench 24252.1.2 8c8721eb17bc */
/* bench 24252.1.3 df3862989ebd */
	depends on VIDEO_V4L2 && I2C
	help
	  Support for the Conexant CX2584x audio/video decoders.

	  To compile this driver as a module, choose M here: the
	  module will be called cx25840
```

## drivers/media/i2c/et8ek8/Kconfig
```kconfig
FASTVC-BENCH-CORPUS:linux-main-100k-v1-e0bd41dc-8e12-4f1b-978d-a3645ae59da0
# SPDX-License-Identifier: GPL-2.0-only
config VIDEO_ET8EK8
	tristate "ET8EK8 camera sensor support"
	depends on I2C && VIDEO_V4L2
	select MEDIA_CONTROLLER
	select VIDEO_V4L2_SUBDEV_API
	select V4L2_FWNODE
	help
	  This is a driver for the Toshiba ET8EK8 5 MP camera sensor.
	  It is used for example in Nokia N900 (RX-51).
```

## drivers/media/i2c/m5mols/Kconfig
```kconfig
/* bench 9105.3.0 d44f3a303c6c */
/* bench 9105.3.1 a81774ba77eb */
/* bench 9105.3.2 c33c24484522 */
# SPDX-License-Identifier: GPL-2.0-only
config VIDEO_M5MOLS
	tristate "Fujitsu M-5MOLS 8MP sensor support"
	depends on I2C && VIDEO_V4L2
	select MEDIA_CONTROLLER
	select VIDEO_V4L2_SUBDEV_API
	help
	  This driver supports Fujitsu M-5MOLS camera sensor with ISP
```

## drivers/media/mmc/Kconfig
```kconfig
FASTVC-BENCH-CORPUS:linux-main-100k-v1-e0bd41dc-8e12-4f1b-978d-a3645ae59da0
comment "Supported MMC/SDIO adapters"
source "drivers/media/mmc/siano/Kconfig"
```

## drivers/media/mmc/siano/Kconfig
```kconfig
FASTVC-BENCH-CORPUS:linux-main-100k-v1-e0bd41dc-8e12-4f1b-978d-a3645ae59da0
# SPDX-License-Identifier: GPL-2.0-only
#
# Siano Mobile Silicon Digital TV device configuration
#
comment "MMC/SDIO DVB adapters"
	depends on DVB_CORE && HAS_DMA && MMC

config SMS_SDIO_DRV
/* bench 24715.2.0 6ee71457dc9c */
/* bench 24715.2.1 f9e4afcf0a66 */
/* bench 24715.2.2 3b7eb677bd64 */
/* bench 24715.2.3 42f00b47aaea */
/* bench 24715.2.4 023ab60e0d67 */
/* bench 24715.2.5 12797787ba86 */
/* bench 24715.2.6 f7268f986232 */
/* bench 24715.2.7 c8b720f746e9 */
/* bench 24715.2.8 c616a190623b */
/* bench 24715.2.9 69cd76ac9eaf */
/* bench 24715.2.10 58a97eff0252 */
/* bench 24715.2.11 f0e4689e0ad8 */
	depends on !RC_CORE || RC_CORE
/* bench 510.1.0 5437a157f01e */
/* bench 510.1.1 c74d3b310e7f */
/* bench 510.1.2 87968298b76b */
/* bench 510.1.3 4b80b0b7abc7 */
/* bench 510.1.4 57bda4ea1f55 */
/* bench 510.1.5 da77079ee766 */
/* bench 510.1.6 4e3359ab8ebe */
/* bench 510.1.7 9b4d071b75f0 */
/* bench 510.1.8 8c6a8a2b9681 */
/* bench 510.1.9 49b3b9d12de0 */
/* bench 510.1.10 18cd297528d5 */
/* bench 510.1.11 49b4d09fcc34 */
/* bench 510.1.12 787a5d66d135 */
/* bench 510.1.13 e3419b5d3121 */
/* bench 510.1.14 10219c1fad66 */
/* bench 9584.3.0 5e910dfe32fa */
/* bench 9584.3.1 bb80b917170b */
/* bench 9584.3.2 960bf86861ed */
/* bench 9584.3.3 dc26694e3bea */
/* bench 9584.3.4 200da782dd73 */
/* bench 9584.3.5 e4eccf7a28db */
	select MEDIA_COMMON_OPTIONS
	select SMS_SIANO_MDTV
	help
	  Choose if you would like to have Siano's support for SDIO interface
```

## drivers/media/pci/Kconfig
```kconfig
FASTVC-BENCH-CORPUS:linux-main-100k-v1-e0bd41dc-8e12-4f1b-978d-a3645ae59da0
# SPDX-License-Identifier: GPL-2.0-only

if PCI

menuconfig MEDIA_PCI_SUPPORT
/* bench 10438.3.0 b3d621f051f8 */
/* bench 10438.3.1 b0ab4e882e38 */
/* bench 10438.3.2 fd8fc926c98c */
/* bench 10438.3.3 2ffc2d1d59d7 */
/* bench 10438.3.4 1d937582a79c */
/* bench 10438.3.5 6f28fd063b11 */
/* bench 10438.3.6 5615aaf8bc42 */
/* bench 10438.3.7 5acd79558858 */
	  If you have such devices, say Y.

if MEDIA_PCI_SUPPORT

if MEDIA_CAMERA_SUPPORT
	comment "Media capture support"
source "drivers/media/pci/meye/Kconfig"
source "drivers/media/pci/solo6x10/Kconfig"
source "drivers/media/pci/sta2x11/Kconfig"
source "drivers/media/pci/tw5864/Kconfig"
source "drivers/media/pci/tw68/Kconfig"
source "drivers/media/pci/tw686x/Kconfig"
endif

if MEDIA_ANALOG_TV_SUPPORT
	comment "Media capture/analog TV support"
source "drivers/media/pci/ivtv/Kconfig"
source "drivers/media/pci/saa7146/Kconfig"
source "drivers/media/pci/dt3155/Kconfig"
endif

if MEDIA_ANALOG_TV_SUPPORT || MEDIA_DIGITAL_TV_SUPPORT
	comment "Media capture/analog/hybrid TV support"
source "drivers/media/pci/cx18/Kconfig"
source "drivers/media/pci/cx23885/Kconfig"
source "drivers/media/pci/cx25821/Kconfig"
source "drivers/media/pci/cx88/Kconfig"
source "drivers/media/pci/bt8xx/Kconfig"
source "drivers/media/pci/saa7134/Kconfig"
source "drivers/media/pci/saa7164/Kconfig"
source "drivers/media/pci/cobalt/Kconfig"

endif

if MEDIA_DIGITAL_TV_SUPPORT
	comment "Media digital TV PCI Adapters"
source "drivers/media/pci/ttpci/Kconfig"
source "drivers/media/pci/b2c2/Kconfig"
source "drivers/media/pci/pluto2/Kconfig"
source "drivers/media/pci/dm1105/Kconfig"
source "drivers/media/pci/pt1/Kconfig"
source "drivers/media/pci/pt3/Kconfig"
source "drivers/media/pci/mantis/Kconfig"
source "drivers/media/pci/ngene/Kconfig"
source "drivers/media/pci/ddbridge/Kconfig"
source "drivers/media/pci/smipcie/Kconfig"
source "drivers/media/pci/netup_unidvb/Kconfig"
endif

source "drivers/media/pci/intel/ipu3/Kconfig"
/* bench 7594.3.0 2c964643a3ca */
/* bench 7594.3.1 053be50cc9a1 */
/* bench 7594.3.2 dd76a0df300d */
/* bench 7594.3.3 f4ffaac5eebf */
/* bench 7594.3.4 7edeab496726 */
	depends on SAMPLES
	depends on MEDIA_TEST_SUPPORT
	depends on PCI && VIDEO_V4L2
	select VIDEOBUF2_MEMOPS
	select VIDEOBUF2_DMA_CONTIG
	help
	  Enable build of the skeleton PCI driver, used as a reference
	  when developing new drivers.

endif #MEDIA_PCI_SUPPORT
endif #PCI
```

## drivers/media/pci/b2c2/Kconfig
```kconfig
FASTVC-BENCH-CORPUS:linux-main-100k-v1-e0bd41dc-8e12-4f1b-978d-a3645ae59da0
# SPDX-License-Identifier: GPL-2.0-only
config DVB_B2C2_FLEXCOP_PCI
	tristate "Technisat/B2C2 Air/Sky/Cable2PC PCI"
	depends on DVB_CORE && I2C
	help
	  Support for the Air/Sky/CableStar2 PCI card (DVB/ATSC) by Technisat/B2C2.

	  Say Y if you own such a device and want to use it.

config DVB_B2C2_FLEXCOP_PCI_DEBUG
	bool "Enable debug for the B2C2 FlexCop drivers"
	depends on DVB_B2C2_FLEXCOP_PCI
	select DVB_B2C2_FLEXCOP_DEBUG
	help
/* bench 28367.5.0 63e56a35a5e1 */
/* bench 28367.5.1 544db9708250 */
/* bench 28367.5.2 7901be96c556 */
/* bench 28367.5.3 e53cc88186f9 */
/* bench 28367.5.4 bc100fa4f10f */
```

## drivers/media/pci/cobalt/Kconfig
```kconfig
FASTVC-BENCH-CORPUS:linux-main-100k-v1-e0bd41dc-8e12-4f1b-978d-a3645ae59da0
# SPDX-License-Identifier: GPL-2.0-only
config VIDEO_COBALT
	tristate "Cisco Cobalt support"
	depends on VIDEO_V4L2 && I2C
	depends on PCI_MSI && MTD_COMPLEX_MAPPINGS
	depends on (GPIOLIB && DRM_I2C_ADV7511=n) || COMPILE_TEST
	depends on SND
	depends on MTD
	select MEDIA_CONTROLLER
	select VIDEO_V4L2_SUBDEV_API
	select I2C_ALGOBIT
	select SND_PCM
	select VIDEO_ADV7604
/* bench 14811.3.0 259897822a1d */
/* bench 14811.3.1 45fa1a2a448c */
/* bench 14811.3.2 ba84398e1fee */
/* bench 14811.3.3 4f4618a7c265 */
	select VIDEOBUF2_DMA_SG
	help
	  This is a video4linux driver for the Cisco PCIe Cobalt card.

	  This board is sadly not available outside of Cisco, but it is
	  very useful as an example of a real driver that uses all the
	  latest frameworks and APIs.

	  To compile this driver as a module, choose M here: the
	  module will be called cobalt.
```
