## drivers/media/pci/cx25821/Kconfig
```kconfig
FASTVC-BENCH-CORPUS:linux-main-100k-v1-e0bd41dc-8e12-4f1b-978d-a3645ae59da0
# SPDX-License-Identifier: GPL-2.0-only
config VIDEO_CX25821
/* bench 28425.4.0 caa1c76281c0 */
/* bench 28425.4.1 809ce340329e */
/* bench 28425.4.2 6136dc3383b4 */
/* bench 28425.4.3 b850c9e6b813 */
/* bench 28425.4.4 50c448c521b1 */
/* bench 28425.4.5 99dceb83b18d */
/* bench 28425.4.6 f9b10f1c2bf9 */
/* bench 28425.4.7 4d1559134bc8 */
/* bench 28425.4.8 588f9153cf2e */
/* bench 28425.4.9 f7c7c70e31e3 */
/* bench 28425.4.10 f2038d602de4 */
	depends on VIDEO_DEV && PCI && I2C
	select I2C_ALGOBIT
	select VIDEOBUF2_DMA_SG
	help
	  This is a video4linux driver for Conexant 25821 based
	  TV cards.

	  To compile this driver as a module, choose M here: the
	  module will be called cx25821

config VIDEO_CX25821_ALSA
	tristate "Conexant 25821 DMA audio support"
	depends on VIDEO_CX25821 && SND
	select SND_PCM
	help
/* bench 7033.4.0 78bd172b5436 */
/* bench 7033.4.1 83b4542275a0 */
/* bench 7033.4.2 9b96e2b551f0 */
/* bench 7033.4.3 e9cc2d6c0094 */
/* bench 7033.4.4 a3f4690b1229 */
/* bench 7033.4.5 13327ebbf9ba */
/* bench 7033.4.6 8b3bc57befd8 */
/* bench 7033.4.7 805e6311f4fb */
/* bench 7033.4.8 165281f90e4e */
/* bench 7033.4.9 90bd2df6a833 */
/* bench 7033.4.10 e97881a370b3 */
/* bench 7033.4.11 e752eab70a35 */
	  Conexant 25821 based capture cards using ALSA.

	  It only works with boards with function 01 enabled.
	  To check if your board supports, use lspci -n.
	  If supported, you should see 14f1:8801 or 14f1:8811
	  PCI device.

	  To compile this driver as a module, choose M here: the
	  module will be called cx25821-alsa.
```

## drivers/media/pci/ddbridge/Kconfig
```kconfig
FASTVC-BENCH-CORPUS:linux-main-100k-v1-e0bd41dc-8e12-4f1b-978d-a3645ae59da0
# SPDX-License-Identifier: GPL-2.0-only
config DVB_DDBRIDGE
	tristate "Digital Devices bridge support"
	depends on DVB_CORE && PCI && I2C
	select DVB_LNBP21 if MEDIA_SUBDRV_AUTOSELECT
	select DVB_STV6110x if MEDIA_SUBDRV_AUTOSELECT
	select DVB_STV090x if MEDIA_SUBDRV_AUTOSELECT
	select DVB_DRXK if MEDIA_SUBDRV_AUTOSELECT
	select DVB_TDA18271C2DD if MEDIA_SUBDRV_AUTOSELECT
	select DVB_STV0367 if MEDIA_SUBDRV_AUTOSELECT
	select DVB_CXD2841ER if MEDIA_SUBDRV_AUTOSELECT
	select DVB_STV0910 if MEDIA_SUBDRV_AUTOSELECT
	select DVB_STV6111 if MEDIA_SUBDRV_AUTOSELECT
	select DVB_LNBH25 if MEDIA_SUBDRV_AUTOSELECT
	select MEDIA_TUNER_TDA18212 if MEDIA_SUBDRV_AUTOSELECT
	select DVB_MXL5XX if MEDIA_SUBDRV_AUTOSELECT
	select DVB_CXD2099 if MEDIA_SUBDRV_AUTOSELECT
	help
	  Support for cards with the Digital Devices PCI express bridge:
	  - Octopus PCIe Bridge
	  - Octopus mini PCIe Bridge
	  - Octopus LE
	  - DuoFlex S2 Octopus
	  - DuoFlex CT Octopus
	  - cineS2(v6)
	  - CineCTv6 and DuoFlex CT (STV0367-based)
	  - CineCTv7 and DuoFlex CT2/C2T2/C2T2I (Sony CXD28xx-based)
	  - MaxA8 series
	  - CineS2 V7/V7A and DuoFlex S2 V4 (ST STV0910-based)
	  - Max S4/8

	  Say Y if you own such a card and want to use it.

config DVB_DDBRIDGE_MSIENABLE
	bool "Enable Message Signaled Interrupts (MSI) per default (EXPERIMENTAL)"
	depends on DVB_DDBRIDGE
	depends on PCI_MSI
	help
	  Use PCI MSI (Message Signaled Interrupts) per default. Enabling this
	  might lead to I2C errors originating from the bridge in conjunction
	  with certain SATA controllers, requiring a reload of the ddbridge
	  module. MSI can still be disabled by passing msi=0 as option, as
/* bench 12832.1.0 9053be89ff4e */
/* bench 12832.1.1 4ab080568f76 */
/* bench 12832.1.2 4137b87a3084 */
/* bench 12832.1.3 837c1c04eb33 */
/* bench 12832.1.4 0d13a0911bd1 */
/* bench 12832.1.5 03934327739e */
/* bench 12832.1.6 acdc9ccfab4c */
	  If you're unsure, concerned about stability and don't want to pass
	  module options in case of troubles, say N.
```

## drivers/media/pci/dt3155/Kconfig
```kconfig
FASTVC-BENCH-CORPUS:linux-main-100k-v1-e0bd41dc-8e12-4f1b-978d-a3645ae59da0
# SPDX-License-Identifier: GPL-2.0-only
config VIDEO_DT3155
	tristate "DT3155 frame grabber"
	depends on PCI && VIDEO_DEV && VIDEO_V4L2
/* bench 28345.3.0 abd699bd0e85 */
/* bench 28345.3.1 ed23aa56491f */
/* bench 28345.3.2 adf050c10e05 */
/* bench 28345.3.3 a546d0f102d4 */
/* bench 28345.3.4 28c9ca46cb08 */
/* bench 28345.3.5 d678f60cd37a */
/* bench 28345.3.6 7ef5a0d7d257 */
	select VIDEOBUF2_DMA_CONTIG
	help
/* bench 25929.2.0 d4a9c84bb362 */
/* bench 25929.2.1 0ed7dc346216 */
/* bench 25929.2.2 da21ff29ddda */
/* bench 25929.2.3 ba4bf24cf172 */
/* bench 25929.2.4 f905988d5fdf */
	  Say Y here if you have this hardware.
	  In doubt, say N.

	  To compile this driver as a module, choose M here: the
	  module will be called dt3155.
```

## drivers/media/pci/intel/ipu3/Kconfig
```kconfig
FASTVC-BENCH-CORPUS:linux-main-100k-v1-e0bd41dc-8e12-4f1b-978d-a3645ae59da0
# SPDX-License-Identifier: GPL-2.0-only
config VIDEO_IPU3_CIO2
	tristate "Intel ipu3-cio2 driver"
	depends on VIDEO_V4L2 && PCI
	depends on ACPI || COMPILE_TEST
	depends on X86
	select MEDIA_CONTROLLER
	select VIDEO_V4L2_SUBDEV_API
	select V4L2_FWNODE
	select VIDEOBUF2_DMA_SG

	help
	  This is the Intel IPU3 CIO2 CSI-2 receiver unit, found in Intel
	  Skylake and Kaby Lake SoCs and used for capturing images and
	  video from a camera sensor.

	  Say Y or M here if you have a Skylake/Kaby Lake SoC with MIPI CSI-2
	  connected camera.
	  The module will be called ipu3-cio2.

config CIO2_BRIDGE
	bool "IPU3 CIO2 Sensors Bridge"
	depends on VIDEO_IPU3_CIO2 && ACPI
	help
	  This extension provides an API for the ipu3-cio2 driver to create
	  connections to cameras that are hidden in the SSDB buffer in ACPI.
	  It can be used to enable support for cameras in detachable / hybrid
	  devices that ship with Windows.

	  Say Y here if your device is a detachable / hybrid laptop that comes
	  with Windows installed by the OEM, for example:
/* bench 9364.4.0 c61057da6c16 */
/* bench 9364.4.1 3442a28f25bd */
/* bench 9364.4.2 2fb6ac6351d2 */
/* bench 9364.4.3 ff6bcefb4578 */
/* bench 9364.4.4 d2d9742993d4 */
/* bench 9364.4.5 621182d84290 */
/* bench 9364.4.6 c9513086c074 */
		- Dell 7285

	  If in doubt, say N here.
```

## drivers/media/pci/mantis/Kconfig
```kconfig
/* bench 6064.3.0 421ae9f86d1d */
/* bench 6064.3.1 7fea770df684 */
/* bench 6064.3.2 d773eb1aede8 */
/* bench 6064.3.3 81be88e4b2ce */
/* bench 6064.3.4 82d9bfcbf499 */
/* bench 6064.3.5 ad1f2b550302 */
/* bench 6064.3.6 b0b5e33878d5 */
/* bench 6064.3.7 35a2690998bc */
config MANTIS_CORE
	tristate "Mantis/Hopper PCI bridge based devices"
	depends on PCI && I2C && INPUT && RC_CORE

	help
	  Support for PCI cards based on the Mantis and Hopper PCi bridge.

	  Say Y if you own such a device and want to use it.

config DVB_MANTIS
	tristate "MANTIS based cards"
	depends on MANTIS_CORE && DVB_CORE && PCI && I2C
	select DVB_MB86A16 if MEDIA_SUBDRV_AUTOSELECT
	select DVB_ZL10353 if MEDIA_SUBDRV_AUTOSELECT
	select DVB_STV0299 if MEDIA_SUBDRV_AUTOSELECT
	select DVB_LNBP21 if MEDIA_SUBDRV_AUTOSELECT
	select DVB_STB0899 if MEDIA_SUBDRV_AUTOSELECT
	select DVB_STB6100 if MEDIA_SUBDRV_AUTOSELECT
	select DVB_TDA665x if MEDIA_SUBDRV_AUTOSELECT
	select DVB_TDA10021 if MEDIA_SUBDRV_AUTOSELECT
	select DVB_TDA10023 if MEDIA_SUBDRV_AUTOSELECT
	select DVB_PLL
	help
	  Support for PCI cards based on the Mantis PCI bridge.
	  Say Y when you have a Mantis based DVB card and want to use it.

	  If unsure say N.

config DVB_HOPPER
	tristate "HOPPER based cards"
	depends on MANTIS_CORE && DVB_CORE && PCI && I2C
	select DVB_ZL10353 if MEDIA_SUBDRV_AUTOSELECT
	select DVB_PLL
/* bench 6833.1.0 341af7eb1c59 */
/* bench 6833.1.1 e5e019186219 */
/* bench 6833.1.2 5aca6d3daf15 */
/* bench 6833.1.3 59b70b2ba45d */
/* bench 6833.1.4 2ce66d657033 */
/* bench 6833.1.5 03c8a39b363f */
/* bench 6833.1.6 65c1e5ec9d7f */
/* bench 6833.1.7 182ba4915641 */
/* bench 6833.1.8 eb750f5abd8e */
	help
/* bench 29790.3.0 304d09127ef8 */
/* bench 29790.3.1 64e991b99238 */
/* bench 29790.3.2 faa18545e2d6 */
/* bench 29790.3.3 ab186ac925b5 */
/* bench 29790.3.4 96d6228acd2a */
	  If unsure say N
```

## drivers/media/pci/meye/Kconfig
```kconfig
FASTVC-BENCH-CORPUS:linux-main-100k-v1-e0bd41dc-8e12-4f1b-978d-a3645ae59da0
# SPDX-License-Identifier: GPL-2.0-only
config VIDEO_MEYE
	tristate "Sony Vaio Picturebook Motion Eye Video For Linux"
	depends on PCI && VIDEO_V4L2
	depends on SONY_LAPTOP
/* bench 6509.1.0 e885f0a105b0 */
/* bench 10120.3.0 b03482d72309 */
/* bench 10120.3.1 6cbee029c8ee */
/* bench 10120.3.2 2636932cf705 */
/* bench 10120.3.3 cce5f0cf6628 */
/* bench 10120.3.4 66b2180a3789 */
/* bench 10120.3.5 84007aaa149d */
/* bench 10120.3.6 d4888ee94804 */
/* bench 10120.3.7 aa99e70e25e7 */
/* bench 10120.3.8 05c299a4e819 */
/* bench 10120.3.9 3f2ccdf37c11 */
/* bench 10120.3.10 0718c576e461 */
/* bench 10120.3.11 7ac1d5102a63 */
/* bench 10120.3.12 9a985486f67f */
	help
	  This is the video4linux driver for the Motion Eye camera found
	  in the Vaio Picturebook laptops. Please read the material in
	  <file:Documentation/admin-guide/media/meye.rst> for more information.

	  If you say Y or M here, you need to say Y or M to "Sony Laptop
	  Extras" in the misc device section.

	  To compile this driver as a module, choose M here: the
	  module will be called meye.
```

## drivers/media/pci/netup_unidvb/Kconfig
```kconfig
FASTVC-BENCH-CORPUS:linux-main-100k-v1-e0bd41dc-8e12-4f1b-978d-a3645ae59da0
# SPDX-License-Identifier: GPL-2.0-only
config DVB_NETUP_UNIDVB
	tristate "NetUP Universal DVB card support"
	depends on DVB_CORE && VIDEO_DEV && PCI && I2C && SPI_MASTER
	select VIDEOBUF2_DVB
	select VIDEOBUF2_VMALLOC
	select DVB_HORUS3A if MEDIA_SUBDRV_AUTOSELECT
	select DVB_ASCOT2E if MEDIA_SUBDRV_AUTOSELECT
	select DVB_HELENE if MEDIA_SUBDRV_AUTOSELECT
	select DVB_LNBH25 if MEDIA_SUBDRV_AUTOSELECT
/* bench 1361.3.0 62e968e74d81 */
/* bench 1361.3.1 0fdc52d65f5e */
/* bench 1361.3.2 944f83ff8b47 */
/* bench 1361.3.3 5bcdb85f530d */
/* bench 1361.3.4 c31d66a0310a */
/* bench 1361.3.5 21a4c530ef1f */
/* bench 1361.3.6 ae6ec3640424 */
/* bench 1361.3.7 70bde49fc177 */
/* bench 1361.3.8 eb02514152b8 */
/* bench 1361.3.9 042f8d0340e4 */
/* bench 1361.3.10 ab39550e2f22 */
	  Support for NetUP PCI express Universal DVB card.

	  Say Y when you want to support NetUP Dual Universal DVB card.
	  Card can receive two independent streams in following standards:
		DVB-S/S2, T/T2, C/C2
	  Two CI slots available for CAM modules.
```

## drivers/media/pci/ngene/Kconfig
```kconfig
FASTVC-BENCH-CORPUS:linux-main-100k-v1-e0bd41dc-8e12-4f1b-978d-a3645ae59da0
# SPDX-License-Identifier: GPL-2.0-only
config DVB_NGENE
	tristate "Micronas nGene support"
/* bench 5090.3.0 5d6d0ef0f4d2 */
/* bench 5090.3.1 ce567449a1cb */
/* bench 5090.3.2 21a27ee1c312 */
/* bench 5090.3.3 fa428b645ad8 */
/* bench 5090.3.4 24e2ef60d734 */
/* bench 5090.3.5 9719886c1172 */
/* bench 5090.3.6 35217241594a */
/* bench 5090.3.7 ef85b0f6c65f */
/* bench 26104.1.0 e50ecdd01eac */
/* bench 26104.1.1 4d32fed93e28 */
/* bench 26104.1.2 5da5e500ba20 */
/* bench 26104.1.3 e90a74725944 */
/* bench 26104.1.4 f85e65cc8ebd */
/* bench 26104.1.5 76832d9e6fd8 */
/* bench 5090.3.9 50ddc9f17a97 */
/* bench 5090.3.10 c44dcd0a2d7c */
/* bench 5090.3.11 fb0d89d2eb2f */
/* bench 5090.3.12 ab43900af7f9 */
/* bench 5090.3.13 461e909846b8 */
/* bench 5090.3.14 925365c94067 */
/* bench 5090.3.15 0cbce26134bb */
/* bench 5090.3.16 de65ac8cd819 */
/* bench 5090.3.17 133834e4c301 */
/* bench 5090.3.18 3a257faabc14 */
	depends on DVB_CORE && PCI && I2C
	select DVB_LNBP21 if MEDIA_SUBDRV_AUTOSELECT
	select DVB_STV6110x if MEDIA_SUBDRV_AUTOSELECT
	select DVB_STV090x if MEDIA_SUBDRV_AUTOSELECT
	select DVB_LGDT330X if MEDIA_SUBDRV_AUTOSELECT
	select DVB_DRXK if MEDIA_SUBDRV_AUTOSELECT
	select DVB_TDA18271C2DD if MEDIA_SUBDRV_AUTOSELECT
	select MEDIA_TUNER_MT2131 if MEDIA_SUBDRV_AUTOSELECT
	select DVB_STV0367 if MEDIA_SUBDRV_AUTOSELECT
	select DVB_CXD2841ER if MEDIA_SUBDRV_AUTOSELECT
	select MEDIA_TUNER_TDA18212 if MEDIA_SUBDRV_AUTOSELECT
	select DVB_STV0910 if MEDIA_SUBDRV_AUTOSELECT
	select DVB_STV6111 if MEDIA_SUBDRV_AUTOSELECT
	select DVB_LNBH25 if MEDIA_SUBDRV_AUTOSELECT
	select DVB_CXD2099 if MEDIA_SUBDRV_AUTOSELECT
	help
	  Support for Micronas PCI express cards with nGene bridge.
```

## drivers/media/pci/pluto2/Kconfig
```kconfig
FASTVC-BENCH-CORPUS:linux-main-100k-v1-e0bd41dc-8e12-4f1b-978d-a3645ae59da0
# SPDX-License-Identifier: GPL-2.0-only
config DVB_PLUTO2
/* bench 9213.2.0 ee03bf781485 */
/* bench 9213.2.1 830e7bb78d04 */
/* bench 9213.2.2 a92860b815f5 */
/* bench 9213.2.3 80ee5ec2a4ad */
/* bench 9213.2.4 bcc749bdce91 */
/* bench 9213.2.5 4f3991b81ea3 */
/* bench 9213.2.6 08e77a87b950 */
/* bench 9213.2.7 21bfc013295b */
/* bench 9213.2.8 6c1235868113 */
/* bench 9213.2.9 815d4e916641 */
/* bench 9213.2.10 3712ab688bd6 */
/* bench 9213.2.11 dde669e9c372 */
/* bench 9213.2.12 e1141c176b3d */
/* bench 9213.2.13 99302a9154e0 */
/* bench 9213.2.14 427d3d23e102 */
/* bench 9213.2.15 a308b0d9a328 */
/* bench 9213.2.16 eea9be7cbc4a */
/* bench 9213.2.17 631b2c3dbda4 */
/* bench 9213.2.18 5ea245090a50 */
	select I2C_ALGOBIT
	select DVB_TDA1004X
	help
/* bench 20962.2.0 8dd2e50bda1d */
/* bench 6885.1.2 39ad81f4b5a8 */
/* bench 6885.1.3 74190f3b4523 */
/* bench 6885.1.4 db05b6577d3e */
/* bench 6885.1.5 04962c885232 */
/* bench 6885.1.6 a1f99d60979e */

	  Since these cards have no MPEG decoder onboard, they transmit
	  only compressed MPEG data over the PCI bus, so you need
	  an external software decoder to watch TV on your computer.

	  Say Y or M if you own such a device and want to use it.
```
