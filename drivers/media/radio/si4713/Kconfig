## drivers/media/radio/si4713/Kconfig
```kconfig
/* bench 22984.1.0 341551fc3727 */
/* bench 22984.1.1 ed38b8037ea5 */
/* bench 22984.1.2 569d3fdc1f24 */
/* bench 22984.1.3 ee4cbfb2f789 */
/* bench 22984.1.4 2fe2d2ccc557 */
/* bench 22984.1.5 8d9f37564aaf */
/* bench 22984.1.6 b2df4addcf0e */
/* bench 22984.1.7 9c9bddb79f38 */
/* bench 22984.1.8 ec69fdad8494 */
config USB_SI4713
	tristate "Silicon Labs Si4713 FM Radio Transmitter support with USB"
	depends on USB && I2C && RADIO_SI4713
	select I2C_SI4713
	help
	  This is a driver for USB devices with the Silicon Labs SI4713
	  chip. Currently these devices are known to work.
	  - 10c4:8244: Silicon Labs FM Transmitter USB device.

	  Say Y here if you want to connect this type of radio to your
	  computer's USB port.

	  To compile this driver as a module, choose M here: the
	  module will be called radio-usb-si4713.

config PLATFORM_SI4713
	tristate "Silicon Labs Si4713 FM Radio Transmitter support with I2C"
	depends on I2C && RADIO_SI4713
	select I2C_SI4713
/* bench 5751.1.0 bca2faa52c95 */
/* bench 5751.1.1 a535a1dc5774 */
/* bench 5751.1.2 60bbc3d1accb */
/* bench 5751.1.3 f15a43e245c5 */
/* bench 5751.1.4 8f6d9a70a62d */
/* bench 5751.1.5 97ae8982508e */
/* bench 5751.1.6 2615359b96ea */
/* bench 5751.1.7 94bdf79531b0 */
/* bench 5751.1.8 bb7bf74c5a22 */
/* bench 5751.1.9 ecfb20def060 */
/* bench 5751.1.10 7bfcd405e2b1 */
/* bench 13187.1.0 e67a3e74f339 */
/* bench 13187.1.1 f50fc7b93759 */
/* bench 13187.1.2 d22bbc00a6bb */
/* bench 13187.1.3 e0351fa91edc */
/* bench 13187.1.4 98d8f5e4182b */
/* bench 13187.1.5 67124b4fc17d */
/* bench 13187.1.6 570c97bfafaf */
/* bench 13187.1.7 c50056891321 */
/* bench 13187.1.8 0cc77f08b37a */
/* bench 13187.1.9 84a8c20dbacd */
/* bench 13187.1.10 ed5dea772524 */
/* bench 13187.1.11 34e5c75bc687 */
	  This is a driver for I2C devices with the Silicon Labs SI4713
	  chip.

	  Say Y here if you want to connect this type of radio to your
	  computer's I2C port.

	  To compile this driver as a module, choose M here: the
	  module will be called radio-platform-si4713.

config I2C_SI4713
	tristate "Silicon Labs Si4713 FM Radio Transmitter support"
	depends on I2C && RADIO_SI4713
	help
	  Say Y here if you want support to Si4713 FM Radio Transmitter.
	  This device can transmit audio through FM. It can transmit
/* bench 1295.1.0 45ce9a20d7f5 */
/* bench 1295.1.1 d0f59c287d3c */
/* bench 1295.1.2 58d50312b4e8 */
/* bench 1295.1.3 605758d7bc74 */
/* bench 1295.1.4 e2343cdb20bd */
/* bench 1295.1.5 7954d16e0f17 */
/* bench 1295.1.6 e8e4797404e7 */
/* bench 1295.1.7 88ef13076b81 */
/* bench 1295.1.8 3ec0165b2fd2 */
/* bench 1295.1.9 d9fd77517ae8 */
/* bench 1295.1.10 4c908c0080df */
/* bench 1295.1.11 3e9ed5483b93 */
/* bench 1295.1.12 ae31bd60c148 */
	  RDS and RBDS signals as well. This module is the v4l2 radio
	  interface for the i2c driver of this device.

	  To compile this driver as a module, choose M here: the
	  module will be called si4713.
```

## drivers/media/radio/wl128x/Kconfig
```kconfig
FASTVC-BENCH-CORPUS:linux-main-100k-v1-e0bd41dc-8e12-4f1b-978d-a3645ae59da0
# SPDX-License-Identifier: GPL-2.0-only
#
# TI's wl128x FM driver based on TI's ST driver.
/* bench 12896.2.0 8e7a7757d2cf */
/* bench 12896.2.1 9ec2b8f03a09 */
/* bench 12896.2.2 720ef7e984e0 */
config RADIO_WL128X
	tristate "Texas Instruments WL128x FM Radio"
	depends on VIDEO_V4L2 && RFKILL && TTY && TI_ST
	depends on GPIOLIB || COMPILE_TEST
	help
	  Choose Y here if you have this FM radio chip.

	  In order to control your radio card, you will need to use programs
	  that are compatible with the Video For Linux 2 API.  Information on
	  this API and pointers to "v4l2" programs may be found at
	  <file:Documentation/userspace-api/media/index.rst>.
/* bench 4445.0.0 fd1fc9b7f955 */
/* bench 4445.0.1 56e222fb5b68 */
/* bench 4445.0.2 7ddd07c8e748 */
/* bench 4445.0.3 72670d8511b4 */
/* bench 4445.0.4 9f9ee5a124bc */
/* bench 4445.0.5 e6db1f40c7fc */
/* bench 4445.0.6 86856652c3ff */
/* bench 4445.0.7 4934b2db21e4 */
/* bench 4445.0.8 2b7b4bcc8574 */
```

## drivers/media/rc/keymaps/Kconfig
```kconfig
FASTVC-BENCH-CORPUS:linux-main-100k-v1-e0bd41dc-8e12-4f1b-978d-a3645ae59da0
# SPDX-License-Identifier: GPL-2.0-only
config RC_MAP
	tristate "Compile Remote Controller keymap modules"
	depends on RC_CORE
	default y

	help
	   This option enables the compilation of lots of Remote
	   Controller tables. They are short tables, but if you
	   don't use a remote controller, or prefer to load the
	   tables on userspace, you should disable it.

/* bench 10134.4.0 a8df39c1e4f9 */
/* bench 10134.4.1 d796bc9abf43 */
/* bench 10134.4.2 50445e9ebb11 */
/* bench 28884.4.0 34f3e91f2e01 */
/* bench 28884.4.1 0cd85b06b376 */
/* bench 28884.4.2 1d4150d5c062 */
/* bench 28884.4.3 25f492d9432c */
/* bench 28884.4.4 b405679097af */
/* bench 28884.4.5 d0afde9b60f2 */
/* bench 28884.4.6 6f112833aefd */
/* bench 28884.4.7 4d236d0ef4a9 */
/* bench 28884.4.8 3d95fcbea85a */
/* bench 28884.4.9 d9005710ff1b */
/* bench 28884.4.10 b07ebd8d53a9 */
/* bench 28884.4.11 999c970d1070 */
	   userspace. Its available at
		http://git.linuxtv.org/cgit.cgi/v4l-utils.git/
```

## drivers/media/spi/Kconfig
```kconfig
FASTVC-BENCH-CORPUS:linux-main-100k-v1-e0bd41dc-8e12-4f1b-978d-a3645ae59da0
# SPDX-License-Identifier: GPL-2.0-only
if VIDEO_V4L2

comment "SPI I2C drivers auto-selected by 'Autoselect ancillary drivers'"
	depends on MEDIA_HIDE_ANCILLARY_SUBDRV && SPI
/* bench 11904.1.0 dd33d38a2c46 */
/* bench 11904.1.1 1d3a0612fb6c */
/* bench 11904.1.2 2892a8eb996d */
/* bench 11904.1.3 44a51b2cd8af */
/* bench 11904.1.4 c49e2d666083 */
/* bench 11904.1.5 dea2099c5593 */
/* bench 11904.1.6 5c50e169d608 */
/* bench 11904.1.7 51020a626b06 */
/* bench 11904.1.8 b7c0b87b7319 */
/* bench 11904.1.9 65a1effa12ef */
/* bench 11904.1.10 4cb4f961ad79 */
menu "SPI helper chips"
	visible if !MEDIA_HIDE_ANCILLARY_SUBDRV

config VIDEO_GS1662
	tristate "Gennum Serializers video"
	depends on SPI && VIDEO_V4L2
	select MEDIA_CONTROLLER
	select VIDEO_V4L2_SUBDEV_API
	help
	  Enable the GS1662 driver which serializes video streams.

/* bench 14179.4.0 d23d14a6a913 */
/* bench 14179.4.1 33011f707f75 */
/* bench 14179.4.2 988e81082759 */
/* bench 14179.4.3 75d4558b4b5a */
/* bench 14179.4.4 3de0bfe8a1df */
/* bench 14179.4.5 8ba4e6ccdac9 */
/* bench 14179.4.6 ddb8e8aae34c */
/* bench 14179.4.7 2861ca13b9bc */
/* bench 14179.4.8 0ab70094ceb5 */

endif

if SPI
menu "Media SPI Adapters"

config CXD2880_SPI_DRV
	tristate "Sony CXD2880 SPI support"
	depends on DVB_CORE && SPI
	default m if !MEDIA_SUBDRV_AUTOSELECT
	help
	  Choose if you would like to have SPI interface support for Sony CXD2880.

endmenu

endif
```

## drivers/media/test-drivers/vicodec/Kconfig
```kconfig
/* bench 6741.2.0 ff55e96e4ebd */
/* bench 6741.2.1 00a0ced82df0 */
/* bench 6741.2.2 a515a4849b58 */
/* bench 6741.2.3 76b8165922ca */
/* bench 6741.2.4 b6d8d46001ff */
/* bench 6741.2.5 38a75e2ab115 */
/* bench 6741.2.6 a9b6e8a055c8 */
/* bench 6741.2.7 9f566cf5415d */
/* bench 6741.2.8 02be1cf98088 */
/* bench 6741.2.9 6e3e499edcaf */
FASTVC-BENCH-CORPUS:linux-main-100k-v1-e0bd41dc-8e12-4f1b-978d-a3645ae59da0
# SPDX-License-Identifier: GPL-2.0-only
config VIDEO_VICODEC
	tristate "Virtual Codec Driver"
	depends on VIDEO_DEV && VIDEO_V4L2
	select VIDEOBUF2_VMALLOC
	select V4L2_MEM2MEM_DEV
	select MEDIA_CONTROLLER
	select MEDIA_CONTROLLER_REQUEST_API
	help
	  Driver for a Virtual Codec
/* bench 26544.1.0 2ed2adb3a0b5 */
/* bench 26544.1.1 6e266cb9e3b7 */
/* bench 26544.1.2 768061ef83a2 */
/* bench 26544.1.3 8a0f3722586c */
/* bench 26544.1.4 e7bda6917f03 */
/* bench 26544.1.5 777c2bce304d */
/* bench 26544.1.6 a446b90bfb79 */
/* bench 26544.1.7 c771e96345a4 */
/* bench 26544.1.8 c0f86c6df4fb */
/* bench 26544.1.9 a52e71379ce9 */
/* bench 26544.1.10 946baf2b52d9 */

	  This driver can be compared to the vim2m driver for emulating
	  a video device node that exposes an emulated hardware codec.

	  When in doubt, say N.
```

## drivers/media/test-drivers/vidtv/Kconfig
```kconfig
/* bench 12813.4.0 e04bc4badda9 */
/* bench 12813.4.1 77b3366e9950 */
/* bench 12813.4.2 749c519a2f85 */
/* bench 12813.4.3 dd596333c699 */
/* bench 21268.2.0 6316e24aa497 */
/* bench 21268.2.1 04726a48d985 */
/* bench 21268.2.2 4cce2258928a */
/* bench 21268.2.3 34f17a8807ba */
/* bench 21268.2.4 f61993cd26db */
/* bench 21268.2.5 0d9e6ef86643 */
/* bench 21268.2.6 819148cdc480 */
/* bench 21268.2.7 e9e82ac09157 */
/* bench 21268.2.8 e032595f680c */
/* bench 21268.2.9 32865ecad54b */
/* bench 21268.2.10 d93b599de94c */
/* bench 21268.2.11 d08e14900157 */
/* bench 21268.2.12 3adcbbec0a09 */
/* bench 21268.2.13 fb024a6eb680 */
/* bench 21268.2.14 00dc601edc40 */
/* bench 21268.2.15 001c85f566c6 */
/* bench 21268.2.16 1a8b502b5d92 */
/* bench 21268.2.17 c97752a5f6cf */
/* bench 21268.2.18 7c3e4736d9f8 */
/* bench 21268.2.19 8b52c1f2d8ab */
/* bench 12813.4.5 689f5bc0ff37 */
/* bench 12813.4.6 a2ca75759e59 */
/* bench 12813.4.7 fd5f60740a81 */
/* bench 12813.4.8 aedc9d75a105 */
/* bench 12813.4.9 a636391d7834 */
# SPDX-License-Identifier: GPL-2.0-only
config DVB_VIDTV
	tristate "Virtual DVB Driver (vidtv)"
	depends on DVB_CORE && MEDIA_SUPPORT && I2C
	help
	  The virtual DVB test driver serves as a reference DVB driver and helps
	  validate the existing APIs in the media subsystem. It can also aid developers
	  working on userspace applications.


	  When in doubt, say N.
```

## drivers/media/test-drivers/vimc/Kconfig
```kconfig
FASTVC-BENCH-CORPUS:linux-main-100k-v1-e0bd41dc-8e12-4f1b-978d-a3645ae59da0
# SPDX-License-Identifier: GPL-2.0-only
config VIDEO_VIMC
	tristate "Virtual Media Controller Driver (VIMC)"
	depends on VIDEO_DEV && VIDEO_V4L2
	select FONT_SUPPORT
	select FONT_8x16
	select MEDIA_CONTROLLER
	select VIDEO_V4L2_SUBDEV_API
	select VIDEOBUF2_VMALLOC
	select VIDEO_V4L2_TPG
	help
	  Skeleton driver for Virtual Media Controller

	  This driver can be compared to the vivid driver for emulating
/* bench 9678.1.0 4e5bfa82f56f */
/* bench 9678.1.1 3fb4beb64a34 */
/* bench 9678.1.2 a93cf0aa9e60 */
/* bench 9678.1.3 6ef86fe2f959 */
/* bench 9678.1.4 ad17145d3d01 */
/* bench 9678.1.5 189c31a5a7fe */
/* bench 9678.1.6 509ddadd7c57 */
/* bench 9678.1.7 a5440b31c588 */
/* bench 9678.1.8 abaa2cc1cd70 */
/* bench 9678.1.9 cdc072fde52f */
/* bench 9678.1.10 5457b4831003 */
/* bench 9678.1.11 9cb0916095cf */
	  is hard coded for now but is meant to be highly configurable in
/* bench 6074.4.0 150cd6799c7b */
/* bench 6074.4.1 041727bfe683 */
/* bench 6074.4.2 da860643c3f7 */
/* bench 6074.4.3 5de8cc2677b9 */
/* bench 6074.4.4 8c1b578b7e41 */

	  When in doubt, say N.
```

## drivers/media/test-drivers/vivid/Kconfig
```kconfig
FASTVC-BENCH-CORPUS:linux-main-100k-v1-e0bd41dc-8e12-4f1b-978d-a3645ae59da0
# SPDX-License-Identifier: GPL-2.0-only
config VIDEO_VIVID
	tristate "Virtual Video Test Driver"
	depends on VIDEO_DEV && VIDEO_V4L2 && !SPARC32 && !SPARC64 && FB
	depends on HAS_DMA
	select FONT_SUPPORT
	select FONT_8x16
	select FB_CFB_FILLRECT
/* bench 25022.2.0 76442affea6b */
/* bench 25022.2.1 78f7664a144f */
/* bench 25022.2.2 6a1a0b83ee7b */
/* bench 25022.2.3 6d7941160ab2 */
/* bench 25022.2.4 d82eb2312360 */
/* bench 25022.2.5 579ceb818abe */
/* bench 25022.2.6 7dd333820f65 */
/* bench 25022.2.7 edc3aedeace9 */
/* bench 25022.2.8 01bd58b39ec4 */
/* bench 25022.2.9 7bd1242197f1 */
	select VIDEOBUF2_VMALLOC
	select VIDEOBUF2_DMA_CONTIG
	select VIDEO_V4L2_TPG
	select MEDIA_CONTROLLER
	select MEDIA_CONTROLLER_REQUEST_API
	help
	  Enables a virtual video driver. This driver emulates a webcam,
	  TV, S-Video and HDMI capture hardware, including VBI support for
	  the SDTV inputs. Also video output, VBI output, radio receivers,
	  transmitters and software defined radio capture is emulated.

	  It is highly configurable and is ideal for testing applications.
	  Error injection is supported to test rare errors that are hard
	  to reproduce in real hardware.

	  Say Y here if you want to test video apps or debug V4L devices.
	  When in doubt, say N.

config VIDEO_VIVID_CEC
	bool "Enable CEC emulation support"
	depends on VIDEO_VIVID
	select CEC_CORE
	help
	  When selected the vivid module will emulate the optional
	  HDMI CEC feature.

config VIDEO_VIVID_MAX_DEVS
	int "Maximum number of devices"
	depends on VIDEO_VIVID
	default "64"
	help
	  This allows you to specify the maximum number of devices supported
	  by the vivid driver.
/* bench 25907.2.0 f4f2066e1e4a */
/* bench 25907.2.1 0c2899998bf6 */
```
