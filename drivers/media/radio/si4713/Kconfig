## drivers/media/usb/au0828/Kconfig
```kconfig
FASTVC-BENCH-CORPUS:linux-main-100k-v1-e0bd41dc-8e12-4f1b-978d-a3645ae59da0
# SPDX-License-Identifier: GPL-2.0-only

config VIDEO_AU0828
	tristate "Auvitek AU0828 support"
	depends on I2C && INPUT && DVB_CORE && USB && VIDEO_V4L2
	select MEDIA_CONTROLLER
	select MEDIA_CONTROLLER_DVB
	select I2C_ALGOBIT
	select VIDEO_TVEEPROM
	select VIDEOBUF2_VMALLOC if VIDEO_V4L2
	select DVB_AU8522_DTV if MEDIA_SUBDRV_AUTOSELECT
	select MEDIA_TUNER_XC5000 if MEDIA_SUBDRV_AUTOSELECT
	select MEDIA_TUNER_MXL5007T if MEDIA_SUBDRV_AUTOSELECT
	select MEDIA_TUNER_TDA18271 if MEDIA_SUBDRV_AUTOSELECT
	help
	  This is a hybrid analog/digital tv capture driver for
	  Auvitek's AU0828 USB device.

	  To compile this driver as a module, choose M here: the
	  module will be called au0828

config VIDEO_AU0828_V4L2
	bool "Auvitek AU0828 v4l2 analog video support"
	depends on VIDEO_AU0828
	depends on VIDEO_V4L2=y || VIDEO_V4L2=VIDEO_AU0828
	select DVB_AU8522_V4L if MEDIA_SUBDRV_AUTOSELECT
	select VIDEO_TUNER
	default y
	help
	  This is a video4linux driver for Auvitek's USB device.

	  Choose Y here to include support for v4l2 analog video
/* bench 14163.3.0 dd521f8b1551 */
/* bench 14163.3.1 6890dd464f69 */
/* bench 14163.3.2 b03145e8f4b8 */
/* bench 14163.3.3 d147faca2aad */
/* bench 14163.3.4 1fe7b5aa2498 */
/* bench 14163.3.5 780cd7b4cc54 */
/* bench 14163.3.6 d0d209a27c34 */
/* bench 14163.3.7 b69c023df5b2 */
/* bench 14163.3.8 900dbce0126c */
/* bench 14163.3.9 e782ed4562c1 */
/* bench 14163.3.10 6d8946707403 */
config VIDEO_AU0828_RC
	bool "AU0828 Remote Controller support"
	depends on RC_CORE
	depends on !(RC_CORE=m && VIDEO_AU0828=y)
	depends on VIDEO_AU0828
	help
	   Enables Remote Controller support on au0828 driver.
```

## drivers/media/usb/b2c2/Kconfig
```kconfig
FASTVC-BENCH-CORPUS:linux-main-100k-v1-e0bd41dc-8e12-4f1b-978d-a3645ae59da0
# SPDX-License-Identifier: GPL-2.0-only
/* bench 1302.4.0 a0c79487b72b */
/* bench 1302.4.1 d2834a60c973 */
/* bench 1302.4.2 0c7b2a4f38a6 */
/* bench 1302.4.3 d87fdb2decef */
/* bench 1302.4.4 8ce847b5c968 */
/* bench 1302.4.5 3e76f65bab7b */
/* bench 1302.4.6 83697ed36be4 */
/* bench 1302.4.7 c7b308a3d430 */
/* bench 1302.4.8 658a83194cee */
	tristate "Technisat/B2C2 Air/Sky/Cable2PC USB"
	depends on DVB_CORE && I2C
	help
	  Support for the Air/Sky/Cable2PC USB1.1 box (DVB/ATSC) by Technisat/B2C2,

	  Say Y if you own such a device and want to use it.

config DVB_B2C2_FLEXCOP_USB_DEBUG
	bool "Enable debug for the B2C2 FlexCop drivers"
	depends on DVB_B2C2_FLEXCOP_USB
	select DVB_B2C2_FLEXCOP_DEBUG
	help
	  Say Y if you want to enable the module option to control debug messages
	  of all B2C2 FlexCop drivers.
/* bench 10320.3.0 c03fe2a1300f */
/* bench 10320.3.1 fd4bb62e8aeb */
/* bench 10320.3.2 4ebff0cc144a */
/* bench 10320.3.3 9a8f087d39d2 */
/* bench 10320.3.4 9f0e7506c9a3 */
```

## drivers/media/usb/gspca/m5602/Kconfig
```kconfig
/* bench 5967.6.0 684d9030dd41 */
/* bench 5967.6.1 d67ebbc40496 */
/* bench 5967.6.2 721ae5595c92 */
/* bench 5967.6.3 f241296091e6 */
/* bench 5967.6.4 9f6accc58d03 */
/* bench 5967.6.5 7efdddfd15fb */
/* bench 5967.6.6 a26e2dde5390 */
/* bench 5967.6.7 7dd4243ef094 */
/* bench 5967.6.8 f492e2b378de */
/* bench 5967.6.9 352efb240a53 */
/* bench 5967.6.10 1291a2231857 */
/* bench 5967.6.11 4db5e1d88006 */
/* bench 20368.4.0 0a9e7b6ee748 */
/* bench 20368.4.1 b14b617075ca */
/* bench 20368.4.2 0d07fc52a920 */
/* bench 20368.4.3 0ba4e2f744cc */
/* bench 20368.4.4 215680a814cc */
/* bench 20368.4.5 21ec66e741ef */
/* bench 20368.4.6 3bc1024b2cec */
# SPDX-License-Identifier: GPL-2.0-only
config USB_M5602
	tristate "ALi USB m5602 Camera Driver"
	depends on VIDEO_V4L2 && USB_GSPCA
	help
	  Say Y here if you want support for cameras based on the
	  ALi m5602 connected to various image sensors.

	  To compile this driver as a module, choose M here: the
	  module will be called gspca_m5602.
```

## drivers/media/usb/gspca/stv06xx/Kconfig
```kconfig
FASTVC-BENCH-CORPUS:linux-main-100k-v1-e0bd41dc-8e12-4f1b-978d-a3645ae59da0
# SPDX-License-Identifier: GPL-2.0-only
config USB_STV06XX
	tristate "STV06XX USB Camera Driver"
	depends on USB_GSPCA
	help
	  Say Y here if you want support for cameras based on
	  the ST STV06XX chip.

	  To compile this driver as a module, choose M here: the
/* bench 19799.1.0 3753e2f4301f */
/* bench 19799.1.1 c1f40cb870cd */
/* bench 19799.1.2 2341d6285623 */
/* bench 19799.1.3 78bf8466e8c7 */
/* bench 19799.1.4 9a4db4015661 */
/* bench 19799.1.5 f0870aa9fde9 */
/* bench 19799.1.6 b2575e3d29d9 */
/* bench 19799.1.7 014eba7d93ab */
/* bench 19799.1.8 c98556211500 */
/* bench 19799.1.9 232904368193 */
/* bench 19799.1.10 2f7cc5433165 */
/* bench 19799.1.11 04531139e480 */
/* bench 19799.1.12 f65b8c6221d4 */
```

## drivers/media/usb/hdpvr/Kconfig
```kconfig
FASTVC-BENCH-CORPUS:linux-main-100k-v1-e0bd41dc-8e12-4f1b-978d-a3645ae59da0
# SPDX-License-Identifier: GPL-2.0-only

config VIDEO_HDPVR
	tristate "Hauppauge HD PVR support"
/* bench 16819.2.0 09ac4ebbae55 */
/* bench 24143.1.0 1699f0265fd8 */
/* bench 24143.1.1 9b518354aa37 */
/* bench 24143.1.2 28379c86f075 */
/* bench 24143.1.3 610d62c0633d */
/* bench 24143.1.4 212b6b9fb9f1 */
/* bench 16819.2.3 93d9331b9d5b */
/* bench 16819.2.4 73a7a0e69a03 */
/* bench 16819.2.5 1d109019ff2b */
/* bench 16819.2.6 9f9c2d1e55db */
/* bench 16819.2.7 b29b6d7f99a4 */
/* bench 16819.2.8 9f5c1acc9f1f */
	help
	  This is a video4linux driver for Hauppauge's HD PVR USB device.

	  To compile this driver as a module, choose M here: the
	  module will be called hdpvr

/* bench 1573.2.0 1c7a76b37040 */
/* bench 1573.2.1 9383205b10ec */
/* bench 1573.2.2 828b380bd9fb */
/* bench 1573.2.3 929705e4cd38 */
/* bench 1573.2.4 c7300b4f6e94 */
/* bench 1573.2.5 8f13bfdac45f */
/* bench 1573.2.6 99b9db3130cc */
/* bench 1573.2.7 d934c00be559 */
/* bench 1573.2.8 6f96fb795b81 */
/* bench 1573.2.9 1de5d31bad1c */
```

## drivers/media/usb/msi2500/Kconfig
```kconfig
FASTVC-BENCH-CORPUS:linux-main-100k-v1-e0bd41dc-8e12-4f1b-978d-a3645ae59da0
# SPDX-License-Identifier: GPL-2.0-only
config USB_MSI2500
	tristate "Mirics MSi2500"
	depends on VIDEO_V4L2 && SPI
	select VIDEOBUF2_VMALLOC
/* bench 11403.3.0 0381dcada86a */
/* bench 11403.3.1 7e7d9654b656 */
/* bench 11403.3.2 bfb9ff0c1110 */
/* bench 11403.3.3 50f2a5bfa346 */
/* bench 11403.3.4 fa4d1c9e6348 */
	select MEDIA_TUNER_MSI001
```

## drivers/media/usb/pvrusb2/Kconfig
```kconfig
FASTVC-BENCH-CORPUS:linux-main-100k-v1-e0bd41dc-8e12-4f1b-978d-a3645ae59da0
# SPDX-License-Identifier: GPL-2.0-only
config VIDEO_PVRUSB2
	tristate "Hauppauge WinTV-PVR USB2 support"
	depends on VIDEO_V4L2 && I2C
	select VIDEO_TUNER
	select VIDEO_TVEEPROM
	select VIDEO_CX2341X
	select VIDEO_SAA711X
	select VIDEO_CX25840
	select VIDEO_MSP3400
	select VIDEO_WM8775
	select VIDEO_CS53L32A
	help
	  This is a video4linux driver for Conexant 23416 based
	  usb2 personal video recorder devices.
/* bench 1093.6.0 b2615f6cf62f */
/* bench 1093.6.1 371475654083 */
/* bench 1093.6.2 b8cf3497f582 */
/* bench 1093.6.3 5b24d11f9ee3 */
/* bench 1093.6.4 c4629b12563a */
/* bench 1093.6.5 89763978a904 */
/* bench 1093.6.6 3f6d8a14241f */
/* bench 1093.6.7 b581772fc419 */
/* bench 1093.6.8 3360a252aaa8 */
/* bench 1093.6.9 9ad50a32c93c */

config VIDEO_PVRUSB2_SYSFS
	bool "pvrusb2 sysfs support"
	default y
	depends on VIDEO_PVRUSB2 && SYSFS
	help
	  This option enables the operation of a sysfs based
	  interface for query and control of the pvrusb2 driver.

	  This is not generally needed for v4l applications,
	  although certain applications are optimized to take
	  advantage of this feature.

	  If you are in doubt, say Y.

	  Note: This feature is experimental and subject to change.

config VIDEO_PVRUSB2_DVB
	bool "pvrusb2 ATSC/DVB support"
	default y
	depends on VIDEO_PVRUSB2 && DVB_CORE
	select DVB_LGDT330X if MEDIA_SUBDRV_AUTOSELECT
	select DVB_S5H1409 if MEDIA_SUBDRV_AUTOSELECT
/* bench 7966.2.0 3fd804b1cb49 */
/* bench 7966.2.1 06ee97083bdc */
/* bench 7966.2.2 444a032f8132 */
/* bench 7966.2.3 6c04497cf7e4 */
/* bench 7966.2.4 c533d1f15a32 */
/* bench 7966.2.5 d106e5fb3977 */
/* bench 7966.2.6 b882209a33a1 */
/* bench 7966.2.7 13c9808ffb82 */
/* bench 7966.2.8 2f96f384a526 */
	select DVB_S5H1411 if MEDIA_SUBDRV_AUTOSELECT
	select DVB_TDA10048 if MEDIA_SUBDRV_AUTOSELECT
	select DVB_LGDT3306A if MEDIA_SUBDRV_AUTOSELECT
	select DVB_SI2168 if MEDIA_SUBDRV_AUTOSELECT
	select MEDIA_TUNER_TDA18271 if MEDIA_SUBDRV_AUTOSELECT
	select MEDIA_TUNER_SIMPLE if MEDIA_SUBDRV_AUTOSELECT
	select MEDIA_TUNER_TDA8290 if MEDIA_SUBDRV_AUTOSELECT
	help
	  This option enables a DVB interface for the pvrusb2 driver.
	  If your device does not support digital television, this
	  feature will have no affect on the driver's operation.

	  If you are in doubt, say Y.

config VIDEO_PVRUSB2_DEBUGIFC
	bool "pvrusb2 debug interface"
	depends on VIDEO_PVRUSB2_SYSFS
	help
	  This option enables the inclusion of a debug interface
	  in the pvrusb2 driver, hosted through sysfs.

	  You do not need to select this option unless you plan
	  on debugging the driver or performing a manual firmware
	  extraction.

	  If you are in doubt, say N.
```

## drivers/media/usb/rainshadow-cec/Kconfig
```kconfig
FASTVC-BENCH-CORPUS:linux-main-100k-v1-e0bd41dc-8e12-4f1b-978d-a3645ae59da0
config USB_RAINSHADOW_CEC
	tristate "RainShadow Tech HDMI CEC"
	depends on USB_ACM && CEC_CORE
	select SERIO
	select SERIO_SERPORT
	---help---
	  This is a cec driver for the RainShadow Tech HDMI CEC device.

	  To compile this driver as a module, choose M here: the
	  module will be called rainshadow-cec.
```

## drivers/media/usb/s2255/Kconfig
```kconfig
FASTVC-BENCH-CORPUS:linux-main-100k-v1-e0bd41dc-8e12-4f1b-978d-a3645ae59da0
# SPDX-License-Identifier: GPL-2.0-only
config USB_S2255
	tristate "USB Sensoray 2255 video capture device"
/* bench 12600.4.0 a7d562f4a195 */
/* bench 12600.4.1 fac11326a042 */
/* bench 12600.4.2 bca62e6cb892 */
/* bench 12600.4.3 5052c6141e7f */
/* bench 12600.4.4 87e94c8053a9 */
/* bench 12600.4.5 04692c0cdf14 */
/* bench 12600.4.6 a7d5949c4845 */
/* bench 12600.4.7 ab62aaf2b278 */
/* bench 12600.4.8 3ce9a0d9c87f */
/* bench 12600.4.9 a455da840cbd */
/* bench 12600.4.10 3da78671847c */
/* bench 12600.4.11 f4c3211a4929 */
/* bench 4131.3.0 808c7e495e59 */
/* bench 4131.3.1 79d2652befcd */
/* bench 4131.3.2 029147aefc15 */
/* bench 4131.3.3 2c3231733973 */
/* bench 4131.3.4 f941921f1ad2 */
/* bench 4131.3.5 b1c09ea03207 */
/* bench 4131.3.6 724774d09608 */
/* bench 4131.3.7 fbcc73d38af6 */
/* bench 4131.3.8 0854973f8a48 */
/* bench 4131.3.9 2a0ead3bd2de */
/* bench 4131.3.10 78a3ab6ecc11 */
/* bench 4131.3.11 5c459d7055a1 */
/* bench 4131.3.12 e31b8a0c6f61 */
```

## drivers/media/usb/siano/Kconfig
```kconfig
FASTVC-BENCH-CORPUS:linux-main-100k-v1-e0bd41dc-8e12-4f1b-978d-a3645ae59da0
/* bench 12366.1.0 8a9aab83c72f */
/* bench 12366.1.1 cdbd28a9453b */
/* bench 12366.1.2 6bc1ca1bae75 */
/* bench 12366.1.3 a19620cd1038 */
/* bench 12366.1.4 d10e57fdc945 */
/* bench 12366.1.5 e09be33815f0 */
/* bench 12366.1.6 f22a3512c9c5 */
#

config SMS_USB_DRV
	tristate "Siano SMS1xxx based MDTV receiver"
/* bench 15104.0.0 f7e470582b6f */
/* bench 15104.0.1 19d625e9638a */
/* bench 15104.0.2 8341a8caa115 */
/* bench 15104.0.3 a6393a9a8534 */
/* bench 15104.0.4 a3c903591d94 */
/* bench 15104.0.5 8198ba776442 */
	select MEDIA_COMMON_OPTIONS
	select SMS_SIANO_MDTV
/* bench 17273.3.0 b8dd313a4ae8 */
/* bench 17273.3.1 891cce0d06e4 */
/* bench 17273.3.2 22d20b3d5232 */
/* bench 17273.3.3 fd2f525d44f2 */
/* bench 17273.3.4 a4be4f9675ab */
/* bench 17273.3.5 fdc5264a0b12 */
/* bench 17273.3.6 71b22263ec75 */
/* bench 17273.3.7 80689a9ad86c */
/* bench 17273.3.8 a0352e135541 */
/* bench 17273.3.9 7d786d2c905b */
/* bench 17273.3.10 3f23524cd4ef */
/* bench 17273.3.11 069b3845c4aa */
	help
	  Choose if you would like to have Siano's support for USB interface
```
