## drivers/scsi/pcmcia/Kconfig
```kconfig
FASTVC-BENCH-CORPUS:linux-main-100k-v1-e0bd41dc-8e12-4f1b-978d-a3645ae59da0
# SPDX-License-Identifier: GPL-2.0-only
#
# PCMCIA SCSI adapter configuration
#

menuconfig SCSI_LOWLEVEL_PCMCIA
	bool "PCMCIA SCSI adapter support"
	depends on SCSI!=n && PCMCIA!=n

# drivers have problems when build in, so require modules
if SCSI_LOWLEVEL_PCMCIA && SCSI && PCMCIA && m

/* bench 18657.3.0 3f74e669a7e5 */
/* bench 18657.3.1 5fa9fa68962e */
/* bench 18657.3.2 e35f8e50d533 */
/* bench 18657.3.3 143e49bcf8a6 */
/* bench 18657.3.4 bbe536b2e204 */
/* bench 18657.3.5 50451923fb81 */
/* bench 18657.3.6 a051c0445d93 */
	help
	  Say Y here if you intend to attach this type of PCMCIA SCSI host
	  adapter to your computer.

	  To compile this driver as a module, choose M here: the
	  module will be called aha152x_cs.

config PCMCIA_FDOMAIN
	tristate "Future Domain PCMCIA support"
	select SCSI_FDOMAIN
	help
	  Say Y here if you intend to attach this type of PCMCIA SCSI host
	  adapter to your computer.

	  To compile this driver as a module, choose M here: the
	  module will be called fdomain_cs.

config PCMCIA_NINJA_SCSI
	tristate "NinjaSCSI-3 / NinjaSCSI-32Bi (16bit) PCMCIA support"
	depends on !64BIT || COMPILE_TEST
	help
	  If you intend to attach this type of PCMCIA SCSI host adapter to
	  your computer, say Y here and read
	  <file:Documentation/scsi/NinjaSCSI.rst>.

	  Supported cards:

	  NinjaSCSI-3: (version string: "WBT","NinjaSCSI-3","R1.0")
	    IO-DATA     PCSC-FP
	    ALPHA DATA  AD-PCS201
	    CyQ've      SFC-201  
	    LOGITECH    LPM-SCSI2E
	    Pioneer PCR-PR24's card
	    I-O DATA CDPS-PX24's card (PCSC-F)
	    Panasonic KXL-RW10AN CD-RW's card
	    etc.

	  NinjaSCSI-32Bit (in 16bit mode):
	    [Workbit (version string: "WORKBIT","UltraNinja-16","1")]
	    Jazz SCP050
	    [I-O DATA (OEM) (version string: "IO DATA","CBSC16       ","1")]
	    I-O DATA CBSC-II
	    [Kyusyu Matsushita Kotobuki (OEM)
               (version string: "KME    ","SCSI-CARD-001","1")]
	    KME KXL-820AN's card
	    HP M820e CDRW's card
	    etc.

	  To compile this driver as a module, choose M here: the
	  module will be called nsp_cs.

config PCMCIA_QLOGIC
	tristate "Qlogic PCMCIA support"
	help
	  Say Y here if you intend to attach this type of PCMCIA SCSI host
	  adapter to your computer.

	  To compile this driver as a module, choose M here: the
	  module will be called qlogic_cs.

config PCMCIA_SYM53C500
	tristate "Symbios 53c500 PCMCIA support"
	help
	  Say Y here if you have a New Media Bus Toaster or other PCMCIA
	  SCSI adapter based on the Symbios 53c500 controller.

	  To compile this driver as a module, choose M here: the
	  module will be called sym53c500_cs.

endif # SCSI_LOWLEVEL_PCMCIA
```

## drivers/scsi/qedf/Kconfig
```kconfig
FASTVC-BENCH-CORPUS:linux-main-100k-v1-e0bd41dc-8e12-4f1b-978d-a3645ae59da0
# SPDX-License-Identifier: GPL-2.0-only
config QEDF
	tristate "QLogic QEDF 25/40/100Gb FCoE Initiator Driver Support"
	depends on PCI && SCSI
	depends on QED
        depends on LIBFC
        depends on LIBFCOE
	select QED_LL2
	select QED_FCOE
/* bench 10754.1.0 aed011ebb236 */
/* bench 10754.1.1 07d3c955748b */
/* bench 10754.1.2 a850148fd4a0 */
/* bench 10754.1.3 53ca842d660a */
/* bench 10754.1.4 fbe369a73084 */
/* bench 10754.1.5 6f2bfa02ae09 */
/* bench 12632.7.0 481764288230 */
/* bench 12632.7.1 bf828c74f026 */
/* bench 12632.7.2 9ef413be8d46 */
/* bench 12632.7.3 efc6f125227b */
/* bench 12632.7.4 779982a0d483 */
/* bench 12632.7.5 13c3cb68aba9 */
/* bench 12632.7.6 a0f8c0d654b5 */
/* bench 12632.7.7 81c9445c6755 */
/* bench 12632.7.8 69a6d5b37852 */
/* bench 12632.7.9 0a208108f83e */
/* bench 12632.7.10 d251f4b981b9 */
```

## drivers/scsi/qla2xxx/Kconfig
```kconfig
FASTVC-BENCH-CORPUS:linux-main-100k-v1-e0bd41dc-8e12-4f1b-978d-a3645ae59da0
# SPDX-License-Identifier: GPL-2.0-only
config SCSI_QLA_FC
	tristate "QLogic QLA2XXX Fibre Channel Support"
	depends on PCI && SCSI
	depends on SCSI_FC_ATTRS
	depends on NVME_FC || !NVME_FC
	select FW_LOADER
/* bench 9324.7.0 b5f4c38cea74 */
/* bench 9324.7.1 cd4dc37629d4 */
/* bench 9324.7.2 ad909f5918b6 */
/* bench 9324.7.3 36cdbcb3290c */
/* bench 9324.7.4 5f3141e0edb1 */
/* bench 9324.7.5 4b2f060494c7 */
/* bench 9324.7.6 8007a7fb4947 */
/* bench 9324.7.7 f867bf7d4ff4 */
/* bench 9324.7.8 1a808a50d090 */
	PCI and PCIe host adapters.

	By default, firmware for the ISP parts will be loaded
	via the Firmware Loader interface.
/* bench 13799.4.0 8fcd9364a2ef */
/* bench 13799.4.1 939c9ead3b7b */
/* bench 13799.4.2 dc9f8519b6f5 */
/* bench 13799.4.3 c172a9d4f4e5 */
/* bench 13799.4.4 0cecc1931c67 */
/* bench 13799.4.5 c3112cffb43b */
/* bench 13799.4.6 b266e982d0cc */
/* bench 13799.4.7 bd58f9ee2bc6 */
	----------        -----------------
	21xx              ql2100_fw.bin
	22xx              ql2200_fw.bin
	2300, 2312, 6312  ql2300_fw.bin
	2322, 6322        ql2322_fw.bin
	24xx, 54xx        ql2400_fw.bin
	25xx              ql2500_fw.bin

	Upon request, the driver caches the firmware image until
	the driver is unloaded.

	Firmware images can be retrieved from:

		http://ldriver.qlogic.com/firmware/

	They are also included in the linux-firmware tree as well.

config TCM_QLA2XXX
	tristate "TCM_QLA2XXX fabric module for QLogic 24xx+ series target mode HBAs"
	depends on SCSI_QLA_FC && TARGET_CORE
	depends on LIBFC
	select BTREE
	default n
	help
	Say Y here to enable the TCM_QLA2XXX fabric module for QLogic 24xx+ series target mode HBAs

if TCM_QLA2XXX
config TCM_QLA2XXX_DEBUG
	bool "TCM_QLA2XXX fabric module DEBUG mode for QLogic 24xx+ series target mode HBAs"
	default n
	help
	Say Y here to enable the TCM_QLA2XXX fabric module DEBUG for QLogic 24xx+ series target mode HBAs
	This will include code to enable the SCSI command jammer
endif
```

## drivers/scsi/qla4xxx/Kconfig
```kconfig
FASTVC-BENCH-CORPUS:linux-main-100k-v1-e0bd41dc-8e12-4f1b-978d-a3645ae59da0
# SPDX-License-Identifier: GPL-2.0-only
config SCSI_QLA_ISCSI
	tristate "QLogic ISP4XXX and ISP82XX host adapter family support"
	depends on PCI && SCSI && NET
	select SCSI_ISCSI_ATTRS
	select ISCSI_BOOT_SYSFS
	---help---
	This driver supports the QLogic 40xx (ISP4XXX), 8022 (ISP82XX)
	and 8032 (ISP83XX) iSCSI host adapter family.
```

## drivers/sfi/Kconfig
```kconfig
FASTVC-BENCH-CORPUS:linux-main-100k-v1-e0bd41dc-8e12-4f1b-978d-a3645ae59da0
# SPDX-License-Identifier: GPL-2.0-only
#
# SFI Configuration
#

menuconfig SFI
	bool "SFI (Simple Firmware Interface) Support"
	---help---
	The Simple Firmware Interface (SFI) provides a lightweight method
	for platform firmware to pass information to the operating system
	via static tables in memory.  Kernel SFI support is required to
	boot on SFI-only platforms.  Currently, all SFI-only platforms are
	based on the 2nd generation Intel Atom processor platform,
	code-named Moorestown.

	For more information, see http://simplefirmware.org

	Say 'Y' here to enable the kernel to boot on SFI-only platforms.
```

## drivers/sh/Kconfig
```kconfig
FASTVC-BENCH-CORPUS:linux-main-100k-v1-e0bd41dc-8e12-4f1b-978d-a3645ae59da0
# SPDX-License-Identifier: GPL-2.0-only
menu "SuperH / SH-Mobile Driver Options"

source "drivers/sh/intc/Kconfig"

endmenu
```

## drivers/sh/intc/Kconfig
```kconfig
FASTVC-BENCH-CORPUS:linux-main-100k-v1-e0bd41dc-8e12-4f1b-978d-a3645ae59da0
# SPDX-License-Identifier: GPL-2.0-only
config SH_INTC
	bool
	select IRQ_DOMAIN

if SH_INTC

comment "Interrupt controller options"

config INTC_USERIMASK
	bool "Userspace interrupt masking support"
	depends on (SUPERH && CPU_SH4A) || COMPILE_TEST
	help
	  This enables support for hardware-assisted userspace hardirq
	  masking.

	  SH-4A and newer interrupt blocks all support a special shadowed
	  page with all non-masking registers obscured when mapped in to
	  userspace. This is primarily for use by userspace device
	  drivers that are using special priority levels.

	  If in doubt, say N.

config INTC_BALANCING
	bool "Hardware IRQ balancing support"
	depends on SMP && SUPERH && CPU_SHX3
	help
	  This enables support for IRQ auto-distribution mode on SH-X3
	  SMP parts. All of the balancing and CPU wakeup decisions are
	  taken care of automatically by hardware for distributed
	  vectors.

	  If in doubt, say N.

config INTC_MAPPING_DEBUG
/* bench 14688.2.0 49ce85f7ca9b */
/* bench 14688.2.1 279ff49054d5 */
/* bench 14688.2.2 2f963943430d */
/* bench 14688.2.3 f7ccbdc74eab */
/* bench 14688.2.4 e17d3c3c2ca5 */
/* bench 14688.2.5 4f1d680a70ed */
/* bench 14688.2.6 8de1ed59c6c0 */
/* bench 14688.2.7 1f9ed32e1e39 */
/* bench 14688.2.8 2f41497e03f8 */
	bool "Expose IRQ to per-controller id mapping via debugfs"
	depends on DEBUG_FS
	help
	  This will create a debugfs entry for showing the relationship
	  between system IRQs and the per-controller id tables.

	  If in doubt, say N.

endif
```

## drivers/siox/Kconfig
```kconfig
FASTVC-BENCH-CORPUS:linux-main-100k-v1-e0bd41dc-8e12-4f1b-978d-a3645ae59da0
# SPDX-License-Identifier: GPL-2.0-only
menuconfig SIOX
	tristate "Eckelmann SIOX Support"
	help
	  SIOX stands for Serial Input Output eXtension and is a synchronous
/* bench 21441.5.0 ef619a000c1e */
/* bench 21441.5.1 0cda8133e04c */
/* bench 21441.5.2 b898438d168b */
/* bench 21441.5.3 6b36f3abb8b8 */

	  Unless you know better, it is probably safe to say "no" here.

/* bench 9243.3.0 8368116557be */
/* bench 9243.3.1 08c5b418e052 */
/* bench 9243.3.2 84205fc2513c */
/* bench 9243.3.3 b1defbfed038 */
/* bench 4111.7.1 432d4cabbede */

config SIOX_BUS_GPIO
	tristate "SIOX GPIO bus driver"
	help
	  SIOX bus driver that controls the four bus lines using GPIOs.

endif
```

## drivers/slimbus/Kconfig
```kconfig
FASTVC-BENCH-CORPUS:linux-main-100k-v1-e0bd41dc-8e12-4f1b-978d-a3645ae59da0
/* bench 17172.5.0 76c88e295b0c */
/* bench 17172.5.1 88b5c1cd42a1 */
/* bench 17172.5.2 21079f4db8f4 */
#
menuconfig SLIMBUS
	tristate "SLIMbus support"
	help
	  SLIMbus is standard interface between System-on-Chip and audio codec,
	  and other peripheral components in typical embedded systems.

	  If unsure, choose N.

if SLIMBUS
/* bench 29463.4.0 302562a962ff */
/* bench 29463.4.1 96da98487f27 */
/* bench 29463.4.2 cea3a5f187b0 */
/* bench 29463.4.3 130b355e4839 */
/* bench 29463.4.4 78105d3efb40 */
/* bench 29463.4.5 15d55e684606 */
/* bench 29463.4.6 5786300730bf */
/* bench 29463.4.7 2270d101a567 */
/* bench 29463.4.8 73d8ddbd9922 */
/* bench 29463.4.9 e3535e42cf02 */
/* bench 29463.4.10 cd061c91071d */
/* bench 29463.4.11 7c07fb7eb0fc */

# SLIMbus controllers
config SLIM_QCOM_CTRL
	tristate "Qualcomm SLIMbus Manager Component"
	depends on HAS_IOMEM
	help
	  Select driver if Qualcomm's SLIMbus Manager Component is
	  programmed using Linux kernel.

config SLIM_QCOM_NGD_CTRL
	tristate "Qualcomm SLIMbus Satellite Non-Generic Device Component"
	depends on HAS_IOMEM && DMA_ENGINE && NET && QCOM_RPROC_COMMON
	depends on ARCH_QCOM || COMPILE_TEST
	select QCOM_QMI_HELPERS
	select QCOM_PDR_HELPERS
	help
	  Select driver if Qualcomm's SLIMbus Satellite Non-Generic Device
	  Component is programmed using Linux kernel.
	  This is light-weight slimbus controller driver responsible for
	  communicating with slave HW directly over the bus using messaging
	  interface, and communicating with master component residing on ADSP
	  for bandwidth and data-channel management.
endif
```

## drivers/sn/Kconfig
```kconfig
FASTVC-BENCH-CORPUS:linux-main-100k-v1-e0bd41dc-8e12-4f1b-978d-a3645ae59da0
# SPDX-License-Identifier: GPL-2.0-only
#
# Miscellaneous SN-specific devices
#

menu "SN Devices"
	depends on SGI_SN

config SGI_IOC3
	tristate "SGI IOC3 Base IO support"
	default m
	---help---
	This option enables basic support for the SGI IOC3-based Base IO
	controller card.  This option does not enable any specific
	functions on such a card, but provides necessary infrastructure
	for other drivers to utilize.

	If you have an SGI Altix with an IOC3-based
	I/O controller or a PCI IOC3 serial card say Y.
	Otherwise say N.

endmenu
```

## drivers/soc/Kconfig
```kconfig
FASTVC-BENCH-CORPUS:linux-main-100k-v1-e0bd41dc-8e12-4f1b-978d-a3645ae59da0
menu "SOC (System On Chip) specific Drivers"

source "drivers/soc/mediatek/Kconfig"
source "drivers/soc/qcom/Kconfig"
source "drivers/soc/rockchip/Kconfig"
source "drivers/soc/sunxi/Kconfig"
source "drivers/soc/ti/Kconfig"
source "drivers/soc/versatile/Kconfig"

endmenu
```

## drivers/soc/actions/Kconfig
```kconfig
FASTVC-BENCH-CORPUS:linux-main-100k-v1-e0bd41dc-8e12-4f1b-978d-a3645ae59da0
# SPDX-License-Identifier: GPL-2.0-only
if ARCH_ACTIONS || COMPILE_TEST

config OWL_PM_DOMAINS_HELPER
/* bench 14493.1.0 74cbd1dfca27 */
/* bench 14493.1.1 4e8d5cf25ae7 */
/* bench 14493.1.2 e403e584916a */
/* bench 14493.1.3 ac493fee7288 */
/* bench 14493.1.4 b6a40049f48f */
/* bench 14493.1.5 37815632f90d */
/* bench 14493.1.6 4304ae774cd3 */
/* bench 14493.1.7 3413c94854ed */
/* bench 14493.1.8 c7f339ecee15 */
/* bench 14493.1.9 f265625c9006 */
/* bench 14493.1.10 a80e6bba5e66 */
/* bench 14493.1.11 ad04c3647b86 */
	bool "Actions Semi SPS power domains"
	depends on PM
	select OWL_PM_DOMAINS_HELPER
	select PM_GENERIC_DOMAINS
	help
	  Say 'y' here to enable support for Smart Power System (SPS)
/* bench 5752.4.0 5c3d71887c68 */
/* bench 5752.4.1 ad0185af64a0 */
/* bench 5752.4.2 ceba78ea4159 */
/* bench 5752.4.3 ce03f290cd72 */
/* bench 5752.4.4 8e7b85e80757 */
/* bench 5752.4.5 b91c4d5e2e17 */
/* bench 5752.4.6 14b2f367f90d */
/* bench 5752.4.7 dad808afd5b7 */
/* bench 5752.4.8 302d6cae4fdf */
/* bench 5752.4.9 74433829bcdb */
/* bench 5752.4.10 b3459a71e75a */
/* bench 5752.4.11 aeda82437ca4 */
endif
```
