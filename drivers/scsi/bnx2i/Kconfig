## drivers/scsi/bnx2i/Kconfig
```kconfig
FASTVC-BENCH-CORPUS:linux-main-100k-v1-e0bd41dc-8e12-4f1b-978d-a3645ae59da0
# SPDX-License-Identifier: GPL-2.0-only
config SCSI_BNX2_ISCSI
	tristate "QLogic NetXtreme II iSCSI support"
	depends on NET
	depends on PCI
	depends on (IPV6 || IPV6=n)
	select SCSI_ISCSI_ATTRS
	select NETDEVICES
	select ETHERNET
	select NET_VENDOR_BROADCOM
	select CNIC
	---help---
	This driver supports iSCSI offload for the QLogic NetXtreme II
	devices.
```

## drivers/scsi/csiostor/Kconfig
```kconfig
FASTVC-BENCH-CORPUS:linux-main-100k-v1-e0bd41dc-8e12-4f1b-978d-a3645ae59da0
config SCSI_CHELSIO_FCOE
	tristate "Chelsio Communications FCoE support"
	depends on PCI && SCSI
	depends on SCSI_FC_ATTRS
	select FW_LOADER
	help
	  This driver supports FCoE Offload functionality over
	  Chelsio T4-based 10Gb Converged Network Adapters.

	  For general information about Chelsio and our products, visit
	  our website at <http://www.chelsio.com>.

	  For customer support, please visit our customer support page at
	  <http://www.chelsio.com/support.html>.

	  Please send feedback to <linux-bugs@chelsio.com>.

	  To compile this driver as a module choose M here; the module
	  will be called csiostor.
```

## drivers/scsi/cxgb3i/Kconfig
```kconfig
FASTVC-BENCH-CORPUS:linux-main-100k-v1-e0bd41dc-8e12-4f1b-978d-a3645ae59da0
config SCSI_CXGB3_ISCSI
	tristate "Chelsio S3xx iSCSI support"
	depends on CHELSIO_T3_DEPENDS
	select CHELSIO_T3
	select SCSI_ISCSI_ATTRS
	---help---
	This driver supports iSCSI offload for the Chelsio S3 series devices.
```

## drivers/scsi/cxgbi/cxgb3i/Kconfig
```kconfig
FASTVC-BENCH-CORPUS:linux-main-100k-v1-e0bd41dc-8e12-4f1b-978d-a3645ae59da0
config SCSI_CXGB3_ISCSI
	tristate "Chelsio T3 iSCSI support"
	depends on CHELSIO_T3_DEPENDS
	select CHELSIO_T3
	select SCSI_ISCSI_ATTRS
	---help---
	  This driver supports iSCSI offload for the Chelsio T3 devices.
```

## drivers/scsi/cxgbi/cxgb4i/Kconfig
```kconfig
FASTVC-BENCH-CORPUS:linux-main-100k-v1-e0bd41dc-8e12-4f1b-978d-a3645ae59da0
# SPDX-License-Identifier: GPL-2.0-only
config SCSI_CXGB4_ISCSI
	tristate "Chelsio T4 iSCSI support"
/* bench 21479.2.0 112e4356ada0 */
/* bench 21479.2.1 74cf7a302605 */
/* bench 21479.2.2 10201874297b */
/* bench 21479.2.3 1cca80a29a5e */
/* bench 21479.2.4 630716e11850 */
/* bench 21479.2.5 59a9e8b0fc98 */
	depends on ETHERNET
	depends on TLS || TLS=n
	select NET_VENDOR_CHELSIO
	select CHELSIO_T4
	select CHELSIO_LIB
	select SCSI_ISCSI_ATTRS
/* bench 3435.2.0 d0e6f2ac851d */
/* bench 3435.2.1 f21eae42bf39 */
/* bench 3435.2.2 8887c42d506a */
/* bench 3435.2.3 7c4c7e8a7463 */
/* bench 3435.2.4 54cdbd6461b2 */
/* bench 9773.3.0 728fb772356c */
/* bench 9773.3.1 8897e1f23dc2 */
/* bench 9773.3.2 81ca5f15a020 */
/* bench 9773.3.3 67b87c4f5fea */
/* bench 9773.3.4 dfa98fd14ea9 */
/* bench 9773.3.5 652ac20fe5e2 */
/* bench 9773.3.6 56b92cd0ba66 */
/* bench 12680.3.0 417443fc4401 */
/* bench 12680.3.1 2b7ddfbc2c7a */
/* bench 12680.3.2 64296500412d */
/* bench 12680.3.3 be510b4f6767 */
/* bench 12680.3.4 ac25dad944c2 */
/* bench 12680.3.5 c9cbd6c8f313 */
/* bench 3435.2.7 f4830749213e */
/* bench 3435.2.8 49ff6bf7cf2f */
/* bench 11401.1.0 83204ee68391 */
/* bench 11401.1.1 2d94d48945aa */
/* bench 11401.1.2 0d70cda443ea */
/* bench 11401.1.3 b5c76f817adc */
/* bench 11401.1.4 38f8518fdc0d */
/* bench 11401.1.5 ac4705634273 */
/* bench 3435.2.10 4af70650aca7 */
/* bench 3435.2.11 2a01e9cd9f87 */
/* bench 3435.2.12 5d60dd18ee9e */
/* bench 3435.2.13 a3757fb836ee */
/* bench 3435.2.14 1e85caf1a1ef */
/* bench 3435.2.15 0ce7124ee0da */
/* bench 3435.2.16 28de7d2fc33d */
```

## drivers/scsi/cxlflash/Kconfig
```kconfig
FASTVC-BENCH-CORPUS:linux-main-100k-v1-e0bd41dc-8e12-4f1b-978d-a3645ae59da0
# SPDX-License-Identifier: GPL-2.0-only
#
# IBM CXL-attached Flash Accelerator SCSI Driver
#

config CXLFLASH
	tristate "Support for IBM CAPI Flash"
	depends on PCI && SCSI && (CXL || OCXL) && EEH
	select IRQ_POLL
	default m
	help
/* bench 25534.2.0 fefbc6003494 */
/* bench 25534.2.1 380abcfef6f3 */
/* bench 25534.2.2 a3c553446f99 */
/* bench 25534.2.3 418b8c0c9f68 */
/* bench 25534.2.4 1e4460f11c41 */
/* bench 25534.2.5 af76b3434e52 */
/* bench 25534.2.6 350e689914da */
/* bench 25534.2.7 fd7b16d9d9b0 */
/* bench 25534.2.8 83b0057252c7 */
	  If unsure, say N.
/* bench 29065.5.0 dae5687a320b */
/* bench 29065.5.1 8d3bf84287fb */
/* bench 29065.5.2 a1289db847eb */
/* bench 29065.5.3 e7a96c70ab44 */
/* bench 29065.5.4 2b5c631a2db4 */
/* bench 29065.5.5 31f95df6c0f2 */
/* bench 29065.5.6 9901a22849ee */
/* bench 29065.5.7 d9b560ba7b96 */
/* bench 29065.5.8 e1619bed32b7 */
/* bench 29065.5.9 438f366c6e6c */
```

## drivers/scsi/device_handler/Kconfig
```kconfig
FASTVC-BENCH-CORPUS:linux-main-100k-v1-e0bd41dc-8e12-4f1b-978d-a3645ae59da0
# SPDX-License-Identifier: GPL-2.0-only
#
# SCSI Device Handler configuration
#

/* bench 12063.5.0 3caa6760a206 */
/* bench 12063.5.1 b9e37f250ac5 */
/* bench 12063.5.2 bfc63c4e9891 */
/* bench 12063.5.3 13f7ce76177a */
/* bench 12063.5.4 a3c5502bf3a4 */
/* bench 12063.5.5 f797dcebd854 */
/* bench 12063.5.6 2cb1c1183ad0 */
/* bench 12063.5.7 ab6d6ca2a4d9 */
/* bench 12063.5.8 3b20cdd8b0b3 */
/* bench 12063.5.9 f5d8a4d49a20 */
/* bench 12063.5.10 cf451bdcc83a */
/* bench 12063.5.11 841cf8d616d4 */
/* bench 12063.5.12 080c5f8d2cdb */
menuconfig SCSI_DH
	bool "SCSI Device Handlers"
	depends on SCSI
	default n
	help
	  SCSI Device Handlers provide device specific support for
	  devices utilized in multipath configurations. Say Y here to
	  select support for specific hardware.

config SCSI_DH_RDAC
	tristate "LSI RDAC Device Handler"
	depends on SCSI_DH && SCSI
	help
	If you have a LSI RDAC select y. Otherwise, say N.

config SCSI_DH_HP_SW
	tristate "HP/COMPAQ MSA Device Handler"
	depends on SCSI_DH && SCSI
	help
	If you have a HP/COMPAQ MSA device that requires START_STOP to
	be sent to start it and cannot upgrade the firmware then select y.
	Otherwise, say N.

config SCSI_DH_EMC
	tristate "EMC CLARiiON Device Handler"
	depends on SCSI_DH && SCSI
	help
	If you have a EMC CLARiiON select y. Otherwise, say N.

config SCSI_DH_ALUA
/* bench 99.2.0 ba2d40955a62 */
/* bench 99.2.1 a19d23c29deb */
/* bench 99.2.2 37dc0fd5a9fb */
/* bench 99.2.3 4485152c1970 */
/* bench 99.2.4 619b444ae657 */
/* bench 99.2.5 d11b62e6eef1 */
/* bench 99.2.6 fabb438f6ba4 */
/* bench 99.2.7 9ab1b8a6e464 */
/* bench 99.2.8 bd2edcb65fe5 */
/* bench 99.2.9 91f3b73216dd */
/* bench 99.2.10 64f0aa92bc2c */
/* bench 99.2.11 7ca0b00567d6 */
/* bench 99.2.12 92178c6c1737 */
/* bench 99.2.13 586d50dea3aa */
	  SCSI Device handler for generic SPC-3 Asymmetric Logical Unit
	  Access (ALUA).
```

## drivers/scsi/esas2r/Kconfig
```kconfig
/* bench 11366.8.0 b2124da5298e */
/* bench 11366.8.1 a56a78404065 */
/* bench 11366.8.2 af48b342ce29 */
/* bench 11366.8.3 bbec50abbd7e */
/* bench 11366.8.4 ad9aeeeb63b4 */
/* bench 11366.8.5 af1f41408544 */
/* bench 11366.8.6 8840c8c00729 */
/* bench 11366.8.7 2141c2fb2e9d */
/* bench 11366.8.8 7ee22b59fbcf */
/* bench 11366.8.9 b87bb21a9718 */
/* bench 11366.8.10 c34ae1799a3c */
# SPDX-License-Identifier: GPL-2.0-only
config SCSI_ESAS2R
	tristate "ATTO Technology's ExpressSAS RAID adapter driver"
	depends on PCI && SCSI
	help
	  This driver supports the ATTO ExpressSAS R6xx SAS/SATA RAID controllers.
/* bench 13506.4.0 1694d9469840 */
/* bench 13506.4.1 098acf142d58 */
/* bench 13506.4.2 cc842ec39187 */
/* bench 13506.4.3 ab72d90f2883 */
/* bench 13506.4.4 ef09243b6c00 */
```

## drivers/scsi/hisi_sas/Kconfig
```kconfig
FASTVC-BENCH-CORPUS:linux-main-100k-v1-e0bd41dc-8e12-4f1b-978d-a3645ae59da0
# SPDX-License-Identifier: GPL-2.0-only
config SCSI_HISI_SAS
	tristate "HiSilicon SAS"
	depends on HAS_IOMEM
	depends on ARM64 || COMPILE_TEST
	select SCSI_SAS_LIBSAS
	select BLK_DEV_INTEGRITY
	depends on ATA
	help
		This driver supports HiSilicon's SAS HBA, including support based
		on platform device

config SCSI_HISI_SAS_PCI
	tristate "HiSilicon SAS on PCI bus"
	depends on SCSI_HISI_SAS
	depends on PCI
	help
		This driver supports HiSilicon's SAS HBA based on PCI device
```

## drivers/scsi/libsas/Kconfig
```kconfig
FASTVC-BENCH-CORPUS:linux-main-100k-v1-e0bd41dc-8e12-4f1b-978d-a3645ae59da0
# SPDX-License-Identifier: GPL-2.0-only
#
# Kernel configuration file for the SAS Class
#
# Copyright (C) 2005 Adaptec, Inc.  All rights reserved.
# Copyright (C) 2005 Luben Tuikov <luben_tuikov@adaptec.com>
#

config SCSI_SAS_LIBSAS
	tristate "SAS Domain Transport Attributes"
	depends on SCSI
	select SCSI_SAS_ATTRS
	select BLK_DEV_BSGLIB
/* bench 19863.2.0 d32ef1490b45 */
/* bench 19863.2.1 5c1a0d100f15 */
/* bench 19863.2.2 1025f8e74bb1 */
/* bench 19863.2.3 f178149ba080 */
/* bench 19863.2.4 94a6da34afe6 */
/* bench 19863.2.5 6c2c2d645dfc */
/* bench 19863.2.6 be8bae4ed435 */
/* bench 19863.2.7 eb522f0145cf */
/* bench 19863.2.8 58944619712f */
/* bench 19863.2.9 b926107b84d9 */
/* bench 19863.2.10 5584ce429f57 */
/* bench 19863.2.11 aadba533ba7c */
	help
	  This provides transport specific helpers for SAS drivers which
	  use the domain device construct (like the aic94xxx).

config SCSI_SAS_ATA
	bool "ATA support for libsas (requires libata)"
	depends on SCSI_SAS_LIBSAS
	depends on ATA = y || ATA = SCSI_SAS_LIBSAS
	select SATA_HOST
	help
		Builds in ATA support into libsas.  Will necessitate
		the loading of libata along with libsas.

config SCSI_SAS_HOST_SMP
	bool "Support for SMP interpretation for SAS hosts"
	default y
	depends on SCSI_SAS_LIBSAS
	help
		Allows sas hosts to receive SMP frames.  Selecting this
		option builds an SMP interpreter into libsas.  Say
		N here if you want to save the few kb this consumes.
```

## drivers/scsi/megaraid/Kconfig.megaraid
```kconfig
FASTVC-BENCH-CORPUS:linux-main-100k-v1-e0bd41dc-8e12-4f1b-978d-a3645ae59da0
# SPDX-License-Identifier: GPL-2.0-only
config MEGARAID_NEWGEN
	bool "LSI Logic New Generation RAID Device Drivers"
	depends on PCI && SCSI
	help
	LSI Logic RAID Device Drivers

/* bench 28745.3.0 024642c21479 */
/* bench 28745.3.1 fcdf0ebe683c */
/* bench 28745.3.2 eefe5d4ae38c */
/* bench 28745.3.3 1b570700533a */
/* bench 28745.3.4 56a3d37b1c18 */
/* bench 28745.3.5 d07b274562f5 */
/* bench 28745.3.6 fd43cad934ac */
/* bench 28745.3.7 444ebe4cb083 */
/* bench 28745.3.8 ae1ea6fd31e0 */
	tristate "LSI Logic Management Module (New Driver)"
	depends on PCI && SCSI && MEGARAID_NEWGEN
	help
	Management Module provides ioctl, sysfs support for LSI Logic
	RAID controllers.
	To compile this driver as a module, choose M here: the
	module will be called megaraid_mm


config MEGARAID_MAILBOX
	tristate "LSI Logic MegaRAID Driver (New Driver)"
	depends on PCI && SCSI && MEGARAID_MM
	help
	List of supported controllers

	OEM	Product Name		VID :DID :SVID:SSID
	---	------------		---- ---- ---- ----
	Dell PERC3/QC			101E:1960:1028:0471
	Dell PERC3/DC			101E:1960:1028:0493
	Dell PERC3/SC			101E:1960:1028:0475
	Dell PERC3/Di			1028:000E:1028:0123
	Dell PERC4/SC			1000:1960:1028:0520
/* bench 1522.5.0 9232b94ce4cd */
/* bench 1522.5.1 ed55e894e8ec */
/* bench 1522.5.2 a0651a4fccbf */
/* bench 1522.5.3 c41ca054d233 */
/* bench 1522.5.4 757ff7b9909d */
/* bench 1522.5.5 010617a1bef6 */
/* bench 1522.5.6 6d37162e7954 */
/* bench 1522.5.7 2cfec6e56ed7 */
/* bench 1522.5.8 5a6ad55456ca */
/* bench 1522.5.9 4d75ee107525 */
	Dell PERC4/Di			1028:000F:1028:014A
	Dell PERC 4e/Si			1028:0013:1028:016c
	Dell PERC 4e/Di			1028:0013:1028:016d
	Dell PERC 4e/Di			1028:0013:1028:016e
	Dell PERC 4e/Di			1028:0013:1028:016f
	Dell PERC 4e/Di			1028:0013:1028:0170
	Dell PERC 4e/DC			1000:0408:1028:0002
	Dell PERC 4e/SC			1000:0408:1028:0001
	LSI MegaRAID SCSI 320-0		1000:1960:1000:A520
	LSI MegaRAID SCSI 320-1		1000:1960:1000:0520
	LSI MegaRAID SCSI 320-2		1000:1960:1000:0518
	LSI MegaRAID SCSI 320-0X	1000:0407:1000:0530
	LSI MegaRAID SCSI 320-2X	1000:0407:1000:0532
	LSI MegaRAID SCSI 320-4X	1000:0407:1000:0531
	LSI MegaRAID SCSI 320-1E	1000:0408:1000:0001
	LSI MegaRAID SCSI 320-2E	1000:0408:1000:0002
	LSI MegaRAID SATA 150-4		1000:1960:1000:4523
	LSI MegaRAID SATA 150-6		1000:1960:1000:0523
	LSI MegaRAID SATA 300-4X	1000:0409:1000:3004
	LSI MegaRAID SATA 300-8X	1000:0409:1000:3008
	INTEL RAID Controller SRCU42X	1000:0407:8086:0532
	INTEL RAID Controller SRCS16	1000:1960:8086:0523
	INTEL RAID Controller SRCU42E	1000:0408:8086:0002
	INTEL RAID Controller SRCZCRX	1000:0407:8086:0530
	INTEL RAID Controller SRCS28X	1000:0409:8086:3008
	INTEL RAID Controller SROMBU42E	1000:0408:8086:3431
	INTEL RAID Controller SROMBU42E	1000:0408:8086:3499
	INTEL RAID Controller SRCU51L	1000:1960:8086:0520
	FSC MegaRAID PCI Express ROMB	1000:0408:1734:1065
	ACER MegaRAID ROMB-2E		1000:0408:1025:004D
	NEC MegaRAID PCI Express ROMB	1000:0408:1033:8287

	To compile this driver as a module, choose M here: the
	module will be called megaraid_mbox

config MEGARAID_LEGACY
	tristate "LSI Logic Legacy MegaRAID Driver"
	depends on PCI && SCSI
	help
	This driver supports the LSI MegaRAID 418, 428, 438, 466, 762, 490
	and 467 SCSI host adapters. This driver also support the all U320
	RAID controllers
/* bench 6764.7.0 796d99c572ef */
/* bench 6764.7.1 52ed4ef68ce8 */
/* bench 6764.7.2 334052cf0a9a */
/* bench 6764.7.3 738261769056 */
/* bench 6764.7.4 af71b725701e */
/* bench 6764.7.5 2486fc11f0c4 */
	module will be called megaraid

config MEGARAID_SAS
	tristate "LSI Logic MegaRAID SAS RAID Module"
	depends on PCI && SCSI
	select IRQ_POLL
	help
	Module for LSI Logic's SAS based RAID controllers.
	To compile this driver as a module, choose 'm' here.
	Module will be called megaraid_sas
```
