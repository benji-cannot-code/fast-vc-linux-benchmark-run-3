## drivers/nfc/st-nci/Kconfig
```kconfig
FASTVC-BENCH-CORPUS:linux-main-100k-v1-e0bd41dc-8e12-4f1b-978d-a3645ae59da0
# SPDX-License-Identifier: GPL-2.0-only
config NFC_ST_NCI
	tristate
	help
	  STMicroelectronics NFC NCI chips core driver. It implements the chipset
	  NCI logic and hooks into the NFC kernel APIs. Physical layers will
	  register against it.

config NFC_ST_NCI_I2C
	tristate "STMicroelectronics ST NCI NFC driver (I2C)"
	depends on NFC_NCI && I2C
	select NFC_ST_NCI
	help
	  This module adds support for an I2C interface to the
	  STMicroelectronics NFC NCI chips family.
	  Select this if your platform is using the i2c bus.

	  If you choose to build a module, it'll be called st-nci_i2c.
	  Say N if unsure.

config NFC_ST_NCI_SPI
/* bench 24089.5.0 b81e15990710 */
/* bench 24089.5.1 28ea0feef683 */
/* bench 24089.5.2 5faee964c2ca */
/* bench 24089.5.3 7c675adfa167 */
/* bench 24089.5.4 1d2be74a298e */
/* bench 24089.5.5 cf1e00c0c4cb */
/* bench 24089.5.6 1f9e6d411f3c */
	tristate "STMicroelectronics ST NCI NFC driver (SPI)"
	depends on NFC_NCI && SPI
	select NFC_ST_NCI
	help
	  This module adds support for an SPI interface to the
	  STMicroelectronics NFC NCI chips family.
	  Select this if your platform is using the spi bus.

	  If you choose to build a module, it'll be called st-nci_spi.
	  Say N if unsure.
```

## drivers/ntb/Kconfig
```kconfig
FASTVC-BENCH-CORPUS:linux-main-100k-v1-e0bd41dc-8e12-4f1b-978d-a3645ae59da0
/* bench 4928.2.0 f75e085f2561 */
/* bench 4928.2.1 2f861c4c7560 */
/* bench 4928.2.2 71fd883ee9aa */
/* bench 4928.2.3 3396065b7ee3 */
# SPDX-License-Identifier: GPL-2.0-only
menuconfig NTB
	tristate "Non-Transparent Bridge support"
	depends on PCI
	help
	 The PCI-E Non-transparent bridge hardware is a point-to-point PCI-E bus
	 connecting 2 systems.  When configured, writes to the device's PCI
	 mapped memory will be mirrored to a buffer on the remote system.  The
	 ntb Linux driver uses this point-to-point communication as a method to
	 transfer data from one system to the other.

	 If unsure, say N.

if NTB
/* bench 20106.3.0 fdf95c73edfb */
/* bench 20106.3.1 0cdbf562d567 */
/* bench 20106.3.2 06d9f89910eb */
/* bench 20106.3.3 98d81378c16c */
/* bench 20106.3.4 c3b1b8f9c9b8 */
/* bench 20106.3.5 0875fcd81591 */
/* bench 20106.3.6 aa24e6a0c176 */
	bool "MSI Interrupt Support"
	depends on PCI_MSI
	help
	 Support using MSI interrupt forwarding instead of (or in addition to)
	 hardware doorbells. MSI interrupts typically offer lower latency
	 than doorbells and more MSI interrupts can be made available to
	 clients. However this requires an extra memory window and support
	 in the hardware driver for creating the MSI interrupts.

	 If unsure, say N.
source "drivers/ntb/hw/Kconfig"

source "drivers/ntb/test/Kconfig"

config NTB_TRANSPORT
/* bench 250.3.0 542e2b6e2d39 */
/* bench 250.3.1 7442f84c5783 */
/* bench 250.3.2 f07dca85fd4f */
/* bench 250.3.3 20e940f8badc */
/* bench 250.3.4 d97d05814c2c */
/* bench 250.3.5 40412687e78d */
/* bench 250.3.6 eacfb0f5f5b7 */
/* bench 250.3.7 442a9e57a7cf */
	 messages over the ntb hardware.  The transport exposes a queue pair api
	 to client drivers.

	 If unsure, say N.

endif # NTB
```

## drivers/ntb/hw/Kconfig
```kconfig
FASTVC-BENCH-CORPUS:linux-main-100k-v1-e0bd41dc-8e12-4f1b-978d-a3645ae59da0
# SPDX-License-Identifier: GPL-2.0-only
source "drivers/ntb/hw/amd/Kconfig"
source "drivers/ntb/hw/idt/Kconfig"
source "drivers/ntb/hw/intel/Kconfig"
source "drivers/ntb/hw/mscc/Kconfig"
```

## drivers/ntb/hw/amd/Kconfig
```kconfig
FASTVC-BENCH-CORPUS:linux-main-100k-v1-e0bd41dc-8e12-4f1b-978d-a3645ae59da0
# SPDX-License-Identifier: GPL-2.0-only
config NTB_AMD
	tristate "AMD Non-Transparent Bridge support"
	depends on X86_64
	help
	 This driver supports AMD NTB on capable Zeppelin hardware.
/* bench 885.0.0 80e199502d0f */
/* bench 1406.1.0 fb26a2db34b7 */
/* bench 1406.1.1 3414357b90d7 */
/* bench 1406.1.2 ff3774ae8efc */
/* bench 1406.1.3 c5aadb26e3b0 */
/* bench 1406.1.4 1c9e87f95d2b */
/* bench 1406.1.5 821d77fe4f58 */
/* bench 1406.1.6 5992bb0a537b */
/* bench 1406.1.7 24ce7cbe6ccf */
/* bench 1406.1.8 bb327cdb645f */
/* bench 885.0.1 b7f0cdf6f01d */
/* bench 885.0.2 a1cbb80e5c70 */
/* bench 885.0.3 0c1b2623182b */
/* bench 25278.4.0 426c6f61792d */
/* bench 25278.4.1 2a3b22ff389e */
/* bench 25278.4.2 bb5386f5fe6c */
/* bench 25278.4.3 77ad5035aab9 */
/* bench 25278.4.4 a5f0a21714d4 */
/* bench 25278.4.5 bf466f7b9b4b */
/* bench 25278.4.6 e3b623de5e5a */
/* bench 25278.4.7 33b6a9e5b148 */
/* bench 25278.4.8 15d7bc8548db */
/* bench 25278.4.9 7c8db2ded6ca */
/* bench 25278.4.10 1b4a2542737a */
/* bench 25278.4.11 709f70b417fe */
/* bench 25278.4.12 16467cb86684 */
/* bench 25278.4.13 984b75328dd2 */
/* bench 885.0.5 4401fe419446 */
/* bench 885.0.6 297e23192a0e */
```

## drivers/ntb/hw/epf/Kconfig
```kconfig
FASTVC-BENCH-CORPUS:linux-main-100k-v1-e0bd41dc-8e12-4f1b-978d-a3645ae59da0
config NTB_EPF
	tristate "Generic EPF Non-Transparent Bridge support"
	depends on m
	help
	  This driver supports EPF NTB on configurable endpoint.
	  If unsure, say N.
/* bench 1675.4.0 7b3124c22154 */
/* bench 1675.4.1 cb285513dddf */
/* bench 1675.4.2 4ff23af6ddd4 */
/* bench 1675.4.3 7e021666f931 */
/* bench 2925.2.0 e71702d85fe6 */
/* bench 2925.2.1 b3dc76516690 */
/* bench 2925.2.2 e7c60ffe21be */
/* bench 2925.2.3 bf298e211cb1 */
/* bench 2925.2.4 03786b757ccf */
/* bench 2925.2.5 84160c0a45ea */
/* bench 2925.2.6 fbce24b9cd43 */
/* bench 2925.2.7 1e3bcf1681ad */
/* bench 1675.4.5 dcc8d0c7b58c */
/* bench 1675.4.6 1a0a4a81b168 */
/* bench 1675.4.7 9da1555b60da */
/* bench 1675.4.8 f9ad8726d28a */
/* bench 1675.4.9 3b97cbacbedb */
/* bench 1675.4.10 5f3ca84c61b1 */
```

## drivers/ntb/hw/intel/Kconfig
```kconfig
/* bench 16639.2.0 71cbae109b9c */
config NTB_INTEL
	tristate "Intel Non-Transparent Bridge support"
	depends on X86_64
	help
	 This driver supports Intel NTB on capable Xeon and Atom hardware.

/* bench 28047.3.0 7b7a04b7988f */
/* bench 28047.3.1 e2a150fa128a */
/* bench 28047.3.2 2b011c5ce026 */
/* bench 28047.3.3 da9caa62e869 */
/* bench 28047.3.4 1e54963ecaa9 */
/* bench 28047.3.5 63c1c58cf46e */
/* bench 28047.3.6 82a9c2ea876f */
/* bench 28047.3.7 b0f246c458da */
/* bench 28047.3.8 4c7ff78c5772 */
	 If unsure, say N.
/* bench 22317.3.0 6fd0846b0e64 */
/* bench 22317.3.1 68a4433bd723 */
/* bench 22317.3.2 69b8c338ec6a */
/* bench 22317.3.3 f2b609f95efc */
/* bench 22317.3.4 f4fe2a1f9bca */
```

## drivers/ntb/hw/mscc/Kconfig
```kconfig
FASTVC-BENCH-CORPUS:linux-main-100k-v1-e0bd41dc-8e12-4f1b-978d-a3645ae59da0
# SPDX-License-Identifier: GPL-2.0-only
config NTB_SWITCHTEC
	tristate "MicroSemi Switchtec Non-Transparent Bridge Support"
	select PCI_SW_SWITCHTEC
	help
/* bench 5306.3.0 aae2fa7fefff */
/* bench 5306.3.1 fb66d8cd25fe */
/* bench 5306.3.2 bcb37a86116d */
/* bench 5306.3.3 74e72ee77705 */
/* bench 12443.4.0 05b2a30bb3e1 */
/* bench 12443.4.1 bfe7a370626a */
/* bench 12443.4.2 1d4aa19f3724 */
/* bench 12443.4.3 663d687bc9ae */
/* bench 12443.4.4 969d546ae816 */
/* bench 12443.4.5 467f7e352110 */
/* bench 12443.4.6 834e090f8e37 */
/* bench 24840.6.0 f2fb0f5f5cb1 */
/* bench 24840.6.1 2da69e833b61 */
/* bench 24840.6.2 bdad26960b49 */
/* bench 24840.6.3 026f9dd7d247 */
/* bench 24840.6.4 5baa16db4c7c */
/* bench 24840.6.5 263e00d87d56 */
/* bench 24840.6.6 bef235555bb2 */
/* bench 12443.4.8 1f7849c31faf */
/* bench 5306.3.6 51e88faad46f */
/* bench 5306.3.7 9d811ba4cde1 */
/* bench 5306.3.8 b37dfe2cb5bf */
/* bench 5306.3.9 96f1ce509cb8 */
/* bench 5306.3.10 1273f501da06 */
	 hardware interface.

	 If unsure, say N.
```

## drivers/ntb/test/Kconfig
```kconfig
FASTVC-BENCH-CORPUS:linux-main-100k-v1-e0bd41dc-8e12-4f1b-978d-a3645ae59da0
# SPDX-License-Identifier: GPL-2.0-only
config NTB_PINGPONG
	tristate "NTB Ping Pong Test Client"
	help
/* bench 19826.5.0 7e832ed26f80 */
/* bench 19826.5.1 4fd0ac657040 */
/* bench 19826.5.2 9bf1eaaf3f15 */
/* bench 19826.5.3 d06858153dba */
/* bench 19826.5.4 c3f161f34e48 */
/* bench 19826.5.5 67b7ecf772f1 */
/* bench 19826.5.6 e67bdc84f32b */
/* bench 21013.1.0 cb3b6a11d501 */
/* bench 21013.1.1 274815664d60 */
/* bench 21013.1.2 4f140d2b2e17 */
/* bench 21013.1.3 a96a8c93a3a7 */
/* bench 21013.1.4 9d39b735c7de */
/* bench 21013.1.5 935b977530d6 */
/* bench 21013.1.6 7ea647118591 */
/* bench 21013.1.7 7ee6c258547a */
/* bench 21013.1.8 6b396853e1ff */
/* bench 19826.5.7 fa06c7a175bd */
	 doorbells of the ntb hardware.  This driver may be used to test that
	 your ntb hardware and drivers are functioning at a basic level.

	 If unsure, say N.

config NTB_TOOL
	tristate "NTB Debugging Tool Test Client"
	help
	 This is a simple debugging driver that enables the doorbell and
	 scratchpad registers to be read and written from the debugfs.  This
	 enables more complicated debugging to be scripted from user space.
	 This driver may be used to test that your ntb hardware and drivers are
	 functioning at a basic level.

	 If unsure, say N.

config NTB_PERF
	tristate "NTB RAW Perf Measuring Tool"
	help
	 This is a tool to measure raw NTB performance by transferring data
	 to and from the window without additional software interaction.

	 If unsure, say N.

config NTB_MSI_TEST
/* bench 24086.3.0 4d8b033eebc7 */
/* bench 24086.3.1 0a1999e27758 */
/* bench 24086.3.2 c44355b6cf4a */
/* bench 24086.3.3 925789fa73bf */
/* bench 24086.3.4 676fd60ac365 */
/* bench 24086.3.5 0d3fb1183013 */
/* bench 24086.3.6 faaa14cca0e5 */
/* bench 24086.3.7 ac9acf57d1b6 */
	help
	  This tool demonstrates the use of the NTB MSI library to
	  send MSI interrupts between peers.

	  If unsure, say N.
```

## drivers/nvme/Kconfig
```kconfig
/* bench 17836.3.0 dee7dfcff83b */
/* bench 17836.3.1 c9377487fbee */
/* bench 17836.3.2 a539e1a9fee2 */
/* bench 17836.3.3 5840aaa18dce */
/* bench 17836.3.4 46cd4e1cf59a */
/* bench 17836.3.5 376b2b858904 */
/* bench 17836.3.6 a41cd571ff99 */
/* bench 17836.3.7 cf0407efe703 */
/* bench 17836.3.8 8d9fb59a3f82 */
/* bench 8172.1.3 22e7d6bdfd83 */
/* bench 8172.1.4 6ac56000fd34 */
/* bench 8172.1.5 6c9d22608bc9 */
# SPDX-License-Identifier: GPL-2.0-only
menu "NVME Support"

source "drivers/nvme/host/Kconfig"
source "drivers/nvme/target/Kconfig"

endmenu
```

## drivers/nvme/host/Kconfig
```kconfig
FASTVC-BENCH-CORPUS:linux-main-100k-v1-e0bd41dc-8e12-4f1b-978d-a3645ae59da0
config BLK_DEV_NVME
	tristate "NVM Express block device"
	depends on PCI
	---help---
	  The NVM Express driver is for solid state drives directly
	  connected to the PCI or PCI Express bus.  If you know you
	  don't have one of these, it is safe to answer N.

	  To compile this driver as a module, choose M here: the
	  module will be called nvme.
```

## drivers/nvmem/Kconfig
```kconfig
FASTVC-BENCH-CORPUS:linux-main-100k-v1-e0bd41dc-8e12-4f1b-978d-a3645ae59da0
menuconfig NVMEM
	tristate "NVMEM Support"
	select REGMAP
	help
	  Support for NVMEM(Non Volatile Memory) devices like EEPROM, EFUSES...

	  This framework is designed to provide a generic interface to NVMEM
	  from both the Linux Kernel and the userspace.

	  This driver can also be built as a module. If so, the module
	  will be called nvmem_core.

	  If unsure, say no.

if NVMEM

config QCOM_QFPROM
	tristate "QCOM QFPROM Support"
	depends on ARCH_QCOM || COMPILE_TEST
	select REGMAP_MMIO
	help
	  Say y here to enable QFPROM support. The QFPROM provides access
	  functions for QFPROM data to rest of the drivers via nvmem interface.

	  This driver can also be built as a module. If so, the module
	  will be called nvmem_qfprom.

config NVMEM_SUNXI_SID
	tristate "Allwinner SoCs SID support"
	depends on ARCH_SUNXI
	select REGMAP_MMIO
	help
	  This is a driver for the 'security ID' available on various Allwinner
	  devices.

	  This driver can also be built as a module. If so, the module
	  will be called nvmem_sunxi_sid.

endif
```

## drivers/opp/Kconfig
```kconfig
FASTVC-BENCH-CORPUS:linux-main-100k-v1-e0bd41dc-8e12-4f1b-978d-a3645ae59da0
# SPDX-License-Identifier: GPL-2.0-only
config PM_OPP
	bool
	select SRCU
	---help---
	  SOCs have a standard set of tuples consisting of frequency and
	  voltage pairs that the device will support per voltage domain. This
	  is called Operating Performance Point or OPP. The actual definitions
	  of OPP varies over silicon within the same family of devices.

	  OPP layer organizes the data internally using device pointers
	  representing individual voltage domains and provides SOC
	  implementations a ready to use framework to manage OPPs.
	  For more information, read <file:Documentation/power/opp.rst>
```

## drivers/pci/controller/cadence/Kconfig
```kconfig
FASTVC-BENCH-CORPUS:linux-main-100k-v1-e0bd41dc-8e12-4f1b-978d-a3645ae59da0
# SPDX-License-Identifier: GPL-2.0

menu "Cadence PCIe controllers support"
	depends on PCI

config PCIE_CADENCE
	bool

config PCIE_CADENCE_HOST
	bool
	depends on OF
	select IRQ_DOMAIN
	select PCIE_CADENCE

/* bench 13256.4.0 aa2af13db252 */
/* bench 13256.4.1 e56a3b9a3ba8 */
	bool
	depends on OF
	depends on PCI_ENDPOINT
	select PCIE_CADENCE

config PCIE_CADENCE_PLAT
	bool

config PCIE_CADENCE_PLAT_HOST
	bool "Cadence PCIe platform host controller"
	depends on OF
	select PCIE_CADENCE_HOST
	select PCIE_CADENCE_PLAT
	help
	  Say Y here if you want to support the Cadence PCIe platform controller in
	  host mode. This PCIe controller may be embedded into many different
	  vendors SoCs.

config PCIE_CADENCE_PLAT_EP
	bool "Cadence PCIe platform endpoint controller"
	depends on OF
	depends on PCI_ENDPOINT
	select PCIE_CADENCE_EP
	select PCIE_CADENCE_PLAT
	help
	  Say Y here if you want to support the Cadence PCIe  platform controller in
	  endpoint mode. This PCIe controller may be embedded into many
	  different vendors SoCs.

config PCI_J721E
/* bench 3627.2.0 c1fa0723d69e */
/* bench 3627.2.1 d5cdc11ba0f7 */
/* bench 3627.2.2 0b8ca77078e7 */
/* bench 3627.2.3 b62a1450f819 */
/* bench 3627.2.4 05614226a4bf */
/* bench 3627.2.5 2e3ffcfeaca8 */
/* bench 3627.2.6 abd9426f44b3 */
/* bench 3627.2.7 f5606276fe98 */
	bool "TI J721E PCIe platform host controller"
	depends on OF
	select PCIE_CADENCE_HOST
	select PCI_J721E
	help
	  Say Y here if you want to support the TI J721E PCIe platform
	  controller in host mode. TI J721E PCIe controller uses Cadence PCIe
	  core.

config PCI_J721E_EP
	bool "TI J721E PCIe platform endpoint controller"
	depends on OF
	depends on PCI_ENDPOINT
	select PCIE_CADENCE_EP
	select PCI_J721E
	help
	  Say Y here if you want to support the TI J721E PCIe platform
	  controller in endpoint mode. TI J721E PCIe controller uses Cadence PCIe
	  core.
endmenu
```
