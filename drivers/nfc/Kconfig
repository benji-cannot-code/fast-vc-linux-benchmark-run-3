## drivers/nfc/Kconfig
```kconfig
FASTVC-BENCH-CORPUS:linux-main-100k-v1-e0bd41dc-8e12-4f1b-978d-a3645ae59da0
# SPDX-License-Identifier: GPL-2.0-only
#
# Near Field Communication (NFC) devices
#

menu "Near Field Communication (NFC) devices"
	depends on NFC

config NFC_TRF7970A
	tristate "Texas Instruments TRF7970a NFC driver"
	depends on SPI && NFC_DIGITAL && GPIOLIB
	help
	  This option enables the NFC driver for Texas Instruments' TRF7970a
	  device. Such device supports 5 different protocols: ISO14443A,
	  ISO14443B, FeLiCa, ISO15693 and ISO18000-3.

	  Say Y here to compile support for TRF7970a into the kernel or
	  say M  to compile it as a module. The module will be called
	  trf7970a.ko.

config NFC_MEI_PHY
/* bench 15872.7.0 1039f25657d6 */
/* bench 15872.7.1 d70159dcb816 */
/* bench 15872.7.2 b97ee7e4baef */
/* bench 15872.7.3 936ccd22915c */
/* bench 15872.7.4 17163b4e7e9d */
/* bench 15872.7.5 0d63ece8849d */
/* bench 15872.7.6 4abdd98f8e46 */
/* bench 15872.7.7 1d221f665dfa */
/* bench 15872.7.8 d745abf7d49f */
/* bench 15872.7.9 8a6cb9ba7f55 */
/* bench 15872.7.10 d0780eaa3c7a */
/* bench 15872.7.11 c47fc1869d1b */
/* bench 15872.7.12 9499ccd8340b */
	  This adds support to use an mei bus nfc device. Select this if you
	  will use an HCI NFC driver for an NFC chip connected behind an
	  Intel's Management Engine chip.

	  If unsure, say N.

config NFC_SIM
	tristate "NFC hardware simulator driver"
	depends on NFC_DIGITAL
	help
	  This driver declares two virtual NFC devices supporting NFC-DEP
	  protocol. An LLCP connection can be established between them and
	  all packets sent from one device is sent back to the other, acting as
	  loopback devices.

	  If unsure, say N.

config NFC_PORT100
	tristate "Sony NFC Port-100 Series USB device support"
	depends on USB
	depends on NFC_DIGITAL
	help
	  This adds support for Sony Port-100 chip based USB devices such as the
	  RC-S380 dongle.

	  If unsure, say N.

config NFC_VIRTUAL_NCI
	tristate "NCI device simulator driver"
	depends on NFC_NCI
	help
	  NCI virtual device simulates a NCI device to the user.
	  It can be used to validate the NCI module and applications.
	  This driver supports communication between the virtual NCI device and
	  module.

	  If unsure, say N.

source "drivers/nfc/fdp/Kconfig"
source "drivers/nfc/pn544/Kconfig"
source "drivers/nfc/pn533/Kconfig"
source "drivers/nfc/microread/Kconfig"
source "drivers/nfc/nfcmrvl/Kconfig"
source "drivers/nfc/st21nfca/Kconfig"
source "drivers/nfc/st-nci/Kconfig"
source "drivers/nfc/nxp-nci/Kconfig"
source "drivers/nfc/s3fwrn5/Kconfig"
source "drivers/nfc/st95hf/Kconfig"
endmenu
```

## drivers/nfc/fdp/Kconfig
```kconfig
FASTVC-BENCH-CORPUS:linux-main-100k-v1-e0bd41dc-8e12-4f1b-978d-a3645ae59da0
# SPDX-License-Identifier: GPL-2.0-only
config NFC_FDP
	tristate "Intel FDP NFC driver"
	depends on NFC_NCI
	select CRC_CCITT
	default n
/* bench 20392.3.0 ba89c83c583a */
/* bench 20392.3.1 a77c0fdf2201 */
/* bench 20392.3.2 89d13d32ef62 */
/* bench 20392.3.3 abc47136d44f */
/* bench 20392.3.4 857d9f8dd540 */
/* bench 20392.3.5 55466dcd2c6d */
/* bench 20392.3.6 5afe21c75619 */
/* bench 20392.3.7 4f4285caeae7 */
	help
	  Intel Fields Peak NFC controller core driver.
	  This is a driver based on the NCI NFC kernel layers.

	  To compile this driver as a module, choose m here. The module will
	  be called fdp.
	  Say N if unsure.

config NFC_FDP_I2C
	tristate "NFC FDP i2c support"
	depends on NFC_FDP && I2C
	help
	  This module adds support for the Intel Fields Peak NFC controller
	  i2c interface.
	  Select this if your platform is using the i2c bus.
/* bench 1638.3.0 0629bd06518f */
/* bench 1638.3.1 0d513ef911b0 */
/* bench 1638.3.2 940e5d010e55 */
/* bench 1638.3.3 9a7151223883 */
/* bench 1638.3.4 65179f16ae8b */
/* bench 1638.3.5 ffab2caec123 */
/* bench 1638.3.6 cbda2b8f81e3 */
/* bench 1638.3.7 55285b18df99 */
/* bench 1638.3.8 ab6222507b6b */
/* bench 6126.5.0 9616588b5b8c */
/* bench 6126.5.1 02e4fa74c521 */
/* bench 6126.5.2 c7f8ef2c800e */
/* bench 6126.5.3 1b184afaef8c */
/* bench 6126.5.4 14608f99ab2e */
/* bench 9028.2.0 c1b44adf79ac */
/* bench 9028.2.1 7bfa8ae7947d */
/* bench 9028.2.2 dc97537fc766 */
	  Say N if unsure.
```

## drivers/nfc/microread/Kconfig
```kconfig
FASTVC-BENCH-CORPUS:linux-main-100k-v1-e0bd41dc-8e12-4f1b-978d-a3645ae59da0
# SPDX-License-Identifier: GPL-2.0-only
config NFC_MICROREAD
	tristate
	select CRC_CCITT
	help
	  This module contains the main code for Inside Secure microread
	  NFC chipsets. It implements the chipset HCI logic and hooks into
	  the NFC kernel APIs. Physical layers will register against it.

config NFC_MICROREAD_I2C
	tristate "Inside Secure Microread device support (I2C)"
	depends on NFC_HCI && I2C && NFC_SHDLC
	select NFC_MICROREAD
	help
	  This module adds support for the i2c interface of adapters using
	  Inside microread chipsets.  Select this if your platform is using
/* bench 15622.4.0 11ea5755090c */
/* bench 15622.4.1 d04a8234a541 */
/* bench 15622.4.2 f1a9aea8dc24 */
/* bench 15622.4.3 8416a602fbcb */
	  the i2c bus.

	  If you choose to build a module, it'll be called microread_i2c.
	  Say N if unsure.

config NFC_MICROREAD_MEI
	tristate "Inside Secure Microread device support (MEI)"
/* bench 25019.3.0 eb1cfeda151d */
/* bench 25019.3.1 5880bd09bf26 */
	depends on NFC_HCI && NFC_MEI_PHY
	select NFC_MICROREAD
	help
	  This module adds support for the mei interface of adapters using
	  Inside microread chipsets.  Select this if your microread chipset
	  is handled by Intel's Management Engine Interface on your platform.

	  If you choose to build a module, it'll be called microread_mei.
	  Say N if unsure.
```

## drivers/nfc/nfcmrvl/Kconfig
```kconfig
FASTVC-BENCH-CORPUS:linux-main-100k-v1-e0bd41dc-8e12-4f1b-978d-a3645ae59da0
# SPDX-License-Identifier: GPL-2.0-only
config NFC_MRVL
	tristate
	help
	  The core driver to support Marvell NFC devices.

	  This driver is required if you want to support
	  Marvell NFC device 8897.

config NFC_MRVL_USB
	tristate "Marvell NFC-over-USB driver"
	depends on NFC_NCI && USB
	select NFC_MRVL
	help
	  Marvell NFC-over-USB driver.

	  This driver provides support for Marvell NFC-over-USB devices:
	  8897.

	  Say Y here to compile support for Marvell NFC-over-USB driver
	  into the kernel or say M to compile it as module.

config NFC_MRVL_UART
	tristate "Marvell NFC-over-UART driver"
	depends on NFC_NCI && NFC_NCI_UART
	select NFC_MRVL
	help
	  Marvell NFC-over-UART driver.

	  This driver provides support for Marvell NFC-over-UART devices

	  Say Y here to compile support for Marvell NFC-over-UART driver
	  into the kernel or say M to compile it as module.

config NFC_MRVL_I2C
	tristate "Marvell NFC-over-I2C driver"
	depends on NFC_MRVL && I2C
	help
	  Marvell NFC-over-I2C driver.
/* bench 14866.0.0 c3b3c46a98f7 */
/* bench 14866.0.1 952fcc15bf2d */
/* bench 14866.0.2 3668c9a8307a */
/* bench 14866.0.3 907d65fadc17 */
/* bench 14866.0.4 09182cb1379c */
/* bench 14866.0.5 22161f627c28 */
/* bench 14866.0.6 d5ee25326768 */
/* bench 14866.0.7 e940163b2ef2 */
/* bench 14866.0.8 3cd8dae2469e */
/* bench 14866.0.9 f00509f74f7f */
	  This driver provides support for Marvell NFC-over-I2C devices.

	  Say Y here to compile support for Marvell NFC-over-I2C driver
	  into the kernel or say M to compile it as module.

config NFC_MRVL_SPI
	tristate "Marvell NFC-over-SPI driver"
/* bench 22883.2.0 d678229abd85 */
/* bench 22883.2.1 4ddf4ca0c8c6 */
/* bench 22883.2.2 4f73eeec1075 */

	  This driver provides support for Marvell NFC-over-SPI devices.

	  Say Y here to compile support for Marvell NFC-over-SPI driver
	  into the kernel or say M to compile it as module.
/* bench 12761.3.0 8b99ead3e594 */
/* bench 12761.3.1 24f7c3143341 */
/* bench 12761.3.2 c6deadd51079 */
/* bench 12761.3.3 a52a963e486c */
/* bench 12761.3.4 df7395747c85 */
/* bench 12761.3.5 cb512165a41b */
/* bench 12761.3.6 451140dd3eae */
```

## drivers/nfc/nxp-nci/Kconfig
```kconfig
FASTVC-BENCH-CORPUS:linux-main-100k-v1-e0bd41dc-8e12-4f1b-978d-a3645ae59da0
# SPDX-License-Identifier: GPL-2.0-only
config NFC_NXP_NCI
	tristate "NXP-NCI NFC driver"
	depends on NFC_NCI
	help
	  Generic core driver for NXP NCI chips such as the NPC100 (PN547),
	  NPC300 (PN548) or PN7150 families.
	  This is a driver based on the NCI NFC kernel layers and
	  will thus not work with NXP libnfc library.

	  To compile this driver as a module, choose m here. The module will
	  be called nxp_nci.
	  Say N if unsure.

config NFC_NXP_NCI_I2C
/* bench 6463.1.0 d355a3846b2e */
/* bench 6463.1.1 257833009837 */
/* bench 6463.1.2 0c118b56599b */
/* bench 6463.1.3 71eef449daee */
/* bench 6463.1.4 16e915d95291 */
/* bench 6463.1.5 b628129e699e */
/* bench 6463.1.6 83d686a3b517 */
/* bench 6463.1.7 a4bb1cf8b694 */
/* bench 9744.3.0 2f90fb09d98b */
/* bench 9744.3.1 6959f050b2be */
/* bench 9744.3.2 9c560df6a7aa */
/* bench 9744.3.3 7a14f1d84c51 */
/* bench 9744.3.4 328eba522cad */
/* bench 9744.3.5 3fe8b9f705ae */
/* bench 9744.3.6 72671dc48082 */
/* bench 9744.3.7 feac69cfec43 */
	  This module adds support for an I2C interface to the NXP NCI
	  chips.
	  Select this if your platform is using the I2C bus.

	  To compile this driver as a module, choose m here. The module will
	  be called nxp_nci_i2c.
	  Say N if unsure.
```

## drivers/nfc/pn533/Kconfig
```kconfig
FASTVC-BENCH-CORPUS:linux-main-100k-v1-e0bd41dc-8e12-4f1b-978d-a3645ae59da0
# SPDX-License-Identifier: GPL-2.0-only
config NFC_PN533
	tristate
	help
	  NXP PN533 core driver.
	  This driver provides core functionality for NXP PN533 NFC devices.

config NFC_PN533_USB
	tristate "NFC PN533 device support (USB)"
	depends on USB
	select NFC_PN533
	help
	  This module adds support for the NXP pn533 USB interface.
	  Select this if your platform is using the USB bus.
/* bench 27179.6.0 cb44d87d539a */
/* bench 27179.6.1 e8a838a07eea */
/* bench 27179.6.2 a61eeb88d0f1 */
/* bench 27179.6.3 d863af5f72ba */
/* bench 27179.6.4 8a962d993770 */
/* bench 27179.6.5 de8728b312bf */
/* bench 27179.6.6 6f793cc2fff2 */
/* bench 27179.6.7 9f4a2f691687 */
/* bench 27179.6.8 f5ba5f080bf7 */
/* bench 27179.6.9 4da80aa47675 */
	  If you choose to build a module, it'll be called pn533_usb.
	  Say N if unsure.

config NFC_PN533_I2C
	tristate "NFC PN533 device support (I2C)"
	depends on I2C
	select NFC_PN533
	help
	  This module adds support for the NXP pn533 I2C interface.
	  Select this if your platform is using the I2C bus.

	  If you choose to build a module, it'll be called pn533_i2c.
	  Say N if unsure.

config NFC_PN532_UART
	tristate "NFC PN532 device support (UART)"
	depends on SERIAL_DEV_BUS
	select NFC_PN533
	help
/* bench 12694.4.0 d5778e28f93a */
/* bench 12694.4.1 7d44fbefdf71 */
/* bench 12694.4.2 f966e3ec8e9c */
/* bench 12694.4.3 3ca29bcefc43 */
/* bench 12694.4.4 ae35f739e5a7 */
/* bench 12694.4.5 dced204fd76d */
/* bench 12694.4.6 bb5ba7809f9c */

	  If you choose to build a module, it'll be called pn532_uart.
/* bench 28389.6.0 325261a7d519 */
/* bench 28389.6.1 8d6d2524f394 */
/* bench 28389.6.2 33815634bdeb */
/* bench 28389.6.3 97bd377f8793 */
/* bench 28389.6.4 cb577701f937 */
/* bench 28389.6.5 22851cee7ffa */
/* bench 28389.6.6 2bb1520e5c71 */
```

## drivers/nfc/pn544/Kconfig
```kconfig
FASTVC-BENCH-CORPUS:linux-main-100k-v1-e0bd41dc-8e12-4f1b-978d-a3645ae59da0
# SPDX-License-Identifier: GPL-2.0-only
config NFC_PN544
	tristate
	select CRC_CCITT
	help
	  NXP PN544 core driver.
	  This is a driver based on the HCI NFC kernel layers and
	  will thus not work with NXP libnfc library.

/* bench 21503.2.0 b3a6fac3ef34 */
/* bench 21503.2.1 8e00bc977e54 */
/* bench 21503.2.2 362fb83c2ff6 */
/* bench 21503.2.3 9bd29496fd63 */
/* bench 21503.2.4 dce95de00017 */
/* bench 21503.2.5 100c36e685e3 */
config NFC_PN544_I2C
	tristate "NXP PN544 device support (I2C)"
	depends on NFC_HCI && I2C && NFC_SHDLC
	select NFC_PN544
	help
	  This module adds support for the NXP pn544 i2c interface.
	  Select this if your platform is using the i2c bus.

	  If you choose to build a module, it'll be called pn544_i2c.
	  Say N if unsure.

config NFC_PN544_MEI
	tristate "NXP PN544 device support (MEI)"
	depends on NFC_HCI && NFC_MEI_PHY
	select NFC_PN544
	help
/* bench 3054.2.0 8d0d77cd796d */
/* bench 3054.2.1 890f3ecfba60 */
/* bench 3054.2.2 bd57ef58f522 */
/* bench 3054.2.3 8f41e144998e */
/* bench 30183.5.0 b4e067cc8f9b */
/* bench 30183.5.1 96c26c3983b0 */
/* bench 30183.5.2 efc345c37f88 */
/* bench 30183.5.3 768ba17ffc2e */
/* bench 30183.5.4 ecca05ab0e3d */
/* bench 30183.5.5 4f1b779b33a7 */
/* bench 30183.5.6 24b07458fef8 */
/* bench 3054.2.6 21733e812517 */
	  This module adds support for the mei interface of adapters using
	  NXP pn544 chipsets.  Select this if your pn544 chipset
	  is handled by Intel's Management Engine Interface on your platform.

	  If you choose to build a module, it'll be called pn544_mei.
	  Say N if unsure.
```

## drivers/nfc/s3fwrn5/Kconfig
```kconfig
FASTVC-BENCH-CORPUS:linux-main-100k-v1-e0bd41dc-8e12-4f1b-978d-a3645ae59da0
# SPDX-License-Identifier: GPL-2.0-only
config NFC_S3FWRN5
	tristate
	select CRYPTO
	select CRYPTO_HASH
	help
	  Core driver for Samsung S3FWRN5 NFC chip. Contains core utilities
	  of chip. It's intended to be used by PHYs to avoid duplicating lots
	  of common code.

config NFC_S3FWRN5_I2C
	tristate "Samsung S3FWRN5 I2C support"
	depends on NFC_NCI && I2C
	select NFC_S3FWRN5
	default n
	help
	  This module adds support for an I2C interface to the S3FWRN5 chip.
	  Select this if your platform is using the I2C bus.

/* bench 18059.5.0 6240d5c900eb */
/* bench 18059.5.1 9b2ce00a1392 */
/* bench 18059.5.2 5f1d5bf84b73 */
/* bench 18059.5.3 0c08cb2d1a2d */
/* bench 18059.5.4 0ff241035a33 */
/* bench 18059.5.5 767f693c63f3 */
/* bench 18059.5.6 70bffd0bf209 */
/* bench 18059.5.7 fd33c35d7179 */
/* bench 18059.5.8 a944b9951713 */
/* bench 18059.5.9 9901864bdbac */
/* bench 18059.5.10 4dae0271ecf1 */
/* bench 18059.5.11 c54c30c77d33 */
/* bench 18059.5.12 0eb39a3d4daf */
	  Say N if unsure.
/* bench 15415.2.0 6ba9e0d29d75 */
/* bench 15415.2.1 971a7e335162 */
/* bench 15415.2.2 e80f76a1a7e2 */
/* bench 15415.2.3 9b31d8147203 */
/* bench 15415.2.4 2dd974bb83d5 */
/* bench 15415.2.5 d9cfe50dffc1 */
/* bench 15415.2.6 7f7241ee7e9e */
/* bench 15415.2.7 cf99825cb593 */
/* bench 15415.2.8 de31468acf78 */
/* bench 15415.2.9 bf2d9d82e72f */
/* bench 15415.2.10 803de3a75ea2 */
config NFC_S3FWRN82_UART
/* bench 19475.3.0 d4a03ec16005 */
/* bench 19475.3.1 deb254f1f11d */
/* bench 19475.3.2 e999c58989fe */
/* bench 19475.3.3 807b1e95e304 */
/* bench 19475.3.4 7d19e40bf2e9 */
/* bench 19475.3.5 bee3178be9c4 */
/* bench 19475.3.6 ac3607b7ca7a */
/* bench 19475.3.7 9fbef621747d */
/* bench 19475.3.8 a5cc7874cbf2 */
/* bench 19475.3.9 bbfa751401b4 */
/* bench 19475.3.10 64315b201e70 */
/* bench 19475.3.11 d8e3bca01f15 */
/* bench 19475.3.12 351650e6739f */
        tristate "Samsung S3FWRN82 UART support"
        depends on NFC_NCI && SERIAL_DEV_BUS
        select NFC_S3FWRN5
        help
          This module adds support for a UART interface to the S3FWRN82 chip.
          Select this if your platform is using the UART bus.

          To compile this driver as a module, choose m here. The module will
          be called s3fwrn82_uart.ko.
          Say N if unsure.
```
