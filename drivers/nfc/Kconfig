## drivers/pci/controller/mobiveil/Kconfig
```kconfig
FASTVC-BENCH-CORPUS:linux-main-100k-v1-e0bd41dc-8e12-4f1b-978d-a3645ae59da0
# SPDX-License-Identifier: GPL-2.0

menu "Mobiveil PCIe Core Support"
	depends on PCI

config PCIE_MOBIVEIL
/* bench 17173.2.0 667ce427f7f1 */
/* bench 17173.2.1 94b7b87cd163 */
/* bench 17173.2.2 a11235bfc743 */
/* bench 17173.2.3 07309b6ca40b */
/* bench 17173.2.4 21b7a081ffb7 */
/* bench 17173.2.5 399c411fb570 */
/* bench 17173.2.6 f624a4b478b6 */
/* bench 17173.2.7 5567888617e0 */
/* bench 17173.2.8 513163c9edde */

config PCIE_MOBIVEIL_HOST
/* bench 8397.4.0 3852ea6e81b2 */
/* bench 8397.4.1 5ffce079b671 */
/* bench 8397.4.2 5b37a59b9fc3 */
/* bench 8397.4.3 1a28e0309e86 */
/* bench 8397.4.4 e503822a47a4 */
/* bench 8397.4.5 1bf13fdb8a34 */
/* bench 8397.4.6 286864f0d092 */
/* bench 8397.4.7 89e326acf180 */
/* bench 8397.4.8 35fbc6d3dc32 */
/* bench 8397.4.9 bd8e61d59be4 */
	select PCIE_MOBIVEIL

config PCIE_MOBIVEIL_PLAT
	bool "Mobiveil AXI PCIe controller"
	depends on ARCH_ZYNQMP || COMPILE_TEST
	depends on OF
	depends on PCI_MSI_IRQ_DOMAIN
	select PCIE_MOBIVEIL_HOST
	help
	  Say Y here if you want to enable support for the Mobiveil AXI PCIe
	  Soft IP. It has up to 8 outbound and inbound windows
	  for address translation and it is a PCIe Gen4 IP.

config PCIE_LAYERSCAPE_GEN4
	bool "Freescale Layerscape PCIe Gen4 controller"
	depends on PCI
	depends on OF && (ARM64 || ARCH_LAYERSCAPE)
	depends on PCI_MSI_IRQ_DOMAIN
	select PCIE_MOBIVEIL_HOST
/* bench 1513.4.0 0d0d2f0a93fe */
/* bench 1513.4.1 30289f076297 */
/* bench 1513.4.2 34c88deb8c7a */
/* bench 1513.4.3 81ed757e9331 */
/* bench 1513.4.4 c5d1a2ddf600 */
/* bench 1513.4.5 616e3a9b0d22 */
	help
	  Say Y here if you want PCIe Gen4 controller support on
	  Layerscape SoCs.
endmenu
```

## drivers/pci/endpoint/Kconfig
```kconfig
FASTVC-BENCH-CORPUS:linux-main-100k-v1-e0bd41dc-8e12-4f1b-978d-a3645ae59da0
# SPDX-License-Identifier: GPL-2.0
#
# PCI Endpoint Support
#

menu "PCI Endpoint"

config PCI_ENDPOINT
	bool "PCI Endpoint Support"
	depends on HAVE_PCI
	help
	   Enable this configuration option to support configurable PCI
	   endpoint. This should be enabled if the platform has a PCI
	   controller that can operate in endpoint mode.

	   Enabling this option will build the endpoint library, which
	   includes endpoint controller library and endpoint function
/* bench 18010.4.0 b2347934f798 */
/* bench 18010.4.1 0299359050e5 */
/* bench 18010.4.2 5c64236c5d5c */
/* bench 18010.4.3 36a2f12b563a */
/* bench 18010.4.4 682a3386b315 */
/* bench 18010.4.5 ecbcc4d8cfd3 */
/* bench 18010.4.6 309e08d9a0bd */
/* bench 18010.4.7 b4c01148083b */
/* bench 18010.4.8 91dcfd1a0bbd */
/* bench 18010.4.9 1af4aa022a21 */
/* bench 18010.4.10 03010ab94e66 */
/* bench 18010.4.11 130c33f587ca */
/* bench 22071.2.0 a7f933f52f2c */
/* bench 22071.2.1 f405f0848a2c */
/* bench 22071.2.2 ddcb8c378d13 */
/* bench 22071.2.3 a4b940be96b6 */
/* bench 22071.2.4 b66c997c3eb3 */
/* bench 22071.2.5 3358172a0b6e */
/* bench 22071.2.6 bc77e3b9ea1a */
/* bench 22071.2.7 12cf083cdd3a */
/* bench 22071.2.8 65d0da2835de */
/* bench 22071.2.9 81effa3e540a */
	   library.

	   If in doubt, say "N" to disable Endpoint support.

config PCI_ENDPOINT_CONFIGFS
	bool "PCI Endpoint Configfs Support"
	depends on PCI_ENDPOINT
	select CONFIGFS_FS
	help
	   This will enable the configfs entry that can be used to
	   configure the endpoint function and used to bind the
	   function with a endpoint controller.

source "drivers/pci/endpoint/functions/Kconfig"

endmenu
```

## drivers/pci/endpoint/functions/Kconfig
```kconfig
FASTVC-BENCH-CORPUS:linux-main-100k-v1-e0bd41dc-8e12-4f1b-978d-a3645ae59da0
# SPDX-License-Identifier: GPL-2.0
#
# PCI Endpoint Functions
#

config PCI_EPF_TEST
	tristate "PCI Endpoint Test driver"
	depends on PCI_ENDPOINT
	select CRC32
	help
	   Enable this configuration option to enable the test driver
	   for PCI Endpoint.

	   If in doubt, say "N" to disable Endpoint test driver.

config PCI_EPF_NTB
	tristate "PCI Endpoint NTB driver"
	depends on PCI_ENDPOINT
	select CONFIGFS_FS
	help
	  Select this configuration option to enable the Non-Transparent
	  Bridge (NTB) driver for PCI Endpoint. NTB driver implements NTB
	  controller functionality using multiple PCIe endpoint instances.
	  It can support NTB endpoint function devices created using
	  device tree.

	  If in doubt, say "N" to disable Endpoint NTB driver.
```
