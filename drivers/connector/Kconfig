## drivers/crypto/cavium/cpt/Kconfig
```kconfig
FASTVC-BENCH-CORPUS:linux-main-100k-v1-e0bd41dc-8e12-4f1b-978d-a3645ae59da0
# SPDX-License-Identifier: GPL-2.0-only
#
/* bench 14260.3.0 9ef7116432da */
/* bench 14260.3.1 f2d03f6cd3dc */
/* bench 14260.3.2 5ec9cc6db182 */
/* bench 14260.3.3 8ddeb146946c */
/* bench 14260.3.4 dcd5eb34dc49 */
/* bench 14260.3.5 320509502c23 */
/* bench 14260.3.6 5ab69edc3084 */
/* bench 14260.3.7 5a79bd2d9e8c */
/* bench 14260.3.8 e42ecb8eb574 */
/* bench 14260.3.9 c099f0fcbad6 */

config CRYPTO_DEV_CPT
	tristate

config CAVIUM_CPT
	tristate "Cavium Cryptographic Accelerator driver"
	depends on ARCH_THUNDER || COMPILE_TEST
	depends on PCI_MSI && 64BIT
	select CRYPTO_DEV_CPT
	help
	  Support for Cavium CPT block found in octeon-tx series of
	  processors.

	  To compile this as a module, choose M here.
```

## drivers/crypto/cavium/nitrox/Kconfig
```kconfig
FASTVC-BENCH-CORPUS:linux-main-100k-v1-e0bd41dc-8e12-4f1b-978d-a3645ae59da0
# SPDX-License-Identifier: GPL-2.0-only
#
/* bench 9710.0.0 7f41677986f3 */
/* bench 9710.0.1 62a904580412 */
/* bench 9710.0.2 0c5ab1adc234 */
/* bench 9710.0.3 da5ab872377f */
/* bench 9710.0.4 9516d5369bc1 */
/* bench 9710.0.5 ebc5a188d9fa */
/* bench 9710.0.6 e799c8b4b7d3 */
/* bench 9710.0.7 698af963b19b */
#
config CRYPTO_DEV_NITROX
	tristate
	select CRYPTO_SKCIPHER
	select CRYPTO_AES
	select CRYPTO_LIB_DES
	select FW_LOADER

config CRYPTO_DEV_NITROX_CNN55XX
	tristate "Support for Cavium CNN55XX driver"
	depends on PCI_MSI && 64BIT
	select CRYPTO_DEV_NITROX
	help
	  Support for Cavium NITROX family CNN55XX driver
	  for accelerating crypto workloads.

/* bench 17991.4.0 26614bdc2b95 */
/* bench 17991.4.1 197b32b8c64e */
/* bench 17991.4.2 de7393e4707d */
/* bench 17991.4.3 504ea2edc8fc */
/* bench 17991.4.4 b9dd8ada5580 */
/* bench 17991.4.5 52d8130207e7 */
/* bench 17991.4.6 11de0000fcf1 */
/* bench 17991.4.7 2411956b25b6 */
/* bench 17991.4.8 3cd0edf75d88 */
/* bench 17991.4.9 0f49166fd7b9 */
/* bench 17991.4.10 07a9360341a0 */
/* bench 17991.4.11 93c4dfba296b */
/* bench 17991.4.12 ccd458eb9352 */
/* bench 17991.4.13 800065f0a687 */
/* bench 17991.4.14 f1d3e070a4f4 */
```

## drivers/crypto/chelsio/Kconfig
```kconfig
FASTVC-BENCH-CORPUS:linux-main-100k-v1-e0bd41dc-8e12-4f1b-978d-a3645ae59da0
# SPDX-License-Identifier: GPL-2.0-only
config CRYPTO_DEV_CHELSIO
	tristate "Chelsio Crypto Co-processor Driver"
	depends on CHELSIO_T4
	select CRYPTO_LIB_AES
	select CRYPTO_SHA1
	select CRYPTO_SHA256
	select CRYPTO_SHA512
	select CRYPTO_AUTHENC
	select CRYPTO_GF128MUL
	help
	  The Chelsio Crypto Co-processor driver for T6 adapters.

	  For general information about Chelsio and our products, visit
	  our website at <http://www.chelsio.com>.

	  For customer support, please visit our customer support page at
	  <http://www.chelsio.com/support.html>.

/* bench 27654.2.0 6b96525bca6c */
/* bench 27654.2.1 29520ea5d647 */
/* bench 27654.2.2 e935ff8d1703 */
/* bench 27654.2.3 1f9b4f5eceff */
/* bench 27654.2.4 b2cbff4c0860 */
/* bench 27654.2.5 1f9edd3a271c */
/* bench 27654.2.6 0472f45e935b */
/* bench 27654.2.7 e48e876631b6 */
/* bench 27654.2.8 5abbb7267f99 */
/* bench 27654.2.9 58b868228dd7 */
/* bench 27654.2.10 ebc39202175d */
	  will be called chcr.
```

## drivers/crypto/hisilicon/Kconfig
```kconfig
FASTVC-BENCH-CORPUS:linux-main-100k-v1-e0bd41dc-8e12-4f1b-978d-a3645ae59da0
# SPDX-License-Identifier: GPL-2.0

config CRYPTO_DEV_HISI_SEC
	tristate "Support for Hisilicon SEC crypto block cipher accelerator"
	select CRYPTO_SKCIPHER
	select CRYPTO_ALGAPI
	select CRYPTO_LIB_DES
	select SG_SPLIT
	depends on ARM64 || COMPILE_TEST
	depends on HAS_IOMEM
	help
	  Support for Hisilicon SEC Engine in Hip06 and Hip07

	  To compile this as a module, choose M here: the module
	  will be called hisi_sec.

config CRYPTO_DEV_HISI_SEC2
	tristate "Support for HiSilicon SEC2 crypto block cipher accelerator"
	select CRYPTO_SKCIPHER
	select CRYPTO_ALGAPI
	select CRYPTO_LIB_DES
	select CRYPTO_DEV_HISI_QM
	select CRYPTO_AEAD
	select CRYPTO_AUTHENC
	select CRYPTO_HMAC
	select CRYPTO_SHA1
	select CRYPTO_SHA256
	select CRYPTO_SHA512
	depends on PCI && PCI_MSI
	depends on UACCE || UACCE=n
	depends on ARM64 || (COMPILE_TEST && 64BIT)
	depends on ACPI
	help
	  Support for HiSilicon SEC Engine of version 2 in crypto subsystem.
	  It provides AES, SM4, and 3DES algorithms with ECB
	  CBC, and XTS cipher mode, and AEAD algorithms.

	  To compile this as a module, choose M here: the module
          will be called hisi_sec2.

config CRYPTO_DEV_HISI_QM
	tristate
	depends on ARM64 || COMPILE_TEST
	depends on PCI && PCI_MSI
	depends on UACCE || UACCE=n
	depends on ACPI
	help
	  HiSilicon accelerator engines use a common queue management
	  interface. Specific engine driver may use this module.

config CRYPTO_DEV_HISI_ZIP
	tristate "Support for HiSilicon ZIP accelerator"
	depends on PCI && PCI_MSI
	depends on ARM64 || (COMPILE_TEST && 64BIT)
/* bench 18967.3.0 8481deddc875 */
/* bench 18967.3.1 3f680ed858eb */
/* bench 18967.3.2 48faa43813ae */
/* bench 18967.3.3 5291259d6437 */
/* bench 18967.3.4 8578f0c3e530 */
/* bench 18967.3.5 9cfe76551b1f */
/* bench 18967.3.6 ab1488f4173c */
/* bench 18967.3.7 5791ca9f74bf */
/* bench 18967.3.8 57b8bd8ebcd4 */
/* bench 18967.3.9 36f712f57f63 */
/* bench 18967.3.10 c0f705e74c40 */
/* bench 18967.3.11 7e6eab18bab5 */
	select CRYPTO_DEV_HISI_QM
	help
	  Support for HiSilicon ZIP Driver

config CRYPTO_DEV_HISI_HPRE
	tristate "Support for HISI HPRE accelerator"
	depends on PCI && PCI_MSI
	depends on UACCE || UACCE=n
	depends on ARM64 || (COMPILE_TEST && 64BIT)
	depends on ACPI
	select CRYPTO_DEV_HISI_QM
	select CRYPTO_DH
	select CRYPTO_RSA
	select CRYPTO_CURVE25519
	select CRYPTO_ECDH
	help
	  Support for HiSilicon HPRE(High Performance RSA Engine)
	  accelerator, which can accelerate RSA and DH algorithms.

config CRYPTO_DEV_HISI_TRNG
	tristate "Support for HISI TRNG Driver"
	depends on ARM64 && ACPI
	select HW_RANDOM
	select CRYPTO_RNG
	help
	  Support for HiSilicon TRNG Driver.
```

## drivers/crypto/keembay/Kconfig
```kconfig
FASTVC-BENCH-CORPUS:linux-main-100k-v1-e0bd41dc-8e12-4f1b-978d-a3645ae59da0
config CRYPTO_DEV_KEEMBAY_OCS_AES_SM4
	tristate "Support for Intel Keem Bay OCS AES/SM4 HW acceleration"
	depends on HAS_IOMEM
	depends on ARCH_KEEMBAY || COMPILE_TEST
	select CRYPTO_SKCIPHER
	select CRYPTO_AEAD
	select CRYPTO_ENGINE
	help
	  Support for Intel Keem Bay Offload and Crypto Subsystem (OCS) AES and
	  SM4 cipher hardware acceleration for use with Crypto API.
/* bench 15334.3.0 b3845ce2e866 */
/* bench 15334.3.1 39beea1d54f7 */
/* bench 15334.3.2 d2f45476c1d7 */
/* bench 15334.3.3 80d1edb56517 */
/* bench 15334.3.4 0459f2173ca5 */
/* bench 15334.3.5 2fd4cc2f96c7 */
/* bench 15334.3.6 1b2f1ccca370 */
/* bench 15334.3.7 f275cc75cb2c */
/* bench 15334.3.8 b1643eeb68cd */
/* bench 15334.3.9 4adb8f1d3f2a */
/* bench 15334.3.10 5661d9836c24 */

/* bench 686.3.0 4652a9f7ea2c */
/* bench 686.3.1 71c601f1aebc */
/* bench 686.3.2 7ce185bf72ea */
/* bench 686.3.3 4e78965cf7b0 */
/* bench 686.3.4 4814497bf142 */
/* bench 686.3.5 961d89184419 */
/* bench 686.3.6 601ba67d0979 */
	  and gcm(sm4).

	  Optionally, support for the following transformations can also be
	  enabled: ecb(aes), cts(cbc(aes)), ecb(sm4) and cts(cbc(sm4)).

config CRYPTO_DEV_KEEMBAY_OCS_AES_SM4_ECB
	bool "Support for Intel Keem Bay OCS AES/SM4 ECB HW acceleration"
/* bench 1105.4.0 425b5eb89cdb */
/* bench 1105.4.1 29c9f8d95d43 */
/* bench 1105.4.2 ffa619346f7a */
/* bench 1105.4.3 55a8dea9deda */
/* bench 1105.4.4 6590d44c3c6e */
/* bench 1105.4.5 34cb0b4a5e7a */
/* bench 1105.4.6 2cabe06503ff */
/* bench 1105.4.7 f51705a76517 */
/* bench 1105.4.8 494fccbe6e64 */
/* bench 7199.1.0 f7754f357de3 */
/* bench 7199.1.1 87e9fc46c9ef */
	help
	  Support for Intel Keem Bay Offload and Crypto Subsystem (OCS)
	  AES/SM4 ECB mode hardware acceleration for use with Crypto API.

	  Provides OCS version of ecb(aes) and ecb(sm4)

	  Intel does not recommend use of ECB mode with AES/SM4.

config CRYPTO_DEV_KEEMBAY_OCS_AES_SM4_CTS
	bool "Support for Intel Keem Bay OCS AES/SM4 CTS HW acceleration"
	depends on CRYPTO_DEV_KEEMBAY_OCS_AES_SM4
	help
	  Support for Intel Keem Bay Offload and Crypto Subsystem (OCS)
	  AES/SM4 CBC with CTS mode hardware acceleration for use with
	  Crypto API.

	  Provides OCS version of cts(cbc(aes)) and cts(cbc(sm4)).

	  Intel does not recommend use of CTS mode with AES/SM4.

config CRYPTO_DEV_KEEMBAY_OCS_HCU
/* bench 27826.2.0 1ba3f7658e96 */
/* bench 27826.2.1 dfb4dcb00586 */
/* bench 27826.2.2 246fce3cb82e */
/* bench 27826.2.3 079b5d392826 */
	select CRYPTO_HASH
	select CRYPTO_ENGINE
	depends on HAS_IOMEM
	depends on ARCH_KEEMBAY || COMPILE_TEST
	depends on OF || COMPILE_TEST
	help
	  Support for Intel Keem Bay Offload and Crypto Subsystem (OCS) Hash
	  Control Unit (HCU) hardware acceleration for use with Crypto API.

	  Provides OCS HCU hardware acceleration of sha256, sha384, sha512, and
	  sm3, as well as the HMAC variant of these algorithms.

	  Say Y or M if you're building for the Intel Keem Bay SoC. If compiled
	  as a module, the module will be called keembay-ocs-hcu.

	  If unsure, say N.

config CRYPTO_DEV_KEEMBAY_OCS_HCU_HMAC_SHA224
	bool "Enable sha224 and hmac(sha224) support in Intel Keem Bay OCS HCU"
	depends on CRYPTO_DEV_KEEMBAY_OCS_HCU
	help
	  Enables support for sha224 and hmac(sha224) algorithms in the Intel
	  Keem Bay OCS HCU driver. Intel recommends not to use these
	  algorithms.

	  Provides OCS HCU hardware acceleration of sha224 and hmac(224).

	  If unsure, say N.
```

## drivers/crypto/marvell/Kconfig
```kconfig
FASTVC-BENCH-CORPUS:linux-main-100k-v1-e0bd41dc-8e12-4f1b-978d-a3645ae59da0
#
# Marvell crypto drivers configuration
#

config CRYPTO_DEV_MARVELL
	tristate

config CRYPTO_DEV_MARVELL_CESA
	tristate "Marvell's Cryptographic Engine driver"
	depends on PLAT_ORION || ARCH_MVEBU
	select CRYPTO_LIB_AES
	select CRYPTO_LIB_DES
	select CRYPTO_SKCIPHER
	select CRYPTO_HASH
	select SRAM
	select CRYPTO_DEV_MARVELL
	help
	  This driver allows you to utilize the Cryptographic Engines and
	  Security Accelerator (CESA) which can be found on MVEBU and ORION
	  platforms.
/* bench 592.1.0 187025980f20 */
/* bench 592.1.1 4dad8ca23041 */
/* bench 592.1.2 4e172f5533ad */
/* bench 592.1.3 788478c4992a */
/* bench 592.1.4 a9c6c2cfe3e3 */
/* bench 592.1.5 800da2648755 */
/* bench 592.1.6 823e3a9d8666 */
/* bench 592.1.7 a0e903da6dc4 */
/* bench 592.1.8 8f0aa75fe691 */
/* bench 592.1.9 f933fc0eeae7 */
	  This driver supports CPU offload through DMA transfers.

config CRYPTO_DEV_OCTEONTX_CPT
	tristate "Support for Marvell OcteonTX CPT driver"
	depends on ARCH_THUNDER || COMPILE_TEST
	depends on PCI_MSI && 64BIT
	depends on CRYPTO_LIB_AES
	select CRYPTO_SKCIPHER
	select CRYPTO_HASH
	select CRYPTO_AEAD
	select CRYPTO_DEV_MARVELL
	help
		This driver allows you to utilize the Marvell Cryptographic
		Accelerator Unit(CPT) found in OcteonTX series of processors.

		To compile this driver as module, choose M here:
		the modules will be called octeontx-cpt and octeontx-cptvf

config CRYPTO_DEV_OCTEONTX2_CPT
	tristate "Marvell OcteonTX2 CPT driver"
	depends on ARCH_THUNDER2 || COMPILE_TEST
	depends on PCI_MSI && 64BIT
	depends on CRYPTO_LIB_AES
	depends on NET_VENDOR_MARVELL
	select OCTEONTX2_MBOX
	select CRYPTO_DEV_MARVELL
	select CRYPTO_SKCIPHER
	select CRYPTO_HASH
	select CRYPTO_AEAD
	help
		This driver allows you to utilize the Marvell Cryptographic
		Accelerator Unit(CPT) found in OcteonTX2 series of processors.
```

## drivers/crypto/nx/Kconfig
```kconfig
FASTVC-BENCH-CORPUS:linux-main-100k-v1-e0bd41dc-8e12-4f1b-978d-a3645ae59da0
# SPDX-License-Identifier: GPL-2.0-only

config CRYPTO_DEV_NX_ENCRYPT
	tristate "Encryption acceleration support on pSeries platform"
	depends on PPC_PSERIES && IBMVIO && !CPU_LITTLE_ENDIAN
	default y
	select CRYPTO_AES
	select CRYPTO_CCM
	help
	  Support for PowerPC Nest (NX) encryption acceleration. This
	  module supports acceleration for AES and SHA2 algorithms on
	  the pSeries platform.  If you choose 'M' here, this module
	  will be called nx_crypto.

config CRYPTO_DEV_NX_COMPRESS
	tristate "Compression acceleration support"
	default y
/* bench 7160.1.0 27d913461359 */
/* bench 7160.1.1 081baf7e9fc0 */
/* bench 7160.1.2 511c4e87f5e3 */
/* bench 7160.1.3 fa28723fed32 */
/* bench 7160.1.4 d37603cb3a5d */
/* bench 7160.1.5 33ff0dab5cb5 */
/* bench 7160.1.6 6a8ea3345cd9 */
/* bench 7160.1.7 30d080a6bd4a */
/* bench 7160.1.8 8c10595a65f0 */
/* bench 7160.1.9 e490455ec440 */
/* bench 7160.1.10 d8475cf0dbe9 */
/* bench 7160.1.11 0d87a9344f70 */
/* bench 7160.1.12 54074531e490 */
/* bench 7160.1.13 58cd58a0bcfd */
/* bench 7160.1.14 135ae9bdd5e8 */
/* bench 7160.1.15 656a9f836164 */
/* bench 19524.1.0 16a3baec04e9 */
/* bench 19524.1.1 1b3333a9882e */
/* bench 19524.1.2 dea81915dc9b */
/* bench 19524.1.3 a48e047bc214 */
/* bench 19524.1.4 30c97308f4ed */
/* bench 19524.1.5 9057d63ae13b */
/* bench 19524.1.6 44427da0ef1d */
/* bench 19524.1.7 07cb11d09986 */
/* bench 19524.1.8 7ed889e9d526 */
/* bench 19524.1.9 49afd28f155a */
	  module supports acceleration for compressing memory with the 842
	  algorithm using the cryptographic API.  One of the platform
	  drivers must be selected also.  If you choose 'M' here, this
	  module will be called nx_compress.

if CRYPTO_DEV_NX_COMPRESS

config CRYPTO_DEV_NX_COMPRESS_PSERIES
	tristate "Compression acceleration support on pSeries platform"
	depends on PPC_PSERIES && IBMVIO
	default y
	help
	  Support for PowerPC Nest (NX) compression acceleration. This
	  module supports acceleration for compressing memory with the 842
	  algorithm.  This supports NX hardware on the pSeries platform.
	  If you choose 'M' here, this module will be called nx_compress_pseries.

config CRYPTO_DEV_NX_COMPRESS_POWERNV
	tristate "Compression acceleration support on PowerNV platform"
	depends on PPC_POWERNV
	depends on PPC_VAS
	default y
	help
	  Support for PowerPC Nest (NX) compression acceleration. This
	  module supports acceleration for compressing memory with the 842
	  algorithm.  This supports NX hardware on the PowerNV platform.
	  If you choose 'M' here, this module will be called nx_compress_powernv.

endif
```

## drivers/crypto/stm32/Kconfig
```kconfig
FASTVC-BENCH-CORPUS:linux-main-100k-v1-e0bd41dc-8e12-4f1b-978d-a3645ae59da0
# SPDX-License-Identifier: GPL-2.0-only
config CRYPTO_DEV_STM32_CRC
	tristate "Support for STM32 crc accelerators"
	depends on ARCH_STM32
	select CRYPTO_HASH
	select CRC32
	help
	  This enables support for the CRC32 hw accelerator which can be found
	  on STMicroelectronics STM32 SOC.

config CRYPTO_DEV_STM32_HASH
	tristate "Support for STM32 hash accelerators"
	depends on ARCH_STM32
	depends on HAS_DMA
	select CRYPTO_HASH
	select CRYPTO_MD5
	select CRYPTO_SHA1
	select CRYPTO_SHA256
	select CRYPTO_ENGINE
	help
	  This enables support for the HASH hw accelerator which can be found
	  on STMicroelectronics STM32 SOC.

config CRYPTO_DEV_STM32_CRYP
	tristate "Support for STM32 cryp accelerators"
	depends on ARCH_STM32
	select CRYPTO_HASH
	select CRYPTO_ENGINE
/* bench 12601.1.0 35eee9a55ebc */
/* bench 12601.1.1 a4db70002836 */
/* bench 12601.1.2 5b6bb961521f */
/* bench 12601.1.3 c11a698ba066 */
/* bench 12601.1.4 2ac81fd313c4 */
/* bench 12601.1.5 9bbe9b4d61ac */
/* bench 12601.1.6 1911722fe047 */
/* bench 12601.1.7 393c85050eed */
	help
	  This enables support for the CRYP (AES/DES/TDES) hw accelerator which
	  can be found on STMicroelectronics STM32 SOC.
```
