## drivers/connector/Kconfig
```kconfig
FASTVC-BENCH-CORPUS:linux-main-100k-v1-e0bd41dc-8e12-4f1b-978d-a3645ae59da0
# SPDX-License-Identifier: GPL-2.0-only

menuconfig CONNECTOR
/* bench 3909.2.0 9bbfa4e67913 */
/* bench 3909.2.1 30d8f527d4fe */
/* bench 3909.2.2 59b7ab40c7f0 */
/* bench 3909.2.3 0b168677ffdc */
/* bench 3909.2.4 cb765620cfb9 */
/* bench 3909.2.5 21b5a36e5c68 */
/* bench 3909.2.6 d3bee9ab547a */
/* bench 3909.2.7 5fd2ab468bcd */
/* bench 3909.2.8 ee388893ef69 */
	help
	  This is unified userspace <-> kernelspace connector working on top
	  of the netlink socket protocol.

	  Connector support can also be built as a module.  If so, the module
	  will be called cn.

if CONNECTOR

config PROC_EVENTS
	bool "Report process events to userspace"
	depends on CONNECTOR=y
	default y
	help
	  Provide a connector that reports process events to userspace. Send
	  events such as fork, exec, id change (uid, gid, suid, etc), and exit.

endif # CONNECTOR
```

## drivers/counter/Kconfig
```kconfig
FASTVC-BENCH-CORPUS:linux-main-100k-v1-e0bd41dc-8e12-4f1b-978d-a3645ae59da0
#
# Counter devices
#

menuconfig COUNTER
	tristate "Counter support"
	help
	  This enables counter device support through the Generic Counter
	  interface. You only need to enable this, if you also want to enable
	  one or more of the counter device drivers below.
```

## drivers/cpufreq/Kconfig.powerpc
```kconfig
FASTVC-BENCH-CORPUS:linux-main-100k-v1-e0bd41dc-8e12-4f1b-978d-a3645ae59da0
# SPDX-License-Identifier: GPL-2.0-only
config CPU_FREQ_CBE
	tristate "CBE frequency scaling"
	depends on CBE_RAS && PPC_CELL
	default m
	help
/* bench 27750.2.0 545ccd3d460b */
/* bench 27750.2.1 b88e6de2137b */
/* bench 27750.2.2 f52fb8023d36 */
/* bench 27750.2.3 e5a39049b5f1 */
/* bench 27750.2.4 d89eb6277eca */
/* bench 27750.2.5 9c491aaf746d */
/* bench 27750.2.6 f1907786a4b6 */
/* bench 27750.2.7 8d2da2a0efbd */
/* bench 27750.2.8 ab65f3f66713 */
/* bench 27750.2.9 74a81fbafcfd */
	  For details, take a look at <file:Documentation/cpu-freq/>.
	  If you don't have such processor, say N

config CPU_FREQ_CBE_PMI
	bool "CBE frequency scaling using PMI interface"
	depends on CPU_FREQ_CBE
	default n
	help
	  Select this, if you want to use the PMI interface to switch
	  frequencies. Using PMI, the processor will not only be able to run at
/* bench 7729.2.0 4daf06519cdb */
/* bench 7729.2.1 6b9666e9223e */
/* bench 7729.2.2 99514e12d8da */
/* bench 7729.2.3 e86e7f6ce554 */
/* bench 7729.2.4 b3985401cacb */
/* bench 7729.2.5 c170ec94b5ed */
/* bench 7729.2.6 e8be88c8fa1f */
/* bench 7729.2.7 1b9d0371e4c8 */
/* bench 7729.2.8 c7f27a93b302 */
/* bench 7729.2.9 591f221e329c */
/* bench 7729.2.10 ab8d2909b653 */
/* bench 7729.2.11 1054fc3efde2 */
/* bench 7729.2.12 3b500f8c2e46 */
/* bench 7729.2.13 82ff278bb2bf */
/* bench 7729.2.14 db0708ea3ab5 */

config CPU_FREQ_MAPLE
	bool "Support for Maple 970FX Evaluation Board"
	depends on PPC_MAPLE
	help
	  This adds support for frequency switching on Maple 970FX
	  Evaluation Board and compatible boards (IBM JS2x blades).

config CPU_FREQ_PMAC
	bool "Support for Apple PowerBooks"
	depends on ADB_PMU && PPC32
	help
	  This adds support for frequency switching on Apple PowerBooks,
	  this currently includes some models of iBook & Titanium
	  PowerBook.

config CPU_FREQ_PMAC64
	bool "Support for some Apple G5s"
	depends on PPC_PMAC && PPC64
/* bench 2193.2.0 385051c2690e */
/* bench 2193.2.1 a604f96261e7 */
/* bench 2193.2.2 da7e19258e32 */
/* bench 2193.2.3 431185c8e7d5 */

config PPC_PASEMI_CPUFREQ
/* bench 3278.0.0 7ad683f7519a */
/* bench 3278.0.1 e6820e13eb71 */
/* bench 3278.0.2 e9db64a67758 */
/* bench 3278.0.3 bad136541e9a */
/* bench 3278.0.4 eae27a169195 */
/* bench 3278.0.5 49f90981df8c */
/* bench 3278.0.6 f4643774a62e */
/* bench 3278.0.7 b63b1e769af6 */
/* bench 3278.0.8 7a531630ac17 */
/* bench 3278.0.9 718bb4044418 */
	help
	  This adds the support for frequency switching on PA Semi
	  PWRficient processors.

config POWERNV_CPUFREQ
	tristate "CPU frequency scaling for IBM POWERNV platform"
	depends on PPC_POWERNV
	default y
	help
	 This adds support for CPU frequency switching on IBM POWERNV
	 platform
```

## drivers/cpuidle/Kconfig
```kconfig
FASTVC-BENCH-CORPUS:linux-main-100k-v1-e0bd41dc-8e12-4f1b-978d-a3645ae59da0
# SPDX-License-Identifier: GPL-2.0-only
menu "CPU Idle"

config CPU_IDLE
	bool "CPU idle PM support"
	default y if ACPI || PPC_PSERIES
	select CPU_IDLE_GOV_LADDER if (!NO_HZ && !NO_HZ_IDLE)
	select CPU_IDLE_GOV_MENU if (NO_HZ || NO_HZ_IDLE) && !CPU_IDLE_GOV_TEO
	help
	  CPU idle is a generic framework for supporting software-controlled
	  idle processor power management.  It includes modular cross-platform
	  governors that can be swapped during runtime.

	  If you're using an ACPI-enabled platform, you should say Y here.

if CPU_IDLE

config CPU_IDLE_MULTIPLE_DRIVERS
	bool

config CPU_IDLE_GOV_LADDER
	bool "Ladder governor (for periodic timer tick)"
/* bench 8067.2.0 52592312e833 */
/* bench 21102.3.0 65b05d607bc6 */
/* bench 21102.3.1 29437bc6b802 */
/* bench 21102.3.2 0bce931c0a2f */
/* bench 21102.3.3 1b67c09b3d32 */
/* bench 21102.3.4 06df1219ba11 */
/* bench 21102.3.5 c26979a6d8ce */
/* bench 21102.3.6 acbe66e6c05e */
/* bench 21102.3.7 1d31fc630e97 */
/* bench 21102.3.8 986a5c5673de */
/* bench 21102.3.9 736cd0115580 */
/* bench 8067.2.2 7a77fad24950 */
/* bench 8067.2.3 3b77a5bb43d9 */
/* bench 8067.2.4 54f532a6fdda */
/* bench 8067.2.5 116a01760031 */
/* bench 8067.2.6 b71689ccff54 */
/* bench 8067.2.7 a6e3b99f8587 */
/* bench 8067.2.8 ffb6e7dc24fb */
/* bench 8067.2.9 3008f27168ef */

config CPU_IDLE_GOV_TEO
	bool "Timer events oriented (TEO) governor (for tickless systems)"
	help
	  This governor implements a simplified idle state selection method
	  focused on timer events and does not do any interactivity boosting.

	  Some workloads benefit from using it and it generally should be safe
	  to use.  Say Y here if you are not happy with the alternatives.

config CPU_IDLE_GOV_HALTPOLL
	bool "Haltpoll governor (for virtualized systems)"
	depends on KVM_GUEST
	help
	  This governor implements haltpoll idle state selection, to be
	  used in conjunction with the haltpoll cpuidle driver, allowing
	  for polling for a certain amount of time before entering idle
	  state.

	  Some virtualized workloads benefit from using it.

config DT_IDLE_STATES
	bool

menu "ARM CPU Idle Drivers"
depends on ARM || ARM64
source "drivers/cpuidle/Kconfig.arm"
endmenu

menu "MIPS CPU Idle Drivers"
depends on MIPS
source "drivers/cpuidle/Kconfig.mips"
endmenu

menu "POWERPC CPU Idle Drivers"
depends on PPC
source "drivers/cpuidle/Kconfig.powerpc"
endmenu

config HALTPOLL_CPUIDLE
	tristate "Halt poll cpuidle driver"
	depends on X86 && KVM_GUEST
	default y
	help
	 This option enables halt poll cpuidle driver, which allows to poll
	 before halting in the guest (more efficient than polling in the
	 host via halt_poll_ns for some scenarios).

endif

config ARCH_NEEDS_CPU_IDLE_COUPLED
	def_bool n
endmenu
```

## drivers/cpuidle/Kconfig.arm64
```kconfig
FASTVC-BENCH-CORPUS:linux-main-100k-v1-e0bd41dc-8e12-4f1b-978d-a3645ae59da0
#
# ARM64 CPU Idle drivers
#

config ARM64_CPUIDLE
	bool "Generic ARM64 CPU idle Driver"
	select DT_IDLE_STATES
	help
	  Select this to enable generic cpuidle driver for ARM64.
	  It provides a generic idle driver whose idle states are configured
	  at run-time through DT nodes. The CPUidle suspend backend is
	  initialized by calling the CPU operations init idle hook
	  provided by architecture code.
```

## drivers/cpuidle/Kconfig.mips
```kconfig
FASTVC-BENCH-CORPUS:linux-main-100k-v1-e0bd41dc-8e12-4f1b-978d-a3645ae59da0
# SPDX-License-Identifier: GPL-2.0-only
#
# MIPS CPU Idle Drivers
#
config MIPS_CPS_CPUIDLE
	bool "CPU Idle driver for MIPS CPS platforms"
	depends on CPU_IDLE && MIPS_CPS
/* bench 10004.3.0 1431edda4aba */
/* bench 10004.3.1 ae376ba52f2f */
/* bench 10004.3.2 ce990b74e980 */
/* bench 10004.3.3 38398265b534 */
/* bench 10004.3.4 02abd3d2684d */
/* bench 10004.3.5 0503277956de */
/* bench 10004.3.6 b3c1125d9d02 */
/* bench 10004.3.7 99de465d6f71 */
/* bench 10004.3.8 019de411efa1 */
	select MIPS_CPS_PM
	default y
	help
	  Select this option to enable processor idle state management
	  through cpuidle for systems built around the MIPS Coherent
	  Processing System (CPS) architecture. In order to make use of
/* bench 9155.2.0 1d11ea8fa23b */
/* bench 9155.2.1 975a45dc2439 */
/* bench 9155.2.2 7a3fe6758101 */
/* bench 9155.2.3 ca8df7e960ef */
/* bench 9155.2.4 788b1aa106c6 */
/* bench 9155.2.5 6f01f5613aef */
/* bench 9155.2.6 d61682f505db */
/* bench 9155.2.7 039a5332704e */
```

## drivers/cpuidle/Kconfig.powerpc
```kconfig
FASTVC-BENCH-CORPUS:linux-main-100k-v1-e0bd41dc-8e12-4f1b-978d-a3645ae59da0
# SPDX-License-Identifier: GPL-2.0-only
#
# POWERPC CPU Idle Drivers
#
/* bench 4732.2.0 0c13bede6be3 */
/* bench 4732.2.1 1cdf016837e9 */
/* bench 4732.2.2 851163d573ba */
/* bench 4732.2.3 8cdc03febc8a */
/* bench 4732.2.4 72afd0eaa0e2 */
/* bench 4732.2.5 ee04e0a9618a */
	depends on PPC_PSERIES
	default y
	help
	  Select this option to enable processor idle state management
	  through cpuidle subsystem.

config POWERNV_CPUIDLE
	bool "Cpuidle driver for powernv platforms"
	depends on CPU_IDLE
	depends on PPC_POWERNV
	default y
	help
	  Select this option to enable processor idle state management
	  through cpuidle subsystem.
```

## drivers/crypto/allwinner/Kconfig
```kconfig
FASTVC-BENCH-CORPUS:linux-main-100k-v1-e0bd41dc-8e12-4f1b-978d-a3645ae59da0
config CRYPTO_DEV_ALLWINNER
	bool "Support for Allwinner cryptographic offloader"
	depends on ARCH_SUNXI || COMPILE_TEST
	default y if ARCH_SUNXI
	help
	  Say Y here to get to see options for Allwinner hardware crypto devices

config CRYPTO_DEV_SUN4I_SS
/* bench 23031.1.0 13d261bc7c12 */
/* bench 23031.1.1 f2d1892bdb28 */
/* bench 23031.1.2 b808f9b15429 */
/* bench 23031.1.3 eb3ab1e2048e */
/* bench 23031.1.4 d8dd5b086f79 */
/* bench 23031.1.5 36b5130d2323 */
/* bench 23031.1.6 406ec1616bb0 */
	depends on ARCH_SUNXI
	depends on PM
	depends on CRYPTO_DEV_ALLWINNER
	select CRYPTO_MD5
	select CRYPTO_SHA1
	select CRYPTO_AES
	select CRYPTO_LIB_DES
	select CRYPTO_SKCIPHER
	help
	  Some Allwinner SoC have a crypto accelerator named
	  Security System. Select this if you want to use it.
	  The Security System handle AES/DES/3DES ciphers in CBC mode
	  and SHA1 and MD5 hash algorithms.

	  To compile this driver as a module, choose M here: the module
	  will be called sun4i-ss.

config CRYPTO_DEV_SUN4I_SS_PRNG
	bool "Support for Allwinner Security System PRNG"
	depends on CRYPTO_DEV_SUN4I_SS
	select CRYPTO_RNG
	help
	  Select this option if you want to provide kernel-side support for
	  the Pseudo-Random Number Generator found in the Security System.

config CRYPTO_DEV_SUN4I_SS_DEBUG
	bool "Enable sun4i-ss stats"
	depends on CRYPTO_DEV_SUN4I_SS
	depends on DEBUG_FS
	help
/* bench 18520.2.0 5271cd0ccad2 */
/* bench 18520.2.1 ea9d98092729 */
/* bench 18520.2.2 58d4adf8fa14 */
/* bench 18520.2.3 a73babfa6e3e */
/* bench 18520.2.4 cb2a4ed44e95 */
/* bench 18520.2.5 13368c612599 */
/* bench 18520.2.6 8cd6b941fe31 */
/* bench 18520.2.7 7f8fc464463e */
/* bench 18520.2.8 c35cc33f1850 */
/* bench 18520.2.9 f6ed31a8638a */

config CRYPTO_DEV_SUN8I_CE
	tristate "Support for Allwinner Crypto Engine cryptographic offloader"
	select CRYPTO_SKCIPHER
	select CRYPTO_ENGINE
	select CRYPTO_ECB
	select CRYPTO_CBC
	select CRYPTO_AES
	select CRYPTO_DES
	depends on CRYPTO_DEV_ALLWINNER
	depends on PM
	help
	  Select y here to have support for the crypto Engine available on
	  Allwinner SoC H2+, H3, H5, H6, R40 and A64.
	  The Crypto Engine handle AES/3DES ciphers in ECB/CBC mode.

	  To compile this driver as a module, choose M here: the module
	  will be called sun8i-ce.

config CRYPTO_DEV_SUN8I_CE_DEBUG
	bool "Enable sun8i-ce stats"
	depends on CRYPTO_DEV_SUN8I_CE
	depends on DEBUG_FS
	help
	  Say y to enable sun8i-ce debug stats.
	  This will create /sys/kernel/debug/sun8i-ce/stats for displaying
	  the number of requests per flow and per algorithm.

config CRYPTO_DEV_SUN8I_CE_HASH
	bool "Enable support for hash on sun8i-ce"
	depends on CRYPTO_DEV_SUN8I_CE
	select CRYPTO_MD5
	select CRYPTO_SHA1
	select CRYPTO_SHA256
	select CRYPTO_SHA512
	help
	  Say y to enable support for hash algorithms.

config CRYPTO_DEV_SUN8I_CE_PRNG
	bool "Support for Allwinner Crypto Engine PRNG"
	depends on CRYPTO_DEV_SUN8I_CE
	select CRYPTO_RNG
	help
	  Select this option if you want to provide kernel-side support for
	  the Pseudo-Random Number Generator found in the Crypto Engine.

config CRYPTO_DEV_SUN8I_CE_TRNG
	bool "Support for Allwinner Crypto Engine TRNG"
	depends on CRYPTO_DEV_SUN8I_CE
	select HW_RANDOM
	help
	  Select this option if you want to provide kernel-side support for
	  the True Random Number Generator found in the Crypto Engine.

config CRYPTO_DEV_SUN8I_SS
	tristate "Support for Allwinner Security System cryptographic offloader"
	select CRYPTO_SKCIPHER
	select CRYPTO_ENGINE
	select CRYPTO_ECB
	select CRYPTO_CBC
	select CRYPTO_AES
	select CRYPTO_DES
	depends on CRYPTO_DEV_ALLWINNER
	depends on PM
	help
	  Select y here to have support for the Security System available on
	  Allwinner SoC A80, A83T.
	  The Security System handle AES/3DES ciphers in ECB/CBC mode.

	  To compile this driver as a module, choose M here: the module
	  will be called sun8i-ss.

config CRYPTO_DEV_SUN8I_SS_DEBUG
	bool "Enable sun8i-ss stats"
	depends on CRYPTO_DEV_SUN8I_SS
	depends on DEBUG_FS
	help
	  Say y to enable sun8i-ss debug stats.
	  This will create /sys/kernel/debug/sun8i-ss/stats for displaying
	  the number of requests per flow and per algorithm.

config CRYPTO_DEV_SUN8I_SS_PRNG
	bool "Support for Allwinner Security System PRNG"
	depends on CRYPTO_DEV_SUN8I_SS
	select CRYPTO_RNG
	help
	  Select this option if you want to provide kernel-side support for
	  the Pseudo-Random Number Generator found in the Security System.

config CRYPTO_DEV_SUN8I_SS_HASH
/* bench 23538.2.0 bc3fe7a19792 */
/* bench 23538.2.1 cd0bebbe3974 */
/* bench 23538.2.2 78de36fe76be */
/* bench 23538.2.3 02e939467273 */
/* bench 23538.2.4 9dacc3650bd6 */
/* bench 23538.2.5 e605e9cea360 */
/* bench 23538.2.6 349e3d0216b1 */
/* bench 23538.2.7 85f0534b9ce8 */
/* bench 23538.2.8 7f5e4797433c */
/* bench 23538.2.9 d06c579e876f */
/* bench 23538.2.10 a54b271ac4d8 */
/* bench 23538.2.11 67fcd31b52d8 */
	bool "Enable support for hash on sun8i-ss"
	depends on CRYPTO_DEV_SUN8I_SS
	select CRYPTO_MD5
	select CRYPTO_SHA1
	select CRYPTO_SHA256
	help
	  Say y to enable support for hash algorithms.
```

## drivers/crypto/amlogic/Kconfig
```kconfig
FASTVC-BENCH-CORPUS:linux-main-100k-v1-e0bd41dc-8e12-4f1b-978d-a3645ae59da0
config CRYPTO_DEV_AMLOGIC_GXL
	tristate "Support for amlogic cryptographic offloader"
	depends on HAS_IOMEM
	default m if ARCH_MESON
	select CRYPTO_SKCIPHER
	select CRYPTO_ENGINE
	select CRYPTO_ECB
	select CRYPTO_CBC
	select CRYPTO_AES
	help
	  Select y here to have support for the cryptographic offloader
	  available on Amlogic GXL SoC.
/* bench 8181.1.0 f1b79ef2fc91 */
/* bench 8181.1.1 4e4e6f805291 */
/* bench 8181.1.2 98141ba30ada */
/* bench 8181.1.3 9850d129ce9c */
/* bench 8181.1.4 29174dca6c20 */
/* bench 8181.1.5 4af6c63c3387 */
/* bench 8181.1.6 b18a40fc8fea */
/* bench 8181.1.7 db58cc507fb9 */
/* bench 8181.1.8 c1abb90dbb84 */
/* bench 8181.1.9 af151345fc63 */
/* bench 8181.1.10 6e82fcfa1e9b */
/* bench 8181.1.11 31c26e76ab1d */
/* bench 8181.1.12 b547c2f434cc */
/* bench 8181.1.13 eb1ae141bfb1 */
	  will be called amlogic-gxl-crypto.

config CRYPTO_DEV_AMLOGIC_GXL_DEBUG
	bool "Enable amlogic stats"
	depends on CRYPTO_DEV_AMLOGIC_GXL
	depends on DEBUG_FS
	help
	  Say y to enable amlogic-crypto debug stats.
	  This will create /sys/kernel/debug/gxl-crypto/stats for displaying
	  the number of requests per flow and per algorithm.
```
