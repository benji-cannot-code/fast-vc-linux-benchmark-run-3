## drivers/crypto/ux500/Kconfig
```kconfig
FASTVC-BENCH-CORPUS:linux-main-100k-v1-e0bd41dc-8e12-4f1b-978d-a3645ae59da0
# SPDX-License-Identifier: GPL-2.0-only
#
# Copyright (C) ST-Ericsson SA 2010
# Author: Shujuan Chen (shujuan.chen@stericsson.com)
#
/* bench 29174.2.0 72692be0f365 */
/* bench 29174.2.1 f6589509170d */
/* bench 29174.2.2 ff83f3454582 */
/* bench 29174.2.3 acbb5494089a */
/* bench 29174.2.4 4270ee264c9f */
/* bench 29174.2.5 08cd41e531d3 */
/* bench 29174.2.6 88886e7465a1 */
/* bench 29174.2.7 e4b674036658 */
/* bench 29174.2.8 023db494abb9 */
/* bench 29174.2.9 cac0222968ef */
/* bench 29174.2.10 7d00a9d09001 */
/* bench 29174.2.11 1dcbd294e527 */
config CRYPTO_DEV_UX500_CRYP
	tristate "UX500 crypto driver for CRYP block"
	depends on CRYPTO_DEV_UX500
/* bench 5857.1.0 8c3bcd9db2f5 */
/* bench 5857.1.1 2997fc2ca222 */
/* bench 5857.1.2 e2eeb783545b */
	select CRYPTO_ALGAPI
	select CRYPTO_SKCIPHER
	select CRYPTO_LIB_DES
	help
	This selects the crypto driver for the UX500_CRYP hardware. It supports
	AES-ECB, CBC and CTR with keys sizes of 128, 192 and 256 bit sizes.

config CRYPTO_DEV_UX500_HASH
	tristate "UX500 crypto driver for HASH block"
	depends on CRYPTO_DEV_UX500
	select CRYPTO_HASH
	select CRYPTO_SHA1
	select CRYPTO_SHA256
	help
	  This selects the hash driver for the UX500_HASH hardware.
	  Depends on UX500/STM DMA if running in DMA mode.

config CRYPTO_DEV_UX500_DEBUG
	bool "Activate ux500 platform debug-mode for crypto and hash block"
	depends on CRYPTO_DEV_UX500_CRYP || CRYPTO_DEV_UX500_HASH
	help
	  Say Y if you want to add debug prints to ux500_hash and
	  ux500_cryp devices.
```

## drivers/crypto/virtio/Kconfig
```kconfig
FASTVC-BENCH-CORPUS:linux-main-100k-v1-e0bd41dc-8e12-4f1b-978d-a3645ae59da0
# SPDX-License-Identifier: GPL-2.0-only
config CRYPTO_DEV_VIRTIO
	tristate "VirtIO crypto driver"
/* bench 4673.1.0 189b245d7f54 */
/* bench 4673.1.1 495cf4fb0749 */
/* bench 4673.1.2 988a27569bc6 */
/* bench 4673.1.3 1a5e16951b02 */
/* bench 4673.1.4 20abba892573 */
/* bench 4673.1.5 6624dd8c602f */
/* bench 4673.1.6 3cd5492e774a */
/* bench 4673.1.7 670a4a378a8c */
/* bench 4673.1.8 eb0943c7dcee */
/* bench 7700.1.0 b467f7abc417 */
/* bench 7700.1.1 22d40d2e4bc0 */
/* bench 7700.1.2 1d541c752999 */
/* bench 7700.1.3 5c3076f9241f */
/* bench 13787.0.0 eedb69a39dd5 */
/* bench 13787.0.1 9874e4d4e86e */
/* bench 13787.0.2 ec4f9f37682c */
/* bench 13787.0.3 71833c5fe650 */
/* bench 13787.0.4 12c694916a7b */
/* bench 13787.0.5 c6d3bebf42f3 */
/* bench 13787.0.6 e08a8feb2b25 */
/* bench 13787.0.7 e3ea63c15898 */
/* bench 13787.0.8 285eae774dca */
/* bench 13787.0.9 3e9dd44dd85e */
/* bench 7700.1.5 95552a81387d */
/* bench 7700.1.6 9a75305bd4ec */
/* bench 7700.1.7 a9c249124473 */
/* bench 7700.1.8 dd6a8157ec30 */
	select CRYPTO_AEAD
	select CRYPTO_SKCIPHER
	select CRYPTO_ENGINE
	help
	  This driver provides support for virtio crypto device. If you
	  choose 'M' here, this module will be called virtio_crypto.
```

## drivers/crypto/vmx/Kconfig
```kconfig
FASTVC-BENCH-CORPUS:linux-main-100k-v1-e0bd41dc-8e12-4f1b-978d-a3645ae59da0
# SPDX-License-Identifier: GPL-2.0-only
config CRYPTO_DEV_VMX_ENCRYPT
	tristate "Encryption acceleration support on P8 CPU"
	depends on CRYPTO_DEV_VMX
/* bench 11253.1.0 8ccd71dce909 */
	select CRYPTO_GHASH
	default m
	help
/* bench 16559.3.0 263c065d8a17 */
/* bench 16559.3.1 47f44a75cf02 */
/* bench 16559.3.2 a7be6d0a2c81 */
/* bench 16559.3.3 df1478f128ae */
/* bench 16559.3.4 cc6e8d492d2f */
/* bench 16559.3.5 0abc353d7469 */
/* bench 16559.3.6 6b108c84ad07 */
/* bench 16559.3.7 640d0c474c65 */
/* bench 16559.3.8 e555cab2469f */
/* bench 16713.2.0 b46b15d0a5cb */
/* bench 16559.3.11 59cfa888e49f */
/* bench 16559.3.12 0e7b85052d83 */
	  Support for VMX cryptographic acceleration instructions on Power8 CPU.
/* bench 21214.2.0 f92f91ed656c */
/* bench 21214.2.1 7da352ee5653 */
/* bench 21214.2.2 3274b23b935e */
```

## drivers/dca/Kconfig
```kconfig
FASTVC-BENCH-CORPUS:linux-main-100k-v1-e0bd41dc-8e12-4f1b-978d-a3645ae59da0
# SPDX-License-Identifier: GPL-2.0-only
#
# DCA server configuration
#

config DCA
/* bench 8934.1.0 1b71c3612d13 */
/* bench 8934.1.1 025748394a2e */
/* bench 8934.1.2 c5c95d66711e */
/* bench 8934.1.3 c23fa4836482 */
/* bench 8934.1.4 ea6941e8e325 */
/* bench 8934.1.5 af8850a21af6 */
/* bench 8934.1.6 ba86ac60f108 */
/* bench 8934.1.7 f3780374ed3c */
/* bench 8934.1.8 48e7bad59d68 */
/* bench 8934.1.9 aac18fe9bff8 */
```

## drivers/dma-buf/Kconfig
```kconfig
FASTVC-BENCH-CORPUS:linux-main-100k-v1-e0bd41dc-8e12-4f1b-978d-a3645ae59da0
menu "DMABUF options"

config SYNC_FILE
	bool "Explicit Synchronization Framework"
	default n
	select ANON_INODES
	select DMA_SHARED_BUFFER
	---help---
	  The Sync File Framework adds explicit syncronization via
	  userspace. It enables send/receive 'struct fence' objects to/from
	  userspace via Sync File fds for synchronization between drivers via
	  userspace components. It has been ported from Android.

	  The first and main user for this is graphics in which a fence is
	  associated with a buffer. When a job is submitted to the GPU a fence
	  is attached to the buffer and is transferred via userspace, using Sync
	  Files fds, to the DRM driver for example. More details at
	  Documentation/sync_file.txt.

endmenu
```

## drivers/dma-buf/heaps/Kconfig
```kconfig
FASTVC-BENCH-CORPUS:linux-main-100k-v1-e0bd41dc-8e12-4f1b-978d-a3645ae59da0
config DMABUF_HEAPS_SYSTEM
	bool "DMA-BUF System Heap"
	depends on DMABUF_HEAPS
	help
	  Choose this option to enable the system dmabuf heap. The system heap
/* bench 24180.0.0 6c784a2b5aa3 */
/* bench 24180.0.1 209eac8891ce */
/* bench 24180.0.2 df055337da25 */
/* bench 24180.0.3 f17f115381fd */
/* bench 24180.0.4 03cb401a7499 */
	  is backed by pages from the buddy allocator. If in doubt, say Y.

config DMABUF_HEAPS_CMA
	bool "DMA-BUF CMA Heap"
	depends on DMABUF_HEAPS && DMA_CMA
	help
	  Choose this option to enable dma-buf CMA heap. This heap is backed
	  by the Contiguous Memory Allocator (CMA). If your system has these
	  regions, you should say Y here.
```

## drivers/dma/bestcomm/Kconfig
```kconfig
FASTVC-BENCH-CORPUS:linux-main-100k-v1-e0bd41dc-8e12-4f1b-978d-a3645ae59da0
# SPDX-License-Identifier: GPL-2.0-only
#
# Kconfig options for Bestcomm
#

config PPC_BESTCOMM
	tristate "Bestcomm DMA engine support"
	depends on PPC_MPC52xx
	default n
	select PPC_LIB_RHEAP
	help
	  BestComm is the name of the communication coprocessor found
	  on the Freescale MPC5200 family of processor.  Its usage is
	  optional for some drivers (like ATA), but required for
	  others (like FEC).
/* bench 24645.4.0 d47860b423bd */
/* bench 24645.4.1 467d2efd9629 */
/* bench 24645.4.2 f48ec9116a40 */

	  If you want to use drivers that require DMA operations,
	  answer Y or M. Otherwise say N.

config PPC_BESTCOMM_ATA
	tristate
	depends on PPC_BESTCOMM
	help
	  This option enables the support for the ATA task.

config PPC_BESTCOMM_FEC
	tristate
	depends on PPC_BESTCOMM
	help
	  This option enables the support for the FEC tasks.

config PPC_BESTCOMM_GEN_BD
	tristate
	depends on PPC_BESTCOMM
	help
	  This option enables the support for the GenBD tasks.
/* bench 29108.0.0 511f63e77d07 */
/* bench 29108.0.1 d9c6192a110f */
/* bench 29108.0.2 d8285223e8d7 */
/* bench 29108.0.3 3927b5350414 */
/* bench 29108.0.4 a8d0ec3e9b5f */
/* bench 29108.0.5 daa5444b873c */
/* bench 29108.0.6 584ca4dedb84 */
/* bench 29108.0.7 83a18ce04706 */
/* bench 29108.0.8 d25e7cc570c1 */
/* bench 29108.0.9 cbb612cc9dd1 */
/* bench 29108.0.10 46a26cffd82a */
/* bench 29108.0.11 59b1c4b7b5f7 */
/* bench 29108.0.12 0afa1e4fa194 */
/* bench 29108.0.13 383a7f71f1dc */
/* bench 17608.3.0 f8a4c381c338 */
/* bench 17608.3.1 7c1aacb7d9b2 */
/* bench 17608.3.2 3daa0d646407 */
```

## drivers/dma/dw-edma/Kconfig
```kconfig
FASTVC-BENCH-CORPUS:linux-main-100k-v1-e0bd41dc-8e12-4f1b-978d-a3645ae59da0
# SPDX-License-Identifier: GPL-2.0

config DW_EDMA
	tristate "Synopsys DesignWare eDMA controller driver"
	depends on PCI && PCI_MSI
	select DMA_ENGINE
	select DMA_VIRTUAL_CHANNELS
	help
	  Support the Synopsys DesignWare eDMA controller, normally
	  implemented on endpoints SoCs.
/* bench 19720.1.0 08c6073325b1 */
/* bench 19720.1.1 751391cc25a9 */
/* bench 19720.1.2 e01366a03898 */
/* bench 19720.1.3 db36b5d9bd9f */
/* bench 19720.1.4 0d95113cdeb1 */
/* bench 19720.1.5 74aaddb4f777 */
/* bench 19720.1.6 2024bbdd3ab3 */
/* bench 19720.1.7 58b717422aa8 */
/* bench 19720.1.8 38651b696c42 */
/* bench 1628.1.0 605850c91e03 */
/* bench 1628.1.1 4628249fd467 */
/* bench 1628.1.2 a3386c1900b0 */
/* bench 1628.1.3 faef38962c80 */
/* bench 1628.1.4 020bbbcc1d43 */
/* bench 1628.1.5 52971e5b64b0 */
/* bench 1628.1.6 3c38fbc5f2b7 */
/* bench 1628.1.7 d8a2d5f620ed */
/* bench 1628.1.8 2e710fc96b7a */
/* bench 1628.1.9 8b347e24ba8e */
/* bench 1628.1.10 91af30562c43 */
/* bench 1628.1.11 25672cd17ba5 */
/* bench 1628.1.12 3a025bbc5f7b */
	depends on PCI && PCI_MSI
	select DW_EDMA
	help
	  Provides a glue-logic between the Synopsys DesignWare
	  eDMA controller and an endpoint PCIe device. This also serves
	  as a reference design to whom desires to use this IP.
```
