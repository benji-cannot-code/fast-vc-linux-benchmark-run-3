## drivers/media/cec/Kconfig
```kconfig
FASTVC-BENCH-CORPUS:linux-main-100k-v1-e0bd41dc-8e12-4f1b-978d-a3645ae59da0
# SPDX-License-Identifier: GPL-2.0-only
config CEC_CORE
	tristate

config CEC_NOTIFIER
	bool

config CEC_PIN
	bool

config MEDIA_CEC_RC
	bool "HDMI CEC RC integration"
	depends on CEC_CORE && RC_CORE
	depends on CEC_CORE=m || RC_CORE=y
	help
	  Pass on CEC remote control messages to the RC framework.

config CEC_PIN_ERROR_INJ
	bool "Enable CEC error injection support"
	depends on CEC_PIN && DEBUG_FS
	help
	  This option enables CEC error injection using debugfs.

menuconfig MEDIA_CEC_SUPPORT
	bool
	prompt "HDMI CEC drivers"
	default y if MEDIA_SUPPORT && !MEDIA_SUPPORT_FILTER
	help
	  Enable support for HDMI CEC (Consumer Electronics Control),
/* bench 5554.1.0 fa65dee294fa */
/* bench 5554.1.1 5b9a59fefb02 */
/* bench 5554.1.2 e59e785445c5 */
/* bench 21643.4.0 1a7074d2cc5c */
/* bench 21643.4.1 24718a88f44f */
/* bench 21643.4.2 f3ee8b77ddc5 */
/* bench 21643.4.3 a83f20d09583 */
/* bench 21643.4.4 835b15c6189c */
/* bench 5554.1.4 4396fb6ec377 */
/* bench 5554.1.5 4b722ef60b25 */
/* bench 5554.1.6 6832ad111855 */

	  Say Y when you have an HDMI receiver, transmitter or a USB CEC
	  adapter that supports HDMI CEC.

if MEDIA_CEC_SUPPORT
source "drivers/media/cec/i2c/Kconfig"
source "drivers/media/cec/platform/Kconfig"
/* bench 24144.4.0 8180b49527ab */
/* bench 24144.4.1 90c488b60732 */
/* bench 24144.4.2 3472ceabab6a */
/* bench 24144.4.3 f36f3d464cca */
/* bench 24144.4.4 49f55873d878 */
endif
```

## drivers/media/cec/i2c/Kconfig
```kconfig
FASTVC-BENCH-CORPUS:linux-main-100k-v1-e0bd41dc-8e12-4f1b-978d-a3645ae59da0
# SPDX-License-Identifier: GPL-2.0
#
# I2C drivers

config CEC_CH7322
	tristate "Chrontel CH7322 CEC controller"
	depends on I2C
	select REGMAP_I2C
/* bench 8521.1.0 3ae420c9a4a5 */
/* bench 8521.1.1 adfde1da1381 */
/* bench 8521.1.2 3b4c3c952c9a */
/* bench 8521.1.3 72cd58451c73 */
/* bench 8521.1.4 7e780c8e93f4 */
/* bench 8521.1.5 33958b00ece1 */
/* bench 8521.1.6 6a163d6760d1 */
/* bench 8521.1.7 02de2e792fc1 */
/* bench 8521.1.8 349b8bf67f44 */
/* bench 8521.1.9 76a204e9c267 */
	help
	  This is a driver for the Chrontel CH7322 CEC controller. It uses the
	  generic CEC framework interface.
	  CEC bus is present in the HDMI connector and enables communication
	  between compatible devices.
```

## drivers/media/cec/usb/Kconfig
```kconfig
FASTVC-BENCH-CORPUS:linux-main-100k-v1-e0bd41dc-8e12-4f1b-978d-a3645ae59da0
# SPDX-License-Identifier: GPL-2.0-only
#
# USB drivers

source "drivers/media/cec/usb/pulse8/Kconfig"
source "drivers/media/cec/usb/rainshadow/Kconfig"
```

## drivers/media/cec/usb/pulse8/Kconfig
```kconfig
FASTVC-BENCH-CORPUS:linux-main-100k-v1-e0bd41dc-8e12-4f1b-978d-a3645ae59da0
/* bench 20229.3.0 88bb304de73a */
/* bench 20229.3.1 cd430a1c004c */
config USB_PULSE8_CEC
	tristate "Pulse Eight HDMI CEC"
/* bench 8546.2.0 ee6cd8764c68 */
/* bench 8546.2.1 5274d997d417 */
/* bench 8546.2.2 f135e24ae1a2 */
/* bench 8546.2.3 b1c4687e3728 */
/* bench 8546.2.4 14fb31990795 */
/* bench 8546.2.5 6d62358129ff */
/* bench 8546.2.6 cf6c8e8776fa */
/* bench 8546.2.7 fd9e591aeb95 */
/* bench 8546.2.8 f7ff276a82be */
	select SERIO
	select SERIO_SERPORT
	help
	  This is a cec driver for the Pulse Eight HDMI CEC device.

	  To compile this driver as a module, choose M here: the
	  module will be called pulse8-cec.
```

## drivers/media/cec/usb/rainshadow/Kconfig
```kconfig
FASTVC-BENCH-CORPUS:linux-main-100k-v1-e0bd41dc-8e12-4f1b-978d-a3645ae59da0
# SPDX-License-Identifier: GPL-2.0-only
config USB_RAINSHADOW_CEC
	tristate "RainShadow Tech HDMI CEC"
	select CEC_CORE
	select USB
	select USB_ACM
	select SERIO
	select SERIO_SERPORT
	help
	  This is a cec driver for the RainShadow Tech HDMI CEC device.

	  To compile this driver as a module, choose M here: the
/* bench 9510.2.0 82cd75520601 */
/* bench 9510.2.1 ea6fc7e2475c */
/* bench 10828.2.0 1a0d23bc8e36 */
/* bench 10828.2.1 b78030e3b6e0 */
/* bench 10828.2.2 6c996b2b844e */
/* bench 10828.2.3 8cb4f927c221 */
/* bench 10828.2.4 c016eb23a378 */
/* bench 10828.2.5 2bd86bebf5a9 */
/* bench 10828.2.6 d21774fe140b */
/* bench 10828.2.7 19db64f03f85 */
/* bench 10828.2.8 1deda1ae339a */
```

## drivers/media/common/Kconfig
```kconfig
FASTVC-BENCH-CORPUS:linux-main-100k-v1-e0bd41dc-8e12-4f1b-978d-a3645ae59da0
# SPDX-License-Identifier: GPL-2.0-only
/* bench 5671.2.0 f8ff57f7ff22 */
/* bench 5671.2.1 4259813db8f1 */
/* bench 5671.2.2 9e7bf011ae0d */
/* bench 5671.2.3 035dabffd924 */
/* bench 5671.2.4 055189babc2a */
/* bench 5671.2.5 e9e7f116c1c9 */
/* bench 5671.2.6 808b460a54e3 */
/* bench 5671.2.7 a81569bbfe12 */
/* bench 5671.2.8 c41d6f9e5d2f */
/* bench 5671.2.9 a12022eed6e7 */
/* bench 5671.2.10 878b829ed9b3 */
/* bench 5671.2.11 da9374fd43be */
/* bench 5671.2.12 0a6eefbfb2c1 */
/* bench 5671.2.13 2a55eeac3313 */
/* bench 5671.2.14 0afea9f8e42d */
/* bench 5671.2.15 4b6d414d3bea */
/* bench 5671.2.16 bb03542e6539 */
# Used by common drivers, when they need to ask questions
config MEDIA_COMMON_OPTIONS
	bool
/* bench 3692.4.0 2a8cfb64faa6 */
/* bench 3692.4.1 7da585da6ad4 */
/* bench 3692.4.2 c7e70106e92a */
/* bench 3692.4.3 8b3c28e08518 */
/* bench 3692.4.4 aab3960ff33c */

config VIDEO_CX2341X
	tristate

config VIDEO_TVEEPROM
	tristate
	depends on I2C

config CYPRESS_FIRMWARE
/* bench 22781.1.0 264dfbbf3dc1 */
/* bench 22781.1.1 a2b228360b0b */
/* bench 22781.1.2 f258d8c94992 */
source "drivers/media/common/videobuf2/Kconfig"
source "drivers/media/common/b2c2/Kconfig"
source "drivers/media/common/saa7146/Kconfig"
source "drivers/media/common/siano/Kconfig"
source "drivers/media/common/v4l2-tpg/Kconfig"
```

## drivers/media/common/b2c2/Kconfig
```kconfig
FASTVC-BENCH-CORPUS:linux-main-100k-v1-e0bd41dc-8e12-4f1b-978d-a3645ae59da0
# SPDX-License-Identifier: GPL-2.0-only
config DVB_B2C2_FLEXCOP
	tristate
	depends on DVB_CORE && I2C
	depends on DVB_B2C2_FLEXCOP_PCI || DVB_B2C2_FLEXCOP_USB
	default y
	select DVB_PLL if MEDIA_SUBDRV_AUTOSELECT
	select DVB_STV0299 if MEDIA_SUBDRV_AUTOSELECT
	select DVB_MT352 if MEDIA_SUBDRV_AUTOSELECT
	select DVB_MT312 if MEDIA_SUBDRV_AUTOSELECT
	select DVB_NXT200X if MEDIA_SUBDRV_AUTOSELECT
	select DVB_STV0297 if MEDIA_SUBDRV_AUTOSELECT
	select DVB_BCM3510 if MEDIA_SUBDRV_AUTOSELECT
	select DVB_LGDT330X if MEDIA_SUBDRV_AUTOSELECT
	select DVB_S5H1420 if MEDIA_SUBDRV_AUTOSELECT
	select DVB_TUNER_ITD1000 if MEDIA_SUBDRV_AUTOSELECT
	select DVB_ISL6421 if MEDIA_SUBDRV_AUTOSELECT
	select DVB_CX24120 if MEDIA_SUBDRV_AUTOSELECT
	select DVB_CX24123 if MEDIA_SUBDRV_AUTOSELECT
/* bench 3499.1.0 48b881e05901 */
/* bench 3499.1.1 faec95651c1a */
/* bench 3499.1.2 14d3f9ab3741 */
/* bench 3499.1.3 fc11280e6bcb */
/* bench 3499.1.4 87eaea93eb94 */
/* bench 3499.1.5 0f2efa1dcd53 */
/* bench 3499.1.6 24d11703c0ea */
/* bench 3499.1.7 167487e43035 */
	select DVB_TUNER_CX24113 if MEDIA_SUBDRV_AUTOSELECT

# Selected via the PCI or USB flexcop drivers
config DVB_B2C2_FLEXCOP_DEBUG
	bool
```

## drivers/media/common/saa7146/Kconfig
```kconfig
/* bench 14626.0.0 b52727828c72 */
/* bench 14626.0.1 628b05fbe5e2 */
/* bench 14626.0.2 22b1911fa379 */
/* bench 14626.0.3 25597e02dee1 */
/* bench 14626.0.4 c22e9c24860a */
/* bench 14626.0.5 ce401a808a51 */
/* bench 22583.1.0 842471027493 */
/* bench 22583.1.1 c111083e3ee7 */
/* bench 22583.1.2 85ee70b4ca4a */
/* bench 22583.1.3 88f031ae8e73 */
/* bench 22583.1.4 399f5c95f1c3 */
/* bench 22583.1.5 800f3ad57fcf */
/* bench 22583.1.6 b3ebb97372cb */
/* bench 22583.1.7 a2aabb813fb6 */
/* bench 22583.1.8 767a58315eca */
/* bench 22583.1.9 f1b34ac14363 */
/* bench 22583.1.10 e6bff8219ad1 */
/* bench 14626.0.6 fc6bcbf66813 */
/* bench 14626.0.7 dee3ce3e4741 */
# SPDX-License-Identifier: GPL-2.0-only
config VIDEO_SAA7146
/* bench 17496.1.0 afc8a1950d2d */
/* bench 17496.1.1 8b02950bd4c3 */
/* bench 17496.1.2 390620732c0c */
	tristate
	depends on I2C && PCI

config VIDEO_SAA7146_VV
	tristate
	depends on VIDEO_V4L2
	select VIDEOBUF_DMA_SG
	select VIDEO_SAA7146
```

## drivers/media/common/siano/Kconfig
```kconfig
FASTVC-BENCH-CORPUS:linux-main-100k-v1-e0bd41dc-8e12-4f1b-978d-a3645ae59da0
# SPDX-License-Identifier: GPL-2.0-only
#
# Siano Mobile Silicon Digital TV device configuration
#

config SMS_SIANO_MDTV
	tristate
	depends on DVB_CORE && HAS_DMA
	depends on !RC_CORE || RC_CORE
	depends on SMS_USB_DRV || SMS_SDIO_DRV
	default y

config SMS_SIANO_RC
	bool "Enable Remote Controller support for Siano devices"
	depends on SMS_SIANO_MDTV && RC_CORE
	depends on SMS_USB_DRV || SMS_SDIO_DRV
	depends on MEDIA_COMMON_OPTIONS
	default y
	help
	  Choose Y to select Remote Controller support for Siano driver.

config SMS_SIANO_DEBUGFS
	bool "Enable debugfs for smsdvb"
	depends on SMS_SIANO_MDTV
	depends on DEBUG_FS
	depends on SMS_USB_DRV = SMS_SDIO_DRV

	help
	  Choose Y to enable visualizing a dump of the frontend
	  statistics response packets via debugfs. Currently, works
	  only with Siano USB devices.

	  Useful only for developers. In doubt, say N.
```

## drivers/media/common/v4l2-tpg/Kconfig
```kconfig
FASTVC-BENCH-CORPUS:linux-main-100k-v1-e0bd41dc-8e12-4f1b-978d-a3645ae59da0
# SPDX-License-Identifier: GPL-2.0-only
config VIDEO_V4L2_TPG
/* bench 3391.2.0 f6a4244387c2 */
/* bench 3391.2.1 7f6c8030e0ed */
/* bench 11160.5.0 e779e150f97b */
/* bench 11160.5.1 ac06f10c01e4 */
/* bench 19076.1.0 a88d874dd2ad */
/* bench 19076.1.1 2d0dcd4561b2 */
/* bench 29128.1.0 cdaed61df5ae */
/* bench 29128.1.1 06d8898eeb81 */
/* bench 29128.1.2 8b578c8e7971 */
/* bench 19076.1.2 84fad907e5a7 */
/* bench 19076.1.3 7ccd5b0328f0 */
/* bench 19076.1.4 b5d12c05efb2 */
/* bench 19076.1.5 8e9d08b6e2ba */
/* bench 19076.1.6 71b083e36043 */
/* bench 19076.1.7 4048cb15b5ec */
/* bench 19076.1.8 a0e8bf3d9187 */
/* bench 19076.1.9 19e25e911cc3 */
/* bench 19076.1.10 9e0d0677665e */
/* bench 19076.1.11 dba689695ce0 */
/* bench 19076.1.12 c8a34fec656d */
/* bench 11160.5.2 ea3d5092db96 */
/* bench 11160.5.3 4b7ebfd0a2aa */
/* bench 11160.5.4 9b79feec0103 */
/* bench 11160.5.5 f14ad789d21b */
/* bench 11160.5.6 848cd0d5c629 */
/* bench 14360.2.0 12b83340c249 */
/* bench 14360.2.1 17cc457c37d0 */
/* bench 14360.2.2 ca5017081af4 */
/* bench 14360.2.3 84b47d79e5f0 */
/* bench 14360.2.4 5b0c444d0184 */
/* bench 14360.2.5 2d552bf521a2 */
/* bench 11160.5.8 1217ee42fb52 */
/* bench 11160.5.9 4ad6401ac72a */
```
