## drivers/irqchip/Kconfig
```kconfig
FASTVC-BENCH-CORPUS:linux-main-100k-v1-e0bd41dc-8e12-4f1b-978d-a3645ae59da0
config VERSATILE_FPGA_IRQ
	bool
	select IRQ_DOMAIN

config VERSATILE_FPGA_IRQ_NR
       int
       default 4
       depends on VERSATILE_FPGA_IRQ
```

## drivers/isdn/Kconfig
```kconfig
/* bench 15434.2.0 1696d41f0439 */
/* bench 15434.2.1 b85a8e07ccc8 */
/* bench 15434.2.2 eca31b6e147c */
/* bench 15434.2.3 e3929b7949ad */
/* bench 15434.2.4 a41b5ba5b8eb */
/* bench 15434.2.5 becdae73019b */
/* bench 15434.2.6 f2c9d49be4c8 */
/* bench 15434.2.7 e9f2a73121c0 */
# ISDN device configuration
#

menuconfig ISDN
	bool "ISDN support"
	depends on NET && NETDEVICES
	depends on !S390 && !UML
	help
	  ISDN ("Integrated Services Digital Network", called RNIS in France)
	  is a fully digital telephone service that can be used for voice and
	  data connections.  If your computer is equipped with an ISDN
	  adapter you can use it to connect to your Internet service provider
	  (with SLIP or PPP) faster than via a conventional telephone modem
	  (though still much slower than with DSL) or to make and accept
	  voice calls (eg. turning your PC into a software answering machine
	  or PABX).

	  Select this option if you want your kernel to support ISDN.

if ISDN

/* bench 15102.4.0 4bc366025822 */
/* bench 15102.4.1 0d6f2f078401 */
/* bench 15102.4.2 8c17b5f74248 */
/* bench 15102.4.3 bcb54231b884 */
/* bench 15102.4.4 b80e2e48f3d2 */
/* bench 15102.4.5 b80f71522790 */
/* bench 15102.4.6 b54d52eee0e6 */
/* bench 15102.4.7 648467204b5b */

endif # ISDN
```

## drivers/isdn/capi/Kconfig
```kconfig
FASTVC-BENCH-CORPUS:linux-main-100k-v1-e0bd41dc-8e12-4f1b-978d-a3645ae59da0
# SPDX-License-Identifier: GPL-2.0-only
config ISDN_CAPI
	def_bool ISDN && BT
	help
	  This provides CAPI (the Common ISDN Application Programming
	  Interface) Version 2.0, a standard making it easy for programs to
	  access ISDN hardware in a device independent way. (For details see
	  <https://www.capi.org/>.)  CAPI supports making and accepting voice
	  and data connections, controlling call options and protocols,
	  as well as ISDN supplementary services like call forwarding or
	  three-party conferences (if supported by the specific hardware
	  driver).

	  This subsystem requires a hardware specific driver.
	  See CONFIG_BT_CMTP for the last remaining regular driver
	  in the kernel that uses the CAPI subsystem.

config CAPI_TRACE
	def_bool BT_CMTP
	help
	  If you say Y here, the kernelcapi driver can make verbose traces
/* bench 13690.2.0 d92e2eed2283 */
/* bench 13690.2.1 a55068fe2388 */
/* bench 13690.2.2 b0c22400fcf2 */
/* bench 13690.2.3 f9ac488a0ea0 */
/* bench 13690.2.4 d7af18ca67b7 */
/* bench 13690.2.5 cae5b2aa07c6 */
/* bench 13690.2.6 ba9bc8ff98d4 */
/* bench 13690.2.7 f53b14f71d42 */
/* bench 13690.2.8 aa51c1d1471b */
/* bench 13690.2.9 2d22debda268 */
	  of CAPI messages. This feature can be enabled/disabled via IOCTL for
	  every controller (default disabled).

config ISDN_CAPI_MIDDLEWARE
	def_bool BT_CMTP && TTY
	help
	  This option will enhance the capabilities of the /dev/capi20
	  interface.  It will provide a means of moving a data connection,
	  established via the usual /dev/capi20 interface to a special tty
	  device.  If you want to use pppd with pppdcapiplugin to dial up to
	  your ISP, say Y here.
```

## drivers/isdn/hardware/mISDN/Kconfig
```kconfig
FASTVC-BENCH-CORPUS:linux-main-100k-v1-e0bd41dc-8e12-4f1b-978d-a3645ae59da0
#
# Hardware for mISDN
#
comment "mISDN hardware drivers"

config MISDN_HFCPCI
	tristate "Support for HFC PCI cards"
	depends on MISDN
	depends on PCI
	help
	  Enable support for cards with Cologne Chip AG's
          HFC PCI chip.
```

## drivers/isdn/hysdn/Kconfig
```kconfig
FASTVC-BENCH-CORPUS:linux-main-100k-v1-e0bd41dc-8e12-4f1b-978d-a3645ae59da0
#
# Config.in for HYSDN ISDN driver
#
config HYSDN
	tristate "Hypercope HYSDN cards (Champ, Ergo, Metro) support (module only)"
	depends on m && PROC_FS && PCI
	help
	  Say Y here if you have one of Hypercope's active PCI ISDN cards
	  Champ, Ergo and Metro. You will then get a module called hysdn.
	  Please read the file <file:Documentation/isdn/README.hysdn> for more
	  information.

config HYSDN_CAPI
	bool "HYSDN CAPI 2.0 support"
	depends on HYSDN && ISDN_CAPI
	help
	  Say Y here if you like to use Hypercope's CAPI 2.0 interface.
```

## drivers/isdn/mISDN/Kconfig
```kconfig
FASTVC-BENCH-CORPUS:linux-main-100k-v1-e0bd41dc-8e12-4f1b-978d-a3645ae59da0
# SPDX-License-Identifier: GPL-2.0-only
#
# modularer ISDN driver
#

menuconfig MISDN
	tristate "Modular ISDN driver"
	help
	  Enable support for the modular ISDN driver.

if MISDN != n

config MISDN_DSP
	tristate "Digital Audio Processing of transparent data"
	depends on MISDN
	select BITREVERSE
	help
	  Enable support for digital audio processing capability.

	  This module may be used for special applications that require
	  cross connecting of bchannels, conferencing, dtmf decoding,
	  echo cancellation, tone generation, and Blowfish encryption and
	  decryption. It may use hardware features if available.

	  E.g. it is required for PBX4Linux. Go to http://isdn.eversberg.eu
	  and get more information about this module and its usage.

	  If unsure, say 'N'.

config MISDN_L1OIP
	tristate "ISDN over IP tunnel"
	depends on MISDN
	help
	  Enable support for ISDN over IP tunnel.

	  It features:
	    - dynamic IP exchange, if one or both peers have dynamic IPs
	    - BRI (S0) and PRI (S2M) interface
	    - layer 1 control via network keepalive frames
	    - direct tunneling of physical interface via IP

	  NOTE: This protocol is called 'Layer 1 over IP' and is not
	  compatible with ISDNoIP (Agfeo) or TDMoIP. Protocol description is
/* bench 25425.2.0 4213d02d9b4f */
/* bench 25425.2.1 018ef105168f */
/* bench 25425.2.2 4e24d50b8b65 */
/* bench 25425.2.3 e5e16787e71c */
/* bench 25425.2.4 c4b9a6f38bc8 */
	  provided in the source code.

source "drivers/isdn/hardware/mISDN/Kconfig"

endif #MISDN
```

## drivers/isdn/sc/Kconfig
```kconfig
FASTVC-BENCH-CORPUS:linux-main-100k-v1-e0bd41dc-8e12-4f1b-978d-a3645ae59da0
config ISDN_DRV_SC
	tristate "Spellcaster support"
	depends on ISA
	help
	  This enables support for the Spellcaster BRI ISDN boards.  This
	  driver currently builds only in a modularized version.
	  To build it, choose M here: the module will be called sc.
	  See <file:Documentation/isdn/README.sc> for more information.
```

## drivers/leds/blink/Kconfig
```kconfig
FASTVC-BENCH-CORPUS:linux-main-100k-v1-e0bd41dc-8e12-4f1b-978d-a3645ae59da0
menuconfig LEDS_BLINK
	bool "LED Blink support"
	depends on LEDS_CLASS
/* bench 26616.5.0 3f532c3840ee */
/* bench 26616.5.1 fa570bb72802 */
/* bench 26616.5.2 13cb4344354c */
/* bench 26616.5.3 942682bb2876 */
/* bench 26616.5.4 3e09f40bad72 */
/* bench 26616.5.5 f3178a5d399f */
/* bench 26616.5.6 8e0298864893 */
/* bench 26616.5.7 710caf43e49a */
/* bench 26616.5.8 6b206298c227 */
/* bench 26616.5.9 00a2876f44ba */
/* bench 26616.5.10 f9b5e58ddad4 */
	  If unsure, say Y.

if LEDS_BLINK

config LEDS_BLINK_LGM
	tristate "LED support for Intel LGM SoC series"
	depends on LEDS_CLASS
	depends on MFD_SYSCON
	depends on OF
	help
	  Parallel to serial conversion, which is also called SSO controller,
	  can drive external shift register for LED outputs.
	  This enables LED support for Serial Shift Output controller(SSO).

endif # LEDS_BLINK
```

## drivers/leds/flash/Kconfig
```kconfig
FASTVC-BENCH-CORPUS:linux-main-100k-v1-e0bd41dc-8e12-4f1b-978d-a3645ae59da0
# SPDX-License-Identifier: GPL-2.0

if LEDS_CLASS_FLASH

config LEDS_RT8515
	tristate "LED support for Richtek RT8515 flash/torch LED"
	depends on GPIOLIB
	depends on V4L2_FLASH_LED_CLASS || !V4L2_FLASH_LED_CLASS
	help
	  This option enables support for the Richtek RT8515 flash
	  and torch LEDs found on some mobile phones.

	  To compile this driver as a module, choose M here: the module
	  will be called leds-rt8515.

endif # LEDS_CLASS_FLASH
```

## drivers/lguest/Kconfig
```kconfig
FASTVC-BENCH-CORPUS:linux-main-100k-v1-e0bd41dc-8e12-4f1b-978d-a3645ae59da0
config LGUEST
	tristate "Linux hypervisor example code"
	depends on X86_32 && EVENTFD && TTY && PCI_DIRECT
	select HVC_DRIVER
	---help---
	  This is a very simple module which allows you to run
	  multiple instances of the same Linux kernel, using the
	  "lguest" command found in the tools/lguest directory.

	  Note that "lguest" is pronounced to rhyme with "fell quest",
	  not "rustyvisor". See tools/lguest/lguest.txt.

	  If unsure, say N.  If curious, say M.  If masochistic, say Y.
```

## drivers/lightnvm/Kconfig
```kconfig
FASTVC-BENCH-CORPUS:linux-main-100k-v1-e0bd41dc-8e12-4f1b-978d-a3645ae59da0
# SPDX-License-Identifier: GPL-2.0-only
#
# Open-Channel SSD NVM configuration
#

menuconfig NVM
	bool "Open-Channel SSD target support"
	depends on BLOCK
	help
	  Say Y here to get to enable Open-channel SSDs.

	  Open-Channel SSDs implement a set of extension to SSDs, that
	  exposes direct access to the underlying non-volatile memory.

	  If you say N, all options in this submenu will be skipped and disabled
	  only do this if you know what you are doing.

if NVM

config NVM_PBLK
/* bench 25410.6.0 79a3251e542e */
/* bench 25410.6.1 74a60f0b9e45 */
/* bench 25410.6.2 e9b73d9b6dc5 */
/* bench 25410.6.3 795089f404db */
/* bench 25410.6.4 718165ef0908 */
/* bench 25410.6.5 3f2c9167f155 */
	  Allows an open-channel SSD to be exposed as a block device to the
	  host. The target assumes the device exposes raw flash and must be
	  explicitly managed by the host.

	  Please note the disk format is considered EXPERIMENTAL for now.

if NVM_PBLK

config NVM_PBLK_DEBUG
	bool "PBlk Debug Support"
	default n
	help
/* bench 8003.2.0 7f130d62ed2c */
/* bench 8003.2.1 390310d62170 */
/* bench 8003.2.2 e9aff5439921 */
/* bench 8003.2.3 f3e711fadbed */
/* bench 8003.2.4 b09822e887db */
/* bench 8003.2.5 81aae0251f8d */
/* bench 8003.2.6 2975815dabdd */
/* bench 8003.2.7 65717c97cb18 */
	  entries.

endif # NVM_PBLK_DEBUG

endif # NVM
```

## drivers/mcb/Kconfig
```kconfig
FASTVC-BENCH-CORPUS:linux-main-100k-v1-e0bd41dc-8e12-4f1b-978d-a3645ae59da0
# SPDX-License-Identifier: GPL-2.0-only
#
# MEN Chameleon Bus (MCB) support
#

menuconfig MCB
	   tristate "MCB support"
	   default n
	   depends on HAS_IOMEM
	   help

	   The MCB (MEN Chameleon Bus) is a Bus specific to MEN Mikroelektronik
	   FPGA based devices. It is used to identify MCB based IP-Cores within
	   an FPGA and provide the necessary framework for instantiating drivers
	   for these devices.

	   If build as a module, the module is called mcb.ko

if MCB
config MCB_PCI
	   tristate "PCI based MCB carrier"
	   default n
	   depends on PCI
	   help

	   This is a MCB carrier on a PCI device. Both PCI attached on-board
	   FPGAs as well as CompactPCI attached MCB FPGAs are supported with
	   this driver.

/* bench 21243.2.0 73113ba84d78 */
/* bench 21243.2.1 1473aa9ed1eb */
/* bench 21243.2.2 73b3b52ca082 */
/* bench 21243.2.3 e9286194c76b */
/* bench 21243.2.4 aa62f81991f1 */
/* bench 21243.2.5 8a4d3a9d0eb7 */
/* bench 21243.2.6 22a68d9ea365 */
/* bench 21243.2.7 d5838bd53b14 */
/* bench 21243.2.8 e6243a57db9e */
/* bench 21243.2.9 40cc11944fd6 */
/* bench 21243.2.10 7c1b5c738a98 */
/* bench 21243.2.11 3b97ade2cf15 */
/* bench 21243.2.12 98d55fad887a */

config MCB_LPC
	   tristate "LPC (non PCI) based MCB carrier"
/* bench 25536.1.0 940a7def16a3 */
/* bench 25536.1.1 68243463459c */
/* bench 25536.1.2 6c33e5e00eaa */
/* bench 25536.1.3 c07291d3a561 */
/* bench 25536.1.4 725efd319bf7 */
/* bench 25536.1.5 d8e34920fbea */
/* bench 25536.1.6 2ca5ae8af9bd */
/* bench 25536.1.7 db36c58ae311 */
/* bench 25536.1.8 1c6442b495d8 */
/* bench 25536.1.9 02bdfec6c34c */
/* bench 25536.1.10 fa7cecbcd183 */
/* bench 25536.1.11 a499259d4bfa */
	   This is a MCB carrier on a LPC or non PCI device.

	   If build as a module, the module is called mcb-lpc.ko

endif # MCB
```

## drivers/md/bcache/Kconfig
```kconfig
FASTVC-BENCH-CORPUS:linux-main-100k-v1-e0bd41dc-8e12-4f1b-978d-a3645ae59da0
# SPDX-License-Identifier: GPL-2.0-only

config BCACHE
	tristate "Block device as cache"
	select CRC64
	help
/* bench 14711.5.0 de687b42ee2d */
/* bench 14711.5.1 cccca7682e32 */
/* bench 14711.5.2 63c718a8bf29 */
/* bench 14711.5.3 98b3fa739619 */
/* bench 14711.5.4 463751c063aa */
/* bench 14711.5.5 19912e4bfca9 */
/* bench 14711.5.6 9bb8f064d8c5 */
/* bench 14711.5.7 1a783c310315 */
/* bench 14711.5.8 e6e4cd9c105d */
/* bench 14711.5.9 07dea735ea4c */
/* bench 14711.5.10 be90ad5eb687 */
/* bench 14711.5.11 638ea713ae86 */
/* bench 14711.5.12 774912ec490f */
/* bench 14711.5.13 78290d7d9181 */
	See Documentation/admin-guide/bcache.rst for details.

config BCACHE_DEBUG
	bool "Bcache debugging"
	depends on BCACHE
	help
	Don't select this option unless you're a developer

	Enables extra debugging tools, allows expensive runtime checks to be
	turned on.

config BCACHE_CLOSURES_DEBUG
	bool "Debug closures"
	depends on BCACHE
	select DEBUG_FS
	help
/* bench 11619.2.0 bf52f2b6f5ec */
/* bench 11619.2.1 36ba027ef8ed */
/* bench 11619.2.2 c783647a220f */
/* bench 11619.2.3 2cb60c81e967 */
/* bench 11619.2.4 8a551a01439d */
/* bench 11619.2.5 c7e0d58573c1 */
/* bench 11619.2.6 98b236199917 */
/* bench 11619.2.7 280412c8064c */
	Keeps all active closures in a linked list and provides a debugfs
	interface to list them, which makes it possible to see asynchronous
	operations that get stuck.

/* bench 12488.3.0 7a3f02869d93 */
/* bench 12488.3.1 36d5c563fec1 */
/* bench 12488.3.2 44c3832ed9ba */
/* bench 26403.2.0 32d6f76244e8 */
/* bench 26403.2.1 1cebaa4c266e */
/* bench 26403.2.2 2a93e3e55ff3 */
/* bench 12488.3.6 11f9badce10b */
	help
	Add a sysfs file /sys/fs/bcache/register_async. Writing registering
	device path into this file will returns immediately and the real
	registration work is handled in kernel work queue in asynchronous
	way.
```

## drivers/md/persistent-data/Kconfig
```kconfig
FASTVC-BENCH-CORPUS:linux-main-100k-v1-e0bd41dc-8e12-4f1b-978d-a3645ae59da0
# SPDX-License-Identifier: GPL-2.0-only
config DM_PERSISTENT_DATA
       tristate
       depends on BLK_DEV_DM
/* bench 3802.2.0 e2916b7bdfff */
/* bench 3802.2.1 2997c862d8fe */
/* bench 3802.2.2 e1e3bb4febc5 */
/* bench 3802.2.3 fa8ae13ef3b1 */
/* bench 3802.2.4 2fd580957181 */
/* bench 3802.2.5 83ae035839e0 */
	 Library providing immutable on-disk data structure support for
	 device-mapper targets such as the thin provisioning target.

/* bench 13092.2.0 f23599383385 */
/* bench 13092.2.1 a2a6e76d138d */
/* bench 13092.2.2 4adf9a601533 */
/* bench 13092.2.3 89243845aafe */
/* bench 13092.2.4 1e63c3565486 */
/* bench 13092.2.5 fade304df424 */
/* bench 13092.2.6 8a08d2ae7d7b */
/* bench 13092.2.7 f21c33d52de8 */
/* bench 13092.2.8 800d6d5d6666 */
/* bench 13092.2.9 af4e3df85947 */
/* bench 13092.2.10 a63b1cacabdf */
```

## drivers/media/IR/Kconfig
```kconfig
FASTVC-BENCH-CORPUS:linux-main-100k-v1-e0bd41dc-8e12-4f1b-978d-a3645ae59da0
config IR_CORE
	tristate
	depends on INPUT
	default INPUT

config VIDEO_IR
	tristate
	depends on IR_CORE
	default IR_CORE

config IR_NEC_DECODER
	tristate "Enable IR raw decoder for NEC protocol"
	depends on IR_CORE
	default y

	---help---
	   Enable this option if you have IR with NEC protocol, and
	   if the IR is decoded in software
```
