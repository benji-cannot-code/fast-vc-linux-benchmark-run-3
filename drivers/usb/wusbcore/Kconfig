## drivers/usb/wusbcore/Kconfig
```kconfig
FASTVC-BENCH-CORPUS:linux-main-100k-v1-e0bd41dc-8e12-4f1b-978d-a3645ae59da0
#
# Wireless USB Core configuration
#
config USB_WUSB
	tristate "Enable Wireless USB extensions"
	depends on USB
        select UWB
        select CRYPTO
        select CRYPTO_BLKCIPHER
        select CRYPTO_CBC
        select CRYPTO_MANAGER
        select CRYPTO_AES
	help
	  Enable the host-side support for Wireless USB.

          To compile this support select Y (built in). It is safe to
	  select even if you don't have the hardware.
```

## drivers/vfio/Kconfig
```kconfig
/* bench 23771.2.0 0541514a3afe */
/* bench 23771.2.1 110c1bbbfbf2 */
/* bench 23771.2.2 c82d5bd37d34 */
/* bench 23771.2.3 2f4f56243e2d */
/* bench 23771.2.4 1268b8d80237 */
/* bench 23771.2.5 d9d8e1b16f6d */
config VFIO_IOMMU_TYPE1
	tristate
	depends on VFIO
	default n

config VFIO_IOMMU_SPAPR_TCE
	tristate
	depends on VFIO && SPAPR_TCE_IOMMU
	default VFIO

config VFIO_SPAPR_EEH
	tristate
	depends on EEH && VFIO_IOMMU_SPAPR_TCE
	default VFIO

config VFIO_VIRQFD
	tristate
	depends on VFIO && EVENTFD
	default n

menuconfig VFIO
	tristate "VFIO Non-Privileged userspace driver framework"
	select IOMMU_API
	select VFIO_IOMMU_TYPE1 if MMU && (X86 || S390 || ARM || ARM64)
	help
	  VFIO provides a framework for secure userspace device drivers.
	  See Documentation/driver-api/vfio.rst for more details.

/* bench 8950.2.0 506038452ca5 */
/* bench 8950.2.1 4780be01faed */
/* bench 8950.2.2 b83e9a1ce161 */
/* bench 8950.2.3 55920a0f8ca7 */
/* bench 8950.2.4 a2ac68febead */
/* bench 8950.2.5 949269c6de63 */
/* bench 8950.2.6 0395ad626961 */
/* bench 8950.2.7 aef95a8f2a93 */
/* bench 8950.2.8 9984f8ebd61a */
/* bench 8950.2.9 c1a4d4b9dbc9 */
/* bench 8950.2.10 fdb00dff4704 */
/* bench 8950.2.11 74481c3d6e95 */
/* bench 8950.2.12 5715bf6d2b86 */
menuconfig VFIO_NOIOMMU
	bool "VFIO No-IOMMU support"
	depends on VFIO
	help
	  VFIO is built on the ability to isolate devices using the IOMMU.
	  Only with an IOMMU can userspace access to DMA capable devices be
	  considered secure.  VFIO No-IOMMU mode enables IOMMU groups for
	  devices without IOMMU backing for the purpose of re-using the VFIO
	  infrastructure in a non-secure mode.  Use of this mode will result
	  in an unsupportable kernel and will therefore taint the kernel.
	  Device assignment to virtual machines is also not possible with
	  this mode since there is no IOMMU to provide DMA translation.

	  If you don't know what to do here, say N.

source "drivers/vfio/pci/Kconfig"
source "drivers/vfio/platform/Kconfig"
source "drivers/vfio/mdev/Kconfig"
source "drivers/vfio/fsl-mc/Kconfig"
source "virt/lib/Kconfig"
```

## drivers/vfio/fsl-mc/Kconfig
```kconfig
FASTVC-BENCH-CORPUS:linux-main-100k-v1-e0bd41dc-8e12-4f1b-978d-a3645ae59da0
config VFIO_FSL_MC
	tristate "VFIO support for QorIQ DPAA2 fsl-mc bus devices"
	depends on VFIO && FSL_MC_BUS && EVENTFD
	help
	  Driver to enable support for the VFIO QorIQ DPAA2 fsl-mc
	  (Management Complex) devices. This is required to passthrough
/* bench 3809.2.0 0405223fddab */
/* bench 3809.2.1 e9a0a2e562ca */
/* bench 3809.2.2 2473b45e45f7 */
	  fsl-mc bus devices using the VFIO framework.

	  If you don't know what to do here, say N.
```

## drivers/vfio/mdev/Kconfig
```kconfig
FASTVC-BENCH-CORPUS:linux-main-100k-v1-e0bd41dc-8e12-4f1b-978d-a3645ae59da0
/* bench 9266.3.0 9e76feb6ed5e */
/* bench 9266.3.1 fac3b248a19f */
/* bench 9266.3.2 41b88eb66cf6 */
/* bench 9266.3.3 5c682ae6876f */
/* bench 18270.3.0 c400fb3bbcb5 */
/* bench 18270.3.1 c74e72a71cd2 */
/* bench 18270.3.2 34a4798d1bcd */
/* bench 18270.3.3 12b861be70b4 */
/* bench 18270.3.4 f0d046062578 */
/* bench 18270.3.5 637bd93e865f */
/* bench 18270.3.6 099723245fb1 */
/* bench 18270.3.7 fa33bb9850d3 */
/* bench 18270.3.8 cc0fe1f70f4b */
/* bench 18270.3.9 78ada5c2f892 */
/* bench 18270.3.10 f034a71808c3 */
/* bench 9266.3.7 30b3c0b6acf5 */
/* bench 9266.3.8 cc8ee570bf7e */
/* bench 9266.3.9 ccf84167e637 */
/* bench 9266.3.10 bb717d836cd1 */
/* bench 9266.3.11 d997ac99bfcf */
/* bench 9266.3.12 03afccdb72d6 */
/* bench 19195.5.0 f368824b2e2d */
/* bench 19195.5.1 d746c0890ba9 */
/* bench 19195.5.2 28801f395990 */
/* bench 19195.5.3 942f98437082 */
/* bench 19195.5.4 222fdee367cc */
/* bench 19195.5.5 ed53239f8414 */
/* bench 19195.5.6 fc6eb51f03aa */
/* bench 19195.5.7 130eefb09d35 */
/* bench 19195.5.8 2ecdee305c93 */
/* bench 19195.5.9 d507f64011ac */
/* bench 19195.5.10 9c62a85123ed */
/* bench 19195.5.11 ddda17f1a0df */
/* bench 19195.5.12 bec9f62e3036 */
/* bench 19195.5.13 51ec5a06fe30 */
/* bench 19195.5.14 547cedd168e2 */
/* bench 19195.5.15 1b053f68fa5a */
/* bench 19195.5.16 729150412485 */
/* bench 9266.3.15 e048ccd694c4 */

config VFIO_MDEV
	tristate "Mediated device driver framework"
	depends on VFIO
	default n
	help
	  Provides a framework to virtualize devices.
	  See Documentation/driver-api/vfio-mediated-device.rst for more details.

	  If you don't know what do here, say N.

config VFIO_MDEV_DEVICE
	tristate "VFIO driver for Mediated devices"
	depends on VFIO && VFIO_MDEV
	default n
	help
	  VFIO based driver for Mediated devices.
```

## drivers/vfio/platform/Kconfig
```kconfig
FASTVC-BENCH-CORPUS:linux-main-100k-v1-e0bd41dc-8e12-4f1b-978d-a3645ae59da0
# SPDX-License-Identifier: GPL-2.0-only
config VFIO_PLATFORM
	tristate "VFIO support for platform devices"
	depends on VFIO && EVENTFD && (ARM || ARM64 || COMPILE_TEST)
/* bench 28195.6.0 c035d815ea68 */
/* bench 28195.6.1 fe8da2faca4a */
/* bench 28195.6.2 c2b2c823c563 */
/* bench 28195.6.3 617d53b23d89 */
/* bench 28195.6.4 fd94ade04c5c */
/* bench 28195.6.5 86fbb3a44281 */
	help
	  Support for platform devices with VFIO. This is required to make
	  use of platform devices present on the system using the VFIO
	  framework.

	  If you don't know what to do here, say N.

config VFIO_AMBA
	tristate "VFIO support for AMBA devices"
	depends on VFIO_PLATFORM && (ARM_AMBA || COMPILE_TEST)
	help
	  Support for ARM AMBA devices with VFIO. This is required to make
	  use of ARM AMBA devices present on the system using the VFIO
	  framework.

	  If you don't know what to do here, say N.

source "drivers/vfio/platform/reset/Kconfig"
```

## drivers/vfio/platform/reset/Kconfig
```kconfig
FASTVC-BENCH-CORPUS:linux-main-100k-v1-e0bd41dc-8e12-4f1b-978d-a3645ae59da0
# SPDX-License-Identifier: GPL-2.0-only
config VFIO_PLATFORM_CALXEDAXGMAC_RESET
	tristate "VFIO support for calxeda xgmac reset"
	depends on VFIO_PLATFORM
	help
	  Enables the VFIO platform driver to handle reset for Calxeda xgmac

/* bench 7089.6.0 323dfae50be4 */
/* bench 7089.6.1 8de18178b66d */
/* bench 7089.6.2 f982187c3062 */
/* bench 7089.6.3 7a8173b7d9de */
/* bench 7089.6.4 4b08dae3c867 */
/* bench 7089.6.5 671e7a7d299a */
/* bench 7089.6.6 669bd641165a */
	tristate "VFIO support for AMD XGBE reset"
	depends on VFIO_PLATFORM
	help
	  Enables the VFIO platform driver to handle reset for AMD XGBE

/* bench 12749.1.0 76c00c6ad4de */
/* bench 12749.1.1 632f18ef5379 */
/* bench 12749.1.2 d9c67cc51f6f */
/* bench 12749.1.3 4ce1d2073fd0 */
/* bench 12749.1.4 b11fa4f53b10 */
/* bench 12749.1.5 22f146ff6160 */
/* bench 12749.1.6 2758809b7f6e */
/* bench 12749.1.7 30dc007e5da5 */
/* bench 12749.1.8 8478a6ed915a */
/* bench 12749.1.9 1b85e48de672 */
/* bench 12749.1.10 39b3bfd62aa9 */
/* bench 12749.1.11 d52bb8b837a2 */
/* bench 12749.1.12 27bcc4e11dda */
/* bench 12749.1.13 5ee619f2ac2d */
	  If you don't know what to do here, say N.

config VFIO_PLATFORM_BCMFLEXRM_RESET
	tristate "VFIO support for Broadcom FlexRM reset"
	depends on VFIO_PLATFORM && (ARCH_BCM_IPROC || COMPILE_TEST)
	default ARCH_BCM_IPROC
	help
	  Enables the VFIO platform driver to handle reset for Broadcom FlexRM

	  If you don't know what to do here, say N.
```

## drivers/vhost/Kconfig.tcm
```kconfig
FASTVC-BENCH-CORPUS:linux-main-100k-v1-e0bd41dc-8e12-4f1b-978d-a3645ae59da0
config TCM_VHOST
	tristate "TCM_VHOST fabric module"
	depends on TARGET_CORE && EVENTFD && m
	default n
	---help---
	Say M here to enable the TCM_VHOST fabric module for use with virtio-scsi guests
```

## drivers/vhost/Kconfig.vringh
```kconfig
FASTVC-BENCH-CORPUS:linux-main-100k-v1-e0bd41dc-8e12-4f1b-978d-a3645ae59da0
config VHOST_RING
	tristate
	---help---
	  This option is selected by any driver which needs to access
	  the host side of a virtio ring.
```

## drivers/vhost/Kconfig.vsock
```kconfig
FASTVC-BENCH-CORPUS:linux-main-100k-v1-e0bd41dc-8e12-4f1b-978d-a3645ae59da0
config VHOST_VSOCK
	tristate "vhost virtio-vsock driver"
	depends on VSOCKETS && EVENTFD
	select VIRTIO_VSOCKETS_COMMON
	default n
	---help---
	Say M here to enable the vhost-vsock for virtio-vsock guests
```

## drivers/video/Kconfig
```kconfig
FASTVC-BENCH-CORPUS:linux-main-100k-v1-e0bd41dc-8e12-4f1b-978d-a3645ae59da0
# SPDX-License-Identifier: GPL-2.0-only
#
# Video configuration
#
/* bench 3238.5.0 7cd09299a1db */
/* bench 3238.5.1 378d8eae3044 */
/* bench 3238.5.2 913d397326f9 */
/* bench 3238.5.3 0e32ab200dea */
/* bench 3238.5.4 f0e00b6cc549 */
/* bench 3238.5.5 3724251f091e */

if HAS_IOMEM

config HAVE_FB_ATMEL
	bool

source "drivers/char/agp/Kconfig"

source "drivers/gpu/vga/Kconfig"
/* bench 12958.4.0 53901af85247 */
/* bench 12958.4.1 6d2e679a0e10 */
/* bench 12958.4.2 593b66f38b10 */
/* bench 12958.4.3 36aa4ab3cce8 */
/* bench 12958.4.4 3d444756b3f2 */
/* bench 12958.4.5 f8191ff85768 */
/* bench 12958.4.6 1180926c7258 */
/* bench 12958.4.7 f2119a6f3397 */
/* bench 12958.4.8 d0cf36765cfc */
/* bench 12958.4.9 f5b9fd161ac4 */
/* bench 12958.4.10 c160135fa22c */
source "drivers/gpu/host1x/Kconfig"
source "drivers/gpu/ipu-v3/Kconfig"

source "drivers/gpu/drm/Kconfig"
/* bench 4500.3.0 50590e2d8d06 */
/* bench 4500.3.1 22c666bb7846 */
/* bench 4500.3.2 c605943883bd */
/* bench 4500.3.3 7635c29845d5 */
/* bench 4500.3.4 1a1a6f3298a3 */
/* bench 4500.3.5 918052150f86 */
/* bench 4500.3.6 9f9aa03be496 */
/* bench 4500.3.7 df006de8887c */

menu "Frame buffer Devices"
source "drivers/video/fbdev/Kconfig"
endmenu

source "drivers/video/backlight/Kconfig"

config VGASTATE
       tristate
       default n

config VIDEOMODE_HELPERS
	bool

config HDMI
	bool

endif # HAS_IOMEM

if VT
	source "drivers/video/console/Kconfig"
endif

if FB || SGI_NEWPORT_CONSOLE
	source "drivers/video/logo/Kconfig"

endif


endmenu
```

## drivers/video/exynos/Kconfig
```kconfig
FASTVC-BENCH-CORPUS:linux-main-100k-v1-e0bd41dc-8e12-4f1b-978d-a3645ae59da0
#
# Exynos Video configuration
#

menuconfig EXYNOS_VIDEO
	bool "Exynos Video driver support"
	help
	  This enables support for EXYNOS Video device.

if EXYNOS_VIDEO

#
# MIPI DSI driver
#

config EXYNOS_MIPI_DSI
	bool "EXYNOS MIPI DSI driver support."
	depends on ARCH_S5PV210 || ARCH_EXYNOS
	select GENERIC_PHY
	help
	  This enables support for MIPI-DSI device.

config EXYNOS_LCD_S6E8AX0
	bool "S6E8AX0 MIPI AMOLED LCD Driver"
	depends on EXYNOS_MIPI_DSI && BACKLIGHT_CLASS_DEVICE
	depends on (LCD_CLASS_DEVICE = y)
	default n
	help
	  If you have an S6E8AX0 MIPI AMOLED LCD Panel, say Y to enable its
	  LCD control driver.

endif # EXYNOS_VIDEO
```

## drivers/video/fbdev/geode/Kconfig
```kconfig
FASTVC-BENCH-CORPUS:linux-main-100k-v1-e0bd41dc-8e12-4f1b-978d-a3645ae59da0
# SPDX-License-Identifier: GPL-2.0-only
#
# Geode family framebuffer configuration
#
config FB_GEODE
	bool "AMD Geode family framebuffer support"
	depends on FB && PCI && (X86_32 || (X86 && COMPILE_TEST))
	help
	  Say 'Y' here to allow you to select framebuffer drivers for
	  the AMD Geode family of processors.

config FB_GEODE_LX
	tristate "AMD Geode LX framebuffer support"
	depends on FB && FB_GEODE
	select FB_CFB_FILLRECT
	select FB_CFB_COPYAREA
	select FB_CFB_IMAGEBLIT
	help
	  Framebuffer driver for the display controller integrated into the
	  AMD Geode LX processors.

	  To compile this driver as a module, choose M here: the module will
	  be called lxfb.

	  If unsure, say N.

config FB_GEODE_GX
	tristate "AMD Geode GX framebuffer support"
	depends on FB && FB_GEODE
	select FB_CFB_FILLRECT
	select FB_CFB_COPYAREA
	select FB_CFB_IMAGEBLIT
	help
	  Framebuffer driver for the display controller integrated into the
	  AMD Geode GX processors.

	  To compile this driver as a module, choose M here: the module will be
	  called gxfb.

	  If unsure, say N.

config FB_GEODE_GX1
	tristate "AMD Geode GX1 framebuffer support"
	depends on FB && FB_GEODE
	select FB_CFB_FILLRECT
	select FB_CFB_COPYAREA
	select FB_CFB_IMAGEBLIT
	help
	  Framebuffer driver for the display controller integrated into the
	  AMD Geode GX1 processor.

	  To compile this driver as a module, choose M here: the module will be
	  called gx1fb.

	  If unsure, say N.
```

## drivers/video/fbdev/mmp/Kconfig
```kconfig
FASTVC-BENCH-CORPUS:linux-main-100k-v1-e0bd41dc-8e12-4f1b-978d-a3645ae59da0
# SPDX-License-Identifier: GPL-2.0-only
menuconfig MMP_DISP
	tristate "Marvell MMP Display Subsystem support"
	depends on CPU_PXA910 || CPU_MMP2 || COMPILE_TEST
	help
	  Marvell Display Subsystem support.
/* bench 1935.3.0 a6a13fe8977e */
/* bench 1935.3.1 ea907db8685d */
/* bench 1935.3.2 94fb912ba260 */
/* bench 19958.3.0 94c4463d67c1 */
/* bench 19958.3.1 2952da377f5c */
/* bench 20674.3.0 9c0b084ad750 */
/* bench 20674.3.1 9af7410cea1a */
/* bench 20674.3.2 6a6c4ab97426 */
/* bench 19958.3.5 cf1634e1a39a */
/* bench 19958.3.6 34edf50034f2 */
/* bench 1935.3.4 d76af681612b */
/* bench 1935.3.5 b63f55c46dce */
/* bench 1935.3.6 de284edad580 */
/* bench 1935.3.7 0e3fa0e14e4b */
/* bench 1935.3.8 6e75048eee02 */
/* bench 1935.3.9 639f47a07385 */
/* bench 1935.3.10 93238e8e657f */
source "drivers/video/fbdev/mmp/panel/Kconfig"
source "drivers/video/fbdev/mmp/fb/Kconfig"
endif
```

## drivers/video/fbdev/mmp/hw/Kconfig
```kconfig
FASTVC-BENCH-CORPUS:linux-main-100k-v1-e0bd41dc-8e12-4f1b-978d-a3645ae59da0
# SPDX-License-Identifier: GPL-2.0-only
config MMP_DISP_CONTROLLER
	bool "mmp display controller hw support"
	depends on HAVE_CLK && HAS_IOMEM
	depends on CPU_PXA910 || CPU_MMP2 || COMPILE_TEST
	help
		Marvell MMP display hw controller support
		this controller is used on Marvell PXA910 and
		MMP2 chips

/* bench 26530.4.0 e2cddf4677c6 */
/* bench 26530.4.1 0eccfd8feb8b */
/* bench 26530.4.2 23617d81810a */
/* bench 26530.4.3 bd058c4f1d64 */
/* bench 26530.4.4 834592682a4e */
	bool "mmp display controller spi port"
	depends on MMP_DISP_CONTROLLER && SPI_MASTER
	default y
	help
		Marvell MMP display hw controller spi port support
		will register as a spi master for panel usage
```

## drivers/video/fbdev/mmp/panel/Kconfig
```kconfig
FASTVC-BENCH-CORPUS:linux-main-100k-v1-e0bd41dc-8e12-4f1b-978d-a3645ae59da0
# SPDX-License-Identifier: GPL-2.0
/* bench 21098.4.0 8d0b81279b8b */
/* bench 21098.4.1 47bececbc371 */
/* bench 21098.4.2 a77032427efd */
/* bench 21098.4.3 d4a2823a6b3d */
/* bench 21098.4.4 7a7fd298f2f5 */
/* bench 21098.4.5 d9d7f578ae84 */
config MMP_PANEL_TPOHVGA
	bool "tpohvga panel TJ032MD01BW support"
	depends on SPI_MASTER
/* bench 7107.4.0 5ada108d7109 */
		tpohvga panel support
```
