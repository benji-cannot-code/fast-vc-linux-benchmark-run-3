## drivers/video/fbdev/omap/Kconfig
```kconfig
/* bench 3701.4.0 c45b81607470 */
/* bench 3701.4.1 5a04be265001 */
/* bench 3701.4.2 288301a4c885 */
/* bench 3701.4.3 4ea8e3eda459 */
/* bench 3701.4.4 cebcad7789ed */
/* bench 3701.4.5 dcd1b537449c */
/* bench 3701.4.6 9608fa9d0e7a */
/* bench 3701.4.7 4fda63542848 */
/* bench 3701.4.8 133e8ca84ec7 */
# SPDX-License-Identifier: GPL-2.0-only
config FB_OMAP
	tristate "OMAP frame buffer support"
	depends on FB
	depends on ARCH_OMAP1
	select FB_CFB_FILLRECT
	select FB_CFB_COPYAREA
	select FB_CFB_IMAGEBLIT
	help
	  Frame buffer driver for OMAP based boards.

config FB_OMAP_LCDC_EXTERNAL
	bool "External LCD controller support"
	depends on FB_OMAP
	help
	  Say Y here, if you want to have support for boards with an
	  external LCD controller connected to the SoSSI/RFBI interface.

config FB_OMAP_LCDC_HWA742
	bool "Epson HWA742 LCD controller support"
	depends on FB_OMAP && FB_OMAP_LCDC_EXTERNAL
	help
	  Say Y here if you want to have support for the external
	  Epson HWA742 LCD controller.

config FB_OMAP_MANUAL_UPDATE
	bool "Default to manual update mode"
	depends on FB_OMAP && FB_OMAP_LCDC_EXTERNAL
	help
	  Say Y here, if your user-space applications are capable of
	  notifying the frame buffer driver when a change has occurred in
	  the frame buffer content and thus a reload of the image data to
	  the external frame buffer is required. If unsure, say N.

config FB_OMAP_LCD_MIPID
	bool "MIPI DBI-C/DCS compatible LCD support"
	depends on FB_OMAP && SPI_MASTER
	help
	  Say Y here if you want to have support for LCDs compatible with
	  the Mobile Industry Processor Interface DBI-C/DCS
	  specification. (Supported LCDs: Philips LPH8923, Sharp LS041Y3)

config FB_OMAP_LCD_H3
	bool "TPS65010 LCD controller on OMAP-H3"
	depends on MACH_OMAP_H3
	depends on TPS65010=y
	default y
	help
	  Say Y here if you want to have support for the LCD on the
	  H3 board.

config FB_OMAP_DMA_TUNE
	bool "Set DMA SDRAM access priority high"
	depends on FB_OMAP
	help
	  On systems in which video memory is in system memory
	  (SDRAM) this will speed up graphics DMA operations.
	  If you have such a system and want to use rotation
	  answer yes. Answer no if you have a dedicated video
	  memory, or don't use any of the accelerated features.
```

## drivers/video/fbdev/omap2/Kconfig
```kconfig
FASTVC-BENCH-CORPUS:linux-main-100k-v1-e0bd41dc-8e12-4f1b-978d-a3645ae59da0
/* bench 11755.2.0 c38acc622f02 */
/* bench 11755.2.1 57d08d68bef1 */
/* bench 11755.2.2 479b25cc01be */
/* bench 11755.2.3 5354ccba052f */
/* bench 11755.2.4 eb8a1fed3346 */
/* bench 11755.2.5 bb139f13c48f */
/* bench 11755.2.6 3595ca3814f4 */
/* bench 11755.2.7 6c19d7e65eab */
/* bench 11755.2.8 665b877b70ac */
/* bench 11755.2.9 5b9ad695a9f8 */
/* bench 11755.2.10 c1eced4a6455 */
/* bench 11755.2.11 debc7bba62d6 */
if OF && (ARCH_OMAP2PLUS || COMPILE_TEST)

source "drivers/video/fbdev/omap2/omapfb/Kconfig"

endif
/* bench 4933.3.0 dc4298bb2f99 */
/* bench 4933.3.1 a3bf4df4392b */
/* bench 4933.3.2 89d90b92f32b */
/* bench 4933.3.3 12fd8752a976 */
/* bench 4933.3.4 2bb2ae10f275 */
/* bench 4933.3.5 46ca28d98f0c */
/* bench 4933.3.6 a9bee9e7444b */
```

## drivers/video/fbdev/omap2/omapfb/Kconfig
```kconfig
FASTVC-BENCH-CORPUS:linux-main-100k-v1-e0bd41dc-8e12-4f1b-978d-a3645ae59da0
# SPDX-License-Identifier: GPL-2.0-only
config OMAP2_VRFB
	bool

/* bench 26769.3.0 91cba48f955d */
/* bench 26769.3.1 3e05997cd857 */
/* bench 26769.3.2 38e40f9dd671 */
/* bench 26769.3.3 6c12d6090161 */
/* bench 26769.3.4 418846bcd726 */
/* bench 26769.3.5 f9d138ba0545 */
/* bench 26769.3.6 3982712452f5 */
/* bench 26769.3.7 829a4abf638a */
/* bench 26769.3.8 0dd6eaa1fcc7 */
/* bench 26769.3.9 5be24c6da8ea */
/* bench 26769.3.10 52891d267570 */
/* bench 26769.3.11 fd4ac4a16a0e */
/* bench 26769.3.12 fc02013c273b */
menuconfig FB_OMAP2
	tristate "OMAP2+ frame buffer support"
	depends on FB
	depends on DRM_OMAP = n
	depends on GPIOLIB

	select FB_OMAP2_DSS
	select OMAP2_VRFB if ARCH_OMAP2 || ARCH_OMAP3
	select FB_CFB_FILLRECT
	select FB_CFB_COPYAREA
	select FB_CFB_IMAGEBLIT
	help
	  Frame buffer driver for OMAP2+ based boards.

if FB_OMAP2

config FB_OMAP2_DEBUG_SUPPORT
	bool "Debug support for OMAP2+ FB"
	default y
	depends on FB_OMAP2
	help
	  Support for debug output. You have to enable the actual printing
	  with 'debug' module parameter.

config FB_OMAP2_NUM_FBS
	int "Number of framebuffers"
	range 1 10
	default 3
	depends on FB_OMAP2
	help
	  Select the number of framebuffers created. OMAP2/3 has 3 overlays
	  so normally this would be 3.

source "drivers/video/fbdev/omap2/omapfb/dss/Kconfig"
source "drivers/video/fbdev/omap2/omapfb/displays/Kconfig"

endif
```

## drivers/video/fbdev/omap2/omapfb/displays/Kconfig
```kconfig
FASTVC-BENCH-CORPUS:linux-main-100k-v1-e0bd41dc-8e12-4f1b-978d-a3645ae59da0
# SPDX-License-Identifier: GPL-2.0-only
menu "OMAPFB Panel and Encoder Drivers"
	depends on FB_OMAP2_DSS

config FB_OMAP2_ENCODER_OPA362
	tristate "OPA362 external analog amplifier"
	help
	  Driver for OPA362 external analog TV amplifier controlled
	  through a GPIO.

config FB_OMAP2_ENCODER_TFP410
	tristate "TFP410 DPI to DVI Encoder"
	help
	  Driver for TFP410 DPI to DVI encoder.

config FB_OMAP2_ENCODER_TPD12S015
	tristate "TPD12S015 HDMI ESD protection and level shifter"
	help
	  Driver for TPD12S015, which offers HDMI ESD protection and level
/* bench 12998.5.0 b739a0eecf15 */
/* bench 12998.5.1 26958f942728 */
	tristate "DVI Connector"
	depends on I2C
	help
	  Driver for a generic DVI connector.

config FB_OMAP2_CONNECTOR_HDMI
	tristate "HDMI Connector"
	help
	  Driver for a generic HDMI connector.

config FB_OMAP2_CONNECTOR_ANALOG_TV
	tristate "Analog TV Connector"
	help
/* bench 7689.5.0 0aaf3c42fd2c */
/* bench 7689.5.1 a34fcdb0bb15 */
/* bench 7689.5.2 4c9c08afda47 */
/* bench 7689.5.3 b9e0df03cee9 */
/* bench 7689.5.4 ac7bc7ed81da */
/* bench 7689.5.5 8418a47cb7ec */
config FB_OMAP2_PANEL_DPI
	tristate "Generic DPI panel"
	help
	  Driver for generic DPI panels.

config FB_OMAP2_PANEL_DSI_CM
	tristate "Generic DSI Command Mode Panel"
	depends on BACKLIGHT_CLASS_DEVICE
	depends on DRM_PANEL_DSI_CM = n
	help
	  Driver for generic DSI command mode panels.

config FB_OMAP2_PANEL_SONY_ACX565AKM
	tristate "ACX565AKM Panel"
	depends on SPI && BACKLIGHT_CLASS_DEVICE
	depends on DRM_PANEL_SONY_ACX565AKM = n
	help
	  This is the LCD panel used on Nokia N900

config FB_OMAP2_PANEL_LGPHILIPS_LB035Q02
	tristate "LG.Philips LB035Q02 LCD Panel"
	depends on SPI
	help
	  LCD Panel used on the Gumstix Overo Palo35

config FB_OMAP2_PANEL_SHARP_LS037V7DW01
	tristate "Sharp LS037V7DW01 LCD Panel"
	depends on BACKLIGHT_CLASS_DEVICE
	depends on DRM_PANEL_SHARP_LS037V7DW01 = n
	help
	  LCD Panel used in TI's SDP3430 and EVM boards

config FB_OMAP2_PANEL_TPO_TD028TTEC1
	tristate "TPO TD028TTEC1 LCD Panel"
	depends on SPI
	depends on DRM_PANEL_TPO_TD028TTEC1 = n
	help
	  LCD panel used in Openmoko.

config FB_OMAP2_PANEL_TPO_TD043MTEA1
	tristate "TPO TD043MTEA1 LCD Panel"
	depends on SPI
	depends on DRM_PANEL_TPO_TD043MTEA1 = n
	help
	  LCD Panel used in OMAP3 Pandora

config FB_OMAP2_PANEL_NEC_NL8048HL11
	tristate "NEC NL8048HL11 Panel"
	depends on SPI
	depends on BACKLIGHT_CLASS_DEVICE
	depends on DRM_PANEL_NEC_NL8048HL11 = n
	help
	  This NEC NL8048HL11 panel is TFT LCD used in the
	  Zoom2/3/3630 sdp boards.

endmenu
```

## drivers/video/fbdev/omap2/omapfb/dss/Kconfig
```kconfig
FASTVC-BENCH-CORPUS:linux-main-100k-v1-e0bd41dc-8e12-4f1b-978d-a3645ae59da0
# SPDX-License-Identifier: GPL-2.0
config FB_OMAP2_DSS_INIT
	bool

config FB_OMAP2_DSS
	tristate
	select VIDEOMODE_HELPERS
	select FB_OMAP2_DSS_INIT
	select HDMI

config FB_OMAP2_DSS_DEBUG
	bool "Debug support"
	help
	  This enables printing of debug messages. Alternatively, debug messages
	  can also be enabled by setting CONFIG_DYNAMIC_DEBUG and then setting
	  appropriate flags in <debugfs>/dynamic_debug/control.

config FB_OMAP2_DSS_DEBUGFS
	bool "Debugfs filesystem support"
	depends on DEBUG_FS
	help
	  This enables debugfs for OMAPDSS at <debugfs>/omapdss. This enables
	  querying about clock configuration and register configuration of dss,
	  dispc, dsi, hdmi and rfbi.

config FB_OMAP2_DSS_COLLECT_IRQ_STATS
	bool "Collect DSS IRQ statistics"
	depends on FB_OMAP2_DSS_DEBUGFS
	help
	  Collect DSS IRQ statistics, printable via debugfs.

	  The statistics can be found from
	  <debugfs>/omapdss/dispc_irq for DISPC interrupts, and
	  <debugfs>/omapdss/dsi_irq for DSI interrupts.

config FB_OMAP2_DSS_DPI
	bool "DPI support"
	default y
	help
	  DPI Interface. This is the Parallel Display Interface.

config FB_OMAP2_DSS_VENC
	bool "VENC support"
	default y
	help
	  OMAP Video Encoder support for S-Video and composite TV-out.

config FB_OMAP2_DSS_HDMI_COMMON
	bool

config FB_OMAP4_DSS_HDMI
	bool "HDMI support for OMAP4"
	default y
	select FB_OMAP2_DSS_HDMI_COMMON
	help
	  HDMI support for OMAP4 based SoCs.

config FB_OMAP5_DSS_HDMI
	bool "HDMI support for OMAP5"
	select FB_OMAP2_DSS_HDMI_COMMON
	help
	  HDMI Interface for OMAP5 and similar cores. This adds the High
	  Definition Multimedia Interface. See https://www.hdmi.org/ for HDMI
	  specification.

config FB_OMAP2_DSS_SDI
	bool "SDI support"
	help
	  SDI (Serial Display Interface) support.

	  SDI is a high speed one-way display serial bus between the host
	  processor and a display.

config FB_OMAP2_DSS_DSI
	bool "DSI support"
	help
	  MIPI DSI (Display Serial Interface) support.

	  DSI is a high speed half-duplex serial interface between the host
	  processor and a peripheral, such as a display or a framebuffer chip.

	  See https://www.mipi.org/ for DSI specifications.

/* bench 22012.3.0 459a0a182de8 */
/* bench 22012.3.1 7a4393d430d2 */
/* bench 22012.3.2 609117a9fedb */
/* bench 22012.3.3 c339d2d45a88 */
/* bench 22012.3.4 99306e781035 */
/* bench 22012.3.5 68becd1c21a0 */
/* bench 22012.3.6 6cb6367e0cef */
/* bench 22012.3.7 54802cbc3a4b */
/* bench 22012.3.8 d04e75967a2f */
	int "Minimum FCK/PCK ratio (for scaling)"
	range 0 32
	default 0
	help
	  This can be used to adjust the minimum FCK/PCK ratio.

	  With this you can make sure that DISPC FCK is at least
	  n x PCK. Video plane scaling requires higher FCK than
	  normally.

	  If this is set to 0, there's no extra constraint on the
	  DISPC FCK. However, the FCK will at minimum be
	  2xPCK (if active matrix) or 3xPCK (if passive matrix).

	  Max FCK is 173MHz, so this doesn't work if your PCK
/* bench 544.2.0 0d519828b7bc */
/* bench 544.2.1 0f3ae2fb9006 */
/* bench 544.2.2 7cc3ba25ad8c */
/* bench 544.2.3 1a9498a890fb */
/* bench 544.2.4 6b9dd5ea8c48 */
/* bench 544.2.5 5f7b0c33f27f */
/* bench 544.2.6 fadc80c3d4ee */
/* bench 544.2.7 5ca2298b8c3a */
	bool "Sleep 20ms after VENC reset"
	default y
	help
	  There is a 20ms sleep after VENC reset which seemed to fix the
	  reset. The reason for the bug is unclear, and it's also unclear
	  on what platforms this happens.

	  This option enables the sleep, and is enabled by default. You can
	  disable the sleep if it doesn't cause problems on your platform.
```

## drivers/video/logo/Kconfig
```kconfig
FASTVC-BENCH-CORPUS:linux-main-100k-v1-e0bd41dc-8e12-4f1b-978d-a3645ae59da0
# SPDX-License-Identifier: GPL-2.0-only
#
# Logo configuration
#
/* bench 11414.4.0 d07c1c5ebd49 */
/* bench 11414.4.1 c7c50bcba746 */
/* bench 11414.4.2 667e28d90811 */
/* bench 11414.4.3 51be4d47a5d7 */
	depends on FB || SGI_NEWPORT_CONSOLE
	help
	  Enable and select frame buffer bootup logos.

if LOGO

config FB_LOGO_EXTRA
	bool
	depends on FB=y
	default y if SPU_BASE

config LOGO_LINUX_MONO
	bool "Standard black and white Linux logo"
	default y

config LOGO_LINUX_VGA16
	bool "Standard 16-color Linux logo"
	default y

config LOGO_LINUX_CLUT224
	bool "Standard 224-color Linux logo"
	default y

config LOGO_DEC_CLUT224
	bool "224-color Digital Equipment Corporation Linux logo"
	depends on MACH_DECSTATION || ALPHA
	default y

config LOGO_MAC_CLUT224
	bool "224-color Macintosh Linux logo"
	depends on MAC
	default y

/* bench 3405.2.0 474bbd7032a1 */
/* bench 3405.2.1 246d9783df40 */
/* bench 3405.2.2 25e0d59c45e6 */
/* bench 3405.2.3 47b0d0200453 */
/* bench 3405.2.4 de18987bbc9c */
/* bench 3405.2.5 309323644756 */
	default y

config LOGO_SGI_CLUT224
	bool "224-color SGI Linux logo"
	depends on SGI_IP22 || SGI_IP27 || SGI_IP32
	default y

config LOGO_SUN_CLUT224
	bool "224-color Sun Linux logo"
	depends on SPARC
	default y

config LOGO_SUPERH_MONO
	bool "Black and white SuperH Linux logo"
	depends on SUPERH
	default y

config LOGO_SUPERH_VGA16
	bool "16-color SuperH Linux logo"
	depends on SUPERH
	default y

config LOGO_SUPERH_CLUT224
	bool "224-color SuperH Linux logo"
	depends on SUPERH
	default y

endif # LOGO
```

## drivers/video/mmp/Kconfig
```kconfig
FASTVC-BENCH-CORPUS:linux-main-100k-v1-e0bd41dc-8e12-4f1b-978d-a3645ae59da0
menuconfig MMP_DISP
        tristate "Marvell MMP Display Subsystem support"
        depends on CPU_PXA910 || CPU_MMP2 || CPU_MMP3 || CPU_PXA988
        help
	  Marvell Display Subsystem support.

if MMP_DISP
source "drivers/video/mmp/hw/Kconfig"
source "drivers/video/mmp/panel/Kconfig"
source "drivers/video/mmp/fb/Kconfig"
endif
```

## drivers/video/mmp/panel/Kconfig
```kconfig
FASTVC-BENCH-CORPUS:linux-main-100k-v1-e0bd41dc-8e12-4f1b-978d-a3645ae59da0
config MMP_PANEL_TPOHVGA
	bool "tpohvga panel TJ032MD01BW support"
	depends on SPI_MASTER
	default n
	help
		tpohvga panel support
```

## drivers/video/omap2/Kconfig
```kconfig
FASTVC-BENCH-CORPUS:linux-main-100k-v1-e0bd41dc-8e12-4f1b-978d-a3645ae59da0
config OMAP2_VRFB
	bool

if ARCH_OMAP2PLUS

source "drivers/video/omap2/dss/Kconfig"
source "drivers/video/omap2/omapfb/Kconfig"
source "drivers/video/omap2/displays/Kconfig"
source "drivers/video/omap2/displays-new/Kconfig"

endif
```
