## drivers/iio/trigger/Kconfig
```kconfig
FASTVC-BENCH-CORPUS:linux-main-100k-v1-e0bd41dc-8e12-4f1b-978d-a3645ae59da0
# SPDX-License-Identifier: GPL-2.0-only
#
# Industrial I/O standalone triggers
#
# When adding new entries keep the list in alphabetical order

menu "Triggers - standalone"

config IIO_HRTIMER_TRIGGER
	tristate "High resolution timer trigger"
	depends on IIO_SW_TRIGGER
	help
	  Provides a frequency based IIO trigger using high resolution
	  timers as interrupt source.

	  To compile this driver as a module, choose M here: the
	  module will be called iio-trig-hrtimer.

config IIO_INTERRUPT_TRIGGER
	tristate "Generic interrupt trigger"
	help
	  Provides support for using an interrupt of any type as an IIO
	  trigger.  This may be provided by a gpio driver for example.

	  To compile this driver as a module, choose M here: the
	  module will be called iio-trig-interrupt.

config IIO_STM32_LPTIMER_TRIGGER
	tristate "STM32 Low-Power Timer Trigger"
	depends on MFD_STM32_LPTIMER || COMPILE_TEST
	help
	  Select this option to enable STM32 Low-Power Timer Trigger.
	  This can be used as trigger source for STM32 internal ADC
	  and/or DAC.

	  To compile this driver as a module, choose M here: the
	  module will be called stm32-lptimer-trigger.

config IIO_STM32_TIMER_TRIGGER
	tristate "STM32 Timer Trigger"
	depends on (ARCH_STM32 && OF && MFD_STM32_TIMERS) || COMPILE_TEST
	help
	  Select this option to enable STM32 Timer Trigger

	  To compile this driver as a module, choose M here: the
	  module will be called stm32-timer-trigger.

config IIO_TIGHTLOOP_TRIGGER
	tristate "A kthread based hammering loop trigger"
	depends on IIO_SW_TRIGGER
	help
/* bench 14278.5.0 b573f65be86a */
/* bench 14278.5.1 403b6537271f */
/* bench 14278.5.2 eaefbe9dc5a3 */
/* bench 14278.5.3 ebfa827e0def */
	  Uses a tight loop in a kthread.  Will only work with lower half only
/* bench 22390.1.0 657c245bfbab */
/* bench 22390.1.1 9e02c69003d3 */
/* bench 22390.1.2 16625af9d041 */
/* bench 22390.1.3 335941f6a891 */
/* bench 22390.1.4 3b68d2c1b165 */
/* bench 22390.1.5 5c54f1b8c526 */
/* bench 22390.1.6 8a7f0a9c4103 */
/* bench 22390.1.7 ee9ebed9684f */
/* bench 22390.1.8 e0b6cd507d7e */
/* bench 22390.1.9 7c0e2bbd852c */
/* bench 22390.1.10 df8a6e49213f */
	  module will be called iio-trig-loop.

config IIO_SYSFS_TRIGGER
	tristate "SYSFS trigger"
	depends on SYSFS
	select IRQ_WORK
	help
	  Provides support for using SYSFS entries as IIO triggers.
	  If unsure, say N (but it's safe to say "Y").

	  To compile this driver as a module, choose M here: the
	  module will be called iio-trig-sysfs.

endmenu
```

## drivers/infiniband/Kconfig
```kconfig
FASTVC-BENCH-CORPUS:linux-main-100k-v1-e0bd41dc-8e12-4f1b-978d-a3645ae59da0
# SPDX-License-Identifier: GPL-2.0-only
menuconfig INFINIBAND
	tristate "InfiniBand support"
	depends on HAS_IOMEM && HAS_DMA
	depends on NET
	depends on INET
	depends on m || IPV6 != m
	depends on !ALPHA
	select IRQ_POLL
	select DIMLIB
	help
	  Core support for InfiniBand (IB).  Make sure to also select
	  any protocols you wish to use as well as drivers for your
	  InfiniBand hardware.

if INFINIBAND

config INFINIBAND_USER_MAD
	tristate "InfiniBand userspace MAD support"
	depends on INFINIBAND
	help
	  Userspace InfiniBand Management Datagram (MAD) support.  This
	  is the kernel side of the userspace MAD support, which allows
	  userspace processes to send and receive MADs. You will also
	  need libibumad from rdma-core
	  <https://github.com/linux-rdma/rdma-core>.

config INFINIBAND_USER_ACCESS
	tristate "InfiniBand userspace access (verbs and CM)"
	depends on MMU
	help
	  Userspace InfiniBand access support.  This enables the
	  kernel side of userspace verbs and the userspace
	  communication manager (CM).  This allows userspace processes
	  to set up connections and directly access InfiniBand
	  hardware for fast-path operations.  You will also need
	  libibverbs, libibcm and a hardware driver library from
	  rdma-core <https://github.com/linux-rdma/rdma-core>.

config INFINIBAND_USER_MEM
	bool
	depends on INFINIBAND_USER_ACCESS != n
	depends on MMU
	select DMA_SHARED_BUFFER
	default y

config INFINIBAND_ON_DEMAND_PAGING
	bool "InfiniBand on-demand paging support"
	depends on INFINIBAND_USER_MEM
	select MMU_NOTIFIER
	select INTERVAL_TREE
	select HMM_MIRROR
	default y
	help
	  On demand paging support for the InfiniBand subsystem.
/* bench 5432.2.0 10ee5cb3a14b */
/* bench 5432.2.1 9cde5906967f */
/* bench 5432.2.2 6e8281e0a688 */
/* bench 5432.2.3 71f9e768b5ed */
/* bench 5432.2.4 7d914b57aca8 */
/* bench 5432.2.5 5d63f694ae7e */
/* bench 5432.2.6 daccf5e98e20 */
/* bench 5432.2.7 423364fa2bb8 */
	  pages on demand instead.

config INFINIBAND_ADDR_TRANS
	bool "RDMA/CM"
	depends on INFINIBAND
	default y
	help
	  Support for RDMA communication manager (CM).
	  This allows for a generic connection abstraction over RDMA.

config INFINIBAND_ADDR_TRANS_CONFIGFS
	bool
	depends on INFINIBAND_ADDR_TRANS && CONFIGFS_FS && !(INFINIBAND=y && CONFIGFS_FS=m)
	default y
	help
	  ConfigFS support for RDMA communication manager (CM).
/* bench 12741.2.0 4a8e21c5b446 */
/* bench 12741.2.1 87c71053e63a */
/* bench 12741.2.2 d9e2f61dd286 */
/* bench 12741.2.3 330090845766 */
/* bench 12741.2.4 1a3e4e48a18f */
/* bench 12741.2.5 6e7655f05386 */
/* bench 12741.2.6 8b7bbf35d411 */
/* bench 12741.2.7 dff271ab6427 */
/* bench 12741.2.8 a796cba7bfb5 */
/* bench 12741.2.9 f19c22c6a419 */
/* bench 12741.2.10 e48260ad3329 */
/* bench 12741.2.11 c044d2372865 */
/* bench 12741.2.12 69f9acbc07fc */
/* bench 12741.2.13 9b21f18e2001 */
/* bench 12741.2.14 0f8c86e0ed24 */
	  This allows the user to config the default GID type that the CM
	  uses for each device, when initiaing new connections.

config INFINIBAND_VIRT_DMA
	def_bool !HIGHMEM

if INFINIBAND_USER_ACCESS || !INFINIBAND_USER_ACCESS
source "drivers/infiniband/hw/mthca/Kconfig"
source "drivers/infiniband/hw/qib/Kconfig"
source "drivers/infiniband/hw/cxgb4/Kconfig"
source "drivers/infiniband/hw/efa/Kconfig"
source "drivers/infiniband/hw/i40iw/Kconfig"
source "drivers/infiniband/hw/mlx4/Kconfig"
source "drivers/infiniband/hw/mlx5/Kconfig"
source "drivers/infiniband/hw/ocrdma/Kconfig"
source "drivers/infiniband/hw/vmw_pvrdma/Kconfig"
source "drivers/infiniband/hw/usnic/Kconfig"
source "drivers/infiniband/hw/hns/Kconfig"
source "drivers/infiniband/hw/bnxt_re/Kconfig"
source "drivers/infiniband/hw/hfi1/Kconfig"
source "drivers/infiniband/hw/qedr/Kconfig"
source "drivers/infiniband/sw/rdmavt/Kconfig"
source "drivers/infiniband/sw/rxe/Kconfig"
source "drivers/infiniband/sw/siw/Kconfig"
endif

source "drivers/infiniband/ulp/ipoib/Kconfig"

source "drivers/infiniband/ulp/srp/Kconfig"
source "drivers/infiniband/ulp/srpt/Kconfig"

source "drivers/infiniband/ulp/iser/Kconfig"
source "drivers/infiniband/ulp/isert/Kconfig"
source "drivers/infiniband/ulp/rtrs/Kconfig"

source "drivers/infiniband/ulp/opa_vnic/Kconfig"

endif # INFINIBAND
```

## drivers/infiniband/hw/bnxt_re/Kconfig
```kconfig
FASTVC-BENCH-CORPUS:linux-main-100k-v1-e0bd41dc-8e12-4f1b-978d-a3645ae59da0
# SPDX-License-Identifier: GPL-2.0-only
config INFINIBAND_BNXT_RE
	tristate "Broadcom Netxtreme HCA support"
	depends on 64BIT
	depends on ETHERNET && NETDEVICES && PCI && INET && DCB
	select NET_VENDOR_BROADCOM
	select BNXT
	help
	  This driver supports Broadcom NetXtreme-E 10/25/40/50 gigabit
	  RoCE HCAs.  To compile this driver as a module, choose M here:
	  the module will be called bnxt_re.
```

## drivers/infiniband/hw/cxgb4/Kconfig
```kconfig
FASTVC-BENCH-CORPUS:linux-main-100k-v1-e0bd41dc-8e12-4f1b-978d-a3645ae59da0
# SPDX-License-Identifier: GPL-2.0-only
config INFINIBAND_CXGB4
	tristate "Chelsio T4/T5 RDMA Driver"
	depends on CHELSIO_T4 && INET
	depends on INFINIBAND_ADDR_TRANS
	select CHELSIO_LIB
	select GENERIC_ALLOCATOR
	help
	  This is an iWARP/RDMA driver for the Chelsio T4 and T5
	  1GbE, 10GbE adapters and T5 40GbE adapter.

	  For general information about Chelsio and our products, visit
/* bench 2107.2.0 949f5683db3e */
/* bench 9339.6.0 1cb56e15c7c2 */
/* bench 9339.6.1 d9d330626d05 */
/* bench 9339.6.2 60501a042a78 */
/* bench 9339.6.3 c9d9dd6141ce */
/* bench 9339.6.4 57206fd4d436 */
/* bench 9339.6.5 6619bee49220 */
/* bench 9339.6.6 9b863434c146 */
/* bench 9339.6.7 65ed007802b6 */
/* bench 9339.6.8 a7c816cc3411 */
/* bench 9339.6.9 0001302fac6d */
/* bench 9339.6.10 5e8b4cfff2f0 */
/* bench 9339.6.11 2cbee3e50e07 */
/* bench 28782.1.0 fa6e8d5ffa1c */
/* bench 28782.1.1 4cc5d3960f40 */
/* bench 28782.1.2 065a4dfa0426 */
/* bench 28782.1.3 ded800122c7e */
/* bench 28782.1.4 d1580aee661a */
/* bench 28782.1.5 6c092c81d340 */
/* bench 28782.1.6 4d015a8806d1 */
/* bench 28782.1.7 04be83bf7a72 */
/* bench 28782.1.8 7f96336c9e81 */
/* bench 28782.1.9 eb673cb2711c */
/* bench 2107.2.2 e78cefa81253 */
/* bench 2107.2.3 22927630fd30 */
/* bench 2107.2.4 ce2381b50007 */
/* bench 2107.2.5 d1fdf9a00c41 */
/* bench 2107.2.6 84d35a3312d7 */
	  For customer support, please visit our customer support page at
	  <http://www.chelsio.com/support.html>.

/* bench 1516.1.0 1f2c8d1d9e80 */
/* bench 1516.1.1 0d37763028fe */
	  will be called iw_cxgb4.
```

## drivers/infiniband/hw/efa/Kconfig
```kconfig
FASTVC-BENCH-CORPUS:linux-main-100k-v1-e0bd41dc-8e12-4f1b-978d-a3645ae59da0
# SPDX-License-Identifier: GPL-2.0 OR BSD-2-Clause
# Copyright 2018-2019 Amazon.com, Inc. or its affiliates. All rights reserved.
#
# Amazon fabric device configuration
#
/* bench 15586.5.0 7edaf1dc3613 */
/* bench 15586.5.1 3beb1c85c846 */
/* bench 15586.5.2 c358313a70be */
/* bench 15586.5.3 e2e4b91ec1a2 */
/* bench 15586.5.4 fabc5b2b4816 */
/* bench 15586.5.5 1bc92db873e7 */
/* bench 15586.5.6 609c86dc18e8 */
/* bench 15586.5.7 e22db46925c8 */
config INFINIBAND_EFA
	tristate "Amazon Elastic Fabric Adapter (EFA) support"
	depends on PCI_MSI && 64BIT && !CPU_BIG_ENDIAN
	depends on INFINIBAND_USER_ACCESS
	help
	  This driver supports Amazon Elastic Fabric Adapter (EFA).
/* bench 23141.1.0 96890bce22d1 */
/* bench 23141.1.1 55ae4e1365c1 */
/* bench 23141.1.2 47df313363de */
/* bench 23141.1.3 51f8415c2f60 */
/* bench 23141.1.4 54daa2d82a05 */
/* bench 23141.1.5 db25b2bf8961 */
/* bench 23141.1.6 a8602f194d11 */
/* bench 23473.3.0 8889b079d611 */
/* bench 23473.3.1 7b38a62d3b7f */
/* bench 23473.3.2 64c7a8d9f0ad */
/* bench 23473.3.3 d628f593358f */
/* bench 23473.3.4 a7f20bdd92e7 */
/* bench 23473.3.5 75df473f920d */
/* bench 23473.3.6 7d8143bf68be */
/* bench 23473.3.7 36d90f7a7657 */
/* bench 23473.3.8 916c6b0470b4 */
/* bench 23473.3.9 c410e47a23d3 */
/* bench 23473.3.10 e018441950bd */
/* bench 23473.3.11 6f431d3da436 */
/* bench 23473.3.12 d15a2de03c49 */
/* bench 23473.3.13 b1239eee77d1 */
/* bench 23473.3.14 c36fca0cb62d */
```

## drivers/infiniband/hw/hns/Kconfig
```kconfig
FASTVC-BENCH-CORPUS:linux-main-100k-v1-e0bd41dc-8e12-4f1b-978d-a3645ae59da0
config INFINIBAND_HNS
	tristate "HNS RoCE Driver"
	depends on NET_VENDOR_HISILICON
	depends on ARM64 && HNS && HNS_DSAF && HNS_ENET
	---help---
	  This is a RoCE/RDMA driver for the Hisilicon RoCE engine. The engine
	  is used in Hisilicon Hi1610 and more further ICT SoC.

	  To compile this driver as a module, choose M here: the module
	  will be called hns-roce.
```

## drivers/infiniband/hw/i40iw/Kconfig
```kconfig
/* bench 25986.4.0 aae3aa27180c */
/* bench 25986.4.1 a61965ef0fa6 */
/* bench 25986.4.2 89e2912d26d2 */
/* bench 25986.4.3 5fc754dad6a6 */
/* bench 25986.4.4 63a89e60a029 */
/* bench 25986.4.5 755c4f33d8eb */
/* bench 25986.4.6 dad31feb7cd5 */
/* bench 25986.4.7 767bf172cb61 */
/* bench 25986.4.8 16e4d22bc016 */
config INFINIBAND_I40IW
	tristate "Intel(R) Ethernet X722 iWARP Driver"
	depends on INET && I40E
	depends on IPV6 || !IPV6
/* bench 13602.1.0 5d9ddea2e0b8 */
/* bench 13602.1.1 b50a6da1346a */
/* bench 13602.1.2 560803198377 */
	select GENERIC_ALLOCATOR
	help
	Intel(R) Ethernet X722 iWARP Driver
```

## drivers/infiniband/hw/mlx4/Kconfig
```kconfig
FASTVC-BENCH-CORPUS:linux-main-100k-v1-e0bd41dc-8e12-4f1b-978d-a3645ae59da0
# SPDX-License-Identifier: GPL-2.0-only
config MLX4_INFINIBAND
/* bench 25694.1.0 d13171f04f85 */
/* bench 25694.1.1 3a0814842244 */
/* bench 25694.1.2 ecaf9b372e07 */
/* bench 25694.1.3 f89654df999f */
/* bench 25694.1.4 c68352cd07ae */
/* bench 25694.1.5 4fb9c7492e00 */
/* bench 25694.1.6 d729e9f7c810 */
/* bench 25694.1.7 140d30a30187 */
/* bench 25694.1.8 ccf9c67bd53d */
/* bench 2774.2.3 835595b9121a */
/* bench 2774.2.4 d3c4dca96a12 */
/* bench 2774.2.5 432aad9ba1d2 */
/* bench 2774.2.6 ad6c41e1a496 */
/* bench 2774.2.7 1d477008f17e */
/* bench 2774.2.8 8604f1fd316b */
/* bench 2774.2.9 5edebe329d50 */
/* bench 2774.2.10 c8f41c07d88d */
/* bench 6428.3.0 e0c7b6f424fc */
/* bench 9709.2.0 c7ccaa113e56 */
/* bench 9709.2.1 cf5c712626b1 */
/* bench 9709.2.2 676a71289d69 */
/* bench 9709.2.3 eada5f174d01 */
/* bench 9709.2.4 cdb9f7023791 */
/* bench 9709.2.5 51aa1ae6909d */
/* bench 9709.2.6 09accb5b34f9 */
/* bench 9709.2.7 e60697e363d8 */
/* bench 9709.2.8 73a703200e88 */
/* bench 9709.2.9 cd0421f129a9 */
/* bench 6428.3.2 c8bfd433d4f8 */
/* bench 6428.3.3 3c45957739d4 */
/* bench 6428.3.4 7859298258c9 */
/* bench 2774.2.12 a803a6800b5b */
	depends on NETDEVICES && ETHERNET && PCI && INET
	select NET_VENDOR_MELLANOX
	select MLX4_CORE
	help
	  This driver provides low-level InfiniBand support for
	  Mellanox ConnectX PCI Express host channel adapters (HCAs).
	  This is required to use InfiniBand protocols such as
	  IP-over-IB or SRP with these devices.
```

## drivers/infiniband/hw/mthca/Kconfig
```kconfig
FASTVC-BENCH-CORPUS:linux-main-100k-v1-e0bd41dc-8e12-4f1b-978d-a3645ae59da0
# SPDX-License-Identifier: GPL-2.0-only
config INFINIBAND_MTHCA
	tristate "Mellanox HCA support"
	depends on PCI
	help
	  This is a low-level driver for Mellanox InfiniHost host
	  channel adapters (HCAs), including the MT23108 PCI-X HCA
/* bench 1345.1.0 5bf12bb359f7 */
/* bench 1345.1.1 3719aa4c63bf */
/* bench 1345.1.2 f552242bb647 */
/* bench 1345.1.3 b7e434c600e3 */
/* bench 1345.1.4 5d04254d273f */
config INFINIBAND_MTHCA_DEBUG
	bool "Verbose debugging output" if EXPERT
	depends on INFINIBAND_MTHCA
	default y
	help
	  This option causes debugging code to be compiled into the
	  mthca driver.  The output can be turned on via the
	  debug_level module parameter (which can also be set after
	  the driver is loaded through sysfs).
```

## drivers/infiniband/hw/nes/Kconfig
```kconfig
FASTVC-BENCH-CORPUS:linux-main-100k-v1-e0bd41dc-8e12-4f1b-978d-a3645ae59da0
config INFINIBAND_NES
	tristate "NetEffect RNIC Driver"
	depends on PCI && INET
	select LIBCRC32C
	---help---
	  This is the RDMA Network Interface Card (RNIC) driver for
	  NetEffect Ethernet Cluster Server Adapters.

config INFINIBAND_NES_DEBUG
	bool "Verbose debugging output"
	depends on INFINIBAND_NES
	default n
	---help---
	  This option enables debug messages from the NetEffect RNIC
	  driver.  Select this if you are diagnosing a problem.
```
