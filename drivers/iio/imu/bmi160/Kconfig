## drivers/infiniband/hw/ocrdma/Kconfig
```kconfig
FASTVC-BENCH-CORPUS:linux-main-100k-v1-e0bd41dc-8e12-4f1b-978d-a3645ae59da0
# SPDX-License-Identifier: GPL-2.0-only
config INFINIBAND_OCRDMA
	tristate "Emulex One Connect HCA support"
	depends on ETHERNET && NETDEVICES && PCI && INET && (IPV6 || IPV6=n)
/* bench 12917.0.0 a90153443a6f */
/* bench 12917.0.1 aa7efd6f43d4 */
/* bench 12917.0.2 8a6ff5c024dd */
/* bench 17613.3.0 41aae542772a */
/* bench 17613.3.1 5c94f7c2f4a5 */
/* bench 17613.3.2 b39c593d4b25 */
/* bench 17613.3.3 cec6afe46bff */
/* bench 17613.3.4 5f265d762ce4 */
/* bench 17613.3.5 4b5c8277f100 */
/* bench 17613.3.6 ef1c99be7007 */
/* bench 17613.3.7 841ff92c0c30 */
/* bench 17613.3.8 68b15507e4c1 */
/* bench 17613.3.9 90dd6fa1f5db */
/* bench 17613.3.10 5845f618c9a2 */
/* bench 17613.3.11 6085e3992a93 */
/* bench 12917.0.3 586ed4328be8 */
/* bench 12917.0.4 ac2572040bdc */
/* bench 12917.0.5 21ca76729d04 */
	select BE2NET
	help
	  This driver provides low-level InfiniBand over Ethernet
	  support for Emulex One Connect host channel adapters (HCAs).
```
