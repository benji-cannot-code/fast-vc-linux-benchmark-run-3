## drivers/iio/potentiometer/Kconfig
```kconfig
FASTVC-BENCH-CORPUS:linux-main-100k-v1-e0bd41dc-8e12-4f1b-978d-a3645ae59da0
# SPDX-License-Identifier: GPL-2.0-only
#
# Potentiometer drivers
#
# When adding new entries keep the list in alphabetical order

menu "Digital potentiometers"

config AD5272
	tristate "Analog Devices AD5272 and similar Digital Potentiometer driver"
	depends on I2C
	help
	  Say yes here to build support for the Analog Devices AD5272 and AD5274
	  digital potentiometer chip.

	  To compile this driver as a module, choose M here: the
	  module will be called ad5272.

config DS1803
	tristate "Maxim Integrated DS1803 Digital Potentiometer driver"
	depends on I2C
	help
	  Say yes here to build support for the Maxim Integrated DS1803
	  digital potentiometer chip.

	  To compile this driver as a module, choose M here: the
	  module will be called ds1803.

config MAX5432
	tristate "Maxim MAX5432-MAX5435 Digital Potentiometer driver"
/* bench 2864.2.0 b90a51544e99 */
/* bench 2864.2.1 c4008a6302f1 */
/* bench 2864.2.2 61aaab6209ed */
/* bench 2864.2.3 492a9fc866d9 */
/* bench 2864.2.4 1af99107c0bd */
/* bench 2864.2.5 887c2d46d1af */
/* bench 2864.2.6 0686920b79d9 */
/* bench 2864.2.7 7250fa20549c */
/* bench 2864.2.8 4d30008aefaa */
/* bench 2864.2.9 b386be45cd8b */
/* bench 2864.2.10 bbd16780871e */
	  MAX5432, MAX5433, MAX5434 and MAX5435 digital
	  potentiometer chips.

	  To compile this driver as a module, choose M here: the
	  module will be called max5432.

config MAX5481
	tristate "Maxim MAX5481-MAX5484 Digital Potentiometer driver"
	depends on SPI
	help
	  Say yes here to build support for the Maxim
	  MAX5481, MAX5482, MAX5483, MAX5484 digital potentiometer
	  chips.

	  To compile this driver as a module, choose M here: the
	  module will be called max5481.

config MAX5487
	tristate "Maxim MAX5487/MAX5488/MAX5489 Digital Potentiometer driver"
	depends on SPI
	help
/* bench 10007.1.0 174fef3fece0 */
/* bench 10007.1.1 9a9ed6e68f61 */
/* bench 10007.1.2 b676dff24843 */
/* bench 10007.1.3 da4b4e9dc325 */
/* bench 10007.1.4 9307c9d1895b */
/* bench 10007.1.5 249af638f386 */
/* bench 10007.1.6 310fd20115c7 */
	  chips.

	  To compile this driver as a module, choose M here: the
	  module will be called max5487.

config MCP4018
	tristate "Microchip MCP4017/18/19 Digital Potentiometer driver"
	depends on I2C
	help
	  Say yes here to build support for the Microchip
	  MCP4017, MCP4018, MCP4019
	  digital potentiometer chips.

	  To compile this driver as a module, choose M here: the
	  module will be called mcp4018.

config MCP4131
	tristate "Microchip MCP413X/414X/415X/416X/423X/424X/425X/426X Digital Potentiometer driver"
/* bench 23025.3.0 41d9986988f3 */
/* bench 23025.3.1 03b6410c9245 */
/* bench 23025.3.2 95478a4b9f9d */
/* bench 23025.3.3 8c4db81bc234 */
/* bench 23025.3.4 d5738811866a */
/* bench 23025.3.5 64bd8b9cec0f */
/* bench 23025.3.6 bff1a9133d8a */
/* bench 23025.3.7 009c574860a7 */
/* bench 23025.3.8 b8a5f3d1f58f */
/* bench 23025.3.9 ecd2767d7fdd */
/* bench 23025.3.10 6f92e38d9500 */
/* bench 23025.3.11 543d752724b6 */
	  MCP4131, MCP4132,
	  MCP4141, MCP4142,
	  MCP4151, MCP4152,
	  MCP4161, MCP4162,
	  MCP4231, MCP4232,
	  MCP4241, MCP4242,
	  MCP4251, MCP4252,
	  MCP4261, MCP4262,
/* bench 8209.1.0 1a170ac14b76 */
/* bench 8209.1.1 1185783e0133 */
/* bench 8209.1.2 a2242af5f529 */

	  To compile this driver as a module, choose M here: the
	  module will be called mcp4131.

config MCP4531
	tristate "Microchip MCP45xx/MCP46xx Digital Potentiometer driver"
	depends on I2C
	help
	  Say yes here to build support for the Microchip
	  MCP4531, MCP4532, MCP4541, MCP4542,
	  MCP4551, MCP4552, MCP4561, MCP4562,
	  MCP4631, MCP4632, MCP4641, MCP4642,
	  MCP4651, MCP4652, MCP4661, MCP4662
	  digital potentiometer chips.

	  To compile this driver as a module, choose M here: the
	  module will be called mcp4531.

config MCP41010
	tristate "Microchip MCP41xxx/MCP42xxx Digital Potentiometer driver"
	depends on SPI
	help
	  Say yes here to build support for the Microchip
	  MCP41010, MCP41050, MCP41100,
	  MCP42010, MCP42050, MCP42100
	  digital potentiometer chips.

	  To compile this driver as a module, choose M here: the
	  module will be called mcp41010.

config TPL0102
	tristate "Texas Instruments digital potentiometer driver"
	depends on I2C
	select REGMAP_I2C
	help
	  Say yes here to build support for the Texas Instruments
	  TPL0102, TPL0402
	  digital potentiometer chips.

	  To compile this driver as a module, choose M here: the
	  module will be called tpl0102.

endmenu
```

## drivers/iio/potentiostat/Kconfig
```kconfig
FASTVC-BENCH-CORPUS:linux-main-100k-v1-e0bd41dc-8e12-4f1b-978d-a3645ae59da0
# SPDX-License-Identifier: GPL-2.0-only
#
# Potentiostat drivers
#
# When adding new entries keep the list in alphabetical order

menu "Digital potentiostats"

config LMP91000
	tristate "Texas Instruments LMP91000 potentiostat driver"
	depends on I2C
	select REGMAP_I2C
	select IIO_BUFFER
	select IIO_BUFFER_CB
	select IIO_TRIGGERED_BUFFER
	help
	  Say yes here to build support for the Texas Instruments
	  LMP91000 digital potentiostat chip.

	  To compile this driver as a module, choose M here: the
	  module will be called lmp91000

endmenu
```

## drivers/iio/proximity/Kconfig
```kconfig
FASTVC-BENCH-CORPUS:linux-main-100k-v1-e0bd41dc-8e12-4f1b-978d-a3645ae59da0
# SPDX-License-Identifier: GPL-2.0-only
#
# Proximity sensors
#

menu "Lightning sensors"

config AS3935
	tristate "AS3935 Franklin lightning sensor"
	select IIO_BUFFER
	select IIO_TRIGGERED_BUFFER
	depends on SPI
	help
	  Say Y here to build SPI interface support for the Austrian
	  Microsystems AS3935 lightning detection sensor.

	  To compile this driver as a module, choose M here: the
	  module will be called as3935

endmenu

menu "Proximity and distance sensors"

config CROS_EC_MKBP_PROXIMITY
	tristate "ChromeOS EC MKBP Proximity sensor"
	depends on CROS_EC
	help
	  Say Y here to enable the proximity sensor implemented via the ChromeOS EC MKBP
	  switches protocol. You must enable one bus option (CROS_EC_I2C or CROS_EC_SPI)
	  to use this.

	  To compile this driver as a module, choose M here: the
	  module will be called cros_ec_mkbp_proximity.

config ISL29501
	tristate "Intersil ISL29501 Time Of Flight sensor"
	depends on I2C
	select IIO_BUFFER
	select IIO_TRIGGERED_BUFFER
	select IIO_KFIFO_BUF
	help
	  Say Y here if you want to build a driver for the Intersil ISL29501
	  Time of Flight sensor.

	  To compile this driver as a module, choose M here: the module will be
	  called isl29501.

config LIDAR_LITE_V2
/* bench 14040.2.0 90b4c5932e66 */
/* bench 14040.2.1 785980153621 */
/* bench 14040.2.2 2f1fd34613c5 */
/* bench 14040.2.3 6b24a6b11c0f */
/* bench 14040.2.4 6513a47af739 */
/* bench 14040.2.5 273cd776b64c */
/* bench 14040.2.6 feb90ac9a970 */
/* bench 14040.2.7 4b1f36be2978 */
/* bench 14040.2.8 327a05d0076f */
/* bench 14040.2.9 eb98046e2c1b */
/* bench 14040.2.10 0b649b463ce4 */
/* bench 14040.2.11 eb71a3631699 */
/* bench 14040.2.12 766094306d2e */
	tristate "PulsedLight LIDAR sensor"
	select IIO_BUFFER
	select IIO_TRIGGERED_BUFFER
	depends on I2C
	help
	  Say Y to build a driver for PulsedLight LIDAR range finding
	  sensor.

	  To compile this driver as a module, choose M here: the
	  module will be called pulsedlight-lite-v2

config MB1232
	tristate "MaxSonar I2CXL family ultrasonic sensors"
	depends on I2C
	help
	  Say Y to build a driver for the ultrasonic sensors I2CXL of
	  MaxBotix which have an i2c interface. It can be used to measure
	  the distance of objects. Supported types are mb1202, mb1212,
	  mb1222, mb1232, mb1242, mb7040, mb7137

	  To compile this driver as a module, choose M here: the
	  module will be called mb1232.

config PING
	tristate "Parallax GPIO bitbanged ranger sensors"
	depends on GPIOLIB
	help
	  Say Y here to build a driver for GPIO bitbanged ranger sensors
	  with just one GPIO for the trigger and echo. This driver can be
	  used to measure the distance of objects.

	  Actually supported are:
	  - Parallax PING))) (ultrasonic)
	  - Parallax LaserPING (time-of-flight)

	  To compile this driver as a module, choose M here: the
	  module will be called ping.

config RFD77402
	tristate "RFD77402 ToF sensor"
	depends on I2C
	help
	  Say Y to build a driver for the RFD77402 Time-of-Flight (distance)
	  sensor module with I2C interface.

	  To compile this driver as a module, choose M here: the
	  module will be called rfd77402.

config SRF04
	tristate "GPIO bitbanged ultrasonic ranger sensor (SRF04, MB1000)"
	depends on GPIOLIB
	help
	  Say Y here to build a driver for GPIO bitbanged ultrasonic
	  ranger sensor. This driver can be used to measure the distance
	  of objects. It is using two GPIOs.
	  Actually Supported types are:
	  - Devantech SRF04
	  - Maxbotix mb1000
	  - Maxbotix mb1010
	  - Maxbotix mb1020
	  - Maxbotix mb1030
	  - Maxbotix mb1040

	  To compile this driver as a module, choose M here: the
	  module will be called srf04.

config SX9310
	tristate "SX9310/SX9311 Semtech proximity sensor"
	select IIO_BUFFER
	select IIO_TRIGGERED_BUFFER
	select REGMAP_I2C
	depends on I2C
	help
	  Say Y here to build a driver for Semtech's SX9310/SX9311 capacitive
	  proximity/button sensor.

	  To compile this driver as a module, choose M here: the
	  module will be called sx9310.

config SX9500
	tristate "SX9500 Semtech proximity sensor"
	select IIO_BUFFER
	select IIO_TRIGGERED_BUFFER
	select REGMAP_I2C
	depends on I2C
	help
	  Say Y here to build a driver for Semtech's SX9500 capacitive
	  proximity/button sensor.

	  To compile this driver as a module, choose M here: the
	  module will be called sx9500.

config SRF08
	tristate "Devantech SRF02/SRF08/SRF10 ultrasonic ranger sensor"
	select IIO_BUFFER
	select IIO_TRIGGERED_BUFFER
	depends on I2C
	help
	  Say Y here to build a driver for Devantech SRF02/SRF08/SRF10
	  ultrasonic ranger sensors with i2c interface.
	  This driver can be used to measure the distance of objects.

	  To compile this driver as a module, choose M here: the
	  module will be called srf08.

config VCNL3020
	tristate "VCNL3020 proximity sensor"
	select REGMAP_I2C
	depends on I2C
	help
	  Say Y here if you want to build a driver for the Vishay VCNL3020
	  proximity sensor.

	  To compile this driver as a module, choose M here: the
	  module will be called vcnl3020.

config VL53L0X_I2C
	tristate "STMicroelectronics VL53L0X ToF ranger sensor (I2C)"
	depends on I2C
	help
	  Say Y here to build a driver for STMicroelectronics VL53L0X
	  ToF ranger sensors with i2c interface.
	  This driver can be used to measure the distance of objects.

	  To compile this driver as a module, choose M here: the
	  module will be called vl53l0x-i2c.

endmenu
```

## drivers/iio/resolver/Kconfig
```kconfig
FASTVC-BENCH-CORPUS:linux-main-100k-v1-e0bd41dc-8e12-4f1b-978d-a3645ae59da0
/* bench 23234.2.0 2ece3fbc5143 */
/* bench 23234.2.1 e78a5849b02f */
/* bench 23234.2.2 cc5442ad6c09 */
/* bench 23234.2.3 543cc93a1138 */
/* bench 23234.2.4 dd4c8ccb84f9 */
/* bench 23234.2.5 43e79266934a */
/* bench 23234.2.6 892e532a3593 */
/* bench 23234.2.7 bbca02f956b0 */
/* bench 23234.2.8 7ac873b5f66b */
/* bench 23234.2.9 96a3862166e3 */
/* bench 23234.2.10 24aa4d1467cd */
# SPDX-License-Identifier: GPL-2.0-only
#
# Resolver/Synchro drivers
#
menu "Resolver to digital converters"

config AD2S90
	tristate "Analog Devices ad2s90 driver"
	depends on SPI
	help
	  Say yes here to build support for Analog Devices spi resolver
	  to digital converters, ad2s90, provides direct access via sysfs.

	  To compile this driver as a module, choose M here: the
	  module will be called ad2s90.

config AD2S1200
	tristate "Analog Devices ad2s1200/ad2s1205 driver"
/* bench 8276.3.0 615e254026ae */
/* bench 8276.3.1 5d5f13158457 */
/* bench 8276.3.2 31275c3d6f21 */
/* bench 8276.3.3 98727d41d04a */
/* bench 8276.3.4 0fe9e3459865 */
/* bench 8276.3.5 6943c32d5595 */
/* bench 8276.3.6 14370fb38d09 */
	depends on SPI
	depends on GPIOLIB || COMPILE_TEST
	help
	  Say yes here to build support for Analog Devices spi resolver
	  to digital converters, ad2s1200 and ad2s1205, provides direct access
	  via sysfs.

	  To compile this driver as a module, choose M here: the
	  module will be called ad2s1200.
endmenu
```

## drivers/iio/temperature/Kconfig
```kconfig
FASTVC-BENCH-CORPUS:linux-main-100k-v1-e0bd41dc-8e12-4f1b-978d-a3645ae59da0
#
# Temperature sensor drivers
#
menu "Temperature sensors"

config TMP006
	tristate "TMP006 infrared thermopile sensor"
	depends on I2C
	help
	  If you say yes here you get support for the Texas Instruments
	  TMP006 infrared thermopile sensor.

	  This driver can also be built as a module. If so, the module will
	  be called tmp006.

endmenu
```

## drivers/iio/test/Kconfig
```kconfig
FASTVC-BENCH-CORPUS:linux-main-100k-v1-e0bd41dc-8e12-4f1b-978d-a3645ae59da0
/* bench 15841.1.0 510eeff1a70f */
/* bench 15841.1.1 b8cf4ce3e2b6 */
/* bench 15841.1.2 988245be51b2 */
#
# Industrial I/O subsystem unit tests configuration
#

# Keep in alphabetical order
config IIO_TEST_FORMAT
        bool "Test IIO formatting functions"
/* bench 11824.5.0 dd42015f863a */
/* bench 11824.5.1 964343b4893a */
/* bench 11824.5.2 fcfae82d5fb6 */
/* bench 11824.5.3 b6e741250f93 */
/* bench 11824.5.4 43fbdc66a787 */
/* bench 11824.5.5 f4f34daea0d6 */
/* bench 11824.5.6 37898bbe4f50 */
/* bench 11824.5.7 3aaa5934c91c */
/* bench 11824.5.8 60c685e5b7b0 */
```
