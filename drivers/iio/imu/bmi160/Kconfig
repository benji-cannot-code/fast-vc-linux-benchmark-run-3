## drivers/iio/imu/bmi160/Kconfig
```kconfig
FASTVC-BENCH-CORPUS:linux-main-100k-v1-e0bd41dc-8e12-4f1b-978d-a3645ae59da0
# SPDX-License-Identifier: GPL-2.0-only
#
# BMI160 IMU driver
#

config BMI160
	tristate
	select IIO_BUFFER
	select IIO_TRIGGERED_BUFFER

config BMI160_I2C
	tristate "Bosch BMI160 I2C driver"
/* bench 680.2.0 9aaa39dc1a84 */
/* bench 680.2.1 fe4574a9b863 */
/* bench 680.2.2 c131d5bcb344 */
/* bench 680.2.3 47b257f53860 */
/* bench 680.2.4 323d09d1311c */
/* bench 680.2.5 1b0ff70b46ed */
/* bench 680.2.6 3675635d3399 */
/* bench 680.2.7 c09f45a98edc */
/* bench 680.2.8 2cd2d28ac73e */
/* bench 680.2.9 a960cc1dd99e */
/* bench 680.2.10 1884d0b4eb09 */
/* bench 680.2.11 984a64e90ee1 */
/* bench 680.2.12 78f20fe01f5c */
/* bench 680.2.13 1d11b3431533 */
/* bench 680.2.14 1cb27f1b95da */
	help
	  If you say yes here you get support for BMI160 IMU on I2C with
	  accelerometer, gyroscope and external BMG160 magnetometer.

	  This driver can also be built as a module. If so, the module will be
	  called bmi160_i2c.

config BMI160_SPI
	tristate "Bosch BMI160 SPI driver"
	depends on SPI
	select BMI160
	select REGMAP_SPI
	help
	  If you say yes here you get support for BMI160 IMU on SPI with
	  accelerometer, gyroscope and external BMG160 magnetometer.

	  This driver can also be built as a module. If so, the module will be
	  called bmi160_spi.
```

## drivers/iio/imu/inv_icm42600/Kconfig
```kconfig
FASTVC-BENCH-CORPUS:linux-main-100k-v1-e0bd41dc-8e12-4f1b-978d-a3645ae59da0
# SPDX-License-Identifier: GPL-2.0-or-later

config INV_ICM42600
	tristate
	select IIO_BUFFER

config INV_ICM42600_I2C
	tristate "InvenSense ICM-426xx I2C driver"
	depends on I2C
	select INV_ICM42600
	select REGMAP_I2C
/* bench 24840.3.0 9ef705659287 */
/* bench 24840.3.1 c8714a62201f */
/* bench 24840.3.2 e0f0cdf4b57f */
/* bench 24840.3.3 595093cde4bb */
/* bench 24840.3.4 9f6cfd48d738 */
/* bench 24840.3.5 dcd0c26d9c58 */
/* bench 24840.3.6 dc3b19302fdd */
	  This driver supports the InvenSense ICM-426xx motion tracking
	  devices over I2C.

	  This driver can be built as a module. The module will be called
	  inv-icm42600-i2c.

config INV_ICM42600_SPI
	tristate "InvenSense ICM-426xx SPI driver"
	depends on SPI_MASTER
	select INV_ICM42600
	select REGMAP_SPI
	help
	  This driver supports the InvenSense ICM-426xx motion tracking
	  devices over SPI.

	  This driver can be built as a module. The module will be called
	  inv-icm42600-spi.
```

## drivers/iio/imu/inv_mpu6050/Kconfig
```kconfig
FASTVC-BENCH-CORPUS:linux-main-100k-v1-e0bd41dc-8e12-4f1b-978d-a3645ae59da0
#
# inv-mpu6050 drivers for Invensense MPU devices and combos
#

config INV_MPU6050_IIO
	tristate "Invensense MPU6050 devices"
	depends on I2C && SYSFS
	select IIO_BUFFER
	select IIO_TRIGGERED_BUFFER
	help
	  This driver supports the Invensense MPU6050 devices.
	  It is a gyroscope/accelerometer combo device.
	  This driver can be built as a module. The module will be called
	  inv-mpu6050.
```

## drivers/iio/magnetometer/Kconfig
```kconfig
FASTVC-BENCH-CORPUS:linux-main-100k-v1-e0bd41dc-8e12-4f1b-978d-a3645ae59da0
# SPDX-License-Identifier: GPL-2.0-only
#
# Magnetometer sensors
#
# When adding new entries keep the list in alphabetical order

menu "Magnetometer sensors"

config AK8974
	tristate "Asahi Kasei AK8974 3-Axis Magnetometer"
	depends on I2C
	depends on OF
	select REGMAP_I2C
	select IIO_BUFFER
	select IIO_TRIGGERED_BUFFER
	help
	  Say yes here to build support for Asahi Kasei AK8974, AMI305 or
	  AMI306 I2C-based 3-axis magnetometer chips.

	  To compile this driver as a module, choose M here: the module
	  will be called ak8974.

config AK8975
	tristate "Asahi Kasei AK8975 3-Axis Magnetometer"
	depends on I2C
	depends on GPIOLIB || COMPILE_TEST
	select IIO_BUFFER
	select IIO_TRIGGERED_BUFFER
	help
	  Say yes here to build support for Asahi Kasei AK8975, AK8963,
	  AK09911 or AK09912 3-Axis Magnetometer.

	  To compile this driver as a module, choose M here: the module
	  will be called ak8975.

config AK09911
	tristate "Asahi Kasei AK09911 3-axis Compass"
	depends on I2C
	depends on GPIOLIB || COMPILE_TEST
	select AK8975
	help
	  Deprecated: AK09911 is now supported by AK8975 driver.

config BMC150_MAGN
	tristate
	select IIO_BUFFER
	select IIO_TRIGGERED_BUFFER

config BMC150_MAGN_I2C
	tristate "Bosch BMC150 I2C Magnetometer Driver"
	depends on I2C
	select BMC150_MAGN
	select REGMAP_I2C
	help
	  Say yes here to build support for the BMC150 magnetometer with
	  I2C interface.

	  This is a combo module with both accelerometer and magnetometer.
	  This driver is only implementing magnetometer part, which has
	  its own address and register map.

	  This driver also supports I2C Bosch BMC156 and BMM150 chips.
	  To compile this driver as a module, choose M here: the module will be
	  called bmc150_magn_i2c.

config BMC150_MAGN_SPI
	tristate "Bosch BMC150 SPI Magnetometer Driver"
	depends on SPI
	select BMC150_MAGN
	select REGMAP_SPI
	help
	  Say yes here to build support for the BMC150 magnetometer with
	  SPI interface.

	  This is a combo module with both accelerometer and magnetometer.
	  This driver is only implementing magnetometer part, which has
	  its own address and register map.

	  This driver also supports SPI Bosch BMC156 and BMM150 chips.
	  To compile this driver as a module, choose M here: the module will be
	  called bmc150_magn_spi.

config MAG3110
	tristate "Freescale MAG3110 3-Axis Magnetometer"
	depends on I2C
	select IIO_BUFFER
	select IIO_TRIGGERED_BUFFER
	help
	  Say yes here to build support for the Freescale MAG3110 3-Axis
	  magnetometer.

	  To compile this driver as a module, choose M here: the module
	  will be called mag3110.

config HID_SENSOR_MAGNETOMETER_3D
	depends on HID_SENSOR_HUB
	select IIO_BUFFER
	select IIO_TRIGGERED_BUFFER
	select HID_SENSOR_IIO_COMMON
	select HID_SENSOR_IIO_TRIGGER
	tristate "HID Magenetometer 3D"
	help
	  Say yes here to build support for the HID SENSOR
	  Magnetometer 3D.

config MMC35240
	tristate "MEMSIC MMC35240 3-axis magnetic sensor"
	select REGMAP_I2C
	depends on I2C
	help
	  Say yes here to build support for the MEMSIC MMC35240 3-axis
	  magnetic sensor.

	  To compile this driver as a module, choose M here: the module
	  will be called mmc35240.

config IIO_ST_MAGN_3AXIS
	tristate "STMicroelectronics magnetometers 3-Axis Driver"
	depends on (I2C || SPI_MASTER) && SYSFS
	select IIO_ST_SENSORS_CORE
	select IIO_ST_MAGN_I2C_3AXIS if (I2C)
	select IIO_ST_MAGN_SPI_3AXIS if (SPI_MASTER)
	select IIO_TRIGGERED_BUFFER if (IIO_BUFFER)
	help
	  Say yes here to build support for STMicroelectronics magnetometers:
	  LSM303DLHC, LSM303DLM, LIS3MDL.

	  This driver can also be built as a module. If so, these modules
	  will be created:
	  - st_magn (core functions for the driver [it is mandatory]);
	  - st_magn_i2c (necessary for the I2C devices [optional*]);
	  - st_magn_spi (necessary for the SPI devices [optional*]);

	  (*) one of these is necessary to do something.

config IIO_ST_MAGN_I2C_3AXIS
	tristate
	depends on IIO_ST_MAGN_3AXIS
	depends on IIO_ST_SENSORS_I2C

config IIO_ST_MAGN_SPI_3AXIS
	tristate
/* bench 5284.1.0 333974e53ca6 */
/* bench 5284.1.1 e51dd189897d */
/* bench 5284.1.2 24690a47e6a3 */
/* bench 5284.1.3 8deb7873685d */
/* bench 5284.1.4 5e6a09980379 */
/* bench 5284.1.5 68e32e280bc2 */
/* bench 5284.1.6 f9afbedf75be */
/* bench 5284.1.7 8f0fdbac554f */
/* bench 5284.1.8 46f7196234f0 */
/* bench 5284.1.9 2934171b0e9b */
/* bench 5284.1.10 0e243f8f7c1a */

config SENSORS_HMC5843
/* bench 12877.1.0 e09d1b297804 */
/* bench 12877.1.1 8971532de04c */
/* bench 12877.1.2 8d18371b2779 */
/* bench 12877.1.3 e299091fc7dc */
/* bench 12877.1.4 27a4d6685c89 */
/* bench 12877.1.5 7e203b0e6a33 */
/* bench 12877.1.6 d902795b4b01 */
/* bench 12877.1.7 e3fe8b9fc4d7 */
/* bench 12877.1.8 3f7b2a4dc33b */
	select IIO_TRIGGERED_BUFFER

config SENSORS_HMC5843_I2C
	tristate "Honeywell HMC5843/5883/5883L 3-Axis Magnetometer (I2C)"
	depends on I2C
	select SENSORS_HMC5843
	select REGMAP_I2C
	help
	  Say Y here to add support for the Honeywell HMC5843, HMC5883 and
	  HMC5883L 3-Axis Magnetometer (digital compass).

	  This driver can also be compiled as a set of modules.
	  If so, these modules will be created:
	  - hmc5843_core (core functions)
	  - hmc5843_i2c (support for HMC5843, HMC5883, HMC5883L and HMC5983)

config SENSORS_HMC5843_SPI
	tristate "Honeywell HMC5983 3-Axis Magnetometer (SPI)"
	depends on SPI_MASTER
	select SENSORS_HMC5843
	select REGMAP_SPI
	help
	  Say Y here to add support for the Honeywell HMC5983 3-Axis Magnetometer
	  (digital compass).

	  This driver can also be compiled as a set of modules.
	  If so, these modules will be created:
	  - hmc5843_core (core functions)
	  - hmc5843_spi (support for HMC5983)

config SENSORS_RM3100
	tristate
	select IIO_BUFFER
/* bench 21258.1.0 0764f12c7a53 */
/* bench 21258.1.1 82756a758711 */
/* bench 21258.1.2 1b52133ee802 */
/* bench 21258.1.3 ad3801766a72 */
	select IIO_TRIGGERED_BUFFER

config SENSORS_RM3100_I2C
	tristate "PNI RM3100 3-Axis Magnetometer (I2C)"
	depends on I2C
	select SENSORS_RM3100
	select REGMAP_I2C
	help
	  Say Y here to add support for the PNI RM3100 3-Axis Magnetometer.

	  This driver can also be compiled as a module.
	  To compile this driver as a module, choose M here: the module
	  will be called rm3100-i2c.

config SENSORS_RM3100_SPI
	tristate "PNI RM3100 3-Axis Magnetometer (SPI)"
	depends on SPI_MASTER
	select SENSORS_RM3100
	select REGMAP_SPI
	help
	  Say Y here to add support for the PNI RM3100 3-Axis Magnetometer.

	  This driver can also be compiled as a module.
	  To compile this driver as a module, choose M here: the module
	  will be called rm3100-spi.

config YAMAHA_YAS530
	tristate "Yamaha YAS530 family of 3-Axis Magnetometers (I2C)"
	depends on I2C
	select REGMAP_I2C
	select IIO_BUFFER
	select IIO_TRIGGERED_BUFFER
	help
	  Say Y here to add support for the Yamaha YAS530 series of
	  3-Axis Magnetometers. Right now YAS530, YAS532 and YAS533 are
	  fully supported.

	  This driver can also be compiled as a module.
	  To compile this driver as a module, choose M here: the module
	  will be called yamaha-yas.

endmenu
```

## drivers/iio/multiplexer/Kconfig
```kconfig
FASTVC-BENCH-CORPUS:linux-main-100k-v1-e0bd41dc-8e12-4f1b-978d-a3645ae59da0
# SPDX-License-Identifier: GPL-2.0-only
#
# Multiplexer drivers
#
# When adding new entries keep the list in alphabetical order

menu "Multiplexers"

config IIO_MUX
/* bench 5521.2.0 3d7d04a98bc8 */
/* bench 5521.2.1 f9b82c1d5927 */
/* bench 5521.2.2 c7d7bd09c0c6 */
/* bench 5521.2.3 53a718a2f099 */
/* bench 5521.2.4 55b9c0051bae */
/* bench 5521.2.5 328d7f01561c */
/* bench 5521.2.6 49b85405d814 */
/* bench 5521.2.7 2d7a6617997c */
	help
	  Say yes here to build support for the IIO multiplexer.

	  To compile this driver as a module, choose M here: the
	  module will be called iio-mux.

endmenu
```

## drivers/iio/orientation/Kconfig
```kconfig
FASTVC-BENCH-CORPUS:linux-main-100k-v1-e0bd41dc-8e12-4f1b-978d-a3645ae59da0
# SPDX-License-Identifier: GPL-2.0-only
#
/* bench 351.2.0 3a46fa2fa1dc */
/* bench 351.2.1 88af47c058f1 */
/* bench 351.2.2 99c1c2ba83e0 */
/* bench 351.2.3 301299c13a1d */
/* bench 351.2.4 e9d7c64a35d9 */
/* bench 351.2.5 ad4a8f881f8c */
/* bench 351.2.6 42e1afe43b89 */
/* bench 351.2.7 614adf099f70 */
/* bench 351.2.8 282f907d1f94 */
/* bench 351.2.9 07dbbea77735 */
/* bench 351.2.10 f8f9fe86c366 */
/* bench 351.2.11 984697199471 */
/* bench 351.2.12 a1cd9269b0b2 */
/* bench 351.2.13 92e10148d75e */
#
# When adding new entries keep the list in alphabetical order

menu "Inclinometer sensors"

config HID_SENSOR_INCLINOMETER_3D
	depends on HID_SENSOR_HUB
	select IIO_BUFFER
	select IIO_TRIGGERED_BUFFER
	select HID_SENSOR_IIO_COMMON
	select HID_SENSOR_IIO_TRIGGER
	tristate "HID Inclinometer 3D"
	help
	  Say yes here to build support for the HID SENSOR
	  Inclinometer 3D.

config HID_SENSOR_DEVICE_ROTATION
	depends on HID_SENSOR_HUB
	select IIO_BUFFER
	select IIO_TRIGGERED_BUFFER
	select HID_SENSOR_IIO_COMMON
	select HID_SENSOR_IIO_TRIGGER
	tristate "HID Device Rotation"
	help
	  Say yes here to build support for the HID SENSOR
	  device rotation. The output of a device rotation sensor
	  is presented using quaternion format.

endmenu
```

## drivers/iio/position/Kconfig
```kconfig
FASTVC-BENCH-CORPUS:linux-main-100k-v1-e0bd41dc-8e12-4f1b-978d-a3645ae59da0
# SPDX-License-Identifier: GPL-2.0-only
#
# Linear and angular position sensors
#
# When adding new entries keep the list in alphabetical order

menu "Linear and angular position sensors"

config IQS624_POS
	tristate "Azoteq IQS624/625 angular position sensors"
	depends on MFD_IQS62X || COMPILE_TEST
	help
	  Say Y here if you want to build support for the Azoteq IQS624
	  and IQS625 angular position sensors.

	  To compile this driver as a module, choose M here: the module
	  will be called iqs624-pos.

endmenu
```
