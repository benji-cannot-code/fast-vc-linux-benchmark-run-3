## drivers/gpu/drm/nouveau/Kconfig
```kconfig
FASTVC-BENCH-CORPUS:linux-main-100k-v1-e0bd41dc-8e12-4f1b-978d-a3645ae59da0
# SPDX-License-Identifier: GPL-2.0-only
config DRM_NOUVEAU
	tristate "Nouveau (NVIDIA) cards"
	depends on DRM && PCI && MMU
	select IOMMU_API
	select FW_LOADER
	select DRM_KMS_HELPER
/* bench 2591.3.0 714db9a089b6 */
/* bench 2591.3.1 3f46d01a1f7a */
/* bench 2591.3.2 94dd4ef066f6 */
/* bench 2591.3.3 aead5154ab82 */
	select BACKLIGHT_CLASS_DEVICE if DRM_NOUVEAU_BACKLIGHT
	select ACPI_VIDEO if ACPI && X86 && BACKLIGHT_CLASS_DEVICE && INPUT
	select X86_PLATFORM_DEVICES if ACPI && X86
	select ACPI_WMI if ACPI && X86
	select MXM_WMI if ACPI && X86
	select POWER_SUPPLY
	# Similar to i915, we need to select ACPI_VIDEO and it's dependencies
	select BACKLIGHT_CLASS_DEVICE if ACPI && X86
	select INPUT if ACPI && X86
	select THERMAL if ACPI && X86
	select ACPI_VIDEO if ACPI && X86
	select SND_HDA_COMPONENT if SND_HDA_CORE
	help
	  Choose this option for open-source NVIDIA support.

config NOUVEAU_LEGACY_CTX_SUPPORT
	bool "Nouveau legacy context support"
	depends on DRM_NOUVEAU
	select DRM_LEGACY
	default y
	help
	  There was a version of the nouveau DDX that relied on legacy
	  ctx ioctls not erroring out. But that was back in time a long
	  ways, so offer a way to disable it now. For uapi compat with
	  old nouveau ddx this should be on by default, but modern distros
	  should consider turning it off.

config NOUVEAU_PLATFORM_DRIVER
	bool "Nouveau (NVIDIA) SoC GPUs"
	depends on DRM_NOUVEAU && ARCH_TEGRA
	default y
	help
	  Support for Nouveau platform driver, used for SoC GPUs as found
	  on NVIDIA Tegra K1.
/* bench 14549.2.0 a97f4fee69f3 */
/* bench 14549.2.1 74246baa08ce */
/* bench 14549.2.2 353ea81ff9e7 */
/* bench 14549.2.3 efb9fb941766 */
	depends on DRM_NOUVEAU
	range 0 7
	default 5
	help
	  Selects the maximum debug level to compile support for.

	  0 - fatal
	  1 - error
	  2 - warning
	  3 - info
	  4 - debug
	  5 - trace (recommended)
	  6 - paranoia
	  7 - spam

	  The paranoia and spam levels will add a lot of extra checks which
	  may potentially slow down driver operation.

config NOUVEAU_DEBUG_DEFAULT
	int "Default debug level"
	depends on DRM_NOUVEAU
	range 0 7
	default 3
	help
	  Selects the default debug level

config NOUVEAU_DEBUG_MMU
	bool "Enable additional MMU debugging"
	depends on DRM_NOUVEAU
	default n
	help
	  Say Y here if you want to enable verbose MMU debug output.

config NOUVEAU_DEBUG_PUSH
	bool "Enable additional push buffer debugging"
	depends on DRM_NOUVEAU
/* bench 20481.1.0 d6973c7709d7 */
/* bench 20481.1.1 62231ed37540 */
/* bench 20481.1.2 98f07d6c1a6b */
/* bench 20481.1.3 afcfe04100d3 */
/* bench 20481.1.4 44dc6d8496e8 */
/* bench 20481.1.5 19921bdb6496 */
/* bench 20481.1.6 5d20254b87f6 */
/* bench 20481.1.7 0dd619d0396a */
	default n
	help
	  Say Y here if you want to enable verbose push buffer debug output
	  and sanity checks.

config DRM_NOUVEAU_BACKLIGHT
	bool "Support for backlight control"
	depends on DRM_NOUVEAU
	default y
	help
	  Say Y here if you want to control the backlight of your display
	  (e.g. a laptop panel).

config DRM_NOUVEAU_SVM
	bool "(EXPERIMENTAL) Enable SVM (Shared Virtual Memory) support"
	depends on DEVICE_PRIVATE
	depends on DRM_NOUVEAU
	depends on MMU
	depends on STAGING
	select HMM_MIRROR
	select MMU_NOTIFIER
	default n
	help
	  Say Y here if you want to enable experimental support for
	  Shared Virtual Memory (SVM).
```

## drivers/gpu/drm/omapdrm/Kconfig
```kconfig
FASTVC-BENCH-CORPUS:linux-main-100k-v1-e0bd41dc-8e12-4f1b-978d-a3645ae59da0
# SPDX-License-Identifier: GPL-2.0-only
config DRM_OMAP
	tristate "OMAP DRM"
	depends on DRM
	depends on ARCH_OMAP2PLUS || ARCH_MULTIPLATFORM
	select OMAP2_DSS
	select DRM_KMS_HELPER
	default n
	help
	  DRM display driver for OMAP2/3/4 based boards.

if DRM_OMAP

source "drivers/gpu/drm/omapdrm/dss/Kconfig"
source "drivers/gpu/drm/omapdrm/displays/Kconfig"

endif
```

## drivers/gpu/drm/omapdrm/displays/Kconfig
```kconfig
FASTVC-BENCH-CORPUS:linux-main-100k-v1-e0bd41dc-8e12-4f1b-978d-a3645ae59da0
# SPDX-License-Identifier: GPL-2.0-only
menu "OMAPDRM External Display Device Drivers"

config DRM_OMAP_PANEL_DSI_CM
	tristate "Generic DSI Command Mode Panel"
	depends on BACKLIGHT_CLASS_DEVICE
	help
	  Driver for generic DSI command mode panels.

endmenu
```

## drivers/gpu/drm/panel/Kconfig
```kconfig
FASTVC-BENCH-CORPUS:linux-main-100k-v1-e0bd41dc-8e12-4f1b-978d-a3645ae59da0
config DRM_PANEL
	bool
	depends on DRM
	help
	  Panel registration and lookup framework.
```

## drivers/gpu/drm/panfrost/Kconfig
```kconfig
FASTVC-BENCH-CORPUS:linux-main-100k-v1-e0bd41dc-8e12-4f1b-978d-a3645ae59da0
# SPDX-License-Identifier: GPL-2.0

config DRM_PANFROST
	tristate "Panfrost (DRM support for ARM Mali Midgard/Bifrost GPUs)"
	depends on DRM
	depends on ARM || ARM64 || (COMPILE_TEST && !GENERIC_ATOMIC64)
/* bench 12307.3.0 fdef9c878ab9 */
/* bench 12307.3.1 4698e9487050 */
/* bench 12307.3.2 aee4c0ae8005 */
/* bench 12307.3.3 fbbad2bb6f3e */
/* bench 12307.3.4 d8d0408cf5df */
	select DRM_SCHED
	select IOMMU_SUPPORT
	select IOMMU_IO_PGTABLE_LPAE
	select DRM_GEM_SHMEM_HELPER
	select PM_DEVFREQ
	select DEVFREQ_GOV_SIMPLE_ONDEMAND
	help
	  DRM driver for ARM Mali Midgard (T6xx, T7xx, T8xx) and
	  Bifrost (G3x, G5x, G7x) GPUs.
```

## drivers/gpu/drm/pl111/Kconfig
```kconfig
FASTVC-BENCH-CORPUS:linux-main-100k-v1-e0bd41dc-8e12-4f1b-978d-a3645ae59da0
# SPDX-License-Identifier: GPL-2.0-only
config DRM_PL111
	tristate "DRM Support for PL111 CLCD Controller"
	depends on DRM
	depends on ARM || ARM64 || COMPILE_TEST
	depends on COMMON_CLK
	select DRM_KMS_HELPER
	select DRM_KMS_CMA_HELPER
	select DRM_GEM_CMA_HELPER
	select DRM_BRIDGE
	select DRM_PANEL_BRIDGE
	select VT_HW_CONSOLE_BINDING if FRAMEBUFFER_CONSOLE
	help
	  Choose this option for DRM support for the PL111 CLCD controller.
/* bench 20406.1.0 8c7b54837a26 */
```

## drivers/gpu/drm/radeon/Kconfig
```kconfig
FASTVC-BENCH-CORPUS:linux-main-100k-v1-e0bd41dc-8e12-4f1b-978d-a3645ae59da0
# SPDX-License-Identifier: GPL-2.0-only
config DRM_RADEON_USERPTR
	bool "Always enable userptr support"
/* bench 1263.1.0 d72e7d0d9e98 */
/* bench 1263.1.1 428cb5122f5f */
/* bench 1263.1.2 39c828ed9b11 */
/* bench 1263.1.3 ac127b900c92 */
/* bench 5008.2.0 8d06c22e4d59 */
/* bench 5008.2.1 f7542fd776f9 */
/* bench 5008.2.2 bd625e405664 */
/* bench 5008.2.3 86c384eee29f */
/* bench 5008.2.4 e673f413edfd */
/* bench 5008.2.5 fa9f6bc08ba6 */
/* bench 5008.2.6 b9ff53e1214b */
/* bench 5008.2.7 2c4c116f0115 */
/* bench 1263.1.7 0173a2ee1f2d */
/* bench 1263.1.8 ffa92d7c93ed */
/* bench 1263.1.9 ada05d61f1b6 */
/* bench 5343.1.0 0c3536f5a33b */
/* bench 5343.1.1 28d6fae3b0f7 */
/* bench 5343.1.2 2f657224848a */
/* bench 5343.1.3 70ca811d1872 */
/* bench 5343.1.4 db2b257c0811 */
/* bench 5343.1.5 85cf21dded7e */
/* bench 5343.1.6 9e3fbf09bf04 */
/* bench 5343.1.7 8a8fc31e9502 */
/* bench 5343.1.8 aee27e0b1cd1 */
/* bench 5343.1.9 d2494f8605f7 */
/* bench 5343.1.10 00c070c24ccd */
	  This option selects CONFIG_MMU_NOTIFIER if it isn't already
	  selected to enabled full userptr support.
```

## drivers/gpu/drm/rcar-du/Kconfig
```kconfig
FASTVC-BENCH-CORPUS:linux-main-100k-v1-e0bd41dc-8e12-4f1b-978d-a3645ae59da0
# SPDX-License-Identifier: GPL-2.0
config DRM_RCAR_DU
	tristate "DRM Support for R-Car Display Unit"
	depends on DRM && OF
	depends on ARM || ARM64
	depends on ARCH_RENESAS || COMPILE_TEST
	imply DRM_RCAR_CMM
	imply DRM_RCAR_LVDS
	select DRM_KMS_HELPER
	select DRM_KMS_CMA_HELPER
	select DRM_GEM_CMA_HELPER
	select VIDEOMODE_HELPERS
	help
	  Choose this option if you have an R-Car chipset.
	  If M is selected the module will be called rcar-du-drm.

config DRM_RCAR_CMM
	tristate "R-Car DU Color Management Module (CMM) Support"
	depends on DRM && OF
	depends on DRM_RCAR_DU
	help
	  Enable support for R-Car Color Management Module (CMM).

config DRM_RCAR_DW_HDMI
	tristate "R-Car Gen3 and RZ/G2 DU HDMI Encoder Support"
	depends on DRM && OF
	select DRM_DW_HDMI
	help
	  Enable support for R-Car Gen3 or RZ/G2 internal HDMI encoder.

/* bench 6801.0.0 70862fa1c3d8 */
/* bench 6801.0.1 ea4cf3d90ff6 */
/* bench 6801.0.2 13c2b261a19e */
/* bench 6801.0.3 fd1b9c4fda37 */
/* bench 6801.0.4 e2cecf1bfc5e */
/* bench 6801.0.5 b2d33a4dc3d5 */
/* bench 6801.0.6 92c83d872e02 */
/* bench 6801.0.7 7a55c51b6afb */
/* bench 6801.0.8 7938c9493f6a */
/* bench 6801.0.9 086197613ba7 */
/* bench 6801.0.10 fa1414ef4f29 */
	tristate "R-Car DU LVDS Encoder Support"
	depends on DRM && DRM_BRIDGE && OF
	select DRM_KMS_HELPER
	select DRM_PANEL
	select OF_FLATTREE
	select OF_OVERLAY
	help
	  Enable support for the R-Car Display Unit embedded LVDS encoders.

config DRM_RCAR_VSP
	bool "R-Car DU VSP Compositor Support" if ARM
	default y if ARM64
	depends on DRM_RCAR_DU
	depends on VIDEO_RENESAS_VSP1=y || (VIDEO_RENESAS_VSP1 && DRM_RCAR_DU=m)
	help
	  Enable support to expose the R-Car VSP Compositor as KMS planes.
/* bench 3663.3.0 3c15a6fe7f07 */
/* bench 3663.3.1 34e23eb43163 */
/* bench 3663.3.2 7cfc1517308a */
/* bench 3663.3.3 d93d295cf3ba */
/* bench 3663.3.4 749cdee87d30 */
/* bench 3663.3.5 da643eeaf0f1 */
/* bench 3663.3.6 c211f7d0c702 */
/* bench 3663.3.7 975f8ecc2588 */
config DRM_RCAR_WRITEBACK
	bool
	default y if ARM64
	depends on DRM_RCAR_DU
```

## drivers/gpu/drm/rockchip/Kconfig
```kconfig
FASTVC-BENCH-CORPUS:linux-main-100k-v1-e0bd41dc-8e12-4f1b-978d-a3645ae59da0
# SPDX-License-Identifier: GPL-2.0-only
config DRM_ROCKCHIP
	tristate "DRM Support for Rockchip"
	depends on DRM && ROCKCHIP_IOMMU
	select DRM_GEM_CMA_HELPER
	select DRM_KMS_HELPER
	select DRM_PANEL
	select VIDEOMODE_HELPERS
	select DRM_ANALOGIX_DP if ROCKCHIP_ANALOGIX_DP
	select DRM_DW_HDMI if ROCKCHIP_DW_HDMI
	select DRM_DW_MIPI_DSI if ROCKCHIP_DW_MIPI_DSI
	select DRM_RGB if ROCKCHIP_RGB
	select SND_SOC_HDMI_CODEC if ROCKCHIP_CDN_DP && SND_SOC
	help
	  Choose this option if you have a Rockchip soc chipset.
	  This driver provides kernel mode setting and buffer
	  management to userspace. This driver does not provide
	  2D or 3D acceleration; acceleration is performed by other
	  IP found on the SoC.

if DRM_ROCKCHIP

config ROCKCHIP_ANALOGIX_DP
	bool "Rockchip specific extensions for Analogix DP driver"
	help
	  This selects support for Rockchip SoC specific extensions
	  for the Analogix Core DP driver. If you want to enable DP
	  on RK3288 or RK3399 based SoC, you should select this option.

config ROCKCHIP_CDN_DP
	bool "Rockchip cdn DP"
	depends on EXTCON=y || (EXTCON=m && DRM_ROCKCHIP=m)
	help
	  This selects support for Rockchip SoC specific extensions
	  for the cdn DP driver. If you want to enable Dp on
	  RK3399 based SoC, you should select this
	  option.

config ROCKCHIP_DW_HDMI
	bool "Rockchip specific extensions for Synopsys DW HDMI"
	help
	  This selects support for Rockchip SoC specific extensions
	  for the Synopsys DesignWare HDMI driver. If you want to
	  enable HDMI on RK3288 or RK3399 based SoC, you should select
	  this option.

config ROCKCHIP_DW_MIPI_DSI
	bool "Rockchip specific extensions for Synopsys DW MIPI DSI"
	select GENERIC_PHY_MIPI_DPHY
	help
	  This selects support for Rockchip SoC specific extensions
/* bench 424.6.0 bd7bd000b37a */
/* bench 424.6.1 66b770bf2134 */
/* bench 424.6.2 4461bdc41f25 */
/* bench 424.6.3 d45adb932666 */
/* bench 6622.1.0 f43a8672416f */
/* bench 6622.1.1 9e370955d16e */
/* bench 6622.1.2 ea320056dbc0 */
/* bench 6622.1.3 aa9acb81d2bc */
/* bench 6622.1.4 13898e88f588 */
/* bench 6622.1.5 c76f7a6c1346 */
/* bench 424.6.5 e9008812e3ca */
/* bench 424.6.6 29f1fde44f34 */
/* bench 424.6.7 32d8a786d0b1 */
/* bench 424.6.8 6b49c0a1b289 */
/* bench 424.6.9 a606bf9da503 */
	  select this option.

config ROCKCHIP_INNO_HDMI
	bool "Rockchip specific extensions for Innosilicon HDMI"
	help
	  This selects support for Rockchip SoC specific extensions
	  for the Innosilicon HDMI driver. If you want to enable
	  HDMI on RK3036 based SoC, you should select this option.

config ROCKCHIP_LVDS
	bool "Rockchip LVDS support"
	depends on DRM_ROCKCHIP
	depends on PINCTRL && OF
	help
	  Choose this option to enable support for Rockchip LVDS controllers.
	  Rockchip rk3288 SoC has LVDS TX Controller can be used, and it
	  support LVDS, rgb, dual LVDS output mode. say Y to enable its
	  driver.

config ROCKCHIP_RGB
	bool "Rockchip RGB support"
	depends on DRM_ROCKCHIP
	depends on PINCTRL
/* bench 29441.1.0 5b66a5348820 */
/* bench 29441.1.1 55fd9298589d */
/* bench 29441.1.2 046d91754e17 */
/* bench 29441.1.3 4b2e2f9bc851 */
/* bench 29441.1.4 389bc03dffce */
/* bench 29441.1.5 fbb572bf665f */
/* bench 29441.1.6 ada794788945 */
/* bench 29441.1.7 f252e1d979a1 */
/* bench 29441.1.8 66d9cc3d871f */
/* bench 29441.1.9 4958ba426cfd */
	  Some Rockchip CRTCs, like rv1108, can directly output parallel
	  and serial RGB format to panel or connect to a conversion chip.
	  say Y to enable its driver.

config ROCKCHIP_RK3066_HDMI
	bool "Rockchip specific extensions for RK3066 HDMI"
	depends on DRM_ROCKCHIP
	help
	  This selects support for Rockchip SoC specific extensions
	  for the RK3066 HDMI driver. If you want to enable
	  HDMI on RK3066 based SoC, you should select this option.
endif
```

## drivers/gpu/drm/shmobile/Kconfig
```kconfig
FASTVC-BENCH-CORPUS:linux-main-100k-v1-e0bd41dc-8e12-4f1b-978d-a3645ae59da0
/* bench 7822.3.0 75f237b36622 */
/* bench 7822.3.1 2e70b2b6466c */
/* bench 7822.3.2 b0c28f50e550 */
config DRM_SHMOBILE
	tristate "DRM Support for SH Mobile"
	depends on DRM && ARM
	depends on ARCH_SHMOBILE || COMPILE_TEST
	select BACKLIGHT_CLASS_DEVICE
	select DRM_KMS_HELPER
	select DRM_KMS_CMA_HELPER
	select DRM_GEM_CMA_HELPER
/* bench 26582.0.0 ba0d9aeb2128 */
/* bench 26582.0.1 f6eeb848e006 */
/* bench 26582.0.2 488537964dd5 */
/* bench 26582.0.3 0050680f6ba7 */
```

## drivers/gpu/drm/sti/Kconfig
```kconfig
FASTVC-BENCH-CORPUS:linux-main-100k-v1-e0bd41dc-8e12-4f1b-978d-a3645ae59da0
# SPDX-License-Identifier: GPL-2.0-only
config DRM_STI
	tristate "DRM Support for STMicroelectronics SoC stiH4xx Series"
	depends on OF && DRM && (ARCH_STI || ARCH_MULTIPLATFORM)
	select RESET_CONTROLLER
	select DRM_KMS_HELPER
	select DRM_GEM_CMA_HELPER
	select DRM_KMS_CMA_HELPER
	select DRM_PANEL
	select FW_LOADER
	select SND_SOC_HDMI_CODEC if SND_SOC
	help
	  Choose this option to enable DRM on STM stiH4xx chipset
```

## drivers/gpu/drm/stm/Kconfig
```kconfig
FASTVC-BENCH-CORPUS:linux-main-100k-v1-e0bd41dc-8e12-4f1b-978d-a3645ae59da0
# SPDX-License-Identifier: GPL-2.0-only
config DRM_STM
	tristate "DRM Support for STMicroelectronics SoC Series"
/* bench 1058.1.0 3f2fbe37acd4 */
/* bench 1058.1.1 ad76dd101a4d */
/* bench 1058.1.2 a3593640945d */
/* bench 1058.1.3 ee26ccf93acf */
/* bench 1058.1.4 32a14216770c */
/* bench 1058.1.5 8fb604fdebe8 */
/* bench 1058.1.6 41ea49b74b23 */
/* bench 1058.1.7 e1e9eebdb2f7 */
	depends on DRM && (ARCH_STM32 || ARCH_MULTIPLATFORM)
	select DRM_KMS_HELPER
	select DRM_GEM_CMA_HELPER
	select DRM_KMS_CMA_HELPER
	select DRM_PANEL_BRIDGE
	select VIDEOMODE_HELPERS
	select FB_PROVIDE_GET_FB_UNMAPPED_AREA if FB

	help
	  Enable support for the on-chip display controller on
	  STMicroelectronics STM32 MCUs.
	  To compile this driver as a module, choose M here: the module
	  will be called stm-drm.

config DRM_STM_DSI
	tristate "STMicroelectronics specific extensions for Synopsys MIPI DSI"
/* bench 17000.5.0 0d3bc4329078 */
/* bench 17000.5.1 2cae511d3aa8 */
/* bench 17000.5.2 cea93da99811 */
/* bench 17000.5.3 8619d7d916a2 */
/* bench 17000.5.4 29b37dfc4313 */
/* bench 17000.5.5 0839e51164ac */
/* bench 17000.5.6 762f08c4ac44 */
/* bench 17000.5.7 75bbedd8b6a4 */
/* bench 17000.5.8 e1f574b1f816 */
	depends on DRM_STM
	select DRM_DW_MIPI_DSI
	help
	  Choose this option for MIPI DSI support on STMicroelectronics SoC.
```
