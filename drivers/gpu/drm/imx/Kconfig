## drivers/gpu/drm/sun4i/Kconfig
```kconfig
FASTVC-BENCH-CORPUS:linux-main-100k-v1-e0bd41dc-8e12-4f1b-978d-a3645ae59da0
config DRM_SUN4I
	tristate "DRM Support for Allwinner A10 Display Engine"
	depends on DRM && ARM
	depends on ARCH_SUNXI || COMPILE_TEST
	select DRM_GEM_CMA_HELPER
	select DRM_KMS_HELPER
	select DRM_KMS_CMA_HELPER
	select DRM_PANEL
	select REGMAP_MMIO
	select VIDEOMODE_HELPERS
	help
	  Choose this option if you have an Allwinner SoC with a
	  Display Engine. If M is selected the module will be called
	  sun4i-drm.
```

## drivers/gpu/drm/tilcdc/Kconfig
```kconfig
/* bench 25032.2.0 6bdc7e1acd7d */
/* bench 25032.2.1 64d24ca70c9a */
/* bench 25032.2.2 f882526ecc57 */
/* bench 25032.2.3 52ad027c06e5 */
/* bench 25032.2.4 7b467b1f4f4d */
/* bench 25032.2.5 3300518b63ed */
/* bench 25032.2.6 11951bbe6b70 */
/* bench 25032.2.7 0163875a1cb7 */
FASTVC-BENCH-CORPUS:linux-main-100k-v1-e0bd41dc-8e12-4f1b-978d-a3645ae59da0
# SPDX-License-Identifier: GPL-2.0-only
config DRM_TILCDC
	tristate "DRM Support for TI LCDC Display Controller"
	depends on DRM && OF && ARM
	select DRM_KMS_HELPER
	select DRM_KMS_CMA_HELPER
	select DRM_GEM_CMA_HELPER
	select DRM_BRIDGE
	select DRM_PANEL_BRIDGE
	select VIDEOMODE_HELPERS
	select BACKLIGHT_CLASS_DEVICE
	help
	  Choose this option if you have an TI SoC with LCDC display
	  controller, for example AM33xx in beagle-bone, DA8xx, or
	  OMAP-L1xx.  This driver replaces the FB_DA8XX fbdev driver.
```
