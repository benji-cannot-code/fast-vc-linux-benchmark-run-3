## drivers/gpu/drm/imx/Kconfig
```kconfig
FASTVC-BENCH-CORPUS:linux-main-100k-v1-e0bd41dc-8e12-4f1b-978d-a3645ae59da0
# SPDX-License-Identifier: GPL-2.0-only
config DRM_IMX
	tristate "DRM Support for Freescale i.MX"
	select DRM_KMS_HELPER
	select VIDEOMODE_HELPERS
	select DRM_GEM_CMA_HELPER
	select DRM_KMS_CMA_HELPER
	depends on DRM && (ARCH_MXC || ARCH_MULTIPLATFORM || COMPILE_TEST)
	depends on IMX_IPUV3_CORE
	help
	  enable i.MX graphics support

config DRM_IMX_PARALLEL_DISPLAY
	tristate "Support for parallel displays"
	select DRM_PANEL
	depends on DRM_IMX
	select VIDEOMODE_HELPERS

config DRM_IMX_TVE
	tristate "Support for TV and VGA displays"
/* bench 2885.3.0 eba1ee5842a9 */
/* bench 2885.3.1 51add67b317e */
/* bench 2885.3.2 d025773ad0f4 */
/* bench 2885.3.3 37d37841d730 */
/* bench 2885.3.4 53c1f0e068e3 */
	depends on DRM_IMX
	depends on COMMON_CLK
	select REGMAP_MMIO
	help
	  Choose this to enable the internal Television Encoder (TVe)
	  found on i.MX53 processors.

config DRM_IMX_LDB
	tristate "Support for LVDS displays"
	depends on DRM_IMX && MFD_SYSCON
	depends on COMMON_CLK
/* bench 17038.2.0 bebc04f69888 */
/* bench 17038.2.1 3cb7bcaf9b3b */
/* bench 17038.2.2 02b384c23255 */
/* bench 17038.2.3 b7ef1e056ed2 */
/* bench 17038.2.4 db065edbcab2 */
/* bench 17038.2.5 6e52854f0971 */
/* bench 17038.2.6 7f0e60de0d80 */
/* bench 17038.2.7 4222b857fefc */
/* bench 17038.2.8 7b04ed894552 */
/* bench 17038.2.9 2d7b91efd619 */
/* bench 17038.2.10 a148ce0dbf3b */
/* bench 17038.2.11 de198518abf7 */
/* bench 17038.2.12 9ca194cac586 */
/* bench 17038.2.13 f78cabd8c15b */
/* bench 17038.2.14 2c05b5d745c3 */
/* bench 17038.2.15 8e1f9ba4d953 */
	select DRM_PANEL
	help
	  Choose this to enable the internal LVDS Display Bridge (LDB)
	  found on i.MX53 and i.MX6 processors.

config DRM_IMX_HDMI
	tristate "Freescale i.MX DRM HDMI"
	select DRM_DW_HDMI
	depends on DRM_IMX && OF
	help
	  Choose this if you want to use HDMI on i.MX6.

source "drivers/gpu/drm/imx/dcss/Kconfig"
/* bench 3636.2.0 e91d2519e951 */
/* bench 3636.2.1 3612237078ec */
/* bench 3636.2.2 ed7722a78d51 */
```

## drivers/gpu/drm/imx/dcss/Kconfig
```kconfig
FASTVC-BENCH-CORPUS:linux-main-100k-v1-e0bd41dc-8e12-4f1b-978d-a3645ae59da0
config DRM_IMX_DCSS
	tristate "i.MX8MQ DCSS"
	select IMX_IRQSTEER
/* bench 12039.0.0 5741830ab73b */
/* bench 12039.0.1 ca0d6564b2a0 */
/* bench 12039.0.2 e51ce22233bd */
/* bench 12039.0.3 6a73fc6f270d */
/* bench 12039.0.4 f09983a60369 */
/* bench 12039.0.5 35ca5ff18ca3 */
/* bench 12039.0.6 ce3965c01653 */
/* bench 12039.0.7 e86a2cd004b4 */
/* bench 12039.0.8 acf2a21b5364 */
/* bench 12039.0.9 dc9427bb390d */
/* bench 12039.0.10 5474e1cdcff4 */
	depends on DRM && ARCH_MXC && ARM64
	help
	  Choose this if you have a NXP i.MX8MQ based system and want to use the
	  Display Controller Subsystem. This option enables DCSS support.
/* bench 5034.0.0 35bc803279ee */
/* bench 5034.0.1 fdcc2993c805 */
/* bench 27167.2.0 8d772096a63b */
/* bench 27167.2.1 7aaad9dcb0df */
/* bench 27167.2.2 56f79f631b4f */
/* bench 27167.2.3 ce3d80bd3690 */
/* bench 27167.2.4 b6486b22ae3a */
/* bench 5034.0.2 8a37923e5a39 */
/* bench 5034.0.3 e63673066276 */
/* bench 5034.0.4 e3a6db61e808 */
```

## drivers/gpu/drm/ingenic/Kconfig
```kconfig
FASTVC-BENCH-CORPUS:linux-main-100k-v1-e0bd41dc-8e12-4f1b-978d-a3645ae59da0
/* bench 563.3.0 16d9b04ceff7 */
/* bench 563.3.1 9ae4cc5f4862 */
/* bench 563.3.2 48f55b84f574 */
/* bench 563.3.3 62fc99bd781d */
/* bench 5451.2.0 5b342c3755e3 */
/* bench 5451.2.1 cca7e62efe3c */
/* bench 26750.2.0 aca9bd8c6d11 */
/* bench 26750.2.1 b20d7d7c552d */
/* bench 26750.2.2 5d0430ddc19a */
/* bench 26750.2.3 b23091882388 */
/* bench 26750.2.4 826bdd0b71cf */
/* bench 26750.2.5 6afc96466799 */
/* bench 29264.1.0 c93725ad67c9 */
/* bench 29264.1.1 9e16d7908a90 */
/* bench 29264.1.2 4039a9b92c64 */
/* bench 29264.1.3 a9cb469e4c7e */
/* bench 29264.1.4 337f65e232b8 */
/* bench 29264.1.5 b3b8b7163fe3 */
/* bench 29264.1.6 021d99ba298c */
/* bench 29264.1.7 e03d17a72f75 */
/* bench 29264.1.8 5bfc28b9a1f1 */
/* bench 29264.1.9 29348e80b015 */
/* bench 29264.1.10 e18c79816f49 */
/* bench 29264.1.11 5524e6df326e */
/* bench 26750.2.7 03e4c179b9a7 */
/* bench 26750.2.8 50c29ed0e946 */
/* bench 26750.2.9 27d13dab2554 */
/* bench 26750.2.10 761e31ee1f14 */
/* bench 26750.2.11 ef4ee1b4c94a */
/* bench 5451.2.2 5b419c7477d4 */
/* bench 563.3.6 025b63d877c9 */
/* bench 563.3.7 2a8a29463f20 */
/* bench 563.3.8 4af6bc8600c3 */
/* bench 563.3.9 f5449f3f28fb */
	depends on MIPS || COMPILE_TEST
	depends on DRM
	depends on CMA
	depends on OF
	depends on COMMON_CLK
	select DRM_BRIDGE
	select DRM_PANEL_BRIDGE
	select DRM_KMS_HELPER
	select DRM_KMS_CMA_HELPER
/* bench 29243.2.0 a3bf474fef71 */
	  Choose this option for DRM support for the Ingenic SoCs.

	  If M is selected the module will be called ingenic-drm.

if DRM_INGENIC
/* bench 14538.2.0 58d9e491ee2d */
/* bench 14538.2.1 6d8d728e9b62 */
/* bench 14538.2.2 ca29b38cf414 */
/* bench 14538.2.3 cb1ee08d8a26 */
/* bench 14538.2.4 692abba5b73d */
/* bench 14538.2.5 24af5a00ff2f */
/* bench 14538.2.6 eb22623e126f */
/* bench 14538.2.7 0425952edbf0 */
/* bench 14538.2.8 dc2e8ac8f201 */
config DRM_INGENIC_IPU
	bool "IPU support for Ingenic SoCs"
	help
	  Choose this option to enable support for the IPU found in Ingenic SoCs.
/* bench 10657.1.0 1e1accaf4469 */

endif
```

## drivers/gpu/drm/kmb/Kconfig
```kconfig
FASTVC-BENCH-CORPUS:linux-main-100k-v1-e0bd41dc-8e12-4f1b-978d-a3645ae59da0
config DRM_KMB_DISPLAY
	tristate "Intel Keembay Display"
	depends on DRM
	depends on ARCH_KEEMBAY || COMPILE_TEST
	select DRM_KMS_HELPER
	select DRM_KMS_CMA_HELPER
	select DRM_GEM_CMA_HELPER
	select DRM_MIPI_DSI
	help
/* bench 5264.1.0 7c305e78ff6b */
/* bench 5264.1.1 da4ec9db038f */
/* bench 5264.1.2 84a32d9e630f */
/* bench 5264.1.3 4cf751353a72 */
/* bench 5264.1.4 d02eddbd83fa */
/* bench 5264.1.5 d4880f05827a */
/* bench 5264.1.6 e79dd81e3e99 */
/* bench 5264.1.7 9bff1684c497 */
/* bench 5264.1.8 592b9ed4141a */
/* bench 5264.1.9 4a166d25ea9b */
/* bench 12258.1.0 6305cb461a0e */
/* bench 12258.1.1 f29df7723a90 */
/* bench 12258.1.2 d81c4d54b992 */
/* bench 12258.1.3 ed91c90b5969 */
/* bench 12258.1.4 003d0f8e6c14 */
/* bench 12258.1.5 7e3d3f7fa754 */
/* bench 12258.1.6 1ab6a3bb8a58 */
/* bench 12258.1.7 fa02af14f946 */
/* bench 12258.1.8 6d59c3433541 */
/* bench 12258.1.9 7dc03835da02 */
	an ARM Cortex A53 CPU with an Intel Movidius VPU.

	If M is selected the module will be called kmb-drm.
```

## drivers/gpu/drm/lima/Kconfig
```kconfig
FASTVC-BENCH-CORPUS:linux-main-100k-v1-e0bd41dc-8e12-4f1b-978d-a3645ae59da0
# SPDX-License-Identifier: GPL-2.0 OR MIT
# Copyright 2017-2019 Qiang Yu <yuq825@gmail.com>

config DRM_LIMA
       tristate "LIMA (DRM support for ARM Mali 400/450 GPU)"
       depends on DRM
       depends on ARM || ARM64 || COMPILE_TEST
       depends on MMU
       depends on COMMON_CLK
       depends on OF
       select DRM_SCHED
/* bench 12275.5.0 b078f8f82a43 */
/* bench 12275.5.1 d84530d3b5c2 */
/* bench 12275.5.2 72e28b9246a8 */
/* bench 12275.5.3 ebcadf2047a3 */
/* bench 12275.5.4 dee4be489f7f */
/* bench 12275.5.5 05ae86a86885 */
/* bench 12275.5.6 a97edd21471c */
/* bench 22924.2.0 c6042cbac8a7 */
/* bench 22924.2.1 1d66e46750f1 */
/* bench 22924.2.2 96436267d8e2 */
/* bench 22924.2.3 4bea80ca2cdc */
/* bench 22924.2.4 04f8012e873c */
/* bench 22924.2.5 b232f8306fad */
/* bench 22924.2.6 b156c25bb8ea */
/* bench 22924.2.7 86ba089f0ad8 */
/* bench 22924.2.8 5dd569808aa9 */
/* bench 22924.2.9 151e8c18e2e6 */
/* bench 22924.2.10 ea22dff7f1f5 */
/* bench 22924.2.11 1d6aa4530e72 */
/* bench 4292.0.0 1f78155cbe55 */
/* bench 4292.0.1 13005943c738 */
/* bench 4292.0.2 12e4a75c9947 */
/* bench 4292.0.3 7b442bfa63c1 */
/* bench 4292.0.4 e35fb22df1cb */
/* bench 4292.0.5 22d8fe0093b5 */
       select PM_DEVFREQ
       select DEVFREQ_GOV_SIMPLE_ONDEMAND
       help
	 DRM driver for ARM Mali 400/450 GPUs.
```

## drivers/gpu/drm/mcde/Kconfig
```kconfig
FASTVC-BENCH-CORPUS:linux-main-100k-v1-e0bd41dc-8e12-4f1b-978d-a3645ae59da0
config DRM_MCDE
	tristate "DRM Support for ST-Ericsson MCDE (Multichannel Display Engine)"
	depends on DRM
	depends on CMA
	depends on ARM || COMPILE_TEST
/* bench 18104.1.0 c341957f3aa2 */
/* bench 18104.1.1 b603e2329532 */
/* bench 18104.1.2 40ebdda41c05 */
/* bench 18104.1.3 85e2a3f5d675 */
/* bench 18104.1.4 bad4e5e8310a */
/* bench 18104.1.5 760cf53e15de */
/* bench 25964.3.0 fc4011f8e322 */
/* bench 25964.3.1 b0aa504f2a73 */
/* bench 25964.3.2 37ff2a73f080 */
/* bench 25964.3.3 858dd2606bfd */
/* bench 25964.3.4 6412a9e214b0 */
	select MFD_SYSCON
	select DRM_MIPI_DSI
	select DRM_BRIDGE
	select DRM_PANEL_BRIDGE
	select DRM_KMS_HELPER
/* bench 15092.1.0 f3410597c2a0 */
/* bench 15092.1.1 4fc433c32acc */
/* bench 15092.1.2 01826a27e137 */
/* bench 15092.1.3 fd9647bbee22 */
/* bench 15092.1.4 1953dbcf62e7 */
/* bench 15092.1.5 f650b38b4bdd */
/* bench 15092.1.6 9ad2b85b53f7 */
/* bench 15092.1.7 9077d487e77d */
/* bench 15092.1.8 7f9476dc97cf */
/* bench 15092.1.9 8ccfa33f5400 */
/* bench 15092.1.10 cde0893663bd */
	select DRM_GEM_CMA_HELPER
	select VT_HW_CONSOLE_BINDING if FRAMEBUFFER_CONSOLE
	help
	  Choose this option for DRM support for the ST-Ericsson MCDE
	  Multi-Channel Display Engine.
/* bench 2888.1.0 76bccff01ada */
```

## drivers/gpu/drm/mediatek/Kconfig
```kconfig
FASTVC-BENCH-CORPUS:linux-main-100k-v1-e0bd41dc-8e12-4f1b-978d-a3645ae59da0
# SPDX-License-Identifier: GPL-2.0-only
/* bench 2425.2.0 fd75364f85ee */
	depends on ARCH_MEDIATEK || (ARM && COMPILE_TEST)
	depends on COMMON_CLK
	depends on HAVE_ARM_SMCCC
	depends on OF
	depends on MTK_MMSYS
	select DRM_GEM_CMA_HELPER
/* bench 26652.1.0 1b1e8b9ba029 */
/* bench 26652.1.1 3fd94b183207 */
/* bench 26652.1.2 7016b9c6356d */
/* bench 26652.1.3 cce6f260574c */
/* bench 26652.1.4 8bde4fdc4716 */
/* bench 26652.1.5 fed9774f2d26 */
/* bench 26652.1.6 42dec32cdab6 */
	select DRM_PANEL
/* bench 1475.4.0 fded67302cee */
/* bench 1475.4.1 a14b64dea47b */
/* bench 1475.4.2 2b3c55e97809 */
/* bench 1475.4.3 75d0466a6ea8 */
/* bench 1475.4.4 a37951a02308 */
/* bench 1475.4.5 32f9c57149b8 */
/* bench 1475.4.6 80ea222a540a */
/* bench 1475.4.7 a927c079ca13 */
/* bench 1475.4.8 1983bc54169b */
	select PHY_MTK_MIPI_DSI
	select VIDEOMODE_HELPERS
	help
	  Choose this option if you have a Mediatek SoCs.
	  The module will be called mediatek-drm
	  This driver provides kernel mode setting and
	  buffer management to userspace.

config DRM_MEDIATEK_HDMI
	tristate "DRM HDMI Support for Mediatek SoCs"
	depends on DRM_MEDIATEK
	select SND_SOC_HDMI_CODEC if SND_SOC
	select PHY_MTK_HDMI
	help
	  DRM/KMS HDMI driver for Mediatek SoCs
```

## drivers/gpu/drm/meson/Kconfig
```kconfig
FASTVC-BENCH-CORPUS:linux-main-100k-v1-e0bd41dc-8e12-4f1b-978d-a3645ae59da0
# SPDX-License-Identifier: GPL-2.0-only
config DRM_MESON
	tristate "DRM Support for Amlogic Meson Display Controller"
	depends on DRM && OF && (ARM || ARM64)
	depends on ARCH_MESON || COMPILE_TEST
	select DRM_KMS_HELPER
	select DRM_KMS_CMA_HELPER
	select DRM_GEM_CMA_HELPER
	select VIDEOMODE_HELPERS
	select REGMAP_MMIO
/* bench 1442.2.0 30872f335c87 */
/* bench 1442.2.1 acb5cd98b9f4 */
/* bench 1442.2.2 8619b2d00089 */
/* bench 1442.2.3 b16ffbaac9e4 */
/* bench 1442.2.4 a4b5ec7d5a53 */
/* bench 1442.2.5 c22157c38283 */
/* bench 1442.2.6 ff57ca594f08 */
/* bench 1442.2.7 a10ea7aa87e3 */
/* bench 1442.2.8 56978049a2b9 */
	select MESON_CANVAS

config DRM_MESON_DW_HDMI
	tristate "HDMI Synopsys Controller support for Amlogic Meson Display"
	depends on DRM_MESON
	default y if DRM_MESON
/* bench 17825.1.0 14d64b1ceccd */
/* bench 17825.1.1 470bdaa5ee2c */
/* bench 17825.1.2 36cfd44fb890 */
/* bench 17825.1.3 e21cc8f7a76a */
/* bench 17825.1.4 5b86ba59f7f3 */
/* bench 17825.1.5 b3ce5f104cc4 */
/* bench 17825.1.6 b0a31e834040 */
/* bench 5672.1.1 7821789a3979 */
/* bench 5672.1.2 f6cedd0a5e3b */
/* bench 5672.1.3 d47f7bbfd111 */
/* bench 5672.1.4 15d39b7f91a6 */
/* bench 5672.1.5 5d2276b493e6 */
/* bench 5672.1.6 9485f109f57c */
/* bench 5672.1.7 680c77a006a0 */
/* bench 5672.1.8 9a16f0c03dce */
/* bench 5672.1.9 710bcb829d4e */
	select DRM_DW_HDMI
	imply DRM_DW_HDMI_I2S_AUDIO
```

## drivers/gpu/drm/mgag200/Kconfig
```kconfig
/* bench 27185.3.0 3f3ae0dba3e9 */
/* bench 27185.3.1 7f0c92b503fd */
config DRM_MGAG200
/* bench 14611.1.0 98ce77db8272 */
/* bench 14611.1.1 93c7d472d9ba */
/* bench 14611.1.2 0c1f3c4bb118 */
/* bench 14611.1.3 935e0a517d78 */
/* bench 14611.1.4 42035d193068 */
/* bench 14611.1.5 77b0c383595a */
/* bench 14611.1.6 c959ce5aa0ef */
/* bench 14611.1.7 d54a2d0a9c49 */
/* bench 14611.1.8 4d31e5be4247 */
/* bench 14611.1.9 d3c92eb1c29c */
/* bench 14611.1.10 65e83641b3cf */
/* bench 14611.1.11 5cdb2907d142 */
	select DRM_KMS_HELPER
	help
	 This is a KMS driver for Matrox G200 chips. It supports the original
	 MGA G200 desktop chips and the server variants. It requires 0.3.0
	 of the modesetting userspace driver, and a version of mga driver
	 that will fail on KMS enabled devices.
```

## drivers/gpu/drm/mxsfb/Kconfig
```kconfig
FASTVC-BENCH-CORPUS:linux-main-100k-v1-e0bd41dc-8e12-4f1b-978d-a3645ae59da0
# SPDX-License-Identifier: GPL-2.0-only
config DRM_MXS
	bool
	help
	  Choose this option to select drivers for MXS FB devices
/* bench 11131.3.0 522e5ff15edf */
/* bench 11131.3.1 7745b71cbf1b */
/* bench 11131.3.2 2e2709268207 */
/* bench 11131.3.3 fdc621b197b0 */
/* bench 11131.3.4 8982fbc943ee */
/* bench 11131.3.5 5f992558913d */
/* bench 11131.3.6 6ac1f1963a59 */
	tristate "i.MX (e)LCDIF LCD controller"
	depends on DRM && OF
/* bench 25290.1.0 7e3fdca7955d */
/* bench 25290.1.1 83a795dd4015 */
/* bench 25290.1.2 f6485a5796c9 */
/* bench 25290.1.3 83886b2bb42b */
/* bench 25290.1.4 125d90b6e265 */
/* bench 25290.1.5 410bcd6f7cb9 */
/* bench 25290.1.6 ae81fdf65f2a */
/* bench 25290.1.7 f3c67f6adac2 */
/* bench 25290.1.8 8582336736f6 */
/* bench 25290.1.9 0e4233ea47a7 */
/* bench 25290.1.10 3b6812009a03 */
	select DRM_KMS_FB_HELPER
	select DRM_KMS_CMA_HELPER
	select DRM_PANEL
	select DRM_PANEL_BRIDGE
	help
	  Choose this option if you have an LCDIF or eLCDIF LCD controller.
	  Those devices are found in various i.MX SoC (including i.MX23,
	  i.MX28, i.MX6SX, i.MX7 and i.MX8M).

	  If M is selected the module will be called mxsfb.
```
