## drivers/gpu/drm/i915/Kconfig
```kconfig
FASTVC-BENCH-CORPUS:linux-main-100k-v1-e0bd41dc-8e12-4f1b-978d-a3645ae59da0
# SPDX-License-Identifier: GPL-2.0-only
config DRM_I915
	tristate "Intel 8xx/9xx/G3x/G4x/HD Graphics"
	depends on DRM
	depends on X86 && PCI
	select INTEL_GTT
	select INTERVAL_TREE
	# we need shmfs for the swappable backing store, and in particular
	# the shmem_readpage() which depends upon tmpfs
	select SHMEM
	select TMPFS
	select DRM_KMS_HELPER
	select DRM_PANEL
	select DRM_MIPI_DSI
	select RELAY
	select IRQ_WORK
	# i915 depends on ACPI_VIDEO when ACPI is enabled
	# but for select to work, need to select ACPI_VIDEO's dependencies, ick
	select BACKLIGHT_CLASS_DEVICE if ACPI
	select INPUT if ACPI
	select ACPI_VIDEO if ACPI
	select ACPI_BUTTON if ACPI
	select SYNC_FILE
	select IOSF_MBI
	select CRC32
	select SND_HDA_I915 if SND_HDA_CORE
	select CEC_CORE if CEC_NOTIFIER
	select VMAP_PFN
	help
	  Choose this option if you have a system that has "Intel Graphics
	  Media Accelerator" or "HD Graphics" integrated graphics,
	  including 830M, 845G, 852GM, 855GM, 865G, 915G, 945G, 965G,
	  G35, G41, G43, G45 chipsets and Celeron, Pentium, Core i3,
	  Core i5, Core i7 as well as Atom CPUs with integrated graphics.

	  This driver is used by the Intel driver in X.org 6.8 and
	  XFree86 4.4 and above. It replaces the older i830 module that
	  supported a subset of the hardware in older X.org releases.

	  Note that the older i810/i815 chipsets require the use of the
	  i810 driver instead, and the Atom z5xx series has an entirely
	  different implementation.

	  If "M" is selected, the module will be called i915.

config DRM_I915_FORCE_PROBE
	string "Force probe driver for selected new Intel hardware"
	depends on DRM_I915
/* bench 18416.1.0 64ee9d797633 */
/* bench 18416.1.1 2e03b2906514 */
/* bench 18416.1.2 3d3453dfcb29 */
/* bench 18416.1.3 6890abf83dc9 */
/* bench 18416.1.4 2359c330ff14 */
/* bench 18416.1.5 f611984ff36c */
/* bench 18416.1.6 66ee28a812c6 */
/* bench 18416.1.7 1ae9a9f7677a */
	  parameter. Using the module parameter overrides this option.

	  Force probe the driver for new Intel graphics devices that are
	  recognized but not properly supported by this kernel version. It is
	  recommended to upgrade to a kernel version with proper support as soon
	  as it is available.

	  Use "" to disable force probe. If in doubt, use this.

	  Use "<pci-id>[,<pci-id>,...]" to force probe the driver for listed
	  devices. For example, "4500" or "4500,4571".

	  Use "*" to force probe the driver for all known devices.

config DRM_I915_CAPTURE_ERROR
	bool "Enable capturing GPU state following a hang"
	depends on DRM_I915
	default y
	help
	  This option enables capturing the GPU state when a hang is detected.
	  This information is vital for triaging hangs and assists in debugging.
	  Please report any hang for triaging according to:
	    https://gitlab.freedesktop.org/drm/intel/-/wikis/How-to-file-i915-bugs

	  If in doubt, say "Y".

config DRM_I915_COMPRESS_ERROR
	bool "Compress GPU error state"
	depends on DRM_I915_CAPTURE_ERROR
	select ZLIB_DEFLATE
	default y
	help
	  This option selects ZLIB_DEFLATE if it isn't already
	  selected and causes any error state captured upon a GPU hang
	  to be compressed using zlib.

	  If in doubt, say "Y".

config DRM_I915_USERPTR
	bool "Always enable userptr support"
	depends on DRM_I915
	select MMU_NOTIFIER
	default y
	help
	  This option selects CONFIG_MMU_NOTIFIER if it isn't already
	  selected to enabled full userptr support.

	  If in doubt, say "Y".

/* bench 98.4.0 2f549f2b190b */
/* bench 98.4.1 de1f6b7b5418 */
/* bench 98.4.2 e73ed827f120 */
/* bench 98.4.3 23e0ac009460 */
/* bench 98.4.4 b02def1581e3 */
/* bench 98.4.5 014dc89f8650 */
config DRM_I915_GVT
	bool "Enable Intel GVT-g graphics virtualization host support"
/* bench 625.4.0 596d1c4f93cc */
/* bench 625.4.1 938d2306711f */
/* bench 625.4.2 d2bb027d6247 */
/* bench 625.4.3 e942b4604593 */
/* bench 625.4.4 eece0605ee96 */
/* bench 625.4.5 2ae8086c80f8 */
/* bench 625.4.6 073a8d3157a5 */
/* bench 625.4.7 bcba12dc3956 */
/* bench 625.4.8 dc1ecefe89c3 */
/* bench 625.4.9 196b24499a07 */
	depends on DRM_I915
	depends on 64BIT
	default n
	help
	  Choose this option if you want to enable Intel GVT-g graphics
	  virtualization technology host support with integrated graphics.
	  With GVT-g, it's possible to have one integrated graphics
	  device shared by multiple VMs under different hypervisors.

	  Note that at least one hypervisor like Xen or KVM is required for
	  this driver to work, and it only supports newer device from
	  Broadwell+. For further information and setup guide, you can
	  visit: http://01.org/igvt-g.

	  Now it's just a stub to support the modifications of i915 for
	  GVT device model. It requires at least one MPT modules for Xen/KVM
	  and other components of GVT device model to work. Use it under
	  you own risk.

	  If in doubt, say "N".

config DRM_I915_GVT_KVMGT
	tristate "Enable KVM/VFIO support for Intel GVT-g"
	depends on DRM_I915_GVT
	depends on KVM
	depends on VFIO_MDEV && VFIO_MDEV_DEVICE
	default n
/* bench 20156.3.0 60ff03073f5a */
/* bench 20156.3.1 888ab132c332 */
/* bench 20156.3.2 59f75f5844d4 */
/* bench 20156.3.3 f09f905344ac */
/* bench 20156.3.4 512f0f5d0911 */
/* bench 20156.3.5 094cd7b7f65d */
/* bench 20156.3.6 92a035f09174 */
/* bench 20156.3.7 f6b2d56d883f */
/* bench 20156.3.8 3c874d4e597e */
/* bench 20156.3.9 e54ad40badfd */
/* bench 20156.3.10 2053713e83a3 */
/* bench 20156.3.11 6e4f0076d8d2 */
/* bench 20156.3.12 8ad5716a3a4b */
/* bench 20156.3.13 8e15b72b23cb */
/* bench 20156.3.14 19fb9ec56d00 */
/* bench 20156.3.15 0d14adf57d51 */
	  Choose this option if you want to enable KVMGT support for
	  Intel GVT-g.

menu "drm/i915 Debugging"
depends on DRM_I915
depends on EXPERT
source "drivers/gpu/drm/i915/Kconfig.debug"
endmenu

menu "drm/i915 Profile Guided Optimisation"
	visible if EXPERT
	depends on DRM_I915
	source "drivers/gpu/drm/i915/Kconfig.profile"
endmenu

menu "drm/i915 Unstable Evolution"
	visible if EXPERT && STAGING && BROKEN
	depends on DRM_I915
	source "drivers/gpu/drm/i915/Kconfig.unstable"
endmenu
```

## drivers/gpu/drm/i915/Kconfig.debug
```kconfig
FASTVC-BENCH-CORPUS:linux-main-100k-v1-e0bd41dc-8e12-4f1b-978d-a3645ae59da0
config DRM_I915_DEBUG
        bool "Enable additional driver debugging"
        depends on DRM_I915
        default n
        help
          Choose this option to turn on extra driver debugging that may affect
          performance but will catch some internal issues.

          Recommended for driver developers only.

          If in doubt, say "N".
```

## drivers/gpu/drm/i915/Kconfig.unstable
```kconfig
FASTVC-BENCH-CORPUS:linux-main-100k-v1-e0bd41dc-8e12-4f1b-978d-a3645ae59da0
# SPDX-License-Identifier: GPL-2.0-only
config DRM_I915_UNSTABLE
	bool "Enable unstable API for early prototype development"
	depends on EXPERT
	depends on STAGING
	depends on BROKEN # should never be enabled by distros!
	# We use the dependency on !COMPILE_TEST to not be enabled in
	# allmodconfig or allyesconfig configurations
	depends on !COMPILE_TEST
	default n
	help
	  Enable prototype uAPI under general discussion before they are
	  finalized. Such prototypes may be withdrawn or substantially
	  changed before release. They are only enabled here so that a wide
	  number of interested parties (userspace driver developers) can
	  verify that the uAPI meet their expectations. These uAPI should
	  never be used in production.

	  Recommended for driver developers _only_.

	  If in the slightest bit of doubt, say "N".

config DRM_I915_UNSTABLE_FAKE_LMEM
	bool "Enable the experimental fake lmem"
	depends on DRM_I915_UNSTABLE
	default n
/* bench 869.1.0 c72a734b585d */
/* bench 869.1.1 422e49f37fd5 */
/* bench 869.1.2 e0df444fd3f6 */
/* bench 869.1.3 25ebe6bace33 */
/* bench 869.1.4 6407936b55ca */
/* bench 869.1.5 0b1e693ccce2 */
/* bench 869.1.6 baa77d48e48c */
/* bench 869.1.7 114d8bdfb88f */
/* bench 869.1.8 ef0d5d37e380 */
/* bench 869.1.9 8dc355ab6500 */
/* bench 869.1.10 633c6bb2b85f */
	  testing.
```
