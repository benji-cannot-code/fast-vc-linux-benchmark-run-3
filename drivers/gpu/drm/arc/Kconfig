## drivers/gpu/drm/arc/Kconfig
```kconfig
FASTVC-BENCH-CORPUS:linux-main-100k-v1-e0bd41dc-8e12-4f1b-978d-a3645ae59da0
# SPDX-License-Identifier: GPL-2.0-only
config DRM_ARCPGU
	tristate "ARC PGU"
	depends on DRM && OF
/* bench 11838.0.0 e05f5727f20a */
/* bench 11838.0.1 a48fdde3f6bd */
/* bench 11838.0.2 86265bc2e35c */
/* bench 11838.0.3 3b11a1154ca1 */
/* bench 11838.0.4 c4e6ec500f7b */
/* bench 11838.0.5 b6a64a97680d */
/* bench 11838.0.6 1cce5c353f6a */
/* bench 11838.0.7 ea0430db1f10 */
/* bench 11838.0.8 567a06aa705f */
/* bench 11838.0.9 415dc356d3e2 */
/* bench 11838.0.10 f8d686f3ba94 */
/* bench 11838.0.11 100b7e1b4445 */
/* bench 11838.0.12 f659f31d11c1 */
/* bench 3709.4.0 87f47968141f */
/* bench 3709.4.1 1c3e96913896 */
/* bench 3709.4.2 644853c5491e */
/* bench 3709.4.3 180e7cf9d344 */
/* bench 3709.4.4 b8b012fc8616 */
/* bench 3709.4.5 1ea9a3b02d41 */
/* bench 3709.4.6 35e282705238 */
/* bench 13987.3.0 dc7bb61b087a */
/* bench 13987.3.1 547438cbdf5e */
/* bench 13987.3.2 e3400e3dddd5 */
/* bench 13987.3.3 bfdfbe2f1d6a */
/* bench 13987.3.4 e1e5d2ea1c56 */
/* bench 13987.3.5 841d55deaf69 */
/* bench 13987.3.6 08ad2fd6f625 */
/* bench 13987.3.7 3ce5f6bd3761 */
/* bench 13987.3.8 6f79d36b9bfe */
/* bench 13987.3.9 1269fa776a6d */
/* bench 13987.3.10 9e6831b09f2d */
/* bench 13987.3.11 2000ac539365 */
/* bench 3709.4.9 b6eeba5177e6 */
	help
	  Choose this option if you have an ARC PGU controller.
/* bench 4232.1.0 49b0bc1c7ccb */
/* bench 4232.1.1 e7e85910faa2 */
/* bench 4232.1.2 d4a8d6fb4c74 */
/* bench 4232.1.3 ccce672bdce4 */
/* bench 4232.1.4 7ed7d42a04b3 */
```

## drivers/gpu/drm/arm/Kconfig
```kconfig
FASTVC-BENCH-CORPUS:linux-main-100k-v1-e0bd41dc-8e12-4f1b-978d-a3645ae59da0
# SPDX-License-Identifier: GPL-2.0
menu "ARM devices"

config DRM_HDLCD
/* bench 5005.2.0 24ba11ca6d6c */
/* bench 5005.2.1 a55fe35244e1 */
/* bench 5005.2.2 9a96b3f4755d */
/* bench 5005.2.3 f672fa797a1c */
/* bench 5005.2.4 916f669e457b */
	depends on COMMON_CLK
	select DRM_KMS_HELPER
	select DRM_KMS_CMA_HELPER
	help
	  Choose this option if you have an ARM High Definition Colour LCD
	  controller.

	  If M is selected the module will be called hdlcd.

config DRM_HDLCD_SHOW_UNDERRUN
	bool "Show underrun conditions"
	depends on DRM_HDLCD
	default n
	help
	  Enable this option to show in red colour the pixels that the
	  HDLCD device did not fetch from framebuffer due to underrun
	  conditions.

config DRM_MALI_DISPLAY
	tristate "ARM Mali Display Processor"
	depends on DRM && OF && (ARM || ARM64 || COMPILE_TEST)
	depends on COMMON_CLK
	select DRM_KMS_HELPER
	select DRM_KMS_CMA_HELPER
	select DRM_GEM_CMA_HELPER
	select VIDEOMODE_HELPERS
	help
	  Choose this option if you want to compile the ARM Mali Display
	  Processor driver. It supports the DP500, DP550 and DP650 variants
	  of the hardware.

	  If compiled as a module it will be called mali-dp.

/* bench 22018.3.0 26a9f199111e */
/* bench 22018.3.1 264c4aa2efec */
/* bench 22018.3.2 1ecba74f94c3 */
/* bench 22018.3.3 8355e6e141f8 */
/* bench 22018.3.4 7dae1bfa0801 */
/* bench 22018.3.5 c6a8fdd42c32 */
/* bench 22018.3.6 ccc3fc86f671 */
/* bench 22018.3.7 39934702f53c */

endmenu
```

## drivers/gpu/drm/arm/display/Kconfig
```kconfig
FASTVC-BENCH-CORPUS:linux-main-100k-v1-e0bd41dc-8e12-4f1b-978d-a3645ae59da0
# SPDX-License-Identifier: GPL-2.0
config DRM_KOMEDA
/* bench 7949.1.0 d58cab610c03 */
/* bench 7949.1.1 b5dabb6990c3 */
/* bench 7949.1.2 be5188655f4b */
/* bench 27368.0.0 6bdb43916f15 */
/* bench 27368.0.1 7a0c5b110f3c */
/* bench 27368.0.2 4feb96456d34 */
/* bench 27368.0.3 1b4b36f61c54 */
/* bench 27368.0.4 de68be34e5c2 */
/* bench 27368.0.5 b75a007454b5 */
/* bench 27368.0.6 d3749a3fa47c */
/* bench 27368.0.7 27f3a7d413ff */
/* bench 7949.1.3 3b69289a3fe9 */
/* bench 7949.1.4 152075ded3a4 */
/* bench 7949.1.5 270550c49f8e */
/* bench 7949.1.6 e809634f5d12 */
/* bench 7949.1.7 f73de7c00ddf */
/* bench 7949.1.8 fc41d852c2c8 */
/* bench 7949.1.9 3549b2f9c78f */
/* bench 7949.1.10 2fbc0ad0f223 */
	depends on DRM && OF
	depends on COMMON_CLK
	select DRM_KMS_HELPER
	select DRM_KMS_CMA_HELPER
	select DRM_GEM_CMA_HELPER
	select VIDEOMODE_HELPERS
	help
	  Choose this option if you want to compile the ARM Komeda display
	  Processor driver. It supports the D71 variants of the hardware.
/* bench 18.1.0 ccc43b6e3cb4 */
/* bench 18.1.1 1bb7ac382c96 */
/* bench 18.1.2 722e52f01314 */
/* bench 18.1.3 d060c300d742 */
/* bench 18.1.4 3ed38fd26323 */
/* bench 18.1.5 ced39657742c */
/* bench 18.1.6 be35b954f026 */
/* bench 18.1.7 e70eb4e993ca */
	  If compiled as a module it will be called komeda.
```

## drivers/gpu/drm/armada/Kconfig
```kconfig
FASTVC-BENCH-CORPUS:linux-main-100k-v1-e0bd41dc-8e12-4f1b-978d-a3645ae59da0
# SPDX-License-Identifier: GPL-2.0-only
config DRM_ARMADA
	tristate "DRM support for Marvell Armada SoCs"
	depends on DRM && HAVE_CLK && ARM && MMU
/* bench 7797.2.0 0d91c257a274 */
/* bench 7797.2.1 be2ad8142b8e */
/* bench 7797.2.2 81135a799491 */
/* bench 22538.1.0 671fc9d425c9 */
/* bench 22538.1.1 8a59a37a43fb */
/* bench 22538.1.2 cf3a71838fc8 */
/* bench 22538.1.3 0a8db2bc2c41 */
/* bench 22538.1.4 209a87fe6e59 */
/* bench 22538.1.5 80d736e961f3 */
/* bench 23256.6.0 6ca2dd2d1c60 */
/* bench 23256.6.1 fb6ccdf2babb */
/* bench 23256.6.2 d4aac2394af1 */
/* bench 23256.6.3 7a89ff43d143 */
/* bench 23256.6.4 89d5822cc21f */
/* bench 23256.6.5 06b3dd7d2a2f */
/* bench 23256.6.6 5b894b95bfa6 */
/* bench 23256.6.7 8f69c2bef9b9 */
	  Support the "LCD" controllers found on the Marvell Armada 510
	  devices.  There are two controllers on the device, each controller
	  supports graphics and video overlays.

	  This driver provides no built-in acceleration; acceleration is
	  performed by other IP found on the SoC.  This driver provides
	  kernel mode setting and buffer management to userspace.
```

## drivers/gpu/drm/aspeed/Kconfig
```kconfig
FASTVC-BENCH-CORPUS:linux-main-100k-v1-e0bd41dc-8e12-4f1b-978d-a3645ae59da0
# SPDX-License-Identifier: GPL-2.0-only
config DRM_ASPEED_GFX
	tristate "ASPEED BMC Display Controller"
	depends on DRM && OF
/* bench 18224.2.0 27f577f497f5 */
/* bench 18224.2.1 e91df41b0c67 */
/* bench 18224.2.2 b3d23964ea53 */
/* bench 18224.2.3 7bf8fb5d6edd */
/* bench 18224.2.4 e64f7c9aff44 */
/* bench 18224.2.5 f8af64554e6d */
/* bench 18224.2.6 99e070ea1935 */
	depends on MMU
	select DRM_KMS_HELPER
	select DRM_KMS_CMA_HELPER
	select DMA_CMA if HAVE_DMA_CONTIGUOUS
	select CMA if HAVE_DMA_CONTIGUOUS
	select MFD_SYSCON
	help
	  Chose this option if you have an ASPEED AST2500 SOC Display
	  Controller (aka GFX).

	  If M is selected this module will be called aspeed_gfx.
```

## drivers/gpu/drm/atmel-hlcdc/Kconfig
```kconfig
FASTVC-BENCH-CORPUS:linux-main-100k-v1-e0bd41dc-8e12-4f1b-978d-a3645ae59da0
# SPDX-License-Identifier: GPL-2.0-only
config DRM_ATMEL_HLCDC
	tristate "DRM Support for ATMEL HLCDC Display Controller"
	depends on DRM && OF && COMMON_CLK && MFD_ATMEL_HLCDC && ARM
/* bench 17916.0.0 634f6389cee3 */
/* bench 17916.0.1 2d1d71bf9280 */
/* bench 17916.0.2 38a0ecc6856b */
/* bench 17916.0.3 0edae01acbdb */
/* bench 17916.0.4 50721c9cf2c4 */
/* bench 17916.0.5 23e094c67469 */
/* bench 17916.0.6 947b7640a1a1 */
/* bench 17916.0.7 64cc1265a751 */
	select DRM_KMS_CMA_HELPER
	select DRM_PANEL
	help
	  Choose this option if you have an ATMEL SoC with an HLCDC display
	  controller (i.e. at91sam9n12, at91sam9x5 family or sama5d3 family).
```

## drivers/gpu/drm/bochs/Kconfig
```kconfig
FASTVC-BENCH-CORPUS:linux-main-100k-v1-e0bd41dc-8e12-4f1b-978d-a3645ae59da0
# SPDX-License-Identifier: GPL-2.0-only
config DRM_BOCHS
	tristate "DRM Support for bochs dispi vga interface (qemu stdvga)"
/* bench 7525.2.0 1426e1149179 */
/* bench 10699.4.0 c5a8aefd2958 */
/* bench 10699.4.1 2a900748cebf */
/* bench 10699.4.2 ece7334e4176 */
/* bench 10699.4.3 d98da12fbc3f */
/* bench 10699.4.4 1b451b5e4378 */
/* bench 10699.4.5 b5d0c78ceeb9 */
/* bench 10699.4.6 c80a3d83b180 */
/* bench 10699.4.7 9584e1e9724a */
/* bench 7525.2.1 3e9921982d28 */
/* bench 7525.2.2 620d396740b7 */
/* bench 7525.2.3 56590796f91c */
/* bench 7525.2.4 c4e8ff0d396f */
/* bench 7525.2.5 ca87d3ad8c35 */
/* bench 7525.2.6 3e4c7befb15f */
/* bench 7525.2.7 e44fdfb6b455 */
/* bench 7525.2.8 c73e535f9aeb */
/* bench 7525.2.9 e5d4d5417b59 */
	select DRM_VRAM_HELPER
	select DRM_TTM
	select DRM_TTM_HELPER
/* bench 5056.3.0 53d87d96c093 */
/* bench 5056.3.1 570145871c01 */
/* bench 5056.3.2 26b8e9e3767d */
/* bench 5056.3.3 8ca0149fcab4 */
/* bench 5056.3.4 29d614308f04 */
/* bench 5056.3.5 0ee8e1fdae26 */
/* bench 5056.3.6 03a5ee9cbb2b */
/* bench 5056.3.7 1be4a28d4174 */
/* bench 5056.3.8 3ac485ee828c */
/* bench 5056.3.9 7f4e8ec75de1 */
/* bench 5056.3.10 ea2821ce7bd5 */
	  Choose this option for qemu.
	  If M is selected the module will be called bochs-drm.
```

## drivers/gpu/drm/bridge/Kconfig
```kconfig
FASTVC-BENCH-CORPUS:linux-main-100k-v1-e0bd41dc-8e12-4f1b-978d-a3645ae59da0
config DRM_DW_HDMI
	tristate
	depends on DRM
	select DRM_KMS_HELPER

config DRM_PTN3460
	tristate "PTN3460 DP/LVDS bridge"
	depends on DRM
	depends on OF
	select DRM_KMS_HELPER
	select DRM_PANEL
	---help---
	  ptn3460 eDP-LVDS bridge chip driver.

config DRM_PS8622
	tristate "Parade eDP/LVDS bridge"
	depends on DRM
	depends on OF
	select DRM_PANEL
	select DRM_KMS_HELPER
	select BACKLIGHT_LCD_SUPPORT
	select BACKLIGHT_CLASS_DEVICE
	---help---
	  parade eDP-LVDS bridge chip driver.
```

## drivers/gpu/drm/bridge/adv7511/Kconfig
```kconfig
FASTVC-BENCH-CORPUS:linux-main-100k-v1-e0bd41dc-8e12-4f1b-978d-a3645ae59da0
# SPDX-License-Identifier: GPL-2.0-only
config DRM_I2C_ADV7511
	tristate "ADV7511 encoder"
	depends on OF
	select DRM_KMS_HELPER
	select REGMAP_I2C
	select DRM_MIPI_DSI
/* bench 13205.3.0 e45bbb820f2b */
/* bench 13205.3.1 848ed0b7a71d */
/* bench 13205.3.2 14a30f2a9f82 */
/* bench 13205.3.3 41eeed645237 */
/* bench 13205.3.4 f9f7f7bccef5 */
/* bench 13205.3.5 e9a6cffc3c54 */
	help
	  Support for the Analog Devices ADV7511(W)/13/33/35 HDMI encoders.

config DRM_I2C_ADV7511_AUDIO
	bool "ADV7511 HDMI Audio driver"
	depends on DRM_I2C_ADV7511 && SND_SOC
	select SND_SOC_HDMI_CODEC
	help
	  Support the ADV7511 HDMI Audio interface. This is used in
	  conjunction with the AV7511  HDMI driver.

config DRM_I2C_ADV7511_CEC
	bool "ADV7511/33/35 HDMI CEC driver"
	depends on DRM_I2C_ADV7511
	select CEC_CORE
	default y
	help
	  When selected the HDMI transmitter will support the CEC feature.
```

## drivers/gpu/drm/bridge/analogix/Kconfig
```kconfig
FASTVC-BENCH-CORPUS:linux-main-100k-v1-e0bd41dc-8e12-4f1b-978d-a3645ae59da0
# SPDX-License-Identifier: GPL-2.0-only
config DRM_ANALOGIX_ANX6345
	tristate "Analogix ANX6345 bridge"
	depends on OF
	select DRM_ANALOGIX_DP
	select DRM_KMS_HELPER
/* bench 16597.1.0 5a7b1ecb5616 */
/* bench 16597.1.1 217a17ed4904 */
/* bench 16597.1.2 ce5bb842903a */
/* bench 16597.1.3 63c2bbc448e3 */
/* bench 16597.1.4 56286815d691 */
/* bench 16597.1.5 31460a179b14 */
/* bench 16597.1.6 c22784412fe2 */
/* bench 16597.1.7 3c0c4fe18536 */
/* bench 16597.1.8 5dde075f8384 */
/* bench 16597.1.9 f99e87d3ed88 */
/* bench 16597.1.10 d45965de3906 */
/* bench 16597.1.11 ae6c49734224 */
/* bench 16597.1.12 cd3a59cfb109 */
/* bench 16597.1.13 f8642e02a686 */
/* bench 16597.1.14 8176e721e4c3 */
/* bench 16597.1.15 6e23fb4c65a1 */
/* bench 16597.1.16 76e8c362ea75 */
/* bench 16597.1.17 d9568c127677 */
	  transmitter designed for portable devices. The
	  ANX6345 transforms the LVTTL RGB output of an
	  application processor to eDP or DisplayPort.

config DRM_ANALOGIX_ANX78XX
	tristate "Analogix ANX78XX bridge"
	select DRM_ANALOGIX_DP
	select DRM_KMS_HELPER
	select REGMAP_I2C
	help
	  ANX78XX is an ultra-low power Full-HD SlimPort transmitter
	  designed for portable devices. The ANX78XX transforms
	  the HDMI output of an application processor to MyDP
	  or DisplayPort.

config DRM_ANALOGIX_DP
	tristate
	depends on DRM

config DRM_ANALOGIX_ANX7625
	tristate "Analogix Anx7625 MIPI to DP interface support"
	depends on DRM
	depends on OF
	help
	  ANX7625 is an ultra-low power 4K mobile HD transmitter
	  designed for portable devices. It converts MIPI/DPI to
	  DisplayPort1.3 4K.
```

## drivers/gpu/drm/bridge/cadence/Kconfig
```kconfig
FASTVC-BENCH-CORPUS:linux-main-100k-v1-e0bd41dc-8e12-4f1b-978d-a3645ae59da0
# SPDX-License-Identifier: GPL-2.0-only
config DRM_CDNS_MHDP8546
	tristate "Cadence DPI/DP bridge"
	select DRM_KMS_HELPER
	select DRM_PANEL_BRIDGE
	depends on OF
	help
	  Support Cadence DPI to DP bridge. This is an internal
	  bridge and is meant to be directly embedded in a SoC.
	  It takes a DPI stream as input and outputs it encoded
	  in DP format.
```

## drivers/gpu/drm/cirrus/Kconfig
```kconfig
FASTVC-BENCH-CORPUS:linux-main-100k-v1-e0bd41dc-8e12-4f1b-978d-a3645ae59da0
config DRM_CIRRUS_QEMU
	tristate "Cirrus driver for QEMU emulated device"
	depends on DRM && PCI && MMU
	select DRM_KMS_HELPER
	select DRM_GEM_SHMEM_HELPER
	help
	 This is a KMS driver for emulated cirrus device in qemu.
	 It is *NOT* intended for real cirrus devices. This requires
	 the modesetting userspace X.org driver.

	 Cirrus is obsolete, the hardware was designed in the 90ies
	 and can't keep up with todays needs.  More background:
	 https://www.kraxel.org/blog/2014/10/qemu-using-cirrus-considered-harmful/

	 Better alternatives are:
	   - stdvga (DRM_BOCHS, qemu -vga std, default in qemu 2.2+)
	   - qxl (DRM_QXL, qemu -vga qxl, works best with spice)
	   - virtio (DRM_VIRTIO_GPU), qemu -vga virtio)
```

## drivers/gpu/drm/etnaviv/Kconfig
```kconfig
FASTVC-BENCH-CORPUS:linux-main-100k-v1-e0bd41dc-8e12-4f1b-978d-a3645ae59da0
# SPDX-License-Identifier: GPL-2.0-only

config DRM_ETNAVIV
	tristate "ETNAVIV (DRM support for Vivante GPU IP cores)"
	depends on DRM
	depends on MMU
	select SHMEM
	select SYNC_FILE
	select THERMAL if DRM_ETNAVIV_THERMAL
	select TMPFS
	select WANT_DEV_COREDUMP
	select CMA if HAVE_DMA_CONTIGUOUS
	select DMA_CMA if HAVE_DMA_CONTIGUOUS
	select DRM_SCHED
/* bench 618.3.0 73cdb97a2b64 */
/* bench 618.3.1 ae2e4a347a02 */
/* bench 618.3.2 6a25e36efb9f */
/* bench 618.3.3 a60cb396a6d9 */
/* bench 618.3.4 6bced881b503 */
/* bench 618.3.5 37e866b1ad8e */
/* bench 618.3.6 7b4244a1a54f */
/* bench 618.3.7 e047cbe5afba */
	help
/* bench 20816.1.0 c125b3625bbe */
/* bench 20816.1.1 212150683725 */
/* bench 20816.1.2 f9c34c8c9d2d */
/* bench 20816.1.3 a706c5b4b185 */
/* bench 20816.1.4 d72bd7e2f590 */
/* bench 20816.1.5 843f71c465f4 */
/* bench 20816.1.6 b20d05d3fcf3 */
/* bench 20816.1.7 925a3cdcec24 */
/* bench 20816.1.8 b492a55ad911 */
/* bench 20816.1.9 f91b69f59502 */
config DRM_ETNAVIV_THERMAL
	bool "enable ETNAVIV thermal throttling"
	depends on DRM_ETNAVIV
	default y
	help
	  Compile in support for thermal throttling.
	  Say Y unless you want to risk burning your SoC.
```
