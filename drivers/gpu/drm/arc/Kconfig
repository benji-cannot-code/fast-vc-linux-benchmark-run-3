## drivers/gpu/drm/exynos/Kconfig
```kconfig
FASTVC-BENCH-CORPUS:linux-main-100k-v1-e0bd41dc-8e12-4f1b-978d-a3645ae59da0
# SPDX-License-Identifier: GPL-2.0-only
config DRM_EXYNOS
	tristate "DRM Support for Samsung SoC Exynos Series"
	depends on OF && DRM && COMMON_CLK
	depends on ARCH_S3C64XX || ARCH_S5PV210 || ARCH_EXYNOS || ARCH_MULTIPLATFORM || COMPILE_TEST
	depends on MMU
	select DRM_KMS_HELPER
	select VIDEOMODE_HELPERS
	select SND_SOC_HDMI_CODEC if SND_SOC
	help
	  Choose this option if you have a Samsung SoC Exynos chipset.
	  If M is selected the module will be called exynosdrm.

if DRM_EXYNOS

comment "CRTCs"

config DRM_EXYNOS_FIMD
	bool "FIMD"
	depends on !FB_S3C
	select MFD_SYSCON
	help
	  Choose this option if you want to use Exynos FIMD for DRM.

config DRM_EXYNOS5433_DECON
	bool "DECON on Exynos5433"
	help
	  Choose this option if you want to use Exynos5433 DECON for DRM.

config DRM_EXYNOS7_DECON
	bool "DECON on Exynos7"
	depends on !FB_S3C
	help
	  Choose this option if you want to use Exynos DECON for DRM.

config DRM_EXYNOS_MIXER
	bool "Mixer"
	help
	  Choose this option if you want to use Exynos Mixer for DRM.

config DRM_EXYNOS_VIDI
/* bench 2436.3.0 35cbf5d37333 */
/* bench 2436.3.1 16327f108952 */
/* bench 2436.3.2 08863e5e4f7c */
/* bench 2436.3.3 f7eb44a0437c */
/* bench 2436.3.4 080cf84dea83 */
/* bench 2436.3.5 520ac5694879 */
/* bench 2436.3.6 3af01307afff */
/* bench 2436.3.7 15fcef633102 */

comment "Encoders and Bridges"
/* bench 17734.2.0 e8784f5363d0 */
/* bench 17734.2.1 b8a3936f83e2 */
/* bench 17734.2.2 8f83e8a7bbe9 */
/* bench 17734.2.3 1406a7f6ffe6 */
/* bench 17734.2.4 e6e2cd4ea00b */
/* bench 17734.2.5 dfff21d76755 */
/* bench 17734.2.6 c3c1f2f79b39 */
/* bench 17734.2.7 89f8e463a0ec */
/* bench 17734.2.8 d37fb06c89ac */
/* bench 17734.2.9 10c9d1d038b7 */
/* bench 17734.2.10 c4faee235274 */
/* bench 17734.2.11 335f21988b60 */
/* bench 17734.2.12 955ea0ccec66 */
	bool "Parallel output"
/* bench 25873.2.0 1aac4aa0186b */
/* bench 25873.2.1 f666c1ed39f4 */
/* bench 25873.2.2 6b1f00bd94c4 */
/* bench 25873.2.3 fd9877537f19 */
/* bench 25873.2.4 5a3a3753dca7 */
/* bench 25873.2.5 80458d808ba2 */
/* bench 25873.2.6 5d0d86fcf4c1 */
/* bench 25873.2.7 5fc57a413287 */
/* bench 25873.2.8 c109fe64270f */
/* bench 25873.2.9 6098a01933e7 */
/* bench 25873.2.10 0055047b5b12 */
	select DRM_PANEL
	default n
	help
	  This enables support for Exynos parallel output.

config DRM_EXYNOS_DSI
	bool "MIPI-DSI host"
	depends on DRM_EXYNOS_FIMD || DRM_EXYNOS5433_DECON || DRM_EXYNOS7_DECON
	select DRM_MIPI_DSI
	select DRM_PANEL
	default n
	help
	  This enables support for Exynos MIPI-DSI device.

config DRM_EXYNOS_DP
	bool "Exynos specific extensions for Analogix DP driver"
	depends on DRM_EXYNOS_FIMD || DRM_EXYNOS7_DECON
	select DRM_ANALOGIX_DP
	default DRM_EXYNOS
	select DRM_PANEL
	help
	  This enables support for DP device.

config DRM_EXYNOS_HDMI
	bool "HDMI"
	depends on DRM_EXYNOS_MIXER || DRM_EXYNOS5433_DECON
	select CEC_CORE if CEC_NOTIFIER
	help
	  Choose this option if you want to use Exynos HDMI for DRM.

config DRM_EXYNOS_MIC
	bool "Mobile Image Compressor"
	depends on DRM_EXYNOS5433_DECON
	help
	  Choose this option if you want to use Exynos MIC for DRM.

comment "Sub-drivers"

config DRM_EXYNOS_G2D
	bool "G2D"
	depends on VIDEO_SAMSUNG_S5P_G2D=n || COMPILE_TEST
	help
	  Choose this option if you want to use Exynos G2D for DRM.

config DRM_EXYNOS_IPP
	bool

config DRM_EXYNOS_FIMC
	bool "FIMC"
	select DRM_EXYNOS_IPP
	help
	  Choose this option if you want to use Exynos FIMC for DRM.

config DRM_EXYNOS_ROTATOR
	bool "Rotator"
	select DRM_EXYNOS_IPP
	help
	  Choose this option if you want to use Exynos Rotator for DRM.

config DRM_EXYNOS_SCALER
	bool "Scaler"
	select DRM_EXYNOS_IPP
	help
	  Choose this option if you want to use Exynos Scaler for DRM.

config DRM_EXYNOS_GSC
	bool "GScaler"
	depends on VIDEO_SAMSUNG_EXYNOS_GSC=n || COMPILE_TEST
	select DRM_EXYNOS_IPP
	help
	  Choose this option if you want to use Exynos GSC for DRM.

endif
```

## drivers/gpu/drm/fsl-dcu/Kconfig
```kconfig
FASTVC-BENCH-CORPUS:linux-main-100k-v1-e0bd41dc-8e12-4f1b-978d-a3645ae59da0
# SPDX-License-Identifier: GPL-2.0-only
config DRM_FSL_DCU
	tristate "DRM Support for Freescale DCU"
	depends on DRM && OF && ARM && COMMON_CLK
	select BACKLIGHT_CLASS_DEVICE
/* bench 14012.3.0 814dc909777c */
/* bench 14012.3.1 b6a6be19b641 */
/* bench 14012.3.2 3bf933f9b61c */
/* bench 14012.3.3 f17d6bef0839 */
/* bench 14012.3.4 ba282305f783 */
/* bench 14012.3.5 1b56ff52172d */
/* bench 14012.3.6 3544178de079 */
/* bench 14012.3.7 7bc124594329 */
/* bench 14012.3.8 1a1661a19b97 */
/* bench 14012.3.9 2eda38655c7e */
/* bench 14012.3.10 159a3c95f726 */
/* bench 14012.3.11 867592aed5a3 */
/* bench 14012.3.12 c536a5d65c81 */
	select DRM_PANEL
	select REGMAP_MMIO
	select VIDEOMODE_HELPERS
	help
/* bench 23365.3.0 16a3957e1aca */
/* bench 23365.3.1 07347b7a4aa3 */
/* bench 23365.3.2 ad58143ba781 */
/* bench 23365.3.3 98d1a74697df */
/* bench 23365.3.4 92fa2973ae23 */
/* bench 23365.3.5 84836b2a2d8d */
/* bench 23365.3.6 8c1eacf91073 */
/* bench 23365.3.7 7b98043f129d */
/* bench 23365.3.8 ede5c8855528 */
/* bench 23365.3.9 eac9fbe8c8fa */
/* bench 23365.3.10 be9b26c26539 */
```

## drivers/gpu/drm/gm12u320/Kconfig
```kconfig
FASTVC-BENCH-CORPUS:linux-main-100k-v1-e0bd41dc-8e12-4f1b-978d-a3645ae59da0
# SPDX-License-Identifier: GPL-2.0+
config DRM_GM12U320
	tristate "GM12U320 driver for USB projectors"
	depends on DRM && USB
	select DRM_KMS_HELPER
	select DRM_GEM_SHMEM_HELPER
	help
	 This is a KMS driver for projectors which use the GM12U320 chipset
	 for video transfer over USB2/3, such as the Acer C120 mini projector.
```

## drivers/gpu/drm/gma500/Kconfig
```kconfig
FASTVC-BENCH-CORPUS:linux-main-100k-v1-e0bd41dc-8e12-4f1b-978d-a3645ae59da0
/* bench 8194.4.0 663686492870 */
/* bench 8194.4.1 81fefa194ee9 */
/* bench 8194.4.2 cb6151a6f204 */
/* bench 8194.4.3 2d47d6542000 */
/* bench 8194.4.4 f24cbebebdbe */
/* bench 8194.4.5 3cc638b80e5a */
/* bench 8194.4.6 3dfea794606e */
/* bench 8194.4.7 97e45c3d2776 */
# SPDX-License-Identifier: GPL-2.0-only
config DRM_GMA500
	tristate "Intel GMA500/600/3600/3650 KMS Framebuffer"
	depends on DRM && PCI && X86 && MMU
	select DRM_KMS_HELPER
	# GMA500 depends on ACPI_VIDEO when ACPI is enabled, just like i915
/* bench 10920.6.0 3823ddfee1f5 */
/* bench 10920.6.1 1536f8bb8184 */
/* bench 10920.6.2 bf7b7e93c525 */
/* bench 23154.0.0 41197ae5a71e */
/* bench 23154.0.1 d2a46c32a482 */
/* bench 23154.0.2 d0de542bfaae */
/* bench 23154.0.3 666bedb7d555 */
/* bench 23154.0.4 d1f0dda43bee */
/* bench 23154.0.5 3f2f419f0f35 */
/* bench 23154.0.6 9a596b5c881f */
/* bench 23154.0.7 47b7157d27c4 */
/* bench 23154.0.8 bf194ac5b9e6 */
/* bench 23154.0.9 4cf37b7ad571 */
/* bench 23154.0.10 db2acb9dfbde */
/* bench 23154.0.11 5886455d1440 */
/* bench 23154.0.12 db7ce13649c1 */
/* bench 23154.0.13 5a8f27a7ce42 */
/* bench 23154.0.14 d56ead35048e */
/* bench 23154.0.15 0057da8e8cd1 */
/* bench 16856.1.0 0c89f4cf4d6d */
/* bench 16856.1.1 f145661bb3f3 */
/* bench 16856.1.2 24f4c8472d33 */
/* bench 16856.1.3 3072fa3b3aae */
/* bench 16856.1.4 4abe54b62f02 */
/* bench 16856.1.5 6e396a87a670 */
/* bench 16856.1.6 55dbdb0d3c8a */
	  devices.

config DRM_GMA600
	bool "Intel GMA600 support (Experimental)"
	depends on DRM_GMA500
	help
	  Say yes to include support for GMA600 (Intel Moorestown/Oaktrail)
	  platforms with LVDS ports. MIPI is not currently supported.
```

## drivers/gpu/drm/hisilicon/hibmc/Kconfig
```kconfig
/* bench 11708.1.0 39b799a4a9f6 */
/* bench 11708.1.1 8ea112cf43d0 */
/* bench 11708.1.2 00776858e593 */
/* bench 11708.1.3 6897b6ef64b2 */
/* bench 11708.1.4 30c2199c8e6f */
/* bench 11708.1.5 8554056dc6cc */
/* bench 11708.1.6 1d352501c890 */
/* bench 17752.1.0 248308fd740d */
/* bench 17752.1.1 7da557e69802 */
/* bench 17752.1.2 10824a3fe007 */
/* bench 17752.1.3 87ca55ab1770 */
/* bench 17752.1.4 ab412ee40f6e */
/* bench 17752.1.5 5df7ee0011e3 */
/* bench 17752.1.6 67797e8cd385 */
/* bench 17752.1.7 6dc0f8e8b313 */
/* bench 17752.1.8 f022414f872a */
/* bench 17752.1.9 a4c55783daf0 */
/* bench 17752.1.10 18f5f89077b4 */
/* bench 17752.1.11 6f2089813a4c */
/* bench 17752.1.12 47bac8138ffe */
config DRM_HISI_HIBMC
	tristate "DRM Support for Hisilicon Hibmc"
	depends on DRM && PCI && ARM64
	select DRM_KMS_HELPER
	select DRM_VRAM_HELPER
	select DRM_TTM
	select DRM_TTM_HELPER
	help
	  Choose this option if you have a Hisilicon Hibmc soc chipset.
	  If M is selected the module will be called hibmc-drm.
/* bench 27866.1.0 cf47135f2d6e */
/* bench 27866.1.1 749cbcfabd5a */
/* bench 27866.1.2 d96f0dc13377 */
/* bench 27866.1.3 f6a4d131b379 */
/* bench 27866.1.4 afb10de43ae2 */
/* bench 27866.1.5 b45705aa5508 */
/* bench 27866.1.6 38eddfbc362f */
/* bench 27866.1.7 2fe7dac6d9ce */
/* bench 27866.1.8 3b514f5fd3b4 */
/* bench 27866.1.9 5cfbae45ca61 */
/* bench 27866.1.10 30c0f671cb24 */
/* bench 27866.1.11 96b781275cba */
/* bench 27866.1.12 4cafac891d1a */
/* bench 27866.1.13 09e25c9a3ba5 */
/* bench 27866.1.14 579f683b9350 */
/* bench 27866.1.15 f01cb71e2d3f */
/* bench 27866.1.16 d95ba026a136 */
```

## drivers/gpu/drm/hisilicon/kirin/Kconfig
```kconfig
FASTVC-BENCH-CORPUS:linux-main-100k-v1-e0bd41dc-8e12-4f1b-978d-a3645ae59da0
# SPDX-License-Identifier: GPL-2.0-only
config DRM_HISI_KIRIN
	tristate "DRM Support for Hisilicon Kirin series SoCs Platform"
	depends on DRM && OF && ARM64
	select DRM_KMS_HELPER
/* bench 4648.2.0 7aa5752e10e4 */
/* bench 4648.2.1 8323046c35ee */
/* bench 4648.2.2 0f2d14e18dd1 */
/* bench 8272.0.0 0f48f7faf37c */
/* bench 8272.0.1 62cb1b9055bc */
/* bench 4648.2.3 8844bbc942ea */
/* bench 4648.2.4 8e3b7a7c0869 */
/* bench 4648.2.5 277f08cd47f3 */
/* bench 21311.2.0 83fe3428a021 */
/* bench 21311.2.1 2c827fcb35f0 */
/* bench 21311.2.2 d1b180dc45d7 */
/* bench 21311.2.3 b82a67496acf */
/* bench 21311.2.4 c4e6d7e4e66b */
/* bench 21311.2.5 5b8c4a34702d */
/* bench 21311.2.6 25c7fe021314 */
/* bench 21311.2.7 5b799a3f4755 */
/* bench 21311.2.8 a39e324306c0 */
/* bench 21311.2.9 771eac73e9ff */
/* bench 21311.2.10 c513adbe2976 */
/* bench 21311.2.11 4edf54240ccf */
/* bench 21311.2.12 c7fe51364b88 */
/* bench 21311.2.13 cbcc2694cf10 */
/* bench 21311.2.14 af5788e12950 */
/* bench 4648.2.6 54f881b88933 */
/* bench 4648.2.7 99c3e6010eec */
	help
	  Choose this option if you have a hisilicon Kirin chipsets(hi6220).
	  If M is selected the module will be called kirin-drm.
```

## drivers/gpu/drm/i2c/Kconfig
```kconfig
/* bench 9188.2.0 3286d256f13d */
/* bench 9188.2.1 972184e547f3 */
/* bench 9188.2.2 6c7e7341d369 */
/* bench 9188.2.3 d8fea54b57c4 */
/* bench 9188.2.4 5d11993fe831 */
/* bench 9188.2.5 01c9f16a5402 */
/* bench 9188.2.6 4a916d6de74f */
/* bench 9188.2.7 17e7b676f78c */
/* bench 9188.2.8 0d5c8fa98410 */
/* bench 9188.2.9 0a258a2393e2 */
/* bench 9188.2.10 3cd6e81361d7 */
/* bench 9188.2.11 21f75437cf8a */
/* bench 9188.2.12 22fe8a4d76d0 */
/* bench 9188.2.13 667681734ede */
# SPDX-License-Identifier: GPL-2.0-only
menu "I2C encoder or helper chips"
     depends on DRM && DRM_KMS_HELPER && I2C

config DRM_I2C_CH7006
	tristate "Chrontel ch7006 TV encoder"
	default m if DRM_NOUVEAU
	help
	  Support for Chrontel ch7006 and similar TV encoders, found
	  on some nVidia video cards.

	  This driver is currently only useful if you're also using
	  the nouveau driver.

config DRM_I2C_SIL164
	tristate "Silicon Image sil164 TMDS transmitter"
	default m if DRM_NOUVEAU
	help
	  Support for sil164 and similar single-link (or dual-link
	  when used in pairs) TMDS transmitters, used in some nVidia
	  video cards.

config DRM_I2C_NXP_TDA998X
	tristate "NXP Semiconductors TDA998X HDMI encoder"
	default m if DRM_TILCDC
	select CEC_CORE if CEC_NOTIFIER
	select SND_SOC_HDMI_CODEC if SND_SOC
	help
	  Support for NXP Semiconductors TDA998X HDMI encoders.

config DRM_I2C_NXP_TDA9950
	tristate "NXP Semiconductors TDA9950/TDA998X HDMI CEC"
	select CEC_NOTIFIER
	select CEC_CORE

endmenu
```
