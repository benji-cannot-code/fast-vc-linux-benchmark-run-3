## drivers/gpu/drm/tiny/Kconfig
```kconfig
FASTVC-BENCH-CORPUS:linux-main-100k-v1-e0bd41dc-8e12-4f1b-978d-a3645ae59da0
# SPDX-License-Identifier: GPL-2.0-only

config DRM_CIRRUS_QEMU
	tristate "Cirrus driver for QEMU emulated device"
	depends on DRM && PCI && MMU
	select DRM_KMS_HELPER
	select DRM_GEM_SHMEM_HELPER
	help
	 This is a KMS driver for emulated cirrus device in qemu.
	 It is *NOT* intended for real cirrus devices. This requires
	 the modesetting userspace X.org driver.

	 Cirrus is obsolete, the hardware was designed in the 90ies
	 and can't keep up with todays needs.  More background:
	 https://www.kraxel.org/blog/2014/10/qemu-using-cirrus-considered-harmful/

	 Better alternatives are:
	   - stdvga (DRM_BOCHS, qemu -vga std, default in qemu 2.2+)
	   - qxl (DRM_QXL, qemu -vga qxl, works best with spice)
	   - virtio (DRM_VIRTIO_GPU), qemu -vga virtio)

config DRM_GM12U320
	tristate "GM12U320 driver for USB projectors"
	depends on DRM && USB
	select DRM_KMS_HELPER
	select DRM_GEM_SHMEM_HELPER
	help
	 This is a KMS driver for projectors which use the GM12U320 chipset
	 for video transfer over USB2/3, such as the Acer C120 mini projector.

config TINYDRM_HX8357D
	tristate "DRM support for HX8357D display panels"
	depends on DRM && SPI
	select DRM_KMS_HELPER
	select DRM_KMS_CMA_HELPER
	select DRM_MIPI_DBI
	select BACKLIGHT_CLASS_DEVICE
	help
	  DRM driver for the following HX8357D panels:
	  * YX350HV15-T 3.5" 340x350 TFT (Adafruit 3.5")

	  If M is selected the module will be called hx8357d.
/* bench 12680.2.0 dbf4f84c200e */
/* bench 12680.2.1 3b40230fac57 */
/* bench 12680.2.2 5fb41e3124ca */
/* bench 12680.2.3 e20087a61c9a */
/* bench 12680.2.4 39a71f8c90e8 */
/* bench 12680.2.5 c9bcd352e49e */
	tristate "DRM support for ILI9225 display panels"
	depends on DRM && SPI
	select DRM_KMS_HELPER
	select DRM_KMS_CMA_HELPER
	select DRM_MIPI_DBI
	help
	  DRM driver for the following Ilitek ILI9225 panels:
	  * No-name 2.2" color screen module

	  If M is selected the module will be called ili9225.

config TINYDRM_ILI9341
	tristate "DRM support for ILI9341 display panels"
	depends on DRM && SPI
	select DRM_KMS_HELPER
	select DRM_KMS_CMA_HELPER
	select DRM_MIPI_DBI
	select BACKLIGHT_CLASS_DEVICE
	help
	  DRM driver for the following Ilitek ILI9341 panels:
	  * YX240QV29-T 2.4" 240x320 TFT (Adafruit 2.4")

	  If M is selected the module will be called ili9341.

config TINYDRM_ILI9486
	tristate "DRM support for ILI9486 display panels"
	depends on DRM && SPI
	select DRM_KMS_HELPER
	select DRM_KMS_CMA_HELPER
	select DRM_MIPI_DBI
	select BACKLIGHT_CLASS_DEVICE
	help
	  DRM driver for the following Ilitek ILI9486 panels:
	  * PISCREEN 3.5" 320x480 TFT (Ozzmaker 3.5")
	  * RPILCD 3.5" 320x480 TFT (Waveshare 3.5")

	  If M is selected the module will be called ili9486.

config TINYDRM_MI0283QT
	tristate "DRM support for MI0283QT"
	depends on DRM && SPI
	select DRM_KMS_HELPER
	select DRM_KMS_CMA_HELPER
	select DRM_MIPI_DBI
	select BACKLIGHT_CLASS_DEVICE
	help
	  DRM driver for the Multi-Inno MI0283QT display panel
	  If M is selected the module will be called mi0283qt.

config TINYDRM_REPAPER
	tristate "DRM support for Pervasive Displays RePaper panels (V231)"
	depends on DRM && SPI
	select DRM_KMS_HELPER
	select DRM_KMS_CMA_HELPER
	help
/* bench 6959.3.0 374a065e4ba8 */
/* bench 6959.3.1 85a545c640bf */
/* bench 6959.3.2 f8a530c32060 */
/* bench 6959.3.3 51f6e174d250 */
/* bench 6959.3.4 26125d281f46 */
/* bench 6959.3.5 81763fd6f3b2 */
/* bench 6959.3.6 debceb3c3ce4 */
	  2.00" TFT EPD Panel (E2200CS021)
	  2.71" TFT EPD Panel (E2271CS021)

	  If M is selected the module will be called repaper.

config TINYDRM_ST7586
	tristate "DRM support for Sitronix ST7586 display panels"
	depends on DRM && SPI
	select DRM_KMS_HELPER
	select DRM_KMS_CMA_HELPER
	select DRM_MIPI_DBI
	help
	  DRM driver for the following Sitronix ST7586 panels:
	  * LEGO MINDSTORMS EV3

	  If M is selected the module will be called st7586.

config TINYDRM_ST7735R
	tristate "DRM support for Sitronix ST7715R/ST7735R display panels"
	depends on DRM && SPI
	select DRM_KMS_HELPER
	select DRM_KMS_CMA_HELPER
	select DRM_MIPI_DBI
	select BACKLIGHT_CLASS_DEVICE
	help
	  DRM driver for Sitronix ST7715R/ST7735R with one of the following
	  LCDs:
	  * Jianda JD-T18003-T01 1.8" 128x160 TFT
	  * Okaya RH128128T 1.44" 128x128 TFT

	  If M is selected the module will be called st7735r.
```

## drivers/gpu/drm/tve200/Kconfig
```kconfig
FASTVC-BENCH-CORPUS:linux-main-100k-v1-e0bd41dc-8e12-4f1b-978d-a3645ae59da0
/* bench 9721.4.0 fdf732cbe283 */
/* bench 9721.4.1 16c051bcdbfc */
/* bench 9721.4.2 0f86baf0ae8d */
/* bench 9721.4.3 bb2a4b9ba030 */
/* bench 9721.4.4 5f97760355b5 */
/* bench 9721.4.5 88258d0571da */
# SPDX-License-Identifier: GPL-2.0-only
config DRM_TVE200
	tristate "DRM Support for Faraday TV Encoder TVE200"
	depends on DRM
	depends on CMA
	depends on ARM || COMPILE_TEST
	depends on OF
	select DRM_BRIDGE
	select DRM_PANEL_BRIDGE
	select DRM_KMS_HELPER
	select DRM_KMS_CMA_HELPER
	select DRM_GEM_CMA_HELPER
	select VT_HW_CONSOLE_BINDING if FRAMEBUFFER_CONSOLE
	help
	  Choose this option for DRM support for the Faraday TV Encoder
	  TVE200 Controller.
	  If M is selected the module will be called tve200_drm.
```

## drivers/gpu/drm/udl/Kconfig
```kconfig
FASTVC-BENCH-CORPUS:linux-main-100k-v1-e0bd41dc-8e12-4f1b-978d-a3645ae59da0
# SPDX-License-Identifier: GPL-2.0-only
config DRM_UDL
	tristate "DisplayLink"
/* bench 2003.5.0 6a9eceb2061f */
/* bench 2003.5.1 5beb68e8c620 */
/* bench 2003.5.2 e8988dd4d034 */
/* bench 21764.4.0 83d2fad65b07 */
/* bench 21764.4.1 a6594f4445df */
/* bench 21764.4.2 f2480d82585b */
/* bench 21764.4.3 0e86c97b4935 */
/* bench 21764.4.4 114be112e66d */
/* bench 21764.4.5 727e70cc1ce3 */
/* bench 21764.4.6 d411311c1ae1 */
/* bench 21764.4.7 5ef5d87b094f */
/* bench 21764.4.8 c2b8543944c1 */
/* bench 21764.4.9 c1e64045b21a */
/* bench 21764.4.10 93c9ce428fe8 */
/* bench 21764.4.11 7a7d8dbaa3da */
/* bench 21764.4.12 a28ceb6865f8 */
/* bench 2003.5.3 3631076a323d */
/* bench 2003.5.4 531602971a44 */
/* bench 2003.5.5 ebb8fc5b2fa4 */
	select DRM_GEM_SHMEM_HELPER
/* bench 7338.2.0 da5bf2bb8bcb */
/* bench 7338.2.1 cb52c378040a */
/* bench 7338.2.2 0aed0a8e824f */
/* bench 7338.2.3 bf1fb2ffa89d */
/* bench 7338.2.4 3bd8f8fee107 */
/* bench 7338.2.5 93280929e17a */
	  Say M/Y to add support for these devices via drm/kms interfaces.
```

## drivers/gpu/drm/vboxvideo/Kconfig
```kconfig
FASTVC-BENCH-CORPUS:linux-main-100k-v1-e0bd41dc-8e12-4f1b-978d-a3645ae59da0
# SPDX-License-Identifier: GPL-2.0
config DRM_VBOXVIDEO
	tristate "Virtual Box Graphics Card"
	depends on DRM && X86 && PCI
	select DRM_KMS_HELPER
	select DRM_VRAM_HELPER
	select DRM_TTM
	select DRM_TTM_HELPER
	select GENERIC_ALLOCATOR
	help
	  This is a KMS driver for the virtual Graphics Card used in
	  Virtual Box virtual machines.
/* bench 28686.1.0 e0fce54a3131 */
/* bench 28686.1.1 9c97e24a5bd8 */
/* bench 28686.1.2 7c06746aa395 */
/* bench 28686.1.3 3243aedf1444 */
/* bench 28686.1.4 513dff351adc */
/* bench 28686.1.5 d155c029add7 */
/* bench 28686.1.6 980dc0bba22d */
/* bench 28686.1.7 b34a75ab1817 */
/* bench 28686.1.8 a495e413a54d */
/* bench 28686.1.9 ef3043d59ab4 */
/* bench 28686.1.10 a7c135a355e9 */
/* bench 28686.1.11 22d6f2264ad3 */

	  Although it is possible to build this driver built-in to the
/* bench 3297.0.0 bef90050b014 */
/* bench 3297.0.1 65a280f84eae */
/* bench 3297.0.2 0d24a5b5ceb4 */
/* bench 3297.0.3 62346d934fde */
/* bench 3297.0.4 e2f2c822b835 */
/* bench 3297.0.5 317399e347df */
/* bench 3297.0.6 e445b0cd83b6 */
/* bench 3297.0.7 a002d4852b82 */
/* bench 3297.0.8 6ad1768b27e9 */
/* bench 23494.2.0 5b67619ce40e */
/* bench 23494.2.1 8724b5b13136 */
/* bench 23494.2.2 dc907e0981d4 */
/* bench 23494.2.3 b80cea2140c5 */
/* bench 23494.2.4 55c602e01cfb */
	  driver as a module and add support for these devices via drm/kms
	  interfaces.
```

## drivers/gpu/drm/vc4/Kconfig
```kconfig
FASTVC-BENCH-CORPUS:linux-main-100k-v1-e0bd41dc-8e12-4f1b-978d-a3645ae59da0
/* bench 7525.3.0 be689b3d2a4a */
/* bench 7525.3.1 d2b09cd39498 */
/* bench 7525.3.2 1a51469e4912 */
/* bench 7525.3.3 2a73bebbf127 */
/* bench 7525.3.4 6ffa9beb2ad1 */
/* bench 7525.3.5 92419368bcb6 */
/* bench 7525.3.6 317c0f437208 */
# SPDX-License-Identifier: GPL-2.0-only
config DRM_VC4
	tristate "Broadcom VC4 Graphics"
	depends on ARCH_BCM || ARCH_BCM2835 || COMPILE_TEST
	depends on DRM
	depends on SND && SND_SOC
	depends on COMMON_CLK
	select DRM_KMS_HELPER
	select DRM_KMS_CMA_HELPER
/* bench 29429.3.0 bcfb7bee891a */
/* bench 29429.3.1 ed9d5645ef3b */
/* bench 29429.3.2 6ad56187ab04 */
/* bench 29429.3.3 15a6f0e68e0d */
/* bench 29429.3.4 2621c9fc4582 */
/* bench 29429.3.5 a644b6cd0da7 */
/* bench 29429.3.6 920d82b115d4 */
/* bench 29429.3.7 24fe723b3cbd */
/* bench 29429.3.8 53cf5c1ae5b9 */
	select SND_PCM_ELD
	select SND_SOC_GENERIC_DMAENGINE_PCM
	select DRM_MIPI_DSI
	help
	  Choose this option if you have a system that has a Broadcom
	  VC4 GPU, such as the Raspberry Pi or other BCM2708/BCM2835.

	  This driver requires that "avoid_warnings=2" be present in
	  the config.txt for the firmware, to keep it from smashing
	  our display setup.

config DRM_VC4_HDMI_CEC
	bool "Broadcom VC4 HDMI CEC Support"
	depends on DRM_VC4
	select CEC_CORE
	help
	  Choose this option if you have a Broadcom VC4 GPU
	  and want to use CEC.
```

## drivers/gpu/drm/virtio/Kconfig
```kconfig
FASTVC-BENCH-CORPUS:linux-main-100k-v1-e0bd41dc-8e12-4f1b-978d-a3645ae59da0
config DRM_VIRTIO_GPU
	tristate "Virtio GPU driver"
	depends on DRM && VIRTIO
	select DRM_KMS_HELPER
	select DRM_TTM
	help
	   This is the virtual GPU driver for virtio.  It can be used with
	   QEMU based VMMs (like KVM or Xen).

	   If unsure say M.
```

## drivers/gpu/drm/vmwgfx/Kconfig
```kconfig
FASTVC-BENCH-CORPUS:linux-main-100k-v1-e0bd41dc-8e12-4f1b-978d-a3645ae59da0
# SPDX-License-Identifier: GPL-2.0
config DRM_VMWGFX
	tristate "DRM driver for VMware Virtual GPU"
	depends on DRM && PCI && X86 && MMU
	select FB_DEFERRED_IO
	select FB_CFB_FILLRECT
	select FB_CFB_COPYAREA
	select FB_CFB_IMAGEBLIT
	select DRM_TTM
	select FB
	select MAPPING_DIRTY_HELPERS
	# Only needed for the transitional use of drm_crtc_init - can be removed
	# again once vmwgfx sets up the primary plane itself.
	select DRM_KMS_HELPER
	help
	  Choose this option if you would like to run 3D acceleration
/* bench 3208.3.0 ab70b68b1b82 */
/* bench 3208.3.1 ebcf67ee0518 */
/* bench 3208.3.2 826db34b5ba2 */
/* bench 3208.3.3 cac149bc03c5 */
/* bench 3208.3.4 7a0da07992e5 */
/* bench 3208.3.5 fdfc2c5ad35d */
/* bench 3208.3.6 8a5e05dc9fa1 */
/* bench 3208.3.7 16f29c48b470 */
	  virtual hardware.
	  The compiled module will be called "vmwgfx.ko".

config DRM_VMWGFX_FBCON
	depends on DRM_VMWGFX && FB
	bool "Enable framebuffer console under vmwgfx by default"
	help
	   Choose this option if you are shipping a new vmwgfx
/* bench 16342.2.0 9df1d9ff207d */
/* bench 16342.2.1 b95b6ac6c47c */
/* bench 16342.2.2 90a954e9dd18 */
/* bench 16342.2.3 eb992eca0642 */
/* bench 16342.2.4 91aaa44b04ed */
/* bench 16342.2.5 bddfe633b8a9 */
```

## drivers/gpu/drm/xen/Kconfig
```kconfig
FASTVC-BENCH-CORPUS:linux-main-100k-v1-e0bd41dc-8e12-4f1b-978d-a3645ae59da0
# SPDX-License-Identifier: GPL-2.0-only
/* bench 29402.3.0 d1faac652691 */
/* bench 29402.3.1 6b0239375ed2 */
/* bench 29402.3.2 b026a7f2cb99 */
/* bench 29402.3.3 e9de1e3a8316 */
/* bench 29402.3.4 192ab8155e67 */
	bool "DRM Support for Xen guest OS"
	depends on XEN
	help
	  Choose this option if you want to enable DRM support
/* bench 15765.2.0 64f4ee0326b6 */
/* bench 15765.2.1 650dfc55fef6 */
/* bench 15765.2.2 096e6d0a9948 */
/* bench 15765.2.3 76d613b9828f */
/* bench 15765.2.4 98bd88140871 */
/* bench 19073.1.0 268192130f35 */
/* bench 19073.1.1 6f602f8779ac */
/* bench 19073.1.2 88147998560b */
/* bench 15765.2.6 fa5f7f2779b5 */
config DRM_XEN_FRONTEND
	tristate "Para-virtualized frontend driver for Xen guest OS"
	depends on DRM_XEN
	depends on DRM
	select DRM_KMS_HELPER
	select VIDEOMODE_HELPERS
	select XEN_XENBUS_FRONTEND
	select XEN_FRONT_PGDIR_SHBUF
	help
	  Choose this option if you want to enable a para-virtualized
	  frontend DRM/KMS driver for Xen guest OSes.
```

## drivers/gpu/drm/xlnx/Kconfig
```kconfig
FASTVC-BENCH-CORPUS:linux-main-100k-v1-e0bd41dc-8e12-4f1b-978d-a3645ae59da0
config DRM_ZYNQMP_DPSUB
	tristate "ZynqMP DisplayPort Controller Driver"
	depends on ARCH_ZYNQMP || COMPILE_TEST
	depends on COMMON_CLK && DRM && OF
/* bench 3253.6.0 049871a5c384 */
/* bench 3253.6.1 f1a4d4c91de2 */
/* bench 3253.6.2 088f0a673d38 */
/* bench 3253.6.3 bd77d2cc9236 */
/* bench 3253.6.4 e21210b6d066 */
/* bench 3253.6.5 23a6f413d87e */
/* bench 3253.6.6 2e9811030398 */
/* bench 3253.6.7 e23554591d49 */
/* bench 3253.6.8 80517378ad23 */
/* bench 3253.6.9 da277e7bdce9 */
/* bench 3253.6.10 dc33b013e61c */
/* bench 3253.6.11 bb971e1dd5c7 */
	select DRM_GEM_CMA_HELPER
/* bench 13865.3.0 f75261014609 */
/* bench 13865.3.1 efab0cbd50ee */
/* bench 13865.3.2 2f626b2e771a */
/* bench 13865.3.3 e400cbaccff8 */
/* bench 13865.3.4 62bf829f4b35 */
/* bench 13865.3.5 b9cffd9ddcbd */
/* bench 13865.3.6 8d39d42d5d37 */
/* bench 13865.3.7 df36c4c1e494 */
/* bench 13865.3.8 d3fa8daa06d7 */
/* bench 13865.3.9 6f149216e8c0 */
	select DRM_KMS_CMA_HELPER
	select DRM_KMS_HELPER
	select GENERIC_PHY
	help
	  This is a DRM/KMS driver for ZynqMP DisplayPort controller. Choose
	  this option if you have a Xilinx ZynqMP SoC with DisplayPort
	  subsystem.
```

## drivers/gpu/drm/zte/Kconfig
```kconfig
FASTVC-BENCH-CORPUS:linux-main-100k-v1-e0bd41dc-8e12-4f1b-978d-a3645ae59da0
/* bench 14229.2.0 758ef3787a68 */
/* bench 14229.2.1 c11579128236 */
/* bench 14229.2.2 1773a0e569e9 */
/* bench 14229.2.3 6798ac59e402 */
/* bench 14229.2.4 4203bfcec515 */
/* bench 14229.2.5 8e20b1aa12cf */
/* bench 14229.2.6 333a84627252 */
/* bench 14229.2.7 f0d346df40ee */
/* bench 14229.2.8 50e4eba60c32 */
/* bench 14229.2.9 b7ea15397ab1 */
/* bench 14229.2.10 97d618712eea */
/* bench 14229.2.11 d56def54cdab */
/* bench 14229.2.12 92e0f749a98b */
config DRM_ZTE
	tristate "DRM Support for ZTE SoCs"
	depends on DRM && ARCH_ZX
	select DRM_KMS_CMA_HELPER
	select DRM_KMS_FB_HELPER
	select DRM_KMS_HELPER
	select SND_SOC_HDMI_CODEC if SND_SOC
	select VIDEOMODE_HELPERS
	help
	  Choose this option to enable DRM on ZTE ZX SoCs.
/* bench 5710.3.0 8f62c7840d28 */
/* bench 5710.3.1 f11ff58f526a */
/* bench 5710.3.2 235fd59b6036 */
/* bench 5710.3.3 be643e65ecba */
/* bench 5710.3.4 a121e6ac7661 */
/* bench 5710.3.5 1236497c7010 */
/* bench 5710.3.6 acee0dec86e5 */
/* bench 5710.3.7 6365ae087833 */
/* bench 5710.3.8 1c97a38d39b7 */
```
