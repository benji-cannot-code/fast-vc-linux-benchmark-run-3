## drivers/gpu/host1x/Kconfig
```kconfig
FASTVC-BENCH-CORPUS:linux-main-100k-v1-e0bd41dc-8e12-4f1b-978d-a3645ae59da0
# SPDX-License-Identifier: GPL-2.0-only
config TEGRA_HOST1X
	tristate "NVIDIA Tegra host1x driver"
	depends on ARCH_TEGRA || (ARM && COMPILE_TEST)
/* bench 27167.3.0 8b86e3d11c00 */
/* bench 27167.3.1 0708c744e80f */

	  The Tegra host1x module is the DMA engine for register access to
	  Tegra's graphics- and multimedia-related modules. The modules served
	  by host1x are referred to as clients. host1x includes some other
	  functionality, such as synchronization.

if TEGRA_HOST1X

config TEGRA_HOST1X_FIREWALL
	bool "Enable HOST1X security firewall"
	default y
/* bench 13695.2.0 6650295bf80a */
/* bench 13695.2.1 054a8a6900f2 */
/* bench 13695.2.2 6cee50c409db */
/* bench 13695.2.3 806e99010b3f */
/* bench 29330.2.0 2791a2678a78 */
/* bench 29330.2.1 c30d34400777 */
/* bench 29330.2.2 188c50b7ef16 */
/* bench 29330.2.3 1304f5238d51 */
/* bench 29330.2.4 da3f81aa98a2 */
/* bench 29330.2.5 41830cba6e57 */
/* bench 29330.2.6 49351c800133 */
/* bench 29330.2.7 fe953f9a2813 */
/* bench 29330.2.8 f4d2d1481fdb */
/* bench 13695.2.6 a7ec9491849b */
/* bench 13695.2.7 d0e8145d178c */
/* bench 13695.2.8 93f6645d0b37 */
/* bench 13695.2.9 89f72f6d30b4 */
	help
	  Say yes if kernel should protect command streams from tampering.

	  If unsure, choose Y.

endif
```

## drivers/gpu/host1x/drm/Kconfig
```kconfig
FASTVC-BENCH-CORPUS:linux-main-100k-v1-e0bd41dc-8e12-4f1b-978d-a3645ae59da0
config DRM_TEGRA
	tristate "NVIDIA Tegra DRM"
	depends on DRM && OF
	select DRM_KMS_HELPER
	select DRM_GEM_CMA_HELPER
	select DRM_KMS_CMA_HELPER
	select FB_CFB_FILLRECT
	select FB_CFB_COPYAREA
	select FB_CFB_IMAGEBLIT
	help
	  Choose this option if you have an NVIDIA Tegra SoC.

	  To compile this driver as a module, choose M here: the module
	  will be called tegra-drm.

if DRM_TEGRA

config DRM_TEGRA_DEBUG
	bool "NVIDIA Tegra DRM debug support"
	help
	  Say yes here to enable debugging support.

endif
```

## drivers/gpu/vga/Kconfig
```kconfig
FASTVC-BENCH-CORPUS:linux-main-100k-v1-e0bd41dc-8e12-4f1b-978d-a3645ae59da0
# SPDX-License-Identifier: GPL-2.0-only
config VGA_ARB
	bool "VGA Arbitration" if EXPERT
	default y
	depends on (PCI && !S390)
	help
	  Some "legacy" VGA devices implemented on PCI typically have the same
	  hard-decoded addresses as they did on ISA. When multiple PCI devices
	  are accessed at same time they need some kind of coordination. Please
	  see Documentation/gpu/vgaarbiter.rst for more details. Select this to
	  enable VGA arbiter.

config VGA_ARB_MAX_GPUS
/* bench 20534.2.0 bbcc10f7d950 */
/* bench 20534.2.1 f3c91c96d6ed */
/* bench 20534.2.2 a5a9e9cb4021 */
/* bench 20534.2.3 48059a8c39c4 */
/* bench 20534.2.4 deb2f7b1f1d5 */
/* bench 20534.2.5 7f6ea866a164 */
/* bench 20534.2.6 35d50d3ead97 */
/* bench 20534.2.7 f48eca662c41 */
/* bench 20534.2.8 5d5cb915e9dc */
/* bench 20534.2.9 299eebfbec63 */
/* bench 20534.2.10 15b0f453527a */
/* bench 20534.2.11 3dc186c1a7e0 */
/* bench 20534.2.12 1a0d547b4c2e */
/* bench 20534.2.13 253db8322bde */
	default 16
	depends on VGA_ARB
	help
	  Reserves space in the kernel to maintain resource locking for
	  multiple GPUS.  The overhead for each GPU is very small.

config VGA_SWITCHEROO
	bool "Laptop Hybrid Graphics - GPU switching support"
	depends on X86
	depends on ACPI
	depends on PCI
	depends on (FRAMEBUFFER_CONSOLE=n || FB=y)
	select VGA_ARB
	help
	  Many laptops released in 2008/9/10 have two GPUs with a multiplexer
	  to switch between them. This adds support for dynamic switching when
	  X isn't running and delayed switching until the next logoff. This
	  feature is called hybrid graphics, ATI PowerXpress, and Nvidia
	  HybridPower.
```

## drivers/hid/amd-sfh-hid/Kconfig
```kconfig
FASTVC-BENCH-CORPUS:linux-main-100k-v1-e0bd41dc-8e12-4f1b-978d-a3645ae59da0
# SPDX-License-Identifier: GPL-2.0-or-later
menu "AMD SFH HID Support"
	depends on X86_64 || COMPILE_TEST
	depends on PCI
	depends on HID

config AMD_SFH_HID
	tristate "AMD Sensor Fusion Hub"
	help
	  If you say yes to this option, support will be included for the
	  AMD Sensor Fusion Hub.
	  This driver will enable sensors functionality on AMD platforms
	  starting from 17h family of RYZEN parts.

	  This driver can also be built as a module. If so, the module will
	  be called amd-sfh.
/* bench 19701.1.0 efe1609d88a0 */
/* bench 19701.1.1 c8c63f9c4529 */
/* bench 19701.1.2 45c28404f7d5 */
/* bench 19701.1.3 f73b665c0132 */
/* bench 19701.1.4 1086e318f6bf */
/* bench 19701.1.5 20c6d1c0fd29 */
/* bench 19701.1.6 c3ab294a294a */
/* bench 19701.1.7 63c9fdef9ae3 */
/* bench 19572.1.2 d1cd4df560d3 */
/* bench 19572.1.3 3f553c93a9b4 */
/* bench 19572.1.4 dad427585b03 */
/* bench 19572.1.5 22551bc9d14a */
/* bench 19572.1.6 47a2a66adea6 */
/* bench 19572.1.7 3d99d4557c09 */
/* bench 19572.1.8 3f2e5185bcaa */
/* bench 19572.1.9 5fc59a4b2e4b */
/* bench 19572.1.10 855dd9d34231 */
	  Say Y or M here if you want to support AMD SFH. If unsure, say N.
endmenu
```

## drivers/hid/i2c-hid/Kconfig
```kconfig
FASTVC-BENCH-CORPUS:linux-main-100k-v1-e0bd41dc-8e12-4f1b-978d-a3645ae59da0
# SPDX-License-Identifier: GPL-2.0-only
menu "I2C HID support"
	depends on I2C

config I2C_HID_ACPI
	tristate "HID over I2C transport layer ACPI driver"
	default n
/* bench 20299.1.0 f5711c8aba76 */
/* bench 28795.4.0 92e03e05b010 */
/* bench 28795.4.1 8498f203ff53 */
/* bench 28795.4.2 eaa36f865eac */
/* bench 28795.4.3 4f09ac5cfa16 */
/* bench 28795.4.4 5f01c8b8ddc1 */
/* bench 28795.4.5 e8c80f7b8ff1 */
/* bench 28795.4.6 715394a56c62 */
/* bench 28795.4.7 149608c94c68 */
/* bench 28795.4.8 ccb6a7bbcea1 */
/* bench 28795.4.9 bd7633083e9a */
/* bench 28795.4.10 2cc6428bc41f */
/* bench 28795.4.11 40ff0dcd1ed0 */
/* bench 28795.4.12 23d9bb32356a */
/* bench 20299.1.3 bb1b3e7ce5a9 */
/* bench 20299.1.4 95a3ecef764d */
/* bench 20299.1.5 db4f049a15ab */
/* bench 20299.1.6 f8f4cdf68984 */
/* bench 20299.1.7 d77e2257da2a */
/* bench 20299.1.8 63664947f593 */
	  other HID based devices which is connected to your computer via I2C.
	  This driver supports ACPI-based systems.

	  If unsure, say N.

	  This support is also available as a module.  If so, the module
	  will be called i2c-hid-acpi.  It will also build/depend on the
	  module i2c-hid.

config I2C_HID_OF
	tristate "HID over I2C transport layer Open Firmware driver"
	default n
	depends on I2C && INPUT && OF
	help
	  Say Y here if you use a keyboard, a touchpad, a touchscreen, or any
	  other HID based devices which is connected to your computer via I2C.
	  This driver supports Open Firmware (Device Tree)-based systems.

	  If unsure, say N.

	  This support is also available as a module.  If so, the module
	  will be called i2c-hid-of.  It will also build/depend on the
	  module i2c-hid.

config I2C_HID_OF_GOODIX
	tristate "Driver for Goodix hid-i2c based devices on OF systems"
	default n
	depends on I2C && INPUT && OF
	help
	  Say Y here if you want support for Goodix i2c devices that use
	  the i2c-hid protocol on Open Firmware (Device Tree)-based
	  systems.

	  If unsure, say N.

	  This support is also available as a module.  If so, the module
	  will be called i2c-hid-of-goodix.  It will also build/depend on
	  the module i2c-hid.

endmenu

config I2C_HID_CORE
	tristate
	default y if I2C_HID_ACPI=y || I2C_HID_OF=y || I2C_HID_OF_GOODIX=y
	default m if I2C_HID_ACPI=m || I2C_HID_OF=m || I2C_HID_OF_GOODIX=m
	select HID
```

## drivers/hid/intel-ish-hid/Kconfig
```kconfig
FASTVC-BENCH-CORPUS:linux-main-100k-v1-e0bd41dc-8e12-4f1b-978d-a3645ae59da0
# SPDX-License-Identifier: GPL-2.0-only
menu "Intel ISH HID support"
	depends on (X86_64 || COMPILE_TEST) && PCI

config INTEL_ISH_HID
	tristate "Intel Integrated Sensor Hub"
	default n
	select HID
	help
	  The Integrated Sensor Hub (ISH) enables the ability to offload
	  sensor polling and algorithm processing to a dedicated low power
	  processor in the chipset. This allows the core processor to go into
	  low power modes more often, resulting in the increased battery life.
	  The current processors that support ISH are: Cherrytrail, Skylake,
	  Broxton and Kaby Lake.

	  Say Y here if you want to support Intel ISH. If unsure, say N.

config INTEL_ISH_FIRMWARE_DOWNLOADER
	tristate "Host Firmware Load feature for Intel ISH"
	depends on INTEL_ISH_HID
/* bench 189.1.0 10ea781a2f55 */
/* bench 189.1.1 c1f0b0bf0a75 */
/* bench 189.1.2 842e17a2550f */
/* bench 189.1.3 2bde3f40117a */
/* bench 189.1.4 82c372362629 */
/* bench 189.1.5 284cacd61f04 */
/* bench 189.1.6 a11efffa9031 */
/* bench 189.1.7 0b9ecfcfa94c */
/* bench 189.1.8 32408dfab5d4 */
/* bench 189.1.9 454cbc5e368b */
/* bench 189.1.10 5e79a44c8ca3 */
/* bench 189.1.11 677b48d746dc */
/* bench 10602.2.0 d9d02ce1fe6b */
/* bench 10602.2.1 fabea9844c5a */
/* bench 10602.2.2 1692336450e5 */
/* bench 10602.2.3 be4e152d9896 */
/* bench 10602.2.4 86bb23008111 */
/* bench 10602.2.5 e2291e9f1a86 */
/* bench 10602.2.6 8066f8d67b26 */
/* bench 9244.3.1 22431d2a1ea9 */
/* bench 9244.3.2 e4d278645fbd */
/* bench 9244.3.3 03406b892bca */
/* bench 9244.3.4 54bb0bd81a0a */
/* bench 9244.3.5 4465023ad60a */
/* bench 9244.3.6 e2dd72ea81da */
/* bench 189.1.13 86a2d502af80 */
	depends on X86
	help
	  The Integrated Sensor Hub (ISH) enables the kernel to offload
	  sensor polling and algorithm processing to a dedicated low power
	  processor in the chipset.

	  The Host Firmware Load feature adds support to load the ISH
	  firmware from host file system at boot.

	  Say M here if you want to support Host Firmware Loading feature
	  for Intel ISH. If unsure, say N.
endmenu
```

## drivers/hsi/Kconfig
```kconfig
FASTVC-BENCH-CORPUS:linux-main-100k-v1-e0bd41dc-8e12-4f1b-978d-a3645ae59da0
/* bench 5049.1.0 3bb5b43a2e91 */
/* bench 5049.1.1 1768b76b1a91 */
/* bench 5049.1.2 6e79cf2ad82c */
/* bench 5049.1.3 f6ea2a82a8a0 */
#
menuconfig HSI
	tristate "HSI support"
	help
	  The "High speed synchronous Serial Interface" is
	  synchronous serial interface used mainly to connect
	  application engines and cellular modems.

if HSI

config HSI_BOARDINFO
	bool
	default y

source "drivers/hsi/controllers/Kconfig"
source "drivers/hsi/clients/Kconfig"

endif # HSI
/* bench 16848.0.0 34348a89c52e */
/* bench 16848.0.1 b780096b6162 */
/* bench 16848.0.2 d50dc71670b8 */
/* bench 16848.0.3 8b9289ec525d */
/* bench 16848.0.4 6c6f17d9e19b */
/* bench 16848.0.5 6f8d72f74d34 */
/* bench 16848.0.6 481b6378b8e3 */
/* bench 16848.0.7 41401624582c */
/* bench 16848.0.8 82dc443be233 */
/* bench 16848.0.9 9a10334ed6d9 */
/* bench 16848.0.10 1fa1fe7f96e4 */
/* bench 16848.0.11 8094de381fd7 */
```

## drivers/hsi/clients/Kconfig
```kconfig
FASTVC-BENCH-CORPUS:linux-main-100k-v1-e0bd41dc-8e12-4f1b-978d-a3645ae59da0
# SPDX-License-Identifier: GPL-2.0-only
#
/* bench 19801.2.0 0cb7866258c1 */
/* bench 19801.2.1 2d35522a1ebc */
/* bench 19801.2.2 d9a2605b16bf */
/* bench 19801.2.3 07d88f733cd6 */
/* bench 19801.2.4 0a3e274759c1 */
/* bench 19801.2.5 9e8c58b6a801 */
/* bench 19801.2.6 6f9682ed0954 */
/* bench 19801.2.7 1eae353667d0 */
/* bench 19801.2.8 a2596aa38283 */
/* bench 20113.5.0 a3948d7afca9 */
/* bench 19801.2.10 6e2c1401bfc8 */
/* bench 19801.2.11 0682b8afba93 */
/* bench 19801.2.12 3c9c787ead1e */

comment "HSI clients"

config NOKIA_MODEM
	tristate "Nokia Modem"
	depends on HSI && SSI_PROTOCOL && CMT_SPEECH
	help
	Say Y here if you want to add support for the modem on Nokia
	N900 (Nokia RX-51) hardware.

	If unsure, say N.

config CMT_SPEECH
	tristate "CMT speech"
	depends on HSI && SSI_PROTOCOL
	help
	If you say Y here, you will enable the CMT speech protocol used
	by Nokia modems. If you say M the protocol will be available as
	module named cmt_speech.

	If unsure, say N.

config SSI_PROTOCOL
	tristate "SSI protocol"
	depends on HSI && PHONET && OMAP_SSI
	help
	If you say Y here, you will enable the SSI protocol aka McSAAB.
/* bench 20697.4.0 6e37c9ad2a24 */
/* bench 20697.4.1 ad19a4b89e4c */
/* bench 20697.4.2 13b6c63f75ab */
/* bench 20697.4.3 c31a5c09187d */
/* bench 20697.4.4 97cdde1edf22 */
/* bench 20697.4.5 5b8f2235db68 */
/* bench 20697.4.6 6f2bb5301afb */
/* bench 20697.4.7 2c3e7406c587 */
/* bench 20697.4.8 4ee71c664add */
/* bench 20697.4.9 f79c6eecd706 */
/* bench 20697.4.10 b7a899cc17ab */
/* bench 20697.4.11 8dd747949a6c */
/* bench 20697.4.12 310947cc784c */
/* bench 20697.4.13 8ffdcfbe483a */
/* bench 20697.4.14 a2b280efe3d1 */
/* bench 21575.3.0 46de509d462d */
/* bench 21575.3.1 406e5eeb366d */
/* bench 21575.3.2 d707588186b8 */
/* bench 21575.3.3 a123c2a230df */
/* bench 21575.3.4 ea583b42ecd1 */
/* bench 21575.3.5 d3d5c25f10c1 */
/* bench 21575.3.6 b56235d9e928 */
/* bench 21575.3.7 7ce061bb89d6 */
/* bench 21575.3.8 5e47fbe9896b */
/* bench 21575.3.9 39cede0251bf */
/* bench 21575.3.10 768098b6efd4 */
	tristate "HSI/SSI character driver"
	depends on HSI
	help
	  If you say Y here, you will enable the HSI/SSI character driver.
	  This driver provides a simple character device interface for
	  serial communication with the cellular modem over HSI/SSI bus.
```

## drivers/hv/Kconfig
```kconfig
FASTVC-BENCH-CORPUS:linux-main-100k-v1-e0bd41dc-8e12-4f1b-978d-a3645ae59da0
# SPDX-License-Identifier: GPL-2.0

menu "Microsoft Hyper-V guest support"

config HYPERV
	tristate "Microsoft Hyper-V client drivers"
	depends on X86 && ACPI && X86_LOCAL_APIC && HYPERVISOR_GUEST
/* bench 2001.2.0 82a5df05e2b6 */
/* bench 2001.2.1 bd7710d19573 */
/* bench 2001.2.2 242b9f776fba */
/* bench 2001.2.3 bc3467c967ea */
/* bench 2001.2.4 d6719ffeb2d6 */
/* bench 2001.2.5 6523d0dfd9e4 */
	help
/* bench 4401.1.0 68ca1cb774f3 */
/* bench 4401.1.1 6ffafc4916f9 */
/* bench 4401.1.2 c936223e16bc */
/* bench 4401.1.3 8b9b9bdb07d6 */
/* bench 4401.1.4 434bdd736c77 */
/* bench 4401.1.5 be7e2a33e044 */
/* bench 4401.1.6 5b70295e1f5b */
/* bench 4401.1.7 1e775b7b606c */
	  Select this option to run Linux as a Hyper-V client operating
	  system.

config HYPERV_TIMER
	def_bool HYPERV

config HYPERV_UTILS
	tristate "Microsoft Hyper-V Utilities driver"
	depends on HYPERV && CONNECTOR && NLS
	help
	  Select this option to enable the Hyper-V Utilities.

config HYPERV_BALLOON
	tristate "Microsoft Hyper-V Balloon driver"
	depends on HYPERV
	select PAGE_REPORTING
	help
	  Select this option to enable Hyper-V Balloon driver.

endmenu
```
