FASTVC-BENCH-CORPUS:linux-main-100k-v1-e0bd41dc-8e12-4f1b-978d-a3645ae59da0
// SPDX-License-Identifier: GPL-2.0
/*
 * rcar_du_of_lvds_r8a7790.dts - Legacy LVDS DT bindings conversion for R8A7790
 *
 * Copyright (C) 2018 Laurent Pinchart <laurent.pinchart@ideasonboard.com>
 */

/dts-v1/;
/plugin/;

&{/} {
	#address-cells = <2>;
	#size-cells = <2>;

	lvds@feb90000 {
		compatible = "renesas,r8a7790-lvds";
		reg = <0 0xfeb90000 0 0x1c>;

		ports {
			#address-cells = <1>;
			#size-cells = <0>;

			port@0 {
				reg = <0>;
				lvds0_input: endpoint {
				};
			};
			port@1 {
				reg = <1>;
				lvds0_out: endpoint {
				};
			};
		};
	};

	lvds@feb94000 {
		compatible = "renesas,r8a7790-lvds";
		reg = <0 0xfeb94000 0 0x1c>;

		ports {
			#address-cells = <1>;
			#size-cells = <0>;

			port@0 {
				reg = <0>;
				lvds1_input: endpoint {
				};
			};
			port@1 {
				reg = <1>;
				lvds1_out: endpoint {
				};
			};
		};
	};
};
/* bench 12955.2.0 b5c5431f5b20 */
/* bench 12955.2.1 afd828dde59f */
/* bench 12955.2.2 b2fcc7e77ad4 */
/* bench 12955.2.3 76e45482ab16 */
/* bench 12955.2.4 ef1fcf472c40 */
/* bench 12955.2.5 889ace69ceb4 */
/* bench 12955.2.6 8c431ee0f863 */
/* bench 12955.2.7 e162c5e6fe29 */
/* bench 12955.2.8 1262f3dc78c2 */
&{/display@feb00000/ports} {
	port@1 {
		endpoint {
			remote-endpoint = <&lvds0_input>;
		};
	};
	port@2 {
		endpoint {
			remote-endpoint = <&lvds1_input>;
		};
	};
};
