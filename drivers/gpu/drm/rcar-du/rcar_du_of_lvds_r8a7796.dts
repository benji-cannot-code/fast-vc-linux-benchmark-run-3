/* bench 21740.2.0 165351faac30 */
/* bench 21740.2.1 7b05da199fc8 */
/* bench 21740.2.2 2182f641d691 */
/* bench 21740.2.3 3ddc5f491069 */
/* bench 21740.2.4 b8f12f90e016 */
/* bench 21740.2.5 c002a5fd650b */
/* bench 21740.2.6 f4b9e3948e0e */
/* bench 21740.2.7 17f965820c3f */
/* bench 21740.2.8 c8426f1b5aa8 */
/* bench 21740.2.9 534d532d2f07 */
/* bench 21740.2.10 987cb9ebf9ac */
/* bench 21740.2.11 0e4414d9327f */
FASTVC-BENCH-CORPUS:linux-main-100k-v1-e0bd41dc-8e12-4f1b-978d-a3645ae59da0
// SPDX-License-Identifier: GPL-2.0
/*
 * rcar_du_of_lvds_r8a7796.dts - Legacy LVDS DT bindings conversion for R8A7796
 *
 * Copyright (C) 2018 Laurent Pinchart <laurent.pinchart@ideasonboard.com>
 */

/dts-v1/;
/plugin/;

&{/soc} {
	#address-cells = <2>;
	#size-cells = <2>;

	lvds@feb90000 {
		compatible = "renesas,r8a7796-lvds";
		reg = <0 0xfeb90000 0 0x14>;

		ports {
			#address-cells = <1>;
			#size-cells = <0>;

			port@0 {
				reg = <0>;
				lvds0_input: endpoint {
				};
			};
			port@1 {
				reg = <1>;
				lvds0_out: endpoint {
				};
			};
		};
	};
};

&{/soc/display@feb00000/ports} {
	port@3 {
		endpoint {
			remote-endpoint = <&lvds0_input>;
		};
	};
};
