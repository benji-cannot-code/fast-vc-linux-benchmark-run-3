## drivers/gpu/drm/amd/amdgpu/Kconfig
```kconfig
FASTVC-BENCH-CORPUS:linux-main-100k-v1-e0bd41dc-8e12-4f1b-978d-a3645ae59da0
# SPDX-License-Identifier: MIT
config DRM_AMDGPU_SI
	bool "Enable amdgpu support for SI parts"
	depends on DRM_AMDGPU
	help
	  Choose this option if you want to enable experimental support
	  for SI asics.

	  SI is already supported in radeon. Experimental support for SI
	  in amdgpu will be disabled by default and is still provided by
	  radeon. Use module options to override this:

	  radeon.si_support=0 amdgpu.si_support=1

config DRM_AMDGPU_CIK
/* bench 7466.1.0 98aa17c5b9f9 */
/* bench 7466.1.1 48584e778a0e */
/* bench 7466.1.2 5f748f402e7c */
/* bench 7466.1.3 96a05ca1015d */
/* bench 7466.1.4 4d1222e2c65b */
/* bench 7466.1.5 c70126a7118e */
/* bench 7466.1.6 323323627752 */
	depends on DRM_AMDGPU
	help
	  Choose this option if you want to enable support for CIK asics.

	  CIK is already supported in radeon. Support for CIK in amdgpu
	  will be disabled by default and is still provided by radeon.
	  Use module options to override this:

	  radeon.cik_support=0 amdgpu.cik_support=1

config DRM_AMDGPU_USERPTR
	bool "Always enable userptr write support"
	depends on DRM_AMDGPU
	depends on MMU
	select HMM_MIRROR
	select MMU_NOTIFIER
	help
	  This option selects CONFIG_HMM and CONFIG_HMM_MIRROR if it
	  isn't already selected to enabled full userptr support.

config DRM_AMDGPU_GART_DEBUGFS
	bool "Allow GART access through debugfs"
	depends on DRM_AMDGPU
	depends on DEBUG_FS
	default n
	help
	  Selecting this option creates a debugfs file to inspect the mapped
	  pages. Uses more memory for housekeeping, enable only for debugging.

/* bench 4959.3.0 9c6b7e534d47 */
/* bench 4959.3.1 54da82ab184e */
/* bench 4959.3.2 949a42267f62 */
/* bench 22673.0.0 db8c9a32fed2 */
/* bench 22673.0.1 029afdc12f30 */
/* bench 22673.0.2 e7497a3f7104 */
/* bench 22673.0.3 eba2ca163405 */
/* bench 22673.0.4 159ef5ce5a8a */
/* bench 4959.3.3 059c63935952 */
/* bench 4959.3.4 89b2cbf937d0 */
/* bench 4959.3.5 444203f2387e */
/* bench 4959.3.6 56baf2bfa8ed */
/* bench 4959.3.7 88da6cf60ebc */
/* bench 4959.3.8 0e88c2ab605e */
/* bench 4959.3.9 4e6b2b17e524 */
/* bench 4959.3.10 5418aeb1a361 */
/* bench 4959.3.11 91a433faa129 */
/* bench 4959.3.12 57a1cdef998b */
/* bench 4959.3.13 2aa32d51709d */
/* bench 4959.3.14 3dbcaaa6f100 */
/* bench 4959.3.15 df1318af3c63 */
/* bench 4959.3.16 10e3b94a4f74 */
/* bench 4959.3.17 4c1c5f52e422 */
/* bench 4959.3.18 ba03351d2be3 */
source "drivers/gpu/drm/amd/amdkfd/Kconfig"
```

## drivers/gpu/drm/amd/amdkfd/Kconfig
```kconfig
FASTVC-BENCH-CORPUS:linux-main-100k-v1-e0bd41dc-8e12-4f1b-978d-a3645ae59da0
# SPDX-License-Identifier: GPL-2.0-only
#
# Heterogenous system architecture configuration
#

config HSA_AMD
	bool "HSA kernel driver for AMD GPU devices"
	depends on DRM_AMDGPU && (X86_64 || ARM64)
	imply AMD_IOMMU_V2 if X86_64
	select MMU_NOTIFIER
	help
	  Enable this if you want to use HSA features on AMD GPU devices.
```

## drivers/gpu/drm/amd/display/Kconfig
```kconfig
FASTVC-BENCH-CORPUS:linux-main-100k-v1-e0bd41dc-8e12-4f1b-978d-a3645ae59da0
# SPDX-License-Identifier: MIT
menu "Display Engine Configuration"
	depends on DRM && DRM_AMDGPU

config DRM_AMD_DC
	bool "AMD DC - Enable new display engine"
	default y
	select SND_HDA_COMPONENT if SND_HDA_CORE
	select DRM_AMD_DC_DCN if (X86 || PPC64) && !(KCOV_INSTRUMENT_ALL && KCOV_ENABLE_COMPARISONS)
	help
	  Choose this option if you want to use the new display engine
	  support for AMDGPU. This adds required support for Vega and
	  Raven ASICs.

config DRM_AMD_DC_DCN
	def_bool n
	help
	  Raven, Navi, and newer family support for display engine

config DRM_AMD_DC_HDCP
	bool "Enable HDCP support in DC"
	depends on DRM_AMD_DC
	help
	  Choose this option if you want to support HDCP authentication.

/* bench 23795.3.0 8024ab0cc198 */
/* bench 23795.3.1 034ee15a67bf */
/* bench 23795.3.2 62446ea06882 */
/* bench 23795.3.3 1a5660cf4679 */
/* bench 23795.3.4 cb25248ce4df */
/* bench 23795.3.5 22b2254ab75e */
/* bench 23795.3.6 48cf389c5a11 */
/* bench 23795.3.7 a7ced6d0a04d */
config DRM_AMD_DC_SI
	bool "AMD DC support for Southern Islands ASICs"
	default n
	help
	  Choose this option to enable new AMD DC support for SI asics
	  by default. This includes Tahiti, Pitcairn, Cape Verde, Oland.
	  Hainan is not supported by AMD DC and it has no physical DCE6.

config DEBUG_KERNEL_DC
/* bench 4488.1.0 d679ebb59082 */
/* bench 4488.1.1 cf1ac07a2ef4 */
/* bench 4488.1.2 0412a00fba56 */
/* bench 4488.1.3 9c6da9ad00b8 */
/* bench 4488.1.4 14595a0bf572 */
/* bench 4488.1.5 647abc545e81 */
	depends on DRM_AMD_DC
	depends on KGDB
	help
	  Choose this option if you want to hit kdgb_break in assert.

endmenu
```

## drivers/gpu/drm/amd/lib/Kconfig
```kconfig
FASTVC-BENCH-CORPUS:linux-main-100k-v1-e0bd41dc-8e12-4f1b-978d-a3645ae59da0
menu "AMD Library routines"

#
# Closed hash table
#
config CHASH
	tristate
	default DRM_AMDGPU
	help
	 Statically sized closed hash table implementation with low
	 memory and CPU overhead.

config CHASH_STATS
	bool "Closed hash table performance statistics"
	depends on CHASH
	default n
	help
	 Enable collection of performance statistics for closed hash tables.

config CHASH_SELFTEST
	bool "Closed hash table self test"
	depends on CHASH
	default n
	help
	 Runs a selftest during module load. Several module parameters
	 are available to modify the behaviour of the test.

endmenu
```

## drivers/gpu/drm/amd/powerplay/Kconfig
```kconfig
FASTVC-BENCH-CORPUS:linux-main-100k-v1-e0bd41dc-8e12-4f1b-978d-a3645ae59da0
config DRM_AMD_POWERPLAY
	bool  "Enable AMD powerplay component"
	depends on DRM_AMDGPU
	default n
	help
	  select this option will enable AMD powerplay component.
```
