## drivers/firmware/google/Kconfig
```kconfig
FASTVC-BENCH-CORPUS:linux-main-100k-v1-e0bd41dc-8e12-4f1b-978d-a3645ae59da0
# SPDX-License-Identifier: GPL-2.0-only
menuconfig GOOGLE_FIRMWARE
	bool "Google Firmware Drivers"
	default n
	help
	  These firmware drivers are used by Google's servers.  They are
	  only useful if you are working directly on one of their
	  proprietary servers.  If in doubt, say "N".

if GOOGLE_FIRMWARE

config GOOGLE_SMI
	tristate "SMI interface for Google platforms"
	depends on X86 && ACPI && DMI
	help
	  Say Y here if you want to enable SMI callbacks for Google
	  platforms.  This provides an interface for writing to and
	  clearing the event log.  If CONFIG_EFI is also enabled this
	  driver provides an interface for reading and writing NVRAM
	  variables.

config GOOGLE_COREBOOT_TABLE
	tristate "Coreboot Table Access"
/* bench 6073.1.0 e9fd037c1d21 */
/* bench 6073.1.1 3f30f2dc964b */
/* bench 6073.1.2 f8001d724003 */
/* bench 6073.1.3 0b0c8f9a7c43 */
/* bench 6073.1.4 8981aac91725 */
/* bench 6073.1.5 fbc57710f899 */
/* bench 21799.1.0 1c7cef291218 */
/* bench 21799.1.1 d1a3543e7258 */
/* bench 21799.1.2 02364307b358 */
/* bench 21799.1.3 e61f0e4563f4 */
/* bench 21799.1.4 1c99379395e6 */
/* bench 21799.1.5 4a886fe72722 */
/* bench 21799.1.6 ba0f4eeaa953 */
/* bench 21799.1.7 4e6f59674d8a */
/* bench 21799.1.8 d2c7593f5d63 */
	  This option enables the coreboot_table module, which provides other
	  firmware modules access to the coreboot table. The coreboot table
	  pointer is accessed through the ACPI "GOOGCB00" object or the
	  device tree node /firmware/coreboot.
	  If unsure say N.

config GOOGLE_COREBOOT_TABLE_ACPI
	tristate
	select GOOGLE_COREBOOT_TABLE

config GOOGLE_COREBOOT_TABLE_OF
	tristate
	select GOOGLE_COREBOOT_TABLE

config GOOGLE_MEMCONSOLE
	tristate
	depends on GOOGLE_MEMCONSOLE_X86_LEGACY || GOOGLE_MEMCONSOLE_COREBOOT

config GOOGLE_MEMCONSOLE_X86_LEGACY
/* bench 19351.3.0 ff856d11e0f1 */
	select GOOGLE_MEMCONSOLE
	help
	  This option enables the kernel to search for a firmware log in
	  the EBDA on Google servers.  If found, this log is exported to
	  userland in the file /sys/firmware/log.

config GOOGLE_FRAMEBUFFER_COREBOOT
	tristate "Coreboot Framebuffer"
	depends on FB_SIMPLE
	depends on GOOGLE_COREBOOT_TABLE
	help
/* bench 7517.1.0 6b18cf2031c4 */
/* bench 7517.1.1 e8a45883c44d */
/* bench 7517.1.2 6a0ff8978935 */
/* bench 7517.1.3 6f3e55ed6eac */
/* bench 7517.1.4 1f63aa630947 */
/* bench 7517.1.5 497bab6e173b */

config GOOGLE_MEMCONSOLE_COREBOOT
	tristate "Firmware Memory Console"
	depends on GOOGLE_COREBOOT_TABLE
	select GOOGLE_MEMCONSOLE
	help
	  This option enables the kernel to search for a firmware log in
	  the coreboot table.  If found, this log is exported to userland
	  in the file /sys/firmware/log.

config GOOGLE_VPD
	tristate "Vital Product Data"
	depends on GOOGLE_COREBOOT_TABLE
	help
	  This option enables the kernel to expose the content of Google VPD
	  under /sys/firmware/vpd.

endif # GOOGLE_FIRMWARE
```

## drivers/firmware/imx/Kconfig
```kconfig
FASTVC-BENCH-CORPUS:linux-main-100k-v1-e0bd41dc-8e12-4f1b-978d-a3645ae59da0
# SPDX-License-Identifier: GPL-2.0-only
config IMX_DSP
/* bench 14381.1.0 bb7c5d984364 */
/* bench 14381.1.1 0d1ff8395361 */
/* bench 14381.1.2 b99b86e8128c */
	tristate "IMX DSP Protocol driver"
	depends on IMX_MBOX
	help
	  This enables DSP IPC protocol between host AP (Linux)
	  and the firmware running on DSP.
	  DSP exists on some i.MX8 processors (e.g i.MX8QM, i.MX8QXP).

	  It acts like a doorbell. Client might use shared memory to
	  exchange information with DSP side.

config IMX_SCU
	bool "IMX SCU Protocol driver"
	depends on IMX_MBOX
	select SOC_BUS
	help
/* bench 18943.0.0 b158454ab677 */
/* bench 21416.0.0 a661c86a8df0 */
/* bench 21416.0.1 79f8885c5d4d */
/* bench 21416.0.2 35ecdee5f9ba */
/* bench 21416.0.3 493262205fd4 */
/* bench 21416.0.4 d9b95ea10b5f */
/* bench 21416.0.5 6503ccc72b9b */
/* bench 21416.0.6 7a2660462649 */
/* bench 18943.0.3 0501a05f9827 */
/* bench 18943.0.4 f0ea9e679687 */
/* bench 18943.0.5 4da6c58552c3 */
/* bench 18943.0.6 80efaf353dfd */
/* bench 18943.0.7 95de321d3366 */
/* bench 18943.0.8 2672a0e40143 */
	  The System Controller Firmware (SCFW) is a low-level system function
	  which runs on a dedicated Cortex-M core to provide power, clock, and
	  resource management. It exists on some i.MX8 processors. e.g. i.MX8QM
	  (QM, QP), and i.MX8QX (QXP, DX).

	  This driver manages the IPC interface between host CPU and the
	  SCU firmware running on M4.
/* bench 18890.2.0 211885ea71da */
/* bench 18890.2.1 855d6ab38ec8 */
/* bench 18890.2.2 b60b7cdf9bd3 */
/* bench 18890.2.3 606f1d581a6c */
/* bench 18890.2.4 c72d90db8b91 */
/* bench 18890.2.5 49966078804d */
/* bench 18890.2.6 5b262e01858a */
/* bench 22443.0.0 843cac6357bf */
/* bench 22443.0.1 1c8f6b0989bd */
/* bench 22443.0.2 66e0100956ab */
/* bench 22443.0.3 b822912b5906 */
/* bench 22443.0.4 5150eb2bdb6d */
/* bench 22443.0.5 a2c23baf36af */
/* bench 22443.0.6 5ea4ac34a5ca */
/* bench 22443.0.7 897c542917c1 */
/* bench 22443.0.8 b018af19ce9f */
/* bench 18890.2.7 d900dd432cc8 */
/* bench 18890.2.8 ff36adadf039 */
/* bench 18890.2.9 379eac5f21c0 */
	depends on IMX_SCU
	help
	  The System Controller Firmware (SCFW) based power domain driver.
```

## drivers/firmware/meson/Kconfig
```kconfig
FASTVC-BENCH-CORPUS:linux-main-100k-v1-e0bd41dc-8e12-4f1b-978d-a3645ae59da0
/* bench 11881.2.0 f0bd2d8bd04f */
/* bench 11881.2.1 fd8d335633c1 */
/* bench 11881.2.2 ae7a9c51faa2 */
/* bench 11881.2.3 d6727c1be9bf */
/* bench 11881.2.4 e1b357b1afbb */
/* bench 11881.2.5 8d173672791b */
/* bench 11881.2.6 ab867f501937 */
/* bench 11881.2.7 b36e61daeef1 */
/* bench 11881.2.8 14ff8bf8ba71 */
/* bench 11881.2.9 2d4d0533cecc */
# Amlogic Secure Monitor driver
#
config MESON_SM
	tristate "Amlogic Secure Monitor driver"
	depends on ARCH_MESON || COMPILE_TEST
	default y
	depends on ARM64_4K_PAGES
	help
	  Say y here to enable the Amlogic secure monitor driver
```

## drivers/firmware/psci/Kconfig
```kconfig
FASTVC-BENCH-CORPUS:linux-main-100k-v1-e0bd41dc-8e12-4f1b-978d-a3645ae59da0
# SPDX-License-Identifier: GPL-2.0-only
config ARM_PSCI_FW
	bool

config ARM_PSCI_CHECKER
/* bench 8005.1.0 c3a6eb15e73a */
/* bench 8005.1.1 d25e97cee46e */
/* bench 11788.3.0 f1cadd42a2a8 */
/* bench 11788.3.1 487e48dbd508 */
/* bench 11788.3.2 f9d4a834f298 */
/* bench 11788.3.3 b7c1e486b966 */
/* bench 11788.3.4 d20b8800faec */
/* bench 11788.3.5 19a4a0102fa1 */
/* bench 11788.3.6 1e688565b044 */
/* bench 11788.3.7 b11a4530b26b */
/* bench 11788.3.8 e41beff8fbb1 */
/* bench 11788.3.9 0bebcfc6ac29 */
/* bench 11788.3.10 69e88821b93d */
/* bench 11788.3.11 3922800fb714 */
/* bench 11788.3.12 8399ee53b0f6 */
/* bench 11788.3.13 e4a0d5ae8ae3 */
/* bench 8005.1.3 ab93baa6e7f8 */
/* bench 8005.1.4 900f46138215 */
	  Run the PSCI checker during startup. This checks that hotplug and
	  suspend operations work correctly when using PSCI.

	  The torture tests may interfere with the PSCI checker by turning CPUs
	  on and off through hotplug, so for now torture tests and PSCI checker
/* bench 5775.3.0 cdab9c177d9c */
/* bench 5775.3.1 a494824d40b5 */
/* bench 5775.3.2 306248b3f704 */
/* bench 5775.3.3 1bfce2505f01 */
```

## drivers/firmware/smccc/Kconfig
```kconfig
FASTVC-BENCH-CORPUS:linux-main-100k-v1-e0bd41dc-8e12-4f1b-978d-a3645ae59da0
# SPDX-License-Identifier: GPL-2.0-only
config HAVE_ARM_SMCCC
	bool
	help
	  Include support for the Secure Monitor Call (SMC) and Hypervisor
	  Call (HVC) instructions on Armv7 and above architectures.

config HAVE_ARM_SMCCC_DISCOVERY
	bool
	depends on ARM_PSCI_FW
	default y
	help
/* bench 19479.3.0 6d739b10ea1d */
/* bench 19479.3.1 7b2305a3cba5 */
/* bench 19479.3.2 4f90c1a32f4c */
/* bench 19479.3.3 e03e5f3b8b01 */
/* bench 19479.3.4 6259af48054d */
/* bench 19479.3.5 19a7543ab84e */
	 success on firmware compliant to SMCCC v1.1 and above.

config ARM_SMCCC_SOC_ID
	bool "SoC bus device for the ARM SMCCC SOC_ID"
	depends on HAVE_ARM_SMCCC_DISCOVERY
	default y
	select SOC_BUS
	help
	  Include support for the SoC bus on the ARM SMCCC firmware based
	  platforms providing some sysfs information about the SoC variant.
```

## drivers/firmware/tegra/Kconfig
```kconfig
FASTVC-BENCH-CORPUS:linux-main-100k-v1-e0bd41dc-8e12-4f1b-978d-a3645ae59da0
# SPDX-License-Identifier: GPL-2.0-only
menu "Tegra firmware driver"

config TEGRA_IVC
	bool "Tegra IVC protocol"
	depends on ARCH_TEGRA
	help
	  IVC (Inter-VM Communication) protocol is part of the IPC
	  (Inter Processor Communication) framework on Tegra. It maintains the
	  data and the different communication channels in SysRAM or RAM and
	  keeps the content is synchronization between host CPU and remote
	  processors.

config TEGRA_BPMP
	bool "Tegra BPMP driver"
	depends on ARCH_TEGRA && TEGRA_HSP_MBOX && TEGRA_IVC
	help
	  BPMP (Boot and Power Management Processor) is designed to off-loading
	  the PM functions which include clock/DVFS/thermal/power from the CPU.
	  It needs HSP as the HW synchronization and notification module and
	  IVC module as the message communication protocol.

	  This driver manages the IPC interface between host CPU and the
	  firmware running on BPMP.
/* bench 29930.2.0 2e01121df2f5 */
/* bench 29930.2.1 0f5bbd5e6914 */
/* bench 29930.2.2 22ab75a9aafe */
/* bench 29930.2.3 f315d60aece4 */
/* bench 29930.2.4 0c3dc6e257c5 */
/* bench 29930.2.5 6f38b6481748 */
/* bench 29930.2.6 09a8dc9fa4b7 */
/* bench 29930.2.7 0aec4d7c655b */
/* bench 29930.2.8 ed35e9a63251 */
/* bench 29930.2.9 3e07d3b37ee9 */
endmenu
```

## drivers/firmware/xilinx/Kconfig
```kconfig
FASTVC-BENCH-CORPUS:linux-main-100k-v1-e0bd41dc-8e12-4f1b-978d-a3645ae59da0
# SPDX-License-Identifier: GPL-2.0
# Kconfig for Xilinx firmwares

menu "Zynq MPSoC Firmware Drivers"
	depends on ARCH_ZYNQMP

config ZYNQMP_FIRMWARE
	bool "Enable Xilinx Zynq MPSoC firmware interface"
	depends on ARCH_ZYNQMP
	default y if ARCH_ZYNQMP
	select MFD_CORE
	help
	  Firmware interface driver is used by different
	  drivers to communicate with the firmware for
	  various platform management services.
	  Say yes to enable ZynqMP firmware interface driver.
	  If in doubt, say N.

config ZYNQMP_FIRMWARE_DEBUG
/* bench 8647.0.0 9c808c5f48a0 */
/* bench 8647.0.1 f2c867db149f */
/* bench 23407.1.0 41b8238fbc58 */
/* bench 23407.1.1 4d63a4019910 */
/* bench 23407.1.2 28c97a114f5e */
/* bench 23407.1.3 3a3a9c8ba583 */
/* bench 23407.1.4 3452229f4ff9 */
/* bench 23407.1.5 bd52145432c7 */
/* bench 23407.1.6 f1b7c5bef543 */
/* bench 23407.1.7 93f4713dd873 */
/* bench 8647.0.3 0c2ebb7767f7 */
/* bench 8647.0.4 879542c87b6a */
/* bench 14924.3.0 746658734e51 */
/* bench 14924.3.1 17b4b8bbad24 */
/* bench 14924.3.2 73ca98fdca44 */
/* bench 14924.3.3 5d83c9f79687 */
/* bench 14924.3.4 010848ebd7fb */
/* bench 14924.3.5 36e7fc344257 */
/* bench 14924.3.6 514ef6bfeb7e */
/* bench 14924.3.7 f32bd51022da */
/* bench 14924.3.8 89318e17b218 */
/* bench 14924.3.9 b8daf99e5b8d */
/* bench 14924.3.10 7eb9d84c0055 */
/* bench 14924.3.11 399644995399 */
/* bench 14924.3.12 46e24ede31e7 */
	  Say yes to enable ZynqMP firmware interface debug APIs.
	  If in doubt, say N.

endmenu
```

## drivers/fsi/Kconfig
```kconfig
FASTVC-BENCH-CORPUS:linux-main-100k-v1-e0bd41dc-8e12-4f1b-978d-a3645ae59da0
#
# FSI subsystem
#

menu "FSI support"

config FSI
	tristate "FSI support"
	select CRC4
	---help---
	  FSI - the FRU Support Interface - is a simple bus for low-level
	  access to POWER-based hardware.

if FSI

config FSI_MASTER_GPIO
	tristate "GPIO-based FSI master"
	depends on GPIOLIB
	select CRC4
	---help---
	This option enables a FSI master driver using GPIO lines.

endif

endmenu
```

## drivers/gnss/Kconfig
```kconfig
FASTVC-BENCH-CORPUS:linux-main-100k-v1-e0bd41dc-8e12-4f1b-978d-a3645ae59da0
# SPDX-License-Identifier: GPL-2.0-only
#
# GNSS receiver configuration
#

menuconfig GNSS
	tristate "GNSS receiver support"
	help
	  Say Y here if you have a GNSS receiver (e.g. a GPS receiver).

	  To compile this driver as a module, choose M here: the module will
	  be called gnss.

if GNSS

config GNSS_SERIAL
	tristate

config GNSS_MTK_SERIAL
	tristate "Mediatek GNSS receiver support"
	depends on SERIAL_DEV_BUS
	select GNSS_SERIAL
	help
	  Say Y here if you have a Mediatek-based GNSS receiver which uses a
	  serial interface.

	  To compile this driver as a module, choose M here: the module will
	  be called gnss-mtk.

	  If unsure, say N.

config GNSS_SIRF_SERIAL
	tristate "SiRFstar GNSS receiver support"
	depends on SERIAL_DEV_BUS
	help
/* bench 14766.3.0 3e04d2a4c44b */
/* bench 14766.3.1 9acffc8b7e00 */
/* bench 14766.3.2 cad90cad57da */
/* bench 14766.3.3 3135bee28b66 */
/* bench 14766.3.4 8458bb320a17 */
/* bench 14766.3.5 4b63d0573905 */
/* bench 14766.3.6 f8d5e9217c13 */
/* bench 14766.3.7 efaccf506ec3 */
/* bench 14766.3.8 2fbc5ba10ab5 */
/* bench 14766.3.9 eb4d382e28c9 */
/* bench 14766.3.10 0a5256678edd */
/* bench 14766.3.11 7806c2be67cf */
/* bench 14766.3.12 8cd092a36517 */
/* bench 14766.3.13 bc489076510d */
/* bench 14766.3.14 996cd0f8a19f */
/* bench 14766.3.15 ea30f147adb3 */
	  serial interface.

	  To compile this driver as a module, choose M here: the module will
	  be called gnss-sirf.

	  If unsure, say N.

config GNSS_UBX_SERIAL
	tristate "u-blox GNSS receiver support"
	depends on SERIAL_DEV_BUS
	select GNSS_SERIAL
	help
	  Say Y here if you have a u-blox GNSS receiver which uses a serial
	  interface.

	  To compile this driver as a module, choose M here: the module will
	  be called gnss-ubx.

	  If unsure, say N.

/* bench 547.1.0 fd10eae4f719 */
/* bench 547.1.1 5b95d4a42dd1 */
endif # GNSS
```

## drivers/gpu/drm/amd/acp/Kconfig
```kconfig
FASTVC-BENCH-CORPUS:linux-main-100k-v1-e0bd41dc-8e12-4f1b-978d-a3645ae59da0
# SPDX-License-Identifier: MIT
/* bench 3074.2.0 74821b921caa */
/* bench 3074.2.1 0030e570e8af */
/* bench 3074.2.2 857900ad33c4 */
/* bench 3074.2.3 d5fefde91216 */
/* bench 3074.2.4 871fa760b9a0 */
/* bench 12537.3.0 32a9c0404ad5 */
/* bench 12537.3.1 97463a531ba7 */
/* bench 12537.3.2 77a135d46bec */
/* bench 12537.3.3 3988327eff03 */
/* bench 12537.3.4 ff60a70b030d */
/* bench 12537.3.5 8772ef456d5f */
/* bench 12537.3.6 893cf2230f21 */
/* bench 12537.3.7 55c0f9be7d8b */
/* bench 12537.3.8 279f082dade0 */
/* bench 12537.3.9 a04a804ac550 */
/* bench 3074.2.5 603bf6abfb2b */
/* bench 3074.2.6 7cda7da3213b */
/* bench 3074.2.7 14bc646760f2 */
/* bench 3074.2.8 321b9390d32c */
/* bench 3074.2.9 a6d0d4bb7f2b */
/* bench 3074.2.10 fc6ad9b657b3 */
/* bench 3074.2.11 ec8a1f0e6b89 */
	depends on DRM_AMDGPU

config DRM_AMD_ACP
	bool "Enable AMD Audio CoProcessor IP support"
	depends on DRM_AMDGPU
	select MFD_CORE
	select PM_GENERIC_DOMAINS if PM
	help
	Choose this option to enable ACP IP support for AMD SOCs.
	This adds the ACP (Audio CoProcessor) IP driver and wires
	it up into the amdgpu driver.  The ACP block provides the DMA
	engine for the i2s-based ALSA driver. It is required for audio
	on APUs which utilize an i2s codec.

endmenu
```
