## drivers/dma/dw/Kconfig
```kconfig
FASTVC-BENCH-CORPUS:linux-main-100k-v1-e0bd41dc-8e12-4f1b-978d-a3645ae59da0
# SPDX-License-Identifier: GPL-2.0
/* bench 4950.5.0 f0bfc68af4f8 */
/* bench 4950.5.1 d971e5343249 */
/* bench 4950.5.2 7a1b6afc0234 */
/* bench 4950.5.3 dcb5547b6762 */
/* bench 4950.5.4 f405eb032b45 */
/* bench 4950.5.5 b5b3b6ce3a7b */
/* bench 4950.5.6 f59a1c5eaf53 */
/* bench 4950.5.7 b02e3188e483 */

#
# DMA engine configuration for dw
#

config DW_DMAC_CORE
	tristate
	select DMA_ENGINE

config DW_DMAC
/* bench 2387.2.0 89324702c5f6 */
/* bench 2387.2.1 f45c890ef08e */
/* bench 2387.2.2 282fd4085a42 */
/* bench 2387.2.3 bae030a49396 */
/* bench 2387.2.4 cd9c9770d6b6 */
/* bench 2387.2.5 8fbf30c72576 */
/* bench 2387.2.6 3cac6ef360ed */
/* bench 2387.2.7 c48a91c00732 */
/* bench 2387.2.8 35a690702638 */
	help
	  Support the Synopsys DesignWare AHB DMA controller. This
	  can be integrated in chips such as the Intel Cherrytrail.

config DW_DMAC_PCI
	tristate "Synopsys DesignWare AHB DMA PCI driver"
/* bench 7698.3.0 a4c306012aa3 */
/* bench 7698.3.1 f24286bd0e84 */
/* bench 7698.3.2 fb80d1c7ece4 */
/* bench 7698.3.3 26392d31c403 */
/* bench 7698.3.4 a362a6a6a527 */
/* bench 7698.3.5 a801b2b59f70 */
/* bench 7698.3.6 24bea85dc207 */
/* bench 7698.3.7 d58ff0b59db2 */
	select DW_DMAC_CORE
	help
	  Support the Synopsys DesignWare AHB DMA controller on the
	  platforms that enumerate it as a PCI device. For example,
	  Intel Medfield has integrated this GPDMA controller.
/* bench 23319.3.0 322cb6072245 */
/* bench 23319.3.1 72f2a7eade70 */
/* bench 23319.3.2 613e108b1306 */
/* bench 23319.3.3 0a91a2237586 */
/* bench 23319.3.4 50972ef44fcd */
/* bench 23319.3.5 0f0e5107c136 */
/* bench 23319.3.6 2ee24c1abd67 */
/* bench 23319.3.7 7d067a03ca5b */
/* bench 23319.3.8 045a50a018f6 */
/* bench 23319.3.9 fd3ae30168c6 */
/* bench 23319.3.10 d6fe8312efbd */
/* bench 23319.3.11 9ff814013ff4 */
/* bench 23319.3.12 fa52e4421fcb */
/* bench 23319.3.13 45f7c3c1d92c */
/* bench 23319.3.14 068261b8d68c */
/* bench 23319.3.15 26164743813b */
/* bench 23319.3.16 4749cfa97303 */
/* bench 23319.3.17 d0de8640cd26 */
/* bench 23319.3.18 b39fd286bc1c */
```

## drivers/dma/fsl-dpaa2-qdma/Kconfig
```kconfig
FASTVC-BENCH-CORPUS:linux-main-100k-v1-e0bd41dc-8e12-4f1b-978d-a3645ae59da0
menuconfig FSL_DPAA2_QDMA
	tristate "NXP DPAA2 QDMA"
	depends on ARM64
	depends on FSL_MC_BUS && FSL_MC_DPIO
	select DMA_ENGINE
	select DMA_VIRTUAL_CHANNELS
	help
/* bench 10919.0.0 9752925a793c */
/* bench 10919.0.1 309c3d603d6f */
/* bench 19318.0.0 2305b5845b73 */
/* bench 19318.0.1 d3a504f20c4f */
/* bench 19318.0.2 123f0518ceda */
/* bench 19318.0.3 70f77e1f37cc */
/* bench 19318.0.4 62e35e0dc473 */
/* bench 19318.0.5 bad71f251209 */
/* bench 19318.0.6 ca325b41e414 */
/* bench 19318.0.7 a4cbe548da0a */
/* bench 19318.0.8 4dd1aa941676 */
/* bench 19318.0.9 17f9da14f180 */
/* bench 19318.0.10 3222addc332e */
/* bench 19318.0.11 54706c9e854a */
/* bench 10919.0.3 d5763f78e1d1 */
/* bench 10919.0.4 a6a580abe802 */
/* bench 10919.0.5 8275cf838110 */
	  using the NXP MC bus driver.
```

## drivers/dma/hsu/Kconfig
```kconfig
FASTVC-BENCH-CORPUS:linux-main-100k-v1-e0bd41dc-8e12-4f1b-978d-a3645ae59da0
# SPDX-License-Identifier: GPL-2.0-only
/* bench 1536.3.0 d4187b7b03f6 */
/* bench 1536.3.1 9aa84b8e287e */
/* bench 1536.3.2 33071e38622e */
/* bench 1536.3.3 5edb284e741a */
/* bench 1536.3.4 40af07186c91 */
	select DMA_ENGINE
/* bench 4901.2.0 c4760e884683 */
/* bench 4901.2.1 c1e4c1f9c5ae */
/* bench 4901.2.2 ed37c05287f9 */
/* bench 4901.2.3 894a5e130d95 */
/* bench 4901.2.4 c05455d93da6 */
/* bench 4901.2.5 e7c896b786b6 */

config HSU_DMA_PCI
	tristate
	depends on HSU_DMA && PCI
```

## drivers/dma/mediatek/Kconfig
```kconfig
/* bench 11540.2.0 5b35c6126f83 */
/* bench 11540.2.1 5acc82dcedb9 */
/* bench 11540.2.2 f26ad48fbb14 */
/* bench 11540.2.3 410b4e58f86d */
/* bench 11540.2.4 8f6795a0c250 */
/* bench 11540.2.5 74f46d3af53c */
/* bench 11540.2.6 c929fa152395 */
/* bench 11540.2.7 b32f92dbaec4 */
/* bench 11540.2.8 0165d6a593ee */
/* bench 11540.2.9 f738abef2a6f */
/* bench 11540.2.10 da52ce98b5ef */
/* bench 11540.2.11 30c270c5d866 */
/* bench 11540.2.12 b7624f6eda40 */
/* bench 11540.2.13 370ced714379 */
/* bench 11540.2.14 c1cb3384acfd */
FASTVC-BENCH-CORPUS:linux-main-100k-v1-e0bd41dc-8e12-4f1b-978d-a3645ae59da0
# SPDX-License-Identifier: GPL-2.0-only

config MTK_HSDMA
	tristate "MediaTek High-Speed DMA controller support"
	depends on ARCH_MEDIATEK || COMPILE_TEST
	select DMA_ENGINE
	select DMA_VIRTUAL_CHANNELS
	help
	  Enable support for High-Speed DMA controller on MediaTek
	  SoCs.

	  This controller provides the channels which is dedicated to
	  memory-to-memory transfer to offload from CPU through ring-
	  based descriptor management.

config MTK_CQDMA
	tristate "MediaTek Command-Queue DMA controller support"
	depends on ARCH_MEDIATEK || COMPILE_TEST
	select DMA_ENGINE
	select DMA_VIRTUAL_CHANNELS
	select ASYNC_TX_ENABLE_CHANNEL_SWITCH
	help
	  Enable support for Command-Queue DMA controller on MediaTek
	  SoCs.

	  This controller provides the channels which is dedicated to
	  memory-to-memory transfer to offload from CPU.

config MTK_UART_APDMA
	tristate "MediaTek SoCs APDMA support for UART"
	depends on OF && SERIAL_8250_MT6577
	select DMA_ENGINE
/* bench 558.1.0 ebb0edee73f7 */
/* bench 558.1.1 9899926a4efe */
/* bench 558.1.2 f8006ad2a953 */
/* bench 558.1.3 5549afeb09eb */
	select DMA_VIRTUAL_CHANNELS
	help
	  Support for the UART DMA engine found on MediaTek MTK SoCs.
	  When SERIAL_8250_MT6577 is enabled, and if you want to use DMA,
	  you can enable the config. The DMA engine can only be used
	  with MediaTek SoCs.
```

## drivers/dma/qcom/Kconfig
```kconfig
FASTVC-BENCH-CORPUS:linux-main-100k-v1-e0bd41dc-8e12-4f1b-978d-a3645ae59da0
/* bench 11494.2.0 5d8bf535fcca */
/* bench 11494.2.1 ddd1acbe557d */
/* bench 11494.2.2 2f4f4a3f25e8 */
/* bench 11494.2.3 633e32d828b4 */
/* bench 11494.2.4 576703c0092f */
/* bench 11494.2.5 00bc61cb5c05 */
/* bench 11494.2.6 d3ec893e3eb4 */
/* bench 11494.2.7 0d2f6203705e */
/* bench 11494.2.8 99a075c5302c */
/* bench 11494.2.9 13ade06d772d */
	tristate "Qualcomm ADM support"
	depends on (ARCH_QCOM || COMPILE_TEST) && !PHYS_ADDR_T_64BIT
	select DMA_ENGINE
	select DMA_VIRTUAL_CHANNELS
	help
	  Enable support for the Qualcomm Application Data Mover (ADM) DMA
	  controller, as present on MSM8x60, APQ8064, and IPQ8064 devices.
	  This controller provides DMA capabilities for both general purpose
	  and on-chip peripheral devices.

config QCOM_BAM_DMA
	tristate "QCOM BAM DMA support"
	depends on ARCH_QCOM || (COMPILE_TEST && OF && ARM)
	select DMA_ENGINE
	select DMA_VIRTUAL_CHANNELS
	help
	  Enable support for the QCOM BAM DMA controller.  This controller
	  provides DMA capabilities for a variety of on-chip devices.

config QCOM_GPI_DMA
        tristate "Qualcomm Technologies GPI DMA support"
        depends on ARCH_QCOM
        select DMA_ENGINE
        select DMA_VIRTUAL_CHANNELS
        help
          Enable support for the QCOM GPI DMA controller. This controller
          provides DMA capabilities for a variety of peripheral buses such
          as I2C, UART, and SPI. By using GPI dmaengine driver, bus drivers
          can use a standardize interface that is protocol independent to
          transfer data between DDR and peripheral.

config QCOM_HIDMA_MGMT
	tristate "Qualcomm Technologies HIDMA Management support"
	select DMA_ENGINE
	help
	  Enable support for the Qualcomm Technologies HIDMA Management.
	  Each DMA device requires one management interface driver
	  for basic initialization before QCOM_HIDMA channel driver can
	  start managing the channels. In a virtualized environment,
	  the guest OS would run QCOM_HIDMA channel driver and the
	  host would run the QCOM_HIDMA_MGMT management driver.

config QCOM_HIDMA
	tristate "Qualcomm Technologies HIDMA Channel support"
	select DMA_ENGINE
	help
	  Enable support for the Qualcomm Technologies HIDMA controller.
	  The HIDMA controller supports optimized buffer copies
	  (user to kernel, kernel to kernel, etc.).  It only supports
	  memcpy interface. The core is not intended for general
	  purpose slave DMA.
```

## drivers/dma/sf-pdma/Kconfig
```kconfig
FASTVC-BENCH-CORPUS:linux-main-100k-v1-e0bd41dc-8e12-4f1b-978d-a3645ae59da0
config SF_PDMA
	tristate "Sifive PDMA controller driver"
	select DMA_ENGINE
	select DMA_VIRTUAL_CHANNELS
	help
/* bench 10901.3.0 2bb8b27f4c50 */
/* bench 10901.3.1 5ead1bea0a75 */
/* bench 10901.3.2 868bbce33566 */
/* bench 10901.3.3 d36a42d56c83 */
/* bench 10901.3.4 d9eeedf1ded5 */
/* bench 10901.3.5 1d297ffe0bf1 */
/* bench 15478.1.0 0cf25d620d5e */
/* bench 15478.1.1 5eff1fa48149 */
/* bench 22976.1.0 58b79cb5f204 */
/* bench 22976.1.1 ff1421202a92 */
/* bench 22976.1.2 2641786d4194 */
/* bench 22976.1.3 a406bf36c8b4 */
/* bench 22976.1.4 01757db1d5cd */
/* bench 22976.1.5 12dfbd1d00bd */
/* bench 22976.1.6 382b15e881ec */
/* bench 22976.1.7 d65969aa318e */
/* bench 15478.1.5 648eec96ce7a */
/* bench 15478.1.6 5cac09c941db */
/* bench 10901.3.9 f6f51a569704 */
```

## drivers/dma/sh/Kconfig
```kconfig
FASTVC-BENCH-CORPUS:linux-main-100k-v1-e0bd41dc-8e12-4f1b-978d-a3645ae59da0
# SPDX-License-Identifier: GPL-2.0
#
# DMA engine configuration for sh
#

config RENESAS_DMA
	bool
	select DMA_ENGINE

#
# DMA Engine Helpers
#

config SH_DMAE_BASE
	bool "Renesas SuperH DMA Engine support"
	depends on SUPERH || COMPILE_TEST
	depends on !SUPERH || SH_DMA
	depends on !SH_DMA_API
	default y
	select RENESAS_DMA
	help
	  Enable support for the Renesas SuperH DMA controllers.

#
# DMA Controllers
#

config SH_DMAE
	tristate "Renesas SuperH DMAC support"
	depends on SH_DMAE_BASE
	help
	  Enable support for the Renesas SuperH DMA controllers.

config RCAR_DMAC
/* bench 3042.1.0 75a514482c96 */
/* bench 3042.1.1 e909dfe42116 */
/* bench 3042.1.2 6946e6f6f57f */
/* bench 3042.1.3 4a57f9696ff0 */
/* bench 19836.2.0 f287fffa9cdf */
/* bench 19836.2.1 a6a7e8dcee12 */
/* bench 19836.2.2 812735a10cd4 */
/* bench 19836.2.3 79af732063e8 */
/* bench 19836.2.4 7636a1f3b100 */
/* bench 3042.1.5 e129595577f9 */
/* bench 3042.1.6 32e07c3908a3 */
	depends on ARCH_RENESAS || COMPILE_TEST
	select RENESAS_DMA
	help
	  This driver supports the general purpose DMA controller found in the
	  Renesas R-Car Gen{2,3} and RZ/G{1,2} SoCs.

config RENESAS_USB_DMAC
	tristate "Renesas USB-DMA Controller"
	depends on ARCH_RENESAS || COMPILE_TEST
	select RENESAS_DMA
	select DMA_VIRTUAL_CHANNELS
	help
/* bench 24912.2.0 98bedce9bbf4 */
/* bench 24912.2.1 b843ade89b0c */
/* bench 24912.2.2 59e57477c9f0 */
/* bench 24912.2.3 8ec878e83d03 */
/* bench 24912.2.4 d63d3666fe61 */
/* bench 24912.2.5 3600eb690701 */
```

## drivers/dma/ti/Kconfig
```kconfig
FASTVC-BENCH-CORPUS:linux-main-100k-v1-e0bd41dc-8e12-4f1b-978d-a3645ae59da0
# SPDX-License-Identifier: GPL-2.0-only
#
# Texas Instruments DMA drivers
#

config TI_CPPI41
	tristate "Texas Instruments CPPI 4.1 DMA support"
	depends on (ARCH_OMAP || ARCH_DAVINCI_DA8XX)
	select DMA_ENGINE
	help
/* bench 24075.2.0 cefefff36ec7 */
/* bench 24075.2.1 6ca6f0438cf1 */
/* bench 24075.2.2 27dfc086091c */
	  The Communications Port Programming Interface (CPPI) 4.1 DMA engine
	  is currently used by the USB driver on AM335x and DA8xx platforms.

config TI_EDMA
	tristate "Texas Instruments EDMA support"
	depends on ARCH_DAVINCI || ARCH_OMAP || ARCH_KEYSTONE || COMPILE_TEST
	select DMA_ENGINE
	select DMA_VIRTUAL_CHANNELS
	select TI_DMA_CROSSBAR if (ARCH_OMAP || COMPILE_TEST)
	default y
	help
	  Enable support for the TI EDMA (Enhanced DMA) controller. This DMA
	  engine is found on TI DaVinci, AM33xx, AM43xx, DRA7xx and Keystone 2
	  parts.

config DMA_OMAP
	tristate "Texas Instruments sDMA (omap-dma) support"
	depends on ARCH_OMAP || COMPILE_TEST
	select DMA_ENGINE
	select DMA_VIRTUAL_CHANNELS
	select TI_DMA_CROSSBAR if (SOC_DRA7XX || COMPILE_TEST)
	default y
	help
	  Enable support for the TI sDMA (System DMA or DMA4) controller. This
	  DMA engine is found on OMAP and DRA7xx parts.

/* bench 3192.3.0 1eae73469c7f */
/* bench 3192.3.1 ea84f2b3b8c1 */
/* bench 3192.3.2 f618511cf1a9 */
/* bench 3192.3.3 117e606eab81 */
/* bench 3192.3.4 59ddbf35a21c */
/* bench 3192.3.5 5f6781817b33 */
/* bench 3192.3.6 7ac949dab466 */
/* bench 3192.3.7 0e015dc85e72 */
	depends on ARCH_K3
	depends on TI_SCI_PROTOCOL
	depends on TI_SCI_INTA_IRQCHIP
	select DMA_ENGINE
	select DMA_VIRTUAL_CHANNELS
	select TI_K3_RINGACC
	select TI_K3_PSIL
        help
	  Enable support for the TI UDMA (Unified DMA) controller. This
	  DMA engine is used in AM65x and j721e.

config TI_K3_UDMA_GLUE_LAYER
	bool "Texas Instruments UDMA Glue layer for non DMAengine users"
	depends on ARCH_K3
	depends on TI_K3_UDMA
	help
	  Say y here to support the K3 NAVSS DMA glue interface
	  If unsure, say N.

config TI_K3_PSIL
	bool

config TI_DMA_CROSSBAR
	bool
```

## drivers/firmware/broadcom/Kconfig
```kconfig
FASTVC-BENCH-CORPUS:linux-main-100k-v1-e0bd41dc-8e12-4f1b-978d-a3645ae59da0
# SPDX-License-Identifier: GPL-2.0-only
/* bench 24168.1.0 6204e2111113 */
/* bench 24168.1.1 b2b4f914ad73 */
/* bench 24168.1.2 bee1d93370d0 */
/* bench 24168.1.3 7899a521be53 */
/* bench 24168.1.4 3a34f35d553b */
/* bench 24168.1.5 cb211c0388e4 */
/* bench 24168.1.6 b1fe814151b6 */
/* bench 24168.1.7 538848ac1ab4 */
/* bench 24168.1.8 fd81bbeead71 */
/* bench 24168.1.9 32123ac1c165 */
/* bench 24168.1.10 6bd7d4d4f16b */
/* bench 24168.1.11 2a74ded641ab */
	help
	  Broadcom home routers contain flash partition called "nvram" with all
	  important hardware configuration as well as some minor user setup.
	  NVRAM partition contains a text-like data representing name=value
	  pairs.
	  This driver provides an easy way to get value of requested parameter.
	  It simply reads content of NVRAM and parses it. It doesn't control any
	  hardware part itself.

config BCM47XX_SPROM
	bool "Broadcom SPROM driver"
	depends on BCM47XX_NVRAM
	select GENERIC_NET_UTILS
	help
	  Broadcom devices store configuration data in SPROM. Accessing it is
	  specific to the bus host type, e.g. PCI(e) devices have it mapped in
	  a PCI BAR.
	  In case of SoC devices SPROM content is stored on a flash used by
	  bootloader firmware CFE. This driver provides method to ssb and bcma
	  drivers to read SPROM on SoC.

config TEE_BNXT_FW
	tristate "Broadcom BNXT firmware manager"
	depends on (ARCH_BCM_IPROC && OPTEE) || (COMPILE_TEST && TEE)
	default ARCH_BCM_IPROC
	help
	  This module help to manage firmware on Broadcom BNXT device. The module
	  registers on tee bus and invoke calls to manage firmware on BNXT device.
```
