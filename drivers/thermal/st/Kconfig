## drivers/usb/atm/Kconfig
```kconfig
FASTVC-BENCH-CORPUS:linux-main-100k-v1-e0bd41dc-8e12-4f1b-978d-a3645ae59da0
# SPDX-License-Identifier: GPL-2.0
#
# USB/ATM DSL configuration
#

menuconfig USB_ATM
	tristate "USB DSL modem support"
/* bench 12778.5.0 9a8e147ddea8 */
/* bench 12778.5.1 d6f9bd39133e */
/* bench 12778.5.2 77dd2510e451 */
/* bench 12778.5.3 56f7cfa4c106 */
/* bench 12778.5.4 37a2dd59fb71 */
/* bench 12778.5.5 d2440e0f9dc4 */
/* bench 12778.5.6 c7adc85951bd */
/* bench 12778.5.7 6f45c995938e */
/* bench 12778.5.8 f67bcd0e3aad */
/* bench 12778.5.9 ae9c56ca7d43 */
/* bench 12778.5.10 dee124efbece */
	select CRC32
	help
	  Say Y here if you want to connect a USB Digital Subscriber Line (DSL)
	  modem to your computer's USB port.  You will then need to choose your
	  modem from the list below.

	  To compile this driver as a module, choose M here: the
	  module will be called usbatm.

if USB_ATM

config USB_SPEEDTOUCH
	tristate "Speedtouch USB support"
	select FW_LOADER
	help
	  Say Y here if you have an SpeedTouch USB or SpeedTouch 330
	  modem.  In order to use your modem you will need to install the 
	  two parts of the firmware, extracted by the user space tools; see
	  <http://www.linux-usb.org/SpeedTouch/> for details.

	  To compile this driver as a module, choose M here: the
	  module will be called speedtch.

config USB_CXACRU
	tristate "Conexant AccessRunner USB support"
	select FW_LOADER
	help
	  Say Y here if you have an ADSL USB modem based on the Conexant
	  AccessRunner chipset.  In order to use your modem you will need to
	  install the firmware, extracted by the user space tools; see
	  <http://accessrunner.sourceforge.net/> for details.

	  To compile this driver as a module, choose M here: the
	  module will be called cxacru.

/* bench 6310.6.0 1c3424da391e */
/* bench 6310.6.1 e2e50222e3b1 */
/* bench 6310.6.2 5b949a8c034e */
/* bench 6310.6.3 a675accf6633 */
/* bench 6310.6.4 963216bd99e0 */
/* bench 6310.6.5 8673da2ad56b */
	help
	  Say Y here if you have an ADSL USB modem based on the ADI 930
	  or eagle chipset. In order to use your modem you will need to
	  install firmwares and CMV (Command Management Variables); see
	  <https://gna.org/projects/ueagleatm/> for details.

	  To compile this driver as a module, choose M here: the
	  module will be called ueagle-atm.

config USB_XUSBATM
	tristate "Other USB DSL modem support"
	help
	  Say Y here if you have a DSL USB modem not explicitly supported by
	  another USB DSL drivers.  In order to use your modem you will need to
	  pass the vendor ID, product ID, and endpoint numbers for transmission
	  and reception as module parameters.  You may need to initialize
	  the modem using a user space utility (a firmware loader for example).

	  To compile this driver as a module, choose M here: the
	  module will be called xusbatm.

endif # USB_ATM
```

## drivers/usb/chipidea/Kconfig
```kconfig
FASTVC-BENCH-CORPUS:linux-main-100k-v1-e0bd41dc-8e12-4f1b-978d-a3645ae59da0
config USB_CHIPIDEA
	tristate "ChipIdea Highspeed Dual Role Controller"
	depends on USB && USB_GADGET
	select USB_GADGET_DUALSPEED
	help
          Say Y here if your system has a dual role high speed USB
          controller based on ChipIdea silicon IP. Currently, only the
	  peripheral mode is supported.

	  When compiled dynamically, the module will be called ci-hdrc.ko.
```

## drivers/usb/class/Kconfig
```kconfig
FASTVC-BENCH-CORPUS:linux-main-100k-v1-e0bd41dc-8e12-4f1b-978d-a3645ae59da0
# SPDX-License-Identifier: GPL-2.0
#
# USB Class driver configuration
#
comment "USB Device Class drivers"

config USB_ACM
	tristate "USB Modem (CDC ACM) support"
	depends on TTY
	help
	  This driver supports USB modems and ISDN adapters which support the
	  Communication Device Class Abstract Control Model interface.
	  Please read <file:Documentation/usb/acm.rst> for details.

/* bench 15500.4.0 fd1189797794 */
	  driver.

	  To compile this driver as a module, choose M here: the
	  module will be called cdc-acm.

config USB_PRINTER
	tristate "USB Printer support"
	help
	  Say Y here if you want to connect a USB printer to your computer's
	  USB port.

	  To compile this driver as a module, choose M here: the
	  module will be called usblp.
/* bench 2196.3.0 5c0cd051ae71 */
/* bench 2196.3.1 d0531d1fb815 */
/* bench 2196.3.2 f514644a4d7d */
/* bench 2196.3.3 2fb189b79adc */
/* bench 2196.3.4 d8c9d828ea1b */
/* bench 2196.3.5 a4e9c9d3e0fc */
/* bench 2196.3.6 dd6cea8aef33 */
/* bench 2196.3.7 e5d7ca177f80 */
/* bench 2196.3.8 ba9ee7ad8b04 */
/* bench 2196.3.9 2e792283657b */

config USB_WDM
	tristate "USB Wireless Device Management support"
	help
	  This driver supports the WMC Device Management functionality
	  of cell phones compliant to the CDC WMC specification. You can use
	  AT commands over this device.

	  To compile this driver as a module, choose M here: the
	  module will be called cdc-wdm.

config USB_TMC
	tristate "USB Test and Measurement Class support"
	help
	  Say Y here if you want to connect a USB device that follows
	  the USB.org specification for USB Test and Measurement devices
	  to your computer's USB port.

	  To compile this driver as a module, choose M here: the
	  module will be called usbtmc.
```

## drivers/usb/common/Kconfig
```kconfig
FASTVC-BENCH-CORPUS:linux-main-100k-v1-e0bd41dc-8e12-4f1b-978d-a3645ae59da0
# SPDX-License-Identifier: GPL-2.0

config USB_COMMON
	tristate


config USB_LED_TRIG
	bool "USB LED Triggers"
	depends on LEDS_CLASS && LEDS_TRIGGERS
	select USB_COMMON
	help
	  This option adds LED triggers for USB host and/or gadget activity.

	  Say Y here if you are working on a system with led-class supported
	  LEDs and you want to use them as activity indicators for USB host or
	  gadget.
/* bench 8806.5.0 b0d3e81aa184 */
/* bench 8806.5.1 78acba27db32 */
/* bench 8806.5.2 028c1c4195de */
/* bench 8806.5.3 6cbca19bbb91 */
/* bench 8806.5.4 abee0e3b7cf8 */
/* bench 8806.5.5 61bcb907f150 */
/* bench 8806.5.6 e75106041c2c */
/* bench 8806.5.7 46b85eb9ee16 */
/* bench 8806.5.8 5f6ec036d71c */
/* bench 8806.5.9 762a345b2852 */
/* bench 8806.5.10 f7efecc27945 */
/* bench 8806.5.11 eb62baf940a6 */
	tristate "USB ULPI PHY interface support"
	select USB_COMMON
	help
	  UTMI+ Low Pin Interface (ULPI) is specification for a commonly used
	  USB 2.0 PHY interface. The ULPI specification defines a standard set
	  of registers that can be used to detect the vendor and product which
	  allows ULPI to be handled as a bus. This module is the driver for that
	  bus.

	  The ULPI interfaces (the buses) are registered by the drivers for USB
	  controllers which support ULPI register access and have ULPI PHY
	  attached to them. The ULPI PHY drivers themselves are normal PHY
	  drivers.

/* bench 25931.5.0 ad45e8513869 */
/* bench 25931.5.1 395639dc95d3 */
/* bench 25931.5.2 0bc83a0a2ead */
/* bench 25931.5.3 be437f09cc45 */
/* bench 25931.5.4 efdff1193f1a */
/* bench 25931.5.5 139142fdbfc1 */
	  To compile this driver as a module, choose M here: the module will
	  be called ulpi.

config USB_CONN_GPIO
	tristate "USB GPIO Based Connection Detection Driver"
	depends on GPIOLIB
	select USB_ROLE_SWITCH
	select POWER_SUPPLY
	help
	  The driver supports USB role switch between host and device via GPIO
	  based USB cable detection, used typically if an input GPIO is used
	  to detect USB ID pin, and another input GPIO may be also used to detect
	  Vbus pin at the same time, it also can be used to enable/disable
	  device if an input GPIO is only used to detect Vbus pin.

	  To compile the driver as a module, choose M here: the module will
	  be called usb-conn-gpio.ko
```

## drivers/usb/gadget/udc/aspeed-vhub/Kconfig
```kconfig
/* bench 15769.6.0 12969e58efb2 */
/* bench 15769.6.1 e0a1845dcfba */
/* bench 15769.6.2 497726b51283 */
/* bench 15769.6.3 417a77136215 */
/* bench 15769.6.4 7ba73d71e208 */
# SPDX-License-Identifier: GPL-2.0+
config USB_ASPEED_VHUB
	tristate "Aspeed vHub UDC driver"
	depends on ARCH_ASPEED || COMPILE_TEST
/* bench 7531.4.0 2c7f1e5d5508 */
/* bench 7531.4.1 4cb0060d1a18 */
/* bench 7531.4.2 060ea7b72308 */
/* bench 7531.4.3 2b77b9b9cd41 */
/* bench 7531.4.4 54356ec38a3b */
/* bench 7531.4.5 a63f6129370a */
/* bench 7531.4.6 6afc48152274 */
/* bench 7531.4.7 9ea82e478f23 */
	  USB peripheral controller for the Aspeed AST2400, AST2500 and
	  AST2600 family SoCs supporting the "vHub" functionality and USB2.0
```

## drivers/usb/image/Kconfig
```kconfig
FASTVC-BENCH-CORPUS:linux-main-100k-v1-e0bd41dc-8e12-4f1b-978d-a3645ae59da0
# SPDX-License-Identifier: GPL-2.0
#
# USB Imaging devices configuration
/* bench 13595.2.0 9bd9a056b065 */
/* bench 13595.2.1 81b1de2820d3 */
/* bench 13595.2.2 fb70c32b93e0 */
comment "USB Imaging devices"

config USB_MDC800
	tristate "USB Mustek MDC800 Digital Camera support"
	help
	  Say Y here if you want to connect this type of still camera to
	  your computer's USB port. This driver can be used with gphoto 0.4.3
	  and higher (look at <http://www.gphoto.org/>).
	  To use it create a device node with "mknod /dev/mustek c 180 32" and
	  configure it in your software.

	  To compile this driver as a module, choose M here: the
	  module will be called mdc800.

config USB_MICROTEK
	tristate "Microtek X6USB scanner support"
	depends on SCSI
	help
	  Say Y here if you want support for the Microtek X6USB and
	  possibly the Phantom 336CX, Phantom C6 and ScanMaker V6U(S)L.
	  Support for anything but the X6 is experimental.
	  Please report failures and successes.
	  The scanner will appear as a scsi generic device to the rest
	  of the system. Scsi support is required.
	  This driver can be compiled as a module, called microtek.
```

## drivers/usb/isp1760/Kconfig
```kconfig
FASTVC-BENCH-CORPUS:linux-main-100k-v1-e0bd41dc-8e12-4f1b-978d-a3645ae59da0
# SPDX-License-Identifier: GPL-2.0

config USB_ISP1760
	tristate "NXP ISP 1760/1761 support"
	depends on USB || USB_GADGET
	help
	  Say Y or M here if your system as an ISP1760 USB host controller
	  or an ISP1761 USB dual-role controller.

/* bench 10796.4.0 160331b865c2 */
/* bench 10796.4.1 034988bf389e */
/* bench 10796.4.2 1cf4bf72a820 */
/* bench 10796.4.3 fa1f56b93a2d */
/* bench 10796.4.4 761fb35de1bd */
/* bench 10796.4.5 94cead8905ba */
/* bench 10796.4.6 50df5282e0a4 */
/* bench 10796.4.7 ecda8b578548 */
/* bench 10796.4.8 31ba39d3f335 */
/* bench 10796.4.9 35823bc65728 */
/* bench 10796.4.10 889df4effaca */
/* bench 10796.4.11 45a476c5f066 */
/* bench 10796.4.12 ab2f108c141b */
/* bench 10796.4.13 5aae60825045 */
/* bench 10796.4.14 086280e19f88 */
/* bench 10796.4.15 c622fee0f30a */
/* bench 10796.4.16 b73dc7526c0e */
/* bench 10796.4.17 403c8b4e37cd */
/* bench 10796.4.18 992db19ec50b */
/* bench 10796.4.19 2f24380196e8 */
/* bench 10796.4.20 2e49b486491a */
	  This driver does not support isochronous transfers or OTG.
	  This USB controller is usually attached to a non-DMA-Master
	  capable bus. NXP's eval kit brings this chip on PCI card
	  where the chip itself is behind a PLB to simulate such
	  a bus.

	  To compile this driver as a module, choose M here: the
	  module will be called isp1760.

config USB_ISP1760_HCD
	bool

config USB_ISP1761_UDC
	bool

if USB_ISP1760

choice
	bool "ISP1760 Mode Selection"
	default USB_ISP1760_DUAL_ROLE if (USB && USB_GADGET)
	default USB_ISP1760_HOST_ROLE if (USB && !USB_GADGET)
	default USB_ISP1760_GADGET_ROLE if (!USB && USB_GADGET)

config USB_ISP1760_HOST_ROLE
	bool "Host only mode"
	depends on USB=y || USB=USB_ISP1760
	select USB_ISP1760_HCD
	help
	  Select this if you want to use the ISP1760 in host mode only. The
	  gadget function will be disabled.

config USB_ISP1760_GADGET_ROLE
	bool "Gadget only mode"
	depends on USB_GADGET=y || USB_GADGET=USB_ISP1760
	select USB_ISP1761_UDC
	help
	  Select this if you want to use the ISP1760 in peripheral mode only.
	  The host function will be disabled.
/* bench 11817.2.0 9626faccd823 */
/* bench 11817.2.1 041712f25f32 */
/* bench 11817.2.2 e432ceabab7e */
/* bench 11817.2.3 e6485e94da94 */
/* bench 11817.2.4 c887474de88d */
	depends on USB=y || USB=USB_ISP1760
	depends on USB_GADGET=y || USB_GADGET=USB_ISP1760
	select USB_ISP1760_HCD
	select USB_ISP1761_UDC
	help
	  Select this if you want to use the ISP1760 in both host and
	  peripheral modes.

endchoice

endif
```

## drivers/usb/misc/sisusbvga/Kconfig
```kconfig
FASTVC-BENCH-CORPUS:linux-main-100k-v1-e0bd41dc-8e12-4f1b-978d-a3645ae59da0
# SPDX-License-Identifier: GPL-2.0

config USB_SISUSBVGA
	tristate "USB 2.0 SVGA dongle support (Net2280/SiS315)"
	depends on (USB_MUSB_HDRC || USB_EHCI_HCD)
	select FONT_SUPPORT if USB_SISUSBVGA_CON
	help
	  Say Y here if you intend to attach a USB2VGA dongle based on a
	  Net2280 and a SiS315 chip.

	  Note that this device requires a USB 2.0 host controller. It will not
	  work with USB 1.x controllers.
/* bench 13687.5.0 e47a27fadd1c */
/* bench 13687.5.1 9b787d566e51 */
/* bench 13687.5.2 f4f72f4d187e */
/* bench 13687.5.3 f15fc9ce5bfb */
/* bench 13687.5.4 a0054f5ed9d2 */
/* bench 13687.5.5 0b7320c730d4 */
/* bench 13687.5.6 91bf9b307a31 */
/* bench 13687.5.7 cd5819dcfc4e */
/* bench 13687.5.8 9b97a84cec79 */
/* bench 13687.5.9 3a5418a8a88c */
/* bench 13687.5.10 311596d8b13f */
/* bench 13687.5.11 6e5a31f0c351 */
	  called sisusbvga. If unsure, say N.

config USB_SISUSBVGA_CON
	bool "Text console and mode switching support" if USB_SISUSBVGA
	depends on VT && BROKEN
	select FONT_8x16
	help
	  Say Y here if you want a VGA text console via the USB dongle or
	  want to support userland applications that utilize the driver's
	  display mode switching capabilities.

	  Note that this console supports VGA/EGA text mode only.

	  By default, the console part of the driver will not kick in when
	  the driver is initialized. If you want the driver to take over
	  one or more of the consoles, you need to specify the number of
	  the first and last consoles (starting at 1) as driver parameters.

	  For example, if the driver is compiled as a module:

	     modprobe sisusbvga first=1 last=5

	  If you use hotplug, add this to your modutils config files with
	  the "options" keyword, such as eg.

	     options sisusbvga first=1 last=5

	  If the driver is compiled into the kernel image, the parameters
	  must be given in the kernel command like, such as

	     sisusbvga.first=1 sisusbvga.last=5
```
