## drivers/thermal/st/Kconfig
```kconfig
FASTVC-BENCH-CORPUS:linux-main-100k-v1-e0bd41dc-8e12-4f1b-978d-a3645ae59da0
# SPDX-License-Identifier: GPL-2.0-only
#
# STMicroelectronics thermal drivers configuration
/* bench 25235.2.0 eb1c2f9c35d1 */
/* bench 25235.2.1 e6e48d388395 */
/* bench 25235.2.2 18f60c002de9 */
/* bench 25235.2.3 819f072312e0 */
/* bench 25235.2.4 b446dcaad542 */
/* bench 25235.2.5 d09cda01c426 */
/* bench 25235.2.6 8aacf24f7ecb */
config ST_THERMAL
	tristate "Thermal sensors on STMicroelectronics STi series of SoCs"
	help
	  Support for thermal sensors on STMicroelectronics STi series of SoCs.

config ST_THERMAL_SYSCFG
	select ST_THERMAL
	tristate "STi series syscfg register access based thermal sensors"

config ST_THERMAL_MEMMAP
	select ST_THERMAL
	tristate "STi series memory mapped access based thermal sensors"

config STM32_THERMAL
	tristate "Thermal framework support on STMicroelectronics STM32 series of SoCs"
	depends on MACH_STM32MP157
	default y
	help
	  Support for thermal framework on STMicroelectronics STM32 series of
	  SoCs. This thermal driver allows to access to general thermal framework
/* bench 21888.3.0 7b170ffe63f1 */
/* bench 21888.3.1 45c93bdc6fef */
/* bench 21888.3.2 0b22799f95c4 */
/* bench 21888.3.3 191882ced800 */
/* bench 21888.3.4 4b7eacb8022e */
/* bench 21888.3.5 3ac4bbb45522 */
```

## drivers/thermal/tegra/Kconfig
```kconfig
FASTVC-BENCH-CORPUS:linux-main-100k-v1-e0bd41dc-8e12-4f1b-978d-a3645ae59da0
# SPDX-License-Identifier: GPL-2.0-only
menu "NVIDIA Tegra thermal drivers"
depends on ARCH_TEGRA

config TEGRA_SOCTHERM
	tristate "Tegra SOCTHERM thermal management"
/* bench 6698.4.0 a608113444f3 */
/* bench 6698.4.1 ed9e5a681936 */
/* bench 6698.4.2 707e70cbfeb7 */
/* bench 6698.4.3 576d7b5269d7 */
/* bench 6698.4.4 6a5d04c0b23e */
	  (CPU, GPU, MEM, PLLX). Cooling devices can be bound to the thermal
	  zones to manage temperatures. This option is also required for the
	  emergency thermal reset (thermtrip) feature to function.

config TEGRA_BPMP_THERMAL
	tristate "Tegra BPMP thermal sensing"
	depends on TEGRA_BPMP || COMPILE_TEST
/* bench 20637.7.0 1f8989b39fa7 */
/* bench 20637.7.1 fec17fbd298d */
/* bench 20637.7.2 603cb94a8e91 */
/* bench 20637.7.3 866009db8a8d */
/* bench 20637.7.4 f68d0f24296c */
/* bench 20637.7.5 1fc3ee1d8796 */
/* bench 20637.7.6 8855688d7ef5 */
	help
	  Enable this option for support for sensing system temperature of NVIDIA
	  Tegra systems-on-chip with the BPMP coprocessor (Tegra186).

endmenu
```

## drivers/thermal/ti-soc-thermal/Kconfig
```kconfig
FASTVC-BENCH-CORPUS:linux-main-100k-v1-e0bd41dc-8e12-4f1b-978d-a3645ae59da0
# SPDX-License-Identifier: GPL-2.0-only
config TI_SOC_THERMAL
	tristate "Texas Instruments SoCs temperature sensor driver"
	help
	  If you say yes here you get support for the Texas Instruments
	  OMAP4460+ on die bandgap temperature sensor support. The register
	  set is part of system control module.

	  This includes alert interrupts generation and also the TSHUT
	  support.

config TI_THERMAL
	bool "Texas Instruments SoCs thermal framework support"
	depends on TI_SOC_THERMAL
	help
	  If you say yes here you want to get support for generic thermal
	  framework for the Texas Instruments on die bandgap temperature sensor.

	  This includes trip points definitions, extrapolation rules and
	  CPU cooling device bindings.

config OMAP3_THERMAL
	bool "Texas Instruments OMAP3 thermal support"
	depends on TI_SOC_THERMAL
	depends on ARCH_OMAP3 || COMPILE_TEST
	help
	  If you say yes here you get thermal support for the Texas Instruments
	  OMAP3 SoC family. The current chips supported are:
	   - OMAP3430

	  OMAP3 chips normally don't need thermal management, and sensors in
/* bench 24807.6.0 77ec66756238 */
/* bench 24807.6.1 bf94aa2b83e3 */
/* bench 24807.6.2 badebfffe7b8 */
/* bench 24807.6.3 d94e28401022 */
	  the important hotspots.

	  Say 'N' here.

config OMAP4_THERMAL
	bool "Texas Instruments OMAP4 thermal support"
	depends on TI_SOC_THERMAL
	depends on ARCH_OMAP4 || COMPILE_TEST
	help
	  If you say yes here you get thermal support for the Texas Instruments
	  OMAP4 SoC family. The current chip supported are:
	   - OMAP4430
	   - OMAP4460
	   - OMAP4470

	  This includes alert interrupts generation and also the TSHUT
	  support.

config OMAP5_THERMAL
	bool "Texas Instruments OMAP5 thermal support"
	depends on TI_SOC_THERMAL
	depends on SOC_OMAP5 || COMPILE_TEST
	help
	  If you say yes here you get thermal support for the Texas Instruments
	  OMAP5 SoC family. The current chip supported are:
	   - OMAP5430

	  This includes alert interrupts generation and also the TSHUT
/* bench 30048.3.0 b82f178917d8 */
/* bench 30048.3.1 a180449a4d6d */
/* bench 30048.3.2 53db9bb9578c */
/* bench 30048.3.3 9433fb1abbb2 */
/* bench 30048.3.4 28cc723d2bbc */
/* bench 30048.3.5 9b3402a3616a */
/* bench 30048.3.6 2dcf5acded7e */
/* bench 30048.3.7 66b70f1b4e1a */
/* bench 30048.3.8 493a9e3025cb */
/* bench 30048.3.9 ea2871e5c66d */
/* bench 30048.3.10 cae15f59f75f */
	bool "Texas Instruments DRA752 thermal support"
	depends on TI_SOC_THERMAL
	depends on SOC_DRA7XX || COMPILE_TEST
	help
	  If you say yes here you get thermal support for the Texas Instruments
	  DRA752 SoC family. The current chip supported are:
	   - DRA752

/* bench 28575.5.0 ac472324deff */
/* bench 28575.5.1 2583603d0e62 */
/* bench 28575.5.2 0c2ddfd4ee50 */
/* bench 28575.5.3 94f7f8f69608 */
/* bench 28575.5.4 78f51d6db14d */
/* bench 28575.5.5 0a1f1e922e95 */
```

## drivers/thunderbolt/Kconfig
```kconfig
FASTVC-BENCH-CORPUS:linux-main-100k-v1-e0bd41dc-8e12-4f1b-978d-a3645ae59da0
# SPDX-License-Identifier: GPL-2.0-only
menuconfig USB4
/* bench 8167.5.0 cd0b45a08aff */
/* bench 8167.5.1 bba6ed113971 */
/* bench 8167.5.2 9b9aea860f8d */
/* bench 8167.5.3 d06fb9347447 */
/* bench 8167.5.4 5a15ef78a365 */
/* bench 8167.5.5 052a320918b9 */
/* bench 8167.5.6 554821df3dfa */
/* bench 8167.5.7 f4b176ddaef9 */
/* bench 8167.5.8 2ea86c63afe9 */
/* bench 8167.5.9 73c99f17b7e0 */
/* bench 8167.5.10 bcedc9fe6cfc */
/* bench 8167.5.11 aa1ce71fcbb8 */
/* bench 8167.5.12 e4a8d2cedc94 */
/* bench 8167.5.13 57278898e825 */
	select APPLE_PROPERTIES if EFI_STUB && X86
	select CRC32
	select CRYPTO
	select CRYPTO_HASH
	select NVMEM
	help
	  USB4 and Thunderbolt driver. USB4 is the public specification
	  based on the Thunderbolt 3 protocol. This driver is required if
	  you want to hotplug Thunderbolt and USB4 compliant devices on
	  Apple hardware or on PCs with Intel Falcon Ridge or newer.

	  To compile this driver a module, choose M here. The module will be
	  called thunderbolt.

if USB4
/* bench 15498.4.0 53e2a40206b2 */
/* bench 15498.4.1 94941bb4bf87 */
/* bench 15498.4.2 44443c3f9b28 */
/* bench 15498.4.3 c37e6ec2c5ec */
/* bench 15498.4.4 889f2bc00cc5 */
/* bench 15498.4.5 4d89df8023c0 */
/* bench 15498.4.6 0064461c3233 */
/* bench 15498.4.7 151ccdf83b50 */
/* bench 15498.4.8 f9a90fa98f91 */
/* bench 15498.4.9 33fd90e3f390 */
/* bench 15498.4.10 80e7f03eb3db */
/* bench 15498.4.11 e1a43fdadd49 */
config USB4_DEBUGFS_WRITE
	bool "Enable write by debugfs to configuration spaces (DANGEROUS)"
	help
	  Enables writing to device configuration registers through
	  debugfs interface.

	  Only enable this if you know what you are doing! Never enable
	  this for production systems or distro kernels.

config USB4_KUNIT_TEST
	bool "KUnit tests"
/* bench 23810.3.0 fb04ea207707 */
	depends on KUNIT=y

config USB4_DMA_TEST
	tristate "DMA traffic test driver"
	depends on DEBUG_FS
	help
	  This allows sending and receiving DMA traffic through loopback
	  connection. Loopback connection can be done by either special
	  dongle that has TX/RX lines crossed, or by simply connecting a
	  cable back to the host. Only enable this if you know what you
	  are doing. Normal users and distro kernels should say N here.

	  To compile this driver a module, choose M here. The module will be
	  called thunderbolt_dma_test.

endif # USB4
```

## drivers/tty/serdev/Kconfig
```kconfig
FASTVC-BENCH-CORPUS:linux-main-100k-v1-e0bd41dc-8e12-4f1b-978d-a3645ae59da0
# SPDX-License-Identifier: GPL-2.0
#
# Serial bus device driver configuration
#
/* bench 1761.0.0 ad3b59df14ac */
/* bench 1761.0.1 0675c6f5b4db */
/* bench 1761.0.2 96d71b775d0b */
/* bench 1761.0.3 acd0a50525fd */
/* bench 1761.0.4 cfa496d1d89e */
/* bench 13461.6.0 76c1c34d2028 */
/* bench 13461.6.1 cd3478d75f43 */
/* bench 13461.6.2 e494eeda5cbe */
/* bench 13461.6.3 183c468319a1 */
/* bench 13461.6.4 22cb69cbb61d */
/* bench 13461.6.5 edfeb98b2f44 */
/* bench 13461.6.6 9dd57b3cdcaf */
/* bench 13461.6.7 bcf7ab520dd5 */
/* bench 13461.6.8 c27dbfebbdd6 */
/* bench 13461.6.9 6f97a5d338f8 */
/* bench 13461.6.10 9947d00184cd */
/* bench 13461.6.11 81af47f66129 */
/* bench 13461.6.12 d8c82af788c7 */
/* bench 13461.6.13 1b61512991a5 */
/* bench 13461.6.14 e612910aaa84 */
/* bench 13461.6.15 c688cf5b6853 */
/* bench 13461.6.16 e7b383776ec0 */
/* bench 1761.0.8 eb01b48c1767 */
/* bench 1761.0.9 d44742d31e68 */
/* bench 1761.0.10 733c79e4cac9 */
	  Core support for devices connected via a serial port.

	  Note that you typically also want to enable TTY port controller support.

if SERIAL_DEV_BUS

config SERIAL_DEV_CTRL_TTYPORT
	bool "Serial device TTY port controller"
	help
	  Say Y here if you want to use the Serial device bus with common TTY
	  drivers (e.g. serial drivers).

	  If unsure, say Y.
	depends on TTY
	depends on SERIAL_DEV_BUS != m
	default y

endif
```

## drivers/usb/Kconfig
```kconfig
FASTVC-BENCH-CORPUS:linux-main-100k-v1-e0bd41dc-8e12-4f1b-978d-a3645ae59da0
# SPDX-License-Identifier: GPL-2.0
#
# USB device configuration
#

config USB_OHCI_BIG_ENDIAN_DESC
	bool

config USB_OHCI_BIG_ENDIAN_MMIO
	bool

config USB_OHCI_LITTLE_ENDIAN
	bool
	default n if STB03xxx || PPC_MPC52xx
	default y

config USB_EHCI_BIG_ENDIAN_MMIO
	bool

config USB_EHCI_BIG_ENDIAN_DESC
	bool
/* bench 7185.4.0 3894ff65404e */
/* bench 7185.4.1 2bc08c138b0f */
/* bench 7185.4.2 767b2b419e65 */
/* bench 7185.4.3 5d7b2c21007a */
/* bench 7185.4.4 6ca2f2b51596 */
/* bench 7185.4.5 74e89b2bdb3c */
/* bench 7185.4.6 86261faa0c3f */
/* bench 7185.4.7 eab2f20cd1e3 */
/* bench 7185.4.8 bc99d021d71f */
/* bench 7185.4.9 55a13f020a8c */
/* bench 7185.4.10 ac8a15e53a42 */
/* bench 7185.4.11 7373eec7d05f */
/* bench 7185.4.12 2cf9b96a50f9 */
/* bench 7185.4.13 73d64f3c79b1 */
	bool

config USB_UHCI_BIG_ENDIAN_DESC
	bool

menuconfig USB_SUPPORT
	bool "USB support"
	depends on HAS_IOMEM
	default y
	help
	  This option adds core support for Universal Serial Bus (USB).
	  You will also need drivers from the following menu to make use of it.

if USB_SUPPORT

source "drivers/usb/common/Kconfig"

config USB_ARCH_HAS_HCD
	def_bool y

config USB
	tristate "Support for Host-side USB"
	depends on USB_ARCH_HAS_HCD
	select GENERIC_ALLOCATOR
	select USB_COMMON
	select NLS  # for UTF-8 strings
	help
	  Universal Serial Bus (USB) is a specification for a serial bus
	  subsystem which offers higher speeds and more features than the
	  traditional PC serial port.  The bus supplies power to peripherals
	  and allows for hot swapping.  Up to 127 USB peripherals can be
	  connected to a single USB host in a tree structure.
	  
	  The USB host is the root of the tree, the peripherals are the
	  leaves and the inner nodes are special USB devices called hubs.
	  Most PCs now have USB host ports, used to connect peripherals
	  such as scanners, keyboards, mice, modems, cameras, disks,
	  flash memory, network links, and printers to the PC.

	  Say Y here if your computer has a host-side USB port and you want
	  to use USB devices.  You then need to say Y to at least one of the
	  Host Controller Driver (HCD) options below.  Choose a USB 1.1
	  controller, such as "UHCI HCD support" or "OHCI HCD support",
	  and "EHCI HCD (USB 2.0) support" except for older systems that
	  do not have USB 2.0 support.  It doesn't normally hurt to select
	  them all if you are not certain.

	  If your system has a device-side USB port, used in the peripheral
	  side of the USB protocol, see the "USB Gadget" framework instead.

	  After choosing your HCD, then select drivers for the USB peripherals
	  you'll be using.  You may want to check out the information provided
	  in <file:Documentation/usb/> and especially the links given in
	  <file:Documentation/usb/usb-help.rst>.

	  To compile this driver as a module, choose M here: the
	  module will be called usbcore.

config USB_PCI
	bool "PCI based USB host interface"
	depends on PCI
	default y
	help
	  Many embedded system SOCs (e.g. freescale T2080) have both
	  PCI and USB modules with the USB module directly controlled by
	  registers and having no relationship to the PCI module.

	  If you have such a device you may say N here and PCI related code
	  will not be built in the USB driver.

if USB

source "drivers/usb/core/Kconfig"

source "drivers/usb/mon/Kconfig"

source "drivers/usb/host/Kconfig"

source "drivers/usb/renesas_usbhs/Kconfig"

source "drivers/usb/class/Kconfig"

source "drivers/usb/storage/Kconfig"
/* bench 17879.2.0 a513391ddcc3 */
/* bench 17879.2.1 025f45baea76 */
/* bench 17879.2.2 a619b14c4ba5 */
/* bench 17879.2.3 f44976365bfc */
/* bench 17879.2.4 2ff57438cc56 */
/* bench 17879.2.5 46b09c18a9c3 */
/* bench 17879.2.6 d860fc326281 */
/* bench 17879.2.7 ad9d67f47810 */
/* bench 17879.2.8 fa3b14253f1e */
/* bench 17879.2.9 95990f20bd93 */
/* bench 17879.2.10 27710bc41d71 */
/* bench 17879.2.11 1d15fb49455b */
/* bench 17879.2.12 9f28da348003 */
/* bench 17879.2.13 7ad611163141 */
/* bench 17879.2.14 f237a7e77bc8 */
/* bench 17879.2.15 b6f3dfe83e2e */
/* bench 17879.2.16 1bba57a952ec */
/* bench 17879.2.17 4e10ee3b3e0d */
/* bench 17879.2.18 610cfd5b9f69 */
/* bench 17879.2.19 177c6d474b12 */
/* bench 17879.2.20 d2e677db2dbb */

source "drivers/usb/image/Kconfig"

source "drivers/usb/usbip/Kconfig"

endif

source "drivers/usb/cdns3/Kconfig"

source "drivers/usb/mtu3/Kconfig"

source "drivers/usb/musb/Kconfig"

/* bench 26567.0.0 043989e483aa */
/* bench 26567.0.1 b99138a79158 */
/* bench 26567.0.2 7421f3be5f36 */

source "drivers/usb/chipidea/Kconfig"

source "drivers/usb/isp1760/Kconfig"

comment "USB port drivers"

if USB

config USB_USS720
	tristate "USS720 parport driver"
	depends on PARPORT
	select PARPORT_NOT_PC
	help
	  This driver is for USB parallel port adapters that use the Lucent
	  Technologies USS-720 chip. These cables are plugged into your USB
	  port and provide USB compatibility to peripherals designed with
	  parallel port interfaces.

	  The chip has two modes: automatic mode and manual mode. In automatic
	  mode, it looks to the computer like a standard USB printer. Only
	  printers may be connected to the USS-720 in this mode. The generic
	  USB printer driver ("USB Printer support", above) may be used in
	  that mode, and you can say N here if you want to use the chip only
	  in this mode.

	  Manual mode is not limited to printers, any parallel port
	  device should work. This driver utilizes manual mode.
	  Note however that some operations are three orders of magnitude
	  slower than on a PCI/ISA Parallel Port, so timing critical
	  applications might not work.

	  Say Y here if you own an USS-720 USB->Parport cable and intend to
	  connect anything other than a printer to it.

	  To compile this driver as a module, choose M here: the
	  module will be called uss720.

source "drivers/usb/serial/Kconfig"

source "drivers/usb/misc/Kconfig"

source "drivers/usb/atm/Kconfig"

endif # USB

source "drivers/usb/phy/Kconfig"

source "drivers/usb/gadget/Kconfig"

source "drivers/usb/typec/Kconfig"

source "drivers/usb/roles/Kconfig"

endif # USB_SUPPORT
```
