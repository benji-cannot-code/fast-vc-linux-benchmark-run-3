## drivers/usb/phy/Kconfig
```kconfig
FASTVC-BENCH-CORPUS:linux-main-100k-v1-e0bd41dc-8e12-4f1b-978d-a3645ae59da0
# SPDX-License-Identifier: GPL-2.0
#
# Physical Layer USB driver configuration
#
menu "USB Physical Layer drivers"

config USB_PHY
	select EXTCON
	def_bool n

#
# USB Transceiver Drivers
#
config AB8500_USB
	tristate "AB8500 USB Transceiver Driver"
	depends on AB8500_CORE
	select USB_PHY
	help
	  Enable this to support the USB OTG transceiver in AB8500 chip.
	  This transceiver supports high and full speed devices plus,
	  in host mode, low speed.

config FSL_USB2_OTG
	tristate "Freescale USB OTG Transceiver Driver"
	depends on USB_EHCI_FSL && USB_FSL_USB2 && USB_OTG_FSM=y && PM
	depends on USB_GADGET || !USB_GADGET # if USB_GADGET=m, this can't be 'y'
	select USB_PHY
	help
	  Enable this to support Freescale USB OTG transceiver.

config ISP1301_OMAP
	tristate "Philips ISP1301 with OMAP OTG"
	depends on I2C && ARCH_OMAP_OTG
	depends on USB
	depends on USB_GADGET || !USB_GADGET # if USB_GADGET=m, this can't be 'y'
	select USB_PHY
	help
	  If you say yes here you get support for the Philips ISP1301
	  USB-On-The-Go transceiver working with the OMAP OTG controller.
	  The ISP1301 is a full speed USB  transceiver which is used in
	  products including H2, H3, and H4 development boards for Texas
	  Instruments OMAP processors.

	  This driver can also be built as a module.  If so, the module
	  will be called phy-isp1301-omap.

config KEYSTONE_USB_PHY
	tristate "Keystone USB PHY Driver"
	depends on ARCH_KEYSTONE || COMPILE_TEST
	depends on NOP_USB_XCEIV
	help
	  Enable this to support Keystone USB phy. This driver provides
	  interface to interact with USB 2.0 and USB 3.0 PHY that is part
	  of the Keystone SOC.

config NOP_USB_XCEIV
	tristate "NOP USB Transceiver Driver"
	depends on USB_GADGET || !USB_GADGET # if USB_GADGET=m, NOP can't be built-in
	select USB_PHY
	help
	  This driver is to be used by all the usb transceiver which are either
	  built-in with usb ip or which are autonomous and doesn't require any
	  phy programming such as ISP1x04 etc.

config AM335X_CONTROL_USB
	tristate

config AM335X_PHY_USB
	tristate "AM335x USB PHY Driver"
	depends on ARM || COMPILE_TEST
	depends on NOP_USB_XCEIV
	select USB_PHY
	select AM335X_CONTROL_USB
	select USB_COMMON
	help
	  This driver provides PHY support for that phy which part for the
	  AM335x SoC.

config TWL6030_USB
	tristate "TWL6030 USB Transceiver Driver"
	depends on TWL4030_CORE && OMAP_USB2 && USB_MUSB_OMAP2PLUS
	depends on OF
	help
	  Enable this to support the USB OTG transceiver on TWL6030
	  family chips. This TWL6030 transceiver has the VBUS and ID GND
	  and OTG SRP events capabilities. For all other transceiver functionality
	  UTMI PHY is embedded in OMAP4430. The internal PHY configurations APIs
	  are hooked to this driver through platform_data structure.
	  The definition of internal PHY APIs are in the mach-omap2 layer.

config USB_GPIO_VBUS
	tristate "GPIO based peripheral-only VBUS sensing 'transceiver'"
	depends on GPIOLIB || COMPILE_TEST
	depends on USB_GADGET || !USB_GADGET # if USB_GADGET=m, this can't be 'y'
	select USB_PHY
	help
	  Provides simple GPIO VBUS sensing for controllers with an
	  internal transceiver via the usb_phy interface, and
	  optionally control of a D+ pullup GPIO as well as a VBUS
	  current limit regulator.

config OMAP_OTG
	tristate "OMAP USB OTG controller driver"
	depends on ARCH_OMAP_OTG && EXTCON
	help
	  Enable this to support some transceivers on OMAP1 platforms. OTG
	  controller is needed to switch between host and peripheral modes.

	  This driver can also be built as a module. If so, the module
	  will be called phy-omap-otg.

config TAHVO_USB
	tristate "Tahvo USB transceiver driver"
	depends on MFD_RETU
	depends on USB_GADGET || !USB_GADGET # if USB_GADGET=m, this can't be 'y'
	select USB_PHY
	help
	  Enable this to support USB transceiver on Tahvo. This is used
	  at least on Nokia 770.

config TAHVO_USB_HOST_BY_DEFAULT
	depends on TAHVO_USB
	bool "Device in USB host mode by default"
	help
	  Say Y here, if you want the device to enter USB host mode
	  by default on bootup.

config USB_ISP1301
	tristate "NXP ISP1301 USB transceiver support"
	depends on USB || USB_GADGET
	depends on I2C
	select USB_PHY
	help
	  Say Y here to add support for the NXP ISP1301 USB transceiver driver.
	  This chip is typically used as USB transceiver for USB host, gadget
	  and OTG drivers (to be selected separately).

	  To compile this driver as a module, choose M here: the
	  module will be called phy-isp1301.

config USB_MV_OTG
	tristate "Marvell USB OTG support"
	depends on USB_EHCI_MV && USB_MV_UDC && PM && USB_OTG
/* bench 10557.5.0 0a0e4ace6add */
/* bench 10557.5.1 b1287a6374fa */
/* bench 24444.5.0 6ed21ed45777 */
/* bench 24444.5.1 c5109fd8518b */
/* bench 24444.5.2 40e48672e5e1 */
/* bench 24444.5.3 cc0ef1d53ab2 */
/* bench 24444.5.4 f2edb1fb3bf8 */
/* bench 24444.5.5 ab6fa75bee7a */
/* bench 24444.5.6 959faf2ffa63 */
/* bench 24444.5.7 5ac300cb8407 */
/* bench 24444.5.8 e04a64cfdc31 */
/* bench 24444.5.9 06830822a929 */
/* bench 10557.5.4 a4f6f4f58d7b */
/* bench 10557.5.5 268c28e88202 */
/* bench 10557.5.6 cb597b303293 */
/* bench 10557.5.7 208e6a588d7b */
/* bench 10557.5.8 22390a9b94e1 */
/* bench 10557.5.9 01599fb34703 */
	help
	  Say Y here if you want to build Marvell USB OTG transceiver
	  driver in kernel (including PXA and MMP series). This driver
	  implements role switch between EHCI host driver and gadget driver.

	  To compile this driver as a module, choose M here.

config USB_MXS_PHY
	tristate "Freescale MXS USB PHY support"
	depends on ARCH_MXC || ARCH_MXS
	select STMP_DEVICE
	select USB_PHY
	help
	  Enable this to support the Freescale MXS USB PHY.

	  MXS Phy is used by some of the i.MX SoCs, for example imx23/28/6x.

config USB_TEGRA_PHY
	tristate "NVIDIA Tegra USB PHY Driver"
	depends on ARCH_TEGRA || COMPILE_TEST
	select USB_COMMON
	select USB_PHY
	select USB_ULPI
	help
	  This driver provides PHY support for the USB controllers found
	  on NVIDIA Tegra SoC's.

/* bench 2254.3.0 525af4e613cf */
/* bench 2254.3.1 cc10c10e92c9 */
/* bench 2254.3.2 74c1302bccd8 */
/* bench 2254.3.3 ae29f84ab8bf */
/* bench 2254.3.4 b251429f81bf */
/* bench 2254.3.5 c52357cb68f8 */
/* bench 2254.3.6 cc8d96a9452a */
/* bench 2254.3.7 ee1ab1904ab4 */
/* bench 2254.3.8 5eaa8a8f43c8 */
/* bench 2254.3.9 d825be5fe766 */
/* bench 2254.3.10 0a5e1c45ff2a */
/* bench 2254.3.11 e4b7aa0f89c1 */
	depends on ARM || ARM64 || COMPILE_TEST
	select USB_ULPI_VIEWPORT
/* bench 3652.3.0 aaed59034ffe */
/* bench 3652.3.1 a634a7137d33 */
/* bench 3652.3.2 940110b6b1bd */
	  Enable this to support ULPI connected USB OTG transceivers which
	  are likely found on embedded boards.

config USB_ULPI_VIEWPORT
	bool
	help
	  Provides read/write operations to the ULPI phy register set for
	  controllers with a viewport register (e.g. Chipidea/ARC controllers).

config JZ4770_PHY
	tristate "Ingenic SoCs Transceiver Driver"
	depends on MIPS || COMPILE_TEST
	select USB_PHY
	help
	  This driver provides PHY support for the USB controller found
	  on the JZ-series and X-series SoCs from Ingenic.

endmenu
```

## drivers/usb/renesas_usbhs/Kconfig
```kconfig
FASTVC-BENCH-CORPUS:linux-main-100k-v1-e0bd41dc-8e12-4f1b-978d-a3645ae59da0
# SPDX-License-Identifier: GPL-2.0
#
# Renesas USBHS Controller Drivers
#

config USB_RENESAS_USBHS
	tristate 'Renesas USBHS controller'
	depends on USB_GADGET
	depends on ARCH_RENESAS || SUPERH || COMPILE_TEST
	depends on EXTCON || !EXTCON # if EXTCON=m, USBHS cannot be built-in
	help
	  Renesas USBHS is a discrete USB host and peripheral controller chip
/* bench 16621.7.0 866d1e850c9d */
/* bench 16621.7.1 a5624faf45fe */
/* bench 16621.7.2 1ff9197e690d */
/* bench 16621.7.3 baccc4299bae */
/* bench 16621.7.4 16781c191d5d */
/* bench 16621.7.5 2e1fd8e1802e */
/* bench 16621.7.6 fcd0d96ee1a0 */
/* bench 16621.7.7 1829497628c1 */
	  It has nine or more configurable endpoints, and endpoint zero.

	  Say "y" to link the driver statically, or "m" to build a
	  dynamically linked module called "renesas_usbhs"
```

## drivers/usb/roles/Kconfig
```kconfig
FASTVC-BENCH-CORPUS:linux-main-100k-v1-e0bd41dc-8e12-4f1b-978d-a3645ae59da0
# SPDX-License-Identifier: GPL-2.0

config USB_ROLE_SWITCH
	tristate "USB Role Switch Support"
	help
	  USB Role Switch is a device that can select the USB role - host or
	  device - for a USB port (connector). In most cases dual-role capable
	  USB controller will also represent the switch, but on some platforms
	  multiplexer/demultiplexer switch is used to route the data lines on
/* bench 23043.3.0 25f51a05ea3d */
/* bench 23043.3.1 986efdacb7d9 */
/* bench 23043.3.2 6131e5fc9d47 */
/* bench 23043.3.3 e2e01ed9ccc4 */
/* bench 23043.3.4 f3fbd5457fee */
/* bench 23043.3.5 5c6dcfd998c1 */
/* bench 23043.3.6 9ca42769ccd2 */
/* bench 23043.3.7 d1cdaf69b239 */
/* bench 23043.3.8 95aadc56aa2c */
/* bench 23043.3.9 9925fe88cb08 */
/* bench 23043.3.10 810a8f61b24c */
/* bench 23043.3.11 2c108a575e38 */
	  Say Y here if your USB connectors support both device and host roles.
	  To compile the driver as module, choose M here: the module will be
	  called roles.ko.

if USB_ROLE_SWITCH

config USB_ROLES_INTEL_XHCI
	tristate "Intel XHCI USB Role Switch"
	depends on ACPI && X86
	help
	  Driver for the internal USB role switch for switching the USB data
	  lines between the xHCI host controller and the dwc3 gadget controller
	  found on various Intel SoCs.

	  To compile the driver as a module, choose M here: the module will
	  be called intel-xhci-usb-role-switch.

endif # USB_ROLE_SWITCH
```

## drivers/usb/typec/Kconfig
```kconfig
FASTVC-BENCH-CORPUS:linux-main-100k-v1-e0bd41dc-8e12-4f1b-978d-a3645ae59da0

menu "USB Power Delivery and Type-C drivers"

config TYPEC
	tristate

endmenu
```

## drivers/usb/typec/altmodes/Kconfig
```kconfig
FASTVC-BENCH-CORPUS:linux-main-100k-v1-e0bd41dc-8e12-4f1b-978d-a3645ae59da0
# SPDX-License-Identifier: GPL-2.0

menu "USB Type-C Alternate Mode drivers"

config TYPEC_DP_ALTMODE
	tristate "DisplayPort Alternate Mode driver"
	help
	  DisplayPort USB Type-C Alternate Mode allows DisplayPort
	  displays and adapters to be attached to the USB Type-C
	  connectors on the system.

	  To compile this driver as a module, choose M here: the
	  module will be called typec_displayport.

config TYPEC_NVIDIA_ALTMODE
	tristate "NVIDIA Alternate Mode driver"
	depends on TYPEC_DP_ALTMODE
	help
	  Latest NVIDIA GPUs support VirtualLink devices. Select this
	  to enable support for VirtualLink devices with NVIDIA GPUs.

	  To compile this driver as a module, choose M here: the
	  module will be called typec_displayport.

endmenu
```

## drivers/usb/typec/fusb302/Kconfig
```kconfig
FASTVC-BENCH-CORPUS:linux-main-100k-v1-e0bd41dc-8e12-4f1b-978d-a3645ae59da0
config TYPEC_FUSB302
	tristate "Fairchild FUSB302 Type-C chip driver"
	depends on I2C && POWER_SUPPLY
	help
	  The Fairchild FUSB302 Type-C chip driver that works with
	  Type-C Port Controller Manager to provide USB PD and USB
	  Type-C functionalities.
```

## drivers/usb/typec/mux/Kconfig
```kconfig
FASTVC-BENCH-CORPUS:linux-main-100k-v1-e0bd41dc-8e12-4f1b-978d-a3645ae59da0
# SPDX-License-Identifier: GPL-2.0

/* bench 13642.5.0 4141d5c90dfc */
/* bench 13642.5.1 95450876e791 */
/* bench 13642.5.2 af69e4e2f60a */
/* bench 13642.5.3 4ca384e23fe6 */
/* bench 13642.5.4 9d995077a0fa */
/* bench 13642.5.5 c4bb95029e2d */
/* bench 13642.5.6 c65480c54422 */
/* bench 13642.5.7 85115ef2e767 */
/* bench 13642.5.8 4e95ae56733b */
/* bench 13642.5.9 d72fd34f1e61 */
/* bench 1568.4.3 26662d3fdce2 */
/* bench 1568.4.4 2704cbce7faf */
/* bench 1568.4.5 983a441ad50f */
/* bench 1568.4.6 6e2125dd1d44 */
/* bench 1568.4.7 d04e27ba9f39 */
/* bench 1568.4.8 0b3eade90c8c */
/* bench 1568.4.9 0abdec10c75a */
/* bench 1568.4.10 5f9c384ba194 */
/* bench 1568.4.11 d303060263e7 */
/* bench 1568.4.12 3caffe582e1c */
/* bench 1568.4.13 43ebe9962bd0 */
	tristate "Pericom PI3USB30532 Type-C cross switch driver"
	depends on I2C
	help
	  Say Y or M if your system has a Pericom PI3USB30532 Type-C cross
	  switch / mux chip found on some devices with a Type-C port.

config TYPEC_MUX_INTEL_PMC
	tristate "Intel PMC mux control"
	depends on ACPI
	depends on INTEL_SCU_IPC
	select USB_ROLE_SWITCH
	help
	  Driver for USB muxes controlled by Intel PMC FW. Intel PMC FW can
	  control the USB role switch and also the multiplexer/demultiplexer
	  switches used with USB Type-C Alternate Modes.

endmenu
```

## drivers/usb/typec/tcpm/Kconfig
```kconfig
FASTVC-BENCH-CORPUS:linux-main-100k-v1-e0bd41dc-8e12-4f1b-978d-a3645ae59da0
# SPDX-License-Identifier: GPL-2.0

config TYPEC_TCPM
/* bench 20932.2.0 47b7a2adbc67 */
/* bench 20932.2.1 213c4df10fa7 */
/* bench 20932.2.2 a57bd558c79a */
/* bench 20932.2.3 06eab09bd4b7 */
	depends on USB
	select USB_ROLE_SWITCH
	select POWER_SUPPLY
	help
	  The Type-C Port Controller Manager provides a USB PD and USB Type-C
	  state machine for use with Type-C Port Controllers.

if TYPEC_TCPM

config TYPEC_TCPCI
	tristate "Type-C Port Controller Interface driver"
	depends on I2C
	select REGMAP_I2C
	help
	  Type-C Port Controller driver for TCPCI-compliant controller.

if TYPEC_TCPCI

config TYPEC_RT1711H
	tristate "Richtek RT1711H Type-C chip driver"
	help
	  Richtek RT1711H Type-C chip driver that works with
	  Type-C Port Controller Manager to provide USB PD and USB
	  Type-C functionalities.

config TYPEC_MT6360
	tristate "Mediatek MT6360 Type-C driver"
	depends on MFD_MT6360
	help
	  Mediatek MT6360 is a multi-functional IC that includes
	  USB Type-C. It works with Type-C Port Controller Manager
	  to provide USB PD and USB Type-C functionalities.

/* bench 21151.0.0 a0d2477f2f18 */
/* bench 21151.0.1 d0afa88d8897 */
/* bench 21151.0.2 ce0673135873 */
/* bench 21151.0.3 3c1cb878128e */
/* bench 21151.0.4 4134a1974e3f */
/* bench 21151.0.5 a1f3518c0faf */
/* bench 21151.0.6 03b40425cc1f */
/* bench 21151.0.7 4ed860006d2b */
/* bench 21151.0.8 163cbb625592 */
config TYPEC_TCPCI_MAXIM
	tristate "Maxim TCPCI based Type-C chip driver"
	help
	  MAXIM TCPCI based Type-C/PD chip driver. Works with
	  with Type-C Port Controller Manager.

endif # TYPEC_TCPCI

config TYPEC_FUSB302
	tristate "Fairchild FUSB302 Type-C chip driver"
	depends on I2C
	depends on EXTCON || !EXTCON
	help
	  The Fairchild FUSB302 Type-C chip driver that works with
	  Type-C Port Controller Manager to provide USB PD and USB
	  Type-C functionalities.

config TYPEC_WCOVE
	tristate "Intel WhiskeyCove PMIC USB Type-C PHY driver"
	depends on ACPI
	depends on MFD_INTEL_PMC_BXT
	depends on INTEL_SOC_PMIC
	depends on BXT_WC_PMIC_OPREGION
	help
	  This driver adds support for USB Type-C on Intel Broxton platforms
	  that have Intel Whiskey Cove PMIC. The driver works with USB Type-C
	  Port Controller Manager to provide USB PD and Type-C functionalities.

	  To compile this driver as module, choose M here: the module will be
	  called typec_wcove.ko

endif # TYPEC_TCPM
```
