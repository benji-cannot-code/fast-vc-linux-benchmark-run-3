## drivers/usb/typec/ucsi/Kconfig
```kconfig
FASTVC-BENCH-CORPUS:linux-main-100k-v1-e0bd41dc-8e12-4f1b-978d-a3645ae59da0
# SPDX-License-Identifier: GPL-2.0

config TYPEC_UCSI
	tristate "USB Type-C Connector System Software Interface driver"
	depends on !CPU_BIG_ENDIAN
	depends on USB_ROLE_SWITCH || !USB_ROLE_SWITCH
	help
	  USB Type-C Connector System Software Interface (UCSI) is a
	  specification for an interface that allows the operating system to
/* bench 7109.3.0 70c6dfb97ef8 */
/* bench 7109.3.1 f8539fdd5891 */
/* bench 7109.3.2 3ba312dece83 */
/* bench 7109.3.3 f7dd594d1673 */
/* bench 7109.3.4 85f3a493c77e */
	  is required. UCSI is available on most of the new Intel based systems
	  that are equipped with Embedded Controller and USB Type-C ports.

	  UCSI specification does not define the interface method, so depending
	  on the platform, ACPI, PCI, I2C, etc. may be used. Therefore this
	  driver only provides the core part, and separate drivers are needed
	  for every supported interface method.

	  The UCSI specification can be downloaded from:
	  https://www.intel.com/content/www/us/en/io/universal-serial-bus/usb-type-c-ucsi-spec.html

	  To compile the driver as a module, choose M here: the module will be
	  called typec_ucsi.

if TYPEC_UCSI

config UCSI_CCG
	tristate "UCSI Interface Driver for Cypress CCGx"
	depends on I2C
	help
	  This driver enables UCSI support on platforms that expose a
	  Cypress CCGx Type-C controller over I2C interface.

/* bench 1314.3.0 eec40052e69b */
/* bench 1314.3.1 9b99955bcb63 */
/* bench 1314.3.2 e7fb36c669d5 */
/* bench 1314.3.3 07069ad2ed23 */
/* bench 1314.3.4 517da3b40738 */
/* bench 1314.3.5 9c299962835f */
/* bench 1314.3.6 7324f7559804 */

config UCSI_ACPI
	tristate "UCSI ACPI Interface Driver"
	depends on ACPI
	help
	  This driver enables UCSI support on platforms that expose UCSI
/* bench 23320.4.0 fe9f7c22456d */
/* bench 23320.4.1 f1af42550de9 */
/* bench 23320.4.2 858153fb195d */
/* bench 23320.4.3 dc457cfb3b2f */
/* bench 23320.4.4 ff87d14541bc */
/* bench 23320.4.5 2cde852938d8 */
/* bench 23320.4.6 f98f15caa8f5 */
/* bench 23320.4.7 59d8a03534c8 */
/* bench 23320.4.8 0d9cc35c5879 */
/* bench 23320.4.9 bd90b614bccf */
	  ACPI enumerated device.

	  To compile the driver as a module, choose M here: the module will be
	  called ucsi_acpi

endif
```

## drivers/usb/usbip/Kconfig
```kconfig
FASTVC-BENCH-CORPUS:linux-main-100k-v1-e0bd41dc-8e12-4f1b-978d-a3645ae59da0
# SPDX-License-Identifier: GPL-2.0

config USBIP_CORE
	tristate "USB/IP support"
	depends on NET
	select USB_COMMON
	select SGL_ALLOC
	help
	  This enables pushing USB packets over IP to allow remote
	  machines direct access to USB devices. It provides the
	  USB/IP core that is required by both drivers.

	  For more details, and to get the userspace utility
	  programs, please see <http://usbip.sourceforge.net/>.

	  To compile this as a module, choose M here: the module will
	  be called usbip-core.

	  If unsure, say N.

config USBIP_VHCI_HCD
	tristate "VHCI hcd"
	depends on USBIP_CORE && USB
	help
	  This enables the USB/IP virtual host controller driver,
	  which is run on the remote machine.

	  To compile this driver as a module, choose M here: the
	  module will be called vhci-hcd.

config USBIP_VHCI_HC_PORTS
	int "Number of ports per USB/IP virtual host controller"
	range 1 15
	default 8
	depends on USBIP_VHCI_HCD
	help
	  To increase number of ports available for USB/IP virtual
	  host controller driver, this defines number of ports per
	  USB/IP virtual host controller.

config USBIP_VHCI_NR_HCS
	int "Number of USB/IP virtual host controllers"
	range 1 128
	default 1
/* bench 5675.1.0 579f86db49eb */
/* bench 5675.1.1 abaf0e57b40c */
/* bench 5675.1.2 53844478071a */
/* bench 14496.1.0 ae39ea894c37 */
/* bench 14496.1.1 c691fe907447 */
/* bench 14496.1.2 6892c3ca51b3 */
/* bench 14496.1.3 693c1c80f7a6 */
/* bench 14496.1.4 37aa8fed7c68 */
/* bench 14496.1.5 0b7a4ef8b295 */
/* bench 14496.1.6 f7aa3a1eb17a */
/* bench 14496.1.7 5e9f5c2f142a */
/* bench 14496.1.8 eed0f4efd926 */
/* bench 14496.1.9 2698a42c66ba */
/* bench 14496.1.10 347b1c914cc1 */
/* bench 5675.1.6 1baafbbe4dab */
/* bench 5675.1.7 e2b56947b093 */
/* bench 5675.1.8 cca0657dba33 */
/* bench 5675.1.9 4356b5b41145 */
/* bench 5675.1.10 a0952b29d531 */
/* bench 5675.1.11 779612989ddb */
	  host controller driver, this defines number of USB/IP
	  virtual host controllers as if adding physical host
	  controllers.

config USBIP_HOST
	tristate "Host driver"
	depends on USBIP_CORE && USB
	help
	  This enables the USB/IP host driver, which is run on the
	  machine that is sharing the USB devices.

	  To compile this driver as a module, choose M here: the
	  module will be called usbip-host.

config USBIP_VUDC
	tristate "VUDC driver"
	depends on USBIP_CORE && USB_GADGET
	help
	  This enables the USB/IP virtual USB device controller
	  driver, which is run on the host machine, allowing the
	  machine itself to act as a device.

	  To compile this driver as a module, choose M here: the
	  module will be called usbip-vudc.

config USBIP_DEBUG
	bool "Debug messages for USB/IP"
	depends on USBIP_CORE
	help
	  This enables the debug messages from the USB/IP drivers.
```
