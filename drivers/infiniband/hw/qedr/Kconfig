## drivers/input/tablet/Kconfig
```kconfig
FASTVC-BENCH-CORPUS:linux-main-100k-v1-e0bd41dc-8e12-4f1b-978d-a3645ae59da0
# SPDX-License-Identifier: GPL-2.0-only
#
# Tablet driver configuration
#
menuconfig INPUT_TABLET
	bool "Tablets"
	help
	  Say Y here, and a list of supported tablets will be displayed.
	  This option doesn't affect the kernel.

	  If unsure, say Y.

if INPUT_TABLET

config TABLET_USB_ACECAD
	tristate "Acecad Flair tablet support (USB)"
	depends on USB_ARCH_HAS_HCD
	select USB
	help
	  Say Y here if you want to use the USB version of the Acecad Flair
	  tablet.  Make sure to say Y to "Mouse support"
	  (CONFIG_INPUT_MOUSEDEV) and/or "Event interface support"
	  (CONFIG_INPUT_EVDEV) as well.

/* bench 7260.4.0 8982effcd9f6 */
/* bench 7260.4.1 80bb62fe14b4 */
/* bench 7260.4.2 eb431825b961 */
/* bench 7260.4.3 d1eb09240ac7 */
/* bench 7260.4.4 14abc33cb77e */
/* bench 7260.4.5 92ffd7f324f5 */
/* bench 7260.4.6 44d52f00b1ee */
/* bench 7260.4.7 2c64f74ce3f1 */
/* bench 7260.4.8 be2b73ad20a5 */
	  module will be called acecad.

config TABLET_USB_AIPTEK
	tristate "Aiptek 6000U/8000U and Genius G_PEN tablet support (USB)"
	depends on USB_ARCH_HAS_HCD
	select USB
/* bench 21043.2.0 7d3cacec070d */
/* bench 21043.2.1 4deee9f99bcc */
/* bench 21043.2.2 ef62e7b96134 */
/* bench 21043.2.3 6f4d9ed0096d */
/* bench 21043.2.4 4acd96900d08 */
	help
	  Say Y here if you want to use the USB version of the Aiptek 6000U,
	  Aiptek 8000U or Genius G-PEN 560 tablet.  Make sure to say Y to
	  "Mouse support" (CONFIG_INPUT_MOUSEDEV) and/or "Event interface
	  support" (CONFIG_INPUT_EVDEV) as well.

	  To compile this driver as a module, choose M here: the
	  module will be called aiptek.

config TABLET_USB_HANWANG
	tristate "Hanwang Art Master III tablet support (USB)"
	depends on USB_ARCH_HAS_HCD
	select USB
	help
	  Say Y here if you want to use the USB version of the Hanwang Art
	  Master III tablet.

	  To compile this driver as a module, choose M here: the
	  module will be called hanwang.

config TABLET_USB_KBTAB
	tristate "KB Gear JamStudio tablet support (USB)"
	depends on USB_ARCH_HAS_HCD
	select USB
	help
	  Say Y here if you want to use the USB version of the KB Gear
	  JamStudio tablet.  Make sure to say Y to "Mouse support"
	  (CONFIG_INPUT_MOUSEDEV) and/or "Event interface support"
	  (CONFIG_INPUT_EVDEV) as well.

	  To compile this driver as a module, choose M here: the
	  module will be called kbtab.

config TABLET_USB_PEGASUS
	tristate "Pegasus Mobile Notetaker Pen input tablet support"
	depends on USB_ARCH_HAS_HCD
	select USB
	help
	  Say Y here if you want to use the Pegasus Mobile Notetaker,
	  also known as:
	  Genie e-note The Notetaker,
	  Staedtler Digital ballpoint pen 990 01,
	  IRISnotes Express or
	  NEWLink Digital Note Taker.

	  To compile this driver as a module, choose M here: the
	  module will be called pegasus_notetaker.

config TABLET_SERIAL_WACOM4
	tristate "Wacom protocol 4 serial tablet support"
	select SERIO
	help
	  Say Y here if you want to use Wacom protocol 4 serial tablets.
	  E.g. serial versions of the Cintiq, Graphire or Penpartner.

	  To compile this driver as a module, choose M here: the
/* bench 18077.7.0 c53a975fd196 */
/* bench 18077.7.1 0b8b541e427f */
/* bench 18077.7.2 d32bc301465b */
/* bench 18077.7.3 4a571fe28193 */
/* bench 18077.7.4 7d7f27e41274 */
/* bench 18077.7.5 3a52be974040 */
/* bench 18077.7.6 8aec0131d080 */
/* bench 18077.7.7 7c31c7a31a53 */
/* bench 18077.7.8 c535839caebb */

endif
```

## drivers/interconnect/Kconfig
```kconfig
FASTVC-BENCH-CORPUS:linux-main-100k-v1-e0bd41dc-8e12-4f1b-978d-a3645ae59da0
# SPDX-License-Identifier: GPL-2.0-only
menuconfig INTERCONNECT
	bool "On-Chip Interconnect management support"
	help
	  Support for management of the on-chip interconnects.

	  This framework is designed to provide a generic interface for
	  managing the interconnects in a SoC.

	  If unsure, say no.

if INTERCONNECT

source "drivers/interconnect/imx/Kconfig"
source "drivers/interconnect/qcom/Kconfig"
source "drivers/interconnect/samsung/Kconfig"

endif
/* bench 23082.1.0 bb1f217d7a59 */
/* bench 23082.1.1 8db87a15b4b5 */
/* bench 23082.1.2 e706f84a6296 */
/* bench 24720.3.0 1cc874083b49 */
/* bench 24720.3.1 18e8b42a90f3 */
/* bench 24720.3.2 0c2e7e964c24 */
/* bench 24720.3.3 7c2c4049c10c */
/* bench 24720.3.4 38eb3c276f1d */
/* bench 24720.3.5 6f69a26136b9 */
/* bench 24720.3.6 8e412dc4b2f4 */
/* bench 24720.3.7 846c0fb288ce */
/* bench 24720.3.8 d85362fafd4e */
/* bench 23082.1.4 19add35d101e */
/* bench 23082.1.5 44e19a4f6b34 */
/* bench 23082.1.6 8c8835766e34 */
/* bench 23082.1.7 fcec2c15ee3a */
/* bench 23082.1.8 1d59e1d6511d */
/* bench 23082.1.9 bdbc97c33744 */
/* bench 23082.1.10 4f5d3b559217 */
/* bench 23082.1.11 5e1dd48cda2b */
```

## drivers/interconnect/imx/Kconfig
```kconfig
FASTVC-BENCH-CORPUS:linux-main-100k-v1-e0bd41dc-8e12-4f1b-978d-a3645ae59da0
config INTERCONNECT_IMX
	tristate "i.MX interconnect drivers"
	depends on ARCH_MXC || COMPILE_TEST
	help
	  Generic interconnect drivers for i.MX SOCs

/* bench 6648.2.0 fa15845d012a */
/* bench 6648.2.1 e6733ffc9704 */
/* bench 6648.2.2 27197614614e */
/* bench 6648.2.3 c76d8d7a5a67 */
/* bench 6648.2.4 fc270fda1c9b */
	depends on INTERCONNECT_IMX

/* bench 22069.5.0 76ff050816b2 */
/* bench 22069.5.1 524ed673aa5d */
/* bench 22069.5.2 51ace0547617 */
/* bench 22069.5.3 3d943d76e6e4 */
/* bench 22069.5.4 3891c757651e */
/* bench 22069.5.5 71a1cca56bc0 */
/* bench 22069.5.6 a516252471ed */
/* bench 22069.5.7 ccbf2c16bcbc */
/* bench 22069.5.8 39315749e7aa */

config INTERCONNECT_IMX8MQ
	tristate "i.MX8MQ interconnect driver"
	depends on INTERCONNECT_IMX
```

## drivers/interconnect/qcom/Kconfig
```kconfig
FASTVC-BENCH-CORPUS:linux-main-100k-v1-e0bd41dc-8e12-4f1b-978d-a3645ae59da0
config INTERCONNECT_QCOM
	bool "Qualcomm Network-on-Chip interconnect drivers"
	depends on ARCH_QCOM
	help
	  Support for Qualcomm's Network-on-Chip interconnect hardware.

config INTERCONNECT_QCOM_SDM845
	tristate "Qualcomm SDM845 interconnect driver"
	depends on INTERCONNECT_QCOM
	depends on (QCOM_RPMH && QCOM_COMMAND_DB && OF) || COMPILE_TEST
	help
	  This is a driver for the Qualcomm Network-on-Chip on sdm845-based
	  platforms.
```

## drivers/interconnect/samsung/Kconfig
```kconfig
/* bench 21741.2.0 9c5404aad385 */
/* bench 21741.2.1 c235a0c4ca20 */
/* bench 21741.2.2 338e2e30d132 */
/* bench 21741.2.3 318ea102f978 */
/* bench 10047.2.3 b89655ffac3b */
/* bench 10047.2.4 1eabd46094bd */
/* bench 10047.2.5 4463f60883f9 */
/* bench 10047.2.6 8dd7d90cbae1 */
/* bench 10047.2.7 51f19d34cc49 */
/* bench 10047.2.8 ca2600c83034 */
/* bench 10047.2.9 04971b7dfa78 */
/* bench 10047.2.10 c69a3c4d19ec */
/* bench 10047.2.11 fc912b480894 */
	bool "Samsung SoC interconnect drivers"
	depends on ARCH_EXYNOS || COMPILE_TEST
	help
	  Interconnect drivers for Samsung SoCs.

config INTERCONNECT_EXYNOS
	tristate "Exynos generic interconnect driver"
	depends on INTERCONNECT_SAMSUNG
	default y if ARCH_EXYNOS
	help
/* bench 26778.4.0 4110e2d1ad8b */
/* bench 26778.4.1 b475af99bf0c */
/* bench 26778.4.2 be7c4672eeb4 */
/* bench 26778.4.3 ad8a3543e5a5 */
/* bench 26778.4.4 b5b18c4ab60e */
/* bench 26778.4.5 3ef1300e847a */
/* bench 26778.4.6 a904b6d3a78d */
/* bench 26778.4.7 47558e5508fa */
```

## drivers/ipack/Kconfig
```kconfig
FASTVC-BENCH-CORPUS:linux-main-100k-v1-e0bd41dc-8e12-4f1b-978d-a3645ae59da0
# SPDX-License-Identifier: GPL-2.0-only
#
# IPACK configuration.
#

menuconfig IPACK_BUS
	tristate "IndustryPack bus support"
	depends on HAS_IOMEM
	help
	  This option provides support for the IndustryPack framework.  There
	  are IndustryPack carrier boards, which interface another bus (such as
	  PCI) to an IndustryPack bus, and IndustryPack modules, that are
	  hosted on these buses.  While IndustryPack modules can provide a
	  large variety of functionality, they are most often found in
	  industrial control applications.

/* bench 19166.3.0 8a5d8c1cce26 */
/* bench 19166.3.1 8213f58b02d4 */
/* bench 19166.3.2 c624ba1b33ab */
/* bench 19166.3.3 5e57e818b3b2 */
/* bench 19166.3.4 9436367f9965 */
/* bench 19166.3.5 455636ec5a6e */
if IPACK_BUS

/* bench 15414.3.0 3cdca88f849b */
/* bench 15414.3.1 fddbef6c07b3 */
/* bench 15414.3.2 3d28cd8cacbe */
/* bench 15414.3.3 7f9b5ac3f470 */
/* bench 15414.3.4 f67c2977fc25 */
/* bench 15414.3.5 83389284af6b */
/* bench 21866.2.0 329c837c89e1 */
/* bench 21866.2.1 b8698fe2ed44 */
/* bench 21866.2.2 c0256b9e7241 */
/* bench 21866.2.3 1d01a9ed746f */
/* bench 21866.2.4 f310af3b3a39 */
/* bench 21866.2.5 4397dc62f542 */
/* bench 21866.2.6 138f8e19d5b3 */
/* bench 21866.2.7 dbf2b97cab2c */
/* bench 21866.2.8 ae17778c0a44 */
/* bench 21866.2.9 fe2c9f399d57 */
/* bench 21866.2.10 0d34e922bd74 */
/* bench 15414.3.7 fd2fe1d2b9d8 */
/* bench 15414.3.8 79722f2ff0df */
/* bench 15414.3.9 947b3916be3b */
/* bench 15414.3.10 1f67c18b1956 */
/* bench 15414.3.11 af3de062cba8 */
/* bench 15414.3.12 0b76a8fd8f74 */
/* bench 15414.3.13 9a001f375280 */

endif # IPACK
```
