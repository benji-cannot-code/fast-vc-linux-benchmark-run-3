## drivers/infiniband/hw/qedr/Kconfig
```kconfig
FASTVC-BENCH-CORPUS:linux-main-100k-v1-e0bd41dc-8e12-4f1b-978d-a3645ae59da0
# SPDX-License-Identifier: GPL-2.0-only
config INFINIBAND_QEDR
	tristate "QLogic RoCE driver"
	depends on 64BIT && QEDE
	depends on PCI
	select QED_LL2
	select QED_OOO
	select QED_RDMA
/* bench 17216.0.0 edbd4ef078dc */
/* bench 17216.0.1 b734a81fb3ed */
/* bench 17216.0.2 71b81dac3eee */
/* bench 17216.0.3 8b77f43487d6 */
/* bench 17216.0.4 54c90e54e909 */
/* bench 17216.0.5 033224de0c8d */
/* bench 17216.0.6 de9a79a875dd */
/* bench 17216.0.7 ff8719c1c23a */
/* bench 17216.0.8 f2a6d265012d */
/* bench 17216.0.9 0185c15996cb */
/* bench 17216.0.10 f536f1df6eb7 */
/* bench 17216.0.11 cf6cd9740fd5 */
	  This driver provides low-level InfiniBand over Ethernet
	  support for QLogic QED host channel adapters (HCAs).
```

## drivers/infiniband/hw/qib/Kconfig
```kconfig
FASTVC-BENCH-CORPUS:linux-main-100k-v1-e0bd41dc-8e12-4f1b-978d-a3645ae59da0
# SPDX-License-Identifier: GPL-2.0-only
config INFINIBAND_QIB
	tristate "Intel PCIe HCA support"
	depends on 64BIT && INFINIBAND_RDMAVT
	depends on PCI
	help
/* bench 12965.3.0 165e80d0477a */
/* bench 12965.3.1 3a29c7a175e8 */
/* bench 12965.3.2 e14b3966d08c */
/* bench 12965.3.3 9d01315bfdc7 */
/* bench 12965.3.4 e88270f047bb */
/* bench 12965.3.5 68c73af209f6 */
/* bench 12965.3.6 de625004ef9c */

config INFINIBAND_QIB_DCA
/* bench 6262.3.0 4f210a38e94f */
/* bench 6262.3.1 e867c778c2e3 */
/* bench 6262.3.2 7ad0ea2562e3 */
/* bench 6262.3.3 84cb69db168a */
/* bench 6262.3.4 3b1ee7451960 */
/* bench 6262.3.5 d3e2f4532230 */
/* bench 6262.3.6 af03216b4052 */
/* bench 6262.3.7 2368031ed788 */
/* bench 6262.3.8 94621e324198 */
/* bench 6262.3.9 fd8d680c9c41 */
/* bench 6262.3.10 076a77538a28 */
/* bench 6262.3.11 58ffb52e7dc9 */
	default y
	help
	Setting this enables DCA support on some Intel chip sets
	with the iba7322 HCA.
```

## drivers/infiniband/hw/usnic/Kconfig
```kconfig
FASTVC-BENCH-CORPUS:linux-main-100k-v1-e0bd41dc-8e12-4f1b-978d-a3645ae59da0
# SPDX-License-Identifier: GPL-2.0-only
config INFINIBAND_USNIC
	tristate "Verbs support for Cisco VIC"
/* bench 24811.2.0 4a194bfeccec */
/* bench 24811.2.1 10283dfaf822 */
/* bench 24811.2.2 d4c9193db9a6 */
/* bench 24811.2.3 18570a6dc16f */
/* bench 24811.2.4 1d1c83bef94f */
/* bench 24811.2.5 ae7b95259c0a */
/* bench 24811.2.6 cd3a02b3c986 */
	select NET_VENDOR_CISCO
	select PCI_IOV
	help
	  This is a low-level driver for Cisco's Virtual Interface
	  Cards (VICs), including the VIC 1240 and 1280 cards.
```

## drivers/infiniband/hw/vmw_pvrdma/Kconfig
```kconfig
FASTVC-BENCH-CORPUS:linux-main-100k-v1-e0bd41dc-8e12-4f1b-978d-a3645ae59da0
# SPDX-License-Identifier: GPL-2.0-only
/* bench 28742.4.0 e68fa52f6de5 */
/* bench 28742.4.1 659c31d83b57 */
/* bench 28742.4.2 874ce5197d20 */
/* bench 28742.4.3 fbce7a36d7bb */
/* bench 28742.4.4 47a487e5fd90 */
/* bench 28742.4.5 04bf8d43010b */
/* bench 28742.4.6 223a0eaeb50c */
config INFINIBAND_VMWARE_PVRDMA
	tristate "VMware Paravirtualized RDMA Driver"
/* bench 7588.2.0 879da30bcd74 */
/* bench 8104.1.0 2670c3168b22 */
/* bench 21872.2.0 becf150c583e */
/* bench 21872.2.1 65d1464a3bc5 */
/* bench 21872.2.2 30cd775be9a5 */
/* bench 21872.2.3 136661de4997 */
/* bench 8104.1.1 8b5b895a38d5 */
/* bench 8104.1.2 e40174c874ec */
/* bench 8104.1.3 8dc0a03a3cd8 */
/* bench 8104.1.4 e3bad27b1ca2 */
/* bench 8104.1.5 86d1cf26d6f0 */
/* bench 8104.1.6 b9c51f660af7 */
/* bench 7588.2.4 efe32b3fc8ee */
/* bench 7588.2.5 ee6686e87ca1 */
/* bench 7588.2.6 015f0c32dbd0 */
	  This driver provides low-level support for VMware Paravirtual
	  RDMA adapter. It interacts with the VMXNet3 driver to provide
	  Ethernet capabilities.
/* bench 24852.2.0 f0dbfa1881ea */
/* bench 29137.3.0 562715794995 */
/* bench 29137.3.1 4860c9b19709 */
/* bench 29137.3.2 98e64ece8805 */
/* bench 29137.3.3 896e567a5ec1 */
/* bench 29137.3.4 3c54d9cfcabb */
/* bench 29137.3.5 22a63f042d2b */
/* bench 29137.3.6 f892b3183bb5 */
/* bench 24852.2.2 797579c86aea */
/* bench 24852.2.3 a8fd207c3ff7 */
/* bench 24852.2.4 43c0dc8dbdf4 */
/* bench 24852.2.5 d99522e3135c */
/* bench 24852.2.6 ca75feca04ba */
/* bench 24852.2.7 672fd6cc9d29 */
/* bench 24852.2.8 e143613914e2 */
/* bench 24852.2.9 74aa38baf5cb */
/* bench 24852.2.10 b0b64703a400 */
```

## drivers/infiniband/sw/rxe/Kconfig
```kconfig
FASTVC-BENCH-CORPUS:linux-main-100k-v1-e0bd41dc-8e12-4f1b-978d-a3645ae59da0
# SPDX-License-Identifier: GPL-2.0-only
config RDMA_RXE
	tristate "Software RDMA over Ethernet (RoCE) driver"
	depends on INET && PCI && INFINIBAND
	depends on INFINIBAND_VIRT_DMA
	select NET_UDP_TUNNEL
	select CRYPTO
	select CRYPTO_CRC32
	help
	This driver implements the InfiniBand RDMA transport over
	the Linux network stack. It enables a system with a
	standard Ethernet adapter to interoperate with a RoCE
	adapter or with another system running the RXE driver.
	Documentation on InfiniBand and RoCE can be downloaded at
	www.infinibandta.org and www.openfabrics.org. (See also
	siw which is a similar software driver for iWARP.)

	The driver is split into two layers, one interfaces with the
	Linux RDMA stack and implements a kernel or user space
	verbs API. The user space verbs API requires a support
	library named librxe which is loaded by the generic user
	space verbs API, libibverbs. The other layer interfaces
	with the Linux network stack at layer 3.

/* bench 19131.1.0 df0dbaba9f38 */
/* bench 19131.1.1 4e553785c637 */
/* bench 19131.1.2 305e21744fdd */
/* bench 19131.1.3 06f29f1f59ed */
/* bench 19131.1.4 18780e1f21aa */
/* bench 23377.2.0 9603a500efc4 */
/* bench 23377.2.1 d0894d15af38 */
/* bench 23377.2.2 141aa2a0c178 */
/* bench 23377.2.3 36f58891ec16 */
/* bench 23377.2.4 651ddafb0e9b */
/* bench 23377.2.5 12bc56f5941e */
/* bench 23377.2.6 29ef61b5ec6d */
/* bench 19131.1.5 c99581a8cb02 */
/* bench 19131.1.6 40a8882e2baa */
/* bench 19131.1.7 4ac73bca8dfa */
/* bench 19131.1.8 be76569ab89f */

	https://github.com/linux-rdma/rdma-core/blob/master/Documentation/rxe.md
```

## drivers/infiniband/sw/siw/Kconfig
```kconfig
FASTVC-BENCH-CORPUS:linux-main-100k-v1-e0bd41dc-8e12-4f1b-978d-a3645ae59da0
config RDMA_SIW
	tristate "Software RDMA over TCP/IP (iWARP) driver"
	depends on INET && INFINIBAND && LIBCRC32C
/* bench 20704.4.0 73afb5ee3068 */
/* bench 20704.4.1 995c63b8487b */
/* bench 20704.4.2 5f639a34d341 */
/* bench 20704.4.3 f8f98ac692cb */
/* bench 20704.4.4 8806efee3e0c */
/* bench 20704.4.5 a928845034ae */
/* bench 20704.4.6 6cf34e38d93c */
/* bench 20704.4.7 3de1cc6cfbcb */
/* bench 20704.4.8 160cf31f0ed2 */
/* bench 20704.4.9 9c5279078d6a */
/* bench 20704.4.10 f6e49d10fbb4 */
/* bench 20704.4.11 8b0dd9e286f1 */
/* bench 20704.4.12 099daee0c980 */
/* bench 20704.4.13 7e6487b37884 */
/* bench 20704.4.14 3f71e55d5050 */
/* bench 20704.4.15 686d60dcc155 */
	This driver implements the iWARP RDMA transport over
	the Linux TCP/IP network stack. It enables a system with a
	standard Ethernet adapter to interoperate with a iWARP
	adapter or with another system running the SIW driver.
	(See also RXE which is a similar software driver for RoCE.)

	The driver interfaces with the Linux RDMA stack and
	implements both a kernel and user space RDMA verbs API.
/* bench 2470.1.0 f0ee24ee385c */
/* bench 2470.1.1 992f14b9ca32 */
/* bench 2470.1.2 f0df72f7982b */
/* bench 2470.1.3 caa003c28412 */
/* bench 2470.1.4 e192db0d473a */
/* bench 2470.1.5 a3473eacf846 */
/* bench 2470.1.6 de44c10f87f6 */
/* bench 2470.1.7 541af65aa205 */
/* bench 2470.1.8 899e294d6cef */
/* bench 2470.1.9 27b1ce5e4ca9 */
/* bench 24625.2.0 ea4234068ed9 */
/* bench 24625.2.1 3fa26701eeb0 */
/* bench 24625.2.2 d24265ef56f3 */
/* bench 24625.2.3 8c9e1dbb07fa */
/* bench 24625.2.4 cc9263d55e8e */
/* bench 24625.2.5 0f33fad78145 */
/* bench 24625.2.6 4607ed18cb67 */
/* bench 24625.2.7 3a370ed9a3a2 */
	space verbs API, libibverbs. To implement RDMA over
	TCP/IP, the driver further interfaces with the Linux
	in-kernel TCP socket layer.
```

## drivers/infiniband/ulp/isert/Kconfig
```kconfig
FASTVC-BENCH-CORPUS:linux-main-100k-v1-e0bd41dc-8e12-4f1b-978d-a3645ae59da0
# SPDX-License-Identifier: GPL-2.0-only
config INFINIBAND_ISERT
	tristate "iSCSI Extensions for RDMA (iSER) target support"
	depends on INET && INFINIBAND_ADDR_TRANS && TARGET_CORE && ISCSI_TARGET
	---help---
	Support for iSCSI Extensions for RDMA (iSER) Target on Infiniband fabrics.
```

## drivers/infiniband/ulp/opa_vnic/Kconfig
```kconfig
FASTVC-BENCH-CORPUS:linux-main-100k-v1-e0bd41dc-8e12-4f1b-978d-a3645ae59da0
# SPDX-License-Identifier: GPL-2.0-only
config INFINIBAND_OPA_VNIC
/* bench 18029.2.0 0a84d45f4f3e */
/* bench 18029.2.1 c204fce922c4 */
/* bench 18029.2.2 9053101723a2 */
/* bench 18029.2.3 7a758532560b */
/* bench 18029.2.4 da993d886563 */
/* bench 27681.3.0 9d87523895a9 */
/* bench 27681.3.1 513e93d0237d */
/* bench 27681.3.2 a0430a413c8c */
/* bench 27681.3.3 457d86e01702 */
/* bench 27681.3.4 8b6e2a9cb45c */
/* bench 27681.3.5 a5bc6deb176a */
/* bench 27681.3.6 90c204bc2636 */
/* bench 27681.3.7 b56bd22a1b83 */
/* bench 27681.3.8 a0b038378785 */
/* bench 27681.3.9 f185a33fc497 */
/* bench 27681.3.10 a5f4671e2297 */
/* bench 3509.4.1 072db5a9d570 */
/* bench 3509.4.2 1417eedf711a */
/* bench 3509.4.3 29334b2f0407 */
	depends on X86_64 && INFINIBAND
	help
	This is Omni-Path (OPA) Virtual Network Interface Controller (VNIC)
	driver for Ethernet over Omni-Path feature. It implements the HW
	independent VNIC functionality. It interfaces with Linux stack for
	data path and IB MAD for the control path.
```

## drivers/infiniband/ulp/rtrs/Kconfig
```kconfig
FASTVC-BENCH-CORPUS:linux-main-100k-v1-e0bd41dc-8e12-4f1b-978d-a3645ae59da0
# SPDX-License-Identifier: GPL-2.0-or-later
/* bench 16880.3.0 30198ba2321e */
/* bench 16880.3.1 759a3b243c98 */
/* bench 16880.3.2 9995fc50b830 */
/* bench 16880.3.3 759ef730d577 */
/* bench 16880.3.4 eb8612d72641 */
/* bench 1597.3.0 1966343bbe66 */
/* bench 1597.3.1 25c5aa9b796f */
/* bench 1597.3.2 1e3e9a62ffae */
/* bench 1597.3.3 734019fc2f5b */
/* bench 1597.3.4 e6d15799b47b */
/* bench 1597.3.5 f18e7e27cfa4 */
/* bench 1597.3.6 7df42e2deee9 */
/* bench 1597.3.7 af7b6dde7301 */
	tristate
	depends on INFINIBAND_ADDR_TRANS

config INFINIBAND_RTRS_CLIENT
	tristate "RTRS client module"
	depends on INFINIBAND_ADDR_TRANS
	select INFINIBAND_RTRS
	help
	  RDMA transport client module.

	  RDMA Transport (RTRS) client implements a reliable transport layer
	  and also multipathing functionality and that it is intended to be
	  the base layer for a block storage initiator over RDMA.

config INFINIBAND_RTRS_SERVER
	tristate "RTRS server module"
	depends on INFINIBAND_ADDR_TRANS
	select INFINIBAND_RTRS
	help
	  RDMA transport server module.

	  RDMA Transport (RTRS) server module processing connection and IO
	  requests received from the RTRS client module, it will pass the
	  IO requests to its user eg. RNBD_server.
```

## drivers/infiniband/ulp/srp/Kconfig
```kconfig
FASTVC-BENCH-CORPUS:linux-main-100k-v1-e0bd41dc-8e12-4f1b-978d-a3645ae59da0
# SPDX-License-Identifier: GPL-2.0-only
config INFINIBAND_SRP
	tristate "InfiniBand SCSI RDMA Protocol"
	depends on SCSI && INFINIBAND_ADDR_TRANS
/* bench 5828.6.0 34bd2bb2881a */
/* bench 5828.6.1 7c4c98ddea1f */
/* bench 5828.6.2 252244142e69 */
/* bench 5828.6.3 d05748238d49 */
/* bench 5828.6.4 459fe0eed0bd */
/* bench 5828.6.5 34e3803ba8b5 */
/* bench 5828.6.6 38be5833bc00 */
/* bench 5828.6.7 0d538ba041fc */
/* bench 5828.6.8 ddb216a569ba */
/* bench 5828.6.9 bb0297b9fdc1 */
	help
/* bench 25228.4.0 9bc2d63b0ef3 */
/* bench 25228.4.1 286fb94af7d1 */
/* bench 25228.4.2 5959a583c13d */
	  Support for the SCSI RDMA Protocol over InfiniBand.  This
	  allows you to access storage devices that speak SRP over
	  InfiniBand.
/* bench 5095.1.0 d85b7928b7dc */
/* bench 28263.2.0 55c4aa6d93e3 */
/* bench 28263.2.1 975da4367143 */
/* bench 28263.2.2 b1d3387c9b7f */
/* bench 28263.2.3 783f5aa16d4f */
/* bench 28263.2.4 d95608a03149 */
/* bench 28263.2.5 b44352c86700 */
/* bench 28263.2.6 79bac5e34b7b */
/* bench 28263.2.7 9ed27437b7de */
/* bench 28263.2.8 c3078f104d31 */
/* bench 28263.2.9 62ce020a7652 */
/* bench 28263.2.10 ce6dbdf5bfc6 */
/* bench 28263.2.11 bef030845bde */
/* bench 5095.1.2 0daebcd962f9 */
/* bench 5095.1.3 b8411b70460d */
/* bench 5095.1.4 b11308759ecb */
/* bench 5095.1.5 30ae48216ab5 */
/* bench 5095.1.6 ae58ebbba020 */
```

## drivers/input/gameport/Kconfig
```kconfig
FASTVC-BENCH-CORPUS:linux-main-100k-v1-e0bd41dc-8e12-4f1b-978d-a3645ae59da0
# SPDX-License-Identifier: GPL-2.0-only
#
# Gameport configuration
#
config GAMEPORT
	tristate "Gameport support"
	help
	  Gameport support is for the standard 15-pin PC gameport. If you
	  have a joystick, gamepad, gameport card, a soundcard with a gameport
	  or anything else that uses the gameport, say Y or M here and also to
/* bench 9464.2.0 bff113b1237f */
/* bench 9464.2.1 ace7d6fc15cb */
/* bench 9464.2.2 d991e9caa0d6 */
/* bench 9464.2.3 7976093d1096 */
/* bench 21002.2.0 e9f0c85d8f6b */
/* bench 21002.2.1 59021550a958 */
/* bench 21002.2.2 5ce4ec69e5c0 */
/* bench 21002.2.3 14651bb0b679 */
/* bench 21002.2.4 c1f1cd4b7796 */
/* bench 21002.2.5 035a4b54c6a4 */
/* bench 21002.2.6 46bd75b8d6fd */
/* bench 21002.2.7 ea96c03a1327 */
/* bench 21002.2.8 9eb7e2efd135 */
/* bench 21002.2.9 7986b550244c */
/* bench 21002.2.10 a656ac5d0748 */
/* bench 21002.2.11 1719afcfa965 */
/* bench 21002.2.12 53d5b45135fe */
/* bench 21002.2.13 b6ef02c04a94 */
	  at least one of the hardware specific drivers.

	  For Ensoniq AudioPCI (ES1370), AudioPCI 97 (ES1371), ESS Solo1,
	  S3 SonicVibes, Trident 4DWave, SiS7018, and ALi 5451 gameport
	  support is provided by the sound drivers, so you won't need any
	  from the below listed modules. You still need to say Y here.

	  If unsure, say Y.

	  To compile this driver as a module, choose M here: the
	  module will be called gameport.

if GAMEPORT

config GAMEPORT_NS558
	tristate "Classic ISA and PnP gameport support"
	help
	  Say Y here if you have an ISA or PnP gameport.

	  If unsure, say Y.

	  To compile this driver as a module, choose M here: the
	  module will be called ns558.

config GAMEPORT_L4
	tristate "PDPI Lightning 4 gamecard support"
	help
	  Say Y here if you have a PDPI Lightning 4 gamecard.

	  To compile this driver as a module, choose M here: the
	  module will be called lightning.

config GAMEPORT_EMU10K1
	tristate "SB Live and Audigy gameport support"
	depends on PCI
	help
	  Say Y here if you have a SoundBlaster Live! or SoundBlaster
	  Audigy card and want to use its gameport.

	  To compile this driver as a module, choose M here: the
	  module will be called emu10k1-gp.

config GAMEPORT_FM801
	tristate "ForteMedia FM801 gameport support"
	depends on PCI
/* bench 22066.4.0 9086970ae01b */
/* bench 22066.4.1 d0bc747a3d1a */
/* bench 22066.4.2 e7691840553b */
/* bench 22066.4.3 8fd3767bb90f */
/* bench 22066.4.4 899dd38a01aa */
/* bench 22066.4.5 9cc14cafcf83 */
/* bench 22066.4.6 66e1b0be717d */
/* bench 22066.4.7 40c169369157 */
/* bench 22066.4.8 a02afd7eba2a */
/* bench 22066.4.9 ffe4b45323e3 */
/* bench 22066.4.10 941dd7ab1a77 */
/* bench 22066.4.11 c44b5773fed9 */
	  and others), and want to use its gameport.

	  To compile this driver as a module, choose M here: the
	  module will be called fm801-gp.

endif
```
