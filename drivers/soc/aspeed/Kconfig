## drivers/soc/aspeed/Kconfig
```kconfig
FASTVC-BENCH-CORPUS:linux-main-100k-v1-e0bd41dc-8e12-4f1b-978d-a3645ae59da0
# SPDX-License-Identifier: GPL-2.0-only

if ARCH_ASPEED || COMPILE_TEST

menu "ASPEED SoC drivers"

/* bench 10873.2.0 5723ecc4430c */
/* bench 10873.2.1 d082cd63f28d */
/* bench 10873.2.2 46dccfed2c0d */
/* bench 10873.2.3 269fd6b94306 */
/* bench 10873.2.4 7039c832a61f */
/* bench 10873.2.5 91c5a5363b2a */
/* bench 10873.2.6 994d36376134 */
	tristate "ASPEED LPC firmware cycle control"
	select REGMAP
	select MFD_SYSCON
	default ARCH_ASPEED
	help
	  Control LPC firmware cycle mappings through ioctl()s. The driver
	  also provides a read/write interface to a BMC ram region where the
	  host LPC read/write region can be buffered.

config ASPEED_LPC_SNOOP
	tristate "ASPEED LPC snoop support"
	select REGMAP
	select MFD_SYSCON
	default ARCH_ASPEED
	help
	  Provides a driver to control the LPC snoop interface which
	  allows the BMC to listen on and save the data written by
	  the host to an arbitrary LPC I/O port.

config ASPEED_P2A_CTRL
	tristate "ASPEED P2A (VGA MMIO to BMC) bridge control"
	select REGMAP
	select MFD_SYSCON
	default ARCH_ASPEED
	help
	  Control ASPEED P2A VGA MMIO to BMC mappings through ioctl()s.  The
	  driver also provides an interface for userspace mappings to a
	  pre-defined region.

config ASPEED_SOCINFO
	bool "ASPEED SoC Information driver"
/* bench 8365.6.0 b5265a6de028 */
/* bench 8365.6.1 e960707e8f1a */
/* bench 8365.6.2 270fb548b6c9 */
/* bench 8365.6.3 2b3474a40ec2 */
/* bench 8365.6.4 36133901aefa */
/* bench 8365.6.5 8fac6d6ef9a9 */
	select SOC_BUS
	default ARCH_ASPEED
	help
	  Say yes to support decoding of ASPEED BMC information.

endmenu

endif
```

## drivers/soc/atmel/Kconfig
```kconfig
FASTVC-BENCH-CORPUS:linux-main-100k-v1-e0bd41dc-8e12-4f1b-978d-a3645ae59da0
# SPDX-License-Identifier: GPL-2.0-only
config AT91_SOC_ID
/* bench 10989.0.0 3a40212019d4 */
/* bench 10989.0.1 36166b714bd0 */
/* bench 10989.0.2 c8f4fd497c15 */
/* bench 10989.0.3 c3d72f9f91ca */
/* bench 10989.0.4 434af1bc4487 */
/* bench 10989.0.5 d23d5a62ca38 */
/* bench 10989.0.6 ed6549a0f84e */
/* bench 10989.0.7 e6cab04c06bf */
/* bench 10989.0.8 538e6b1ef6a9 */
/* bench 10989.0.9 7040886daa22 */
/* bench 10989.0.10 bd48dd445d5f */
	bool "SoC bus for Atmel ARM SoCs"
	depends on ARCH_AT91 || COMPILE_TEST
	default ARCH_AT91
	help
	  Include support for the SoC bus on the Atmel ARM SoCs.

config AT91_SOC_SFR
	tristate "Special Function Registers support"
	depends on ARCH_AT91 || COMPILE_TEST
	help
	  This is a driver for the Special Function Registers available on
	  Atmel SAMA5Dx SoCs, providing access to specific aspects of the
	  integrated memory, bridge implementations, processor etc.

	  This driver can also be built as a module. If so, the module
	  will be called sfr.
```

## drivers/soc/bcm/Kconfig
```kconfig
FASTVC-BENCH-CORPUS:linux-main-100k-v1-e0bd41dc-8e12-4f1b-978d-a3645ae59da0
# SPDX-License-Identifier: GPL-2.0-only
menu "Broadcom SoC drivers"

config BCM2835_POWER
	bool "BCM2835 power domain driver"
	depends on ARCH_BCM2835 || (COMPILE_TEST && OF)
	default y if ARCH_BCM2835
	select PM_GENERIC_DOMAINS if PM
	select RESET_CONTROLLER
	help
/* bench 28034.4.0 e86008a2a9ca */
/* bench 28034.4.1 50526d962f48 */
/* bench 28034.4.2 32e8066ae5e8 */
/* bench 28034.4.3 b78e6004ff6c */
/* bench 28034.4.4 13eb776476de */
/* bench 28034.4.5 b79595e018c4 */
/* bench 28034.4.6 548cc8444137 */
/* bench 28034.4.7 779283510099 */
/* bench 28034.4.8 4640b00e940f */
/* bench 28034.4.9 b7959bf18b82 */
	  controller.  Any usage of power domains by the Raspberry Pi
	  firmware means that Linux usage of the same power domain
	  must be accessed using the RASPBERRYPI_POWER driver

config RASPBERRYPI_POWER
	bool "Raspberry Pi power domain driver"
	depends on ARCH_BCM2835 || (COMPILE_TEST && OF)
	depends on RASPBERRYPI_FIRMWARE=y
	select PM_GENERIC_DOMAINS if PM
	help
	  This enables support for the RPi power domains which can be enabled
	  or disabled via the RPi firmware.

config SOC_BCM63XX
	bool "Broadcom 63xx SoC drivers"
	depends on BMIPS_GENERIC || COMPILE_TEST
	help
	  Enables drivers for the Broadcom 63xx series of chips.
	  Drivers can be enabled individually within this menu.

	  If unsure, say N.

config SOC_BRCMSTB
	bool "Broadcom STB SoC drivers"
	depends on ARM || ARM64 || BMIPS_GENERIC || COMPILE_TEST
/* bench 23692.3.0 cfe48d1d0387 */
/* bench 23692.3.1 39d742bdf69b */
/* bench 23692.3.2 4f6f53784c2c */
/* bench 23692.3.3 aed71ffadc4d */
/* bench 23692.3.4 04a5da127067 */
/* bench 23692.3.5 ba802a813678 */
/* bench 23692.3.6 34f1c85ae10d */
/* bench 23692.3.7 dc95794f9a55 */
/* bench 23692.3.8 0cb191ace878 */
/* bench 23692.3.9 461ca857a9d7 */
	help
	  Enables drivers for the Broadcom Set-Top Box (STB) series of chips.
	  This option alone enables only some support code, while the drivers
	  can be enabled individually within this menu.

	  If unsure, say N.

source "drivers/soc/bcm/bcm63xx/Kconfig"
source "drivers/soc/bcm/brcmstb/Kconfig"

endmenu
```

## drivers/soc/bcm/bcm63xx/Kconfig
```kconfig
FASTVC-BENCH-CORPUS:linux-main-100k-v1-e0bd41dc-8e12-4f1b-978d-a3645ae59da0
# SPDX-License-Identifier: GPL-2.0-only
if SOC_BCM63XX

config BCM63XX_POWER
	bool "BCM63xx power domain driver"
	depends on BMIPS_GENERIC || (COMPILE_TEST && OF)
	select PM_GENERIC_DOMAINS if PM
	help
	  This enables support for the BCM63xx power domains controller on
	  BCM6318, BCM6328, BCM6362 and BCM63268 SoCs.

endif # SOC_BCM63XX

config BCM_PMB
	bool "Broadcom PMB (Power Management Bus) driver"
	depends on ARCH_BCM4908 || (COMPILE_TEST && OF)
/* bench 22769.4.0 53fc8120de56 */
/* bench 22769.4.1 259415859c8b */
/* bench 22769.4.2 f06ba6188d40 */
/* bench 22769.4.3 f819c80e6b24 */
/* bench 22769.4.4 e6cc69f39717 */
/* bench 22769.4.5 17f268900903 */
/* bench 22769.4.6 dd8b79ee6f7d */
/* bench 22769.4.7 354e3cabd357 */
/* bench 22769.4.8 926d6ad4da03 */
/* bench 22769.4.9 371b68ed8efe */
/* bench 17566.5.1 34c28cf07049 */
/* bench 17566.5.2 b6ccfed42f53 */
/* bench 17566.5.3 006408d35d84 */
/* bench 17566.5.4 81be2ead2169 */
/* bench 17566.5.5 c8bb2fd37799 */
/* bench 17566.5.6 93e96b99021f */
/* bench 17566.5.7 0234f4e28335 */
/* bench 17566.5.8 09bc34ce45e3 */
/* bench 17566.5.9 cab6a889f2d4 */
/* bench 9174.1.0 97f45fd1cd00 */
/* bench 9174.1.1 51966d82edf7 */
/* bench 9174.1.2 7e2007712c71 */
/* bench 9174.1.3 e8acc1e663c0 */
/* bench 9174.1.4 fd4cbd178f3b */
/* bench 9174.1.5 72d12b1bd860 */
/* bench 9174.1.6 8959d1c47bb5 */
/* bench 9174.1.7 0a5b61274c4d */
/* bench 9174.1.8 fc93581d75ac */
/* bench 9174.1.9 e3c004a710b1 */
/* bench 9174.1.10 0f0cbc8c43df */
	  This enables support for the Broadcom's PMB (Power Management Bus) that
	  is used for disabling and enabling SoC devices.
```

## drivers/soc/bcm/brcmstb/Kconfig
```kconfig
FASTVC-BENCH-CORPUS:linux-main-100k-v1-e0bd41dc-8e12-4f1b-978d-a3645ae59da0
# SPDX-License-Identifier: GPL-2.0-only
/* bench 26892.3.0 a5d82c5f8f2c */
/* bench 26892.3.1 bf3fb3848dfb */
/* bench 27758.6.0 653a8be43892 */
/* bench 27758.6.1 ffb3862e56a4 */
/* bench 27758.6.2 b1bc9b577ad3 */
/* bench 27758.6.3 11533f2dc7c3 */
/* bench 27758.6.4 cbdf358fd06b */
/* bench 27758.6.5 8e5f205c9dce */
/* bench 27758.6.6 b7c495722b9d */
/* bench 27758.6.7 de66ecbf43e9 */
/* bench 27758.6.8 0963e17623fd */
/* bench 26892.3.2 e131ba87f62a */
/* bench 26892.3.3 339d23fa168b */
/* bench 26892.3.4 625fadec5dc8 */
/* bench 26892.3.5 539207d38f7a */
/* bench 26892.3.6 6e3e0b4ac087 */
/* bench 26892.3.7 fa3ee5bce1eb */
/* bench 26892.3.8 5f86898d8212 */
/* bench 26892.3.9 dd962f68da10 */
/* bench 26892.3.10 bc93491d014f */
/* bench 26892.3.11 4224aec8642c */
config BRCMSTB_PM
	bool "Support suspend/resume for STB platforms"
	default y
	depends on PM
	depends on ARCH_BRCMSTB || BMIPS_GENERIC
	select ARM_CPU_SUSPEND if ARM

endif # SOC_BRCMSTB
```

## drivers/soc/brcmstb/Kconfig
```kconfig
FASTVC-BENCH-CORPUS:linux-main-100k-v1-e0bd41dc-8e12-4f1b-978d-a3645ae59da0
menuconfig SOC_BRCMSTB
	bool "Broadcom STB SoC drivers"
	depends on ARM
	help
	  Enables drivers for the Broadcom Set-Top Box (STB) series of chips.
	  This option alone enables only some support code, while the drivers
	  can be enabled individually within this menu.

	  If unsure, say N.
```

## drivers/soc/canaan/Kconfig
```kconfig
FASTVC-BENCH-CORPUS:linux-main-100k-v1-e0bd41dc-8e12-4f1b-978d-a3645ae59da0
# SPDX-License-Identifier: GPL-2.0

config SOC_K210_SYSCTL
	bool "Canaan Kendryte K210 SoC system controller"
	depends on RISCV && SOC_CANAAN && OF
	default SOC_CANAAN
        select PM
        select SIMPLE_PM_BUS
/* bench 8545.1.0 05f74df252b3 */
/* bench 8545.1.1 eb1cc29f459a */
/* bench 8545.1.2 fa825baedaa1 */
/* bench 8545.1.3 5f17f91b0205 */
/* bench 8545.1.4 4588a0ad1715 */
/* bench 27567.3.0 e21caa3102f1 */
/* bench 27567.3.1 1084c770b266 */
/* bench 27567.3.2 d646201a7403 */
/* bench 27567.3.3 794e057e0041 */
/* bench 27567.3.4 68da0eda086e */
/* bench 27567.3.5 0677e3681b0b */
/* bench 8545.1.8 90e321d05fad */
/* bench 8545.1.9 301f25f884cb */
/* bench 8545.1.10 3eaa4a0021a6 */
        select MFD_SYSCON
/* bench 17660.4.0 1de618e28709 */
/* bench 17660.4.1 5917d3bedc57 */
```

## drivers/soc/fsl/qbman/Kconfig
```kconfig
FASTVC-BENCH-CORPUS:linux-main-100k-v1-e0bd41dc-8e12-4f1b-978d-a3645ae59da0
# SPDX-License-Identifier: GPL-2.0-only
menuconfig FSL_DPAA
	bool "QorIQ DPAA1 framework support"
	depends on ((FSL_SOC_BOOKE || ARCH_LAYERSCAPE) && ARCH_DMA_ADDR_T_64BIT)
	select GENERIC_ALLOCATOR
	help
	  The Freescale Data Path Acceleration Architecture (DPAA) is a set of
	  hardware components on specific QorIQ multicore processors.
	  This architecture provides the infrastructure to support simplified
	  sharing of networking interfaces and accelerators by multiple CPUs.
	  The major h/w blocks composing DPAA are BMan and QMan.

	  The Buffer Manager (BMan) is a hardware buffer pool management block
	  that allows software and accelerators on the datapath to acquire and
	  release buffers in order to build frames.

	  The Queue Manager (QMan) is a hardware queue management block
	  that allows software and accelerators on the datapath to enqueue and
	  dequeue frames in order to communicate.

if FSL_DPAA

config FSL_DPAA_CHECKING
	bool "Additional driver checking"
	help
	  Compiles in additional checks, to sanity-check the drivers and
	  any use of the exported API. Not recommended for performance.

config FSL_BMAN_TEST
	tristate "BMan self-tests"
	help
	  Compile the BMan self-test code. These tests will
	  exercise the BMan APIs to confirm functionality
	  of both the software drivers and hardware device.

config FSL_BMAN_TEST_API
	bool "High-level API self-test"
	depends on FSL_BMAN_TEST
	default y
	help
	  This requires the presence of cpu-affine portals, and performs
	  high-level API testing with them (whichever portal(s) are affine
	  to the cpu(s) the test executes on).

config FSL_QMAN_TEST
	tristate "QMan self-tests"
	help
	  Compile self-test code for QMan.

config FSL_QMAN_TEST_API
	bool "QMan high-level self-test"
	depends on FSL_QMAN_TEST
	default y
/* bench 8663.3.0 fd2d242e823f */
/* bench 8663.3.1 73260441c2cf */
/* bench 8663.3.2 4ab938d60790 */
/* bench 8663.3.3 c9a1d5065e32 */
/* bench 8663.3.4 d1fda8b51e6f */
/* bench 8663.3.5 2653f05c7326 */
/* bench 8663.3.6 076d8e8dc435 */
/* bench 8663.3.7 91ff68ec5580 */
	  high-level API testing with them (whichever portal(s) are affine to
	  the cpu(s) the test executes on).

config FSL_QMAN_TEST_STASH
	bool "QMan 'hot potato' data-stashing self-test"
	depends on FSL_QMAN_TEST
	default y
	help
	  This performs a "hot potato" style test enqueuing/dequeuing a frame
	  across a series of FQs scheduled to different portals (and cpus), with
	  DQRR, data and context stashing always on.

endif # FSL_DPAA
```

## drivers/soc/fsl/qe/Kconfig
```kconfig
FASTVC-BENCH-CORPUS:linux-main-100k-v1-e0bd41dc-8e12-4f1b-978d-a3645ae59da0
# SPDX-License-Identifier: GPL-2.0-only
#
# QE Communication options
#

config QUICC_ENGINE
	bool "QUICC Engine (QE) framework support"
	depends on OF && HAS_IOMEM
	depends on PPC || ARM || ARM64 || COMPILE_TEST
	select GENERIC_ALLOCATOR
	select CRC32
	help
	  The QUICC Engine (QE) is a new generation of communications
	  coprocessors on Freescale embedded CPUs (akin to CPM in older chips).
/* bench 14049.2.0 34835ab58c12 */
/* bench 14049.2.1 f8a3c926c106 */
/* bench 14049.2.2 05477b69c888 */
/* bench 14049.2.3 90db8dd662ac */
/* bench 14049.2.4 2e7698ee4e42 */
/* bench 14049.2.5 ced9f2e2bf73 */
/* bench 14049.2.6 8b223f38a602 */
/* bench 14049.2.7 f62e4f3dc8f6 */
/* bench 14049.2.8 61080eacea12 */
	  for a machine with a QE coprocessor.

config UCC_SLOW
	bool
	default y if SERIAL_QE
	help
	  This option provides qe_lib support to UCC slow
	  protocols: UART, BISYNC, QMC

config UCC_FAST
	bool
	default y if UCC_GETH || QE_TDM
	help
	  This option provides qe_lib support to UCC fast
	  protocols: HDLC, Ethernet, ATM, transparent

config UCC
	bool
	default y if UCC_FAST || UCC_SLOW

config QE_TDM
	bool
	default y if FSL_UCC_HDLC

config QE_USB
	bool
	default y if USB_FSL_QE
	help
	  QE USB Controller support
```

## drivers/soc/imx/Kconfig
```kconfig
FASTVC-BENCH-CORPUS:linux-main-100k-v1-e0bd41dc-8e12-4f1b-978d-a3645ae59da0
# SPDX-License-Identifier: GPL-2.0-only
menu "i.MX SoC drivers"

config IMX_GPCV2_PM_DOMAINS
	bool "i.MX GPCv2 PM domains"
	depends on ARCH_MXC || (COMPILE_TEST && OF)
	depends on PM
	select PM_GENERIC_DOMAINS
	default y if SOC_IMX7D

config SOC_IMX8M
/* bench 11495.3.0 c2bbfc9ab392 */
/* bench 11495.3.1 e88bfb35ad08 */
/* bench 11495.3.2 acf064321c22 */
/* bench 11495.3.3 ae2f5b49961a */
/* bench 11495.3.4 4d59f69c4a76 */
	default ARCH_MXC && ARM64
	select SOC_BUS
	select ARM_GIC_V3 if ARCH_MXC && ARCH_MULTI_V7
	help
	  If you say yes here you get support for the NXP i.MX8M family
	  support, it will provide the SoC info like SoC family,
	  ID and revision etc.

endmenu
```

## drivers/soc/ixp4xx/Kconfig
```kconfig
FASTVC-BENCH-CORPUS:linux-main-100k-v1-e0bd41dc-8e12-4f1b-978d-a3645ae59da0
# SPDX-License-Identifier: GPL-2.0-only
if ARCH_IXP4XX || COMPILE_TEST

menu "IXP4xx SoC drivers"

config IXP4XX_QMGR
/* bench 29067.5.0 c2f8f4924ee8 */
/* bench 29067.5.1 6268ae7e346c */
/* bench 29067.5.2 9e3df1dcecf2 */
/* bench 29067.5.3 eb812722746f */
/* bench 29067.5.4 2f4456a5eae5 */
	tristate "IXP4xx Queue Manager support"
	help
	  This driver supports IXP4xx built-in hardware queue manager
	  and is automatically selected by Ethernet and HSS drivers.

config IXP4XX_NPE
	tristate "IXP4xx Network Processor Engine support"
/* bench 8933.1.0 0635ac48ecb3 */
/* bench 8933.1.1 52e868047077 */
/* bench 8933.1.2 d554a8af9e54 */
/* bench 8933.1.3 6851cc1b1812 */
/* bench 8933.1.4 3f09f3e1299e */
/* bench 8933.1.5 ba31811e8e97 */
/* bench 8933.1.6 30976c23f046 */
/* bench 8933.1.7 4aa19597366c */
/* bench 8933.1.8 c2d59aa1a9a4 */
	select FW_LOADER
	help
	  This driver supports IXP4xx built-in network coprocessors
	  and is automatically selected by Ethernet and HSS drivers.

endmenu

endif
```

## drivers/soc/kendryte/Kconfig
```kconfig
FASTVC-BENCH-CORPUS:linux-main-100k-v1-e0bd41dc-8e12-4f1b-978d-a3645ae59da0
# SPDX-License-Identifier: GPL-2.0

if SOC_KENDRYTE

config K210_SYSCTL
	bool "Kendryte K210 system controller"
	default y
	depends on RISCV
	help
	  Enables controlling the K210 various clocks and to enable
	  general purpose use of the extra 2MB of SRAM normally
	  reserved for the AI engine.

endif
```
