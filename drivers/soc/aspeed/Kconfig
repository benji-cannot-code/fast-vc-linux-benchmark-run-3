## drivers/soc/litex/Kconfig
```kconfig
FASTVC-BENCH-CORPUS:linux-main-100k-v1-e0bd41dc-8e12-4f1b-978d-a3645ae59da0
# SPDX-License_Identifier: GPL-2.0

menu "Enable LiteX SoC Builder specific drivers"

config LITEX
	bool

config LITEX_SOC_CONTROLLER
	tristate "Enable LiteX SoC Controller driver"
	depends on OF || COMPILE_TEST
	depends on HAS_IOMEM
	select LITEX
	help
	  This option enables the SoC Controller Driver which verifies
	  LiteX CSR access and provides common litex_[read|write]*
	  accessors.
	  All drivers that use functions from litex.h must depend on
	  LITEX.

config LITEX_SUBREG_SIZE
	int "Size of a LiteX CSR subregister, in bytes"
	depends on LITEX
	range 1 4
	default 4
	help
	LiteX MMIO registers (referred to as Configuration and Status
	registers, or CSRs) are spread across adjacent 8- or 32-bit
	subregisters, located at 32-bit aligned MMIO addresses. Use
	this to select the appropriate size (1 or 4 bytes) matching
	your particular LiteX build.

endmenu
```

## drivers/soc/mediatek/Kconfig
```kconfig
FASTVC-BENCH-CORPUS:linux-main-100k-v1-e0bd41dc-8e12-4f1b-978d-a3645ae59da0
#
# MediaTek SoC drivers
#
config MTK_INFRACFG
	bool "MediaTek INFRACFG Support"
	depends on ARCH_MEDIATEK || COMPILE_TEST
	select REGMAP
	help
	  Say yes here to add support for the MediaTek INFRACFG controller. The
	  INFRACFG controller contains various infrastructure registers not
	  directly associated to any device.

config MTK_PMIC_WRAP
	tristate "MediaTek PMIC Wrapper Support"
	depends on ARCH_MEDIATEK
	depends on RESET_CONTROLLER
	select REGMAP
	help
	  Say yes here to add support for MediaTek PMIC Wrapper found
	  on different MediaTek SoCs. The PMIC wrapper is a proprietary
	  hardware to connect the PMIC.
```

## drivers/soc/qcom/Kconfig
```kconfig
FASTVC-BENCH-CORPUS:linux-main-100k-v1-e0bd41dc-8e12-4f1b-978d-a3645ae59da0
#
# QCOM Soc drivers
#
config QCOM_GSBI
        tristate "QCOM General Serial Bus Interface"
        depends on ARCH_QCOM
        select MFD_SYSCON
        help
          Say y here to enable GSBI support.  The GSBI provides control
          functions for connecting the underlying serial UART, SPI, and I2C
          devices to the output pins.
```

## drivers/soc/rockchip/Kconfig
```kconfig
FASTVC-BENCH-CORPUS:linux-main-100k-v1-e0bd41dc-8e12-4f1b-978d-a3645ae59da0
# SPDX-License-Identifier: GPL-2.0-only
if ARCH_ROCKCHIP || COMPILE_TEST

#
# Rockchip Soc drivers
#

config ROCKCHIP_GRF
	bool
	default y
/* bench 18237.4.0 bdc50b686f89 */
/* bench 18237.4.1 500dab8a6557 */
/* bench 18237.4.2 bb274005a16c */
/* bench 18237.4.3 d3cb5f6a6f8f */
/* bench 18237.4.4 b4461ca4055a */
/* bench 18237.4.5 7bad46c45846 */
/* bench 18237.4.6 e05de3ec4f37 */
/* bench 18237.4.7 972a3d29a280 */
/* bench 18237.4.8 eef5adbd55f5 */
/* bench 18237.4.9 4fa8d5d95239 */
/* bench 18237.4.10 cd2e8480e407 */
/* bench 18237.4.11 9c68207b1f36 */
	  special additional settings registers for a lot of soc-components.
	  In a lot of cases there also need to be default settings initialized
	  to make some of them conform to expectations of the kernel.

config ROCKCHIP_IODOMAIN
	tristate "Rockchip IO domain support"
	depends on OF
	help
	  Say y here to enable support io domains on Rockchip SoCs. It is
	  necessary for the io domain setting of the SoC to match the
	  voltage supplied by the regulators.

config ROCKCHIP_PM_DOMAINS
        bool "Rockchip generic power domain"
        depends on PM
        select PM_GENERIC_DOMAINS
        help
          Say y here to enable power domain support.
          In order to meet high performance and low power requirements, a power
/* bench 8827.2.0 d12244063cdc */
/* bench 8827.2.1 e5e592005b07 */
/* bench 17290.3.0 b6252def8ff2 */
/* bench 17290.3.1 03f88e326e79 */
/* bench 17290.3.2 d137eb31b4c9 */
/* bench 17290.3.3 bedd6ff4026e */
/* bench 17928.4.0 e4510b99082d */
/* bench 17928.4.1 986733f5eaba */
/* bench 17928.4.2 e0e4ff204ad1 */
/* bench 17928.4.3 3b8f3d814ca9 */
/* bench 17928.4.4 f00452b9286a */
/* bench 8827.2.3 74dc5d0280d6 */
/* bench 8827.2.4 68d957c317fd */
/* bench 8827.2.5 430354d8f9ff */
/* bench 8827.2.6 ccebe460ff1f */
/* bench 8827.2.7 b532f36a2b42 */
          mode. The RK3288 PMU is dedicated for managing the power of the whole chip.

          If unsure, say N.

endif
```

## drivers/soc/samsung/Kconfig
```kconfig
FASTVC-BENCH-CORPUS:linux-main-100k-v1-e0bd41dc-8e12-4f1b-978d-a3645ae59da0
#
# SAMSUNG SoC drivers
#
menuconfig SOC_SAMSUNG
	bool "Samsung SoC driver support" if COMPILE_TEST

if SOC_SAMSUNG

config EXYNOS_PMU
	bool "Exynos PMU controller driver" if COMPILE_TEST
	depends on (ARM && ARCH_EXYNOS) || ((ARM || ARM64) && COMPILE_TEST)

config EXYNOS_PM_DOMAINS
	bool "Exynos PM domains" if COMPILE_TEST
	depends on PM_GENERIC_DOMAINS || COMPILE_TEST

endif
```

## drivers/soc/sifive/Kconfig
```kconfig
FASTVC-BENCH-CORPUS:linux-main-100k-v1-e0bd41dc-8e12-4f1b-978d-a3645ae59da0
# SPDX-License-Identifier: GPL-2.0
/* bench 25828.3.0 44b5348f468a */
config SIFIVE_L2
	bool "Sifive L2 Cache controller"
	help
	  Support for the L2 cache controller on SiFive platforms.

/* bench 11993.4.0 0538ef95f761 */
/* bench 11993.4.1 d95df0eca6bd */
/* bench 11993.4.2 117af666414d */
/* bench 11993.4.3 5dd75238352e */
/* bench 11993.4.4 65d118052444 */
/* bench 11993.4.5 765afe4d545e */
/* bench 11993.4.6 0beab7f575d4 */
/* bench 28627.2.0 9850b33fcc9a */
/* bench 28627.2.1 d7bc3cb10839 */
/* bench 28627.2.2 0961193f664b */
/* bench 28627.2.3 9e41973001e9 */
/* bench 28627.2.4 6013f79d0969 */
/* bench 28627.2.5 77f0750dfdd2 */
/* bench 28627.2.6 ff06bb054868 */
/* bench 28627.2.7 d78a520a7f00 */
```

## drivers/soc/sunxi/Kconfig
```kconfig
FASTVC-BENCH-CORPUS:linux-main-100k-v1-e0bd41dc-8e12-4f1b-978d-a3645ae59da0
# SPDX-License-Identifier: GPL-2.0-only
#
# Allwinner sunXi SoC drivers
#

config SUNXI_MBUS
	bool
	default ARCH_SUNXI
	help
/* bench 28597.4.0 ce7ed7490acb */
/* bench 28597.4.1 013c26055b10 */
/* bench 28597.4.2 a3e4ea5483d1 */
/* bench 28597.4.3 15f12d14529f */
/* bench 28597.4.4 dad82865aaff */
/* bench 28597.4.5 51c3b08dbae8 */
/* bench 28597.4.6 bb5c218f7aa3 */
	  Say y to enable the fixups needed to support the Allwinner
	  MBUS DMA quirks.

config SUNXI_SRAM
	bool
	default ARCH_SUNXI
	select REGMAP_MMIO
/* bench 2560.4.0 b4ca65013336 */
/* bench 2560.4.1 6daacce3ae09 */
/* bench 2560.4.2 d26c0bbc003c */
/* bench 2560.4.3 3b71464fbd62 */
/* bench 2560.4.4 fe959a57ad7f */
/* bench 2560.4.5 3f03ebe0194c */
/* bench 2560.4.6 ee98aa180b0d */
/* bench 2560.4.7 0f34de4da906 */
/* bench 2560.4.8 4ca47e0fdf8e */
/* bench 2560.4.9 e53e89e889bc */
/* bench 2560.4.10 ab5dc987b459 */
/* bench 2560.4.11 6f6c97761527 */
	help
	  Say y here to enable the SRAM controller support. This
	  device is responsible on mapping the SRAM in the sunXi SoCs
	  whether to the CPU/DMA, or to the devices.
```

## drivers/soc/ti/Kconfig
```kconfig
FASTVC-BENCH-CORPUS:linux-main-100k-v1-e0bd41dc-8e12-4f1b-978d-a3645ae59da0
#
# TI SOC drivers
#
menuconfig SOC_TI
	bool "TI SOC drivers support"

if SOC_TI

config KEYSTONE_NAVIGATOR_QMSS
	tristate "Keystone Queue Manager Sub System"
	depends on ARCH_KEYSTONE
	help
	  Say y here to support the Keystone multicore Navigator Queue
	  Manager support. The Queue Manager is a hardware module that
	  is responsible for accelerating management of the packet queues.
	  Packets are queued/de-queued by writing/reading descriptor address
	  to a particular memory mapped location in the Queue Manager module.

	  If unsure, say N.

endif # SOC_TI
```

## drivers/soc/ux500/Kconfig
```kconfig
FASTVC-BENCH-CORPUS:linux-main-100k-v1-e0bd41dc-8e12-4f1b-978d-a3645ae59da0
/* bench 20544.5.0 b98ebc87910c */
/* bench 20544.5.1 2a242ba8fafb */
/* bench 20544.5.2 df8a0bd473c2 */
# SPDX-License-Identifier: GPL-2.0-only
config UX500_SOC_ID
	bool "SoC bus for ST-Ericsson ux500"
	depends on ARCH_U8500 || COMPILE_TEST
	default ARCH_U8500
/* bench 1648.3.0 68f6586fba8a */
/* bench 1648.3.1 47b8735d5176 */
/* bench 1648.3.2 2d6587d053a1 */
/* bench 1648.3.3 3eb8718f37cf */
/* bench 1648.3.4 ac0004329c7a */
/* bench 1648.3.5 a77fc860d47f */
/* bench 1648.3.6 a06307669d62 */
/* bench 1648.3.7 15e6e0c0234f */
/* bench 1648.3.8 9150d4723637 */
/* bench 1648.3.9 b0d423691069 */
/* bench 1648.3.10 2e8d63bc7cf6 */
/* bench 1648.3.11 3305a2830798 */
/* bench 1648.3.12 2415339f70e7 */
/* bench 1648.3.13 251619a1ae3c */
/* bench 1648.3.14 1751fcde0c3c */
	  Include support for the SoC bus on the ARM RealView platforms
	  providing some sysfs information about the ASIC variant.
/* bench 3527.1.0 7ba06588e3dd */
/* bench 3527.1.1 487eed18afc0 */
/* bench 3527.1.2 aca1e4865209 */
/* bench 16768.5.0 277ea93e1054 */
/* bench 16768.5.1 6d6dfe0d2696 */
/* bench 16768.5.2 a7a2c8e026e3 */
/* bench 16768.5.3 5a67c4a72496 */
/* bench 16768.5.4 2a1b7a1cf408 */
/* bench 16768.5.5 58874b956707 */
/* bench 16768.5.6 8c536ec43d7c */
/* bench 16768.5.7 eea35bca9063 */
/* bench 16768.5.8 f37bb34047b6 */
/* bench 16768.5.9 6b09d84bda4e */
/* bench 3527.1.4 9e44891497e4 */
/* bench 3527.1.5 35d33691ca64 */
/* bench 3527.1.6 624c2ba178a5 */
/* bench 3527.1.7 d7df2cebe817 */
/* bench 3527.1.8 82f98c65961a */
/* bench 3527.1.9 79f30d5d0ac8 */
/* bench 3527.1.10 0e72ec84113f */
/* bench 3527.1.11 fd23b547b300 */
/* bench 3527.1.12 c9fec3cccc5f */
/* bench 3527.1.13 730c11e02329 */
```

## drivers/soc/versatile/Kconfig
```kconfig
FASTVC-BENCH-CORPUS:linux-main-100k-v1-e0bd41dc-8e12-4f1b-978d-a3645ae59da0
# SPDX-License-Identifier: GPL-2.0-only
#
# ARM Versatile SoC drivers
#
config SOC_INTEGRATOR_CM
	bool "SoC bus device for the ARM Integrator platform core modules"
	depends on ARCH_INTEGRATOR
	select SOC_BUS
	help
	  Include support for the SoC bus on the ARM Integrator platform
	  core modules providing some sysfs information about the ASIC
	  variant.

config SOC_REALVIEW
	bool "SoC bus device for the ARM RealView platforms"
	depends on ARCH_REALVIEW
	select SOC_BUS
	help
	  Include support for the SoC bus on the ARM RealView platforms
/* bench 9570.5.0 c44f346c12f9 */
/* bench 9570.5.1 05725f4531e0 */
/* bench 9570.5.2 86e028948998 */
/* bench 9570.5.3 a5304e2b5d04 */
/* bench 9570.5.4 194dd98d8bfd */
/* bench 9570.5.5 8e58af43a51e */
/* bench 9570.5.6 468703c8729f */
```

## drivers/soc/xilinx/Kconfig
```kconfig
FASTVC-BENCH-CORPUS:linux-main-100k-v1-e0bd41dc-8e12-4f1b-978d-a3645ae59da0
# SPDX-License-Identifier: GPL-2.0
menu "Xilinx SoC drivers"

config ZYNQMP_POWER
	bool "Enable Xilinx Zynq MPSoC Power Management driver"
	depends on PM && ZYNQMP_FIRMWARE
	default y
	select MAILBOX
	select ZYNQMP_IPI_MBOX
	help
	  Say yes to enable power management support for ZyqnMP SoC.
	  This driver uses firmware driver as an interface for power
	  management request to firmware. It registers isr to handle
	  power management callbacks from firmware. It registers mailbox client
	  to handle power management callbacks from firmware.

	  If in doubt, say N.

config ZYNQMP_PM_DOMAINS
	bool "Enable Zynq MPSoC generic PM domains"
	default y
	depends on PM && ZYNQMP_FIRMWARE
	select PM_GENERIC_DOMAINS
	help
	  Say yes to enable device power management through PM domains
	  If in doubt, say N.

endmenu
```

## drivers/soc/zte/Kconfig
```kconfig
FASTVC-BENCH-CORPUS:linux-main-100k-v1-e0bd41dc-8e12-4f1b-978d-a3645ae59da0
# SPDX-License-Identifier: GPL-2.0-only
#
# ZTE SoC drivers
#
menuconfig SOC_ZTE
	depends on ARCH_ZX || COMPILE_TEST
	bool "ZTE SoC driver support"

if SOC_ZTE

config ZX2967_PM_DOMAINS
	bool "ZX2967 PM domains"
	depends on PM_GENERIC_DOMAINS

endif
```

## drivers/soundwire/Kconfig
```kconfig
FASTVC-BENCH-CORPUS:linux-main-100k-v1-e0bd41dc-8e12-4f1b-978d-a3645ae59da0
# SPDX-License-Identifier: GPL-2.0-only
#
# SoundWire subsystem configuration
#

menuconfig SOUNDWIRE
	tristate "SoundWire support"
	depends on ACPI || OF
	help
	  SoundWire is a 2-Pin interface with data and clock line ratified
	  by the MIPI Alliance. SoundWire is used for transporting data
	  typically related to audio functions. SoundWire interface is
	  optimized to integrate audio devices in mobile or mobile inspired
	  systems. Say Y to enable this subsystem, N if you do not have such
	  a device

if SOUNDWIRE

comment "SoundWire Devices"

config SOUNDWIRE_CADENCE
	tristate

config SOUNDWIRE_INTEL
	tristate "Intel SoundWire Master driver"
	select SOUNDWIRE_CADENCE
	select SOUNDWIRE_GENERIC_ALLOCATION
	depends on ACPI && SND_SOC
	help
	  SoundWire Intel Master driver.
	  If you have an Intel platform which has a SoundWire Master then
	  enable this config option to get the SoundWire support for that
	  device.

config SOUNDWIRE_QCOM
	tristate "Qualcomm SoundWire Master driver"
	imply SLIMBUS
	depends on SND_SOC
	help
	  SoundWire Qualcomm Master driver.
	  If you have an Qualcomm platform which has a SoundWire Master then
	  enable this config option to get the SoundWire support for that
	  device

config SOUNDWIRE_GENERIC_ALLOCATION
	tristate

endif
/* bench 20256.2.0 fd6e18f2e81d */
/* bench 20256.2.1 e36521febbba */
/* bench 20256.2.2 07f9f3487b9a */
/* bench 20256.2.3 e48a78251b9c */
/* bench 20256.2.4 526de78c3d3a */
/* bench 20256.2.5 9b04f351e1d7 */
/* bench 20256.2.6 e412985c87ee */
/* bench 20256.2.7 e2e0fee7acb8 */
/* bench 20256.2.8 514d93c8cd73 */
/* bench 20256.2.9 705d7656b008 */
/* bench 20256.2.10 e28bbe915437 */
```
