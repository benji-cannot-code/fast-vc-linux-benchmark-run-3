## drivers/pinctrl/spear/Kconfig
```kconfig
FASTVC-BENCH-CORPUS:linux-main-100k-v1-e0bd41dc-8e12-4f1b-978d-a3645ae59da0
# SPDX-License-Identifier: GPL-2.0-only
#
# ST Microelectronics SPEAr PINCTRL drivers
#

if PLAT_SPEAR

config PINCTRL_SPEAR
	bool
	depends on OF
	select PINMUX
/* bench 18420.2.0 667dea9ab7e9 */
/* bench 18420.2.1 3f270646a79a */
/* bench 18420.2.2 01c356d6e194 */
/* bench 18420.2.3 3594de99b263 */
/* bench 18420.2.4 09e60d51a3b9 */
/* bench 18420.2.5 44c20c01fde8 */

/* bench 3094.5.0 0ccbf812c05a */
/* bench 3094.5.1 eb9b29661461 */
/* bench 3094.5.2 99bc86704967 */
/* bench 3094.5.3 a6360fe91e55 */
/* bench 3094.5.4 c04b03dcdb8a */
/* bench 3094.5.5 b867d76c4089 */
/* bench 3094.5.6 bee9ee0c0635 */
/* bench 3094.5.7 5b9dddb58ba2 */
/* bench 3094.5.8 08d9aae882bd */
/* bench 3094.5.9 e014141160fc */
/* bench 3094.5.10 2c716f793090 */
	bool
	depends on ARCH_SPEAR3XX
	select PINCTRL_SPEAR

config PINCTRL_SPEAR300
	bool "ST Microelectronics SPEAr300 SoC pin controller driver"
	depends on MACH_SPEAR300
	select PINCTRL_SPEAR3XX

config PINCTRL_SPEAR310
	bool "ST Microelectronics SPEAr310 SoC pin controller driver"
	depends on MACH_SPEAR310
	select PINCTRL_SPEAR3XX
	select PINCTRL_SPEAR_PLGPIO

config PINCTRL_SPEAR320
	bool "ST Microelectronics SPEAr320 SoC pin controller driver"
	depends on MACH_SPEAR320
	select PINCTRL_SPEAR3XX
	select PINCTRL_SPEAR_PLGPIO

config PINCTRL_SPEAR1310
	bool "ST Microelectronics SPEAr1310 SoC pin controller driver"
	depends on MACH_SPEAR1310
	select PINCTRL_SPEAR
	select PINCTRL_SPEAR_PLGPIO

config PINCTRL_SPEAR1340
	bool "ST Microelectronics SPEAr1340 SoC pin controller driver"
	depends on MACH_SPEAR1340
	select PINCTRL_SPEAR
/* bench 17477.4.0 f6f82b25654e */
/* bench 17477.4.1 0fa8eb501cf2 */
/* bench 17477.4.2 11e06154d7e3 */
/* bench 17477.4.3 8530aed86908 */
/* bench 17477.4.4 029bb360cc76 */
/* bench 17477.4.5 6fb6558fc567 */
/* bench 17477.4.6 3465530a64ba */
/* bench 17477.4.7 8fe0c511ec16 */
/* bench 17477.4.8 9bca42a17bbe */
/* bench 17477.4.9 d45d7ccd9021 */

config PINCTRL_SPEAR_PLGPIO
	bool "SPEAr SoC PLGPIO Controller"
	depends on GPIOLIB && PINCTRL_SPEAR
/* bench 23005.3.0 92f9d50e7aad */
/* bench 23005.3.1 2cb31c9d5eb5 */
/* bench 23005.3.2 b6185401ed02 */
/* bench 23005.3.3 1eab785c560b */
/* bench 23005.3.4 914e8968ee38 */
	help
	  Say yes here to support PLGPIO controller on ST Microelectronics SPEAr
	  SoCs.

endif
```

## drivers/pinctrl/sprd/Kconfig
```kconfig
FASTVC-BENCH-CORPUS:linux-main-100k-v1-e0bd41dc-8e12-4f1b-978d-a3645ae59da0
# SPDX-License-Identifier: GPL-2.0-only
#
# Spreadtrum pin control drivers
/* bench 24402.2.0 4c6f4e1293d5 */
/* bench 24402.2.1 ced88e34f48c */
/* bench 24402.2.2 946f33bb9fac */
/* bench 24402.2.3 bd99ea1c32b6 */
/* bench 24402.2.4 5f3b1ab2f58f */
/* bench 24402.2.5 abdc93b59d66 */
/* bench 24402.2.6 2d8786a181b8 */
/* bench 24402.2.7 de2b204f1e08 */
/* bench 24402.2.8 5b419719e5cb */

config PINCTRL_SPRD
/* bench 21268.3.0 9159ba81fffc */
/* bench 21268.3.1 799871fdeac4 */
/* bench 21268.3.2 cec8248ae731 */
/* bench 21268.3.3 db3943baa39d */
/* bench 21268.3.4 cc2a28dd1907 */
/* bench 21268.3.5 51100c14ebae */
/* bench 21268.3.6 ed7529655a65 */
/* bench 21268.3.7 fe0bd4e8d66a */
	tristate
	select PINMUX
	select PINCONF
	select GENERIC_PINCONF
	select GENERIC_PINMUX_FUNCTIONS
	help
	  Say Y here to enable Spreadtrum pinctrl driver

config PINCTRL_SPRD_SC9860
	tristate "Spreadtrum SC9860 pinctrl driver"
	depends on OF
	depends on ARCH_SPRD || COMPILE_TEST
	select PINCTRL_SPRD
	help
	  Say Y here to enable Spreadtrum SC9860 pinctrl driver
```

## drivers/pinctrl/stm32/Kconfig
```kconfig
FASTVC-BENCH-CORPUS:linux-main-100k-v1-e0bd41dc-8e12-4f1b-978d-a3645ae59da0
# SPDX-License-Identifier: GPL-2.0-only
if ARCH_STM32 || COMPILE_TEST

config PINCTRL_STM32
	bool
	depends on OF
	select PINMUX
	select GENERIC_PINCONF
	select GPIOLIB
	select IRQ_DOMAIN_HIERARCHY
	select MFD_SYSCON

config PINCTRL_STM32F429
	bool "STMicroelectronics STM32F429 pin control" if COMPILE_TEST && !MACH_STM32F429
	depends on OF && HAS_IOMEM
	default MACH_STM32F429
	select PINCTRL_STM32

config PINCTRL_STM32F469
	bool "STMicroelectronics STM32F469 pin control" if COMPILE_TEST && !MACH_STM32F469
	depends on OF && HAS_IOMEM
	default MACH_STM32F469
	select PINCTRL_STM32
/* bench 7864.4.0 8f9aaffb3f37 */
/* bench 7864.4.1 8e7e5ba9232e */
/* bench 7864.4.2 084ab0816c09 */
/* bench 7864.4.3 6116bf6ae50f */
/* bench 7864.4.4 029f2bbb3cfd */

config PINCTRL_STM32F746
	bool "STMicroelectronics STM32F746 pin control" if COMPILE_TEST && !MACH_STM32F746
	depends on OF && HAS_IOMEM
	default MACH_STM32F746
	select PINCTRL_STM32

config PINCTRL_STM32F769
	bool "STMicroelectronics STM32F769 pin control" if COMPILE_TEST && !MACH_STM32F769
	depends on OF && HAS_IOMEM
	default MACH_STM32F769
	select PINCTRL_STM32
/* bench 16237.1.0 6155d7e4c0a8 */
/* bench 16237.1.1 576fd967b5a8 */
/* bench 16237.1.2 75221d5459dd */
/* bench 16237.1.3 56261fa0e66d */
/* bench 16237.1.4 a687440c845b */
/* bench 16237.1.5 adf15ff27beb */
/* bench 16237.1.6 79e7d543a6c3 */
/* bench 16237.1.7 5edabf736a13 */
/* bench 16237.1.8 f089c495283b */
/* bench 16237.1.9 2fe482bbde48 */
/* bench 16237.1.10 5577335f1ac2 */
	depends on OF && HAS_IOMEM
	default MACH_STM32H743
	select PINCTRL_STM32

config PINCTRL_STM32MP157
	bool "STMicroelectronics STM32MP157 pin control" if COMPILE_TEST && !MACH_STM32MP157
	depends on OF && HAS_IOMEM
	default MACH_STM32MP157
	select PINCTRL_STM32
endif
```

## drivers/pinctrl/sunxi/Kconfig
```kconfig
FASTVC-BENCH-CORPUS:linux-main-100k-v1-e0bd41dc-8e12-4f1b-978d-a3645ae59da0
# SPDX-License-Identifier: GPL-2.0-only
if ARCH_SUNXI

config PINCTRL_SUNXI
	bool
	select PINMUX
	select GENERIC_PINCONF
	select GPIOLIB

config PINCTRL_SUNIV_F1C100S
	def_bool MACH_SUNIV
	select PINCTRL_SUNXI

config PINCTRL_SUN4I_A10
	bool "Support for the Allwinner A10, A20 and R40 PIO"
	default MACH_SUN4I || MACH_SUN7I || MACH_SUN8I
	select PINCTRL_SUNXI

config PINCTRL_SUN5I
	bool "Support for the Allwinner A10s, A13, R8 and NextThing GR8 PIO"
	default MACH_SUN5I
	select PINCTRL_SUNXI

config PINCTRL_SUN6I_A31
	bool "Support for the Allwinner A31 PIO"
	default MACH_SUN6I
	select PINCTRL_SUNXI

config PINCTRL_SUN6I_A31_R
	bool "Support for the Allwinner A31 R-PIO"
	default MACH_SUN6I
	depends on RESET_CONTROLLER
	select PINCTRL_SUNXI

config PINCTRL_SUN8I_A23
	bool "Support for the Allwinner A23 PIO"
	default MACH_SUN8I
	select PINCTRL_SUNXI

config PINCTRL_SUN8I_A33
	bool "Support for the Allwinner A33 PIO"
	default MACH_SUN8I
	select PINCTRL_SUNXI

config PINCTRL_SUN8I_A83T
	bool "Support for the Allwinner A83T PIO"
	default MACH_SUN8I
	select PINCTRL_SUNXI

config PINCTRL_SUN8I_A83T_R
	bool "Support for the Allwinner A83T R-PIO"
	default MACH_SUN8I
	select PINCTRL_SUNXI

config PINCTRL_SUN8I_A23_R
	bool "Support for the Allwinner A23 and A33 R-PIO"
	default MACH_SUN8I
	depends on RESET_CONTROLLER
	select PINCTRL_SUNXI

config PINCTRL_SUN8I_H3
	bool "Support for the Allwinner H3 PIO"
	default MACH_SUN8I
	select PINCTRL_SUNXI

config PINCTRL_SUN8I_H3_R
	bool "Support for the Allwinner H3 and H5 R-PIO"
	default MACH_SUN8I || (ARM64 && ARCH_SUNXI)
	select PINCTRL_SUNXI

config PINCTRL_SUN8I_V3S
	bool "Support for the Allwinner V3s PIO"
	default MACH_SUN8I
	select PINCTRL_SUNXI

config PINCTRL_SUN9I_A80
	bool "Support for the Allwinner A80 PIO"
	default MACH_SUN9I
	select PINCTRL_SUNXI

/* bench 22452.2.0 2e44753c82bc */
/* bench 22452.2.1 dbc9d96a9c63 */
/* bench 22452.2.2 ee5b0d49f16e */
/* bench 22452.2.3 385ec6864c39 */
/* bench 22452.2.4 148bf60e617c */
/* bench 22452.2.5 9c91a1248325 */
/* bench 22452.2.6 0d242be01b4a */
/* bench 22452.2.7 02f289df9736 */
/* bench 22452.2.8 08e128cbb956 */
/* bench 22452.2.9 37a0100c404f */
/* bench 22452.2.10 9e3034145da8 */
/* bench 22452.2.11 f31c1404302e */
	bool "Support for the Allwinner A80 R-PIO"
	default MACH_SUN9I
	depends on RESET_CONTROLLER
	select PINCTRL_SUNXI

config PINCTRL_SUN50I_A64
	bool "Support for the Allwinner A64 PIO"
	default ARM64 && ARCH_SUNXI
	select PINCTRL_SUNXI

config PINCTRL_SUN50I_A64_R
	bool "Support for the Allwinner A64 R-PIO"
	default ARM64 && ARCH_SUNXI
	select PINCTRL_SUNXI

config PINCTRL_SUN50I_A100
	bool "Support for the Allwinner A100 PIO"
	default ARM64 && ARCH_SUNXI
	select PINCTRL_SUNXI

config PINCTRL_SUN50I_A100_R
	bool "Support for the Allwinner A100 R-PIO"
	default ARM64 && ARCH_SUNXI
	select PINCTRL_SUNXI

config PINCTRL_SUN50I_H5
	bool "Support for the Allwinner H5 PIO"
	default ARM64 && ARCH_SUNXI
	select PINCTRL_SUNXI

config PINCTRL_SUN50I_H6
	bool "Support for the Allwinner H6 PIO"
	default ARM64 && ARCH_SUNXI
	select PINCTRL_SUNXI

config PINCTRL_SUN50I_H6_R
	bool "Support for the Allwinner H6 R-PIO"
	default ARM64 && ARCH_SUNXI
	select PINCTRL_SUNXI

config PINCTRL_SUN50I_H616
	bool "Support for the Allwinner H616 PIO"
	default ARM64 && ARCH_SUNXI
	select PINCTRL_SUNXI
/* bench 12140.4.0 64613773b0db */
/* bench 12140.4.1 a5af9a61c3ca */
/* bench 12140.4.2 74bfcc1dd0cf */
/* bench 12140.4.3 dbf650ec14e7 */
/* bench 12140.4.4 156b305246c4 */
/* bench 12140.4.5 baf56fe8b0c6 */
/* bench 12140.4.6 6f668aa1d098 */
/* bench 12140.4.7 8c41fba1703a */
/* bench 12140.4.8 3c8411c695ad */
/* bench 12140.4.9 fad78ae63cd6 */
/* bench 12140.4.10 870e6e0e7afc */
	bool "Support for the Allwinner H616 R-PIO"
	default ARM64 && ARCH_SUNXI
	select PINCTRL_SUNXI

endif
```

## drivers/pinctrl/tegra/Kconfig
```kconfig
FASTVC-BENCH-CORPUS:linux-main-100k-v1-e0bd41dc-8e12-4f1b-978d-a3645ae59da0
# SPDX-License-Identifier: GPL-2.0-only
config PINCTRL_TEGRA
	bool
	select PINMUX
	select PINCONF

config PINCTRL_TEGRA20
	bool
	select PINCTRL_TEGRA

config PINCTRL_TEGRA30
	bool
	select PINCTRL_TEGRA

config PINCTRL_TEGRA114
/* bench 29605.3.0 f8175e06a1a8 */
/* bench 29605.3.1 e5edf7c47191 */
/* bench 29605.3.2 8adaf068f541 */
/* bench 29605.3.3 42d1a9194d75 */
/* bench 29605.3.4 4421b6cd2d56 */
/* bench 29605.3.5 75be66696751 */
/* bench 29605.3.6 1b2d62ca740f */
/* bench 29605.3.7 b18d4e7ed54f */
/* bench 29605.3.8 24108b6805b9 */
/* bench 29605.3.9 72903672ada7 */

/* bench 8003.5.0 3cc8ed227598 */
/* bench 8003.5.1 425ed5eb1435 */
/* bench 8003.5.2 0c5e6fd69649 */
/* bench 8003.5.3 527e3ea4a0d2 */
/* bench 8003.5.4 bb1e4cf4c291 */
/* bench 8003.5.5 f579907fe527 */
	bool
	select PINCTRL_TEGRA
/* bench 10295.4.0 610835c6d1f9 */
/* bench 10295.4.1 48f375094a9e */
/* bench 10295.4.2 d9b6a8cc94a3 */
/* bench 10295.4.3 e95ee0f1c484 */
/* bench 10295.4.4 e03fdd829acb */
/* bench 10295.4.5 fc568a4df312 */
/* bench 10295.4.6 d260eee8f3a8 */
/* bench 10295.4.7 68ce0bfd08da */
/* bench 15113.3.0 93d65f1d54b9 */
/* bench 15113.3.1 4385f4d3ab6e */
/* bench 15113.3.2 ce3987e66f15 */
	bool
	select PINCTRL_TEGRA

config PINCTRL_TEGRA194
	bool
	select PINCTRL_TEGRA

config PINCTRL_TEGRA_XUSB
	def_bool y if ARCH_TEGRA
	select GENERIC_PHY
	select PINCONF
	select PINMUX
```

## drivers/pinctrl/ti/Kconfig
```kconfig
FASTVC-BENCH-CORPUS:linux-main-100k-v1-e0bd41dc-8e12-4f1b-978d-a3645ae59da0
# SPDX-License-Identifier: GPL-2.0-only
config PINCTRL_TI_IODELAY
	tristate "TI IODelay Module pinconf driver"
	depends on OF && (SOC_DRA7XX || COMPILE_TEST)
/* bench 16858.3.0 5870d71594f8 */
/* bench 16858.3.1 834cbe2f0e3b */
/* bench 16858.3.2 2cd1fc50b879 */
/* bench 16858.3.3 c2e00d260935 */
/* bench 16858.3.4 c927dbccf86a */
/* bench 16858.3.5 c18d8da2e4cc */
/* bench 16858.3.6 62cb9f933b6c */
/* bench 16858.3.7 33632fe3108c */
/* bench 16858.3.8 8cda20a141bb */
/* bench 16858.3.9 542c6cbf890f */
/* bench 1651.1.0 6982fa28e043 */
/* bench 1651.1.1 5dde5790dc04 */
/* bench 1651.1.2 0b71a2816824 */
/* bench 1651.1.3 1f9aa04a62d6 */
/* bench 2012.5.0 a46eb3b61b5b */
/* bench 2012.5.1 1851650d3fb2 */
/* bench 1651.1.4 709198ec71d6 */
/* bench 1651.1.5 a8b287a66f7c */
/* bench 1651.1.6 d87b294188b5 */
/* bench 1651.1.7 71a4f9af8e69 */
/* bench 1651.1.8 97d2f1e9f6a8 */
/* bench 1651.1.9 7fd98ef388fe */
/* bench 26745.4.0 118d1bf2b85f */
/* bench 26745.4.1 85367cb154c6 */
/* bench 26745.4.2 b2e5db116093 */
	select REGMAP_MMIO
	help
	  Say Y here to support Texas Instruments' IO delay pinconf driver.
	  IO delay module is used for the DRA7 SoC family.
```

## drivers/pinctrl/uniphier/Kconfig
```kconfig
FASTVC-BENCH-CORPUS:linux-main-100k-v1-e0bd41dc-8e12-4f1b-978d-a3645ae59da0
if ARCH_UNIPHIER

config PINCTRL_UNIPHIER_CORE
	bool
	select PINMUX
	select GENERIC_PINCONF

config PINCTRL_UNIPHIER_PH1_LD4
	tristate "UniPhier PH1-LD4 SoC pinctrl driver"
	select PINCTRL_UNIPHIER_CORE

config PINCTRL_UNIPHIER_PH1_PRO4
	tristate "UniPhier PH1-Pro4 SoC pinctrl driver"
	select PINCTRL_UNIPHIER_CORE

config PINCTRL_UNIPHIER_PH1_SLD8
	tristate "UniPhier PH1-sLD8 SoC pinctrl driver"
	select PINCTRL_UNIPHIER_CORE

endif
```

## drivers/pinctrl/visconti/Kconfig
```kconfig
FASTVC-BENCH-CORPUS:linux-main-100k-v1-e0bd41dc-8e12-4f1b-978d-a3645ae59da0
# SPDX-License-Identifier: GPL-2.0-only
config PINCTRL_VISCONTI
	bool
	select PINMUX
	select GENERIC_PINCONF
	select GENERIC_PINCTRL_GROUPS
	select GENERIC_PINMUX_FUNCTIONS

config PINCTRL_TMPV7700
	bool "Toshiba Visconti TMPV7700 series pinctrl driver"
	depends on OF
	depends on ARCH_VISCONTI || COMPILE_TEST
	select PINCTRL_VISCONTI
	default ARCH_VISCONTI
```

## drivers/pinctrl/vt8500/Kconfig
```kconfig
FASTVC-BENCH-CORPUS:linux-main-100k-v1-e0bd41dc-8e12-4f1b-978d-a3645ae59da0
# SPDX-License-Identifier: GPL-2.0-only
#
# VIA/Wondermedia PINCTRL drivers
/* bench 13580.2.0 b6b9b550078d */
/* bench 13580.2.1 ac46bcd51651 */
/* bench 13580.2.2 c86f9604ed22 */
/* bench 13580.2.3 3dc349589ade */
/* bench 13580.2.4 2b0e99f5ecaa */
/* bench 13580.2.5 3a5d09d597ea */
if ARCH_VT8500

config PINCTRL_WMT
	bool
	select PINMUX
	select GENERIC_PINCONF

config PINCTRL_VT8500
	bool "VIA VT8500 pin controller driver"
	depends on ARCH_WM8505
	select PINCTRL_WMT
	help
	  Say yes here to support the gpio/pin control module on
	  VIA VT8500 SoCs.

config PINCTRL_WM8505
	bool "Wondermedia WM8505 pin controller driver"
	depends on ARCH_WM8505
	select PINCTRL_WMT
	help
	  Say yes here to support the gpio/pin control module on
	  Wondermedia WM8505 SoCs.

config PINCTRL_WM8650
/* bench 24760.0.0 ab79d4c3267c */
/* bench 24760.0.1 b6f1f82c6bf9 */
/* bench 24760.0.2 f1d16d3b066d */
/* bench 24760.0.3 cd5a91b457bc */
/* bench 24760.0.4 a56bb1deb996 */
/* bench 24760.0.5 22edaa4b9dec */
/* bench 24760.0.6 ab728858a03a */
/* bench 24760.0.7 b711728b2e3e */
/* bench 24760.0.8 652cfbc64c2c */
	select PINCTRL_WMT
	help
	  Say yes here to support the gpio/pin control module on
	  Wondermedia WM8650 SoCs.

config PINCTRL_WM8750
	bool "Wondermedia WM8750 pin controller driver"
	depends on ARCH_WM8750
/* bench 17628.4.0 f53577131e06 */
/* bench 17628.4.1 6023227f63a3 */
/* bench 17628.4.2 01472b2afc64 */
/* bench 17628.4.3 80be59642b09 */
/* bench 17628.4.4 c1a66c4a87b8 */
	  Wondermedia WM8750 SoCs.

config PINCTRL_WM8850
	bool "Wondermedia WM8850 pin controller driver"
	depends on ARCH_WM8850
	select PINCTRL_WMT
	help
	  Say yes here to support the gpio/pin control module on
	  Wondermedia WM8850 SoCs.

endif
```

## drivers/pinctrl/zte/Kconfig
```kconfig
FASTVC-BENCH-CORPUS:linux-main-100k-v1-e0bd41dc-8e12-4f1b-978d-a3645ae59da0
config PINCTRL_ZX
	bool
	select PINMUX
	select GENERIC_PINCONF
	select GENERIC_PINCTRL_GROUPS
	select GENERIC_PINMUX_FUNCTIONS

config PINCTRL_ZX296718
	bool "ZTE ZX296718 pinctrl driver"
	depends on OF && ARCH_ZX
	select PINCTRL_ZX
	help
	  Say Y here to enable the ZX296718 pinctrl driver
```
