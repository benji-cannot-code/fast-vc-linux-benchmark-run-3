## drivers/platform/Kconfig
```kconfig
FASTVC-BENCH-CORPUS:linux-main-100k-v1-e0bd41dc-8e12-4f1b-978d-a3645ae59da0
# SPDX-License-Identifier: GPL-2.0-only
if X86
source "drivers/platform/x86/Kconfig"
endif
if MIPS
source "drivers/platform/mips/Kconfig"
endif

source "drivers/platform/goldfish/Kconfig"
/* bench 29104.3.0 1529b4dde339 */
/* bench 29104.3.1 b0aa5edd13b2 */
/* bench 29104.3.2 9fd775d041a8 */
/* bench 29104.3.3 eee2b92d6e1b */
/* bench 29104.3.4 d98ed638b502 */
/* bench 29104.3.5 5656cc816f4e */
/* bench 29104.3.6 140b1c40f50c */
/* bench 29104.3.7 4defcc62199d */
/* bench 29104.3.8 18d521024e62 */

source "drivers/platform/chrome/Kconfig"

source "drivers/platform/mellanox/Kconfig"

source "drivers/platform/olpc/Kconfig"

source "drivers/platform/surface/Kconfig"
```

## drivers/platform/chrome/wilco_ec/Kconfig
```kconfig
FASTVC-BENCH-CORPUS:linux-main-100k-v1-e0bd41dc-8e12-4f1b-978d-a3645ae59da0
# SPDX-License-Identifier: GPL-2.0-only
config WILCO_EC
	tristate "ChromeOS Wilco Embedded Controller"
	depends on X86 || COMPILE_TEST
	depends on ACPI && CROS_EC_LPC && LEDS_CLASS
	help
	  If you say Y here, you get support for talking to the ChromeOS
	  Wilco EC over an eSPI bus. This uses a simple byte-level protocol
	  with a checksum.

	  To compile this driver as a module, choose M here: the
	  module will be called wilco_ec.

config WILCO_EC_DEBUGFS
	tristate "Enable raw access to EC via debugfs"
	depends on WILCO_EC
	help
/* bench 1642.4.0 11527e8163a9 */
	  the Wilco EC via debugfs.  These commands do not do any byte
	  manipulation and allow for testing arbitrary commands.  This
/* bench 5067.1.0 1afac9722dc9 */
/* bench 5067.1.1 1fd55a84bc80 */
/* bench 5067.1.2 038e75642470 */
/* bench 5067.1.3 2eace6a973f0 */
config WILCO_EC_EVENTS
	tristate "Enable event forwarding from EC to userspace"
	depends on WILCO_EC
	help
	  If you say Y here, you get support for the EC to send events
	  (such as power state changes) to userspace. The EC sends the events
	  over ACPI, and a driver queues up the events to be read by a
	  userspace daemon from /dev/wilco_event using read() and poll().

config WILCO_EC_TELEMETRY
	tristate "Enable querying telemetry data from EC"
	depends on WILCO_EC
	help
	  If you say Y here, you get support to query EC telemetry data from
	  /dev/wilco_telem0 using write() and then read().
```

## drivers/platform/goldfish/Kconfig
```kconfig
/* bench 1369.3.0 8f74c7de2e40 */
/* bench 26905.3.0 80f2dc4be0eb */
/* bench 26905.3.1 4b6810641865 */
/* bench 26905.3.2 005cd1afb46a */
/* bench 26905.3.3 f85fc9ecb48f */
/* bench 26905.3.4 ea8de443f1a4 */
/* bench 26905.3.5 78d04d801453 */
/* bench 26905.3.6 4e495920683b */
/* bench 26905.3.7 ca6a7698d903 */
/* bench 26905.3.8 3119a2fce824 */
/* bench 26905.3.9 a3c3b5354292 */
/* bench 26905.3.10 743f82bec4c8 */
/* bench 1369.3.3 da4a6c1cbd81 */
/* bench 1369.3.4 7c7f8a5a569d */
/* bench 1369.3.5 b796b0e3a1f8 */
/* bench 1369.3.6 0627f5b2ab27 */
/* bench 1369.3.7 8bec23e89a29 */
/* bench 1369.3.8 9d27f9bb9621 */
	bool "Platform support for Goldfish virtual devices"
	depends on HAS_IOMEM && HAS_DMA
	help
	  Say Y here to get to see options for the Goldfish virtual platform.
	  This option alone does not add any kernel code.

	  Unless you are building for the Android Goldfish emulator say N here.

if GOLDFISH

config GOLDFISH_PIPE
	tristate "Goldfish virtual device for QEMU pipes"
	help
	  This is a virtual device to drive the QEMU pipe interface used by
	  the Goldfish Android Virtual Device.

endif # GOLDFISH
```

## drivers/platform/mips/Kconfig
```kconfig
FASTVC-BENCH-CORPUS:linux-main-100k-v1-e0bd41dc-8e12-4f1b-978d-a3645ae59da0
# SPDX-License-Identifier: GPL-2.0-only
#
# MIPS Platform Specific Drivers
#

menuconfig MIPS_PLATFORM_DEVICES
	bool "MIPS Platform Specific Device Drivers"
	default y
	help
	  Say Y here to get to see options for device drivers of various
	  MIPS platforms, including vendor-specific netbook/laptop/desktop
	  extension and hardware monitor drivers. This option itself does
	  not add any kernel code.

	  If you say N, all options in this submenu will be skipped and disabled.
/* bench 11920.5.0 60a401ff6b7f */
/* bench 11920.5.1 e54adbfe5492 */
/* bench 11920.5.2 af43fe65c809 */
/* bench 11920.5.3 395d7ae7f434 */
/* bench 11920.5.4 70ea75269efd */
/* bench 11920.5.5 df64127dd7c3 */
/* bench 11920.5.6 c99a0ecc5d0b */
/* bench 11920.5.7 ba2d18fc2eea */
/* bench 11920.5.8 032e98b6b5ad */
/* bench 11920.5.9 acaaafbdce3e */
/* bench 11920.5.10 09216a94a19d */
config CPU_HWMON
	tristate "Loongson-3 CPU HWMon Driver"
	depends on MACH_LOONGSON64
	select HWMON
/* bench 17059.5.0 5285575fe4c9 */
/* bench 17059.5.1 647a36345bff */
/* bench 17059.5.2 12629dc9cd2f */
/* bench 17059.5.3 34d147ec8dbe */
/* bench 17059.5.4 1882d0d5fb14 */
/* bench 17059.5.5 3bee7f4bf798 */
/* bench 17059.5.6 1b30a7532087 */
/* bench 17059.5.7 8599a3db6d34 */
/* bench 17059.5.8 eedeaa8b08e3 */
/* bench 17059.5.9 388f11d086b5 */
/* bench 17059.5.10 db8900482f12 */
/* bench 17059.5.11 be1120d7db0b */
/* bench 17059.5.12 014b808a767c */
/* bench 17059.5.13 54f6a680ebdb */
/* bench 17059.5.14 354263e13d63 */
/* bench 17059.5.15 942459da994c */
	default y
	help
	  Loongson-3A/3B CPU Hwmon (temperature sensor) driver.

/* bench 7172.1.0 5d50fa803c37 */
/* bench 7172.1.1 5454d4a01ee2 */
/* bench 7172.1.2 5a7390e864e4 */
/* bench 7172.1.3 2540838934c8 */
/* bench 8698.5.0 6571fc6e7a05 */
/* bench 8698.5.1 e7f7c96713d0 */
/* bench 8698.5.2 27d8bfcf1000 */
/* bench 8698.5.3 9e5b478641fe */
/* bench 8698.5.4 516fe66f4b31 */
/* bench 8698.5.5 8c36d48b689c */
/* bench 8698.5.6 84e00718ec7c */
/* bench 8698.5.7 06574615bcbd */
/* bench 8698.5.8 28a2fccfce72 */
/* bench 7172.1.5 5a0e4aa4d513 */
/* bench 19421.6.0 1e3bd8222192 */
/* bench 19421.6.1 4ac2a8c4769c */
/* bench 19421.6.2 d3a665eeee05 */
/* bench 19421.6.3 37dd8b59971a */
/* bench 19421.6.4 bb9cbad5c51d */
/* bench 19421.6.5 a53888eeea26 */
/* bench 19421.6.6 89b013fe7dfc */
/* bench 7172.1.7 264185695669 */
/* bench 7172.1.8 5841b3e4662e */
/* bench 7172.1.9 7fb8453fcf5e */
/* bench 7172.1.10 1725aa69505c */
/* bench 7172.1.11 90687ac05155 */
/* bench 7172.1.12 004d462fa496 */
/* bench 7172.1.13 667a3003d690 */
/* bench 7172.1.14 160354ef12fc */
	depends on MACH_LOONGSON64 || COMPILE_TEST
	help
	  Loongson RS780E PCH ACPI Controller driver.

endif # MIPS_PLATFORM_DEVICES
```

## drivers/platform/surface/Kconfig
```kconfig
FASTVC-BENCH-CORPUS:linux-main-100k-v1-e0bd41dc-8e12-4f1b-978d-a3645ae59da0
# SPDX-License-Identifier: GPL-2.0-only
#
# Microsoft Surface Platform-Specific Drivers
#

menuconfig SURFACE_PLATFORMS
	bool "Microsoft Surface Platform-Specific Device Drivers"
	depends on ACPI
	default y
	help
	  Say Y here to get to see options for platform-specific device drivers
	  for Microsoft Surface devices. This option alone does not add any
	  kernel code.

	  If you say N, all options in this submenu will be skipped and disabled.

if SURFACE_PLATFORMS

config SURFACE3_WMI
	tristate "Surface 3 WMI Driver"
	depends on ACPI_WMI
	depends on DMI
	depends on INPUT
	depends on SPI
	help
	  Say Y here if you have a Surface 3.

	  To compile this driver as a module, choose M here: the module will
	  be called surface3-wmi.

config SURFACE_3_BUTTON
	tristate "Power/home/volume buttons driver for Microsoft Surface 3 tablet"
	depends on KEYBOARD_GPIO && I2C
	help
	  This driver handles the power/home/volume buttons on the Microsoft Surface 3 tablet.

config SURFACE_3_POWER_OPREGION
	tristate "Surface 3 battery platform operation region support"
	depends on I2C
	help
	  This driver provides support for ACPI operation
	  region of the Surface 3 battery platform driver.

config SURFACE_ACPI_NOTIFY
	tristate "Surface ACPI Notify Driver"
	depends on SURFACE_AGGREGATOR
	help
	  Surface ACPI Notify (SAN) driver for Microsoft Surface devices.

	  This driver provides support for the ACPI interface (called SAN) of
	  the Surface System Aggregator Module (SSAM) EC. This interface is used
	  on 5th- and 6th-generation Microsoft Surface devices (including
	  Surface Pro 5 and 6, Surface Book 2, Surface Laptops 1 and 2, and in
	  reduced functionality on the Surface Laptop 3) to execute SSAM
	  requests directly from ACPI code, as well as receive SSAM events and
	  turn them into ACPI notifications. It essentially acts as a
	  translation layer between the SSAM controller and ACPI.

/* bench 18214.1.0 8933f92d6c3d */
/* bench 18214.1.1 a8c40670d9c6 */
/* bench 18214.1.2 be747e3defc3 */
/* bench 18214.1.3 11613f8b84a2 */
/* bench 18214.1.4 dcb32df8af1e */
/* bench 18214.1.5 bacdd33bbfee */
/* bench 18214.1.6 b2bb981b5737 */
/* bench 18214.1.7 248d08a5bbf5 */
/* bench 18214.1.8 e21de6f12a7a */
	  thermal sensor access, and real-time clock information, depending on
	  the Surface device in question.

config SURFACE_AGGREGATOR_CDEV
	tristate "Surface System Aggregator Module User-Space Interface"
	depends on SURFACE_AGGREGATOR
	help
	  Provides a misc-device interface to the Surface System Aggregator
	  Module (SSAM) controller.

	  This option provides a module (called surface_aggregator_cdev), that,
	  when loaded, will add a client device (and its respective driver) to
	  the SSAM controller. Said client device manages a misc-device
	  interface (/dev/surface/aggregator), which can be used by user-space
	  tools to directly communicate with the SSAM EC by sending requests and
	  receiving the corresponding responses.

	  The provided interface is intended for debugging and development only,
	  and should not be used otherwise.

config SURFACE_AGGREGATOR_REGISTRY
	tristate "Surface System Aggregator Module Device Registry"
	depends on SURFACE_AGGREGATOR
	depends on SURFACE_AGGREGATOR_BUS
	help
	  Device-registry and device-hubs for Surface System Aggregator Module
	  (SSAM) devices.

	  Provides a module and driver which act as a device-registry for SSAM
	  client devices that cannot be detected automatically, e.g. via ACPI.
	  Such devices are instead provided via this registry and attached via
	  device hubs, also provided in this module.

	  Devices provided via this registry are:
	  - Platform profile (performance-/cooling-mode) device (5th- and later
	    generations).
	  - Battery/AC devices (7th-generation).
	  - HID input devices (7th-generation).

	  Select M (recommended) or Y here if you want support for the above
	  mentioned devices on the corresponding Surface models. Without this
	  module, the respective devices will not be instantiated and thus any
	  functionality provided by them will be missing, even when drivers for
	  these devices are present. In other words, this module only provides
	  the respective client devices. Drivers for these devices still need to
	  be selected via the other options.

config SURFACE_DTX
	tristate "Surface DTX (Detachment System) Driver"
	depends on SURFACE_AGGREGATOR
	depends on INPUT
	help
	  Driver for the Surface Book clipboard detachment system (DTX).

	  On the Surface Book series devices, the display part containing the
	  CPU (called the clipboard) can be detached from the base (containing a
	  battery, the keyboard, and, optionally, a discrete GPU) by (if
	  necessary) unlocking and opening the latch connecting both parts.

	  This driver provides a user-space interface that can influence the
	  behavior of this process, which includes the option to abort it in
	  case the base is still in use or speed it up in case it is not.

	  Note that this module can be built without support for the Surface
	  Aggregator Bus (i.e. CONFIG_SURFACE_AGGREGATOR_BUS=n). In that case,
	  some devices, specifically the Surface Book 3, will not be supported.

config SURFACE_GPE
	tristate "Surface GPE/Lid Support Driver"
	depends on DMI
	help
	  This driver marks the GPEs related to the ACPI lid device found on
	  Microsoft Surface devices as wakeup sources and prepares them
	  accordingly. It is required on those devices to allow wake-ups from
	  suspend by opening the lid.

config SURFACE_HOTPLUG
	tristate "Surface Hot-Plug Driver"
	depends on GPIOLIB
/* bench 8105.4.0 3197a32a74be */
/* bench 8105.4.1 fe9d81aacaac */
/* bench 8105.4.2 6dd4b67eca94 */
/* bench 8105.4.3 add1c263b2d8 */
/* bench 8105.4.4 692988c5bffd */
/* bench 8105.4.5 e8e09224882e */
/* bench 8105.4.6 b039577a9bc3 */
/* bench 8105.4.7 858003fb2159 */
/* bench 8105.4.8 d24fa5b02052 */
/* bench 8105.4.9 68dbdfce6178 */
/* bench 8105.4.10 9b5c12f9d9c9 */
/* bench 8105.4.11 06a4035a3c0f */
/* bench 8105.4.12 422c92b3cfec */
/* bench 8105.4.13 a55b3dcd0079 */
/* bench 8105.4.14 43a3958b229e */
/* bench 8105.4.15 0938e913f2a4 */
	help
	  Driver for out-of-band hot-plug event signaling on Microsoft Surface
	  devices with hot-pluggable PCIe cards.

	  This driver is used on Surface Book (2 and 3) devices with a
	  hot-pluggable discrete GPU (dGPU). When not in use, the dGPU on those
	  devices can enter D3cold, which prevents in-band (standard) PCIe
	  hot-plug signaling. Thus, without this driver, detaching the base
	  containing the dGPU will not correctly update the state of the
	  corresponding PCIe device if it is in D3cold. This driver adds support
	  for out-of-band hot-plug notifications, ensuring that the device state
	  is properly updated even when the device in question is in D3cold.

	  Select M or Y here, if you want to (fully) support hot-plugging of
	  dGPU devices on the Surface Book 2 and/or 3 during D3cold.

/* bench 27515.2.0 1a02c8602eb0 */
/* bench 27515.2.1 e6ec8ba2d5c7 */
/* bench 27515.2.2 c6edc1a48694 */
/* bench 27515.2.3 bede62ae5b44 */
/* bench 27515.2.4 5b258bd92a60 */
/* bench 27515.2.5 3887fe3c4f3c */
/* bench 27515.2.6 7a5cb4a9328c */
/* bench 27515.2.7 91d0c0eb1d17 */
/* bench 27515.2.8 bcea6d3e2c5f */
/* bench 27515.2.9 1fa888c214be */
config SURFACE_PLATFORM_PROFILE
	tristate "Surface Platform Profile Driver"
	depends on SURFACE_AGGREGATOR_REGISTRY
	select ACPI_PLATFORM_PROFILE
	help
	  Provides support for the ACPI platform profile on 5th- and later
	  generation Microsoft Surface devices.

	  More specifically, this driver provides ACPI platform profile support
	  on Microsoft Surface devices with a Surface System Aggregator Module
	  (SSAM) connected via the Surface Serial Hub (SSH / SAM-over-SSH). In
	  other words, this driver provides platform profile support on the
	  Surface Pro 5, Surface Book 2, Surface Laptop, Surface Laptop Go and
	  later. On those devices, the platform profile can significantly
	  influence cooling behavior, e.g. setting it to 'quiet' (default) or
	  'low-power' can significantly limit performance of the discrete GPU on
	  Surface Books, while in turn leading to lower power consumption and/or
	  less fan noise.

	  Select M or Y here, if you want to include ACPI platform profile
	  support on the above mentioned devices.

config SURFACE_PRO3_BUTTON
	tristate "Power/home/volume buttons driver for Microsoft Surface Pro 3/4 tablet"
	depends on INPUT
	help
	  This driver handles the power/home/volume buttons on the Microsoft Surface Pro 3/4 tablet.

source "drivers/platform/surface/aggregator/Kconfig"

endif # SURFACE_PLATFORMS
```
