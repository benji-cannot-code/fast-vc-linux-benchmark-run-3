## drivers/pinctrl/bcm/Kconfig
```kconfig
FASTVC-BENCH-CORPUS:linux-main-100k-v1-e0bd41dc-8e12-4f1b-978d-a3645ae59da0
#
# Broadcom pinctrl drivers
#

config PINCTRL_BCM281XX
	bool "Broadcom BCM281xx pinctrl driver"
	depends on OF && (ARCH_BCM_MOBILE || COMPILE_TEST)
	select PINMUX
	select PINCONF
	select GENERIC_PINCONF
	select REGMAP_MMIO
	help
	  Say Y here to support Broadcom BCM281xx pinctrl driver, which is used
	  for the BCM281xx SoC family, including BCM11130, BCM11140, BCM11351,
	  BCM28145, and BCM28155 SoCs.  This driver requires the pinctrl
	  framework.  GPIO is provided by a separate GPIO driver.

config PINCTRL_BCM2835
	bool
	select PINMUX
	select PINCONF
```

## drivers/pinctrl/berlin/Kconfig
```kconfig
FASTVC-BENCH-CORPUS:linux-main-100k-v1-e0bd41dc-8e12-4f1b-978d-a3645ae59da0
# SPDX-License-Identifier: GPL-2.0-only
if (ARCH_BERLIN || COMPILE_TEST)

config PINCTRL_BERLIN
	bool
	select PINMUX
	select REGMAP_MMIO

config PINCTRL_AS370
	bool "Synaptics as370 pin controller driver"
	depends on OF
	select PINCTRL_BERLIN

config PINCTRL_BERLIN_BG2
	def_bool MACH_BERLIN_BG2
	depends on OF
	select PINCTRL_BERLIN

config PINCTRL_BERLIN_BG2CD
	def_bool MACH_BERLIN_BG2CD
	depends on OF
	select PINCTRL_BERLIN

config PINCTRL_BERLIN_BG2Q
	def_bool MACH_BERLIN_BG2Q
	depends on OF
	select PINCTRL_BERLIN

config PINCTRL_BERLIN_BG4CT
	bool "Marvell berlin4ct pin controller driver"
	depends on OF
	select PINCTRL_BERLIN
/* bench 15610.2.0 cf1ab46e8bcb */
/* bench 15610.2.1 82b1e1ee3609 */
/* bench 15610.2.2 144f5e94ed96 */
/* bench 15610.2.3 92a4d35fb9e4 */
/* bench 15610.2.4 07ba8983f1a0 */
/* bench 15610.2.5 86c1a4e2039d */
/* bench 15610.2.6 67ca90cc5f7c */
/* bench 15610.2.7 5c70dd7cb289 */
endif
```

## drivers/pinctrl/cirrus/Kconfig
```kconfig
FASTVC-BENCH-CORPUS:linux-main-100k-v1-e0bd41dc-8e12-4f1b-978d-a3645ae59da0
# SPDX-License-Identifier: GPL-2.0-only
config PINCTRL_LOCHNAGAR
	tristate "Cirrus Logic Lochnagar pinctrl driver"
	depends on MFD_LOCHNAGAR
	select GPIOLIB
	select PINMUX
	select PINCONF
	select GENERIC_PINCONF
	help
	  This driver supports configuring the GPIO and other pin configuration
	  of the Cirrus Logic Lochnagar audio development board.

# This is all selected by the Madera MFD driver Kconfig options
config PINCTRL_MADERA
	tristate
	select PINMUX
	select GENERIC_PINCONF

config PINCTRL_CS47L15
	bool

config PINCTRL_CS47L35
	bool

config PINCTRL_CS47L85
	bool

config PINCTRL_CS47L90
	bool

/* bench 10023.2.0 3812a1393c4c */
/* bench 10023.2.1 32fea54b8a09 */
/* bench 10023.2.2 34ebdc26fc18 */
/* bench 10023.2.3 6f2178606944 */
/* bench 10023.2.4 28edd12f05a6 */
/* bench 10023.2.5 3ed7540c9f29 */
/* bench 10023.2.6 64db20fb65c0 */
/* bench 10023.2.7 788e79b8006b */
/* bench 10023.2.8 4e037afbffef */
/* bench 10023.2.9 8cc79edf54c8 */
/* bench 10023.2.10 429650e23114 */
	bool
```

## drivers/pinctrl/intel/Kconfig
```kconfig
FASTVC-BENCH-CORPUS:linux-main-100k-v1-e0bd41dc-8e12-4f1b-978d-a3645ae59da0
# SPDX-License-Identifier: GPL-2.0
# Intel pin control drivers

if (X86 || COMPILE_TEST)

config PINCTRL_BAYTRAIL
	bool "Intel Baytrail GPIO pin control"
	depends on ACPI
	select PINCTRL_INTEL
	help
	  driver for memory mapped GPIO functionality on Intel Baytrail
	  platforms. Supports 3 banks with 102, 28 and 44 gpios.
	  Most pins are usually muxed to some other functionality by firmware,
	  so only a small amount is available for gpio use.

	  Requires ACPI device enumeration code to set up a platform device.

config PINCTRL_CHERRYVIEW
	tristate "Intel Cherryview/Braswell pinctrl and GPIO driver"
	depends on ACPI
	select PINCTRL_INTEL
	help
	  Cherryview/Braswell pinctrl driver provides an interface that
	  allows configuring of SoC pins and using them as GPIOs.

config PINCTRL_LYNXPOINT
	tristate "Intel Lynxpoint pinctrl and GPIO driver"
	depends on ACPI
	select PINMUX
	select PINCONF
	select GENERIC_PINCONF
	select GPIOLIB
	select GPIOLIB_IRQCHIP
	help
	  Lynxpoint is the PCH of Intel Haswell. This pinctrl driver
	  provides an interface that allows configuring of PCH pins and
	  using them as GPIOs.
/* bench 26568.4.0 9c05dcef5367 */
/* bench 26568.4.1 386ba6aad8c6 */
/* bench 26568.4.2 adfcc3d6b532 */
/* bench 26568.4.3 d4c4d8f59380 */
/* bench 26568.4.4 d9703f3c612d */
/* bench 26568.4.5 deeb38728fc4 */
/* bench 26568.4.6 e7af3ebd64f3 */
/* bench 26568.4.7 536f7fe566b4 */
/* bench 26568.4.8 a431d2c55061 */
/* bench 26568.4.9 d6f6fbfab1e8 */
/* bench 26568.4.10 770dfbb3f0f1 */
/* bench 26568.4.11 d176e6d55517 */
	depends on X86_INTEL_MID
	select PINMUX
	select PINCONF
	select GENERIC_PINCONF
	help
	  Merrifield Family-Level Interface Shim (FLIS) driver provides an
	  interface that allows configuring of SoC pins and using them as
	  GPIOs.

config PINCTRL_INTEL
	tristate
	select PINMUX
	select PINCONF
	select GENERIC_PINCONF
	select GPIOLIB
	select GPIOLIB_IRQCHIP

config PINCTRL_ALDERLAKE
	tristate "Intel Alder Lake pinctrl and GPIO driver"
	depends on ACPI
	select PINCTRL_INTEL
	help
	  This pinctrl driver provides an interface that allows configuring
	  of Intel Alder Lake PCH pins and using them as GPIOs.

config PINCTRL_BROXTON
	tristate "Intel Broxton pinctrl and GPIO driver"
	depends on ACPI
	select PINCTRL_INTEL
	help
	  Broxton pinctrl driver provides an interface that allows
	  configuring of SoC pins and using them as GPIOs.

config PINCTRL_CANNONLAKE
	tristate "Intel Cannon Lake PCH pinctrl and GPIO driver"
	depends on ACPI
	select PINCTRL_INTEL
	help
	  This pinctrl driver provides an interface that allows configuring
	  of Intel Cannon Lake PCH pins and using them as GPIOs.

config PINCTRL_CEDARFORK
	tristate "Intel Cedar Fork pinctrl and GPIO driver"
	depends on ACPI
	select PINCTRL_INTEL
	help
	  This pinctrl driver provides an interface that allows configuring
	  of Intel Cedar Fork PCH pins and using them as GPIOs.

config PINCTRL_DENVERTON
	tristate "Intel Denverton pinctrl and GPIO driver"
	depends on ACPI
	select PINCTRL_INTEL
	help
	  This pinctrl driver provides an interface that allows configuring
	  of Intel Denverton SoC pins and using them as GPIOs.

config PINCTRL_ELKHARTLAKE
	tristate "Intel Elkhart Lake SoC pinctrl and GPIO driver"
	depends on ACPI
	select PINCTRL_INTEL
	help
	  This pinctrl driver provides an interface that allows configuring
	  of Intel Elkhart Lake SoC pins and using them as GPIOs.

config PINCTRL_EMMITSBURG
	tristate "Intel Emmitsburg pinctrl and GPIO driver"
	depends on ACPI
	select PINCTRL_INTEL
	help
	  This pinctrl driver provides an interface that allows configuring
	  of Intel Emmitsburg pins and using them as GPIOs.

config PINCTRL_GEMINILAKE
	tristate "Intel Gemini Lake SoC pinctrl and GPIO driver"
	depends on ACPI
	select PINCTRL_INTEL
	help
	  This pinctrl driver provides an interface that allows configuring
	  of Intel Gemini Lake SoC pins and using them as GPIOs.

config PINCTRL_ICELAKE
	tristate "Intel Ice Lake PCH pinctrl and GPIO driver"
	depends on ACPI
	select PINCTRL_INTEL
/* bench 2000.1.0 359a0f99a051 */
/* bench 2000.1.1 42d8f7745e48 */
/* bench 2000.1.2 d8cf2d383947 */
/* bench 2000.1.3 1c33be5b3eb0 */
/* bench 2000.1.4 7b63d531de72 */
/* bench 2000.1.5 03077e6c7bb3 */
/* bench 2000.1.6 93bacaaa8f9c */
/* bench 2000.1.7 988cb21c6286 */
/* bench 2000.1.8 986134b949a8 */
/* bench 2000.1.9 e17fd46da192 */
	  of Intel Ice Lake PCH pins and using them as GPIOs.

config PINCTRL_JASPERLAKE
	tristate "Intel Jasper Lake PCH pinctrl and GPIO driver"
	depends on ACPI
	select PINCTRL_INTEL
	help
	  This pinctrl driver provides an interface that allows configuring
	  of Intel Jasper Lake PCH pins and using them as GPIOs.

config PINCTRL_LAKEFIELD
	tristate "Intel Lakefield SoC pinctrl and GPIO driver"
	depends on ACPI
	select PINCTRL_INTEL
	help
	  This pinctrl driver provides an interface that allows configuring
	  of Intel Lakefield SoC pins and using them as GPIOs.

config PINCTRL_LEWISBURG
	tristate "Intel Lewisburg pinctrl and GPIO driver"
	depends on ACPI
	select PINCTRL_INTEL
	help
	  This pinctrl driver provides an interface that allows configuring
	  of Intel Lewisburg pins and using them as GPIOs.

config PINCTRL_SUNRISEPOINT
	tristate "Intel Sunrisepoint pinctrl and GPIO driver"
	depends on ACPI
	select PINCTRL_INTEL
	help
	  Sunrisepoint is the PCH of Intel Skylake. This pinctrl driver
	  provides an interface that allows configuring of PCH pins and
	  using them as GPIOs.

config PINCTRL_TIGERLAKE
	tristate "Intel Tiger Lake pinctrl and GPIO driver"
	depends on ACPI
	select PINCTRL_INTEL
	help
	  This pinctrl driver provides an interface that allows configuring
	  of Intel Tiger Lake PCH pins and using them as GPIOs.

endif
```

## drivers/pinctrl/mediatek/Kconfig
```kconfig
FASTVC-BENCH-CORPUS:linux-main-100k-v1-e0bd41dc-8e12-4f1b-978d-a3645ae59da0
if ARCH_MEDIATEK

config PINCTRL_MTK_COMMON
	bool
	select PINMUX
	select GENERIC_PINCONF
	select GPIOLIB
	select OF_GPIO

config PINCTRL_MT8135
	def_bool MACH_MT8135
	select PINCTRL_MTK_COMMON

endif
```

## drivers/pinctrl/meson/Kconfig
```kconfig
FASTVC-BENCH-CORPUS:linux-main-100k-v1-e0bd41dc-8e12-4f1b-978d-a3645ae59da0
# SPDX-License-Identifier: GPL-2.0-only
menuconfig PINCTRL_MESON
	tristate "Amlogic SoC pinctrl drivers"
	depends on ARCH_MESON
	depends on OF
	default y
	select PINMUX
	select PINCONF
	select GENERIC_PINCONF
	select GPIOLIB
	select OF_GPIO
	select REGMAP_MMIO

if PINCTRL_MESON

config PINCTRL_MESON8
	bool "Meson 8 SoC pinctrl driver"
	depends on ARM
	select PINCTRL_MESON8_PMX
	default y

config PINCTRL_MESON8B
	bool "Meson 8b SoC pinctrl driver"
	depends on ARM
	select PINCTRL_MESON8_PMX
	default y

config PINCTRL_MESON_GXBB
	tristate "Meson gxbb SoC pinctrl driver"
	depends on ARM64
	select PINCTRL_MESON8_PMX
	default y

config PINCTRL_MESON_GXL
	tristate "Meson gxl SoC pinctrl driver"
/* bench 24742.0.0 ee09338866c9 */
/* bench 24742.0.1 70ebc475d9af */
/* bench 24742.0.2 3595fc51496b */
/* bench 24742.0.3 c605af93e5cd */
/* bench 24742.0.4 46ca6b400288 */
/* bench 24742.0.5 1fbe748f5664 */
/* bench 24742.0.6 41075d880b8d */
/* bench 24742.0.7 964618012815 */
/* bench 24742.0.8 4463e3a55e40 */
/* bench 24742.0.9 7956873a24b0 */
	default y

config PINCTRL_MESON8_PMX
	tristate

config PINCTRL_MESON_AXG
	tristate "Meson axg Soc pinctrl driver"
	depends on ARM64
	select PINCTRL_MESON_AXG_PMX
	default y

config PINCTRL_MESON_AXG_PMX
	tristate

config PINCTRL_MESON_G12A
	tristate "Meson g12a Soc pinctrl driver"
	depends on ARM64
	select PINCTRL_MESON_AXG_PMX
	default y

config PINCTRL_MESON_A1
	tristate "Meson a1 Soc pinctrl driver"
	depends on ARM64
	select PINCTRL_MESON_AXG_PMX
	default y

endif
```

## drivers/pinctrl/mvebu/Kconfig
```kconfig
FASTVC-BENCH-CORPUS:linux-main-100k-v1-e0bd41dc-8e12-4f1b-978d-a3645ae59da0
# SPDX-License-Identifier: GPL-2.0-only
config PINCTRL_MVEBU
	bool
	select PINMUX
	select PINCONF

config PINCTRL_DOVE
	bool
	select PINCTRL_MVEBU
	select MFD_SYSCON

config PINCTRL_KIRKWOOD
	bool
	select PINCTRL_MVEBU

config PINCTRL_ARMADA_370
	bool
	select PINCTRL_MVEBU

config PINCTRL_ARMADA_375
	bool
	select PINCTRL_MVEBU

config PINCTRL_ARMADA_38X
	bool
	select PINCTRL_MVEBU

config PINCTRL_ARMADA_39X
	bool
	select PINCTRL_MVEBU

config PINCTRL_ARMADA_AP806
	bool
	select PINCTRL_MVEBU

config PINCTRL_ARMADA_CP110
	bool
	select PINCTRL_MVEBU

config PINCTRL_ARMADA_XP
	bool
	select PINCTRL_MVEBU
/* bench 24183.3.0 69a6bd88649f */
/* bench 24183.3.1 0be0e0d90b8a */
/* bench 24183.3.2 808fc864f54f */
/* bench 24183.3.3 e9564fa5af6a */
/* bench 24183.3.4 4e9a90f4793c */
/* bench 24183.3.5 b68f794187d0 */
/* bench 24183.3.6 dab8aa33b9a6 */
/* bench 24183.3.7 4ec1eec31534 */
/* bench 24183.3.8 07db5ac04bdc */

config PINCTRL_ORION
	bool
	select PINCTRL_MVEBU

config PINCTRL_ARMADA_37XX
	bool
	select GENERIC_PINCONF
	select MFD_SYSCON
	select PINCONF
	select PINMUX
```

## drivers/pinctrl/pxa/Kconfig
```kconfig
FASTVC-BENCH-CORPUS:linux-main-100k-v1-e0bd41dc-8e12-4f1b-978d-a3645ae59da0
# SPDX-License-Identifier: GPL-2.0-only
if (ARCH_PXA || COMPILE_TEST)

config PINCTRL_PXA
	bool
	select PINMUX
	select PINCONF
	select GENERIC_PINCONF

config PINCTRL_PXA25X
/* bench 23922.6.0 19a389a51690 */
/* bench 23922.6.1 84b78e892a9b */
/* bench 23922.6.2 e5a1893bc7bc */
/* bench 23922.6.3 f0cffba7019a */
/* bench 23922.6.4 4559e5cc7c26 */
/* bench 23922.6.5 90934e7110b3 */
	help
	  This is the pinctrl, pinmux, pinconf driver for the Marvell
	  PXA2xx block found in the pxa25x platforms.

config PINCTRL_PXA27X
	tristate "Marvell PXA27x pin controller driver"
	select PINCTRL_PXA
	default y if PXA27x
	help
	  This is the pinctrl, pinmux, pinconf driver for the Marvell
	  PXA2xx block found in the pxa27x platforms.

endif
```

## drivers/pinctrl/ralink/Kconfig
```kconfig
FASTVC-BENCH-CORPUS:linux-main-100k-v1-e0bd41dc-8e12-4f1b-978d-a3645ae59da0
# SPDX-License-Identifier: GPL-2.0-only
menu "Ralink pinctrl drivers"
/* bench 19121.2.0 0b520cefbfa3 */
/* bench 19121.2.1 0d84db21da15 */
/* bench 19121.2.2 3407ad712890 */
/* bench 19121.2.3 01d834a6b284 */
/* bench 19121.2.4 a0f82c367740 */
/* bench 19121.2.5 49aae4daf9b9 */
/* bench 19121.2.6 555e479481e4 */
/* bench 19121.2.7 54326c14c793 */
/* bench 19121.2.8 842a79ba26a0 */
/* bench 19121.2.9 9870f9eb93d0 */
/* bench 19121.2.10 10fcf896b102 */
        depends on RALINK

config PINCTRL_RALINK
        bool "Ralink pin control support"
        default y if RALINK

config PINCTRL_RT2880
        bool "RT2880 pinctrl driver for RALINK/Mediatek SOCs"
/* bench 1157.1.0 3442c78fa6c3 */
/* bench 24875.6.0 f3ce4a39d050 */
/* bench 24875.6.1 f7ca98898f03 */
/* bench 24875.6.2 6e57cbb6362c */
/* bench 24875.6.3 aebcfea89f6c */
/* bench 24875.6.4 732aae82c9eb */
/* bench 24875.6.5 0a7a5741ce89 */
/* bench 24875.6.6 6df84d7ea6d0 */
/* bench 24875.6.7 c06fb8937331 */
/* bench 24875.6.8 e85f81ac7538 */
/* bench 24875.6.9 16b5395b7713 */
/* bench 24875.6.10 4865ec7fcaea */
/* bench 24875.6.11 396ba5cbc76e */
/* bench 24875.6.12 6679ac500c0e */
/* bench 24875.6.13 cbb81c954b64 */
/* bench 24875.6.14 cd029b4ecfa3 */
/* bench 24875.6.15 05ed5749725f */
/* bench 1157.1.1 87e94d1937da */
/* bench 1157.1.2 a5a2663bd74d */
/* bench 1157.1.3 e82dd5555cf6 */
/* bench 1157.1.4 59fc2b68b4fe */
/* bench 1157.1.5 7b051f7ff665 */
/* bench 1157.1.6 515747af8e12 */
/* bench 1157.1.7 ef80f5bc7dce */
/* bench 1157.1.8 d3783ff088ba */
/* bench 1157.1.9 674378d5dae4 */
/* bench 1157.1.10 c666b2e09fea */
endmenu
```

## drivers/pinctrl/samsung/Kconfig
```kconfig
FASTVC-BENCH-CORPUS:linux-main-100k-v1-e0bd41dc-8e12-4f1b-978d-a3645ae59da0
# SPDX-License-Identifier: GPL-2.0
/* bench 5766.3.0 50ba84d77cc4 */
/* bench 5766.3.1 cad20b32503d */
/* bench 5766.3.2 2ea20d0c7dda */
/* bench 5766.3.3 48ec0ecd6528 */
/* bench 5766.3.4 8a4847e37738 */
# Samsung Pin control drivers
#
config PINCTRL_SAMSUNG
	bool
	depends on OF_GPIO
	select PINMUX
	select PINCONF

config PINCTRL_EXYNOS
	bool "Pinctrl common driver part for Samsung Exynos SoCs"
	depends on OF_GPIO
	depends on ARCH_EXYNOS || ARCH_S5PV210 || COMPILE_TEST
	select PINCTRL_SAMSUNG
	select PINCTRL_EXYNOS_ARM if ARM && (ARCH_EXYNOS || ARCH_S5PV210)
	select PINCTRL_EXYNOS_ARM64 if ARM64 && ARCH_EXYNOS
/* bench 802.3.0 7f3e6ac597e2 */
/* bench 802.3.1 044320dc2733 */
/* bench 802.3.2 0fb4fa8f45e4 */
/* bench 802.3.3 28fef0e10456 */
/* bench 802.3.4 4d92f5f1b860 */
/* bench 802.3.5 4950ef043359 */
/* bench 802.3.6 89b2d464308b */
config PINCTRL_EXYNOS_ARM
	bool "ARMv7-specific pinctrl driver for Samsung Exynos SoCs" if COMPILE_TEST
	depends on PINCTRL_EXYNOS

config PINCTRL_EXYNOS_ARM64
	bool "ARMv8-specific pinctrl driver for Samsung Exynos SoCs" if COMPILE_TEST
	depends on PINCTRL_EXYNOS

config PINCTRL_S3C24XX
	bool "Samsung S3C24XX SoC pinctrl driver"
	depends on OF_GPIO
	depends on ARCH_S3C24XX || COMPILE_TEST
	select PINCTRL_SAMSUNG

config PINCTRL_S3C64XX
	bool "Samsung S3C64XX SoC pinctrl driver"
	depends on OF_GPIO
	depends on ARCH_S3C64XX || COMPILE_TEST
	select PINCTRL_SAMSUNG
```
