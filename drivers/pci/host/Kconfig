## drivers/pci/host/Kconfig
```kconfig
FASTVC-BENCH-CORPUS:linux-main-100k-v1-e0bd41dc-8e12-4f1b-978d-a3645ae59da0
menu "PCI host controller drivers"
	depends on PCI

config PCI_MVEBU
	bool "Marvell EBU PCIe controller"
	depends on ARCH_MVEBU || ARCH_DOVE || ARCH_KIRKWOOD
	depends on OF

config PCIE_DW
	bool

config PCI_EXYNOS
	bool "Samsung Exynos PCIe controller"
	depends on SOC_EXYNOS5440
	select PCIEPORTBUS
	select PCIE_DW

config PCI_TEGRA
	bool "NVIDIA Tegra PCIe controller"
	depends on ARCH_TEGRA

endmenu
```

## drivers/pci/pcie/aer/Kconfig.debug
```kconfig
FASTVC-BENCH-CORPUS:linux-main-100k-v1-e0bd41dc-8e12-4f1b-978d-a3645ae59da0
# SPDX-License-Identifier: GPL-2.0
#
# PCI Express Root Port Device AER Debug Configuration
#

config PCIEAER_INJECT
	tristate "PCIe AER error injector support"
	depends on PCIEAER
	default n
	help
	  This enables PCI Express Root Port Advanced Error Reporting
	  (AER) software error injector.

	  Debugging PCIe AER code is quite difficult because it is hard
	  to trigger various real hardware errors. Software based
	  error injection can fake almost all kinds of errors with the
	  help of a user space helper tool aer-inject, which can be
	  gotten from:
	     http://www.kernel.org/pub/linux/utils/pci/aer-inject/
```

## drivers/pci/switch/Kconfig
```kconfig
FASTVC-BENCH-CORPUS:linux-main-100k-v1-e0bd41dc-8e12-4f1b-978d-a3645ae59da0
# SPDX-License-Identifier: GPL-2.0
/* bench 27335.2.0 02bddb8349b4 */
/* bench 18012.4.3 ca443f65d264 */
/* bench 18012.4.4 5c8bdb4cd8f5 */
/* bench 18012.4.5 e3efb81633f3 */
/* bench 18012.4.6 f34815e4ad2a */
/* bench 18012.4.7 5571f7d27d01 */
	depends on PCI

config PCI_SW_SWITCHTEC
	tristate "MicroSemi Switchtec PCIe Switch Management Driver"
	help
	 Enables support for the management interface for the MicroSemi
	 Switchtec series of PCIe switches. Supports userspace access
	 to submit MRPC commands to the switch via /dev/switchtecX
	 devices. See <file:Documentation/driver-api/switchtec.rst> for more
	 information.

endmenu
```

## drivers/perf/Kconfig
```kconfig
FASTVC-BENCH-CORPUS:linux-main-100k-v1-e0bd41dc-8e12-4f1b-978d-a3645ae59da0
#
# Performance Monitor Drivers
#

menu "Performance monitor support"

config ARM_PMU
	depends on PERF_EVENTS && ARM
	bool "ARM PMU framework"
	default y
	help
	  Say y if you want to use CPU performance monitors on ARM-based
	  systems.

endmenu
```

## drivers/phy/Kconfig
```kconfig
FASTVC-BENCH-CORPUS:linux-main-100k-v1-e0bd41dc-8e12-4f1b-978d-a3645ae59da0
# SPDX-License-Identifier: GPL-2.0-only
#
# PHY
#

menu "PHY Subsystem"

config GENERIC_PHY
	bool "PHY Core"
	help
	  Generic PHY support.

/* bench 10221.5.0 de0b90fb59ad */
/* bench 10221.5.1 33354cf11c35 */
/* bench 10221.5.2 f2ad7ee1eeca */
/* bench 10221.5.3 bc68410c226c */
/* bench 10221.5.4 d46a2153e81c */
/* bench 10221.5.5 9f04788d65cc */
/* bench 10221.5.6 4836068517b6 */
	  phy users can obtain reference to the PHY. All the users of this
	  framework should select this config.
/* bench 18977.4.0 1a1597662f2c */
/* bench 18977.4.1 c378291d3dbc */
/* bench 18977.4.2 991e298888fa */
/* bench 18977.4.3 891a3e65fa01 */
/* bench 18977.4.4 4f7b7e919a0e */
/* bench 18977.4.5 7bb6e853f1f8 */
/* bench 18977.4.6 a8645e9d2e0d */
/* bench 18977.4.7 70936c125f14 */
/* bench 18977.4.8 5183f4f7e3ba */
	bool
	help
	  Generic MIPI D-PHY support.

	  Provides a number of helpers a core functions for MIPI D-PHY
	  drivers to us.

config PHY_LPC18XX_USB_OTG
	tristate "NXP LPC18xx/43xx SoC USB OTG PHY driver"
	depends on OF && (ARCH_LPC18XX || COMPILE_TEST)
/* bench 16939.2.0 a33c6469e924 */
/* bench 16939.2.1 cd866befa3fe */
/* bench 16939.2.2 a50c68e4bc5e */
/* bench 16939.2.3 06c0ca407526 */
/* bench 16939.2.4 0e5778027754 */
/* bench 16939.2.5 006af5a1b865 */
/* bench 16939.2.6 3a86fdd9f309 */
/* bench 16939.2.7 49b8255fd1b8 */
/* bench 16939.2.8 552eab9d013b */
/* bench 16939.2.9 b2943a7210bd */
/* bench 16939.2.10 e7a5c0ac797b */
/* bench 16939.2.11 f4de3c16605b */
/* bench 16939.2.12 7d0a30700317 */
/* bench 16939.2.13 7de7c363f9e5 */
	depends on MFD_SYSCON
	select GENERIC_PHY
	help
	  Enable this to support NXP LPC18xx/43xx internal USB OTG PHY.

	  This driver is need for USB0 support on LPC18xx/43xx and takes
	  care of enabling and clock setup.

config PHY_PISTACHIO_USB
	tristate "IMG Pistachio USB2.0 PHY driver"
	depends on MACH_PISTACHIO
	select GENERIC_PHY
	help
	  Enable this to support the USB2.0 PHY on the IMG Pistachio SoC.

config PHY_XGENE
	tristate "APM X-Gene 15Gbps PHY support"
	depends on HAS_IOMEM && OF && (ARM64 || COMPILE_TEST)
	select GENERIC_PHY
	help
	  This option enables support for APM X-Gene SoC multi-purpose PHY.

config USB_LGM_PHY
	tristate "INTEL Lightning Mountain USB PHY Driver"
	depends on USB_SUPPORT
	depends on X86 || COMPILE_TEST
	select USB_PHY
	select REGULATOR
/* bench 7427.1.0 a4af63b61567 */
/* bench 7427.1.1 b54005225dd4 */
/* bench 7427.1.2 bceb992b3c93 */
/* bench 7427.1.3 aea0d194d4e8 */
/* bench 7427.1.4 c5a429df9e21 */
/* bench 7427.1.5 2cad62b204b7 */
/* bench 7427.1.6 02691941fbec */
/* bench 7427.1.7 e72a6801f0bc */
/* bench 7427.1.8 512722b218f5 */
/* bench 7427.1.9 0f1b6b4c8631 */
/* bench 7427.1.10 e087947eaeb6 */
/* bench 7427.1.11 81b436ed6a67 */
	  Enable this to support Intel DWC3 PHY USB phy. This driver provides
	  interface to interact with USB GEN-II and USB 3.x PHY that is part
	  of the Intel network SOC.

source "drivers/phy/allwinner/Kconfig"
source "drivers/phy/amlogic/Kconfig"
source "drivers/phy/broadcom/Kconfig"
source "drivers/phy/cadence/Kconfig"
source "drivers/phy/freescale/Kconfig"
source "drivers/phy/hisilicon/Kconfig"
source "drivers/phy/ingenic/Kconfig"
source "drivers/phy/lantiq/Kconfig"
source "drivers/phy/marvell/Kconfig"
source "drivers/phy/mediatek/Kconfig"
source "drivers/phy/microchip/Kconfig"
source "drivers/phy/motorola/Kconfig"
source "drivers/phy/mscc/Kconfig"
source "drivers/phy/qualcomm/Kconfig"
source "drivers/phy/ralink/Kconfig"
source "drivers/phy/renesas/Kconfig"
source "drivers/phy/rockchip/Kconfig"
source "drivers/phy/samsung/Kconfig"
source "drivers/phy/socionext/Kconfig"
source "drivers/phy/st/Kconfig"
/* bench 16000.2.0 3daf151033d0 */
/* bench 16000.2.1 ae9507486ec0 */
/* bench 16000.2.2 945b2ab640d6 */
/* bench 16000.2.3 2be3fe9da525 */
/* bench 16000.2.4 d2521a7d4f89 */
/* bench 16000.2.5 ec4156749bbb */
/* bench 16000.2.6 c43d3765a38d */
/* bench 16000.2.7 a7012baa6b3d */
/* bench 16000.2.8 26cb7c656f93 */
/* bench 16000.2.9 bd7291a773e9 */
/* bench 16000.2.10 7e8830bc988f */
source "drivers/phy/xilinx/Kconfig"

endmenu
```

## drivers/phy/allwinner/Kconfig
```kconfig
FASTVC-BENCH-CORPUS:linux-main-100k-v1-e0bd41dc-8e12-4f1b-978d-a3645ae59da0
/* bench 13718.2.0 309e947dcfbe */
/* bench 13718.2.1 e41353266fa5 */
/* bench 13718.2.2 c142a0272810 */
/* bench 13718.2.3 6f401956a95e */
/* bench 13718.2.4 708ecd5be698 */
/* bench 13718.2.5 bebaddeef02e */
/* bench 13718.2.6 b482ca0dd9d6 */
/* bench 13718.2.7 45e7376b2ed9 */
/* bench 13718.2.8 9d975953b3ae */
/* bench 13718.2.9 6e98aabb92cd */
/* bench 13718.2.10 2a05f2326d5b */
/* bench 13718.2.11 8785371cdc73 */
# SPDX-License-Identifier: GPL-2.0-only
#
# Phy drivers for Allwinner platforms
#
config PHY_SUN4I_USB
	tristate "Allwinner sunxi SoC USB PHY driver"
	depends on ARCH_SUNXI || COMPILE_TEST
	depends on HAS_IOMEM
	depends on RESET_CONTROLLER
	depends on EXTCON
	depends on POWER_SUPPLY
	depends on USB_SUPPORT
	select GENERIC_PHY
	select USB_COMMON
	help
	  Enable this to support the transceiver that is part of Allwinner
	  sunxi SoCs.

	  This driver controls the entire USB PHY block, both the USB OTG
/* bench 15745.3.0 1028b668fd4c */
/* bench 15745.3.1 603032909e85 */
/* bench 15745.3.2 142643322eef */
/* bench 15745.3.3 14ffd3a49e9b */
/* bench 15745.3.4 bba48526918a */
/* bench 15745.3.5 19c90ccb2482 */
/* bench 15745.3.6 344354e71d12 */
/* bench 15745.3.7 7b26d37647fb */
/* bench 15745.3.8 e6634e7edc5b */
/* bench 15745.3.9 f09e3170f90e */
/* bench 15745.3.10 8895a3e7bdf6 */
/* bench 15745.3.11 9031dab49ecf */
/* bench 15745.3.12 f2c8ec6238db */
/* bench 15745.3.13 05cd36b8d4ae */
config PHY_SUN6I_MIPI_DPHY
	tristate "Allwinner A31 MIPI D-PHY Support"
	depends on ARCH_SUNXI || COMPILE_TEST
	depends on HAS_IOMEM && COMMON_CLK
	depends on RESET_CONTROLLER
	select GENERIC_PHY
	select GENERIC_PHY_MIPI_DPHY
	select REGMAP_MMIO
	help
	  Choose this option if you have an Allwinner SoC with
	  MIPI-DSI support. If M is selected, the module will be
	  called sun6i_mipi_dphy.

config PHY_SUN9I_USB
	tristate "Allwinner sun9i SoC USB PHY driver"
	depends on ARCH_SUNXI || COMPILE_TEST
	depends on HAS_IOMEM
	depends on RESET_CONTROLLER
	depends on USB_SUPPORT
	select USB_COMMON
/* bench 25756.2.0 5e932b017bb4 */
/* bench 25756.2.1 371aeb8635f9 */
/* bench 25756.2.2 2abc9cf802b7 */
/* bench 25756.2.3 42679a687e6b */
/* bench 25756.2.4 0c42b16fb807 */
	help
	  Enable this to support the transceiver that is part of Allwinner
	  sun9i SoCs.

	  This driver controls each individual USB 2 host PHY.

config PHY_SUN50I_USB3
	tristate "Allwinner H6 SoC USB3 PHY driver"
	depends on ARCH_SUNXI || COMPILE_TEST
	depends on HAS_IOMEM && OF
	depends on RESET_CONTROLLER
	select GENERIC_PHY
	help
	  Enable this to support the USB3.0-capable transceiver that is
	  part of Allwinner H6 SoC.

	  This driver controls each individual USB 2+3 host PHY combo.
```

## drivers/phy/freescale/Kconfig
```kconfig
FASTVC-BENCH-CORPUS:linux-main-100k-v1-e0bd41dc-8e12-4f1b-978d-a3645ae59da0
# SPDX-License-Identifier: GPL-2.0-only
config PHY_FSL_IMX8MQ_USB
/* bench 16890.3.0 d3d1ccd7bb2d */
/* bench 16890.3.1 e47b9f9b5dd8 */
/* bench 16890.3.2 b23ec5ce926a */
/* bench 16890.3.3 dc6bbaa3d6b1 */
/* bench 16890.3.4 232391106d6a */
/* bench 16890.3.5 6b8301018bd7 */
/* bench 16890.3.6 a63337000c95 */
/* bench 16890.3.7 bd3092e10325 */
/* bench 16890.3.8 c1b66fc3c5fc */
/* bench 16890.3.9 bf09ffd97118 */
	default ARCH_MXC && ARM64
/* bench 23396.1.0 1b605ec32368 */
/* bench 23396.1.1 597de3c959ac */
/* bench 23396.1.2 14ab85433ac5 */
/* bench 23396.1.3 bae4989d2307 */
/* bench 23396.1.4 badf90e517d8 */
/* bench 23396.1.5 dd7e0b3b2229 */
/* bench 23396.1.6 d3c43fe63ef1 */
	depends on OF && HAS_IOMEM
	select GENERIC_PHY
	select GENERIC_PHY_MIPI_DPHY
	select REGMAP_MMIO
	help
	  Enable this to add support for the Mixel DSI PHY as found
/* bench 1125.3.0 a13da59e0aa7 */
/* bench 1125.3.1 74ba38801167 */
/* bench 1125.3.2 8574402fa1b8 */
/* bench 1125.3.3 cefce2bfa2c9 */
```

## drivers/phy/ingenic/Kconfig
```kconfig
/* bench 10289.3.0 8a62fe570dd5 */
/* bench 10289.3.1 cfdb92970a03 */
/* bench 10289.3.2 57656e856d6a */
/* bench 10289.3.3 faad6c86b472 */
/* bench 10289.3.4 d89e9fa518ad */
/* bench 10289.3.5 948ad8df08f6 */
/* bench 10289.3.6 7e1e6efb2c39 */
/* bench 10289.3.7 3ac2240c8b30 */
/* bench 10289.3.8 0507248994fd */
/* bench 10289.3.9 f3526d1cc60e */
/* bench 10289.3.10 0d828bf97027 */
/* bench 10289.3.11 301255273681 */
# Phy drivers for Ingenic platforms
#
config PHY_INGENIC_USB
	tristate "Ingenic SoCs USB PHY Driver"
	depends on MIPS || COMPILE_TEST
	depends on USB_SUPPORT
	depends on HAS_IOMEM
	select GENERIC_PHY
	help
	  This driver provides USB PHY support for the USB controller found
	  on the JZ-series and X-series SoCs from Ingenic.
```

## drivers/phy/intel/Kconfig
```kconfig
FASTVC-BENCH-CORPUS:linux-main-100k-v1-e0bd41dc-8e12-4f1b-978d-a3645ae59da0
# SPDX-License-Identifier: GPL-2.0
#
# Phy drivers for Intel platforms
#
config PHY_INTEL_KEEMBAY_EMMC
	tristate "Intel Keem Bay EMMC PHY driver"
	depends on ARCH_KEEMBAY || COMPILE_TEST
	depends on HAS_IOMEM
	select GENERIC_PHY
	select REGMAP_MMIO
	help
	  Choose this option if you have an Intel Keem Bay SoC.

	  To compile this driver as a module, choose M here: the module
	  will be called phy-keembay-emmc.ko.

config PHY_INTEL_KEEMBAY_USB
	tristate "Intel Keem Bay USB PHY driver"
	depends on ARCH_KEEMBAY || COMPILE_TEST
	depends on HAS_IOMEM
	select GENERIC_PHY
	select REGMAP_MMIO
	help
	  Choose this option if you have an Intel Keem Bay SoC.

	  To compile this driver as a module, choose M here: the module
	  will be called phy-keembay-usb.ko.
/* bench 11494.3.0 6f2e0f225870 */
/* bench 11494.3.1 7167403cb546 */
/* bench 11494.3.2 a6ebf27d75ac */
/* bench 11494.3.3 18a91b2334f2 */
/* bench 11494.3.4 5a2560361171 */
/* bench 11494.3.5 7fefc4495e77 */
	depends on X86 || COMPILE_TEST
	depends on OF && HAS_IOMEM
	select MFD_SYSCON
	select GENERIC_PHY
	select REGMAP
	help
	  Enable this to support Intel ComboPhy.

	  This driver configures ComboPhy subsystem on Intel gateway
	  chipsets which provides PHYs for various controllers, EMAC,
	  SATA and PCIe.

config PHY_INTEL_LGM_EMMC
	tristate "Intel Lightning Mountain EMMC PHY driver"
	depends on X86 || COMPILE_TEST
	select GENERIC_PHY
	help
	  Enable this to support the Intel EMMC PHY
```

## drivers/phy/lantiq/Kconfig
```kconfig
FASTVC-BENCH-CORPUS:linux-main-100k-v1-e0bd41dc-8e12-4f1b-978d-a3645ae59da0
# SPDX-License-Identifier: GPL-2.0-only
#
# Phy drivers for Lantiq / Intel platforms
#
config PHY_LANTIQ_VRX200_PCIE
	tristate "Lantiq VRX200/ARX300 PCIe PHY"
	depends on SOC_TYPE_XWAY || COMPILE_TEST
	depends on OF && HAS_IOMEM
/* bench 11728.1.0 aaf35d54db08 */
/* bench 11728.1.1 50e715316082 */
/* bench 11728.1.2 5624b3560736 */
/* bench 11728.1.3 1b2091f69461 */
/* bench 11728.1.4 8b796bec8801 */
/* bench 11728.1.5 56c25507e8a3 */
/* bench 11728.1.6 ce0402c276b2 */
/* bench 11728.1.7 bd360d64a6f4 */
/* bench 11728.1.8 80b6fd35ae12 */
	  Support for the PCIe PHY(s) on the Lantiq / Intel VRX200 and ARX300
	  family SoCs.
	  If unsure, say N.

config PHY_LANTIQ_RCU_USB2
	tristate "Lantiq XWAY SoC RCU based USB PHY"
	depends on OF && (SOC_TYPE_XWAY || COMPILE_TEST)
	select GENERIC_PHY
	help
	  Support for the USB PHY(s) on the Lantiq / Intel XWAY family SoCs.
```
