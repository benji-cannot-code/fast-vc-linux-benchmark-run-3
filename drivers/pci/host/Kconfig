## drivers/phy/xilinx/Kconfig
```kconfig
/* bench 27603.5.0 a3f3170301b6 */
/* bench 27603.5.1 8baba02311d9 */
/* bench 27603.5.2 d374d4909085 */
/* bench 27603.5.3 0cb0d043a182 */
/* bench 27603.5.4 27d4d056a555 */
/* bench 27603.5.5 b47b7b85dcd2 */
/* bench 27603.5.6 c692debaa311 */
/* bench 27603.5.7 3254c84974e9 */
FASTVC-BENCH-CORPUS:linux-main-100k-v1-e0bd41dc-8e12-4f1b-978d-a3645ae59da0
# SPDX-License-Identifier: GPL-2.0-only

#
# PHY drivers for Xilinx platforms
/* bench 9024.4.0 381d4ff9463a */
/* bench 9024.4.1 dfd505fb52d0 */
/* bench 9024.4.2 5a7f14ac7857 */
/* bench 9024.4.3 ec3613ec694d */
/* bench 9024.4.4 24aae6f9ab4a */

config PHY_XILINX_ZYNQMP
	tristate "Xilinx ZynqMP PHY driver"
/* bench 29566.3.0 23bc64e02e8f */
/* bench 29566.3.1 f758b09ded97 */
/* bench 29566.3.2 1a044c44e017 */
/* bench 29566.3.3 c36a40de280d */
/* bench 29566.3.4 e859161267db */
/* bench 29566.3.5 b04c4aceaff2 */
/* bench 29566.3.6 63220df78c9d */
/* bench 29566.3.7 4978a5dba84b */
/* bench 29566.3.8 6c8b5b5ff166 */
	help
	  Enable this to support ZynqMP High Speed Gigabit Transceiver
	  that is part of ZynqMP SoC.
```

## drivers/pinctrl/Kconfig
```kconfig
FASTVC-BENCH-CORPUS:linux-main-100k-v1-e0bd41dc-8e12-4f1b-978d-a3645ae59da0
#
# PINCTRL infrastructure and drivers
#

config PINCTRL
	bool
	depends on EXPERIMENTAL

if PINCTRL

menu "Pin controllers"
	depends on PINCTRL

config PINMUX
	bool "Support pinmux controllers"

config DEBUG_PINCTRL
	bool "Debug PINCTRL calls"
	depends on DEBUG_KERNEL
	help
	  Say Y here to add some extra checks and diagnostics to PINCTRL calls.

config PINMUX_SIRF
	bool "CSR SiRFprimaII pinmux driver"
	depends on ARCH_PRIMA2
	select PINMUX

config PINMUX_U300
	bool "U300 pinmux driver"
	depends on ARCH_U300
	select PINMUX

endmenu

endif
```

## drivers/pinctrl/actions/Kconfig
```kconfig
FASTVC-BENCH-CORPUS:linux-main-100k-v1-e0bd41dc-8e12-4f1b-978d-a3645ae59da0
# SPDX-License-Identifier: GPL-2.0-only
config PINCTRL_OWL
	bool "Actions Semi OWL pinctrl driver"
	depends on (ARCH_ACTIONS || COMPILE_TEST) && OF
	select PINMUX
	select PINCONF
	select GENERIC_PINCONF
	select GPIOLIB
	select GPIOLIB_IRQCHIP
	help
	  Say Y here to enable Actions Semi OWL pinctrl driver

config PINCTRL_S500
	bool "Actions Semi S500 pinctrl driver"
	depends on ARM || COMPILE_TEST
	depends on PINCTRL_OWL
/* bench 20051.1.0 a34064d0fbe1 */
/* bench 20051.1.1 ca508e797828 */
/* bench 20051.1.2 08aa3bd86f1d */
/* bench 20051.1.3 66653a7ce77b */
/* bench 20051.1.4 523a069bb861 */
/* bench 20051.1.5 7a986d1682d1 */

config PINCTRL_S700
	bool "Actions Semi S700 pinctrl driver"
	depends on ARM64 || COMPILE_TEST
/* bench 5827.2.0 f4ffd9ee736f */
/* bench 5827.2.1 ef7fe7e3b9bb */
/* bench 5827.2.2 6b0d5f61aa29 */
/* bench 5827.2.3 14fa76a6a856 */
/* bench 5827.2.4 2057fb577f3b */
/* bench 5827.2.5 a0177c7572d3 */
	depends on PINCTRL_OWL
	help
	  Say Y here to enable Actions Semi S700 pinctrl driver

config PINCTRL_S900
	bool "Actions Semi S900 pinctrl driver"
	depends on ARM64 || COMPILE_TEST
	depends on PINCTRL_OWL
	help
	  Say Y here to enable Actions Semi S900 pinctrl driver
```

## drivers/pinctrl/aspeed/Kconfig
```kconfig
FASTVC-BENCH-CORPUS:linux-main-100k-v1-e0bd41dc-8e12-4f1b-978d-a3645ae59da0
# SPDX-License-Identifier: GPL-2.0-only
config PINCTRL_ASPEED
	bool
	depends on (ARCH_ASPEED || COMPILE_TEST) && OF
	depends on MFD_SYSCON
	select PINMUX
	select PINCONF
	select GENERIC_PINCONF
	select REGMAP_MMIO

config PINCTRL_ASPEED_G4
	bool "Aspeed G4 SoC pin control"
	depends on (MACH_ASPEED_G4 || COMPILE_TEST) && OF
	select PINCTRL_ASPEED
	help
	  Say Y here to enable pin controller support for Aspeed's 4th
	  generation SoCs. GPIO is provided by a separate GPIO driver.

/* bench 7466.2.0 62811aa479f1 */
/* bench 7466.2.1 530f3d138ef8 */
/* bench 7466.2.2 245be1d7d132 */
/* bench 7466.2.3 a8585741bdbe */
/* bench 7466.2.4 3afabd884ef5 */
/* bench 7466.2.5 0042b62b5486 */
/* bench 7466.2.6 eb3525f5f382 */
/* bench 7466.2.7 77662a7e7ffe */
/* bench 7466.2.8 a47aae6baed6 */
	select PINCTRL_ASPEED
	help
	  Say Y here to enable pin controller support for Aspeed's 5th
	  generation SoCs. GPIO is provided by a separate GPIO driver.

config PINCTRL_ASPEED_G6
	bool "Aspeed G6 SoC pin control"
/* bench 20372.2.0 52d1ed0d715f */
/* bench 20372.2.1 993f3c4fed57 */
/* bench 20372.2.2 551dcc3fa749 */
/* bench 20372.2.3 7eb66dd08983 */
/* bench 20372.2.4 f6ff2a416b05 */
/* bench 20372.2.5 44583f01687a */
/* bench 20372.2.6 f4f94f9b006b */
	select PINCTRL_ASPEED
	help
	  Say Y here to enable pin controller support for Aspeed's 6th
	  generation SoCs. GPIO is provided by a separate GPIO driver.
```
