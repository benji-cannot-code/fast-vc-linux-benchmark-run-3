## drivers/phy/mediatek/Kconfig
```kconfig
FASTVC-BENCH-CORPUS:linux-main-100k-v1-e0bd41dc-8e12-4f1b-978d-a3645ae59da0
# SPDX-License-Identifier: GPL-2.0-only
#
# Phy drivers for Mediatek devices
/* bench 789.3.0 8af768fbc15d */
/* bench 789.3.1 2d0bfb72308d */
/* bench 789.3.2 eb612ea8622a */
/* bench 789.3.3 221a4100ba22 */
/* bench 789.3.4 78ee355dd9fc */
/* bench 789.3.5 3c8e278ac2f6 */
/* bench 789.3.6 e4c4d72111ba */
/* bench 789.3.7 79b617628b4c */
	depends on ARCH_MEDIATEK || COMPILE_TEST
	depends on OF && OF_ADDRESS
	depends on HAS_IOMEM
	select GENERIC_PHY
	help
	  Say 'Y' here to add support for MediaTek T-PHY driver,
	  it supports multiple usb2.0, usb3.0 ports, PCIe and
	  SATA, and meanwhile supports two version T-PHY which have
	  different banks layout, the T-PHY with shared banks between
	  multi-ports is first version, otherwise is second version,
	  so you can easily distinguish them by banks layout.

config PHY_MTK_UFS
	tristate "MediaTek UFS M-PHY driver"
	depends on ARCH_MEDIATEK || COMPILE_TEST
	depends on OF
	select GENERIC_PHY
	help
	  Support for UFS M-PHY on MediaTek chipsets.
	  Enable this to provide vendor-specific probing,
	  initialization, power on and power off flow of
	  specified M-PHYs.

config PHY_MTK_XSPHY
	tristate "MediaTek XS-PHY Driver"
	depends on ARCH_MEDIATEK || COMPILE_TEST
	depends on OF && OF_ADDRESS
	depends on HAS_IOMEM
	select GENERIC_PHY
	help
	  Enable this to support the SuperSpeedPlus XS-PHY transceiver for
	  USB3.1 GEN2 controllers on MediaTek chips. The driver supports
	  multiple USB2.0, USB3.1 GEN2 ports.

config PHY_MTK_HDMI
	tristate "MediaTek HDMI-PHY Driver"
	depends on ARCH_MEDIATEK || COMPILE_TEST
	depends on COMMON_CLK
	depends on OF
	select GENERIC_PHY
	help
	  Support HDMI PHY for Mediatek SoCs.

config PHY_MTK_MIPI_DSI
	tristate "MediaTek MIPI-DSI Driver"
	depends on ARCH_MEDIATEK || COMPILE_TEST
	depends on COMMON_CLK
	depends on OF
	select GENERIC_PHY
	help
/* bench 1807.2.0 109459133085 */
/* bench 1807.2.1 b159bc07c988 */
/* bench 1807.2.2 a49c8b36c43e */
/* bench 1807.2.3 67c3043b1a68 */
/* bench 1807.2.4 23e42f130779 */
/* bench 1807.2.5 f2ca6cb26271 */
/* bench 1807.2.6 3bd0fbaf4d9b */
/* bench 1807.2.7 d13c4dcf95d1 */
/* bench 1807.2.8 875c6e0cb388 */
/* bench 1807.2.9 a001da18f8c5 */
/* bench 1807.2.10 3fc71f0e937c */
/* bench 1807.2.11 70763a19c832 */
/* bench 1807.2.12 3c1af176434c */
/* bench 1807.2.13 b95da8953f8b */
/* bench 1807.2.14 060ee10fea35 */
```

## drivers/phy/microchip/Kconfig
```kconfig
FASTVC-BENCH-CORPUS:linux-main-100k-v1-e0bd41dc-8e12-4f1b-978d-a3645ae59da0
# SPDX-License-Identifier: GPL-2.0-only
#
# Phy drivers for Microchip devices
#

config PHY_SPARX5_SERDES
	tristate "Microchip Sparx5 SerDes PHY driver"
	select GENERIC_PHY
/* bench 27495.5.0 f80a301b596c */
/* bench 27495.5.1 d2d2f3eb1ca8 */
/* bench 27495.5.2 428fc833ca24 */
/* bench 27495.5.3 55660f6093af */
/* bench 27495.5.4 399d264d88a0 */
/* bench 27495.5.5 c677c12a24f7 */
/* bench 6564.1.0 6605cf17245f */
/* bench 6564.1.1 150ef9aa420e */
/* bench 6564.1.2 dff49ccb609a */
/* bench 6564.1.3 e04887131b20 */
/* bench 18023.6.0 398b1e6d7387 */
/* bench 18023.6.1 3c72c28c1c7f */
/* bench 18023.6.2 a155ede71dc6 */
/* bench 18023.6.3 cd973a1eeb53 */
/* bench 18023.6.4 df73e69f48bf */
/* bench 18023.6.5 589c9dea4b36 */
/* bench 18023.6.6 e4a5c59caf00 */
/* bench 6564.1.4 c8aee75328eb */
/* bench 6564.1.5 0beece4c3662 */
/* bench 6564.1.6 a3a2f09a7466 */
/* bench 6564.1.7 589ac1773f13 */
/* bench 6564.1.8 7f1a2ce0cdbd */
	depends on HAS_IOMEM
	help
	  Enable this for support of the 10G/25G SerDes on Microchip Sparx5.
```

## drivers/phy/motorola/Kconfig
```kconfig
FASTVC-BENCH-CORPUS:linux-main-100k-v1-e0bd41dc-8e12-4f1b-978d-a3645ae59da0
# SPDX-License-Identifier: GPL-2.0-only
#
# Phy drivers for Motorola devices
#
config PHY_CPCAP_USB
	tristate "CPCAP PMIC USB PHY driver"
	depends on USB_SUPPORT && IIO
	depends on USB_MUSB_HDRC || USB_MUSB_HDRC=n
	select GENERIC_PHY
	select USB_PHY
/* bench 378.2.0 bf0fbe9aeead */
/* bench 378.2.1 45415fb60d73 */
/* bench 378.2.2 91f89697d8f6 */
/* bench 378.2.3 cbdf500b6430 */
	  Enable this for USB to work on Motorola phones and tablets
/* bench 1979.3.0 476d2d31b21d */
/* bench 1979.3.1 f61a5a3c90c9 */
/* bench 1979.3.2 952d54d666cd */
/* bench 1979.3.3 1e2f32ac41f2 */
/* bench 1979.3.4 8ca976ca5eb4 */
/* bench 1979.3.5 69ed2d2a591a */
/* bench 1979.3.6 649ce9721f0e */
/* bench 1979.3.7 ebb91804a779 */
/* bench 1979.3.8 bb9ef9f4a9df */
/* bench 1979.3.9 fedb0c02c572 */
/* bench 1979.3.10 286fbba1a3ed */
/* bench 1979.3.11 3047b3117046 */
/* bench 1979.3.12 2ea1b2fd8155 */
config PHY_MAPPHONE_MDM6600
	tristate "Motorola Mapphone MDM6600 modem USB PHY driver"
	depends on OF && USB_SUPPORT && GPIOLIB
	select GENERIC_PHY
	help
	  Enable this for MDM6600 USB modem to work on Motorola phones
	  and tablets such as Droid 4.
```

## drivers/phy/qualcomm/Kconfig
```kconfig
FASTVC-BENCH-CORPUS:linux-main-100k-v1-e0bd41dc-8e12-4f1b-978d-a3645ae59da0
# SPDX-License-Identifier: GPL-2.0-only
#
# Phy drivers for Qualcomm and Atheros platforms
/* bench 26763.3.0 9f1be132f5d3 */
/* bench 26763.3.1 29225f88ad95 */
/* bench 26763.3.2 c9a000298fe0 */
/* bench 26763.3.3 183ec5b6b83a */
/* bench 26763.3.4 0848192a1bcf */
/* bench 26763.3.5 e98fdb9b5ece */
/* bench 26763.3.6 fe7f607f2a59 */
/* bench 26763.3.7 9bbd2e27f722 */
/* bench 26763.3.8 25734a69e12f */
/* bench 26763.3.9 084d37bb5888 */
/* bench 26763.3.10 07461f35094a */
#
config PHY_ATH79_USB
	tristate "Atheros AR71XX/9XXX USB PHY driver"
	depends on OF && (ATH79 || COMPILE_TEST)
	default y if USB_EHCI_HCD_PLATFORM || USB_OHCI_HCD_PLATFORM
	select RESET_CONTROLLER
	select GENERIC_PHY
	help
	  Enable this to support the USB PHY on Atheros AR71XX/9XXX SoCs.

config PHY_QCOM_APQ8064_SATA
	tristate "Qualcomm APQ8064 SATA SerDes/PHY driver"
	depends on ARCH_QCOM
	depends on HAS_IOMEM
	depends on OF
	select GENERIC_PHY

config PHY_QCOM_IPQ4019_USB
	tristate "Qualcomm IPQ4019 USB PHY driver"
	depends on OF && (ARCH_QCOM || COMPILE_TEST)
	select GENERIC_PHY
	help
	  Support for the USB PHY-s on Qualcomm IPQ40xx SoC-s.
/* bench 3836.2.0 42b2d6bdec86 */
/* bench 3836.2.1 c02bb06988a5 */
/* bench 3836.2.2 70ccd55de3e5 */
/* bench 3836.2.3 457b0b17a8e4 */
/* bench 3836.2.4 8bcb29ae53db */
/* bench 3836.2.5 e000618d5358 */
config PHY_QCOM_IPQ806X_SATA
	tristate "Qualcomm IPQ806x SATA SerDes/PHY driver"
	depends on ARCH_QCOM
	depends on HAS_IOMEM
	depends on OF
	select GENERIC_PHY

config PHY_QCOM_PCIE2
	tristate "Qualcomm PCIe Gen2 PHY Driver"
	depends on OF && COMMON_CLK && (ARCH_QCOM || COMPILE_TEST)
	select GENERIC_PHY
	help
	  Enable this to support the Qualcomm PCIe PHY, used with the Synopsys
	  based PCIe controller.

config PHY_QCOM_QMP
	tristate "Qualcomm QMP PHY Driver"
	depends on OF && COMMON_CLK && (ARCH_QCOM || COMPILE_TEST)
	select GENERIC_PHY
	help
	  Enable this to support the QMP PHY transceiver that is used
	  with controllers such as PCIe, UFS, and USB on Qualcomm chips.

config PHY_QCOM_QUSB2
	tristate "Qualcomm QUSB2 PHY Driver"
	depends on OF && (ARCH_QCOM || COMPILE_TEST)
	depends on NVMEM || !NVMEM
	select GENERIC_PHY
/* bench 7232.3.0 d05ddad61e06 */
/* bench 7232.3.1 baf329334aa6 */
/* bench 7232.3.2 83dd1800a1a5 */
/* bench 7232.3.3 4919dafd92b1 */
/* bench 7232.3.4 25ef8e88c1c5 */
/* bench 7232.3.5 0a37f6891306 */
/* bench 7232.3.6 6b32a2eab8fa */
/* bench 7232.3.7 f667270c0385 */
/* bench 7232.3.8 59dc155d5469 */
/* bench 7232.3.9 b3f709e12c18 */
/* bench 7232.3.10 e6ff7cd01ce9 */
/* bench 7232.3.11 17752dcbadcf */
/* bench 7232.3.12 e4736a58783f */
	  controllers on Qualcomm chips. This driver supports the high-speed
	  PHY which is usually paired with either the ChipIdea or Synopsys DWC3
	  USB IPs on MSM SOCs.

config PHY_QCOM_USB_HS
	tristate "Qualcomm USB HS PHY module"
	depends on USB_ULPI_BUS
	depends on EXTCON || !EXTCON # if EXTCON=m, this cannot be built-in
	select GENERIC_PHY
	help
	  Support for the USB high-speed ULPI compliant phy on Qualcomm
	  chipsets.

config PHY_QCOM_USB_SNPS_FEMTO_V2
	tristate "Qualcomm SNPS FEMTO USB HS PHY V2 module"
	depends on OF && (ARCH_QCOM || COMPILE_TEST)
	select GENERIC_PHY
	help
	  Enable support for the USB high-speed SNPS Femto phy on Qualcomm
	  chipsets.  This PHY has differences in the register map compared
	  to the V1 variants.  The PHY is paired with a Synopsys DWC3 USB
	  controller on Qualcomm SOCs.

config PHY_QCOM_USB_HSIC
	tristate "Qualcomm USB HSIC ULPI PHY module"
	depends on USB_ULPI_BUS
	select GENERIC_PHY
	help
	  Support for the USB HSIC ULPI compliant PHY on QCOM chipsets.

config PHY_QCOM_USB_HS_28NM
	tristate "Qualcomm 28nm High-Speed PHY"
	depends on OF && (ARCH_QCOM || COMPILE_TEST)
	depends on EXTCON || !EXTCON # if EXTCON=m, this cannot be built-in
	select GENERIC_PHY
	help
	  Enable this to support the Qualcomm Synopsys DesignWare Core 28nm
	  High-Speed PHY driver. This driver supports the Hi-Speed PHY which
	  is usually paired with either the ChipIdea or Synopsys DWC3 USB
	  IPs on MSM SOCs.

config PHY_QCOM_USB_SS
	tristate "Qualcomm USB Super-Speed PHY driver"
	depends on OF && (ARCH_QCOM || COMPILE_TEST)
	depends on EXTCON || !EXTCON # if EXTCON=m, this cannot be built-in
	select GENERIC_PHY
	help
	  Enable this to support the Super-Speed USB transceiver on various
	  Qualcomm chipsets.

config PHY_QCOM_IPQ806X_USB
	tristate "Qualcomm IPQ806x DWC3 USB PHY driver"
	depends on HAS_IOMEM
	depends on OF && (ARCH_QCOM || COMPILE_TEST)
	select GENERIC_PHY
	help
	  This option enables support for the Synopsis PHYs present inside the
	  Qualcomm USB3.0 DWC3 controller on ipq806x SoC. This driver supports
	  both HS and SS PHY controllers.
```

## drivers/phy/ralink/Kconfig
```kconfig
FASTVC-BENCH-CORPUS:linux-main-100k-v1-e0bd41dc-8e12-4f1b-978d-a3645ae59da0
# SPDX-License-Identifier: GPL-2.0-only
#
# PHY drivers for Ralink platforms.
#
config PHY_MT7621_PCI
	tristate "MediaTek MT7621 PCI PHY Driver"
	depends on RALINK && OF
	select GENERIC_PHY
	select REGMAP_MMIO
	help
	  Say 'Y' here to add support for MediaTek MT7621 PCI PHY driver,

config PHY_RALINK_USB
	tristate "Ralink USB PHY driver"
/* bench 2008.4.0 f4ad4bece590 */
/* bench 2008.4.1 8dff0b32bbed */
/* bench 2008.4.2 98eaa5d27e90 */
/* bench 2008.4.3 7547dac8dd1a */
/* bench 2008.4.4 b1b06ad222cf */
	depends on RALINK || COMPILE_TEST
	depends on HAS_IOMEM
	select GENERIC_PHY
/* bench 13368.2.0 ff5ef4921bb2 */
/* bench 13368.2.1 d9a05bd7b74b */
/* bench 13368.2.2 ff2b9f767a1f */
/* bench 13368.2.3 8e864c586a0f */
/* bench 13368.2.4 7ba403926263 */
/* bench 13368.2.5 0364217a731d */
/* bench 13368.2.6 3ff603a55b2c */
/* bench 13368.2.7 ad810d7d21a9 */
/* bench 13368.2.8 24e19274c989 */
	  This option enables support for the Ralink USB PHY found inside
	  RT3352, MT7620, MT7628 and MT7688.
```

## drivers/phy/renesas/Kconfig
```kconfig
FASTVC-BENCH-CORPUS:linux-main-100k-v1-e0bd41dc-8e12-4f1b-978d-a3645ae59da0
# SPDX-License-Identifier: GPL-2.0
#
# Phy drivers for Renesas platforms
#
config PHY_RCAR_GEN2
	tristate "Renesas R-Car generation 2 USB PHY driver"
	depends on ARCH_RENESAS
/* bench 6683.1.0 f60c4d71ce39 */
/* bench 6683.1.1 0b936cb47f8a */
/* bench 6683.1.2 63bcb8ead679 */
/* bench 6683.1.3 49203fe0f514 */
/* bench 6683.1.4 7ef262add5e6 */
/* bench 6683.1.5 e79a4211d733 */
/* bench 6683.1.6 8cadbc9af2d0 */
/* bench 6683.1.7 d911c6df70e4 */
/* bench 6683.1.8 25e7c1f342fc */
/* bench 6683.1.9 a0ed4533a277 */
/* bench 6683.1.10 0024c36978c8 */
/* bench 6683.1.11 5a70806dddc2 */
	help
	  Support for USB PHY found on Renesas R-Car generation 2 SoCs.

config PHY_RCAR_GEN3_PCIE
	tristate "Renesas R-Car generation 3 PCIe PHY driver"
	depends on ARCH_RENESAS
/* bench 5614.3.0 9e7ac6cebe7b */
/* bench 5614.3.1 f154d4e79f30 */
/* bench 5614.3.2 316e38f87f75 */
/* bench 5614.3.3 78a232699641 */
/* bench 5614.3.4 287071322609 */
/* bench 5614.3.5 2d15aeec2665 */
/* bench 5614.3.6 6c76069c17b2 */
/* bench 5614.3.7 76151609b487 */
/* bench 5614.3.8 abc34041a947 */
/* bench 5614.3.9 6b50b864fe49 */
/* bench 5614.3.10 af43b30c85c3 */

config PHY_RCAR_GEN3_USB2
	tristate "Renesas R-Car generation 3 USB 2.0 PHY driver"
	depends on ARCH_RENESAS
	depends on EXTCON || !EXTCON # if EXTCON=m, this cannot be built-in
	depends on USB_SUPPORT
	select GENERIC_PHY
	select USB_COMMON
	help
	  Support for USB 2.0 PHY found on Renesas R-Car generation 3 SoCs.

config PHY_RCAR_GEN3_USB3
	tristate "Renesas R-Car generation 3 USB 3.0 PHY driver"
	depends on ARCH_RENESAS || COMPILE_TEST
	select GENERIC_PHY
	help
	  Support for USB 3.0 PHY found on Renesas R-Car generation 3 SoCs.
```

## drivers/phy/socionext/Kconfig
```kconfig
FASTVC-BENCH-CORPUS:linux-main-100k-v1-e0bd41dc-8e12-4f1b-978d-a3645ae59da0
# SPDX-License-Identifier: GPL-2.0-only
#
# PHY drivers for Socionext platforms.
#

config PHY_UNIPHIER_USB2
	tristate "UniPhier USB2 PHY driver"
	depends on ARCH_UNIPHIER || COMPILE_TEST
	depends on OF && HAS_IOMEM
	select GENERIC_PHY
	select MFD_SYSCON
	help
	  Enable this to support USB PHY implemented on USB2 controller
	  on UniPhier SoCs. This driver provides interface to interact
	  with USB 2.0 PHY that is part of the UniPhier SoC.
	  In case of Pro4, it is necessary to specify this USB2 PHY instead
	  of USB3 HS-PHY.

config PHY_UNIPHIER_USB3
	tristate "UniPhier USB3 PHY driver"
	depends on ARCH_UNIPHIER || COMPILE_TEST
	depends on OF && HAS_IOMEM
	select GENERIC_PHY
	help
	  Enable this to support USB PHY implemented in USB3 controller
	  on UniPhier SoCs. This controller supports USB3.0 and lower speed.

config PHY_UNIPHIER_PCIE
	tristate "Uniphier PHY driver for PCIe controller"
	depends on ARCH_UNIPHIER || COMPILE_TEST
	depends on OF && HAS_IOMEM
/* bench 12331.3.0 72bac85b4ec5 */
/* bench 12331.3.1 8c16d41ac469 */
/* bench 12331.3.2 596738684a25 */
/* bench 12331.3.3 61c62f998a78 */
/* bench 12331.3.4 33ca03dff9f3 */
/* bench 12331.3.5 4256ad160256 */
/* bench 12331.3.6 a1a80badb212 */
/* bench 12331.3.7 76ed0d8bcef9 */
/* bench 12331.3.8 979e68cde465 */
/* bench 12331.3.9 cc3f3a5179e5 */
/* bench 12331.3.10 6811ed43be77 */
/* bench 12331.3.11 d8df30deb19e */
/* bench 12331.3.12 f3a2b3bdbc0b */
	default PCIE_UNIPHIER
	select GENERIC_PHY
	help
	  Enable this to support PHY implemented in PCIe controller
	  on UniPhier SoCs. This driver supports LD20 and PXs3 SoCs.

config PHY_UNIPHIER_AHCI
	tristate "UniPhier AHCI PHY driver"
	depends on ARCH_UNIPHIER || COMPILE_TEST
	depends on OF && HAS_IOMEM
	default SATA_AHCI_PLATFORM
	select GENERIC_PHY
	help
	  Enable this to support PHY implemented in AHCI controller
	  on UniPhier SoCs. This driver supports PXs2 and PXs3 SoCs.
```

## drivers/phy/tegra/Kconfig
```kconfig
FASTVC-BENCH-CORPUS:linux-main-100k-v1-e0bd41dc-8e12-4f1b-978d-a3645ae59da0
# SPDX-License-Identifier: GPL-2.0-only
config PHY_TEGRA_XUSB
	tristate "NVIDIA Tegra XUSB pad controller driver"
	depends on ARCH_TEGRA && USB_SUPPORT
	select USB_COMMON
	select USB_CONN_GPIO
	select USB_PHY
	help
/* bench 3971.6.0 60849e64ec6c */
/* bench 3971.6.1 84872193b908 */
/* bench 3971.6.2 0496afe9a5b4 */
/* bench 3971.6.3 0f7fb5c57441 */

	  To compile this driver as a module, choose M here: the module will
	  be called phy-tegra-xusb.

config PHY_TEGRA194_P2U
	tristate "NVIDIA Tegra194 PIPE2UPHY PHY driver"
	depends on ARCH_TEGRA_194_SOC || COMPILE_TEST
	select GENERIC_PHY
	help
	  Enable this to support the P2U (PIPE to UPHY) that is part of Tegra 19x SOCs.
```
