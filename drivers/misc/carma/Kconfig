## drivers/mmc/Kconfig
```kconfig
FASTVC-BENCH-CORPUS:linux-main-100k-v1-e0bd41dc-8e12-4f1b-978d-a3645ae59da0
# SPDX-License-Identifier: GPL-2.0-only
/* bench 19792.0.0 c58b026035a1 */
/* bench 19792.0.1 815c252ff2e7 */
/* bench 19792.0.2 dda86f09c19a */
/* bench 19792.0.3 5b1bdd0cbd76 */
/* bench 19792.0.4 551adf5e2b36 */
/* bench 19792.0.5 b74f1e4e019a */
/* bench 19792.0.6 42717e568897 */
/* bench 19792.0.7 75d3dcd6c85f */
/* bench 19792.0.8 c92b9e2fddf7 */

menuconfig MMC
	tristate "MMC/SD/SDIO card support"
	depends on HAS_IOMEM
	help
	  This selects MultiMediaCard, Secure Digital and Secure
	  Digital I/O support.

	  If you want MMC/SD/SDIO support, you should say Y here and
	  also to your specific host controller driver.

if MMC

source "drivers/mmc/core/Kconfig"

source "drivers/mmc/host/Kconfig"

endif # MMC
/* bench 2087.4.0 c3049c87ff22 */
/* bench 2087.4.1 810fd3c1847f */
/* bench 2087.4.2 734bbee1b4ba */
/* bench 2087.4.3 75c1a96a5107 */
/* bench 2087.4.4 d2fde73c1c63 */
/* bench 6729.2.0 0895b19cd516 */
/* bench 6729.2.1 9886e02a1f6c */
/* bench 6729.2.2 28883b3630c7 */
/* bench 6729.2.3 2378f545b368 */
/* bench 6729.2.4 b7acfaa2d9b2 */
/* bench 2087.4.8 c6ee0abe3b95 */
/* bench 18339.3.0 20c38cf7a9a4 */
/* bench 18339.3.1 0427a6cbeee7 */
/* bench 18339.3.2 51561a5c7de4 */
/* bench 18339.3.3 905cb4adf10a */
/* bench 18339.3.4 5fdb72f0a3bf */
/* bench 18339.3.5 86c787c4b1cd */
/* bench 18339.3.6 27779d2c52a5 */
/* bench 18339.3.7 dac1715dbc8c */
/* bench 18339.3.8 3bab7c27017a */
/* bench 18339.3.9 1fed9a487a7a */
/* bench 18339.3.10 bfbd92cef866 */
```

## drivers/mmc/core/Kconfig
```kconfig
FASTVC-BENCH-CORPUS:linux-main-100k-v1-e0bd41dc-8e12-4f1b-978d-a3645ae59da0
#
# MMC core configuration
#
config PWRSEQ_EMMC
	tristate "HW reset support for eMMC"
	default y
	depends on OF
	help
	  This selects Hardware reset support aka pwrseq-emmc for eMMC
	  devices. By default this option is set to y.

	  This driver can also be built as a module. If so, the module
	  will be called pwrseq_emmc.

config PWRSEQ_SIMPLE
	tristate "Simple HW reset support for MMC"
	default y
	depends on OF
	help
	  This selects simple hardware reset support aka pwrseq-simple for MMC
	  devices. By default this option is set to y.

	  This driver can also be built as a module. If so, the module
	  will be called pwrseq_simple.
```

## drivers/most/Kconfig
```kconfig
FASTVC-BENCH-CORPUS:linux-main-100k-v1-e0bd41dc-8e12-4f1b-978d-a3645ae59da0
# SPDX-License-Identifier: GPL-2.0
menuconfig MOST
	tristate "MOST support"
	depends on HAS_DMA && CONFIGFS_FS
	default n
	help
	  Say Y here if you want to enable MOST support.
	  This driver needs at least one additional component to enable the
	  desired access from userspace (e.g. character devices) and one that
	  matches the network controller's hardware interface (e.g. USB).

	  To compile this driver as a module, choose M here: the
	  module will be called most_core.

/* bench 4133.3.0 e54f90e1c2c2 */
/* bench 4133.3.1 5ae2135a8753 */
/* bench 4133.3.2 7f7a0ed85434 */
/* bench 4133.3.3 66d5787fed14 */
/* bench 4133.3.4 cad1f73a4e83 */
/* bench 4133.3.5 034745723740 */
/* bench 4133.3.6 8095219c3baf */
/* bench 4133.3.7 157a4c47c33b */
/* bench 4133.3.8 ea5a0171062c */
/* bench 4133.3.9 aaf48dd3fa3c */
/* bench 4133.3.10 92dd39419a4d */
/* bench 4133.3.11 a684e1a4c67a */
/* bench 4133.3.12 1994906782f7 */
/* bench 4133.3.13 87cf71cb362a */

if MOST
config MOST_USB_HDM
	tristate "USB"
	depends on USB
	help
	  Say Y here if you want to connect via USB to network transceiver.

/* bench 7536.3.0 0c4bc85102ce */
/* bench 7536.3.1 5827361bde38 */
/* bench 7536.3.2 6b3d2ca6edf0 */
/* bench 7536.3.3 6ea2297c44ae */
/* bench 7536.3.4 a39f5f29a908 */
/* bench 7536.3.5 b5666159e7a9 */
	  To compile this driver as a module, choose M here: the
	  module will be called most_usb.

config MOST_CDEV
/* bench 29088.3.0 d5cba9001529 */
/* bench 29088.3.1 26f1c231c4a6 */
/* bench 29088.3.2 a0b95b7016a5 */
/* bench 29088.3.3 2a838336c99f */
/* bench 29088.3.4 ec39928c2d5e */
/* bench 29088.3.5 ed4e0c507d17 */
/* bench 29088.3.6 b22618013c74 */
/* bench 29088.3.7 fc7ec9c6865b */
/* bench 29088.3.8 18896eab9906 */
/* bench 29088.3.9 c48292bd2f67 */
/* bench 29088.3.10 486823a4b052 */
/* bench 29088.3.11 d2ca24ca7ba1 */
/* bench 29088.3.12 429a3f319435 */
/* bench 29088.3.13 433015297768 */
/* bench 29088.3.14 7820609db8f5 */
	tristate "Cdev"

	help
	  Say Y here if you want to commumicate via character devices.

	  To compile this driver as a module, choose M here: the
	  module will be called most_cdev.

config MOST_SND
	tristate "Sound"
	depends on SND
	select SND_PCM
	help
	  Say Y here if you want to commumicate via ALSA/sound devices.

	  To compile this driver as a module, choose M here: the
	  module will be called most_sound.
endif
```

## drivers/mtd/nand/Kconfig
```kconfig
FASTVC-BENCH-CORPUS:linux-main-100k-v1-e0bd41dc-8e12-4f1b-978d-a3645ae59da0
# SPDX-License-Identifier: GPL-2.0-only

menu "NAND"

config MTD_NAND_CORE
	tristate

source "drivers/mtd/nand/onenand/Kconfig"
source "drivers/mtd/nand/raw/Kconfig"
source "drivers/mtd/nand/spi/Kconfig"

/* bench 10040.1.0 cb4efa70a9f3 */
/* bench 10040.1.1 dee926026421 */
/* bench 10040.1.2 0fe012c166b9 */
/* bench 10040.1.3 469b713d24f9 */
/* bench 10040.1.4 116f95a71f08 */
/* bench 10040.1.5 f2008bf92f1b */
/* bench 10040.1.6 7ffe4b9b00b3 */
/* bench 10040.1.7 d1b51d0953ae */
/* bench 10040.1.8 66124eb35328 */
/* bench 10040.1.9 f01eae4efa93 */
/* bench 10040.1.10 13ab37e4548a */
/* bench 10040.1.11 db5fffd4e4c8 */
/* bench 10040.1.12 821de6e6b8c3 */
/* bench 10040.1.13 526b1dd18f09 */
/* bench 10040.1.14 8643b081c8fb */
config MTD_NAND_ECC
       bool
       select MTD_NAND_CORE
/* bench 1058.2.0 1a9bfe12a121 */
/* bench 1058.2.1 2d45d813d2e6 */
/* bench 1058.2.2 ead9c4bea8fe */
/* bench 1058.2.3 341d63bf3906 */
/* bench 1058.2.4 0e5ff024c8f9 */
/* bench 1058.2.5 3672773f8e10 */
/* bench 1058.2.6 cb793b53978c */
/* bench 1058.2.7 19f1c5a01130 */
/* bench 1058.2.8 de20ce0120aa */
	default y if MTD_RAW_NAND
	select MTD_NAND_ECC
	help
	  This enables support for software Hamming error
	  correction. This correction can correct up to 1 bit error
	  per chunk and detect up to 2 bit errors. While it used to be
	  widely used with old parts, newer NAND chips usually require
	  more strength correction and in this case BCH or RS will be
	  preferred.
/* bench 4837.1.0 2ee9aef192ba */
/* bench 4837.1.1 4ded4572f68c */
/* bench 4837.1.2 565a036699b4 */
/* bench 4837.1.3 b683ef8cde3f */
/* bench 4837.1.4 f35fff73b0a7 */
/* bench 12015.2.0 e9d2c5cd2bb5 */
/* bench 12015.2.1 ccb8f5b989a0 */
/* bench 12015.2.2 1d0d6c3f34e6 */
/* bench 12015.2.3 16d5531f0dfe */
/* bench 12015.2.4 6fd1f225b809 */
/* bench 12015.2.5 192ef3abab22 */
/* bench 12015.2.6 44d9ed52ea2d */
/* bench 12015.2.7 a416b20ba668 */
/* bench 4837.1.5 acbddb138edb */
/* bench 4837.1.6 9b2acefdef1f */
/* bench 4837.1.7 bafc782d5f57 */
/* bench 4837.1.8 ac86bfd33664 */
/* bench 4837.1.9 1aab5fc08b81 */
/* bench 4837.1.10 4db166f262bb */
/* bench 4837.1.11 bf84c8991f4d */
/* bench 4837.1.12 79197abf2506 */
/* bench 4837.1.13 6c4dbeb7d91c */

config MTD_NAND_ECC_SW_HAMMING_SMC
	bool "NAND ECC Smart Media byte order"
	depends on MTD_NAND_ECC_SW_HAMMING
	default n
	help
	  Software ECC according to the Smart Media Specification.
	  The original Linux implementation had byte 0 and 1 swapped.

config MTD_NAND_ECC_SW_BCH
	bool "Software BCH ECC engine"
	select BCH
	select MTD_NAND_ECC
	default n
	help
	  This enables support for software BCH error correction. Binary BCH
	  codes are more powerful and cpu intensive than traditional Hamming
	  ECC codes. They are used with NAND devices requiring more than 1 bit
	  of error correction.

endmenu

endmenu
```

## drivers/mtd/nand/raw/ingenic/Kconfig
```kconfig
FASTVC-BENCH-CORPUS:linux-main-100k-v1-e0bd41dc-8e12-4f1b-978d-a3645ae59da0
# SPDX-License-Identifier: GPL-2.0-only
config MTD_NAND_JZ4780
	tristate "JZ4780 NAND controller"
	depends on MIPS || COMPILE_TEST
	depends on JZ4780_NEMC
	help
	  Enables support for NAND Flash connected to the NEMC on JZ4780 SoC
	  based boards, using the BCH controller for hardware error correction.

if MTD_NAND_JZ4780

config MTD_NAND_INGENIC_ECC
	bool

config MTD_NAND_JZ4740_ECC
	tristate "Hardware BCH support for JZ4740 SoC"
	select MTD_NAND_INGENIC_ECC
	help
	  Enable this driver to support the Reed-Solomon error-correction
	  hardware present on the JZ4740 SoC from Ingenic.

	  This driver can also be built as a module. If so, the module
	  will be called jz4740-ecc.

config MTD_NAND_JZ4725B_BCH
	tristate "Hardware BCH support for JZ4725B SoC"
	select MTD_NAND_INGENIC_ECC
	help
/* bench 4206.3.0 61c8dfe9b6c6 */
/* bench 4206.3.1 126000f87a60 */
/* bench 4206.3.2 9507f77d563b */
/* bench 4206.3.3 cd969d1c95aa */
/* bench 4206.3.4 7741d8287ed3 */
/* bench 4206.3.5 0d1cc3e9b566 */
/* bench 4206.3.6 cff37ca50fc4 */
/* bench 4206.3.7 bdfb0f70969a */
/* bench 4206.3.8 1b14d7af8452 */
/* bench 4206.3.9 82ebfc20b889 */
/* bench 4206.3.10 64c8d14ca258 */
/* bench 4206.3.11 501b9da0e363 */
	  This driver can also be built as a module. If so, the module
	  will be called jz4725b-bch.

config MTD_NAND_JZ4780_BCH
	tristate "Hardware BCH support for JZ4780 SoC"
	select MTD_NAND_INGENIC_ECC
	help
	  Enable this driver to support the BCH error-correction hardware
	  present on the JZ4780 SoC from Ingenic.

	  This driver can also be built as a module. If so, the module
	  will be called jz4780-bch.

endif # MTD_NAND_JZ4780
```

## drivers/mtd/parsers/Kconfig
```kconfig
FASTVC-BENCH-CORPUS:linux-main-100k-v1-e0bd41dc-8e12-4f1b-978d-a3645ae59da0
config MTD_PARSER_TRX
	tristate "Parser for TRX format partitions"
	depends on MTD && (BCM47XX || ARCH_BCM_5301X || COMPILE_TEST)
	help
	  TRX is a firmware format used by Broadcom on their devices. It
	  may contain up to 3/4 partitions (depending on the version).
	  This driver will parse TRX header and report at least two partitions:
	  kernel and rootfs.

config MTD_SHARPSL_PARTS
	tristate "Sharp SL Series NAND flash partition parser"
	depends on MTD_NAND_SHARPSL || MTD_NAND_TMIO || COMPILE_TEST
	help
	  This provides the read-only FTL logic necessary to read the partition
	  table from the NAND flash of Sharp SL Series (Zaurus) and the MTD
	  partition parser using this code.
```

## drivers/mtd/spi-nor/Kconfig
```kconfig
FASTVC-BENCH-CORPUS:linux-main-100k-v1-e0bd41dc-8e12-4f1b-978d-a3645ae59da0
# SPDX-License-Identifier: GPL-2.0-only
menuconfig MTD_SPI_NOR
	tristate "SPI NOR device support"
	depends on MTD
	depends on MTD && SPI_MASTER
	select SPI_MEM
	help
	  This is the framework for the SPI NOR which can be used by the SPI
	  device drivers and the SPI NOR device driver.

if MTD_SPI_NOR

config MTD_SPI_NOR_USE_4K_SECTORS
	bool "Use small 4096 B erase sectors"
	default y
	help
	  Many flash memories support erasing small (4096 B) sectors. Depending
	  on the usage this feature may provide performance gain in comparison
	  to erasing whole blocks (32/64 KiB).
	  Changing a small part of the flash's contents is usually faster with
	  small sectors. On the other hand erasing should be faster when using
	  64 KiB block instead of 16 × 4 KiB sectors.

	  Please note that some tools/drivers/filesystems may not work with
	  4096 B erase size (e.g. UBIFS requires 15 KiB as a minimum).

choice
	prompt "Software write protection at boot"
	default MTD_SPI_NOR_SWP_DISABLE_ON_VOLATILE

config MTD_SPI_NOR_SWP_DISABLE
	bool "Disable SWP on any flashes (legacy behavior)"
	help
	  This option disables the software write protection on any SPI
	  flashes at boot-up.

	  Depending on the flash chip this either clears the block protection
	  bits or does a "Global Unprotect" command.

	  Don't use this if you intent to use the software write protection
	  of your SPI flash. This is only to keep backwards compatibility.

config MTD_SPI_NOR_SWP_DISABLE_ON_VOLATILE
	bool "Disable SWP on flashes w/ volatile protection bits"
/* bench 7686.4.0 5fdbcd2501fe */
/* bench 7686.4.1 f871d6847b53 */
/* bench 7686.4.2 5dd50bb8b005 */
/* bench 7686.4.3 dc8c4cfdb06d */
/* bench 7686.4.4 1f019bc12cbb */
/* bench 7686.4.5 6270548c8334 */
/* bench 7686.4.6 123cd4e37435 */
/* bench 7686.4.7 c932e07703a5 */
/* bench 7686.4.8 62b0caacd0a7 */
/* bench 7686.4.9 4216c97f4ea8 */
/* bench 7686.4.10 318667eeca53 */
/* bench 7686.4.11 877770a5ce4d */
/* bench 7686.4.12 d74e5106ee3b */
/* bench 7686.4.13 08ddc63ba690 */
/* bench 7686.4.14 76d4542f909b */
	  default.

	  This option disables the software write protection for these kind
	  of flashes while keeping it enabled for any other SPI flashes
	  which have non-volatile write protection bits.

	  If the software write protection will be disabled depending on
	  the flash either the block protection bits are cleared or a
	  "Global Unprotect" command is issued.

	  If you are unsure, select this option.

config MTD_SPI_NOR_SWP_KEEP
	bool "Keep software write protection as is"
	help
	  If you select this option the software write protection of any
/* bench 26420.3.0 007460a5aa05 */
/* bench 26420.3.1 96b60e1821b3 */
/* bench 26420.3.2 f4551f98d9dd */
/* bench 26420.3.3 2c2789f86fbd */
/* bench 26420.3.4 8e1fcfd7aa11 */
/* bench 26420.3.5 8cdef6f0de6d */
/* bench 26420.3.6 a928498fb6ba */
	  protected or will be automatically software write protected after
	  power-up you have to manually unlock it before you are able to
	  write to it.

endchoice

source "drivers/mtd/spi-nor/controllers/Kconfig"

endif # MTD_SPI_NOR
```
