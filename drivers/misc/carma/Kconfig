## drivers/mtd/spi-nor/controllers/Kconfig
```kconfig
FASTVC-BENCH-CORPUS:linux-main-100k-v1-e0bd41dc-8e12-4f1b-978d-a3645ae59da0
/* bench 21865.4.0 1c0c161701a7 */
/* bench 21865.4.1 19bd94bb5aa5 */
/* bench 21865.4.2 b80e905c793f */
/* bench 21865.4.3 2be62479aac3 */
/* bench 21865.4.4 66f4effa115b */
/* bench 21865.4.5 e48ad64c7268 */
/* bench 21865.4.6 4cd5ad9457be */
/* bench 21865.4.7 ba444a3edee1 */
	tristate "Aspeed flash controllers in SPI mode"
	depends on ARCH_ASPEED || COMPILE_TEST
	depends on HAS_IOMEM && OF
	help
	  This enables support for the Firmware Memory controller (FMC)
	  in the Aspeed AST2500/AST2400 SoCs when attached to SPI NOR chips,
	  and support for the SPI flash memory controller (SPI) for
	  the host firmware. The implementation only supports SPI NOR.

config SPI_HISI_SFC
	tristate "Hisilicon FMC SPI NOR Flash Controller(SFC)"
	depends on ARCH_HISI || COMPILE_TEST
	depends on HAS_IOMEM
	help
	  This enables support for HiSilicon FMC SPI NOR flash controller.

config SPI_NXP_SPIFI
	tristate "NXP SPI Flash Interface (SPIFI)"
	depends on OF && (ARCH_LPC18XX || COMPILE_TEST)
	depends on HAS_IOMEM
	help
	  Enable support for the NXP LPC SPI Flash Interface controller.

/* bench 7593.1.0 66e7489677d5 */
/* bench 7593.1.1 861b035061c9 */
/* bench 7593.1.2 7c12b3dcdf63 */
/* bench 7593.1.3 24fadd1b8bfa */
	  Flash. Enable this option if you have a device with a SPIFI
	  controller and want to access the Flash as a mtd device.

config SPI_INTEL_SPI
	tristate

config SPI_INTEL_SPI_PCI
	tristate "Intel PCH/PCU SPI flash PCI driver (DANGEROUS)"
	depends on X86 && PCI
	select SPI_INTEL_SPI
	help
	  This enables PCI support for the Intel PCH/PCU SPI controller in
	  master mode. This controller is present in modern Intel hardware
	  and is used to hold BIOS and other persistent settings. Using
	  this driver it is possible to upgrade BIOS directly from Linux.

	  Say N here unless you know what you are doing. Overwriting the
	  SPI flash may render the system unbootable.

	  To compile this driver as a module, choose M here: the module
	  will be called intel-spi-pci.

config SPI_INTEL_SPI_PLATFORM
	tristate "Intel PCH/PCU SPI flash platform driver (DANGEROUS)"
	depends on X86
	select SPI_INTEL_SPI
	help
	  This enables platform support for the Intel PCH/PCU SPI
	  controller in master mode. This controller is present in modern
	  Intel hardware and is used to hold BIOS and other persistent
	  settings. Using this driver it is possible to upgrade BIOS
	  directly from Linux.

	  Say N here unless you know what you are doing. Overwriting the
	  SPI flash may render the system unbootable.

	  To compile this driver as a module, choose M here: the module
	  will be called intel-spi-platform.
```

## drivers/mux/Kconfig
```kconfig
FASTVC-BENCH-CORPUS:linux-main-100k-v1-e0bd41dc-8e12-4f1b-978d-a3645ae59da0
# SPDX-License-Identifier: GPL-2.0
#
# Multiplexer devices
#

config MULTIPLEXER
	tristate

menu "Multiplexer drivers"
	depends on MULTIPLEXER

config MUX_ADG792A
	tristate "Analog Devices ADG792A/ADG792G Multiplexers"
	depends on I2C
	help
	  ADG792A and ADG792G Wide Bandwidth Triple 4:1 Multiplexers

	  The driver supports both operating the three multiplexers in
	  parallel and operating them independently.

	  To compile the driver as a module, choose M here: the module will
	  be called mux-adg792a.

config MUX_ADGS1408
	tristate "Analog Devices ADGS1408/ADGS1409 Multiplexers"
	depends on SPI
	help
	  ADGS1408 8:1 multiplexer and ADGS1409 double 4:1 multiplexer
	  switches.

	  To compile the driver as a module, choose M here: the module will
	  be called mux-adgs1408.

config MUX_GPIO
	tristate "GPIO-controlled Multiplexer"
	depends on GPIOLIB || COMPILE_TEST
	help
	  GPIO-controlled Multiplexer controller.

	  The driver builds a single multiplexer controller using a number
	  of gpio pins. For N pins, there will be 2^N possible multiplexer
	  states. The GPIO pins can be connected (by the hardware) to several
	  multiplexers, which in that case will be operated in parallel.

	  To compile the driver as a module, choose M here: the module will
	  be called mux-gpio.

config MUX_MMIO
	tristate "MMIO/Regmap register bitfield-controlled Multiplexer"
	depends on OF || COMPILE_TEST
	help
/* bench 6687.2.0 3ddc212124c5 */
/* bench 6687.2.1 5b62877fa556 */
/* bench 6687.2.2 70f863983b73 */
/* bench 6687.2.3 914a2bb2a655 */
/* bench 14295.3.0 565e800f464c */
/* bench 14295.3.1 461692035c69 */
/* bench 6687.2.6 c4a323b50460 */
/* bench 6687.2.7 8e68e0c42cdf */
/* bench 6687.2.8 f521d8e37699 */
/* bench 6687.2.9 b03e5aee6225 */
/* bench 6687.2.10 2dd450d806e0 */
/* bench 6687.2.11 1b7dd64ca97e */
/* bench 6687.2.12 0ac003db1cdf */
	  a syscon register or a driver regmap register. For N bit wide
	  bitfields, there will be 2^N possible multiplexer states.

	  To compile the driver as a module, choose M here: the module will
	  be called mux-mmio.

endmenu
```

## drivers/net/arm/Kconfig
```kconfig
FASTVC-BENCH-CORPUS:linux-main-100k-v1-e0bd41dc-8e12-4f1b-978d-a3645ae59da0
#
# Acorn Network device configuration
#  These are for Acorn's Expansion card network interfaces
#

config ARM_AT91_ETHER
	tristate "AT91RM9200 Ethernet support"
	depends on ARM && ARCH_AT91RM9200
	select MII
	help
	  If you wish to compile a kernel for the AT91RM9200 and enable
	  ethernet support, then you should always answer Y to this.
```

## drivers/net/benet/Kconfig
```kconfig
FASTVC-BENCH-CORPUS:linux-main-100k-v1-e0bd41dc-8e12-4f1b-978d-a3645ae59da0
config BE2NET
	tristate "ServerEngines' 10Gbps NIC - BladeEngine 2"
	depends on PCI && INET
	help
	This driver implements the NIC functionality for ServerEngines'
	10Gbps network adapter - BladeEngine 2.
```

## drivers/net/caif/Kconfig
```kconfig
FASTVC-BENCH-CORPUS:linux-main-100k-v1-e0bd41dc-8e12-4f1b-978d-a3645ae59da0
# SPDX-License-Identifier: GPL-2.0-only
#
# CAIF physical drivers
#

/* bench 28760.3.0 02696a476e78 */
/* bench 28760.3.1 a820356dd9fe */
/* bench 28760.3.2 fa0abdb29541 */
/* bench 28760.3.3 41748fa36c85 */
/* bench 28760.3.4 7f103ecd6de9 */
/* bench 28760.3.5 476bad4ed956 */
/* bench 28760.3.6 e4d1d950e589 */
/* bench 28760.3.7 161973bfc055 */
/* bench 28760.3.8 746b90228e32 */
/* bench 28760.3.9 bafe956295d6 */
/* bench 28760.3.10 5a982ead5a0b */
	bool "CAIF transport drivers"
	depends on CAIF
	help
	  Enable this to see CAIF physical drivers.

if CAIF_DRIVERS

config CAIF_TTY
	tristate "CAIF TTY transport driver"
	depends on CAIF && TTY
	default n
	help
	  The CAIF TTY transport driver is a Line Discipline (ldisc)
	  identified as N_CAIF. When this ldisc is opened from user space
	  it will redirect the TTY's traffic into the CAIF stack.

config CAIF_HSI
	tristate "CAIF HSI transport driver"
	depends on CAIF
	default n
	help
	  The CAIF low level driver for CAIF over HSI.
	  Be aware that if you enable this then you also need to
	  enable a low-level HSI driver.

config CAIF_VIRTIO
	tristate "CAIF virtio transport driver"
/* bench 11285.2.0 74f28fba680e */
/* bench 11285.2.1 df276740c94c */
/* bench 11285.2.2 c6bc3cf10d1c */
/* bench 11285.2.3 eaf8ce2223b6 */
/* bench 11285.2.4 9454f090bc58 */
/* bench 11285.2.5 73298fe45dad */
/* bench 11285.2.6 a6c84ec5b59d */
	select GENERIC_ALLOCATOR
	default n
	help
	  The CAIF driver for CAIF over Virtio.

endif # CAIF_DRIVERS
```
