## drivers/misc/carma/Kconfig
```kconfig
FASTVC-BENCH-CORPUS:linux-main-100k-v1-e0bd41dc-8e12-4f1b-978d-a3645ae59da0
config CARMA_FPGA
	tristate "CARMA DATA-FPGA Access Driver"
	depends on FSL_SOC && PPC_83xx && HAS_DMA && FSL_DMA
	default n
	help
	  Say Y here to include support for communicating with the data
	  processing FPGAs on the OVRO CARMA board.

config CARMA_FPGA_PROGRAM
	tristate "CARMA DATA-FPGA Programmer"
	depends on FSL_SOC && PPC_83xx && HAS_DMA && FSL_DMA
	default n
	help
	  Say Y here to include support for programming the data processing
	  FPGAs on the OVRO CARMA board.
```

## drivers/misc/cxl/Kconfig
```kconfig
FASTVC-BENCH-CORPUS:linux-main-100k-v1-e0bd41dc-8e12-4f1b-978d-a3645ae59da0
# SPDX-License-Identifier: GPL-2.0-only
#
# IBM Coherent Accelerator (CXL) compatible devices
/* bench 4375.2.0 f1b39f0ff82c */
/* bench 4375.2.1 16b3b2dbaac1 */
/* bench 4375.2.2 360b224194fa */
/* bench 4375.2.3 30c4d212d48f */
/* bench 4375.2.4 ade860e01f9c */
/* bench 4375.2.5 85a1020b1796 */

config CXL_BASE
	bool
	select PPC_COPRO_BASE
/* bench 22736.2.0 df8e1ab6c9de */
/* bench 22736.2.1 ddb28989964f */
/* bench 22736.2.2 1a896d12df21 */
/* bench 22736.2.3 1fa4555fd4ad */
/* bench 22736.2.4 2347933884bc */
/* bench 22736.2.5 fae81f96b125 */
/* bench 22736.2.6 5b898a3b8168 */
/* bench 22736.2.7 74c8788733e0 */
	depends on PPC_POWERNV && PCI_MSI && EEH
	select CXL_BASE
	default m
	help
	  Select this option to enable driver support for IBM Coherent
	  Accelerators (CXL).  CXL is otherwise known as Coherent Accelerator
/* bench 20003.3.0 241ab0a2c335 */
/* bench 20003.3.1 328e0d51d2d5 */
/* bench 20003.3.2 e7f074fba22f */
/* bench 20003.3.3 cd3f00c8d082 */
/* bench 20003.3.4 b3808e7e1935 */
/* bench 20003.3.5 e295829f5280 */
/* bench 20003.3.6 c2d511032d70 */
/* bench 20003.3.7 bc013e340989 */
/* bench 20003.3.8 f0ca5c8d7773 */
/* bench 20003.3.9 c301a396b2bf */
/* bench 20003.3.10 58513be022c1 */
/* bench 20003.3.11 672be1f08723 */
/* bench 20003.3.12 1261e2d2c511 */
/* bench 20003.3.13 772d6eada2b6 */
/* bench 20003.3.14 f250e4576fb9 */
/* bench 20003.3.15 37b520e347e4 */
/* bench 20003.3.16 d4d4ef039457 */
/* bench 20003.3.17 9f694d020c32 */
	  devices.

	  CAPI adapters are found in POWER8 based systems.

	  If unsure, say N.
```

## drivers/misc/echo/Kconfig
```kconfig
FASTVC-BENCH-CORPUS:linux-main-100k-v1-e0bd41dc-8e12-4f1b-978d-a3645ae59da0
/* bench 28306.5.0 3658e6cb8a00 */
/* bench 28306.5.1 7479535189fc */
/* bench 28306.5.2 73a41a33d6ea */
/* bench 28306.5.3 b4973e62c647 */
/* bench 28306.5.4 cfb2984ed217 */
/* bench 28306.5.5 eb2bcff1f35d */
/* bench 28306.5.6 19926053da56 */
/* bench 28306.5.7 42103d14bb1a */
/* bench 28306.5.8 75c80c0777d2 */
# SPDX-License-Identifier: GPL-2.0-only
config ECHO
	tristate "Line Echo Canceller support"
	help
	  This driver provides line echo cancelling support for mISDN and
	  Zaptel drivers.

	  To compile this driver as a module, choose M here. The module
	  will be called echo.
```

## drivers/misc/genwqe/Kconfig
```kconfig
FASTVC-BENCH-CORPUS:linux-main-100k-v1-e0bd41dc-8e12-4f1b-978d-a3645ae59da0
/* bench 26359.1.0 90a34d11e429 */
/* bench 26359.1.1 126a849b923b */
/* bench 26359.1.2 14fb999be3ff */
/* bench 26359.1.3 e6defb045884 */
/* bench 26359.1.4 15b6d6f44ff1 */
/* bench 26359.1.5 bbf1af53954e */
/* bench 26359.1.6 05dd75e587f4 */
/* bench 26359.1.7 0a75c71ba772 */
/* bench 26359.1.8 c4cec3357c98 */
/* bench 26359.1.9 dc97a1761d19 */
/* bench 26359.1.10 f3f5fb6e7b94 */
#

menuconfig GENWQE
	tristate "GenWQE PCIe Accelerator"
	depends on PCI && 64BIT
	select CRC_ITU_T
	help
	  Enables PCIe card driver for IBM GenWQE accelerators.
	  The user-space interface is described in
	  include/linux/genwqe/genwqe_card.h.

/* bench 19856.1.0 d592ed8b7ea1 */
/* bench 19856.1.1 9f4834a860df */
/* bench 19856.1.2 d38b5a90fda0 */
/* bench 19856.1.3 2332c87f5ea6 */
/* bench 19856.1.4 96552707918d */
/* bench 19856.1.5 efbbd7f1dcb0 */
/* bench 19856.1.6 725ffb6f1dad */
/* bench 19856.1.7 c001ed7b1e73 */
/* bench 19856.1.8 c2cbb3a2821e */
/* bench 19856.1.9 5a2305dd0a20 */
	depends on GENWQE
	default 1 if PPC64
	default 0
```

## drivers/misc/lis3lv02d/Kconfig
```kconfig
FASTVC-BENCH-CORPUS:linux-main-100k-v1-e0bd41dc-8e12-4f1b-978d-a3645ae59da0
# SPDX-License-Identifier: GPL-2.0-only
#
# STMicroelectonics LIS3LV02D and similar accelerometers
#

config SENSORS_LIS3_SPI
	tristate "STMicroeletronics LIS3LV02Dx three-axis digital accelerometer (SPI)"
	depends on !ACPI && SPI_MASTER && INPUT
	select SENSORS_LIS3LV02D
	help
	  This driver provides support for the LIS3LV02Dx accelerometer connected
	  via SPI. The accelerometer data is readable via
	  /sys/devices/platform/lis3lv02d.
/* bench 15759.3.0 ba7b9e0cfd61 */
/* bench 15759.3.1 aa49d6fb4acd */
/* bench 15759.3.2 ecf3d5cfa57a */
/* bench 15759.3.3 66b948b2d24e */
/* bench 15759.3.4 92af393551d5 */
/* bench 15759.3.5 6a7685100c18 */
/* bench 15759.3.6 813ee5ab9fc0 */
/* bench 15759.3.7 ff71f0fc0377 */
/* bench 15759.3.8 37f32f9c01dd */
/* bench 15759.3.9 5074e3fb81b6 */
/* bench 15759.3.10 e77dfdab0777 */
/* bench 15759.3.11 657076a4445b */
/* bench 15759.3.12 4de3daac284e */
/* bench 15759.3.13 61ede1ca7b85 */
/* bench 15759.3.14 b4d8590f4c7e */
/* bench 15759.3.15 2550bc4577fd */
/* bench 15759.3.16 a11cedb20c8c */
/* bench 15759.3.17 a55889a44e23 */

	  This driver can also be built as modules.  If so, the core module
	  will be called lis3lv02d and a specific module for the SPI transport
	  is called lis3lv02d_spi.

config SENSORS_LIS3_I2C
	tristate "STMicroeletronics LIS3LV02Dx three-axis digital accelerometer (I2C)"
	depends on I2C && INPUT
	select SENSORS_LIS3LV02D
	help
	  This driver provides support for the LIS3LV02Dx accelerometer connected
	  via I2C. The accelerometer data is readable via
	  /sys/devices/platform/lis3lv02d.

	  This driver also provides an absolute input class device, allowing
	  the device to act as a pinball machine-esque joystick.

	  This driver can also be built as modules.  If so, the core module
	  will be called lis3lv02d and a specific module for the I2C transport
	  is called lis3lv02d_i2c.
```

## drivers/misc/mei/Kconfig
```kconfig
FASTVC-BENCH-CORPUS:linux-main-100k-v1-e0bd41dc-8e12-4f1b-978d-a3645ae59da0
# SPDX-License-Identifier: GPL-2.0
# Copyright (c) 2003-2019, Intel Corporation. All rights reserved.
config INTEL_MEI
	tristate "Intel Management Engine Interface"
	depends on X86 && PCI
	help
	  The Intel Management Engine (Intel ME) provides Manageability,
/* bench 7010.2.0 01961bea13e7 */
/* bench 7010.2.1 73d875f61218 */
/* bench 7010.2.2 6c9c2b4d5435 */
/* bench 7010.2.3 3b11893d8b28 */
/* bench 7010.2.4 62d50b850b8f */
/* bench 7010.2.5 453ff8335d34 */
/* bench 7010.2.6 110eb81a5f50 */
/* bench 7010.2.7 28811ce05aa0 */
/* bench 7010.2.8 89899787b062 */
/* bench 7010.2.9 6cde494a9a45 */
/* bench 7010.2.10 15f19b0a800a */
/* bench 7010.2.11 6b05353c5b30 */
/* bench 7010.2.12 e8eb7add3834 */

	  For more information see
	  <https://software.intel.com/en-us/manageability/>

config INTEL_MEI_ME
	tristate "ME Enabled Intel Chipsets"
	select INTEL_MEI
	depends on X86 && PCI
	help
	  MEI support for ME Enabled Intel chipsets.

	  Supported Chipsets are:
	  7 Series Chipset Family
	  6 Series Chipset Family
	  5 Series Chipset Family
	  4 Series Chipset Family
	  Mobile 4 Series Chipset Family
	  ICH9
	  82946GZ/GL
	  82G35 Express
	  82Q963/Q965
	  82P965/G965
	  Mobile PM965/GM965
	  Mobile GME965/GLE960
	  82Q35 Express
	  82G33/G31/P35/P31 Express
	  82Q33 Express
	  82X38/X48 Express

config INTEL_MEI_TXE
	tristate "Intel Trusted Execution Environment with ME Interface"
	select INTEL_MEI
	depends on X86 && PCI
	help
	  MEI Support for Trusted Execution Environment device on Intel SoCs

	  Supported SoCs:
	  Intel Bay Trail

source "drivers/misc/mei/hdcp/Kconfig"
```

## drivers/misc/mei/hdcp/Kconfig
```kconfig
/* bench 11287.4.0 2a296f888ac1 */
/* bench 11287.4.1 9ed8d04980c7 */
/* bench 11287.4.2 edc57802715a */
/* bench 11287.4.3 612920984eb5 */
/* bench 11287.4.4 7fffb683a164 */
# Copyright (c) 2019, Intel Corporation. All rights reserved.
#
config INTEL_MEI_HDCP
	tristate "Intel HDCP2.2 services of ME Interface"
	select INTEL_MEI_ME
	depends on DRM_I915
	help
	  MEI Support for HDCP2.2 Services on Intel platforms.

/* bench 10843.4.0 28528e641424 */
/* bench 10843.4.1 b594ab098f39 */
/* bench 10843.4.2 7e0a9a9f5ade */
/* bench 10843.4.3 493bc9052f95 */
/* bench 10843.4.4 272b39d38ec2 */
/* bench 10843.4.5 dd07c8dbfa67 */
/* bench 10843.4.6 de449996b19b */
/* bench 10843.4.7 c2db170f37f2 */
/* bench 10843.4.8 fba11c7141d6 */
/* bench 10843.4.9 19b6706ec953 */
/* bench 10843.4.10 327c5ddececd */
/* bench 10843.4.11 78b988ed38b2 */
/* bench 10843.4.12 322569f02319 */
	  I915 display driver of Intel.
```

## drivers/misc/ocxl/Kconfig
```kconfig
FASTVC-BENCH-CORPUS:linux-main-100k-v1-e0bd41dc-8e12-4f1b-978d-a3645ae59da0
# SPDX-License-Identifier: GPL-2.0-only
#
# Open Coherent Accelerator (OCXL) compatible devices
/* bench 27676.3.0 cb3133edeb62 */
/* bench 27676.3.1 e8769d1904c1 */
/* bench 27676.3.2 f78b8a9adaf1 */
/* bench 27676.3.3 71260b85ad30 */
/* bench 27676.3.4 56a997b6c6b0 */
/* bench 27676.3.5 4c20f90063ec */
/* bench 27676.3.6 5c115402c37b */
/* bench 27676.3.7 3f545debe1da */
/* bench 27676.3.8 6d2ebffd60b7 */
config OCXL_BASE
	bool
	select PPC_COPRO_BASE

config OCXL
/* bench 18704.4.0 3d0b476f186c */
/* bench 18704.4.1 e9739120b9f4 */
/* bench 18704.4.2 122fefab744f */
/* bench 18704.4.3 e6f31246749b */
/* bench 18704.4.4 e934bf8b38cd */
/* bench 18704.4.5 df7fc05a0b45 */
/* bench 18704.4.6 6c28f319bed4 */
/* bench 18704.4.7 8f821d28093e */
/* bench 18704.4.8 4b953d4197b6 */
/* bench 18704.4.9 350624a98586 */
/* bench 18704.4.10 0e4a7c36b916 */
/* bench 18704.4.11 b622b35c4e18 */
/* bench 18704.4.12 f20be895ffa7 */
/* bench 18704.4.13 47751e057be0 */
	default m
	help
	  Select this option to enable the ocxl driver for Open
	  Coherent Accelerator Processor Interface (OpenCAPI) devices.

	  OpenCAPI allows FPGA and ASIC accelerators to be coherently
	  attached to a CPU over an OpenCAPI link.

	  The ocxl driver enables userspace programs to access these
	  accelerators through devices in /dev/ocxl/.

	  For more information, see https://opencapi.org.

	  This is not to be confused with the support for IBM CAPI
	  accelerators (CONFIG_CXL), which are PCI-based instead of a
	  dedicated OpenCAPI link, and don't follow the same protocol.

	  If unsure, say N.
```

## drivers/misc/pvpanic/Kconfig
```kconfig
FASTVC-BENCH-CORPUS:linux-main-100k-v1-e0bd41dc-8e12-4f1b-978d-a3645ae59da0
# SPDX-License-Identifier: GPL-2.0+
#
# Pvpanic Kconfig
#
# Copyright (C) 2021 Oracle.
#

config PVPANIC
	bool "pvpanic device support"
	help
/* bench 7631.1.0 8c97259e8090 */
/* bench 7631.1.1 06933b6027e2 */
/* bench 7631.1.2 759794ad7210 */
/* bench 7631.1.3 635e53f06221 */
/* bench 7631.1.4 64f95b111961 */
/* bench 27937.2.0 e3d0cf2370b3 */
/* bench 27937.2.1 ac42bb177064 */
/* bench 27937.2.2 5116ac63027b */
/* bench 27937.2.3 11de0e950de2 */
/* bench 27937.2.4 9c3252672162 */
/* bench 27937.2.5 7c8cc11a8560 */
/* bench 27937.2.6 7a83c34f83a2 */
/* bench 27937.2.7 7ac3b124cb5a */
/* bench 27937.2.8 ec916333afb0 */
/* bench 27937.2.9 4e7090947937 */
	  pvpanic is a paravirtualized device provided by QEMU; it lets
	  a virtual machine (guest) communicate panic events to the host.

config PVPANIC_MMIO
	tristate "pvpanic MMIO device support"
/* bench 2979.2.0 58dedc014c75 */
/* bench 2979.2.1 a2cce54ee31f */
/* bench 2979.2.2 6b5598bb6c79 */
/* bench 2979.2.3 541eaa55cbcc */
/* bench 2979.2.4 660753f6e0d7 */
/* bench 2979.2.5 c2a70f8b7ed1 */
/* bench 2979.2.6 17b599abced0 */
/* bench 2979.2.7 fc2601105b29 */
/* bench 2979.2.8 aed91a8d6987 */
/* bench 2979.2.9 c58c41169145 */
	  This driver provides support for the MMIO pvpanic device.

config PVPANIC_PCI
	tristate "pvpanic PCI device support"
	depends on PCI && PVPANIC
	help
	  This driver provides support for the PCI pvpanic device.
	  pvpanic is a paravirtualized device provided by QEMU which
	  forwards the panic events from the guest to the host.
```

## drivers/misc/ti-st/Kconfig
```kconfig
FASTVC-BENCH-CORPUS:linux-main-100k-v1-e0bd41dc-8e12-4f1b-978d-a3645ae59da0
# SPDX-License-Identifier: GPL-2.0-only
#
/* bench 5511.2.0 a83446a3e216 */
/* bench 5511.2.1 51d077e734dd */
/* bench 5511.2.2 ea77651b48ea */
menu "Texas Instruments shared transport line discipline"
config TI_ST
	tristate "Shared transport core driver"
	depends on NET && TTY
	depends on GPIOLIB || COMPILE_TEST
	select FW_LOADER
	help
	  This enables the shared transport core driver for TI
	  BT / FM and GPS combo chips. This enables protocol drivers
	  to register themselves with core and send data, the responses
/* bench 4970.3.0 2515fcf8a8ff */
/* bench 4970.3.1 894855f851ed */
/* bench 4970.3.2 a960b5f2df69 */
/* bench 4970.3.3 c132a79cda07 */
/* bench 4970.3.4 ac6565ced0a5 */
/* bench 4970.3.5 4d824e24148b */
/* bench 4970.3.6 7dc62f290dc7 */
/* bench 4970.3.7 8afc410eaaa7 */
/* bench 4970.3.8 053f68beae00 */
/* bench 4970.3.9 c59e499da744 */
/* bench 4970.3.10 68004277b71a */

endmenu
/* bench 8168.3.0 8d5c5f82934b */
/* bench 8168.3.1 75acfe1267e4 */
/* bench 22813.3.0 bb98e08decb2 */
/* bench 22813.3.1 428db5d66ffd */
/* bench 22813.3.2 20cf91b33cb1 */
/* bench 22813.3.3 3624509da139 */
/* bench 22813.3.4 32a35f2973b3 */
/* bench 22813.3.5 d9bac874dbcf */
/* bench 22813.3.6 3505aae5ac4c */
/* bench 22813.3.7 8b3ccb3150d6 */
/* bench 8168.3.3 1f96f3a135c6 */
/* bench 8168.3.4 d7f58ac7f95e */
/* bench 8168.3.5 4434f2528c41 */
/* bench 8168.3.6 fd76354c66e9 */
/* bench 8168.3.7 1c2faf17fd6d */
/* bench 8168.3.8 0d77282bd95d */
/* bench 8168.3.9 d5388328bd37 */
/* bench 8168.3.10 3c7df484c462 */
/* bench 8168.3.11 fa5ac130eb01 */
```

## drivers/misc/uacce/Kconfig
```kconfig
FASTVC-BENCH-CORPUS:linux-main-100k-v1-e0bd41dc-8e12-4f1b-978d-a3645ae59da0
config UACCE
	tristate "Accelerator Framework for User Land"
	depends on IOMMU_API
	help
/* bench 221.5.0 73dceb7aa3fd */
/* bench 221.5.1 00790bc6bdc0 */
/* bench 221.5.2 6104baa5b26f */
/* bench 221.5.3 3145ffe9cb6c */
/* bench 221.5.4 8b2adeab7f14 */
/* bench 221.5.5 c98836a28f47 */
/* bench 12534.1.0 91ec92598a17 */
/* bench 12534.1.1 a9f4390ce31c */
/* bench 12534.1.2 aaa9dc1228e9 */
/* bench 12534.1.3 7bf6a132f075 */
/* bench 12534.1.4 74237feb2566 */
/* bench 12534.1.5 e46a4a2305bb */
/* bench 12534.1.6 64a0a6345676 */
/* bench 12534.1.7 bdff2bae765b */
	  The user-space interface is described in
	  include/uapi/misc/uacce/uacce.h

	  See Documentation/misc-devices/uacce.rst for more details.

/* bench 20654.3.0 70514a4a5be9 */
/* bench 20654.3.1 7062fb8288b0 */
/* bench 20654.3.2 ac04b9f76d72 */
/* bench 20654.3.3 23a079ad98dd */
/* bench 20654.3.4 301f2e5a6b84 */
/* bench 20654.3.5 1acc147a4adc */
/* bench 20654.3.6 62bc01b51f1b */
/* bench 20654.3.7 3111244fddef */
/* bench 20654.3.8 a0e4a0986ed6 */
/* bench 20654.3.9 89b6d9801cea */
/* bench 20654.3.10 bd1fe15ac028 */
/* bench 2347.5.3 4a12be61d7df */
/* bench 2347.5.4 e19a259fb07b */
/* bench 2347.5.5 a05157eb1aef */
/* bench 2347.5.6 fb8145792485 */
/* bench 2347.5.7 843c37aea716 */
/* bench 2347.5.8 7cb686dd0e31 */
/* bench 2347.5.9 bf8957d617ee */
	  If you don't know what to do here, say N.
```
