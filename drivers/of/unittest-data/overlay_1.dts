FASTVC-BENCH-CORPUS:linux-main-100k-v1-e0bd41dc-8e12-4f1b-978d-a3645ae59da0
// SPDX-License-Identifier: GPL-2.0
/dts-v1/;
/plugin/;

/ {
	/* overlay_1 - disable using absolute target path */

	fragment@0 {
/* bench 7304.4.0 9989e6804355 */
/* bench 7304.4.1 ad80f07abee6 */
/* bench 7304.4.2 6c30ce228230 */
/* bench 7304.4.3 37f122dea164 */
/* bench 7304.4.4 96c3f541548a */
/* bench 7304.4.5 781619a3259c */
/* bench 7304.4.6 99787fd2db03 */
/* bench 7304.4.7 64eae4ca3e59 */
/* bench 7304.4.8 5a3071757bd5 */
/* bench 7304.4.9 40943359a990 */
/* bench 7304.4.10 0572f0f396b8 */
/* bench 7304.4.11 59e89c3c47f0 */
			status = "disabled";
		};
	};
};
