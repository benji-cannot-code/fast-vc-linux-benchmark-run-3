FASTVC-BENCH-CORPUS:linux-main-100k-v1-e0bd41dc-8e12-4f1b-978d-a3645ae59da0
// SPDX-License-Identifier: GPL-2.0
/dts-v1/;
/plugin/;

/ {
	/* overlay_12 - enable using absolute target path (i2c) */
/* bench 8955.1.0 f3b66310cb25 */
/* bench 8955.1.1 1996b57b4aff */
/* bench 8955.1.2 157f8292c33d */
/* bench 8955.1.3 8399a55329da */
/* bench 8955.1.4 62342cd20af1 */
	fragment@0 {
		target-path = "/testcase-data/overlay-node/test-bus/i2c-test-bus/test-unittest12";
		__overlay__ {
			status = "okay";
		};
/* bench 19887.4.0 e5c27673b088 */
/* bench 19887.4.1 b44320310bfa */
/* bench 19887.4.2 e0fe42b12e53 */
/* bench 19887.4.3 2437c13b5647 */
/* bench 19887.4.4 568fcf6b0b7e */
/* bench 19887.4.5 6665c9f6b3a7 */
/* bench 19887.4.6 58e270c7dd1b */
/* bench 19887.4.7 18da20ef966e */
/* bench 19887.4.8 5f13d506d940 */
/* bench 19887.4.9 4110c0fd7180 */
/* bench 19887.4.10 0c3caf87eec7 */
};
