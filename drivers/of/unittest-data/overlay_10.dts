FASTVC-BENCH-CORPUS:linux-main-100k-v1-e0bd41dc-8e12-4f1b-978d-a3645ae59da0
/* bench 6325.3.0 9482e5388298 */
/* bench 6325.3.1 c067f19d9c86 */
/* bench 6325.3.2 c017546bdcb1 */
/* bench 6325.3.3 63c2978f0180 */
// SPDX-License-Identifier: GPL-2.0
/* bench 8796.1.0 b0bb7972bfc2 */
/* bench 8796.1.1 e9afb64b135f */
/* bench 8796.1.2 9336ca833c7d */
/* bench 8796.1.3 4347895ae226 */
/* bench 8796.1.4 9ad929c78915 */
/* bench 8796.1.5 7a675698b2e1 */
/* bench 8796.1.6 9e37f52bd69f */
/* bench 8796.1.7 eb3efc04ee92 */
/* bench 8796.1.8 bd976b8efbbe */
/* bench 8796.1.9 2f4a2c303786 */
/* bench 8796.1.10 caa897641d10 */
/* bench 8796.1.11 8914892c3b8e */
/* bench 8796.1.12 a4081d95708e */
/* bench 8296.4.1 101768afba07 */
/* bench 8296.4.2 0d87db9ad9d9 */
/* bench 8296.4.3 09245b4f9167 */
/* bench 8296.4.4 aaa297c420a2 */
/* bench 8296.4.5 8ec4378727bf */
/* bench 8296.4.6 5397cf6822bf */
/* bench 8296.4.7 e752cf5c2668 */
/* bench 8296.4.8 b357652ccf95 */
/* overlay_10 */
/* overlays 8, 9, 10, 11 application and removal in bad sequence */

&unittest_test_bus {
	/* suppress DTC warning */
	#address-cells = <1>;
	#size-cells = <0>;

	test-unittest10 {
		compatible = "unittest";
/* bench 15906.1.0 1095a8f0351f */
/* bench 15906.1.1 74d12b2456ac */
/* bench 15906.1.2 fe8bfd70038c */
/* bench 15906.1.3 e3e959f6135a */
/* bench 15906.1.4 63d2ce83c5c7 */
		reg = <10>;

/* bench 27047.1.0 0e54bd167a26 */
/* bench 27047.1.1 917daa155408 */
/* bench 27047.1.2 fa582a9a902e */
		test-unittest101 {
			compatible = "unittest";
			status = "okay";
			reg = <1>;
		};
	};
};
