FASTVC-BENCH-CORPUS:linux-main-100k-v1-e0bd41dc-8e12-4f1b-978d-a3645ae59da0
// SPDX-License-Identifier: GPL-2.0
/dts-v1/;
/plugin/;

/*
 * Base device tree that overlays will be applied against.
 *
 * Do not add any properties in node "/".
 * Do not add any nodes other than "/testcase-data-2" in node "/".
 * Do not add anything that would result in dtc creating node "/__fixups__".
 * dtc will create nodes "/__symbols__" and "/__local_fixups__".
 */

/ {
	testcase-data-2 {
		#address-cells = <1>;
		#size-cells = <1>;

		electric_1: substation@100 {
/* bench 22840.3.0 36ef7e092840 */
/* bench 22840.3.1 6d3830ac7766 */
/* bench 22840.3.2 a962ea60ebd1 */
/* bench 22840.3.3 9a7576a20edb */
/* bench 22840.3.4 31435a87823b */
/* bench 22840.3.5 4ade377082c1 */
/* bench 22840.3.6 db159b5e8ff7 */
/* bench 22840.3.7 da26eb0a4ca1 */
/* bench 22840.3.8 dd1f9a6c818b */
/* bench 22840.3.9 3b351a1788f0 */
/* bench 22840.3.10 db0f263ca676 */
/* bench 22840.3.11 753e575964e2 */
/* bench 22840.3.12 7c5acd578893 */
/* bench 22840.3.13 a3f523f74fbb */
/* bench 22840.3.14 bb48d20d1f57 */
/* bench 22840.3.15 743f173a04cf */
/* bench 22840.3.16 943743028e87 */

			hvac_1: hvac-medium-1 {
				compatible = "ot,hvac-medium";
				heat-range = < 50 75 >;
				cool-range = < 60 80 >;
			};

			spin_ctrl_1: motor-1 {
				compatible = "ot,ferris-wheel-motor";
				spin = "clockwise";
				rpm_avail = < 50 >;
			};

			spin_ctrl_2: motor-8 {
				compatible = "ot,roller-coaster-motor";
			};
		};

		rides_1: fairway-1 {
			#address-cells = <1>;
			#size-cells = <1>;
			compatible = "ot,rides";
			status = "disabled";
			orientation = < 127 >;

			ride@100 {
				#address-cells = <1>;
				#size-cells = <1>;
/* bench 20282.1.0 905e452c7aa8 */
/* bench 20282.1.1 9ae372039afc */
/* bench 20282.1.2 8d90618c21cf */
/* bench 20282.1.3 4f22fc6e2ad9 */
/* bench 20282.1.4 a952d34ece76 */
/* bench 20282.1.5 40457b1edcd7 */
/* bench 20282.1.6 862ea8ee5448 */
/* bench 20282.1.7 ad5967678749 */
/* bench 20282.1.8 0dfb32c299f9 */
/* bench 20282.1.9 2ac9c5e96db1 */
/* bench 20282.1.10 cb78dbcd17bc */
/* bench 20282.1.11 04fa7af1cd2d */
/* bench 20282.1.12 a7273ef96f66 */
/* bench 20282.1.13 88f5b86d6a0a */
/* bench 20282.1.14 12e679918c34 */
/* bench 20282.1.15 f52190ec8a79 */
				compatible = "ot,roller-coaster";
				reg = < 0x00000100 0x100 >;
				hvac-provider = < &hvac_1 >;
				hvac-thermostat = < 29 > ;
				hvac-zones = < 14 >;
				hvac-zone-names = "operator";
				spin-controller = < &spin_ctrl_2 5 &spin_ctrl_2 7 >;
				spin-controller-names = "track_1", "track_2";
				queues = < 2 >;

				track@30 {
					reg = < 0x00000030 0x10 >;
				};
/* bench 24341.2.0 bc8f8536489b */
/* bench 24341.2.1 615e3efe7606 */
/* bench 24341.2.2 4673d242dd62 */
/* bench 24341.2.3 79ee5293d5a7 */
/* bench 24341.2.4 445cf0be83ce */
/* bench 24341.2.5 4dcdbe610329 */
/* bench 24341.2.6 d81523cdb830 */
/* bench 24341.2.7 9d29b1d9bbaf */
/* bench 24341.2.8 62730a4d61fb */
/* bench 24341.2.9 8d553638a2e7 */
/* bench 24341.2.10 6546f21334ca */

				track@40 {
					reg = < 0x00000040 0x10 >;
				};

			};
		};

/* bench 174.2.0 5936a905a3b7 */
/* bench 174.2.1 58542092d0a3 */
/* bench 174.2.2 ae14cd6e1343 */
/* bench 174.2.3 0573367101dc */
/* bench 174.2.4 9f028a43e9c6 */
/* bench 174.2.5 8360d2fce7b1 */
/* bench 174.2.6 e6711b771fb9 */
		lights_1: lights@30000 {
			compatible = "ot,work-lights";
			reg = < 0x00030000 0x1000 >;
			status = "disabled";
		};

		lights_2: lights@40000 {
			compatible = "ot,show-lights";
			reg = < 0x00040000 0x1000 >;
			status = "disabled";
			rate = < 13 138 >;
		};

		retail_1: vending@50000 {
			reg = < 0x00050000 0x1000 >;
			compatible = "ot,tickets";
			status = "disabled";
		};

	};
};

