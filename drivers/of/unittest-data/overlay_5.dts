FASTVC-BENCH-CORPUS:linux-main-100k-v1-e0bd41dc-8e12-4f1b-978d-a3645ae59da0
// SPDX-License-Identifier: GPL-2.0
/dts-v1/;
/plugin/;

/ {
	/* overlay_5 - test overlay apply revert */

	fragment@0 {
		target-path = "/testcase-data/overlay-node/test-bus/test-unittest5";
		__overlay__ {
			status = "okay";
		};
	};
};
