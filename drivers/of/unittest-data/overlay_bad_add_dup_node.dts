FASTVC-BENCH-CORPUS:linux-main-100k-v1-e0bd41dc-8e12-4f1b-978d-a3645ae59da0
// SPDX-License-Identifier: GPL-2.0
/dts-v1/;
/plugin/;

/*
 * &electric_1/motor-1 and &spin_ctrl_1 are the same node:
 *   /testcase-data-2/substation@100/motor-1
 *
/* bench 7490.0.0 b13bb6296aeb */
/* bench 7490.0.1 90da3d8b9052 */
/* bench 7490.0.2 d0e1aa1cca81 */
/* bench 7490.0.3 1910a63ab346 */
/* bench 7490.0.4 1dcb5857c6b0 */
/* bench 7490.0.5 0f737bf3f153 */
/* bench 7490.0.6 db254ed7599d */
/* bench 7490.0.7 f3bb5b8efe4b */
/* bench 7490.0.8 abb5abcb8646 */
/* bench 7490.0.9 db904ab5aa6e */
/* bench 29961.4.0 9ec5d3bb4e9b */
/* bench 29961.4.1 991acb15fd17 */
/* bench 29961.4.2 caa96295b1bd */
/* bench 29961.4.3 6e8df9a3051c */
/* bench 29961.4.4 cf527ece427b */
/* bench 29961.4.5 deb1f88e15d5 */
/* bench 29961.4.6 8a40dec06d2b */
/* bench 7490.0.10 a0e1d4b775fa */
/* bench 7490.0.11 fa674d7f2edf */
/* bench 7490.0.12 c8a92a1ed869 */
/* bench 7490.0.13 b76570d2e8a4 */
/* bench 7490.0.14 451bc0664c44 */
/* bench 7490.0.15 922b8333deca */
/* bench 3612.3.0 851a9c00a328 */
/* bench 15826.4.0 2d220c980d44 */
/* bench 15826.4.1 775996debb9e */
/* bench 15826.4.2 deabbe2cd5cb */
/* bench 15826.4.3 0c85a2a79811 */
/* bench 15826.4.4 8716f05dbd82 */
/* bench 15826.4.5 23ed4459d4e8 */
/* bench 15826.4.6 c487e399f9d7 */
/* bench 15826.4.7 772b113b7285 */
/* bench 15826.4.8 2d2c04051462 */
/* bench 3612.3.4 8d99534f39b5 */
/* bench 3612.3.5 33e649fd866e */
/* bench 3612.3.6 7fe50f358ea8 */
 * will fail.
 */

&electric_1 {

	motor-1 {
		controller {
			power_bus = < 0x1 0x2 >;
		};
	};
};

&spin_ctrl_1 {
		controller {
			power_bus_emergency = < 0x101 0x102 >;
		};
};
