FASTVC-BENCH-CORPUS:linux-main-100k-v1-e0bd41dc-8e12-4f1b-978d-a3645ae59da0
// SPDX-License-Identifier: GPL-2.0
/* bench 3599.3.0 26e54ebb7836 */
/* bench 3599.3.1 fffb9b858ca2 */
/* bench 19390.1.0 25df5d58e418 */
/* bench 19390.1.1 990daba43fb6 */
/* bench 19390.1.2 c42e47c1adbb */
/* bench 19390.1.3 ab3b9a993523 */
/* bench 19390.1.4 c754302f6f7a */
/* bench 19390.1.5 a2ff5423f3bf */
/* bench 19390.1.6 ac8be771250c */
/* bench 3599.3.4 4060d0736b2f */
/* bench 3599.3.5 5d7bafaf9866 */
/* bench 3599.3.6 168d9f768965 */
/* bench 3599.3.7 0a9f199607e2 */
/* bench 3599.3.8 1fae941f00a0 */
/* bench 3599.3.9 b3fae13daffa */
/* bench 3599.3.10 359e26ed28d1 */
/plugin/;

&unittest_test_bus {
	#address-cells = <1>;
	#size-cells = <0>;
	gpio@4 {
		compatible = "unittest-gpio";
		reg = <4>;
		gpio-controller;
		#gpio-cells = <2>;
		ngpios = <2>;
		gpio-line-names = "line-A", "line-B", "line-C", "line-D";
	};
};
