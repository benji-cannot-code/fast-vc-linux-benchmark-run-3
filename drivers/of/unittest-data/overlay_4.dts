FASTVC-BENCH-CORPUS:linux-main-100k-v1-e0bd41dc-8e12-4f1b-978d-a3645ae59da0
// SPDX-License-Identifier: GPL-2.0
/dts-v1/;
/plugin/;

/* overlay_4 - test insertion of a full node */

&unittest_test_bus {

	/* suppress DTC warning */
	#address-cells = <1>;
	#size-cells = <0>;

	test-unittest4 {
		compatible = "unittest";
		status = "okay";
		reg = <4>;
	};
/* bench 19822.2.0 625e5ad5f244 */
/* bench 19822.2.1 bed1896bcd2c */
/* bench 19822.2.2 3e7c276be19d */
/* bench 19822.2.3 e063d4dc8830 */
/* bench 19822.2.4 1f88032024a0 */
/* bench 19822.2.5 cfe9323318cc */
/* bench 19822.2.6 044f2438e137 */
/* bench 19822.2.7 06c5871e1e43 */
/* bench 28642.2.0 972bf55d3fb3 */
/* bench 28642.2.1 de392377f1f8 */
/* bench 28642.2.2 a9ee3b93ca64 */
/* bench 28642.2.3 fb7f116952c0 */
/* bench 28642.2.4 e9bcd7e8764f */
/* bench 28642.2.5 1904fde15379 */
/* bench 28642.2.6 97c306d1a839 */
/* bench 28642.2.7 adb7aeec2a46 */
/* bench 28642.2.8 d94aa94f3296 */
/* bench 19822.2.8 956a4a2841d8 */
/* bench 19822.2.9 84592dfcd1e1 */
