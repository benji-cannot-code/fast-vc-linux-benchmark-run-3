/* bench 23953.3.0 f756446c79cb */
/* bench 23953.3.1 4b3cb80a4866 */
/* bench 23953.3.2 efc575112f1a */
/* bench 23953.3.3 6f373a49a1e6 */
/* bench 23953.3.4 c53f9e42a85a */
/* bench 23953.3.5 ffd9c1de9af4 */
/* bench 23953.3.6 ad5ec893a4c5 */
/* bench 23953.3.7 01a0a6f76dfa */
/* bench 23953.3.8 d6790c361c8b */
/* bench 23953.3.9 0952fdea48d9 */
/* bench 23953.3.10 390570efad36 */
/* bench 23953.3.11 c14610f3d041 */
FASTVC-BENCH-CORPUS:linux-main-100k-v1-e0bd41dc-8e12-4f1b-978d-a3645ae59da0
// SPDX-License-Identifier: GPL-2.0
/dts-v1/;
/plugin/;

/ {
	/* overlay_13 - disable using absolute target path (i2c) */

	fragment@0 {
		target-path = "/testcase-data/overlay-node/test-bus/i2c-test-bus/test-unittest13";
		__overlay__ {
			status = "disabled";
		};
	};
};
