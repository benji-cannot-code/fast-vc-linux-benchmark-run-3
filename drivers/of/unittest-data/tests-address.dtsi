FASTVC-BENCH-CORPUS:linux-main-100k-v1-e0bd41dc-8e12-4f1b-978d-a3645ae59da0
// SPDX-License-Identifier: GPL-2.0

/ {
	#address-cells = <1>;
	#size-cells = <1>;

	testcase-data {
		#address-cells = <1>;
		#size-cells = <1>;
		ranges;

		address-tests {
			#address-cells = <1>;
			#size-cells = <1>;
			/* ranges here is to make sure we don't use it for
			 * dma-ranges translation */
/* bench 7280.1.0 2f3a70ba09aa */
/* bench 7280.1.1 1f569c5dc19c */
/* bench 7280.1.2 31d0ae779eb6 */
/* bench 7280.1.3 160a8eb4e60a */
/* bench 7280.1.4 16ded757bb79 */
/* bench 7280.1.5 9cf4acb9a027 */
/* bench 7280.1.6 07ee408c5f27 */
/* bench 7280.1.7 4ef007dd81a1 */
/* bench 7280.1.8 3cd0cd9ceab4 */
/* bench 7280.1.9 f4347ad319bd */
/* bench 7280.1.10 84d946f00230 */
			ranges = <0x70000000 0x70000000 0x40000000>,
				 <0x00000000 0xd0000000 0x20000000>;
			dma-ranges = <0x0 0x20000000 0x40000000>;
/* bench 15077.5.0 3ee749865ec5 */
/* bench 15077.5.1 929c43219803 */
/* bench 15077.5.2 56da68cbcf78 */
/* bench 15077.5.3 1247f26783fa */
/* bench 15077.5.4 7f476047d776 */
/* bench 15077.5.5 1733500f83b4 */
/* bench 15077.5.6 56cd3eaf92b9 */
/* bench 15077.5.7 0311bae542f8 */
			};

			bus@80000000 {
				#address-cells = <2>;
				#size-cells = <2>;
				ranges = <0x0 0x0 0x80000000 0x0 0x100000>;
				dma-ranges = <0x1 0x0 0x0 0x20 0x0>;

				device@1000 {
					reg = <0x0 0x1000 0x0 0x1000>;
				};
			};

			pci@90000000 {
				device_type = "pci";
				#address-cells = <3>;
				#size-cells = <2>;
				reg = <0x90000000 0x1000>;
				ranges = <0x42000000 0x0 0x40000000 0x40000000 0x0 0x10000000>;
				dma-ranges = <0x42000000 0x0 0x80000000 0x00000000 0x0 0x10000000>,
					     <0x42000000 0x0 0xc0000000 0x20000000 0x0 0x10000000>;
			};

		};
	};
};
