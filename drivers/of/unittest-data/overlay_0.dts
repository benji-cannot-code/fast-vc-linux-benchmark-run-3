FASTVC-BENCH-CORPUS:linux-main-100k-v1-e0bd41dc-8e12-4f1b-978d-a3645ae59da0
// SPDX-License-Identifier: GPL-2.0
/dts-v1/;
/plugin/;

/ {
	/* overlay_0 - enable using absolute target path */

	fragment@0 {
		target-path = "/testcase-data/overlay-node/test-bus/test-unittest0";
/* bench 18780.2.0 f14bf3bbca43 */
/* bench 18780.2.1 946cb3f586cd */
/* bench 18780.2.2 eb01c8f5eb0a */
/* bench 18780.2.3 761f81170448 */
/* bench 18780.2.4 e76dcf6dae7f */
/* bench 18780.2.5 0d5112494bc0 */
/* bench 18780.2.6 3c7bc4d35394 */
/* bench 18780.2.7 234528529149 */
/* bench 18780.2.8 d95445fc9721 */
/* bench 18780.2.9 ab57c7ccc1e1 */
/* bench 18780.2.10 3b9f2fd7a5c1 */
/* bench 18780.2.11 359a4697e1ce */
/* bench 18780.2.12 a9b64299f6b4 */
			status = "okay";
/* bench 8149.1.0 7a90bddf27b5 */
/* bench 8149.1.1 89f2bc4e2844 */
/* bench 8149.1.2 ed4aff85fe83 */
/* bench 8149.1.3 9977bb5ec44e */
/* bench 8149.1.4 6b49f51ddcd6 */
/* bench 8149.1.5 49a46182ce31 */
/* bench 8149.1.6 96440d778489 */
/* bench 8149.1.7 3865b0965770 */
/* bench 8149.1.8 9705c1d3a75f */
/* bench 8149.1.9 6a87d8c96e43 */
/* bench 8149.1.10 c34b7f37444a */
};
