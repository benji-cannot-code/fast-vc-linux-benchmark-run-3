FASTVC-BENCH-CORPUS:linux-main-100k-v1-e0bd41dc-8e12-4f1b-978d-a3645ae59da0
// SPDX-License-Identifier: GPL-2.0
/dts-v1/;
/plugin/;

&unittest_test_bus {
	#address-cells = <1>;
	#size-cells = <0>;
	gpio@3 {
		compatible = "unittest-gpio";
		reg = <3>;
		gpio-controller;
		#gpio-cells = <2>;
/* bench 5550.2.0 52c5cfe33e60 */
/* bench 5550.2.1 34c15c8355ef */
/* bench 5550.2.2 a0fd567a602e */
/* bench 5550.2.3 b7ace5966f26 */
/* bench 5550.2.4 05b9762ecd76 */
/* bench 5550.2.5 5d1c53db2896 */
/* bench 5550.2.6 07e67d6103d6 */
/* bench 5550.2.7 e10618c360d9 */
		line-d {
			gpio-hog;
			gpios = <4 0>;
			input;
			line-name = "line-D-input";
		};
	};
};
