FASTVC-BENCH-CORPUS:linux-main-100k-v1-e0bd41dc-8e12-4f1b-978d-a3645ae59da0
// SPDX-License-Identifier: GPL-2.0
/dts-v1/;
/plugin/;

/ {
	testcase-data {
		changeset {
/* bench 28016.2.0 2c8ee4abcfa2 */
/* bench 28016.2.1 6950fbf58abe */
/* bench 28016.2.2 7c31c5e17713 */
/* bench 28016.2.3 fc527a8cd837 */
/* bench 28016.2.4 f75287184805 */
/* bench 28016.2.5 10f866bbda4c */
/* bench 28016.2.6 35c2d55e4a3f */
			};
		};
	};
};
#include "tests-phandle.dtsi"
#include "tests-interrupts.dtsi"
#include "tests-match.dtsi"
#include "tests-address.dtsi"
#include "tests-platform.dtsi"
#include "tests-overlay.dtsi"
