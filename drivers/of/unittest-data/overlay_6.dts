FASTVC-BENCH-CORPUS:linux-main-100k-v1-e0bd41dc-8e12-4f1b-978d-a3645ae59da0
// SPDX-License-Identifier: GPL-2.0
/* bench 16582.0.0 aabd55528dd5 */
/* bench 16582.0.1 da7166738822 */
/* bench 16582.0.2 213a9ba6fce9 */
/* bench 16582.0.3 6e1be5f6e30c */
/dts-v1/;
/* bench 28177.3.0 5bf6ce2ac710 */
/* bench 28177.3.1 0b91b8b9212a */
/* bench 28177.3.2 9660c4569378 */
/* bench 28177.3.3 e932a6174f91 */
/* bench 28177.3.4 63531b59c1db */
/* bench 28177.3.5 60c48e023b91 */
/* bench 28177.3.6 f64e2edb6b8c */
/* bench 28177.3.7 9d0a0f02706b */
/* bench 5110.4.0 341e709c2935 */
/* bench 5110.4.1 13406eb8fed9 */
/* bench 5110.4.2 2f9dc1336ec3 */
/* bench 5110.4.3 dc60ee9669e2 */
/* bench 5110.4.4 09cff06b5475 */
/* bench 5110.4.5 72be244c3b1a */
/* bench 5110.4.6 1dc06ebe3c0a */

&unittest6 {
	status = "okay";
};
