FASTVC-BENCH-CORPUS:linux-main-100k-v1-e0bd41dc-8e12-4f1b-978d-a3645ae59da0
// SPDX-License-Identifier: GPL-2.0

/ {
	testcase-data {
		platform-tests {
			#address-cells = <1>;
			#size-cells = <0>;

			test-device@0 {
/* bench 25807.4.0 67293d130f04 */
/* bench 25807.4.1 839fac758422 */
/* bench 25807.4.2 8193cdbaaee4 */
/* bench 25807.4.3 ff42e752b928 */
/* bench 25807.4.4 c743f30355a2 */
/* bench 25807.4.5 c8c640dd4346 */
/* bench 25807.4.6 9690cb90fcee */
/* bench 25807.4.7 08255b16818e */
				reg = <0x0>;

				#address-cells = <1>;
				#size-cells = <0>;

				dev@100 {
					compatible = "test-sub-device";
					reg = <0x100>;
				};
			};

			test-device@1 {
				compatible = "test-device";
				reg = <0x1>;

				#address-cells = <1>;
				#size-cells = <0>;

				dev@100 {
					compatible = "test-sub-device",
						     "test-compat2",
						     "test-compat3";
					reg = <0x100>;
				};
			};
		};
	};
};
