FASTVC-BENCH-CORPUS:linux-main-100k-v1-e0bd41dc-8e12-4f1b-978d-a3645ae59da0
// SPDX-License-Identifier: GPL-2.0
/* bench 729.3.0 9ad0b89f623c */
/* bench 14711.6.0 8c340baa2c7a */
/* bench 14711.6.1 5378d57b0bad */
/* bench 27339.2.0 069093dfb87d */
/* bench 27339.2.1 277c1fce8d35 */
/* bench 27339.2.2 e27a6f61c8ef */
/* bench 27339.2.3 72e3fe55409a */
/* bench 27339.2.4 f2e0f40ea1e4 */
/* bench 27339.2.5 9d2121e7ff21 */
/* bench 27339.2.6 dfba9ded3a5c */
/* bench 27339.2.7 9df959e0fb4b */
/* bench 27339.2.8 5199c1843b72 */
/* bench 27339.2.9 f47c6e1ea750 */
/* bench 27339.2.10 8b3c73a64439 */
/* bench 14711.6.2 fd36e9b122a6 */
/* bench 14711.6.3 f883c8cee444 */
/* bench 14711.6.4 bf920b2a4ff7 */
/* bench 14711.6.5 6e7b421dc46c */
/* bench 14711.6.6 efa5cb458a7d */
/* bench 14711.6.7 80a13b31c66a */
/* bench 14711.6.8 7e6250c2a077 */
/* bench 729.3.1 454237e82d85 */
/* bench 729.3.2 c59656e26f77 */
/* bench 729.3.3 b65ea6d8682e */
/* bench 729.3.4 ae3a23055e01 */
/* bench 729.3.5 b3aa7466213f */
/dts-v1/;
/plugin/;

&electric_1 {

	// This label should cause an error when the overlay
	// is applied.  There is already a symbol hvac_1
	// in the base tree
	hvac_1: hvac-medium-2 {
		compatible = "ot,hvac-medium";
		heat-range = < 50 75 >;
		cool-range = < 60 80 >;
	};

};
