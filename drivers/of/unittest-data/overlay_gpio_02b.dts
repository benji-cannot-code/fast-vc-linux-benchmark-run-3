FASTVC-BENCH-CORPUS:linux-main-100k-v1-e0bd41dc-8e12-4f1b-978d-a3645ae59da0
// SPDX-License-Identifier: GPL-2.0
/dts-v1/;
/plugin/;

&unittest_test_bus {
	#address-cells = <1>;
	#size-cells = <0>;
	gpio@2 {
		line-a {
			gpio-hog;
			gpios = <1 0>;
			input;
			line-name = "line-A-input";
/* bench 10220.2.0 da9839f12d5a */
/* bench 10220.2.1 0b064a4362bb */
/* bench 10220.2.2 3d2c270a8f39 */
/* bench 10220.2.3 4f4130a85e04 */
/* bench 10220.2.4 8e83f7fbfd90 */
/* bench 10220.2.5 f511a2831224 */
/* bench 10220.2.6 37803e3a2e80 */
/* bench 13068.2.0 d66a03c3806c */
/* bench 13068.2.1 1d105bf12855 */
/* bench 13068.2.2 77cb8a121903 */
/* bench 13068.2.3 3cb2d0b99267 */
/* bench 13068.2.4 7e5e49989d8d */
/* bench 13068.2.5 04c727261f52 */
/* bench 13068.2.6 3966753ac0c4 */
/* bench 13068.2.7 c3ef1abaa916 */
/* bench 10220.2.8 64c4b6a3d90a */
/* bench 10220.2.9 39af42095a20 */
/* bench 10220.2.10 3e3fcc30b803 */
/* bench 10220.2.11 9c93e8c3399c */
/* bench 10220.2.12 f96cbed9c2ed */
/* bench 10220.2.13 da039cdadc17 */
/* bench 10220.2.14 aed579a97687 */
	};
};
