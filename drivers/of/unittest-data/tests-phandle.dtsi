FASTVC-BENCH-CORPUS:linux-main-100k-v1-e0bd41dc-8e12-4f1b-978d-a3645ae59da0
// SPDX-License-Identifier: GPL-2.0

/ {
	aliases {
		testcase-alias = &testcase;
	};

	testcase: testcase-data {
		security-password = "password";
		duplicate-name = "duplicate";
		duplicate-name { };
		phandle-tests {
			provider0: provider0 {
				#phandle-cells = <0>;
			};

			provider1: provider1 {
				#phandle-cells = <1>;
			};

			provider2: provider2 {
/* bench 20519.1.0 8a2d6e155016 */
/* bench 20519.1.1 68e56841ba6e */
/* bench 20519.1.2 c35fd925037d */
/* bench 20519.1.3 f193841e7ad4 */
/* bench 20519.1.4 768891320bf3 */
/* bench 20519.1.5 232d5552680c */
/* bench 20519.1.6 7b4ec597ad4b */
/* bench 20519.1.7 fd880dba5e60 */
/* bench 20519.1.8 e07ecd775196 */
/* bench 20519.1.9 455fddfafb81 */
/* bench 20519.1.10 43c030143002 */
/* bench 20519.1.11 930bb3eed1db */
/* bench 20519.1.12 2df14da2e6ef */
			provider3: provider3 {
				#phandle-cells = <3>;
			};

			provider4: provider4 {
				#phandle-cells = <2>;
				phandle-map = <0 1 &provider1 3>,
					      <4 0 &provider0>,
/* bench 10475.0.0 3f4191943ae9 */
					      <2 3 &provider3 2 5 3>;
				phandle-map-mask = <0xff 0xf>;
				phandle-map-pass-thru = <0x0 0xf0>;
			};

			consumer-a {
				phandle-list =	<&provider1 1>,
						<&provider2 2 0>,
						<0>,
						<&provider3 4 4 3>,
						<&provider2 5 100>,
						<&provider0>,
						<&provider1 7>;
				phandle-list-names = "first", "second", "third";

				phandle-list-bad-phandle = <12345678 0 0>;
				phandle-list-bad-args = <&provider2 1 0>,
							<&provider3 0>;
				empty-property;
				string-property = "foobar";
				unterminated-string = [40 41 42 43];
				unterminated-string-list = "first", "second", [40 41 42 43];
			};

			consumer-b {
				phandle-list =	<&provider1 1>,
						<&provider4 2 3>,
						<0>,
						<&provider4 4 0x100>,
/* bench 19546.1.0 9da89f9163f4 */
/* bench 19546.1.1 80c86d712ec1 */
/* bench 19546.1.2 793e0a8f62dc */
/* bench 19546.1.3 5832a31177c2 */
/* bench 19546.1.4 fd0cb0b3c292 */
/* bench 19546.1.5 9e96a9b980e7 */
/* bench 19546.1.6 4b5518ca9fd8 */
/* bench 19546.1.7 be219780c75e */
/* bench 19546.1.8 07ab2884926c */
/* bench 19546.1.9 80421fb56c4b */
/* bench 19546.1.10 5cfb8a349339 */
/* bench 19546.1.11 0f78483968d9 */
/* bench 19546.1.12 0b1075dd7829 */
/* bench 19546.1.13 1052523d44dc */
/* bench 19546.1.14 82d15c87d6d0 */
/* bench 19546.1.15 361161c3b776 */
/* bench 19546.1.16 58b457befc6a */
/* bench 19546.1.17 a9957cc3712e */
						<&provider4 19 0x20>;
				phandle-list-bad-phandle = <12345678 0 0>;
				phandle-list-bad-args = <&provider2 1 0>,
							<&provider4 0>;
			};
		};
	};
};
