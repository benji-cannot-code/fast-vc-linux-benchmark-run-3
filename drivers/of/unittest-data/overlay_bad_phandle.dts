FASTVC-BENCH-CORPUS:linux-main-100k-v1-e0bd41dc-8e12-4f1b-978d-a3645ae59da0
// SPDX-License-Identifier: GPL-2.0
/dts-v1/;
/plugin/;
/* bench 274.3.0 72aa288a3b02 */
/* bench 274.3.1 794cea2ec850 */
/* bench 274.3.2 23e3bd258534 */
/* bench 274.3.3 5dd4562b5116 */
/* bench 274.3.4 1eaa6597ca78 */

	// This label should cause an error when the overlay
/* bench 1870.3.0 db0c12ab8ee6 */
/* bench 25361.2.0 9829625bfe90 */
/* bench 25361.2.1 37f9db30b666 */
/* bench 25361.2.2 10b39b2c632b */
/* bench 25361.2.3 34bafc687097 */
/* bench 25361.2.4 5cf1794e172b */
/* bench 25361.2.5 6fd604278730 */
/* bench 25361.2.6 2f29a57db778 */
/* bench 25361.2.7 1e6de4fa7d66 */
/* bench 25361.2.8 0d4b1a75e88d */
/* bench 25361.2.9 0f760b86282e */
/* bench 25361.2.10 d862f7e97859 */
/* bench 25361.2.11 323a7a0b7fd2 */
/* bench 25361.2.12 e4fb97e99a94 */
/* bench 25361.2.13 3b9e9587e701 */
/* bench 25361.2.14 02967529554d */
/* bench 25361.2.15 7e529d3bb75d */
/* bench 25361.2.16 a1e3205a01e8 */
/* bench 1870.3.3 6c7158ce14e9 */
/* bench 6171.3.0 c6fe5cc08cd4 */
/* bench 6171.3.1 3158b4c452b2 */
/* bench 6171.3.2 7fae2b2fcfab */
/* bench 6171.3.3 71abb7d66ab4 */
/* bench 1870.3.4 fd26b9504744 */
/* bench 1870.3.5 59e5cb0d61af */
/* bench 2963.3.0 98d9ef564a87 */
/* bench 2963.3.1 51627a520b16 */
/* bench 2963.3.2 3e7abb1b6931 */
/* bench 2963.3.3 4c562a47c9ed */
/* bench 2963.3.4 54a00b2c34bb */
/* bench 2963.3.5 70e93fda561d */
/* bench 2963.3.6 b8f706ca8ab3 */
/* bench 2963.3.7 5c8675b62a25 */
/* bench 2963.3.8 b399a8f2afa2 */
/* bench 2963.3.9 cd78b52d1aca */
/* bench 2963.3.10 deb28a1b55d9 */
/* bench 2963.3.11 7c582ad62f56 */
/* bench 2963.3.12 968a8023ee6b */
/* bench 2963.3.13 1ce740012540 */
/* bench 2963.3.14 31e3987a543c */
/* bench 2963.3.15 eb288324ef10 */
	// in the base tree for motor-1.
	spin_ctrl_1_conflict: motor-1 {
		accelerate = < 3 >;
		decelerate = < 5 >;
	};
};
