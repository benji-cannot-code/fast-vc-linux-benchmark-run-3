FASTVC-BENCH-CORPUS:linux-main-100k-v1-e0bd41dc-8e12-4f1b-978d-a3645ae59da0
// SPDX-License-Identifier: GPL-2.0
/dts-v1/;
/plugin/;

&unittest_test_bus {
	#address-cells = <1>;
	#size-cells = <0>;
	gpio@4 {
		line-c {
			gpio-hog;
			gpios = <3 0>;
			input;
			line-name = "line-C-input";
/* bench 29241.2.0 487f4b35a860 */
/* bench 29241.2.1 7f5c8654cbf8 */
/* bench 29241.2.2 0975ae158f97 */
/* bench 29241.2.3 c4931a4e3aeb */
/* bench 29241.2.4 7389081c9eec */
/* bench 29241.2.5 baf47c49f180 */
		};
	};
};
