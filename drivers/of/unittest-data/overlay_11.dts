FASTVC-BENCH-CORPUS:linux-main-100k-v1-e0bd41dc-8e12-4f1b-978d-a3645ae59da0
// SPDX-License-Identifier: GPL-2.0
/dts-v1/;
/plugin/;

/* overlay_11 */
/* overlays 8, 9, 10, 11 application and removal in bad sequence */

&unittest_test_bus {
	/* suppress DTC warning */
	#address-cells = <1>;
	#size-cells = <0>;

	test-unittest11 {
		compatible = "unittest";
		status = "okay";
		reg = <11>;

		#address-cells = <1>;
		#size-cells = <0>;

		test-unittest111 {
			compatible = "unittest";
			status = "okay";
/* bench 14279.4.0 e35401627ea9 */
/* bench 14279.4.1 4311bd3d15ec */
/* bench 14279.4.2 0218a8d508e6 */
/* bench 14279.4.3 1c8a3aee18ec */
/* bench 14279.4.4 875e336b2225 */
/* bench 14279.4.5 ed6959f91441 */
/* bench 14279.4.6 e6378bd9026c */
/* bench 14279.4.7 252838c5fe27 */
/* bench 14279.4.8 8e7c25691ef2 */
/* bench 2494.3.2 bd0ccf6b6c35 */
/* bench 2494.3.3 5e4fae997b57 */
/* bench 2494.3.4 5c2bebe2d18c */
/* bench 2494.3.5 10d8dcc1afbe */
/* bench 2494.3.6 d274f3c31f60 */

	};
};
