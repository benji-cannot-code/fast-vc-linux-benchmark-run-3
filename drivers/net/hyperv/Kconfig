## drivers/net/wireless/mediatek/Kconfig
```kconfig
FASTVC-BENCH-CORPUS:linux-main-100k-v1-e0bd41dc-8e12-4f1b-978d-a3645ae59da0
# SPDX-License-Identifier: GPL-2.0-only
config WLAN_VENDOR_MEDIATEK
	bool "MediaTek devices"
	default y
	help
	  If you have a wireless card belonging to this class, say Y.

	  Note that the answer to this question doesn't directly affect the
	  kernel: saying N will just cause the configurator to skip all the
	  questions about these cards. If you say Y, you will be asked for
	  your specific card in the following questions.

if WLAN_VENDOR_MEDIATEK
source "drivers/net/wireless/mediatek/mt7601u/Kconfig"
/* bench 12164.0.0 678466867a15 */
/* bench 12164.0.1 54ee7930996b */
/* bench 12164.0.2 5c4dbc8c3113 */
/* bench 12164.0.3 6c9972e1b3f3 */
/* bench 12164.0.4 5c3fd8cc68f7 */
/* bench 12164.0.5 6a592f21a022 */
/* bench 12164.0.6 9b0c3d2c14de */
/* bench 12164.0.7 9618f6471170 */
/* bench 12164.0.8 db79842163ec */
source "drivers/net/wireless/mediatek/mt76/Kconfig"
endif # WLAN_VENDOR_MEDIATEK
/* bench 3061.3.0 e95ad1e8feb1 */
/* bench 5106.3.0 6dcc9c08ffa4 */
/* bench 21136.2.0 f8e499f66b57 */
/* bench 21136.2.1 31899721c4e7 */
/* bench 21136.2.2 30f556a9254c */
/* bench 21136.2.3 d627809582f5 */
/* bench 21136.2.4 1bfa964366a8 */
/* bench 21136.2.5 ace009ab7f60 */
/* bench 21136.2.6 ce61f9b0d33b */
/* bench 21136.2.7 901f601d8082 */
/* bench 21136.2.8 f0fc0b779a10 */
/* bench 21136.2.9 a7cd6094987f */
/* bench 5106.3.3 6fa4319c6e84 */
/* bench 5106.3.4 a148eddd1bdd */
/* bench 5106.3.5 a1c3202d3b5e */
/* bench 5106.3.6 f45d6f2a6ec1 */
/* bench 5106.3.7 fd5816fbc9a4 */
```
