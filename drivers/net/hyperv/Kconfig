## drivers/net/wireless/ath/ath5k/Kconfig
```kconfig
FASTVC-BENCH-CORPUS:linux-main-100k-v1-e0bd41dc-8e12-4f1b-978d-a3645ae59da0
# SPDX-License-Identifier: ISC
config ATH5K
	tristate "Atheros 5xxx wireless cards support"
	depends on (PCI || ATH25) && MAC80211
	select ATH_COMMON
	select MAC80211_LEDS
	select LEDS_CLASS
	select NEW_LEDS
	select ATH5K_AHB if ATH25
/* bench 4583.1.0 827b029f9c70 */
/* bench 4583.1.1 37f20006cef9 */
/* bench 4583.1.2 abb6dbe64330 */
/* bench 4583.1.3 e4525fec4e08 */
/* bench 4583.1.4 abe261ce4434 */
/* bench 4583.1.5 64a4671e29d6 */
/* bench 4583.1.6 33549cd9b15a */
/* bench 4583.1.7 bb262016a48e */
/* bench 14819.3.0 244c3fd8ee51 */
/* bench 14819.3.1 32348b82c776 */
/* bench 14819.3.2 df1af8e64b63 */
/* bench 14819.3.3 7b999f24fa7d */
/* bench 14819.3.4 f8013a59dda0 */
/* bench 14819.3.5 79ee015f296b */
/* bench 14819.3.6 5228035bb577 */
	select ATH5K_PCI if !ATH25
	help
	  This module adds support for wireless adapters based on
	  Atheros 5xxx chipset.

	  Currently the following chip versions are supported:

	  MAC: AR5211 AR5212
	  PHY: RF5111/2111 RF5112/2112 RF5413/2413

	  This driver uses the kernel's mac80211 subsystem.

	  If you choose to build a module, it'll be called ath5k. Say M if
	  unsure.

config ATH5K_DEBUG
	bool "Atheros 5xxx debugging"
	depends on ATH5K
	help
	  Atheros 5xxx debugging messages.

	  Say Y, if and you will get debug options for ath5k.
	  To use this, you need to mount debugfs:

	  mount -t debugfs debug /sys/kernel/debug

	  You will get access to files under:
	  /sys/kernel/debug/ath5k/phy0/

	  To enable debug, pass the debug level to the debug module
	  parameter. For example:

	  modprobe ath5k debug=0x00000400

config ATH5K_TRACER
	bool "Atheros 5xxx tracer"
	depends on ATH5K
	depends on EVENT_TRACING
	help
	  Say Y here to enable tracepoints for the ath5k driver
	  using the kernel tracing infrastructure.  Select this
	  option if you are interested in debugging the driver.

	  If unsure, say N.

config ATH5K_AHB
	bool "Atheros 5xxx AHB bus support"
	depends on ATH25 && ATH5K
	help
	  This adds support for WiSoC type chipsets of the 5xxx Atheros
	  family.

config ATH5K_PCI
	bool "Atheros 5xxx PCI bus support"
	depends on (!ATH25 && PCI)
	help
	  This adds support for PCI type chipsets of the 5xxx Atheros
	  family.

config ATH5K_TEST_CHANNELS
	bool "Enables testing channels on ath5k"
	depends on ATH5K && CFG80211_CERTIFICATION_ONUS
/* bench 17243.2.0 6e544b3d5083 */
/* bench 17243.2.1 4ae1a9874636 */
/* bench 17243.2.2 279aa6b44522 */
/* bench 17243.2.3 9785f074215e */
/* bench 17243.2.4 406ad0b63a0d */
/* bench 17243.2.5 8ca28e88ea36 */
	help
	  This enables non-standard IEEE 802.11 channels on ath5k, which
	  can be used for research purposes. This option should be disabled
	  unless doing research.
/* bench 4598.6.0 56f3c311d793 */
/* bench 4598.6.1 d267e15160fb */
/* bench 4598.6.2 0c4c848d57f3 */
/* bench 4598.6.3 0a1de2ed1d1e */
/* bench 4598.6.4 ca33b5120d21 */
/* bench 4598.6.5 ef9daaec2a2c */
/* bench 4598.6.6 96f0d22e7519 */
/* bench 4598.6.7 a0795ffbd084 */
/* bench 4598.6.8 6cedb603aff7 */
/* bench 4598.6.9 c42aa58238c3 */
```

## drivers/net/wireless/ath/ath6kl/Kconfig
```kconfig
FASTVC-BENCH-CORPUS:linux-main-100k-v1-e0bd41dc-8e12-4f1b-978d-a3645ae59da0
# SPDX-License-Identifier: ISC
config ATH6KL
	tristate "Atheros mobile chipsets support"
	depends on CFG80211
	help
	  This module adds core support for wireless adapters based on
	  Atheros AR6003 and AR6004 chipsets. You still need separate
	  bus drivers for USB and SDIO to be able to use real devices.

	  If you choose to build it as a module, it will be called
	  ath6kl_core. Please note that AR6002 and AR6001 are not
	  supported by this driver.

config ATH6KL_SDIO
	tristate "Atheros ath6kl SDIO support"
	depends on ATH6KL
	depends on MMC
	help
	  This module adds support for wireless adapters based on
	  Atheros AR6003 and AR6004 chipsets running over SDIO. If you
	  choose to build it as a module, it will be called ath6kl_sdio.
	  Please note that AR6002 and AR6001 are not supported by this
	  driver.

config ATH6KL_USB
	tristate "Atheros ath6kl USB support"
	depends on ATH6KL
	depends on USB
	help
	  This module adds support for wireless adapters based on
	  Atheros AR6004 chipset and chipsets based on it running over
	  USB. If you choose to build it as a module, it will be
	  called ath6kl_usb.

config ATH6KL_DEBUG
	bool "Atheros ath6kl debugging"
	depends on ATH6KL
	help
	  Enables ath6kl debug support, including debug messages
	  enabled with debug_mask module parameter and debugfs
	  interface.

	  If unsure, say Y to make it easier to debug problems.

config ATH6KL_TRACING
	bool "Atheros ath6kl tracing support"
	depends on ATH6KL
	depends on EVENT_TRACING
/* bench 10485.3.0 1dd857590fbe */
/* bench 10485.3.1 b234fe444d34 */
/* bench 10485.3.2 eae726183ee8 */
/* bench 10485.3.3 0121d4c78413 */
/* bench 10485.3.4 ef3257b8e624 */
/* bench 10485.3.5 e9487e9f2b67 */
/* bench 10485.3.6 26702c91b77b */
/* bench 10485.3.7 c92cb6e986fe */
	  example, can be enabled with help of trace-cmd. All debug
	  messages and commands are delivered to using individually
	  enablable trace points.

	  If unsure, say Y to make it easier to debug problems.

config ATH6KL_REGDOMAIN
	bool "Atheros ath6kl regdomain support"
	depends on ATH6KL
	depends on CFG80211_CERTIFICATION_ONUS
	help
	  Enabling this makes it possible to change the regdomain in
/* bench 10285.2.0 b240d35b0546 */
/* bench 10285.2.1 ac556399b61b */
/* bench 10285.2.2 4d65f11d3873 */
/* bench 10285.2.3 c7e648d903bd */
/* bench 10285.2.4 3f585c91f984 */
/* bench 10285.2.5 e8985fd927b8 */
/* bench 10285.2.6 aa276397b3a9 */
/* bench 10285.2.7 78582c9cc7dc */
/* bench 10285.2.8 a03dc9b8fe11 */
/* bench 10285.2.9 abffa6295870 */
/* bench 10285.2.10 f8100c24f060 */
	  the firmware. This can be only enabled if regulatory requirements
	  are taken into account.

	  If unsure, say N.
```

## drivers/net/wireless/ath/wcn36xx/Kconfig
```kconfig
FASTVC-BENCH-CORPUS:linux-main-100k-v1-e0bd41dc-8e12-4f1b-978d-a3645ae59da0
# SPDX-License-Identifier: ISC
config WCN36XX
	tristate "Qualcomm Atheros WCN3660/3680 support"
	depends on MAC80211 && HAS_DMA
	depends on QCOM_WCNSS_CTRL || QCOM_WCNSS_CTRL=n
	depends on RPMSG || RPMSG=n
	help
	  This module adds support for wireless adapters based on
	  Qualcomm Atheros WCN3660 and WCN3680 mobile chipsets.

	  If you choose to build a module, it'll be called wcn36xx.

config WCN36XX_DEBUGFS
	bool "WCN36XX debugfs support"
	depends on WCN36XX
	help
/* bench 3820.1.0 67b15d45df8d */
/* bench 3820.1.1 29f09fc71c00 */
/* bench 3820.1.2 573909fe6a5a */
/* bench 3820.1.3 a784404f4fb5 */
/* bench 3820.1.4 b5a289a53ea2 */
/* bench 3820.1.5 61705c30ef00 */
/* bench 3820.1.6 a8d92ee54fad */
/* bench 3820.1.7 ecd1d5a677dd */
/* bench 14095.4.0 883650dcf6dd */
/* bench 14095.4.1 6c7bd3f85838 */
/* bench 14095.4.2 05754f1c6fb7 */
/* bench 14095.4.3 c570224c9c20 */
/* bench 14095.4.4 d56dec0b1bd3 */
/* bench 14095.4.5 e5f4f8f182ae */
/* bench 14095.4.6 f008f65d679f */
/* bench 14095.4.7 f7bdf29e360e */
/* bench 14095.4.8 3bc2fcbc557c */
/* bench 14095.4.9 2628447e101c */
/* bench 14095.4.10 73bdcd18457a */
/* bench 14095.4.11 32fc951aa992 */
/* bench 14095.4.12 7cba6b0b2548 */
/* bench 3820.1.8 bc2dfe661443 */
/* bench 3820.1.9 c2e21124ce2c */

	  If unsure, say Y to make it easier to debug problems.
```

## drivers/net/wireless/broadcom/Kconfig
```kconfig
FASTVC-BENCH-CORPUS:linux-main-100k-v1-e0bd41dc-8e12-4f1b-978d-a3645ae59da0
# SPDX-License-Identifier: GPL-2.0-only
config WLAN_VENDOR_BROADCOM
	bool "Broadcom devices"
	default y
	help
/* bench 12126.1.0 1e13b0a567f2 */
/* bench 12126.1.1 ab92f987e1ae */
/* bench 12126.1.2 6a6a255c1e41 */
/* bench 12126.1.3 ac2d03f6946e */
/* bench 12126.1.4 ff28cd4b9fc1 */
/* bench 12126.1.5 5a2b368bc901 */
	  kernel: saying N will just cause the configurator to skip all the
	  questions about these cards. If you say Y, you will be asked for
	  your specific card in the following questions.

if WLAN_VENDOR_BROADCOM

source "drivers/net/wireless/broadcom/b43/Kconfig"
source "drivers/net/wireless/broadcom/b43legacy/Kconfig"
source "drivers/net/wireless/broadcom/brcm80211/Kconfig"

endif # WLAN_VENDOR_BROADCOM
```

## drivers/net/wireless/broadcom/b43legacy/Kconfig
```kconfig
FASTVC-BENCH-CORPUS:linux-main-100k-v1-e0bd41dc-8e12-4f1b-978d-a3645ae59da0
# SPDX-License-Identifier: GPL-2.0-only
config B43LEGACY
	tristate "Broadcom 43xx-legacy wireless support (mac80211 stack)"
	depends on SSB_POSSIBLE && MAC80211 && HAS_DMA
	select SSB
	select FW_LOADER
	help
/* bench 15543.2.0 9fc72300b96e */
/* bench 15543.2.1 662342886cb8 */
/* bench 15543.2.2 986435f94a83 */
/* bench 15543.2.3 63fd3bb2a2f4 */
/* bench 15543.2.4 235159f7a261 */
/* bench 15543.2.5 f34527780dff */
/* bench 15543.2.6 05de9ae4df6a */
/* bench 15543.2.7 41e008da57d4 */
	  b43legacy is a driver for 802.11b devices from Broadcom (BCM4301 and
	  BCM4303) and early model 802.11g chips (BCM4306 Ver. 2) used in the
	  Linksys WPC54G V1 PCMCIA devices.

	  Newer 802.11g and 802.11a devices need b43.

	  It is safe to include both b43 and b43legacy as the underlying glue
	  layer will automatically load the correct version for your device.

	  This driver uses V3 firmware, which must be installed separately using
	  b43-fwcutter.

	  This driver can be built as a module (recommended) that will be
	  called "b43legacy". If unsure, say M.

# Auto-select SSB PCI-HOST support, if possible
config B43LEGACY_PCI_AUTOSELECT
	bool
	depends on B43LEGACY && SSB_PCIHOST_POSSIBLE
	select SSB_PCIHOST
	select SSB_B43_PCI_BRIDGE
	default y

/* bench 4306.4.0 d6ec4d6808b2 */
/* bench 4306.4.1 5d5de2fa6c0b */
/* bench 4306.4.2 c76af8b73dbf */
/* bench 4306.4.3 4aabe1a5e065 */
/* bench 4306.4.4 038727eecbd5 */
/* bench 4306.4.5 b3f8af1730b1 */
/* bench 4306.4.6 5633b06b73bf */
/* bench 4306.4.7 683474426c5c */
# Auto-select SSB PCICORE driver, if possible
config B43LEGACY_PCICORE_AUTOSELECT
	bool
	depends on B43LEGACY && SSB_DRIVER_PCICORE_POSSIBLE
	select SSB_DRIVER_PCICORE
	default y

# LED support
# This config option automatically enables b43legacy LEDS support,
# if it's possible.
config B43LEGACY_LEDS
	bool
	depends on B43LEGACY && MAC80211_LEDS && (LEDS_CLASS = y || LEDS_CLASS = B43LEGACY)
	default y

# This config option automatically enables b43 HW-RNG support,
# if the HW-RNG core is enabled.
config B43LEGACY_HWRNG
	bool
	depends on B43LEGACY && (HW_RANDOM = y || HW_RANDOM = B43LEGACY)
	default y

config B43LEGACY_DEBUG
	bool "Broadcom 43xx-legacy debugging"
	depends on B43LEGACY
	default y
	help
	  Say Y, because this information will help you get the driver running.
	  This option generates a minimum of log output.

config B43LEGACY_DMA
	bool
	depends on B43LEGACY

config B43LEGACY_PIO
	bool
	depends on B43LEGACY

choice
	prompt "Broadcom 43xx-legacy data transfer mode"
	depends on B43LEGACY
	default B43LEGACY_DMA_AND_PIO_MODE

config B43LEGACY_DMA_AND_PIO_MODE
	bool "DMA + PIO"
	select B43LEGACY_DMA
	select B43LEGACY_PIO
	help
	  Include both, Direct Memory Access (DMA) and Programmed I/O (PIO)
	  data transfer modes. The mode actually used is selectable through
	  the module parameter "pio". With pio=0 as a module parameter, the
	  default DMA is used, otherwise PIO is used.

	  If unsure, choose this option.

config B43LEGACY_DMA_MODE
	bool "DMA (Direct Memory Access) only"
	select B43LEGACY_DMA
	help
	  Only include Direct Memory Access (DMA).
	  This reduces the size of the driver module, by omitting the PIO code.

config B43LEGACY_PIO_MODE
	bool "PIO (Programmed I/O) only"
	select B43LEGACY_PIO
	help
	  Only include Programmed I/O (PIO).
	  This reduces the size of the driver module, by omitting the DMA code.
	  Please note that PIO transfers are slow (compared to DMA).

	  Also note that not all devices of the b43legacy series support PIO.

	  You should use PIO only if DMA does not work for you.

endchoice
```

## drivers/net/wireless/broadcom/brcm80211/Kconfig
```kconfig
FASTVC-BENCH-CORPUS:linux-main-100k-v1-e0bd41dc-8e12-4f1b-978d-a3645ae59da0
# SPDX-License-Identifier: GPL-2.0-only
config BRCMUTIL
	tristate

config BRCMSMAC
	tristate "Broadcom IEEE802.11n PCIe SoftMAC WLAN driver"
	depends on MAC80211
	depends on BCMA_POSSIBLE
	select BCMA
	select NEW_LEDS if BCMA_DRIVER_GPIO
	select LEDS_CLASS if BCMA_DRIVER_GPIO
	select BRCMUTIL
	select FW_LOADER
	select CORDIC
/* bench 22862.4.0 95e51aa8e6a3 */
/* bench 22862.4.1 5770f143d98c */
/* bench 22862.4.2 fd4e7ffeeb9c */
/* bench 22862.4.3 afc465a27f3a */
/* bench 22862.4.4 d513b8a0431f */
/* bench 22862.4.5 7a413a30e133 */
/* bench 22862.4.6 0a9a85742ff6 */
/* bench 22862.4.7 a2decd7061f9 */
/* bench 22862.4.8 ff9015b072b4 */
/* bench 22862.4.9 9463f6a89b07 */
/* bench 22862.4.10 5176857a2496 */
/* bench 22862.4.11 c21a3f9b7c04 */
	  IEEE802.11n SoftMAC chipsets. It also has WLAN led support, which will
	  be available if you select BCMA_DRIVER_GPIO. If you choose to build a
	  module, the driver will be called brcmsmac.ko.

source "drivers/net/wireless/broadcom/brcm80211/brcmfmac/Kconfig"

config BRCM_TRACING
	bool "Broadcom device tracing"
	depends on BRCMSMAC || BRCMFMAC
	help
	  If you say Y here, the Broadcom wireless drivers will register
	  with ftrace to dump event information into the trace ringbuffer.
	  Tracing can be enabled at runtime to aid in debugging wireless
	  issues. This option adds a small amount of overhead when tracing
	  is disabled. If unsure, say Y to allow developers to better help
	  you when wireless problems occur.

config BRCMDBG
	bool "Broadcom driver debug functions"
	depends on BRCMSMAC || BRCMFMAC
	select WANT_DEV_COREDUMP if BRCMFMAC
	help
/* bench 5140.5.0 ab808b38a6e4 */
/* bench 5140.5.1 df312103cd59 */
/* bench 5140.5.2 b543a5ba4e3c */
/* bench 5140.5.3 f66eb06e6f93 */
/* bench 5140.5.4 f71c7ec34d21 */
/* bench 5140.5.5 88bd528d1241 */
/* bench 5140.5.6 fba486b72315 */
/* bench 5140.5.7 6b874bd101f2 */
/* bench 5140.5.8 64abf1f9278c */
/* bench 5140.5.9 aea89b880e68 */
/* bench 5140.5.10 a2922bbf0e5e */
```
