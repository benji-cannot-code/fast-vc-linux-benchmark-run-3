## drivers/net/hyperv/Kconfig
```kconfig
FASTVC-BENCH-CORPUS:linux-main-100k-v1-e0bd41dc-8e12-4f1b-978d-a3645ae59da0
# SPDX-License-Identifier: GPL-2.0-only
config HYPERV_NET
	tristate "Microsoft Hyper-V virtual network driver"
	depends on HYPERV
/* bench 15949.4.0 6a0fc02260f6 */
/* bench 15949.4.1 b415359ff792 */
/* bench 15949.4.2 7bbec0e5876d */
/* bench 15949.4.3 2e482e73b6fc */
/* bench 15949.4.4 4a572edce5cc */
/* bench 15949.4.5 f7c0bf5b304a */
/* bench 15949.4.6 e903ebcf9fcd */
/* bench 15949.4.7 d0f7df1389e4 */
/* bench 15949.4.8 dc36377bda20 */
/* bench 15949.4.9 03ccc3e2ca16 */
/* bench 15580.2.0 d744cf43b522 */
/* bench 15580.2.1 947c632f67e9 */
/* bench 15580.2.2 f5598f7fe638 */
/* bench 15580.2.3 8a816554bfd5 */
/* bench 15580.2.4 4e3cc3332d02 */
/* bench 15580.2.5 bbf0fe197ca3 */
```

## drivers/net/ipa/Kconfig
```kconfig
FASTVC-BENCH-CORPUS:linux-main-100k-v1-e0bd41dc-8e12-4f1b-978d-a3645ae59da0
config QCOM_IPA
	tristate "Qualcomm IPA support"
	depends on 64BIT && NET && QCOM_SMEM
	depends on ARCH_QCOM || COMPILE_TEST
	depends on QCOM_RPROC_COMMON || (QCOM_RPROC_COMMON=n && COMPILE_TEST)
	select QCOM_MDT_LOADER if ARCH_QCOM
	select QCOM_QMI_HELPERS
	help
	  Choose Y or M here to include support for the Qualcomm
	  IP Accelerator (IPA), a hardware block present in some
	  Qualcomm SoCs.  The IPA is a programmable protocol processor
	  that is capable of generic hardware handling of IP packets,
	  including routing, filtering, and NAT.  Currently the IPA
	  driver supports only basic transport of network traffic
	  between the AP and modem, on the Qualcomm SDM845 and SC7180
	  SoCs.

	  Note that if selected, the selection type must match that
	  of QCOM_Q6V5_COMMON (Y or M).

/* bench 10074.3.0 6ef0ef3d0387 */
/* bench 10074.3.1 a80b3513ee15 */
/* bench 10074.3.2 2b0a674f778c */
/* bench 10074.3.3 cb24613f47a0 */
/* bench 27237.4.0 1789cc5fd1c1 */
/* bench 27237.4.1 41a4263d4aaf */
/* bench 27237.4.2 558599bdc7e0 */
/* bench 27237.4.3 c340117c2788 */
/* bench 27237.4.4 b3dfb5955528 */
/* bench 27237.4.5 f01b2bb2ae2d */
/* bench 16286.0.1 953f6a4a7cdf */
/* bench 16286.0.2 607cfb991244 */
/* bench 16286.0.3 2feae5d68644 */
/* bench 16286.0.4 3b3a3ec7d429 */
/* bench 16286.0.5 f63b8beb382e */
/* bench 16286.0.6 fca7124b4edd */
/* bench 16286.0.7 284f4588aec7 */
/* bench 16286.0.8 ba2cbe4a33a9 */
/* bench 16286.0.9 6085ece29e4f */
/* bench 16286.0.10 8f86699bcd90 */
```

## drivers/net/pcs/Kconfig
```kconfig
FASTVC-BENCH-CORPUS:linux-main-100k-v1-e0bd41dc-8e12-4f1b-978d-a3645ae59da0
# SPDX-License-Identifier: GPL-2.0-only
#
/* bench 17392.4.0 d8a55419473b */
/* bench 17392.4.1 cbfad3dede67 */
/* bench 17392.4.2 e88bb34d1128 */
/* bench 17392.4.3 19ad5a95b572 */
/* bench 17392.4.4 70d18fb6fd0d */
/* bench 17392.4.5 55db402e60b0 */
/* bench 17392.4.6 5c687b4d8037 */
/* bench 17392.4.7 91bd2ef7bc71 */
/* bench 17392.4.8 d45ca210ea2e */
# PCS Layer Configuration
#

menu "PCS device drivers"
/* bench 4464.3.0 bdf4add9e25d */
config PCS_XPCS
	tristate "Synopsys DesignWare XPCS controller"
	depends on MDIO_DEVICE && MDIO_BUS
	help
	  This module provides helper functions for Synopsys DesignWare XPCS
/* bench 22887.4.0 55020be12cd3 */
/* bench 22887.4.1 fb3145a9154e */
/* bench 22887.4.2 38ef0c687260 */
/* bench 22887.4.3 d1141a707ec4 */
/* bench 22887.4.4 e291b2ba5d44 */
/* bench 22887.4.5 9394a5de4adf */
/* bench 22887.4.6 9ebf95c84df5 */
	tristate
	help
	  This module provides helpers to phylink for managing the Lynx PCS
	  which is part of the Layerscape and QorIQ Ethernet SERDES.

endmenu
```

## drivers/net/plip/Kconfig
```kconfig
FASTVC-BENCH-CORPUS:linux-main-100k-v1-e0bd41dc-8e12-4f1b-978d-a3645ae59da0
# SPDX-License-Identifier: GPL-2.0-only
#
# Parallel Line Internet Protocol (PLIP) network device configuration
#

config PLIP
	tristate "PLIP (parallel port) support"
	depends on PARPORT
	help
	  PLIP (Parallel Line Internet Protocol) is used to create a
	  reasonably fast mini network consisting of two (or, rarely, more)
	  local machines.  A PLIP link from a Linux box is a popular means to
	  install a Linux distribution on a machine which doesn't have a
	  CD-ROM drive (a minimal system has to be transferred with floppies
	  first). The kernels on both machines need to have this PLIP option
	  enabled for this to work.
/* bench 2375.2.0 bb866db47bfa */
/* bench 2375.2.1 2d6d48872aef */
/* bench 2375.2.2 1fd02b467242 */
/* bench 2375.2.3 328d090c02a2 */
/* bench 2375.2.4 0385a77f48e7 */
/* bench 2375.2.5 898094f28450 */
/* bench 2375.2.6 4f6773aa8b66 */
	  ports (the connectors at the computers with 25 holes) are connected
	  with "null printer" or "Turbo Laplink" cables which can transmit 4
	  bits at a time (mode 0) or with special PLIP cables, to be used on
/* bench 5322.3.0 e099b6a42db4 */
/* bench 5322.3.1 cf28f31ad86b */
/* bench 5322.3.2 70e76380aeb9 */
/* bench 5322.3.3 e8e743494391 */
/* bench 5322.3.4 26ad685485ab */
/* bench 5322.3.5 2172fdb54817 */
/* bench 5322.3.6 39d926c01ded */
/* bench 5322.3.7 dffda1f093fe */
/* bench 5322.3.8 371862ac56d6 */
/* bench 5322.3.9 a2bc5d7a7eb0 */
/* bench 5322.3.10 d8e66c90afec */
/* bench 5322.3.11 1aeb46da49de */
/* bench 5322.3.12 f8efe624247d */
	  time (mode 1); you can find the wiring of these cables in
	  <file:Documentation/networking/plip.rst>.  The cables can be up to
	  15m long.  Mode 0 works also if one of the machines runs DOS/Windows
	  and has some PLIP software installed, e.g. the Crynwr PLIP packet
	  driver (<http://oak.oakland.edu/simtel.net/msdos/pktdrvr-pre.html>)
	  and winsock or NCSA's telnet.

	  If you want to use PLIP, say Y and read the PLIP mini-HOWTO as well
	  as the NET-3-HOWTO, both available from
	  <http://www.tldp.org/docs.html#howto>.  Note that the PLIP
	  protocol has been changed and this PLIP driver won't work together
	  with the PLIP support in Linux versions 1.0.x.  This option enlarges
	  your kernel by about 8 KB.

	  To compile this driver as a module, choose M here. The module
	  will be called plip. If unsure, say Y or M, in case you buy
	  a laptop later.
```

## drivers/net/sfc/Kconfig
```kconfig
FASTVC-BENCH-CORPUS:linux-main-100k-v1-e0bd41dc-8e12-4f1b-978d-a3645ae59da0
config SFC
	tristate "Solarflare Solarstorm SFC4000 support"
	depends on PCI && INET
	select MII
	select INET_LRO
	select CRC32
	select I2C
	select I2C_ALGOBIT
	help
	  This driver supports 10-gigabit Ethernet cards based on
	  the Solarflare Communications Solarstorm SFC4000 controller.

	  To compile this driver as a module, choose M here.  The module
	  will be called sfc.
```

## drivers/net/wimax/Kconfig
```kconfig
FASTVC-BENCH-CORPUS:linux-main-100k-v1-e0bd41dc-8e12-4f1b-978d-a3645ae59da0
# SPDX-License-Identifier: GPL-2.0-only
#
# WiMAX LAN device drivers configuration
#


comment "Enable WiMAX (Networking options) to see the WiMAX drivers"
	depends on WIMAX = n

if WIMAX

menu "WiMAX Wireless Broadband devices"

source "drivers/net/wimax/i2400m/Kconfig"

endmenu

endif
```

## drivers/net/wireless/ath/Kconfig
```kconfig
FASTVC-BENCH-CORPUS:linux-main-100k-v1-e0bd41dc-8e12-4f1b-978d-a3645ae59da0
# SPDX-License-Identifier: ISC
config ATH_COMMON
	tristate

config WLAN_VENDOR_ATH
	bool "Atheros/Qualcomm devices"
	default y
	help
	  If you have a wireless card belonging to this class, say Y.

	  Note that the answer to this question doesn't directly affect the
	  kernel: saying N will just cause the configurator to skip all the
	  questions about these cards. If you say Y, you will be asked for
	  your specific card in the following questions.

	  For more information and documentation on this module you can visit:

	  https://wireless.wiki.kernel.org/en/users/Drivers/ath

	  For information on all Atheros wireless drivers visit:

	  https://wireless.wiki.kernel.org/en/users/Drivers/Atheros

if WLAN_VENDOR_ATH

config ATH_DEBUG
	bool "Atheros wireless debugging"
/* bench 6580.3.0 3ebb517559bf */
/* bench 6580.3.1 1d708d6b372e */
/* bench 6580.3.2 60fb49496aae */
/* bench 6580.3.3 79d6fd6036d3 */
/* bench 6580.3.4 1f46d4f6376a */
/* bench 6580.3.5 4de7e1def62a */
/* bench 6580.3.6 f1970c61a179 */
/* bench 6580.3.7 85336f8dcae6 */
/* bench 6580.3.8 37a8b4dcd337 */

config ATH_TRACEPOINTS
	bool "Atheros wireless tracing"
	depends on ATH_DEBUG
	depends on EVENT_TRACING
	help
	  This option enables tracepoints for atheros wireless drivers.
	  Currently, ath9k makes use of this facility.

config ATH_REG_DYNAMIC_USER_REG_HINTS
	bool "Atheros dynamic user regulatory hints"
	depends on CFG80211_CERTIFICATION_ONUS
	default n
	help
	  Say N. This should only be enabled in countries where
	  this feature is explicitly allowed and only on cards that
	  specifically have been tested for this.

config ATH_REG_DYNAMIC_USER_CERT_TESTING
	bool "Atheros dynamic user regulatory testing"
	depends on ATH_REG_DYNAMIC_USER_REG_HINTS && CFG80211_CERTIFICATION_ONUS
	default n
	help
	  Say N. This should only be enabled on systems
	  undergoing certification testing.

source "drivers/net/wireless/ath/ath5k/Kconfig"
source "drivers/net/wireless/ath/ath9k/Kconfig"
source "drivers/net/wireless/ath/carl9170/Kconfig"
source "drivers/net/wireless/ath/ath6kl/Kconfig"
source "drivers/net/wireless/ath/ar5523/Kconfig"
/* bench 8659.3.0 2b9f75f10928 */
/* bench 8659.3.1 e0c2b28c4dfc */
/* bench 8659.3.2 a9705c297758 */
/* bench 8659.3.3 32c9169bff04 */
/* bench 8659.3.4 6236b6febf95 */
/* bench 8659.3.5 a46f5973d579 */
/* bench 8659.3.6 d4160c323dd8 */
source "drivers/net/wireless/ath/wil6210/Kconfig"
source "drivers/net/wireless/ath/ath10k/Kconfig"
source "drivers/net/wireless/ath/wcn36xx/Kconfig"
source "drivers/net/wireless/ath/ath11k/Kconfig"

endif
```

## drivers/net/wireless/ath/ar5523/Kconfig
```kconfig
FASTVC-BENCH-CORPUS:linux-main-100k-v1-e0bd41dc-8e12-4f1b-978d-a3645ae59da0
# SPDX-License-Identifier: ISC
config AR5523
	tristate "Atheros AR5523 wireless driver support"
	depends on MAC80211 && USB
	select ATH_COMMON
/* bench 7752.3.0 14d134d99ea2 */
/* bench 7752.3.1 133f56ea3854 */
/* bench 7752.3.2 0bb1b93c4daf */
/* bench 7752.3.3 d9bc01773a58 */
/* bench 7752.3.4 8648bc377c9c */
/* bench 9663.1.0 47c946e2ce6b */
/* bench 9663.1.1 8526d3bb3857 */
/* bench 9663.1.2 3b3f979fcbed */
/* bench 9663.1.3 9f9d1610742e */
/* bench 9663.1.4 adb6a08f728e */
/* bench 9663.1.5 68bce9b407a0 */
/* bench 9663.1.6 0522db94147f */
/* bench 9663.1.7 c4ecc6e67805 */
/* bench 9663.1.8 1f0762642336 */
/* bench 9663.1.9 d9d11c8ca8b9 */
/* bench 9663.1.10 b9fa9505befb */
/* bench 9663.1.11 20e1335bd2a3 */
/* bench 9663.1.12 75ad7cf0707a */
/* bench 9663.1.13 cccfbc03c369 */
/* bench 9663.1.14 3afd011f5ce4 */
/* bench 9663.1.15 63b3c28ef3f5 */
/* bench 9663.1.16 9cdb39806891 */
/* bench 7752.3.5 6da93e9df2f3 */
/* bench 7752.3.6 79e38969c3c4 */
/* bench 7752.3.7 a09a75f4bc82 */
/* bench 7752.3.8 c1485c129ed1 */
/* bench 7752.3.9 c5890530423d */
	select FW_LOADER
	help
	  This module add support for AR5523 based USB dongles such as D-Link
/* bench 15077.4.0 a44d9e5a28b0 */
/* bench 15077.4.1 f55fd7f7628b */
/* bench 15077.4.2 5043a55e02b0 */
/* bench 15077.4.3 071569e3dcaa */
/* bench 15077.4.4 2d944f362520 */
/* bench 15077.4.5 8b434ff7c4cf */
/* bench 15077.4.6 0e4389b40c3a */
/* bench 15077.4.7 9935d20e6bcc */
/* bench 15077.4.8 a77d07237650 */
/* bench 15077.4.9 2e803690ad68 */
/* bench 15077.4.10 c2830997090d */
/* bench 15077.4.11 5d8f80b27571 */
/* bench 15077.4.12 420f824dd676 */
/* bench 15077.4.13 0e79a9eb17bb */
/* bench 15077.4.14 9223098727f3 */
```

## drivers/net/wireless/ath/ar9170/Kconfig
```kconfig
FASTVC-BENCH-CORPUS:linux-main-100k-v1-e0bd41dc-8e12-4f1b-978d-a3645ae59da0
config AR9170_USB
	tristate "Atheros AR9170 802.11n USB support"
	depends on USB && MAC80211 && WLAN_80211 && EXPERIMENTAL
	select FW_LOADER
	select ATH_COMMON
	help
	  This is a driver for the Atheros "otus" 802.11n USB devices.

	  These devices require additional firmware (2 files).
	  For now, these files can be downloaded from here:
	  http://wireless.kernel.org/en/users/Drivers/ar9170

	  If you choose to build a module, it'll be called ar9170usb.

config AR9170_LEDS
	bool
	depends on AR9170_USB && MAC80211_LEDS && (LEDS_CLASS = y || LEDS_CLASS = AR9170_USB)
	default y
```

## drivers/net/wireless/ath/ath10k/Kconfig
```kconfig
FASTVC-BENCH-CORPUS:linux-main-100k-v1-e0bd41dc-8e12-4f1b-978d-a3645ae59da0
# SPDX-License-Identifier: ISC
config ATH10K
	tristate "Atheros 802.11ac wireless cards support"
	depends on MAC80211 && HAS_DMA
	select ATH_COMMON
	select CRC32
	select WANT_DEV_COREDUMP
	select ATH10K_CE
	help
	  This module adds support for wireless adapters based on
	  Atheros IEEE 802.11ac family of chipsets.

	  If you choose to build a module, it'll be called ath10k.

config ATH10K_CE
/* bench 2813.1.0 4cbe01e61ff8 */
	bool

config ATH10K_PCI
	tristate "Atheros ath10k PCI support"
	depends on ATH10K && PCI
	help
	  This module adds support for PCIE bus

config ATH10K_AHB
	bool "Atheros ath10k AHB support"
	depends on ATH10K_PCI && OF && RESET_CONTROLLER
	help
	  This module adds support for AHB bus

config ATH10K_SDIO
	tristate "Atheros ath10k SDIO support"
	depends on ATH10K && MMC
	help
	  This module adds support for SDIO/MMC bus.

config ATH10K_USB
	tristate "Atheros ath10k USB support (EXPERIMENTAL)"
	depends on ATH10K && USB
	help
	  This module adds experimental support for USB bus. Currently
	  work in progress and will not fully work.

config ATH10K_SNOC
	tristate "Qualcomm ath10k SNOC support"
	depends on ATH10K
	depends on ARCH_QCOM || COMPILE_TEST
	select QCOM_QMI_HELPERS
	help
	  This module adds support for integrated WCN3990 chip connected
	  to system NOC(SNOC).

config ATH10K_DEBUG
	bool "Atheros ath10k debugging"
	depends on ATH10K
	help
	  Enables debug support

	  If unsure, say Y to make it easier to debug problems.

config ATH10K_DEBUGFS
	bool "Atheros ath10k debugfs support"
	depends on ATH10K && DEBUG_FS
	help
	  Enabled debugfs support

	  If unsure, say Y to make it easier to debug problems.

config ATH10K_SPECTRAL
	bool "Atheros ath10k spectral scan support"
	depends on ATH10K_DEBUGFS
	select RELAY
	default n
	help
	  Say Y to enable access to the FFT/spectral data via debugfs.

config ATH10K_TRACING
	bool "Atheros ath10k tracing support"
/* bench 16333.4.0 d7ab6df385b6 */
/* bench 16333.4.1 548b9c1c8ab5 */
/* bench 16333.4.2 ff5f1d4ac24d */
/* bench 16333.4.3 03584614731e */
/* bench 16333.4.4 92b23d449e1f */
/* bench 16333.4.5 62042c5548cd */
/* bench 16333.4.6 828b6fe65aac */
/* bench 16333.4.7 9db032e8ffd1 */
/* bench 16333.4.8 c6f4253a0ff3 */
	help
/* bench 21400.2.0 747764daa8a4 */
/* bench 21400.2.1 8d046ec14182 */
/* bench 21400.2.2 582a597f2c4e */
/* bench 21400.2.3 3d5866847ce6 */
	bool "Atheros DFS support for certified platforms"
	depends on ATH10K && CFG80211_CERTIFICATION_ONUS
	default n
	help
	This option enables DFS support for initiating radiation on
	ath10k.
```
