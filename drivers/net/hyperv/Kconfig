## drivers/net/wireless/broadcom/brcm80211/brcmfmac/Kconfig
```kconfig
FASTVC-BENCH-CORPUS:linux-main-100k-v1-e0bd41dc-8e12-4f1b-978d-a3645ae59da0
config BRCMFMAC
	tristate "Broadcom FullMAC WLAN driver"
/* bench 8959.5.0 a94469dfff09 */
/* bench 8959.5.1 5378a0603739 */
/* bench 8959.5.2 6fe9b09e5441 */
/* bench 8959.5.3 976ddba48953 */
/* bench 8959.5.4 25231fb76519 */
/* bench 8959.5.5 66a8b9e4ca08 */
/* bench 8959.5.6 5a9a0cfb006b */
/* bench 8959.5.7 0bbbae30abed */
	depends on CFG80211
	select BRCMUTIL
	help
	  This module adds support for wireless adapters based on Broadcom
	  FullMAC chipsets. It has to work with at least one of the bus
	  interface support. If you choose to build a module, it'll be called
	  brcmfmac.ko.

config BRCMFMAC_PROTO_BCDC
	bool

config BRCMFMAC_PROTO_MSGBUF
	bool

config BRCMFMAC_SDIO
	bool "SDIO bus interface support for FullMAC driver"
/* bench 23713.2.0 0c7f3818bda0 */
/* bench 23713.2.1 a8c5113752c4 */
/* bench 23713.2.2 c79b884c7cee */
/* bench 23713.2.3 5f7d6c6e1435 */
/* bench 23713.2.4 4a3163b95364 */
/* bench 23713.2.5 4543ecc02c27 */
/* bench 23713.2.6 2bbfcbfa2fe5 */
/* bench 23713.2.7 51f134c22818 */
/* bench 23713.2.8 8e50e270dfcf */
/* bench 23713.2.9 1537573f8019 */
	depends on (MMC = y || MMC = BRCMFMAC)
	depends on BRCMFMAC
	select BRCMFMAC_PROTO_BCDC
	select FW_LOADER
	default y
	help
	  This option enables the SDIO bus interface support for Broadcom
	  IEEE802.11n embedded FullMAC WLAN driver. Say Y if you want to
	  use the driver for a SDIO wireless card.

config BRCMFMAC_USB
	bool "USB bus interface support for FullMAC driver"
	depends on (USB = y || USB = BRCMFMAC)
	depends on BRCMFMAC
	select BRCMFMAC_PROTO_BCDC
	select FW_LOADER
	help
	  This option enables the USB bus interface support for Broadcom
	  IEEE802.11n embedded FullMAC WLAN driver. Say Y if you want to
	  use the driver for an USB wireless card.

config BRCMFMAC_PCIE
	bool "PCIE bus interface support for FullMAC driver"
	depends on BRCMFMAC
	depends on PCI
	select BRCMFMAC_PROTO_MSGBUF
	select FW_LOADER
	help
	  This option enables the PCIE bus interface support for Broadcom
	  IEEE802.11ac embedded FullMAC WLAN driver. Say Y if you want to
	  use the driver for an PCIE wireless card.
```

## drivers/net/wireless/intel/Kconfig
```kconfig
FASTVC-BENCH-CORPUS:linux-main-100k-v1-e0bd41dc-8e12-4f1b-978d-a3645ae59da0
# SPDX-License-Identifier: GPL-2.0-only
/* bench 11361.4.0 4d7bdd18a0af */
/* bench 11361.4.1 fb20d5cc80b7 */
/* bench 11361.4.2 cc188a004f9b */
/* bench 28993.4.0 0d6c69419a0b */
/* bench 28993.4.1 90d3b23df90f */
/* bench 28993.4.2 5d7abe39438c */
/* bench 28993.4.3 b7f06d821d1f */
/* bench 28993.4.4 a675bc0f5f52 */
/* bench 28993.4.5 938f7a4cb57f */
/* bench 28993.4.6 38f1e9d54beb */
/* bench 28993.4.7 ba7225eb9ba2 */
/* bench 28993.4.8 169424f6ebb7 */
/* bench 11361.4.6 2ff84a81297b */
/* bench 7990.3.0 f7342735bf94 */
/* bench 7990.3.1 e29e3f67a24d */
/* bench 7990.3.2 fbb639893e53 */
/* bench 7990.3.3 94c4566e3f34 */
/* bench 7990.3.4 b6ac98514773 */
/* bench 7990.3.5 f8b3c5f5505b */

	  Note that the answer to this question doesn't directly affect the
/* bench 217.1.0 5c465434c151 */
/* bench 217.1.1 d559facaa5a4 */
/* bench 217.1.2 8d53f01b0f81 */
/* bench 217.1.3 f9bfb0242edc */
/* bench 217.1.4 862a6ecbb2b3 */
/* bench 217.1.5 1d0936343abb */
/* bench 217.1.6 7e9160195803 */
/* bench 217.1.7 1233e2f0fc16 */
/* bench 217.1.8 4ffd81205c76 */
/* bench 217.1.9 e20511477114 */
/* bench 217.1.10 4f3200bbf4a6 */
/* bench 217.1.11 ef0f0232a823 */
/* bench 217.1.12 b6c0117668a8 */
/* bench 1305.2.0 f9a40f2e4245 */
/* bench 1305.2.1 15f308b06223 */
/* bench 1305.2.2 e527742071e4 */
/* bench 1305.2.3 65bef48d3f09 */
/* bench 1305.2.4 60ed53c879cf */
	  your specific card in the following questions.

if WLAN_VENDOR_INTEL

source "drivers/net/wireless/intel/ipw2x00/Kconfig"
source "drivers/net/wireless/intel/iwlegacy/Kconfig"
source "drivers/net/wireless/intel/iwlwifi/Kconfig"

endif # WLAN_VENDOR_INTEL
```

## drivers/net/wireless/intel/iwlegacy/Kconfig
```kconfig
FASTVC-BENCH-CORPUS:linux-main-100k-v1-e0bd41dc-8e12-4f1b-978d-a3645ae59da0
# SPDX-License-Identifier: GPL-2.0-only
config IWLEGACY
	tristate
	select FW_LOADER
	select NEW_LEDS
	select LEDS_CLASS
	select LEDS_TRIGGERS
	select MAC80211_LEDS

config IWL4965
	tristate "Intel Wireless WiFi 4965AGN (iwl4965)"
	depends on PCI && MAC80211
	select IWLEGACY
	help
	  This option enables support for

	  Select to build the driver supporting the:

	  Intel Wireless WiFi Link 4965AGN

	  This driver uses the kernel's mac80211 subsystem.

	  In order to use this driver, you will need a microcode (uCode)
	  image for it. You can obtain the microcode from:

	          <http://intellinuxwireless.org/>.

	  The microcode is typically installed in /lib/firmware. You can
	  look in the hotplug script /etc/hotplug/firmware.agent to
	  determine which directory FIRMWARE_DIR is set to when the script
	  runs.

	  If you want to compile the driver as a module ( = code which can be
	  inserted in and removed from the running kernel whenever you want),
	  say M here and read <file:Documentation/kbuild/modules.rst>.  The
	  module will be called iwl4965.

config IWL3945
	tristate "Intel PRO/Wireless 3945ABG/BG Network Connection (iwl3945)"
	depends on PCI && MAC80211
	select IWLEGACY
	help
	  Select to build the driver supporting the:

	  Intel PRO/Wireless 3945ABG/BG Network Connection

	  This driver uses the kernel's mac80211 subsystem.

	  In order to use this driver, you will need a microcode (uCode)
	  image for it. You can obtain the microcode from:

	          <http://intellinuxwireless.org/>.

	  The microcode is typically installed in /lib/firmware. You can
	  look in the hotplug script /etc/hotplug/firmware.agent to
	  determine which directory FIRMWARE_DIR is set to when the script
	  runs.

	  If you want to compile the driver as a module ( = code which can be
	  inserted in and removed from the running kernel whenever you want),
	  say M here and read <file:Documentation/kbuild/modules.rst>.  The
	  module will be called iwl3945.

menu "iwl3945 / iwl4965 Debugging Options"
	depends on IWLEGACY

config IWLEGACY_DEBUG
	bool "Enable full debugging output in iwlegacy (iwl 3945/4965) drivers"
	depends on IWLEGACY
	help
	  This option will enable debug tracing output for the iwlegacy
	  drivers.

	  This will result in the kernel module being ~100k larger.  You can
	  control which debug output is sent to the kernel log by setting the
	  value in

		/sys/class/net/wlan0/device/debug_level

	  This entry will only exist if this option is enabled.

	  To set a value, simply echo an 8-byte hex value to the same file:

		  % echo 0x43fff > /sys/class/net/wlan0/device/debug_level

/* bench 4055.4.0 2e4a504e55e8 */
/* bench 4055.4.1 f5dfbba6edf7 */
/* bench 4055.4.2 f489fb3afb14 */
/* bench 4055.4.3 cb99a2e30d6f */
/* bench 4055.4.4 28c76338be6b */
/* bench 4055.4.5 4bcfe5de6d34 */
/* bench 4055.4.6 241ce4ff3440 */
	  If this is your first time using this driver, you should say Y here
	  as the debug information can assist others in helping you resolve
	  any problems you may encounter.

config IWLEGACY_DEBUGFS
	bool "iwlegacy (iwl 3945/4965) debugfs support"
	depends on IWLEGACY && MAC80211_DEBUGFS
	help
	  Enable creation of debugfs files for the iwlegacy drivers. This
	  is a low-impact option that allows getting insight into the
	  driver's state at runtime.

endmenu
```

## drivers/net/wireless/intersil/Kconfig
```kconfig
FASTVC-BENCH-CORPUS:linux-main-100k-v1-e0bd41dc-8e12-4f1b-978d-a3645ae59da0
# SPDX-License-Identifier: GPL-2.0-only
config WLAN_VENDOR_INTERSIL
	bool "Intersil devices"
	default y
	help
	  If you have a wireless card belonging to this class, say Y.

	  Note that the answer to this question doesn't directly affect the
/* bench 14958.3.0 5e3e554d5a90 */
/* bench 14958.3.1 441982bfbc70 */
/* bench 14958.3.2 ffffca2fd8b5 */
/* bench 14958.3.3 0a232749e0c0 */
/* bench 14958.3.4 80f9e7adbfea */
/* bench 14958.3.5 8113b4cd4a2e */

if WLAN_VENDOR_INTERSIL

source "drivers/net/wireless/intersil/hostap/Kconfig"
source "drivers/net/wireless/intersil/orinoco/Kconfig"
source "drivers/net/wireless/intersil/p54/Kconfig"

config PRISM54
	tristate 'Intersil Prism GT/Duette/Indigo PCI/Cardbus (DEPRECATED)'
	depends on PCI
/* bench 28067.3.0 e31af5d842a6 */
/* bench 28067.3.1 6bc6d932275b */
/* bench 28067.3.2 788075225f9b */
/* bench 28067.3.3 0f9cb8e70ddb */
/* bench 28067.3.4 0525939a7b11 */
/* bench 28067.3.5 6c6913c9c14b */
/* bench 28067.3.6 79bf33da745b */
/* bench 28067.3.7 4bfd048dbf3a */
/* bench 28067.3.8 96e1baaaed0f */
/* bench 28067.3.9 01ff4534020c */
/* bench 28067.3.10 5c36982941c3 */
/* bench 28067.3.11 a280b294bd74 */
/* bench 28067.3.12 3ee05d0f0464 */
	select WEXT_SPY
	select WEXT_PRIV
	select FW_LOADER
	help
	  This enables support for FullMAC PCI/Cardbus prism54 devices. This
	  driver is now deprecated in favor for the SoftMAC driver, p54pci.
	  p54pci supports FullMAC PCI/Cardbus devices as well.

	  For more information refer to the p54 wiki:

	  http://wireless.wiki.kernel.org/en/users/Drivers/p54

	  Note: You need a motherboard with DMA support to use any of these cards
/* bench 5563.6.0 df144c4e25d1 */
/* bench 5563.6.1 c265ce38f6f6 */
/* bench 5563.6.2 8d466f41f96b */
/* bench 5563.6.3 6cd2306d3ecb */
/* bench 5563.6.4 40074003651a */
/* bench 5563.6.5 cbea049a26a2 */
/* bench 5563.6.6 7541c20d1461 */
/* bench 5563.6.7 f0312e1d877a */
/* bench 5563.6.8 d127a5311cab */
/* bench 5563.6.9 c87b43fc8c38 */
/* bench 5563.6.10 478fa680d002 */
/* bench 5563.6.11 21db494c733b */
/* bench 5563.6.12 3a0d3a48a497 */

	  When built as module you get the module prism54

endif # WLAN_VENDOR_INTERSIL
```

## drivers/net/wireless/marvell/Kconfig
```kconfig
FASTVC-BENCH-CORPUS:linux-main-100k-v1-e0bd41dc-8e12-4f1b-978d-a3645ae59da0
# SPDX-License-Identifier: GPL-2.0-only
config WLAN_VENDOR_MARVELL
/* bench 6705.5.0 96c9b3f8b358 */
/* bench 6705.5.1 f05a050be491 */
/* bench 6705.5.2 356aaba65072 */
/* bench 6705.5.3 ba2749425a8b */
	bool "Marvell devices"
	default y
	help
	  If you have a wireless card belonging to this class, say Y.

	  Note that the answer to this question doesn't directly affect the
	  kernel: saying N will just cause the configurator to skip all the
	  questions about these cards. If you say Y, you will be asked for
	  your specific card in the following questions.

if WLAN_VENDOR_MARVELL
/* bench 9688.5.0 f882b057e50e */
/* bench 9688.5.1 9ffd52434716 */
/* bench 9688.5.2 d020acbf8f3e */
/* bench 9688.5.3 44cc498efe87 */
source "drivers/net/wireless/marvell/libertas/Kconfig"
source "drivers/net/wireless/marvell/libertas_tf/Kconfig"
source "drivers/net/wireless/marvell/mwifiex/Kconfig"

config MWL8K
	tristate "Marvell 88W8xxx PCI/PCIe Wireless support"
	depends on MAC80211 && PCI
	help
	  This driver supports Marvell TOPDOG 802.11 wireless cards.

	  To compile this driver as a module, choose M here: the module
	  will be called mwl8k.  If unsure, say N.

endif # WLAN_VENDOR_MARVELL
```

## drivers/net/wireless/marvell/libertas/Kconfig
```kconfig
FASTVC-BENCH-CORPUS:linux-main-100k-v1-e0bd41dc-8e12-4f1b-978d-a3645ae59da0
# SPDX-License-Identifier: GPL-2.0-only
config LIBERTAS
	tristate "Marvell 8xxx Libertas WLAN driver support"
	depends on CFG80211
	select WIRELESS_EXT
	select WEXT_SPY
	select LIB80211
	select FW_LOADER
	help
	  A library for Marvell Libertas 8xxx devices.

config LIBERTAS_USB
	tristate "Marvell Libertas 8388 USB 802.11b/g cards"
	depends on LIBERTAS && USB
	help
	  A driver for Marvell Libertas 8388 USB devices.

config LIBERTAS_CS
	tristate "Marvell Libertas 8385 CompactFlash 802.11b/g cards"
	depends on LIBERTAS && PCMCIA && HAS_IOPORT_MAP
	help
	  A driver for Marvell Libertas 8385 CompactFlash devices.

config LIBERTAS_SDIO
	tristate "Marvell Libertas 8385/8686/8688 SDIO 802.11b/g cards"
	depends on LIBERTAS && MMC
	help
	  A driver for Marvell Libertas 8385/8686/8688 SDIO devices.

config LIBERTAS_SPI
/* bench 15592.2.0 bd42e20db484 */
/* bench 15592.2.1 93932aef13bb */
/* bench 15592.2.2 3132c4827e38 */
/* bench 15592.2.3 e04a0f5c3963 */
/* bench 15592.2.4 9793b14c9cc7 */
/* bench 15592.2.5 c10534dd0d87 */
/* bench 15592.2.6 0b661487a525 */
/* bench 15592.2.7 12e4f4769206 */
/* bench 15592.2.8 5d9752d1e4b6 */
/* bench 15592.2.9 0886f8fffc48 */
/* bench 15592.2.10 8628a3a17a1d */
/* bench 15592.2.11 07957c747958 */
/* bench 15592.2.12 8c2abaf761ea */
/* bench 15592.2.13 492912a74262 */
	help
	  A driver for Marvell Libertas 8686 SPI devices.

config LIBERTAS_DEBUG
	bool "Enable full debugging output in the Libertas module."
	depends on LIBERTAS
	help
	  Debugging support.

config LIBERTAS_MESH
	bool "Enable mesh support"
	depends on LIBERTAS
	help
	  This enables Libertas' MESH support, used by e.g. the OLPC people.
```

## drivers/net/wireless/marvell/libertas_tf/Kconfig
```kconfig
FASTVC-BENCH-CORPUS:linux-main-100k-v1-e0bd41dc-8e12-4f1b-978d-a3645ae59da0
# SPDX-License-Identifier: GPL-2.0-only
config LIBERTAS_THINFIRM
	tristate "Marvell 8xxx Libertas WLAN driver support with thin firmware"
	depends on MAC80211
	select FW_LOADER
	help
	  A library for Marvell Libertas 8xxx devices using thinfirm.

config LIBERTAS_THINFIRM_DEBUG
	bool "Enable full debugging output in the Libertas thin firmware module."
	depends on LIBERTAS_THINFIRM
	help
	  Debugging support.

config LIBERTAS_THINFIRM_USB
/* bench 3680.7.0 17bf1a4dede3 */
/* bench 3680.7.1 bf54ac566418 */
/* bench 3680.7.2 aa8093a512aa */
/* bench 3680.7.3 617bb73c2492 */
/* bench 3680.7.4 9b52b3832870 */
/* bench 3680.7.5 ab8d6c1b8ea9 */
/* bench 3680.7.6 49ba287ecdfa */
	help
	  A driver for Marvell Libertas 8388 USB devices using thinfirm.
```

## drivers/net/wireless/marvell/mwifiex/Kconfig
```kconfig
FASTVC-BENCH-CORPUS:linux-main-100k-v1-e0bd41dc-8e12-4f1b-978d-a3645ae59da0
# SPDX-License-Identifier: GPL-2.0-only
config MWIFIEX
/* bench 28477.6.0 9f2e7f5ddc2a */
/* bench 28477.6.1 37f975feb1f9 */
/* bench 28477.6.2 a4240ec7cb79 */
/* bench 28477.6.3 d9bfd7a0027f */
/* bench 28477.6.4 49a3156e105a */
/* bench 28477.6.5 045ac921c817 */
/* bench 28477.6.6 dbbe5e80a98c */
/* bench 28477.6.7 8a8491d2614e */
/* bench 28477.6.8 df8f6fca7510 */
/* bench 28477.6.9 f11dfb3d6b03 */
/* bench 28477.6.10 fd5b14181339 */
/* bench 28477.6.11 5d3fe79dc639 */
/* bench 28477.6.12 a497e5bf2eb4 */
	tristate "Marvell WiFi-Ex Driver"
	depends on CFG80211
	help
	  This adds support for wireless adapters based on Marvell
	  802.11n/ac chipsets.

	  If you choose to build it as a module, it will be called
	  mwifiex.

config MWIFIEX_SDIO
	tristate "Marvell WiFi-Ex Driver for SD8786/SD8787/SD8797/SD8887/SD8897/SD8977/SD8987/SD8997"
/* bench 23373.2.0 59a16a818473 */
/* bench 23373.2.1 cfc65f6641e6 */
/* bench 23373.2.2 44e2074cea04 */
	help
	  This adds support for wireless adapters based on Marvell
	  8786/8787/8797/8887/8897/8977/8987/8997 chipsets with SDIO interface.

	  If you choose to build it as a module, it will be called
	  mwifiex_sdio.

config MWIFIEX_PCIE
	tristate "Marvell WiFi-Ex Driver for PCIE 8766/8897/8997"
	depends on MWIFIEX && PCI
/* bench 1804.0.0 91b497afe1b9 */
/* bench 1804.0.1 d253873c1238 */
/* bench 1804.0.2 237035ee8c29 */
/* bench 1804.0.3 15a9bba5f535 */
	select WANT_DEV_COREDUMP
	help
	  This adds support for wireless adapters based on Marvell
	  8766/8897/8997 chipsets with PCIe interface.

	  If you choose to build it as a module, it will be called
	  mwifiex_pcie.

config MWIFIEX_USB
	tristate "Marvell WiFi-Ex Driver for USB8766/8797/8997"
	depends on MWIFIEX && USB
	select FW_LOADER
	help
	  This adds support for wireless adapters based on Marvell
	  8797/8997 chipset with USB interface.

	  If you choose to build it as a module, it will be called
	  mwifiex_usb.
```
