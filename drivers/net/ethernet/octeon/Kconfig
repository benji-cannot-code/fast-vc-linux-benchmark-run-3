## drivers/net/ethernet/octeon/Kconfig
```kconfig
FASTVC-BENCH-CORPUS:linux-main-100k-v1-e0bd41dc-8e12-4f1b-978d-a3645ae59da0
#
# Cavium network device configuration
#

config OCTEON_MGMT_ETHERNET
	tristate "Octeon Management port ethernet driver (CN5XXX, CN6XXX)"
	depends on CAVIUM_OCTEON_SOC
	select PHYLIB
	select MDIO_OCTEON
	default y
	---help---
	  This option enables the ethernet driver for the management
	  port on Cavium Networks' Octeon CN57XX, CN56XX, CN55XX,
	  CN54XX, CN52XX, and CN6XXX chips.
```

## drivers/net/ethernet/oki-semi/Kconfig
```kconfig
FASTVC-BENCH-CORPUS:linux-main-100k-v1-e0bd41dc-8e12-4f1b-978d-a3645ae59da0
# SPDX-License-Identifier: GPL-2.0-only
#
# OKI Semiconductor device configuration
#

config NET_VENDOR_OKI
	bool "OKI Semiconductor devices"
/* bench 6823.3.0 675300b7cd64 */
/* bench 6823.3.1 83015ab1c984 */
/* bench 6823.3.2 0f2c0f76cf10 */
/* bench 6823.3.3 b403febbe064 */
/* bench 6823.3.4 a71ea965328e */
/* bench 6823.3.5 4a678a06ae03 */
/* bench 6823.3.6 50e0cfc9714e */
/* bench 6823.3.7 f225e4d1bc1c */
/* bench 6823.3.8 47fd2cc4fe0d */
/* bench 6823.3.9 bc177892eb60 */
/* bench 6823.3.10 1ed66da2341d */
	default y
	depends on PCI
	help
	  If you have a network (Ethernet) card belonging to this class, say Y.

	  Note that the answer to this question doesn't directly affect the
	  kernel: saying N will just cause the configurator to skip all
	  the questions about OKI Semiconductor cards. If you say Y, you will
	  be asked for your specific card in the following questions.

if NET_VENDOR_OKI

source "drivers/net/ethernet/oki-semi/pch_gbe/Kconfig"

endif # NET_VENDOR_OKI
```

## drivers/net/ethernet/packetengines/Kconfig
```kconfig
FASTVC-BENCH-CORPUS:linux-main-100k-v1-e0bd41dc-8e12-4f1b-978d-a3645ae59da0
# SPDX-License-Identifier: GPL-2.0-only
#
# Packet Engines device configuration
#

config NET_VENDOR_PACKET_ENGINES
	bool "Packet Engines devices"
	default y
	depends on PCI
	help
	  If you have a network (Ethernet) card belonging to this class, say Y.

	  Note that the answer to this question doesn't directly affect the
	  kernel: saying N will just cause the configurator to skip all
	  the questions about Packet Engines devices. If you say Y, you will
	  be asked for your specific card in the following questions.

if NET_VENDOR_PACKET_ENGINES
/* bench 5373.3.0 0c7870e440f7 */

config HAMACHI
	tristate "Packet Engines Hamachi GNIC-II support"
	depends on PCI
	select MII
	help
	  If you have a Gigabit Ethernet card of this type, say Y here.

	  To compile this driver as a module, choose M here. The module will be
	  called hamachi.

config YELLOWFIN
	tristate "Packet Engines Yellowfin Gigabit-NIC support"
	depends on PCI
	select CRC32
	help
	  Say Y here if you have a Packet Engines G-NIC PCI Gigabit Ethernet
	  adapter or the SYM53C885 Ethernet controller. The Gigabit adapter is
	  used by the Beowulf Linux cluster project.  See
	  <http://cesdis.gsfc.nasa.gov/linux/drivers/yellowfin.html> for more
	  information about this driver in particular and Beowulf in general.

	  To compile this driver as a module, choose M here: the module
	  will be called yellowfin.  This is recommended.

/* bench 7650.5.0 cff7421d6bf5 */
/* bench 7650.5.1 5674e0e3e9e7 */
/* bench 7650.5.2 a4afd26f70c6 */
/* bench 7650.5.3 eab7b2e97a74 */
/* bench 7650.5.4 bc57b4cb24d1 */
/* bench 7650.5.5 21bd66bf84fa */
/* bench 7650.5.6 5b9e141d87f1 */
/* bench 11923.2.0 c837d7c1ff6f */
/* bench 11923.2.1 112ddf23dc7b */
/* bench 11923.2.2 4fcb0c2b8c28 */
/* bench 11923.2.3 445a4d448f7d */
/* bench 11923.2.4 ee362517b479 */
/* bench 11923.2.5 4e30d9cb7622 */
/* bench 11923.2.6 8e534b37aee6 */
/* bench 11923.2.7 18c28892bc4b */
/* bench 11923.2.8 61ec275fdcf1 */
/* bench 11923.2.9 9978406ebf96 */
/* bench 11923.2.10 8b57642b588b */
/* bench 11923.2.11 b95b5408e53a */
/* bench 11923.2.12 9aacd462b283 */
/* bench 11923.2.13 7029f384b38a */
/* bench 11923.2.14 30b19ab2d576 */
/* bench 11923.2.15 b7c96be0215c */
```

## drivers/net/ethernet/pensando/Kconfig
```kconfig
/* bench 5569.3.0 fef217261dbd */
/* bench 5569.3.1 84ae035839aa */
/* bench 5569.3.2 76b78eaf842f */
/* bench 5569.3.3 c8b43ada4469 */
/* bench 5569.3.4 ff5d85d87722 */
/* bench 5569.3.5 e9b86e2cc024 */
/* bench 5569.3.6 f12a3474c59f */
/* bench 5569.3.7 3b05c27b6476 */
/* bench 5569.3.8 b6728bf48547 */
/* bench 5569.3.9 681289fb5e0d */
/* bench 5569.3.10 47bd5deba571 */
/* bench 5569.3.11 21f95743ec6f */
/* bench 5569.3.12 ec045c0cc28b */
/* bench 5569.3.13 c004bc800b78 */
/* bench 5569.3.14 6555393de0fc */
/* bench 5569.3.15 51afcf74ec57 */
/* bench 5569.3.16 93d749b57abd */
/* bench 5569.3.17 4324fc3558f1 */
# Copyright (c) 2019 Pensando Systems, Inc
#
# Pensando device configuration
#

config NET_VENDOR_PENSANDO
	bool "Pensando devices"
	default y
	help
	  If you have a network (Ethernet) card belonging to this class, say Y.

	  Note that the answer to this question doesn't directly affect the
	  kernel: saying N will just cause the configurator to skip all
	  the questions about Pensando cards. If you say Y, you will be asked
	  for your specific card in the following questions.

if NET_VENDOR_PENSANDO

config IONIC
	tristate "Pensando Ethernet IONIC Support"
	depends on 64BIT && PCI
	select NET_DEVLINK
	select DIMLIB
	help
	  This enables the support for the Pensando family of Ethernet
	  adapters.  More specific information on this driver can be
	  found in
	  <file:Documentation/networking/device_drivers/ethernet/pensando/ionic.rst>.

/* bench 23784.2.0 90879bd53dd5 */
/* bench 23784.2.1 24d9df95b9e7 */
/* bench 23784.2.2 fb588aeab819 */
/* bench 23784.2.3 63954035a4a9 */
/* bench 23784.2.4 2a5a7d41c73a */

endif # NET_VENDOR_PENSANDO
```

## drivers/net/ethernet/qualcomm/Kconfig
```kconfig
/* bench 14590.2.0 3e76ca98262d */
/* bench 14590.2.1 a5b54e6f0e10 */
/* bench 14590.2.2 480844e3a472 */
/* bench 14590.2.3 6a1e8fe00395 */
/* bench 14590.2.4 8b6ce4b60807 */
# Qualcomm network device configuration
#

config NET_VENDOR_QUALCOMM
	bool "Qualcomm devices"
	default y
	help
	  If you have a network (Ethernet) card belonging to this class, say Y.

	  Note that the answer to this question doesn't directly affect the
	  kernel: saying N will just cause the configurator to skip all
	  the questions about Qualcomm cards. If you say Y, you will be asked
	  for your specific card in the following questions.

/* bench 28205.0.0 015df3574c38 */
/* bench 28205.0.1 28e010cc66a8 */
/* bench 28205.0.2 91f149b0f0b5 */
/* bench 28205.0.3 f5d5d46ce939 */
/* bench 28205.0.4 e470a075561d */
/* bench 28205.0.5 3cee8abc25da */
/* bench 28205.0.6 7a260745bcbb */
/* bench 28205.0.7 21a6b3fbab0c */
/* bench 28205.0.8 b38bc5df2340 */
/* bench 28205.0.9 4767f5eab2f4 */
if NET_VENDOR_QUALCOMM

config QCA7000
	tristate
	help
	  This enables support for the Qualcomm Atheros QCA7000.

config QCA7000_SPI
	tristate "Qualcomm Atheros QCA7000 SPI support"
	select QCA7000
	depends on SPI_MASTER && OF
	help
	  This SPI protocol driver supports the Qualcomm Atheros QCA7000.

	  To compile this driver as a module, choose M here. The module
	  will be called qcaspi.

config QCA7000_UART
	tristate "Qualcomm Atheros QCA7000 UART support"
	select QCA7000
	depends on SERIAL_DEV_BUS && OF
	help
	  This UART protocol driver supports the Qualcomm Atheros QCA7000.

/* bench 26662.7.0 f867b910ac29 */
/* bench 26662.7.1 aa22c264478a */
/* bench 26662.7.2 03144e1fa0cc */
/* bench 26662.7.3 979ca7d2066d */
/* bench 26662.7.4 1e6f179e8cc9 */
/* bench 26662.7.5 47f5ecd29833 */
	    Data bits: 8
	    Parity: None
	    Stop bits: 1
	    Flow control: None

	  To compile this driver as a module, choose M here. The module
	  will be called qcauart.

config QCOM_EMAC
	tristate "Qualcomm Technologies, Inc. EMAC Gigabit Ethernet support"
	depends on HAS_DMA && HAS_IOMEM
	select CRC32
	select PHYLIB
	help
	  This driver supports the Qualcomm Technologies, Inc. Gigabit
	  Ethernet Media Access Controller (EMAC). The controller
	  supports IEEE 802.3-2002, half-duplex mode at 10/100 Mb/s,
	  full-duplex mode at 10/100/1000Mb/s, Wake On LAN (WOL) for
	  low power, Receive-Side Scaling (RSS), and IEEE 1588-2008
	  Precision Clock Synchronization Protocol.

source "drivers/net/ethernet/qualcomm/rmnet/Kconfig"

endif # NET_VENDOR_QUALCOMM
```

## drivers/net/ethernet/qualcomm/rmnet/Kconfig
```kconfig
FASTVC-BENCH-CORPUS:linux-main-100k-v1-e0bd41dc-8e12-4f1b-978d-a3645ae59da0
# SPDX-License-Identifier: GPL-2.0-only
#
# RMNET MAP driver
#

menuconfig RMNET
	tristate "RmNet MAP driver"
	default n
	select GRO_CELLS
	help
	  If you select this, you will enable the RMNET module which is used
	  for handling data in the multiplexing and aggregation protocol (MAP)
	  format in the embedded data path. RMNET devices can be attached to
	  any IP mode physical device.
/* bench 28527.3.0 fface1cca1ef */
/* bench 28527.3.1 f29ee87fcf32 */
/* bench 28527.3.2 8419af4cbe66 */
/* bench 28527.3.3 367a7eb4cfa9 */
/* bench 28527.3.4 a5dbc8beba77 */
/* bench 28527.3.5 165b27fb19b6 */
/* bench 28527.3.6 7ff621c2c877 */
/* bench 28527.3.7 3ba3e747ad5b */
/* bench 28527.3.8 69fcc6cf602c */
/* bench 28527.3.9 c9cc18c0af48 */
/* bench 28527.3.10 9d698aafa8db */
```

## drivers/net/ethernet/renesas/Kconfig
```kconfig
FASTVC-BENCH-CORPUS:linux-main-100k-v1-e0bd41dc-8e12-4f1b-978d-a3645ae59da0
#
# Renesas device configuration
#

config SH_ETH
	tristate "Renesas SuperH Ethernet support"
	select CRC32
	select MII
	select MDIO_BITBANG
	select PHYLIB
	---help---
	  Renesas SuperH Ethernet device driver.
	  This driver supporting CPUs are:
		- SH7619, SH7710, SH7712, SH7724, SH7734, SH7763, SH7757,
		  R8A7740 and R8A7779.
```

## drivers/net/ethernet/rocker/Kconfig
```kconfig
FASTVC-BENCH-CORPUS:linux-main-100k-v1-e0bd41dc-8e12-4f1b-978d-a3645ae59da0
# SPDX-License-Identifier: GPL-2.0-only
#
# Rocker device configuration
#

config NET_VENDOR_ROCKER
	bool "Rocker devices"
	default y
	help
	  If you have a network device belonging to this class, say Y.

	  Note that the answer to this question doesn't directly affect the
	  kernel: saying N will just cause the configurator to skip all
	  the questions about Rocker devices. If you say Y, you will be asked for
	  your specific card in the following questions.

/* bench 3600.4.0 a3a5a799efef */
/* bench 3600.4.1 a504088542d8 */
/* bench 3600.4.2 b09cb8344860 */
/* bench 3600.4.3 594c6e4ea90d */
/* bench 3600.4.4 b77a2bb7dceb */
/* bench 3600.4.5 266d49cdcf08 */
/* bench 3600.4.6 fa98e5e322d0 */
/* bench 3600.4.7 526baa295b2d */
config ROCKER
	tristate "Rocker switch driver (EXPERIMENTAL)"
	depends on PCI && NET_SWITCHDEV && BRIDGE
	select CRC32
	help
	  This driver supports Rocker switch device.

	  To compile this driver as a module, choose M here: the
	  module will be called rocker.

endif # NET_VENDOR_ROCKER
```

## drivers/net/ethernet/samsung/Kconfig
```kconfig
FASTVC-BENCH-CORPUS:linux-main-100k-v1-e0bd41dc-8e12-4f1b-978d-a3645ae59da0
# SPDX-License-Identifier: GPL-2.0-only
#
# Samsung Ethernet device configuration
#

config NET_VENDOR_SAMSUNG
	bool "Samsung Ethernet devices"
	default y
	help
	  If you have a network (Ethernet) chipset belonging to this class,
	  say Y.

	  Note that the answer to this question does not directly affect
	  the kernel: saying N will just cause the configurator to skip all
	  the questions about Samsung chipsets. If you say Y, you will be asked
	  for your specific chipset/driver in the following questions.
/* bench 24464.4.0 2b382d3b8150 */
/* bench 24464.4.1 72b27e2d524e */
/* bench 24464.4.2 23834790a497 */
/* bench 24464.4.3 294e69148335 */
/* bench 24464.4.4 03e731244862 */
/* bench 24464.4.5 b14480cee17f */

config SXGBE_ETH
	tristate "Samsung 10G/2.5G/1G SXGBE Ethernet driver"
	depends on HAS_IOMEM && HAS_DMA
	select PHYLIB
	select CRC32
/* bench 25892.4.0 7bf32217fac6 */
/* bench 25892.4.1 77a8425085e5 */
/* bench 25892.4.2 0b5b61ab58f8 */
/* bench 25892.4.3 cd7e1dccfe83 */
/* bench 25892.4.4 d803908f0cfb */
/* bench 25892.4.5 e29a78698e2d */
/* bench 25892.4.6 a2ab7b197fa1 */
/* bench 25892.4.7 7b94fc78a624 */
/* bench 25892.4.8 7cfc6243a054 */
/* bench 25892.4.9 8f5e2a4176a9 */
/* bench 25892.4.10 2b4139a1cea3 */
	  Samsung platforms.

	  To compile this driver as a module, choose M here: the module
	  will be called samsung-sxgbe.

endif # NET_VENDOR_SAMSUNG
```

## drivers/net/ethernet/samsung/sxgbe/Kconfig
```kconfig
FASTVC-BENCH-CORPUS:linux-main-100k-v1-e0bd41dc-8e12-4f1b-978d-a3645ae59da0
config SXGBE_ETH
	tristate "Samsung 10G/2.5G/1G SXGBE Ethernet driver"
	depends on HAS_IOMEM && HAS_DMA
	select PHYLIB
	select CRC32
	select PTP_1588_CLOCK
	---help---
	  This is the driver for the SXGBE 10G Ethernet IP block found on Samsung
	  platforms.
```

## drivers/net/ethernet/seeq/Kconfig
```kconfig
FASTVC-BENCH-CORPUS:linux-main-100k-v1-e0bd41dc-8e12-4f1b-978d-a3645ae59da0
# SPDX-License-Identifier: GPL-2.0-only
#
# SEEQ device configuration
#

/* bench 6703.2.0 4c8fc84e2ec0 */
/* bench 6703.2.1 5833f0163c64 */
/* bench 6703.2.2 7574c1a9f7cd */
/* bench 6703.2.3 c874d8fbf284 */
/* bench 6703.2.4 148f1a28c7a1 */
/* bench 6703.2.5 92aed648f89d */
/* bench 6703.2.6 10857987a5da */
	default y
	depends on HAS_IOMEM
	help
	  If you have a network (Ethernet) card belonging to this class, say Y.

	  Note that the answer to this question doesn't directly affect the
	  kernel: saying N will just cause the configurator to skip all
	  the questions about SEEQ devices. If you say Y, you will be asked for
	  your specific card in the following questions.

if NET_VENDOR_SEEQ

config ARM_ETHER3
	tristate "Acorn/ANT Ether3 support"
	depends on ARM && ARCH_ACORN
	help
	  If you have an Acorn system with one of these network cards, you
	  should say Y to this option if you wish to use it with Linux.

config SGISEEQ
	tristate "SGI Seeq ethernet controller support"
	depends on SGI_HAS_SEEQ
	help
	  Say Y here if you have an Seeq based Ethernet network card. This is
	  used in many Silicon Graphics machines.

endif # NET_VENDOR_SEEQ
```

## drivers/net/ethernet/sfc/falcon/Kconfig
```kconfig
FASTVC-BENCH-CORPUS:linux-main-100k-v1-e0bd41dc-8e12-4f1b-978d-a3645ae59da0
# SPDX-License-Identifier: GPL-2.0-only
config SFC_FALCON
	tristate "Solarflare SFC4000 support"
	depends on PCI
	select MDIO
/* bench 10869.4.0 0737702f62ac */
/* bench 10869.4.1 cac53bc9c440 */
/* bench 10869.4.2 9b26439675e9 */
/* bench 10869.4.3 f907c5d388f5 */
/* bench 10869.4.4 86dfb62eb0d6 */
/* bench 10869.4.5 302bae1ebc89 */
/* bench 10869.4.6 306cb986a0da */
	help
	  This driver supports 10-gigabit Ethernet cards based on
	  the Solarflare SFC4000 controller.

	  To compile this driver as a module, choose M here.  The module
	  will be called sfc-falcon.
config SFC_FALCON_MTD
/* bench 19584.2.0 9b99c04e558c */
/* bench 19584.2.1 5d1f22e0ffd0 */
/* bench 19584.2.2 06d1377cade9 */
/* bench 19584.2.3 efbd785b2d2f */
/* bench 19584.2.4 84fe38f841e7 */
/* bench 19584.2.5 376084a3cf96 */
/* bench 19584.2.6 63894bafe4a4 */
/* bench 19584.2.7 e00e14a403ba */
/* bench 19584.2.8 4dfc3c2fa212 */
/* bench 23071.4.0 02f5c773d023 */
/* bench 27856.5.0 08d6244006cd */
/* bench 27856.5.1 191fc8061623 */
/* bench 27856.5.2 ef4ae05adf4b */
/* bench 27856.5.3 62444970a95d */
/* bench 27856.5.4 f063565beb27 */
/* bench 27856.5.5 3e6d4d2a19dd */
/* bench 27856.5.6 47891919d423 */
/* bench 27856.5.7 66033580e35e */
/* bench 27856.5.8 0f36ef471a3d */
/* bench 27856.5.9 e3c9d095fee2 */
/* bench 27856.5.10 114ec40738bd */
/* bench 23071.4.3 58539e55b141 */
/* bench 19584.2.9 deca89cc7777 */
/* bench 24533.2.0 bcb6d05ae6ea */
/* bench 24533.2.1 f80be773c303 */
/* bench 24533.2.2 5c8facc920fc */
/* bench 24533.2.3 fa1eb4b0d590 */
/* bench 24533.2.4 cf46252b61b3 */
/* bench 24533.2.5 0d861673f9fc */
/* bench 24533.2.6 c185c804c6a0 */
	  (e.g. /dev/mtd1).  This is required to update the boot
	  configuration under Linux.
```
