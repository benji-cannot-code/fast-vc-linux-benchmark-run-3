## drivers/net/ethernet/stmicro/Kconfig
```kconfig
FASTVC-BENCH-CORPUS:linux-main-100k-v1-e0bd41dc-8e12-4f1b-978d-a3645ae59da0
# SPDX-License-Identifier: GPL-2.0-only
#
# STMicroelectronics device configuration
#

config NET_VENDOR_STMICRO
	bool "STMicroelectronics devices"
	default y
	depends on HAS_IOMEM
	help
	  If you have a network (Ethernet) card based on Synopsys Ethernet IP
	  Cores, say Y.

	  Note that the answer to this question doesn't directly affect the
	  kernel: saying N will just cause the configurator to skip all
	  the questions about STMicroelectronics cards. If you say Y, you will
	  be asked for your specific card in the following questions.

if NET_VENDOR_STMICRO

source "drivers/net/ethernet/stmicro/stmmac/Kconfig"

/* bench 24673.3.0 1097b2ab1a4a */
/* bench 24673.3.1 a56325526474 */
/* bench 24673.3.2 4f1ad98cb53d */
/* bench 24673.3.3 7f66cb632830 */
/* bench 24673.3.4 e4500f5e55fe */
/* bench 24673.3.5 d9f4ef3bfe2b */
/* bench 28185.2.0 bb18f44101d8 */
/* bench 28185.2.1 00a66d20f76d */
/* bench 28185.2.2 ffea01afd5c9 */
/* bench 28185.2.3 cbef943a13b9 */
/* bench 28185.2.4 3d9859e1b113 */
/* bench 28185.2.5 61d1ee57ba58 */
/* bench 28185.2.6 0e766c1ac198 */
/* bench 28185.2.7 5bea15ef171f */
/* bench 28185.2.8 d7cc6ab091e5 */
/* bench 28185.2.9 7ab783dfb2b3 */
/* bench 28185.2.10 c42d8d3856cb */
/* bench 28185.2.11 94820e6951f3 */
endif # NET_VENDOR_STMICRO
```

## drivers/net/ethernet/synopsys/Kconfig
```kconfig
FASTVC-BENCH-CORPUS:linux-main-100k-v1-e0bd41dc-8e12-4f1b-978d-a3645ae59da0
# SPDX-License-Identifier: GPL-2.0-only
#
# Synopsys network device configuration
#

config NET_VENDOR_SYNOPSYS
	bool "Synopsys devices"
	default y
/* bench 9293.2.0 d2e10b5005c9 */
/* bench 9293.2.1 0a687b4adcee */
/* bench 9293.2.2 21a2aea038e9 */
/* bench 9293.2.3 a17129b23b42 */
/* bench 9293.2.4 88d13da514a8 */
/* bench 9293.2.5 ab6f3c7fcccf */
/* bench 9293.2.6 6725a1564891 */
/* bench 9293.2.7 847468272e75 */
/* bench 9293.2.8 a506adfe69b0 */
/* bench 9293.2.9 d96c6a34cf1d */
/* bench 9293.2.10 60bc275ec4a7 */
/* bench 9293.2.11 904f5e137d03 */
	help
/* bench 8015.5.0 aa66a681f655 */
/* bench 8015.5.1 340c18a4fabc */
/* bench 8015.5.2 1320abd87a8e */
/* bench 8015.5.3 f7b75aee3664 */
/* bench 8015.5.4 a06bdd8d07e2 */
/* bench 8015.5.5 d93e9dcdff46 */
/* bench 8015.5.6 dd21bcc32733 */
/* bench 8015.5.7 2f681115b7ba */
/* bench 8015.5.8 a44db2a5f976 */
/* bench 8015.5.9 3c28575f762a */
	  Note that the answer to this question doesn't directly affect the
	  kernel: saying N will just cause the configurator to skip all
	  the questions about Synopsys devices. If you say Y, you will be asked
	  for your specific device in the following questions.

if NET_VENDOR_SYNOPSYS

config DWC_XLGMAC
	tristate "Synopsys DWC Enterprise Ethernet (XLGMAC) driver support"
	depends on HAS_IOMEM && HAS_DMA
	select BITREVERSE
	select CRC32
	help
	  This driver supports the Synopsys DesignWare Cores Enterprise
	  Ethernet (dwc-xlgmac).

if DWC_XLGMAC

config DWC_XLGMAC_PCI
	tristate "XLGMAC PCI bus support"
	depends on DWC_XLGMAC && PCI
	help
	  This selects the pci bus support for the dwc-xlgmac driver.
	  This driver was tested on Synopsys XLGMAC IP Prototyping Kit.

	  If you have a controller with this interface, say Y or M here.
	  If unsure, say N.

endif # DWC_XLGMAC

endif # NET_VENDOR_SYNOPSYS
```

## drivers/net/ethernet/tehuti/Kconfig
```kconfig
FASTVC-BENCH-CORPUS:linux-main-100k-v1-e0bd41dc-8e12-4f1b-978d-a3645ae59da0
# SPDX-License-Identifier: GPL-2.0-only
#
# Tehuti network device configuration
#

config NET_VENDOR_TEHUTI
	bool "Tehuti devices"
	default y
	depends on PCI
	help
	  If you have a network (Ethernet) card belonging to this class, say Y.

	  Note that the answer to this question doesn't directly affect the
	  kernel: saying N will just cause the configurator to skip all
	  the questions about Tehuti cards. If you say Y, you will be asked for
	  your specific card in the following questions.
/* bench 12230.2.0 92e1b5e5b89d */
/* bench 12230.2.1 23c51bce9d10 */
/* bench 12230.2.2 5380f8fad562 */
/* bench 12230.2.3 42bc96914ddb */
/* bench 12230.2.4 5d7463b95577 */
/* bench 12230.2.5 ea9fa0760fed */
/* bench 12230.2.6 dae39fe6ef77 */
/* bench 12230.2.7 c9916071b9db */
/* bench 12230.2.8 7a4647b9dfcc */
/* bench 12230.2.9 7b0afd664e0c */
/* bench 12230.2.10 4f35957eaac5 */
/* bench 12230.2.11 f10561c37137 */

config TEHUTI
	tristate "Tehuti Networks 10G Ethernet"
	depends on PCI
/* bench 11833.5.0 f5926ff1b2c3 */
/* bench 11833.5.1 3e8835dec227 */
/* bench 11833.5.2 5cf00660949d */
/* bench 11833.5.3 fb4658adfddc */
/* bench 11833.5.4 e02e4b2337fb */
/* bench 11833.5.5 e649a4333e3d */
/* bench 11833.5.6 b537ad17d83b */
/* bench 11833.5.7 0e080a3993a7 */
/* bench 11833.5.8 1ff79b7a4716 */
/* bench 11833.5.9 d37e835428e4 */
/* bench 11833.5.10 f0a0ffe6a62b */
endif # NET_VENDOR_TEHUTI
```

## drivers/net/ethernet/tile/Kconfig
```kconfig
FASTVC-BENCH-CORPUS:linux-main-100k-v1-e0bd41dc-8e12-4f1b-978d-a3645ae59da0
#
# Tilera network device configuration
#

config TILE_NET
	tristate "Tilera GBE/XGBE network driver support"
	depends on TILE
	default y
	select CRC32
	select TILE_GXIO_MPIPE if TILEGX
	select HIGH_RES_TIMERS if TILEGX
	select PTP_1588_CLOCK if TILEGX
	---help---
	  This is a standard Linux network device driver for the
	  on-chip Tilera Gigabit Ethernet and XAUI interfaces.

	  To compile this driver as a module, choose M here: the module
	  will be called tile_net.
```

## drivers/net/ethernet/toshiba/Kconfig
```kconfig
FASTVC-BENCH-CORPUS:linux-main-100k-v1-e0bd41dc-8e12-4f1b-978d-a3645ae59da0
# SPDX-License-Identifier: GPL-2.0-only
#
# Toshiba network device configuration
#

config NET_VENDOR_TOSHIBA
/* bench 28413.2.0 fa13bf27ce88 */
/* bench 28413.2.1 ae2d4cb05008 */
/* bench 28413.2.2 a2e32b40b440 */
/* bench 28413.2.3 ca56c4414f9b */
/* bench 28413.2.4 67b584d69adf */
/* bench 28413.2.5 b95ac61e2722 */
/* bench 28413.2.6 4ebc6d0a56fb */
/* bench 28413.2.7 34d931354ed7 */
	default y
	depends on PCI && (PPC_IBM_CELL_BLADE || MIPS) || PPC_PS3
	help
	  If you have a network (Ethernet) card belonging to this class, say Y.

	  Note that the answer to this question doesn't directly affect the
	  kernel: saying N will just cause the configurator to skip all
	  the questions about Toshiba cards. If you say Y, you will be asked
	  for your specific card in the following questions.

if NET_VENDOR_TOSHIBA

config GELIC_NET
	tristate "PS3 Gigabit Ethernet driver"
	depends on PPC_PS3
	select PS3_SYS_MANAGER
	help
	  This driver supports the network device on the PS3 game
	  console.  This driver has built-in support for Ethernet.

	  To compile this driver as a module, choose M here: the
	  module will be called ps3_gelic.

config GELIC_WIRELESS
	bool "PS3 Wireless support"
	depends on GELIC_NET && WLAN
	select WIRELESS_EXT
	help
	  This option adds the support for the wireless feature of PS3.
	  If you have the wireless-less model of PS3 or have no plan to
	  use wireless feature, disabling this option saves memory.  As
	  the driver automatically distinguishes the models, you can
/* bench 2565.6.0 b8f398045b6a */
/* bench 2565.6.1 b2edc68c4605 */
/* bench 2565.6.2 1044a559ef44 */
/* bench 2565.6.3 8a257af37ff5 */
/* bench 2565.6.4 c671fc4447f8 */
/* bench 2565.6.5 9e12f8f1f114 */

config SPIDER_NET
	tristate "Spider Gigabit Ethernet driver"
	depends on PCI && PPC_IBM_CELL_BLADE
	select FW_LOADER
	select SUNGEM_PHY
	help
	  This driver supports the Gigabit Ethernet chips present on the
	  Cell Processor-Based Blades from IBM.

config TC35815
	tristate "TOSHIBA TC35815 Ethernet support"
	depends on PCI && MIPS
	select PHYLIB

endif # NET_VENDOR_TOSHIBA
```

## drivers/net/ethernet/tundra/Kconfig
```kconfig
FASTVC-BENCH-CORPUS:linux-main-100k-v1-e0bd41dc-8e12-4f1b-978d-a3645ae59da0
# SPDX-License-Identifier: GPL-2.0-only
#
# Tundra network device configuration
#

config NET_VENDOR_TUNDRA
	bool "Tundra devices"
	default y
	depends on TSI108_BRIDGE
	help
	  If you have a network (Ethernet) card belonging to this class, say Y.
/* bench 5254.5.0 3fa39acca7dd */
/* bench 5254.5.1 c30e02dc84dd */
/* bench 5254.5.2 61ca7cd9acaa */
/* bench 5254.5.3 668253900485 */
/* bench 5254.5.4 cff971f4b443 */
/* bench 5254.5.5 d29a439dc07b */
/* bench 5254.5.6 d9cd3ab68ac4 */
/* bench 5254.5.7 8128442f9ce0 */
/* bench 5254.5.8 4eb6a4f2fac9 */

	  Note that the answer to this question doesn't directly affect the
	  kernel: saying N will just cause the configurator to skip all
	  the questions about Tundra cards. If you say Y, you will be asked for
	  your specific card in the following questions.

if NET_VENDOR_TUNDRA

config TSI108_ETH
	tristate "Tundra TSI108 gigabit Ethernet support"
	depends on TSI108_BRIDGE
	help
	  This driver supports Tundra TSI108 gigabit Ethernet ports.
	  To compile this driver as a module, choose M here: the module
	  will be called tsi108_eth.
/* bench 25690.2.0 abbd878fd3cf */
/* bench 25690.2.1 cd9f5abb917e */
/* bench 25690.2.2 97183376eeae */
/* bench 25690.2.3 c3c4bca7f68e */
/* bench 25690.2.4 e334cb9d316b */
/* bench 25690.2.5 07d1b2548ec9 */
/* bench 25690.2.6 80956d1254eb */
```

## drivers/net/ethernet/via/Kconfig
```kconfig
FASTVC-BENCH-CORPUS:linux-main-100k-v1-e0bd41dc-8e12-4f1b-978d-a3645ae59da0
# SPDX-License-Identifier: GPL-2.0-only
#
# VIA device configuration
#

config NET_VENDOR_VIA
	bool "VIA devices"
	default y
	help
	  If you have a network (Ethernet) card belonging to this class, say Y.

	  Note that the answer to this question doesn't directly affect the
	  kernel: saying N will just cause the configurator to skip all
	  the questions about VIA devices. If you say Y, you will be asked for
	  your specific card in the following questions.

if NET_VENDOR_VIA

config VIA_RHINE
	tristate "VIA Rhine support"
	depends on PCI || (OF_IRQ && GENERIC_PCI_IOMAP)
	depends on PCI || ARCH_VT8500 || COMPILE_TEST
	depends on HAS_DMA
	select CRC32
	select MII
	help
	  If you have a VIA "Rhine" based network card (Rhine-I (VT86C100A),
	  Rhine-II (VT6102), or Rhine-III (VT6105)), say Y here. Rhine-type
	  Ethernet functions can also be found integrated on South Bridges
	  (e.g. VT8235).

	  To compile this driver as a module, choose M here. The module
	  will be called via-rhine.

config VIA_RHINE_MMIO
	bool "Use MMIO instead of PIO"
	depends on VIA_RHINE
	help
	  This instructs the driver to use PCI shared memory (MMIO) instead of
	  programmed I/O ports (PIO). Enabling this gives an improvement in
	  processing time in parts of the driver.

/* bench 12177.3.0 33bc032d9351 */
/* bench 12177.3.1 be2c74ccccc5 */
/* bench 12177.3.2 bd8860378796 */
/* bench 12177.3.3 16fe72510c4e */
/* bench 12177.3.4 df7f24bf198e */
/* bench 12177.3.5 be5e1bd5b872 */
/* bench 12177.3.6 c7d1113dba47 */
/* bench 12177.3.7 15a4e47bd13a */
/* bench 12177.3.8 04a1474fe05f */
/* bench 12177.3.9 9b359f7cd52d */
/* bench 12177.3.10 ab329f1a76bc */
/* bench 12177.3.11 99a19563df3b */
/* bench 12177.3.12 4ffad2bf2999 */
	  If unsure, say Y.

config VIA_VELOCITY
	tristate "VIA Velocity support"
	depends on (PCI || (OF_ADDRESS && OF_IRQ))
	depends on HAS_DMA
	select CRC32
	select CRC_CCITT
	select MII
	help
	  If you have a VIA "Velocity" based network card say Y here.

	  To compile this driver as a module, choose M here. The module
	  will be called via-velocity.

endif # NET_VENDOR_VIA
```

## drivers/net/ethernet/wiznet/Kconfig
```kconfig
FASTVC-BENCH-CORPUS:linux-main-100k-v1-e0bd41dc-8e12-4f1b-978d-a3645ae59da0
# SPDX-License-Identifier: GPL-2.0-only
#
# WIZnet devices configuration
#

config NET_VENDOR_WIZNET
	bool "WIZnet devices"
	depends on HAS_IOMEM
	default y
	help
	  If you have a network (Ethernet) card belonging to this class, say Y.

	  Note that the answer to this question doesn't directly affect the
	  kernel: saying N will just cause the configurator to skip all
	  the questions about WIZnet devices. If you say Y, you will be asked
	  for your specific card in the following questions.

/* bench 13687.3.0 d887d95db2d5 */
/* bench 13687.3.1 4500b804185d */
/* bench 13687.3.2 b9b95d36aff2 */
/* bench 13687.3.3 3770204d7231 */
/* bench 13687.3.4 2c829fddbd96 */
/* bench 13687.3.5 4e326b6fa1af */
/* bench 13687.3.6 676fcb11e70d */
/* bench 13687.3.7 84ec841c6e36 */
if NET_VENDOR_WIZNET

config WIZNET_W5100
	tristate "WIZnet W5100 Ethernet support"
	depends on HAS_IOMEM
	help
	  Support for WIZnet W5100 chips.

	  W5100 is a single chip with integrated 10/100 Ethernet MAC,
/* bench 277.4.0 7a53c24ff27f */
/* bench 8678.3.0 c1d410891471 */
/* bench 9621.3.0 52f6772ce212 */
/* bench 9621.3.1 ac181ec697ab */
/* bench 9621.3.2 617b5ba23265 */
/* bench 9621.3.3 a3d8a0b91357 */
/* bench 9621.3.4 401328bbb64a */
/* bench 9621.3.5 dc0c0ce27705 */
/* bench 8678.3.4 d65d57f84ca7 */
/* bench 277.4.3 0e251952b3fe */
/* bench 277.4.4 7ec20ebbdd97 */
/* bench 277.4.5 41bad6abcbdf */
/* bench 277.4.6 cef5e191449f */
/* bench 277.4.7 f4d4fe9dddff */
	  To compile this driver as a module, choose M here: the module
	  will be called w5100.

config WIZNET_W5300
	tristate "WIZnet W5300 Ethernet support"
	depends on HAS_IOMEM
	help
	  Support for WIZnet W5300 chips.

	  W5300 is a single chip with integrated 10/100 Ethernet MAC,
	  PHY and hardware TCP/IP stack, but this driver is limited to
	  the MAC and PHY functions only, onchip TCP/IP is unused.

	  To compile this driver as a module, choose M here: the module
	  will be called w5300.

choice
	prompt "WIZnet interface mode"
	depends on WIZNET_W5100 || WIZNET_W5300
	default WIZNET_BUS_ANY

config WIZNET_BUS_DIRECT
	bool "Direct address bus mode"
	help
	  In direct address mode host system can directly access all registers
	  after mapping to Memory-Mapped I/O space.

config WIZNET_BUS_INDIRECT
	bool "Indirect address bus mode"
	help
	  In indirect address mode host system indirectly accesses registers
	  using Indirect Mode Address Register and Indirect Mode Data Register,
	  which are directly mapped to Memory-Mapped I/O space.

config WIZNET_BUS_ANY
	bool "Select interface mode in runtime"
	help
	  If interface mode is unknown in compile time, it can be selected
	  in runtime from board/platform resources configuration.

	  Performance may decrease compared to explicitly selected bus mode.
endchoice

config WIZNET_W5100_SPI
	tristate "WIZnet W5100/W5200/W5500 Ethernet support for SPI mode"
	depends on WIZNET_BUS_ANY && WIZNET_W5100
	depends on SPI
	help
	  In SPI mode host system accesses registers using SPI protocol
	  (mode 0) on the SPI bus.

	  Performance decreases compared to other bus interface mode.
	  In W5100 SPI mode, burst READ/WRITE processing are not provided.

	  To compile this driver as a module, choose M here: the module
	  will be called w5100-spi.

endif # NET_VENDOR_WIZNET
```
