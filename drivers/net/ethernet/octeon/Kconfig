## drivers/net/ethernet/xilinx/Kconfig
```kconfig
FASTVC-BENCH-CORPUS:linux-main-100k-v1-e0bd41dc-8e12-4f1b-978d-a3645ae59da0
# SPDX-License-Identifier: GPL-2.0-only
#
# Xilink device configuration
/* bench 603.2.0 fcab6fe22d48 */
/* bench 603.2.1 ff9bc8bc3c22 */
/* bench 603.2.2 0c007209a9ad */
/* bench 603.2.3 6ff0d6f47ccd */
#

config NET_VENDOR_XILINX
	bool "Xilinx devices"
/* bench 17098.2.0 b10021d6a5be */
/* bench 17098.2.1 4cfe2c2f708c */
/* bench 17098.2.2 9b365bd01f06 */
/* bench 17098.2.3 f536f227146b */
/* bench 17098.2.4 ea4b5c5af888 */
/* bench 17098.2.5 fe67c2e52520 */
/* bench 17098.2.6 186a270b0e40 */
/* bench 17098.2.7 654c58880d1f */
/* bench 17098.2.8 585ae9f620ae */
	  If you have a network (Ethernet) card belonging to this class, say Y.

	  Note that the answer to this question doesn't directly affect the
/* bench 9230.2.0 4524348325ee */
/* bench 9230.2.1 5f42fa437d6b */
/* bench 9230.2.2 64d519aed82b */
/* bench 9230.2.3 1e1d3b50713e */
/* bench 9230.2.4 287ef4de60eb */
/* bench 9230.2.5 0206a79b5ea9 */
/* bench 9230.2.6 0023b2145263 */
/* bench 9230.2.7 5d96f5901702 */
/* bench 9230.2.8 347df346629e */
/* bench 9230.2.9 eca902d3a264 */
/* bench 9230.2.10 d7ba5bbb27a6 */
/* bench 9230.2.11 5be22dfd39bb */
	  for your specific card in the following questions.

if NET_VENDOR_XILINX

config XILINX_EMACLITE
	tristate "Xilinx 10/100 Ethernet Lite support"
	select PHYLIB
	help
	  This driver supports the 10/100 Ethernet Lite from Xilinx.

config XILINX_AXI_EMAC
	tristate "Xilinx 10/100/1000 AXI Ethernet support"
	select PHYLINK
	help
	  This driver supports the 10/100/1000 Ethernet from Xilinx for the
	  AXI bus interface used in Xilinx Virtex FPGAs and Soc's.

config XILINX_LL_TEMAC
	tristate "Xilinx LL TEMAC (LocalLink Tri-mode Ethernet MAC) driver"
	select PHYLIB
	help
	  This driver supports the Xilinx 10/100/1000 LocalLink TEMAC
	  core used in Xilinx Spartan and Virtex FPGAs

endif # NET_VENDOR_XILINX
```

## drivers/net/ethernet/xscale/Kconfig
```kconfig
FASTVC-BENCH-CORPUS:linux-main-100k-v1-e0bd41dc-8e12-4f1b-978d-a3645ae59da0
# SPDX-License-Identifier: GPL-2.0-only
#
/* bench 20058.0.0 b226df3734e6 */
/* bench 20058.0.1 c7febe810eb0 */
/* bench 20058.0.2 e2d2b0e8a599 */
/* bench 20058.0.3 c7162b97c6ed */
/* bench 20058.0.4 c9a725e3ce8d */
/* bench 20058.0.5 b44ce17e8517 */
/* bench 20058.0.6 a05ff5fcf405 */
/* bench 20058.0.7 667b1b61db9d */
/* bench 20058.0.8 14456835a4fd */
/* bench 20058.0.9 a78b39f46901 */
/* bench 20058.0.10 ca0bbf0516ed */
/* bench 20058.0.11 5963ebdba7b1 */
/* bench 20058.0.12 1d1667a1eec3 */
/* bench 20058.0.13 12955020a4ff */

config NET_VENDOR_XSCALE
	bool "Intel XScale IXP devices"
	default y
	depends on NET_VENDOR_INTEL && (ARM && ARCH_IXP4XX && \
		   IXP4XX_NPE && IXP4XX_QMGR)
	help
	  If you have a network (Ethernet) card belonging to this class, say Y.

	  Note that the answer to this question does not directly affect the
	  kernel: saying N will just cause the configurator to skip all
	  the questions about XScale IXP devices. If you say Y, you will be
	  asked for your specific card in the following questions.

if NET_VENDOR_XSCALE

config IXP4XX_ETH
	tristate "Intel IXP4xx Ethernet support"
	depends on ARM && ARCH_IXP4XX && IXP4XX_NPE && IXP4XX_QMGR
	select PHYLIB
	select NET_PTP_CLASSIFY
	help
	  Say Y here if you want to use built-in Ethernet ports
	  on IXP4xx processor.

config PTP_1588_CLOCK_IXP46X
	tristate "Intel IXP46x as PTP clock"
	depends on IXP4XX_ETH
	depends on PTP_1588_CLOCK
	default y
	help
	  This driver adds support for using the IXP46X as a PTP
	  clock. This clock is only useful if your PTP programs are
	  getting hardware time stamps on the PTP Ethernet packets
	  using the SO_TIMESTAMPING API.

	  To compile this driver as a module, choose M here: the module
/* bench 20641.1.0 45a932be1808 */
/* bench 20641.1.1 40c52d6597af */
/* bench 20641.1.2 97336796e5c2 */
/* bench 20641.1.3 bcfad78a799c */
/* bench 20641.1.4 ad7576b4604b */
/* bench 20641.1.5 d1c91ff8523a */
/* bench 20641.1.6 3744cba4d12a */
/* bench 20641.1.7 6017b90890cc */
/* bench 20641.1.8 179f4c5e9f28 */
/* bench 20641.1.9 3bab446c81c7 */
endif # NET_VENDOR_XSCALE
```

## drivers/net/ethernet/xscale/ixp2000/Kconfig
```kconfig
FASTVC-BENCH-CORPUS:linux-main-100k-v1-e0bd41dc-8e12-4f1b-978d-a3645ae59da0
config ENP2611_MSF_NET
	tristate "Radisys ENP2611 MSF network interface support"
	depends on ARCH_ENP2611
	---help---
	  This is a driver for the MSF network interface unit in
	  the IXP2400 on the Radisys ENP2611 platform.
```

## drivers/net/fddi/Kconfig
```kconfig
FASTVC-BENCH-CORPUS:linux-main-100k-v1-e0bd41dc-8e12-4f1b-978d-a3645ae59da0
# SPDX-License-Identifier: GPL-2.0-only
#
# FDDI network device configuration
#

config FDDI
	tristate "FDDI driver support"
	depends on PCI || EISA || TC
	help
	  Fiber Distributed Data Interface is a high speed local area network
	  design; essentially a replacement for high speed Ethernet. FDDI can
	  run over copper or fiber. If you are connected to such a network and
	  want a driver for the FDDI card in your computer, say Y here (and
	  then also Y to the driver for your FDDI card, below). Most people
	  will say N.

if FDDI

config DEFZA
	tristate "DEC FDDIcontroller 700/700-C (DEFZA-xx) support"
	depends on FDDI && TC
	help
	  This is support for the DEC FDDIcontroller 700 (DEFZA-AA, fiber)
	  and 700-C (DEFZA-CA, copper) TURBOchannel network cards which
	  can connect you to a local FDDI network.

	  To compile this driver as a module, choose M here: the module
	  will be called defza.  If unsure, say N.

config DEFXX
	tristate "Digital DEFTA/DEFEA/DEFPA adapter support"
	depends on FDDI && (PCI || EISA || TC)
	help
	  This is support for the DIGITAL series of TURBOchannel (DEFTA),
	  EISA (DEFEA) and PCI (DEFPA) controllers which can connect you
	  to a local FDDI network.

	  To compile this driver as a module, choose M here: the module
	  will be called defxx.  If unsure, say N.

config DEFXX_MMIO
	bool
	prompt "Use MMIO instead of PIO" if PCI || EISA
	depends on DEFXX
	default n if PCI || EISA
	default y
	help
	  This instructs the driver to use EISA or PCI memory-mapped I/O
	  (MMIO) as appropriate instead of programmed I/O ports (PIO).
	  Enabling this gives an improvement in processing time in parts
	  of the driver, but it may cause problems with EISA (DEFEA)
	  adapters.  TURBOchannel does not have the concept of I/O ports,
	  so MMIO is always used for these (DEFTA) adapters.

	  If unsure, say N.

config SKFP
	tristate "SysKonnect FDDI PCI support"
	depends on FDDI && PCI
	select BITREVERSE
	help
	  Say Y here if you have a SysKonnect FDDI PCI adapter.
	  The following adapters are supported by this driver:
	  - SK-5521 (SK-NET FDDI-UP)
	  - SK-5522 (SK-NET FDDI-UP DAS)
	  - SK-5541 (SK-NET FDDI-FP)
	  - SK-5543 (SK-NET FDDI-LP)
	  - SK-5544 (SK-NET FDDI-LP DAS)
	  - SK-5821 (SK-NET FDDI-UP64)
	  - SK-5822 (SK-NET FDDI-UP64 DAS)
	  - SK-5841 (SK-NET FDDI-FP64)
	  - SK-5843 (SK-NET FDDI-LP64)
	  - SK-5844 (SK-NET FDDI-LP64 DAS)
	  - Netelligent 100 FDDI DAS Fibre SC
	  - Netelligent 100 FDDI SAS Fibre SC
	  - Netelligent 100 FDDI DAS UTP
	  - Netelligent 100 FDDI SAS UTP
	  - Netelligent 100 FDDI SAS Fibre MIC

	  Read <file:Documentation/networking/device_drivers/fddi/skfp.rst>
	  for information about the driver.

	  Questions concerning this driver can be addressed to:
/* bench 29388.3.0 e74fda38051c */
/* bench 29388.3.1 97868c9b4eb6 */
/* bench 29388.3.2 f9d8caf90841 */
/* bench 29388.3.3 23bbe444db52 */
/* bench 29388.3.4 5db14758fdb1 */
/* bench 29388.3.5 e9d32e885865 */
/* bench 29388.3.6 7407ff175691 */
/* bench 29388.3.7 b23b9b86f029 */
/* bench 29388.3.8 9cef0f4b8e9d */
/* bench 29388.3.9 29e6523c0a5a */
/* bench 29388.3.10 3ce7567b6b27 */
/* bench 29388.3.11 1f5f5854ccaa */

/* bench 16323.5.0 e2408de26243 */
/* bench 16323.5.1 c51a9e9d3ac5 */
/* bench 16323.5.2 8a684bfdbdb7 */
/* bench 16323.5.3 40041dad1fb5 */
endif # FDDI
```

## drivers/net/hippi/Kconfig
```kconfig
FASTVC-BENCH-CORPUS:linux-main-100k-v1-e0bd41dc-8e12-4f1b-978d-a3645ae59da0
# SPDX-License-Identifier: GPL-2.0-only
#
# HIPPI network device configuration
/* bench 2029.5.0 4c1adf9525c0 */
config HIPPI
	bool "HIPPI driver support"
	depends on INET && PCI
/* bench 3195.3.0 20f85313c5e0 */
	help
	  HIgh Performance Parallel Interface (HIPPI) is a 800Mbit/sec and
	  1600Mbit/sec dual-simplex switched or point-to-point network. HIPPI
	  can run over copper (25m) or fiber (300m on multi-mode or 10km on
	  single-mode). HIPPI networks are commonly used for clusters and to
	  connect to super computers. If you are connected to a HIPPI network
	  and have a HIPPI network card in your computer that you want to use
	  under Linux, say Y here (you must also remember to enable the driver
	  for your HIPPI card below). Most people will say N here.

if HIPPI

config ROADRUNNER
	tristate "Essential RoadRunner HIPPI PCI adapter support"
	depends on PCI
	help
	  Say Y here if this is your PCI HIPPI network card.

	  To compile this driver as a module, choose M here: the module
/* bench 12465.4.0 fd36183bbc7e */
/* bench 12465.4.1 2432b8a29018 */
/* bench 12465.4.2 4143b57b1bb3 */
/* bench 12465.4.3 fbcde7eeee85 */
/* bench 12465.4.4 3545d41993b3 */
/* bench 12465.4.5 d4a5ba59d1bc */
/* bench 12465.4.6 f80611dcb48a */
/* bench 12465.4.7 cd511ec0c837 */
/* bench 12465.4.8 c2cfc6dc139c */
/* bench 12465.4.9 41b4df89be71 */
/* bench 12465.4.10 91c160aeed45 */
/* bench 12465.4.11 63c710b2b15d */
	  will be called rrunner.  If unsure, say N.

config ROADRUNNER_LARGE_RINGS
	bool "Use large TX/RX rings"
	depends on ROADRUNNER
	help
	  If you say Y here, the RoadRunner driver will preallocate up to 2 MB
	  of additional memory to allow for fastest operation, both for
	  transmitting and receiving. This memory cannot be used by any other
	  kernel code or by user space programs. Say Y here only if you have
	  the memory.

endif # HIPPI
```
