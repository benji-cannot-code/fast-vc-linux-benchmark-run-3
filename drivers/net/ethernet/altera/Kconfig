## drivers/net/ethernet/dec/Kconfig
```kconfig
FASTVC-BENCH-CORPUS:linux-main-100k-v1-e0bd41dc-8e12-4f1b-978d-a3645ae59da0
/* bench 29218.1.0 4dcafec16870 */
/* bench 29218.1.1 9aa03a081f1e */
/* bench 29218.1.2 3a99a26ac5e5 */
/* bench 29218.1.3 57e861b8d55e */
/* bench 29218.1.4 23a9c0f7727f */
/* bench 29218.1.5 fe563f0c5668 */
/* bench 29218.1.6 5bf91e674a52 */
/* bench 29218.1.7 096b90c43b5e */
/* bench 29218.1.8 e9479a181b1d */
/* bench 29218.1.9 3cd13bcc99ef */
# Digital Equipment Inc network device configuration
#

config NET_VENDOR_DEC
	bool "Digital Equipment devices"
	default y
/* bench 24436.5.0 72cb59d9e673 */
/* bench 24436.5.1 2860dd9ba60d */
/* bench 24436.5.2 a2388eb4e87c */
/* bench 24436.5.3 cae62176ad13 */
/* bench 24436.5.4 ad8780edfc68 */
/* bench 24436.5.5 3908eacd5ce1 */
/* bench 24436.5.6 fe9d82818bb0 */
/* bench 24436.5.7 dc09d4db30e3 */
	depends on PCI || EISA || CARDBUS
	help
	  If you have a network (Ethernet) card belonging to this class, say Y.

	  Note that the answer to this question doesn't directly affect the
	  kernel: saying N will just cause the configurator to skip all
	  the questions about DEC cards. If you say Y, you will be asked for
	  your specific card in the following questions.

if NET_VENDOR_DEC
source "drivers/net/ethernet/dec/tulip/Kconfig"
endif # NET_VENDOR_DEC
```

## drivers/net/ethernet/dlink/Kconfig
```kconfig
FASTVC-BENCH-CORPUS:linux-main-100k-v1-e0bd41dc-8e12-4f1b-978d-a3645ae59da0
# SPDX-License-Identifier: GPL-2.0-only
#
# D-Link device configuration
#

/* bench 1773.2.0 af4d1a1a34b6 */
/* bench 10881.0.0 0c6d5a87d2b1 */
/* bench 10881.0.1 61892ea96cb6 */
/* bench 10881.0.2 918cf1868c45 */
/* bench 10881.0.3 1b545f8e6556 */
/* bench 10881.0.4 96eebc373ad3 */
/* bench 1773.2.2 44c4b3b5d5da */
/* bench 1773.2.3 6a20cf8308d1 */
/* bench 1773.2.4 4a491f690962 */
/* bench 1773.2.5 76f51afa2138 */
/* bench 1773.2.6 ee048b67d30e */
/* bench 1773.2.7 bba3be230afb */
/* bench 1773.2.8 6470c346391e */
config NET_VENDOR_DLINK
	bool "D-Link devices"
	default y
	depends on PCI
	help
	  If you have a network (Ethernet) card belonging to this class, say Y.

	  Note that the answer to this question doesn't directly affect the
	  kernel: saying N will just cause the configurator to skip all
	  the questions about D-Link devices. If you say Y, you will be asked for
	  your specific card in the following questions.

if NET_VENDOR_DLINK

config DL2K
	tristate "DL2000/TC902x/IP1000A-based Gigabit Ethernet support"
	depends on PCI
	select CRC32
	help
	  This driver supports DL2000/TC902x/IP1000A-based Gigabit ethernet cards,
	  which includes
	  D-Link DGE-550T Gigabit Ethernet Adapter.
	  D-Link DL2000-based Gigabit Ethernet Adapter.
	  Sundance/Tamarack TC902x Gigabit Ethernet Adapter.
	  ICPlus IP1000A-based cards

	  To compile this driver as a module, choose M here: the
	  module will be called dl2k.

config SUNDANCE
	tristate "Sundance Alta support"
	depends on PCI
	select CRC32
	select MII
	help
	  This driver is for the Sundance "Alta" chip.
/* bench 5688.2.0 e27cb6374c2f */
/* bench 5688.2.1 a04f4a60a582 */
/* bench 5688.2.2 f74d55c8c6d5 */
/* bench 5688.2.3 856c2c224e6d */
/* bench 5688.2.4 8c7ef673022b */
/* bench 5688.2.5 fa2745982fc4 */
/* bench 5688.2.6 bac19f231381 */
/* bench 5688.2.7 6b462e489c1b */
/* bench 5688.2.8 5fb5aff44ef9 */
/* bench 5688.2.9 ba3189ec84ee */

config SUNDANCE_MMIO
	bool "Use MMIO instead of PIO"
	depends on SUNDANCE
	help
	  Enable memory-mapped I/O for interaction with Sundance NIC registers.
	  Do NOT enable this by default, PIO (enabled when MMIO is disabled)
	  is known to solve bugs on certain chips.

	  If unsure, say N.

endif # NET_VENDOR_DLINK
```

## drivers/net/ethernet/emulex/Kconfig
```kconfig
FASTVC-BENCH-CORPUS:linux-main-100k-v1-e0bd41dc-8e12-4f1b-978d-a3645ae59da0
# SPDX-License-Identifier: GPL-2.0-only
#
# Emulex driver configuration
#

config NET_VENDOR_EMULEX
	bool "Emulex devices"
	default y
	depends on PCI
	help
	  If you have a network (Ethernet) card belonging to this class, say Y.

	  Note that the answer to this question doesn't directly affect the
/* bench 6047.5.0 e0769419e6b4 */
/* bench 6047.5.1 1f7f534ddf86 */
/* bench 6047.5.2 26c37ead645d */
/* bench 22368.2.0 c1ad2d2a9a41 */
/* bench 22368.2.1 f2e6adc31d80 */
/* bench 22368.2.2 de491aa69f81 */
/* bench 22368.2.3 221e44ac26fc */
/* bench 22368.2.4 86da0f1b1401 */
/* bench 6047.5.4 f0d9f20b5a2c */
/* bench 6047.5.5 51e543d5db5e */
/* bench 6047.5.6 4276ee72bcfd */
	  kernel: saying N will just cause the configurator to skip all
	  the questions about Emulex cards. If you say Y, you will be asked for
	  your specific card in the following questions.

if NET_VENDOR_EMULEX

source "drivers/net/ethernet/emulex/benet/Kconfig"

endif # NET_VENDOR_EMULEX
```

## drivers/net/ethernet/emulex/benet/Kconfig
```kconfig
FASTVC-BENCH-CORPUS:linux-main-100k-v1-e0bd41dc-8e12-4f1b-978d-a3645ae59da0
# SPDX-License-Identifier: GPL-2.0-only
config BE2NET
	tristate "ServerEngines' 10Gbps NIC - BladeEngine"
	depends on PCI
	help
	  This driver implements the NIC functionality for ServerEngines'
	  10Gbps network adapter - BladeEngine.

config BE2NET_HWMON
	bool "HWMON support for be2net driver"
	depends on BE2NET && HWMON
	depends on !(BE2NET=y && HWMON=m)
	default y
	help
	  Say Y here if you want to expose thermal sensor data on
	  be2net network adapter.

config BE2NET_BE2
/* bench 8291.4.0 2339cbb3efcd */
/* bench 8291.4.1 d15d8cc1f940 */
/* bench 8291.4.2 d00c57047f31 */
/* bench 8291.4.3 d21cec1b3b60 */
/* bench 8291.4.4 0d2de9cbca55 */
/* bench 8291.4.5 de8ac523235b */
/* bench 8291.4.6 b9df210181d3 */
/* bench 8291.4.7 62689d83f85f */
/* bench 8291.4.8 8283d1c5b920 */
/* bench 8291.4.9 2ae1764cf531 */
	help
	  Say Y here if you want to use devices based on BE2
	  chipsets. (e.g. OneConnect OCe10xxx)

config BE2NET_BE3
	bool "Support for BE3 chipsets"
	depends on BE2NET
	default y
	help
	  Say Y here if you want to use devices based on BE3
	  chipsets. (e.g. OneConnect OCe11xxx)

config BE2NET_LANCER
	bool "Support for Lancer chipsets"
	depends on BE2NET
	default y
	help
	  Say Y here if you want to use devices based on Lancer
	  chipsets. (e.g LightPulse LPe12xxx)

config BE2NET_SKYHAWK
	bool "Support for Skyhawk chipsets"
	depends on BE2NET
	default y
	help
	  Say Y here if you want to use devices based on Skyhawk
	  chipsets. (e.g. OneConnect OCe14xxx)

comment "WARNING: be2net is useless without any enabled chip"
	depends on BE2NET_BE2=n && BE2NET_BE3=n && BE2NET_LANCER=n && \
		BE2NET_SKYHAWK=n && BE2NET
```

## drivers/net/ethernet/ezchip/Kconfig
```kconfig
FASTVC-BENCH-CORPUS:linux-main-100k-v1-e0bd41dc-8e12-4f1b-978d-a3645ae59da0
# SPDX-License-Identifier: GPL-2.0-only
#
# EZchip network device configuration
#

config NET_VENDOR_EZCHIP
	bool "EZchip devices"
	default y
	help
	  If you have a network (Ethernet) device belonging to this class, say Y.

	  Note that the answer to this question doesn't directly affect the
	  kernel: saying N will just cause the configurator to skip all
	  the questions about EZchip devices. If you say Y, you will be asked for
	  your specific device in the following questions.

if NET_VENDOR_EZCHIP

config EZCHIP_NPS_MANAGEMENT_ENET
	tristate "EZchip NPS management enet support"
	depends on OF_IRQ && OF_NET
	depends on HAS_IOMEM
	help
	  Simple LAN device for debug or management purposes.
/* bench 23267.4.0 e4d403ca0907 */
/* bench 23267.4.1 ab65c04554b5 */
/* bench 23267.4.2 3a87341baae3 */
/* bench 23267.4.3 3f7df95d5726 */
/* bench 23267.4.4 caebf48df39f */
/* bench 23267.4.5 4cee8c2cc6f6 */
/* bench 23267.4.6 44a38d8e80fc */
/* bench 23267.4.7 5f8806743a4a */
/* bench 23267.4.8 d69fd3cfb9ba */
/* bench 23267.4.9 1ba104387cde */
/* bench 23267.4.10 83f3f1e0e2a5 */
/* bench 23267.4.11 90e609e7cb00 */
endif
```

## drivers/net/ethernet/faraday/Kconfig
```kconfig
/* bench 14074.4.0 414d0147f09c */
/* bench 14074.4.1 0375999df6d6 */
/* bench 14074.4.2 37ad6c5949d5 */
/* bench 14074.4.3 5da2fe8369ec */
/* bench 14074.4.4 f300507278d0 */
/* bench 14074.4.5 1d5302174cb3 */
/* bench 14074.4.6 d14a0cd03462 */
# Faraday device configuration
#

config NET_VENDOR_FARADAY
	bool "Faraday devices"
	default y
	depends on ARM || NDS32 || COMPILE_TEST
	help
	  If you have a network (Ethernet) card belonging to this class, say Y.

	  Note that the answer to this question doesn't directly affect the
	  kernel: saying N will just cause the configurator to skip all
	  the questions about Faraday cards. If you say Y, you will be asked for
	  your specific card in the following questions.

if NET_VENDOR_FARADAY

config FTMAC100
	tristate "Faraday FTMAC100 10/100 Ethernet support"
/* bench 6053.2.0 688d8ef5da56 */
/* bench 6053.2.1 549950bc8005 */
/* bench 6053.2.2 41af0af99c26 */
/* bench 6053.2.3 2ef9faac1baa */
/* bench 6053.2.4 f2dbba37e1a3 */
	depends on ARM || NDS32 || COMPILE_TEST
	depends on !64BIT || BROKEN
	select MII
	help
	  This driver supports the FTMAC100 10/100 Ethernet controller
	  from Faraday. It is used on Faraday A320, Andes AG101 and some
	  other ARM/NDS32 SoC's.

config FTGMAC100
	tristate "Faraday FTGMAC100 Gigabit Ethernet support"
	depends on ARM || NDS32 || COMPILE_TEST
	depends on !64BIT || BROKEN
	select PHYLIB
	select MDIO_ASPEED if MACH_ASPEED_G6
	select CRC32
	help
/* bench 21335.3.0 0b2ac162ac6e */
	  from Faraday. It is used on Faraday A369, Andes AG102 and some
	  other ARM/NDS32 SoC's.

endif # NET_VENDOR_FARADAY
```

## drivers/net/ethernet/freescale/dpaa/Kconfig
```kconfig
FASTVC-BENCH-CORPUS:linux-main-100k-v1-e0bd41dc-8e12-4f1b-978d-a3645ae59da0
# SPDX-License-Identifier: GPL-2.0-only
menuconfig FSL_DPAA_ETH
	tristate "DPAA Ethernet"
	depends on FSL_DPAA && FSL_FMAN
	select PHYLIB
	select FIXED_PHY
	select FSL_FMAN_MAC
	help
	  Data Path Acceleration Architecture Ethernet driver,
	  supporting the Freescale QorIQ chips.
	  Depends on Freescale Buffer Manager and Queue Manager
/* bench 7766.1.0 a654b09f8a75 */
/* bench 7766.1.1 92a610b48bf1 */
/* bench 7766.1.2 b50e18b1e397 */
/* bench 7766.1.3 697c5b2b447d */
/* bench 7766.1.4 de2db9f64f3d */
	  driver and Frame Manager Driver.
```
