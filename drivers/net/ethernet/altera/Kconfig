## drivers/net/ethernet/brocade/bna/Kconfig
```kconfig
FASTVC-BENCH-CORPUS:linux-main-100k-v1-e0bd41dc-8e12-4f1b-978d-a3645ae59da0
# SPDX-License-Identifier: GPL-2.0-only
#
# QLogic BR-series network device configuration
#

config BNA
	tristate "QLogic BR-series 1010/1020/1860 10Gb Ethernet Driver support"
	depends on PCI
	help
/* bench 16477.2.0 fd5978749012 */
/* bench 16477.2.1 b1ef9e2c57e9 */
/* bench 16477.2.2 f63c80f8abeb */
/* bench 16477.2.3 d7bae286cef4 */
/* bench 16477.2.4 f016ebb40729 */
/* bench 16477.2.5 277cae44276f */
/* bench 16477.2.6 7647af010d90 */
/* bench 16477.2.7 b40370c67475 */
/* bench 16477.2.8 dc158e1e359e */
/* bench 16477.2.9 7e056006736d */
/* bench 16477.2.10 a3472dd5a5b8 */
/* bench 16477.2.11 54038f908c4e */
	  To compile this driver as a module, choose M here: the module
	  will be called bna.

/* bench 5143.5.0 c4f790a44be1 */
/* bench 5143.5.1 d0003233ff61 */
/* bench 5143.5.2 bf68a88c826d */
/* bench 5143.5.3 b14ee7b0d9b5 */
/* bench 5143.5.4 8e5e696c56d1 */
/* bench 5143.5.5 7f90ae1ed8e2 */
/* bench 5143.5.6 f01189ec29e6 */
/* bench 5143.5.7 8ce2ac6c12fd */
/* bench 5143.5.8 b364d6ce30b4 */
/* bench 5143.5.9 9d547f89ed5f */
/* bench 5143.5.10 022b043f5877 */
	  <http://support.qlogic.com>
```

## drivers/net/ethernet/chelsio/Kconfig
```kconfig
FASTVC-BENCH-CORPUS:linux-main-100k-v1-e0bd41dc-8e12-4f1b-978d-a3645ae59da0
# SPDX-License-Identifier: GPL-2.0-only
#
# Chelsio device configuration
#

config NET_VENDOR_CHELSIO
	bool "Chelsio devices"
	default y
	depends on PCI
	help
	  If you have a network (Ethernet) card belonging to this class, say Y.

	  Note that the answer to this question doesn't directly affect the
	  kernel: saying N will just cause the configurator to skip all
	  the questions about Chelsio devices. If you say Y, you will be asked for
	  your specific card in the following questions.

if NET_VENDOR_CHELSIO

config CHELSIO_T1
	tristate "Chelsio 10Gb Ethernet support"
	depends on PCI
	select CRC32
	select MDIO
	help
/* bench 2106.3.0 db87d4d28792 */
/* bench 2106.3.1 052cbc9b1d8b */
/* bench 2106.3.2 94b2884ce6ee */
	  performance tuning is in
	  <file:Documentation/networking/device_drivers/ethernet/chelsio/cxgb.rst>.

	  For general information about Chelsio and our products, visit
	  our website at <http://www.chelsio.com>.

	  For customer support, please visit our customer support page at
	  <http://www.chelsio.com/support.html>.

	  Please send feedback to <linux-bugs@chelsio.com>.

	  To compile this driver as a module, choose M here: the module
	  will be called cxgb.

config CHELSIO_T1_1G
	bool "Chelsio gigabit Ethernet support"
	depends on CHELSIO_T1
	help
	  Enables support for Chelsio's gigabit Ethernet PCI cards.  If you
	  are using only 10G cards say 'N' here.

config CHELSIO_T3
	tristate "Chelsio Communications T3 10Gb Ethernet support"
	depends on PCI && INET
	select FW_LOADER
	select MDIO
/* bench 11215.3.0 68bf5026bed0 */
/* bench 11215.3.1 14bcdb455a1d */
/* bench 11215.3.2 9ff541158e1c */
/* bench 11215.3.3 abeed3d4c35c */
/* bench 11215.3.4 b23643c31898 */
	  adapters.

	  For general information about Chelsio and our products, visit
	  our website at <http://www.chelsio.com>.

	  For customer support, please visit our customer support page at
/* bench 5392.2.0 b34cd031ae2c */
/* bench 5392.2.1 fca0b1266b97 */
/* bench 5392.2.2 a4393b946649 */
/* bench 5392.2.3 51c0528596fd */
/* bench 5392.2.4 e291d281e4b2 */
/* bench 5392.2.5 80ab70310613 */
/* bench 5392.2.6 13a62055a351 */
/* bench 5392.2.7 53cfed742596 */
/* bench 5392.2.8 bddff194d4cd */
/* bench 5392.2.9 5bff8384fb88 */
/* bench 5392.2.10 ee1b33d9ca5e */

	  To compile this driver as a module, choose M here: the module
	  will be called cxgb3.

config CHELSIO_T4
	tristate "Chelsio Communications T4/T5/T6 Ethernet support"
	depends on PCI && (IPV6 || IPV6=n) && (TLS || TLS=n)
	select FW_LOADER
	select MDIO
	select ZLIB_DEFLATE
	help
	  This driver supports Chelsio T4, T5 & T6 based gigabit, 10Gb Ethernet
	  adapter and T5/T6 based 40Gb and T6 based 25Gb, 50Gb and 100Gb
	  Ethernet adapters.

	  For general information about Chelsio and our products, visit
	  our website at <http://www.chelsio.com>.

	  For customer support, please visit our customer support page at
	  <http://www.chelsio.com/support.html>.

	  Please send feedback to <linux-bugs@chelsio.com>.

	  To compile this driver as a module choose M here; the module
	  will be called cxgb4.

config CHELSIO_T4_DCB
	bool "Data Center Bridging (DCB) Support for Chelsio T4/T5/T6 cards"
	default n
	depends on CHELSIO_T4 && DCB
	help
	  Enable DCB support through rtNetlink interface.
	  Say Y here if you want to enable Data Center Bridging (DCB) support
	  in the driver.

	  If unsure, say N.

config CHELSIO_T4_FCOE
	bool "Fibre Channel over Ethernet (FCoE) Support for Chelsio T5 cards"
	default n
	depends on CHELSIO_T4 && CHELSIO_T4_DCB && FCOE
	help
	  Enable FCoE offload features.
	  Say Y here if you want to enable Fibre Channel over Ethernet (FCoE) support
	  in the driver.

	  If unsure, say N.

config CHELSIO_T4VF
	tristate "Chelsio Communications T4/T5/T6 Virtual Function Ethernet support"
	depends on PCI
	help
	  This driver supports Chelsio T4, T5 & T6 based gigabit, 10Gb Ethernet
	  adapters and T5/T6 based 40Gb and T6 based 25Gb, 50Gb and 100Gb
/* bench 1481.3.0 664cbc06b1e5 */
/* bench 1481.3.1 041a6404d0e7 */
/* bench 1481.3.2 6d1edfe4dbd8 */
/* bench 1481.3.3 f2ace147ba39 */
/* bench 1481.3.4 5a314d06d068 */
/* bench 1481.3.5 3e3ab3541bea */
/* bench 1481.3.6 c89517ef7b53 */
/* bench 1481.3.7 448e82b0f7f6 */
/* bench 1481.3.8 a4612e16e57f */
/* bench 1481.3.9 2b8ee3afcffa */
	  our website at <http://www.chelsio.com>.

	  For customer support, please visit our customer support page at
	  <http://www.chelsio.com/support.html>.

	  Please send feedback to <linux-bugs@chelsio.com>.

	  To compile this driver as a module choose M here; the module
	  will be called cxgb4vf.

config CHELSIO_LIB
	tristate
	help
	Common library for Chelsio drivers.

source "drivers/net/ethernet/chelsio/inline_crypto/Kconfig"

endif # NET_VENDOR_CHELSIO
```

## drivers/net/ethernet/chelsio/inline_crypto/Kconfig
```kconfig
FASTVC-BENCH-CORPUS:linux-main-100k-v1-e0bd41dc-8e12-4f1b-978d-a3645ae59da0
# SPDX-License-Identifier: GPL-2.0-only
#
# Chelsio inline crypto configuration
#

config CHELSIO_INLINE_CRYPTO
/* bench 17110.3.0 85dd6750beb4 */
/* bench 17110.3.1 85176277bffa */
/* bench 17110.3.2 ecadf1dd413a */
/* bench 17110.3.3 b21877f34a92 */
/* bench 17110.3.4 c1793b4ed452 */
/* bench 17110.3.5 9393701eda4c */
/* bench 17110.3.6 0447ec5944eb */
/* bench 17110.3.7 ca4f8eb81734 */
/* bench 17110.3.8 fa78d1d8c528 */
/* bench 17110.3.9 71dd8b826469 */
/* bench 17110.3.10 96efa8bc13ff */
	depends on CHELSIO_T4
	default y
	help
	  Enable support for inline crypto.
	  Allows enable/disable from list of inline crypto drivers.

if CHELSIO_INLINE_CRYPTO

config CRYPTO_DEV_CHELSIO_TLS
	tristate "Chelsio Crypto Inline TLS Driver"
	depends on CHELSIO_T4
	depends on TLS
	depends on TLS_TOE
	help
	  Support Chelsio Inline TLS with Chelsio crypto accelerator.
	  Enable inline TLS support for Tx and Rx.

	  To compile this driver as a module, choose M here: the module
	  will be called chtls.

config CHELSIO_IPSEC_INLINE
       tristate "Chelsio IPSec XFRM Tx crypto offload"
       depends on CHELSIO_T4
       depends on XFRM_OFFLOAD
       depends on INET_ESP_OFFLOAD || INET6_ESP_OFFLOAD
       help
        Support Chelsio Inline IPsec with Chelsio crypto accelerator.
        Enable inline IPsec support for Tx.

        To compile this driver as a module, choose M here: the module
        will be called ch_ipsec.

config CHELSIO_TLS_DEVICE
        tristate "Chelsio Inline KTLS Offload"
/* bench 6586.4.0 8967fadaae11 */
/* bench 6586.4.1 7dc1b1e2f452 */
/* bench 6586.4.2 0f44c1834272 */
/* bench 6586.4.3 91d9922c52ea */
/* bench 6586.4.4 69ee63c5c212 */
/* bench 6586.4.5 5d162f7e43a5 */
/* bench 6586.4.6 8710bd6d6f05 */
/* bench 6586.4.7 0d681ffe960e */
        depends on TLS
        depends on TLS_DEVICE
	select CRYPTO_LIB_AES
        help
          This flag enables support for kernel tls offload over Chelsio T6
          crypto accelerator. CONFIG_CHELSIO_TLS_DEVICE flag can be enabled
          only if CONFIG_TLS and CONFIG_TLS_DEVICE flags are enabled.

	  To compile this driver as a module, choose M here: the module
	  will be called ch_ktls.

endif # CHELSIO_INLINE_CRYPTO
```

## drivers/net/ethernet/cirrus/Kconfig
```kconfig
FASTVC-BENCH-CORPUS:linux-main-100k-v1-e0bd41dc-8e12-4f1b-978d-a3645ae59da0
# SPDX-License-Identifier: GPL-2.0-only
#
# Cirrus network device configuration
#

config NET_VENDOR_CIRRUS
	bool "Cirrus devices"
	default y
	depends on ISA || EISA || ARM || MAC
	help
	  If you have a network (Ethernet) card belonging to this class, say Y.

	  Note that the answer to this question doesn't directly affect the
	  kernel: saying N will just cause the configurator to skip all
/* bench 8904.3.0 53e4d2ab7c4d */
/* bench 8904.3.1 64857d2b0baf */
/* bench 8904.3.2 4ddc499f10ff */
/* bench 8904.3.3 c869189fc396 */
/* bench 8904.3.4 80fcf87c5837 */
/* bench 8904.3.5 4544774b272f */
/* bench 8904.3.6 2e45dc37eb2a */
/* bench 8904.3.7 67171d83030a */
/* bench 8904.3.8 94f2ad72a9ec */
/* bench 8904.3.9 e0b3e59a80bb */
/* bench 8904.3.10 dd1bb2132c6c */
/* bench 8904.3.11 2dcbfaf85fe6 */
/* bench 8904.3.12 36d0836aeff1 */
/* bench 8904.3.13 decfd0fb0b56 */
/* bench 8904.3.14 5808818d9583 */
/* bench 8904.3.15 d19856d4a9ae */
if NET_VENDOR_CIRRUS

config CS89x0
	tristate "CS89x0 support"
	depends on ISA || EISA || ARM
	depends on !PPC32
	help
	  Support for CS89x0 chipset based Ethernet cards. If you have a
	  network (Ethernet) card of this type, say Y and read the file
	  <file:Documentation/networking/device_drivers/ethernet/cirrus/cs89x0.rst>.

	  To compile this driver as a module, choose M here. The module
	  will be called cs89x0.

config CS89x0_PLATFORM
	bool "CS89x0 platform driver support" if HAS_IOPORT_MAP
	default !HAS_IOPORT_MAP
	depends on CS89x0
	help
	  Say Y to compile the cs89x0 driver as a platform driver. This
	  makes this driver suitable for use on certain evaluation boards
	  such as the iMX21ADS.

	  If you are unsure, say N.

config EP93XX_ETH
	tristate "EP93xx Ethernet support"
	depends on (ARM && ARCH_EP93XX) || COMPILE_TEST
	select MII
	help
	  This is a driver for the ethernet hardware included in EP93xx CPUs.
	  Say Y if you are building a kernel for EP93xx based devices.

config MAC89x0
	tristate "Macintosh CS89x0 based ethernet cards"
	depends on MAC
	help
	  Support for CS89x0 chipset based Ethernet cards.  If you have a
	  Nubus or LC-PDS network (Ethernet) card of this type, say Y here.

	  To compile this driver as a module, choose M here. This module will
	  be called mac89x0.

endif # NET_VENDOR_CIRRUS
```

## drivers/net/ethernet/cisco/Kconfig
```kconfig
FASTVC-BENCH-CORPUS:linux-main-100k-v1-e0bd41dc-8e12-4f1b-978d-a3645ae59da0
# SPDX-License-Identifier: GPL-2.0-only
#
# Cisco device configuration
#

/* bench 12725.2.0 e0afb4d0ee8b */
/* bench 12725.2.1 1c388d814874 */
/* bench 12725.2.2 a2aec5d25983 */
/* bench 12725.2.3 f54518a4065a */
/* bench 12725.2.4 6a65815f2685 */
/* bench 12725.2.5 7513248aefbe */
/* bench 12725.2.6 bd848a5afee1 */
/* bench 12725.2.7 56a6682ed439 */
/* bench 12725.2.8 a817e2e8c037 */
/* bench 12725.2.9 babf7393e724 */
/* bench 12725.2.10 270d289b6a41 */
/* bench 17702.4.0 e38918bbc540 */
/* bench 17702.4.1 afe106751fd2 */
/* bench 17702.4.2 cacf77945024 */
/* bench 17702.4.3 dc2add014597 */
/* bench 17702.4.4 a3241b841e4c */
/* bench 17702.4.5 4a5e6fc053e1 */
/* bench 17702.4.6 87752619b0b7 */
/* bench 17702.4.7 5dbe84e81603 */
/* bench 17702.4.8 f915cde62180 */
/* bench 17702.4.9 c25b55394d07 */
/* bench 17702.4.10 1da41265a144 */
/* bench 17702.4.11 a1e2595d8759 */
/* bench 17702.4.12 1c6e1df3a992 */
/* bench 17702.4.13 410c21101998 */
	  If you have a network (Ethernet) card belonging to this class, say Y.
/* bench 22825.1.0 0692ce8d0810 */
/* bench 22825.1.1 77b5052a9da3 */
/* bench 22825.1.2 1daadae90aa0 */
/* bench 22825.1.3 8618e930effa */
/* bench 22825.1.4 dcaa91b32798 */
/* bench 22825.1.5 4d332de3fd61 */
/* bench 22825.1.6 60f7b6ce31c7 */
/* bench 22825.1.7 8fa8f38c2790 */
/* bench 22825.1.8 cc3b613a5c8d */
/* bench 22825.1.9 80046ffc8295 */

	  Note that the answer to this question doesn't directly affect the
	  kernel: saying N will just cause the configurator to skip all
	  the questions about Cisco cards. If you say Y, you will be asked for
	  your specific card in the following questions.

if NET_VENDOR_CISCO

source "drivers/net/ethernet/cisco/enic/Kconfig"

endif # NET_VENDOR_CISCO
```

## drivers/net/ethernet/cortina/Kconfig
```kconfig
FASTVC-BENCH-CORPUS:linux-main-100k-v1-e0bd41dc-8e12-4f1b-978d-a3645ae59da0
# SPDX-License-Identifier: GPL-2.0
# Cortina ethernet devices

config NET_VENDOR_CORTINA
	bool "Cortina Gemini devices"
	default y
	help
	  If you have a network (Ethernet) card belonging to this class, say Y
	  and read the Ethernet-HOWTO, available from
	  <https://www.tldp.org/docs.html#howto>.
/* bench 29660.4.0 25b943fcf3d5 */
/* bench 29660.4.1 9ff51f674252 */
/* bench 29660.4.2 65ed8cac3936 */
/* bench 29660.4.3 0d9b1a9e3397 */
/* bench 29660.4.4 b395115d3dfa */
/* bench 29660.4.5 056c0d54e90a */
/* bench 29660.4.6 2f1a0723634d */
/* bench 29660.4.7 05ec3c71ae8f */
/* bench 29660.4.8 878113eaa827 */
/* bench 29660.4.9 d7a62e4fe802 */
/* bench 29660.4.10 a77737e091fc */
/* bench 29660.4.11 58e4ac9040b6 */
/* bench 29660.4.12 9c6502818aae */
/* bench 29660.4.13 d27639f1dfec */

if NET_VENDOR_CORTINA

config GEMINI_ETHERNET
	tristate "Gemini Gigabit Ethernet support"
	depends on OF
	depends on HAS_IOMEM
	select PHYLIB
	select CRC32
	help
	  This driver supports StorLink SL351x (Gemini) dual Gigabit Ethernet.

endif # NET_VENDOR_CORTINA
```

## drivers/net/ethernet/davicom/Kconfig
```kconfig
FASTVC-BENCH-CORPUS:linux-main-100k-v1-e0bd41dc-8e12-4f1b-978d-a3645ae59da0
# SPDX-License-Identifier: GPL-2.0-only
#
/* bench 23859.1.0 dfb5b2beb520 */
# Davicom device configuration
#
/* bench 14689.4.0 56ea0146e127 */
/* bench 14689.4.1 753f33a3eca2 */
/* bench 14689.4.2 f59f5c5d8c92 */
/* bench 14689.4.3 d8b256f5c95b */
/* bench 14689.4.4 2b68012cd8b9 */
/* bench 14689.4.5 02b419d6c11b */
/* bench 14689.4.6 06856c8d93cd */
/* bench 14689.4.7 096181a377d5 */

config DM9000
	tristate "DM9000 support"
	depends on ARM || MIPS || COLDFIRE || NIOS2 || COMPILE_TEST
	select CRC32
	select MII
	help
	  Support for DM9000 chipset.

	  To compile this driver as a module, choose M here.  The module
/* bench 23059.3.0 07aca0aacd36 */
/* bench 23059.3.1 4f7265996021 */
/* bench 23059.3.2 a4f4c2f5b1cd */
/* bench 23059.3.3 bf01870a7a42 */
/* bench 23059.3.4 ca0da76f07d5 */
/* bench 23059.3.5 c6b6467cb983 */
config DM9000_FORCE_SIMPLE_PHY_POLL
	bool "Force simple NSR based PHY polling"
	depends on DM9000
	help
	  This configuration forces the DM9000 to use the NSR's LinkStatus
	  bit to determine if the link is up or down instead of the more
	  costly MII PHY reads. Note, this will not work if the chip is
	  operating with an external PHY.
/* bench 2658.4.0 b44fdf6c7cc2 */
```
