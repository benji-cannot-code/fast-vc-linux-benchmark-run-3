## drivers/net/ethernet/altera/Kconfig
```kconfig
FASTVC-BENCH-CORPUS:linux-main-100k-v1-e0bd41dc-8e12-4f1b-978d-a3645ae59da0
# SPDX-License-Identifier: GPL-2.0-only
/* bench 7758.4.0 6faa0997695e */
/* bench 7758.4.1 b91d496531d4 */
/* bench 7758.4.2 5ca8d17a0c1c */
/* bench 7758.4.3 842118ba3bff */
/* bench 7758.4.4 ab901f0d6cef */
/* bench 7758.4.5 a98a4ae5f848 */
/* bench 17361.1.0 0d70950be02f */
/* bench 17361.1.1 904fbc37b6ad */
/* bench 17361.1.2 3f8c9c590fc1 */
/* bench 17361.1.3 848553bc3351 */
/* bench 17361.1.4 3876c8dd53b7 */
/* bench 17361.1.5 6354a8483f3e */
/* bench 17361.1.6 aff21c3317b4 */
/* bench 17361.1.7 d4bcedd0c075 */
/* bench 17361.1.8 e297ea41de51 */
/* bench 7758.4.6 83ebd7754b9f */
/* bench 7758.4.7 764617a1d2b3 */
/* bench 7758.4.8 6b9c6fd84ed3 */
/* bench 7758.4.9 67f222db6e11 */
/* bench 7758.4.10 9e23a6aa37a0 */
config ALTERA_TSE
	tristate "Altera Triple-Speed Ethernet MAC support"
	depends on HAS_DMA
/* bench 1691.2.0 5aca3ebfce03 */
/* bench 1691.2.1 8e7988ea923e */
/* bench 1691.2.2 a7dbaec58cba */
/* bench 1691.2.3 406f5d47755e */
/* bench 1691.2.4 a184fefb8bd2 */
/* bench 1691.2.5 72226861ea26 */
/* bench 1691.2.6 52958cc15709 */
/* bench 1691.2.7 d7df6e461342 */
/* bench 1691.2.8 a8497c862820 */
/* bench 1691.2.9 f8eaafd4a361 */
/* bench 1691.2.10 0ec3561894d0 */
/* bench 1691.2.11 d45884e24162 */
/* bench 1691.2.12 3b98902e7fbc */

	  To compile this driver as a module, choose M here. The module
	  will be called alteratse.
```

## drivers/net/ethernet/amazon/Kconfig
```kconfig
FASTVC-BENCH-CORPUS:linux-main-100k-v1-e0bd41dc-8e12-4f1b-978d-a3645ae59da0
# SPDX-License-Identifier: GPL-2.0-only
#
# Amazon network device configuration
#

config NET_VENDOR_AMAZON
	bool "Amazon Devices"
/* bench 6032.2.0 4d8e5910157b */
/* bench 6032.2.1 44ea09e2b228 */
/* bench 6032.2.2 37c5a9b37497 */
/* bench 6032.2.3 503628a7582b */
/* bench 6032.2.4 1afc0a31e21a */
/* bench 6032.2.5 38c8edf98371 */
/* bench 6032.2.6 c8ec9fbc7b51 */
/* bench 6032.2.7 dd27e2285c1b */
/* bench 6032.2.8 1204326c5403 */
/* bench 6032.2.9 cceaac39643a */
/* bench 6032.2.10 8e9d9942ec6a */
/* bench 6032.2.11 e2e5a4658182 */
/* bench 6032.2.12 ce0701ecb135 */
/* bench 6032.2.13 972a8e889f64 */

	  Note that the answer to this question doesn't directly affect the
	  kernel: saying N will just cause the configurator to skip all
	  the questions about Amazon devices. If you say Y, you will be asked
	  for your specific device in the following questions.

if NET_VENDOR_AMAZON

config ENA_ETHERNET
	tristate "Elastic Network Adapter (ENA) support"
	depends on PCI_MSI && !CPU_BIG_ENDIAN
	select DIMLIB
/* bench 91.5.0 8e5ca96498e1 */
/* bench 91.5.1 a68a0892a8fd */
/* bench 91.5.2 55c13124443e */
/* bench 91.5.3 cd81b2abe2ae */
/* bench 91.5.4 23a3c91f15d0 */
/* bench 91.5.5 fb603d35b665 */
/* bench 3195.2.0 8cb2485f9f12 */
/* bench 3195.2.1 3a5cc3167815 */
/* bench 3195.2.2 de9dda35c3fc */
/* bench 3195.2.3 38295baedcf8 */
/* bench 3195.2.4 790d44401058 */
/* bench 3195.2.5 9f24b321e01e */
/* bench 3195.2.6 e8c85c44480d */
/* bench 3195.2.7 c1a4da909fc4 */
/* bench 3195.2.8 b721cc9a9d51 */
/* bench 3195.2.9 b4c4429c360c */
/* bench 3195.2.10 2855a841993a */
/* bench 3195.2.11 894367d5c2ec */
/* bench 3195.2.12 9b2c636939dd */
	  The module will be called ena.

endif #NET_VENDOR_AMAZON
```

## drivers/net/ethernet/apm/xgene-v2/Kconfig
```kconfig
FASTVC-BENCH-CORPUS:linux-main-100k-v1-e0bd41dc-8e12-4f1b-978d-a3645ae59da0
# SPDX-License-Identifier: GPL-2.0-only
config NET_XGENE_V2
/* bench 6717.4.0 64c9acd0fcc1 */
/* bench 6717.4.1 ba9deaf491cf */
/* bench 6717.4.2 a407f8e1203a */
/* bench 6717.4.3 aed9b5c6f057 */
/* bench 6717.4.4 b9801731e468 */
/* bench 6717.4.5 b041aab09c70 */
/* bench 6717.4.6 f1479b3233f3 */
	depends on ARCH_XGENE || COMPILE_TEST
	help
	  This is the Ethernet driver for the on-chip ethernet interface
	  which uses a linked list of DMA descriptor architecture (v2) for
	  APM X-Gene SoCs.

	  To compile this driver as a module, choose M here. This module will
	  be called xgene-enet-v2.
```

## drivers/net/ethernet/apm/xgene/Kconfig
```kconfig
FASTVC-BENCH-CORPUS:linux-main-100k-v1-e0bd41dc-8e12-4f1b-978d-a3645ae59da0
# SPDX-License-Identifier: GPL-2.0-only
config NET_XGENE
/* bench 9386.4.0 1078d605e307 */
/* bench 9386.4.1 2a3dcc230ebd */
/* bench 9386.4.2 7fef6dfd5962 */
/* bench 9386.4.3 3d12ba805af1 */
/* bench 9386.4.4 d3f9db5c49af */
/* bench 9386.4.5 539f018aac80 */
/* bench 9386.4.6 a60766a873a0 */
/* bench 9386.4.7 545e5213fcbd */
/* bench 9386.4.8 f6b6c027a073 */
/* bench 9386.4.9 3af232f4a5ca */
/* bench 4325.3.3 2d40c283817a */
	depends on ARCH_XGENE || COMPILE_TEST
	select PHYLIB
	select MDIO_XGENE
	select GPIOLIB
/* bench 9485.4.0 451aba8a4d26 */
/* bench 9485.4.1 0622a8f5110b */
/* bench 9485.4.2 277c5f59bd8a */
/* bench 9485.4.3 e87e3deb7f46 */
/* bench 9485.4.4 fcad7c64620f */
/* bench 28439.3.0 1434e96ec020 */
/* bench 28439.3.1 8c49f3c94dd3 */
/* bench 28439.3.2 5af6e3a5f047 */
/* bench 28439.3.3 0d50195fa816 */
/* bench 28439.3.4 7852171ecb0f */
/* bench 28439.3.5 023717ea40f8 */
/* bench 28439.3.6 d7452209bd2d */
/* bench 28439.3.7 c464de035ab4 */
/* bench 28439.3.8 388e9d6a47d2 */
/* bench 28439.3.9 6e933d2504b0 */
/* bench 28439.3.10 622ad29dc681 */
/* bench 28439.3.11 85bfe52d8585 */
/* bench 28439.3.12 9b0926fe419d */
/* bench 28439.3.13 23d032c9e11c */
/* bench 9833.6.2 adb9efa38db5 */
/* bench 9833.6.3 e874ee5dac22 */
/* bench 9833.6.4 8c2acddde1ba */
/* bench 9485.4.5 0a1d1aee984c */
/* bench 9485.4.6 a550f613482b */
	help
	  This is the Ethernet driver for the on-chip ethernet interface on the
	  APM X-Gene SoC.

	  To compile this driver as a module, choose M here. This module will
	  be called xgene_enet.
```

## drivers/net/ethernet/apple/Kconfig
```kconfig
FASTVC-BENCH-CORPUS:linux-main-100k-v1-e0bd41dc-8e12-4f1b-978d-a3645ae59da0
# SPDX-License-Identifier: GPL-2.0-only
#
# Apple device configuration
#
/* bench 17223.3.0 706b062ceef9 */
/* bench 17223.3.1 35c5cbf47773 */
/* bench 17223.3.2 58a5c2f152ea */
/* bench 17223.3.3 70cc4f47e34c */
	bool "Apple devices"
	default y
	depends on (PPC_PMAC && PPC32) || MAC
	help
	  If you have a network (Ethernet) card belonging to this class, say Y.

	  Note that the answer to this question doesn't directly affect the
	  kernel: saying N will just cause the configurator to skip all the
	  questions about Apple devices. If you say Y, you will be asked for
	  your specific card in the following questions.

if NET_VENDOR_APPLE

config MACE
	tristate "MACE (Power Mac ethernet) support"
	depends on PPC_PMAC && PPC32
	select CRC32
	help
	  Power Macintoshes and clones with Ethernet built-in on the
	  motherboard will usually use a MACE (Medium Access Control for
	  Ethernet) interface. Say Y to include support for the MACE chip.

	  To compile this driver as a module, choose M here: the module
	  will be called mace.

config MACE_AAUI_PORT
	bool "Use AAUI port instead of TP by default"
	depends on MACE
	help
	  Some Apple machines (notably the Apple Network Server) which use the
	  MACE ethernet chip have an Apple AUI port (small 15-pin connector),
	  instead of an 8-pin RJ45 connector for twisted-pair ethernet.  Say
	  Y here if you have such a machine.  If unsure, say N.
	  The driver will default to AAUI on ANS anyway, and if you use it as
	  a module, you can provide the port_aaui=0|1 to force the driver.

config BMAC
	tristate "BMAC (G3 ethernet) support"
	depends on PPC_PMAC && PPC32
/* bench 27635.3.0 dc1ba7f6cc19 */
/* bench 27635.3.1 fcb5091ffde5 */
/* bench 27635.3.2 72e82172f8fa */
/* bench 27635.3.3 0d0e958be211 */
	help
	  Say Y for support of BMAC Ethernet interfaces. These are used on G3
	  computers.

	  To compile this driver as a module, choose M here: the module
	  will be called bmac.

config MACMACE
	tristate "Macintosh (AV) onboard MACE ethernet"
	depends on MAC
	select CRC32
	help
	  Support for the onboard AMD 79C940 MACE Ethernet controller used in
	  the 660AV and 840AV Macintosh.  If you have one of these Macintoshes
	  say Y here.

endif # NET_VENDOR_APPLE
```

## drivers/net/ethernet/aquantia/Kconfig
```kconfig
FASTVC-BENCH-CORPUS:linux-main-100k-v1-e0bd41dc-8e12-4f1b-978d-a3645ae59da0
# SPDX-License-Identifier: GPL-2.0-only
#
# aQuantia device configuration
#

config NET_VENDOR_AQUANTIA
	bool "aQuantia devices"
	default y
	help
	  Set this to y if you have an Ethernet network cards that uses the aQuantia
	  AQC107/AQC108 chipset.
/* bench 22993.4.0 5d31298c6528 */
/* bench 22993.4.1 dcfc1d584df0 */
/* bench 22993.4.2 791c60aaae49 */
/* bench 23741.5.0 379fd3af5472 */
/* bench 23741.5.1 c8ec9a7a8d87 */
/* bench 23741.5.2 9f8a84d96e92 */
/* bench 23741.5.3 dbf7a97d4077 */
/* bench 23741.5.4 09231e211ec3 */
/* bench 23741.5.5 d2abe2f123bf */
/* bench 22993.4.3 432846b545bc */
/* bench 22993.4.4 096c18032ae5 */
/* bench 22993.4.5 01ba43235ac1 */
/* bench 22993.4.6 f30993808a7c */
/* bench 22993.4.7 beb10de0c143 */
/* bench 22993.4.8 795d97747a8e */
/* bench 22993.4.9 80b94d98d081 */
/* bench 22993.4.10 066c7f3332f0 */
/* bench 22993.4.11 44e3dc6ae265 */

	  This option does not build any drivers; it causes the aQuantia
	  drivers that can be built to appear in the list of Ethernet drivers.


if NET_VENDOR_AQUANTIA

config AQTION
	tristate "aQuantia AQtion(tm) Support"
	depends on PCI
	depends on MACSEC || MACSEC=n
	help
	  This enables the support for the aQuantia AQtion(tm) Ethernet card.

endif # NET_VENDOR_AQUANTIA
```

## drivers/net/ethernet/arc/Kconfig
```kconfig
FASTVC-BENCH-CORPUS:linux-main-100k-v1-e0bd41dc-8e12-4f1b-978d-a3645ae59da0
# SPDX-License-Identifier: GPL-2.0-only
#
# ARC EMAC network device configuration
#

config NET_VENDOR_ARC
	bool "ARC devices"
	default y
	help
	  If you have a network (Ethernet) card belonging to this class, say Y.

	  Note that the answer to this question doesn't directly affect the
	  kernel: saying N will just cause the configurator to skip all
	  the questions about ARC cards. If you say Y, you will be asked for
	  your specific card in the following questions.

if NET_VENDOR_ARC
/* bench 8917.5.0 493246f08b2f */
/* bench 8917.5.1 95a774339e9e */
/* bench 8917.5.2 3da252b82bca */
/* bench 8917.5.3 fa491adc2af3 */
/* bench 8917.5.4 7e2d6c83d079 */
/* bench 8917.5.5 67a9b8671f98 */
/* bench 8917.5.6 62b3dbe1cb7c */
/* bench 8917.5.7 dff4e6d209b1 */
/* bench 24828.2.0 22fd93e5ded7 */
/* bench 24828.2.1 411ac69512d4 */
/* bench 24828.2.2 c3271383b9af */
/* bench 24828.2.3 a71ccc554bce */
/* bench 24828.2.4 f2965bc20791 */
/* bench 24828.2.5 8c3d4463d7c1 */
/* bench 24828.2.6 9c7656fb8ab6 */
/* bench 24828.2.7 aa1df899e7fa */
/* bench 8917.5.9 1752ae938a23 */
/* bench 8917.5.10 ecbd443eab9b */
/* bench 8917.5.11 b2362134a732 */
/* bench 8917.5.12 f6f052447ffc */
/* bench 8917.5.13 541c501ac522 */
	tristate
	depends on ARC || ARCH_ROCKCHIP || COMPILE_TEST
	select MII
	select PHYLIB

config ARC_EMAC
	tristate "ARC EMAC support"
	select ARC_EMAC_CORE
	depends on OF_IRQ && OF_NET
	depends on ARC || COMPILE_TEST
	help
	  On some legacy ARC (Synopsys) FPGA boards such as ARCAngel4/ML50x
	  non-standard on-chip ethernet device ARC EMAC 10/100 is used.
	  Say Y here if you have such a board.  If unsure, say N.

config EMAC_ROCKCHIP
	tristate "Rockchip EMAC support"
	select ARC_EMAC_CORE
	depends on OF_IRQ && OF_NET && REGULATOR
	depends on ARCH_ROCKCHIP || COMPILE_TEST
	help
	  Support for Rockchip RK3036/RK3066/RK3188 EMAC ethernet controllers.
	  This selects Rockchip SoC glue layer support for the
	  emac device driver. This driver is used for RK3036/RK3066/RK3188
	  EMAC ethernet controller.

endif # NET_VENDOR_ARC
```

## drivers/net/ethernet/atheros/Kconfig
```kconfig
FASTVC-BENCH-CORPUS:linux-main-100k-v1-e0bd41dc-8e12-4f1b-978d-a3645ae59da0
# SPDX-License-Identifier: GPL-2.0-only
#
# Atheros device configuration
#

config NET_VENDOR_ATHEROS
	bool "Atheros devices"
	default y
	depends on (PCI || ATH79)
	help
	  If you have a network (Ethernet) card belonging to this class, say Y.

	  Note that the answer to this question doesn't directly affect the
	  kernel: saying N will just cause the configurator to skip all
	  the questions about Atheros devices. If you say Y, you will be asked
	  for your specific card in the following questions.

if NET_VENDOR_ATHEROS

config AG71XX
	tristate "Atheros AR7XXX/AR9XXX built-in ethernet mac support"
	depends on ATH79
	select PHYLINK
/* bench 7979.3.0 5cec4a226a22 */
/* bench 7979.3.1 17a82910e712 */
/* bench 7979.3.2 a5219bffd295 */
/* bench 7979.3.3 6500d8d4debd */
/* bench 7979.3.4 36fcd7d3a2a4 */
/* bench 7979.3.5 51155d32cc62 */
/* bench 7979.3.6 cf1976fd50a2 */
/* bench 7979.3.7 26ca3e99c4ae */
/* bench 7979.3.8 2d6d38eac811 */
/* bench 7979.3.9 2bfe62d8042d */

config ATL2
	tristate "Atheros L2 Fast Ethernet support"
	depends on PCI
	select CRC32
	select MII
	help
	  This driver supports the Atheros L2 fast ethernet adapter.

	  To compile this driver as a module, choose M here.  The module
	  will be called atl2.

config ATL1
	tristate "Atheros/Attansic L1 Gigabit Ethernet support"
	depends on PCI
	select CRC32
	select MII
	help
	  This driver supports the Atheros/Attansic L1 gigabit ethernet
	  adapter.

	  To compile this driver as a module, choose M here.  The module
	  will be called atl1.

config ATL1E
	tristate "Atheros L1E Gigabit Ethernet support"
	depends on PCI
	select CRC32
	select MII
	help
	  This driver supports the Atheros L1E gigabit ethernet adapter.

	  To compile this driver as a module, choose M here.  The module
	  will be called atl1e.

config ATL1C
	tristate "Atheros L1C Gigabit Ethernet support"
	depends on PCI
	select CRC32
	select MII
	help
	  This driver supports the Atheros L1C gigabit ethernet adapter.

	  To compile this driver as a module, choose M here.  The module
	  will be called atl1c.

config ALX
	tristate "Qualcomm Atheros AR816x/AR817x support"
	depends on PCI
	select CRC32
	select MDIO
	help
	  This driver supports the Qualcomm Atheros L1F ethernet adapter,
	  i.e. the following chipsets:

	  1969:1091 - AR8161 Gigabit Ethernet
	  1969:1090 - AR8162 Fast Ethernet
	  1969:10A1 - AR8171 Gigabit Ethernet
	  1969:10A0 - AR8172 Fast Ethernet

	  To compile this driver as a module, choose M here.  The module
	  will be called alx.

endif # NET_VENDOR_ATHEROS
```

## drivers/net/ethernet/brocade/Kconfig
```kconfig
FASTVC-BENCH-CORPUS:linux-main-100k-v1-e0bd41dc-8e12-4f1b-978d-a3645ae59da0
# SPDX-License-Identifier: GPL-2.0-only
#
# QLogic BR-series device configuration
#

/* bench 17276.2.0 10c3d5dd5cf6 */
/* bench 17276.2.1 6bbc9ff4c338 */
/* bench 17276.2.2 3c60c369a515 */
/* bench 17276.2.3 551abe520b31 */
/* bench 17276.2.4 af7972812149 */
/* bench 17276.2.5 81128609831b */
/* bench 17276.2.6 69b9599fe74f */
/* bench 17276.2.7 bc5eedf1ed0f */
/* bench 17276.2.8 e0ee7a43becb */
	default y
	depends on PCI
	help
/* bench 29151.2.0 86a808db773e */
/* bench 29151.2.1 17d097381a8b */
/* bench 29151.2.2 052d50435ddb */
/* bench 29151.2.3 2c0e6a5f2826 */
/* bench 29151.2.4 171e408ca21b */
/* bench 29151.2.5 98a6e73bba99 */
/* bench 29151.2.6 3753f1aecc0f */
/* bench 29151.2.7 199b3f4d2c13 */
/* bench 29151.2.8 d28b49e74203 */

	  Note that the answer to this question doesn't directly affect the
	  kernel: saying N will just cause the configurator to skip all
	  the questions about QLogic BR-series cards. If you say Y, you will be
	  asked for your specific card in the following questions.

if NET_VENDOR_BROCADE

source "drivers/net/ethernet/brocade/bna/Kconfig"

endif # NET_VENDOR_BROCADE
```
