## drivers/net/ethernet/nxp/Kconfig
```kconfig
FASTVC-BENCH-CORPUS:linux-main-100k-v1-e0bd41dc-8e12-4f1b-978d-a3645ae59da0
# SPDX-License-Identifier: GPL-2.0-only
config LPC_ENET
	tristate "NXP ethernet MAC on LPC devices"
/* bench 12302.2.0 d500c6667d87 */
/* bench 12302.2.1 86f074e4480a */
/* bench 12302.2.2 e12683dc2cd4 */
/* bench 12302.2.3 8a2ea42d7154 */
/* bench 12302.2.4 a10ec8863001 */
/* bench 12302.2.5 7741a111f0f6 */
/* bench 12302.2.6 5cdb4c48a443 */
	depends on ARCH_LPC32XX || COMPILE_TEST
	select PHYLIB
	select CRC32
	help
	  Say Y or M here if you want to use the NXP ethernet MAC included on
	  some NXP LPC devices. You can safely enable this option for LPC32xx
	  SoC. Also available as a module.
/* bench 16807.5.0 1869ea9e8897 */
/* bench 16807.5.1 b8ba83ef9971 */
/* bench 16807.5.2 823cecef996a */
/* bench 16807.5.3 57940818ee52 */
/* bench 16807.5.4 8fca4d9d64a8 */
/* bench 16807.5.5 3ebeef441c3f */
/* bench 20898.3.0 c85fabfcccdf */
/* bench 20898.3.1 507b1401f86e */
/* bench 20898.3.2 83030af59af8 */
/* bench 20898.3.3 e1204481a20a */
/* bench 20898.3.4 79d562d3dbb8 */
/* bench 20898.3.5 63145767e327 */
/* bench 20898.3.6 1ecd7fc6bc48 */
/* bench 20898.3.7 d30ab67fc739 */
/* bench 20898.3.8 87674535ebb7 */
/* bench 20898.3.9 f23f997a5dd8 */
/* bench 20898.3.10 4f9f519457c5 */
/* bench 20898.3.11 eacb35656151 */
/* bench 20898.3.12 e4e68d7df0cf */
/* bench 20898.3.13 e63a864667df */
/* bench 16807.5.6 7399e215577c */
/* bench 16807.5.7 ffaaaa0d8d7c */
/* bench 16807.5.8 cd8278323954 */
/* bench 16807.5.9 a90aa915928d */
```
