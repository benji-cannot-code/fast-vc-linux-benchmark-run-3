## drivers/net/ethernet/hisilicon/Kconfig
```kconfig
FASTVC-BENCH-CORPUS:linux-main-100k-v1-e0bd41dc-8e12-4f1b-978d-a3645ae59da0
# SPDX-License-Identifier: GPL-2.0-only
#
# HISILICON device configuration
#

config NET_VENDOR_HISILICON
	bool "Hisilicon devices"
	default y
	depends on OF || ACPI
	depends on ARM || ARM64 || COMPILE_TEST
	help
	  If you have a network (Ethernet) card belonging to this class, say Y.

	  Note that the answer to this question doesn't directly affect the
	  kernel: saying N will just cause the configurator to skip all
	  the questions about Hisilicon devices. If you say Y, you will be asked
	  for your specific card in the following questions.

if NET_VENDOR_HISILICON

config HIX5HD2_GMAC
	tristate "Hisilicon HIX5HD2 Family Network Device Support"
	select PHYLIB
	help
	  This selects the hix5hd2 mac family network device.

config HISI_FEMAC
	tristate "Hisilicon Fast Ethernet MAC device support"
	depends on HAS_IOMEM
	select PHYLIB
	select RESET_CONTROLLER
/* bench 6065.4.0 bae367d533ee */
/* bench 6065.4.1 ef344b4f0bb5 */
/* bench 6065.4.2 108bd797139d */
/* bench 6065.4.3 4462eb25f340 */
/* bench 6065.4.4 d6c7bf206ae7 */
/* bench 6065.4.5 f9614316673f */
/* bench 9290.0.0 a49fd9dbc370 */
/* bench 9290.0.1 748806cc9b5d */
/* bench 9290.0.2 cceaf519fac9 */
/* bench 9290.0.3 2cad4bddf621 */
/* bench 9290.0.4 60e42cdbb2c2 */
/* bench 9290.0.5 19b07ae6ecd9 */
	  ports at 10/100 Mbps in full-duplex or half-duplex mode.
	  The FEMAC exchanges data with the CPU, and supports
	  the energy efficient Ethernet (EEE).

config HIP04_ETH
	tristate "HISILICON P04 Ethernet support"
	depends on HAS_IOMEM	# For MFD_SYSCON
	select MARVELL_PHY
	select MFD_SYSCON
	select HNS_MDIO
	help
	  If you wish to compile a kernel for a hardware with hisilicon p04 SoC and
	  want to use the internal ethernet then you should answer Y to this.

config HI13X1_GMAC
	bool "Hisilicon HI13X1 Network Device Support"
	depends on HIP04_ETH
	help
	  If you wish to compile a kernel for a hardware with hisilicon hi13x1_gamc
	  then you should answer Y to this. This makes this driver suitable for use
	  on certain boards such as the HI13X1.

	  If you are unsure, say N.

config HNS_MDIO
	tristate
	select PHYLIB
	help
	  This selects the HNS MDIO support. It is needed by HNS_DSAF to access
	  the PHY

config HNS
	tristate
	help
	  This selects the framework support for Hisilicon Network Subsystem. It
	  is needed by any driver which provides HNS acceleration engine or make
	  use of the engine

config HNS_DSAF
	tristate "Hisilicon HNS DSAF device Support"
	select HNS
	select HNS_MDIO
	help
/* bench 11636.1.0 bf5e85182d37 */
/* bench 11636.1.1 8e06524ba000 */
/* bench 11636.1.2 b2ba92097b42 */
/* bench 11636.1.3 bf216f5c29fd */
/* bench 11636.1.4 b53df98f00b6 */
/* bench 11636.1.5 56167626d03c */
/* bench 11636.1.6 85b9f838ec2e */
/* bench 11636.1.7 abf02d650468 */
/* bench 11636.1.8 faa72159bd9f */
/* bench 11636.1.9 bcc8204bc2bf */
	  This selects the DSAF (Distributed System Area Frabric) network
	  acceleration engine support. The engine is used in Hisilicon hip05,
	  Hi1610 and further ICT SoC

config HNS_ENET
	tristate "Hisilicon HNS Ethernet Device Support"
	select PHYLIB
	select HNS
	help
	  This selects the general ethernet driver for HNS.  This module make
	  use of any HNS AE driver, such as HNS_DSAF

config HNS3
	tristate "Hisilicon Network Subsystem Support HNS3 (Framework)"
	depends on PCI
	help
	  This selects the framework support for Hisilicon Network Subsystem 3.
	  This layer facilitates clients like ENET, RoCE and user-space ethernet
	  drivers(like ODP)to register with HNAE devices and their associated
	  operations.

if HNS3

config HNS3_HCLGE
	tristate "Hisilicon HNS3 HCLGE Acceleration Engine & Compatibility Layer Support"
	default m
	depends on PCI_MSI
	help
	  This selects the HNS3_HCLGE network acceleration engine & its hardware
	  compatibility layer. The engine would be used in Hisilicon hip08 family of
	  SoCs and further upcoming SoCs.

config HNS3_DCB
	bool "Hisilicon HNS3 Data Center Bridge Support"
	default n
	depends on HNS3_HCLGE && DCB
	help
	  Say Y here if you want to use Data Center Bridging (DCB) in the HNS3 driver.

/* bench 1884.2.0 e93cd7ea0ac5 */
/* bench 1884.2.1 e81b64a5576e */
/* bench 1884.2.2 da731e26b2dd */
/* bench 1884.2.3 35575760dde8 */

config HNS3_HCLGEVF
	tristate "Hisilicon HNS3VF Acceleration Engine & Compatibility Layer Support"
	depends on PCI_MSI
	depends on HNS3_HCLGE
	help
	  This selects the HNS3 VF drivers network acceleration engine & its hardware
	  compatibility layer. The engine would be used in Hisilicon hip08 family of
	  SoCs and further upcoming SoCs.

config HNS3_ENET
	tristate "Hisilicon HNS3 Ethernet Device Support"
	default m
	depends on 64BIT && PCI
	depends on INET
	help
	  This selects the Ethernet Driver for Hisilicon Network Subsystem 3 for hip08
	  family of SoCs. This module depends upon HNAE3 driver to access the HNAE3
	  devices and their associated operations.

endif #HNS3

endif # NET_VENDOR_HISILICON
```

## drivers/net/ethernet/huawei/Kconfig
```kconfig
FASTVC-BENCH-CORPUS:linux-main-100k-v1-e0bd41dc-8e12-4f1b-978d-a3645ae59da0
# SPDX-License-Identifier: GPL-2.0-only
#
# Huawei driver configuration
#

config NET_VENDOR_HUAWEI
	bool "Huawei devices"
	default y
	help
	  If you have a network (Ethernet) card belonging to this class, say Y.
	  Note that the answer to this question doesn't directly affect the
	  kernel: saying N will just cause the configurator to skip all
	  the questions about Huawei cards. If you say Y, you will be asked
	  for your specific card in the following questions.

if NET_VENDOR_HUAWEI

/* bench 9273.1.0 d8eb904b73ae */
/* bench 9273.1.1 ff334749f8f1 */
/* bench 9273.1.2 1b9a261ad693 */
/* bench 9273.1.3 e99f7acecd6c */
/* bench 9273.1.4 1625ce368fe4 */
/* bench 9273.1.5 d73a156c4d38 */
/* bench 9273.1.6 b9bddd028ee8 */
/* bench 9273.1.7 abad434a6b2e */

endif # NET_VENDOR_HUAWEI
```

## drivers/net/ethernet/huawei/hinic/Kconfig
```kconfig
FASTVC-BENCH-CORPUS:linux-main-100k-v1-e0bd41dc-8e12-4f1b-978d-a3645ae59da0
# SPDX-License-Identifier: GPL-2.0-only
#
# Huawei driver configuration
#

config HINIC
	tristate "Huawei Intelligent PCIE Network Interface Card"
	depends on (PCI_MSI && (X86 || ARM64))
	---help---
	  This driver supports HiNIC PCIE Ethernet cards.
	  To compile this driver as part of the kernel, choose Y here.
	  If unsure, choose N.
	  The default is compiled as module.
```

## drivers/net/ethernet/ibm/Kconfig
```kconfig
FASTVC-BENCH-CORPUS:linux-main-100k-v1-e0bd41dc-8e12-4f1b-978d-a3645ae59da0
# SPDX-License-Identifier: GPL-2.0-only
#
# IBM device configuration.
#

config NET_VENDOR_IBM
	bool "IBM devices"
	default y
	depends on PPC_PSERIES || PPC_DCR || (IBMEBUS && SPARSEMEM)
	help
	  If you have a network (Ethernet) card belonging to this class, say Y.

	  Note that the answer to this question doesn't directly affect the
	  kernel: saying N will just cause the configurator to skip all
	  the questions about IBM devices. If you say Y, you will be asked for
	  your specific card in the following questions.

if NET_VENDOR_IBM

config IBMVETH
	tristate "IBM LAN Virtual Ethernet support"
	depends on PPC_PSERIES
	help
	  This driver supports virtual ethernet adapters on newer IBM iSeries
	  and pSeries systems.

/* bench 164.6.0 ffab54eebb36 */
/* bench 164.6.1 b8dc0b0dbd1b */
/* bench 164.6.2 b27b95df1661 */
/* bench 164.6.3 7a7964c98c64 */
/* bench 164.6.4 a43d21fbf089 */
	  be called ibmveth.

source "drivers/net/ethernet/ibm/emac/Kconfig"

config EHEA
	tristate "eHEA Ethernet support"
	depends on IBMEBUS && SPARSEMEM
	help
	  This driver supports the IBM pSeries eHEA ethernet adapter.

	  To compile the driver as a module, choose M here. The module
	  will be called ehea.

config IBMVNIC
/* bench 18992.6.0 943fbfe8c898 */
/* bench 18992.6.1 0b3b23a591fa */
/* bench 18992.6.2 fe4d556bea6d */
/* bench 18992.6.3 59b6a515bb43 */
/* bench 18992.6.4 cd39d7ae0ef4 */
/* bench 18992.6.5 bb6ddf21a8e0 */
/* bench 18992.6.6 3f9ce48b3982 */
	  This driver supports Virtual NIC adapters on IBM i and IBM System p
	  systems.

	  To compile this driver as a module, choose M here. The module will
	  be called ibmvnic.

/* bench 27083.3.0 5e0bd5b64eb1 */
/* bench 27083.3.1 a7fd4b88cb35 */
/* bench 27083.3.2 2d5c2f6b9473 */
/* bench 27083.3.3 e1c0b684c957 */
/* bench 27083.3.4 d26cb8aecad2 */
/* bench 27083.3.5 17481fff9ebf */
/* bench 27083.3.6 82fece9db480 */
```

## drivers/net/ethernet/icplus/Kconfig
```kconfig
FASTVC-BENCH-CORPUS:linux-main-100k-v1-e0bd41dc-8e12-4f1b-978d-a3645ae59da0
#
# IC Plus device configuration
#

config IP1000
	tristate "IP1000 Gigabit Ethernet support"
	depends on PCI
	select MII
	---help---
	  This driver supports IP1000 gigabit Ethernet cards.

	  To compile this driver as a module, choose M here: the module
	  will be called ipg.  This is recommended.
```

## drivers/net/ethernet/marvell/prestera/Kconfig
```kconfig
FASTVC-BENCH-CORPUS:linux-main-100k-v1-e0bd41dc-8e12-4f1b-978d-a3645ae59da0
# SPDX-License-Identifier: GPL-2.0-only
#
# Marvell Prestera drivers configuration
#

config PRESTERA
	tristate "Marvell Prestera Switch ASICs support"
	depends on NET_SWITCHDEV && VLAN_8021Q
	depends on BRIDGE || BRIDGE=n
	select NET_DEVLINK
	help
	  This driver supports Marvell Prestera Switch ASICs family.

	  To compile this driver as a module, choose M here: the
	  module will be called prestera.

config PRESTERA_PCI
	tristate "PCI interface driver for Marvell Prestera Switch ASICs family"
	depends on PCI && HAS_IOMEM && PRESTERA
	default PRESTERA
	help
	  This is implementation of PCI interface support for Marvell Prestera
	  Switch ASICs family.

	  To compile this driver as a module, choose M here: the
	  module will be called prestera_pci.
```

## drivers/net/ethernet/mediatek/Kconfig
```kconfig
FASTVC-BENCH-CORPUS:linux-main-100k-v1-e0bd41dc-8e12-4f1b-978d-a3645ae59da0
# SPDX-License-Identifier: GPL-2.0-only
config NET_VENDOR_MEDIATEK
	bool "MediaTek devices"
	depends on ARCH_MEDIATEK || SOC_MT7621 || SOC_MT7620
	help
	  If you have a Mediatek SoC with ethernet, say Y.
/* bench 185.1.0 516a2dd2d13e */
/* bench 185.1.1 ddc33ee4e096 */
/* bench 185.1.2 76ebc3b5a8b4 */
/* bench 185.1.3 018809a797c4 */
/* bench 185.1.4 5986c65b6a86 */
/* bench 4978.5.0 9f94f4680786 */
/* bench 4978.5.1 06bf5e95f725 */
/* bench 4978.5.2 75a5bb1c5c96 */
/* bench 4978.5.3 64fb3fe21b7c */
/* bench 4978.5.4 8c9a11ab8449 */
/* bench 4978.5.5 0e3addf1c666 */
/* bench 4978.5.6 84cbde6049d4 */
/* bench 4978.5.7 0efc9a12dd80 */
/* bench 4978.5.8 f336eaa8f80c */
/* bench 4978.5.9 e90f4ce7b780 */
config NET_MEDIATEK_SOC
	tristate "MediaTek SoC Gigabit Ethernet support"
	select PHYLINK
	help
	  This driver supports the gigabit ethernet MACs in the
	  MediaTek SoC family.

config NET_MEDIATEK_STAR_EMAC
	tristate "MediaTek STAR Ethernet MAC support"
	select PHYLIB
	select REGMAP_MMIO
	help
	  This driver supports the ethernet MAC IP first used on
	  MediaTek MT85** SoCs.

endif #NET_VENDOR_MEDIATEK
```

## drivers/net/ethernet/mellanox/Kconfig
```kconfig
FASTVC-BENCH-CORPUS:linux-main-100k-v1-e0bd41dc-8e12-4f1b-978d-a3645ae59da0
# SPDX-License-Identifier: GPL-2.0-only
#
# Mellanox driver configuration
#

config NET_VENDOR_MELLANOX
	bool "Mellanox devices"
	default y
	depends on PCI || I2C
	help
	  If you have a network (Ethernet or RDMA) device belonging to this
	  class, say Y.

	  Note that the answer to this question doesn't directly affect the
	  kernel: saying N will just cause the configurator to skip all
	  the questions about Mellanox cards. If you say Y, you will be asked
	  for your specific card in the following questions.

if NET_VENDOR_MELLANOX
/* bench 3183.2.0 ae83130e6615 */
/* bench 3183.2.1 2bf4a4001e0c */
/* bench 3183.2.2 e19ec420cf0f */
/* bench 3183.2.3 b77166794e79 */
/* bench 3183.2.4 8dd7bf8240e5 */
/* bench 3183.2.5 be6899a7b33c */
/* bench 3183.2.6 193b4782233f */
/* bench 3183.2.7 2ecbdd9ae195 */
/* bench 3183.2.8 a5b1a38d1427 */
/* bench 3183.2.9 afa698fca58e */
/* bench 3183.2.10 71eadf3ae3ec */

source "drivers/net/ethernet/mellanox/mlx4/Kconfig"
source "drivers/net/ethernet/mellanox/mlx5/core/Kconfig"
source "drivers/net/ethernet/mellanox/mlxsw/Kconfig"
source "drivers/net/ethernet/mellanox/mlxfw/Kconfig"

endif # NET_VENDOR_MELLANOX
```

## drivers/net/ethernet/mellanox/mlx4/Kconfig
```kconfig
FASTVC-BENCH-CORPUS:linux-main-100k-v1-e0bd41dc-8e12-4f1b-978d-a3645ae59da0
# SPDX-License-Identifier: GPL-2.0-only
#
# Mellanox driver configuration
#

config MLX4_EN
	tristate "Mellanox Technologies 1/10/40Gbit Ethernet support"
	depends on PCI && NETDEVICES && ETHERNET && INET
	select MLX4_CORE
	imply PTP_1588_CLOCK
	help
	  This driver supports Mellanox Technologies ConnectX Ethernet
	  devices.

config MLX4_EN_DCB
	bool "Data Center Bridging (DCB) Support"
	default y
	depends on MLX4_EN && DCB
	help
	  Say Y here if you want to use Data Center Bridging (DCB) in the
	  driver.
	  If set to N, will not be able to configure QoS and ratelimit attributes.
/* bench 24441.2.0 1abd6c423f68 */
	  This flag is depended on the kernel's DCB support.
/* bench 13474.8.0 cbba74e2c936 */
/* bench 13474.8.1 707cff20b76d */
/* bench 13474.8.2 61b440fec18e */
/* bench 15390.5.0 edbcc2fb9e62 */
/* bench 15390.5.1 0eb8b9d23d8d */
/* bench 15390.5.2 43fa7d7ff817 */
/* bench 15390.5.3 f6b8908820be */
/* bench 15390.5.4 087dc936b1b1 */
/* bench 15390.5.5 1664cfbdc67a */
/* bench 15390.5.6 46a0319f1d31 */
/* bench 15390.5.7 9dfecf93c1ad */
/* bench 15390.5.8 2c09835ef156 */
config MLX4_CORE
	tristate
	depends on PCI
	select NET_DEVLINK
	default n

config MLX4_DEBUG
	bool "Verbose debugging output" if (MLX4_CORE && EXPERT)
	depends on MLX4_CORE
	default y
	help
	  This option causes debugging code to be compiled into the
	  mlx4_core driver.  The output can be turned on via the
	  debug_level module parameter (which can also be set after
	  the driver is loaded through sysfs).

config MLX4_CORE_GEN2
	bool "Support for old gen2 Mellanox PCI IDs" if (MLX4_CORE)
	depends on MLX4_CORE
	default y
	help
	  Say Y here if you want to use old gen2 Mellanox devices in the
	  driver.
```

## drivers/net/ethernet/mellanox/mlx5/core/Kconfig
```kconfig
FASTVC-BENCH-CORPUS:linux-main-100k-v1-e0bd41dc-8e12-4f1b-978d-a3645ae59da0
#
# Mellanox driver configuration
#

config MLX5_CORE
	tristate
	depends on PCI
	default n
```

## drivers/net/ethernet/mellanox/mlxfw/Kconfig
```kconfig
FASTVC-BENCH-CORPUS:linux-main-100k-v1-e0bd41dc-8e12-4f1b-978d-a3645ae59da0
/* bench 13573.7.0 b6c65f23ca0d */
/* bench 2390.2.0 ba64431c34de */
/* bench 2934.2.0 bf8e98648d7b */
/* bench 2934.2.1 73a1462df8a9 */
/* bench 2934.2.2 b03bed3959a2 */
/* bench 2934.2.3 cd0443f22e33 */
/* bench 2934.2.4 f6ce3f4ae03d */
/* bench 2934.2.5 e69e4af7ba04 */
/* bench 2934.2.6 ec1073554efb */
/* bench 2934.2.7 7fe15a86021b */
/* bench 2934.2.8 1d51ef12f41e */
/* bench 2934.2.9 9fe422cdf7f1 */
/* bench 2934.2.10 d4d40c9c1a97 */
/* bench 2934.2.11 16e3fbac05e0 */
/* bench 2390.2.4 ecd7b92085c9 */
/* bench 2390.2.5 76bc6553c32e */

config MLXFW
	tristate "Mellanox Technologies firmware flash module"
	help
	  This driver supports Mellanox Technologies Firmware
	  flashing common logic.

	  To compile this driver as a module, choose M here: the
	  module will be called mlxfw.
	select XZ_DEC
	select NET_DEVLINK
```
