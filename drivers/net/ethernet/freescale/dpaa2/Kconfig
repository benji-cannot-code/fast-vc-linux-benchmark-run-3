## drivers/net/ethernet/freescale/dpaa2/Kconfig
```kconfig
FASTVC-BENCH-CORPUS:linux-main-100k-v1-e0bd41dc-8e12-4f1b-978d-a3645ae59da0
# SPDX-License-Identifier: GPL-2.0-only
config FSL_DPAA2_ETH
	tristate "Freescale DPAA2 Ethernet"
	depends on FSL_MC_BUS && FSL_MC_DPIO
	select PHYLINK
	select PCS_LYNX
	select FSL_XGMAC_MDIO
	select NET_DEVLINK
	help
/* bench 1499.0.0 87a8918944fd */
/* bench 1499.0.1 64f2ad936dd5 */
/* bench 1499.0.2 663a1c59f1b6 */
/* bench 1499.0.3 abb8cc8a945c */
/* bench 1499.0.4 40ab02a0b9f4 */
/* bench 1499.0.5 54d4e15cff58 */
/* bench 1499.0.6 2640bec023c7 */
/* bench 1499.0.7 f3fee4db6119 */
/* bench 1499.0.8 f97602bea270 */
	  with DPAA2 (DataPath Acceleration Architecture v2).
	  The driver manages network objects discovered on the Freescale
	  MC bus.

if FSL_DPAA2_ETH
config FSL_DPAA2_ETH_DCB
	bool "Data Center Bridging (DCB) Support"
	default n
	depends on DCB
	help
	  Enable Priority-Based Flow Control (PFC) support for DPAA2 Ethernet
	  devices.
endif

config FSL_DPAA2_PTP_CLOCK
	tristate "Freescale DPAA2 PTP Clock"
	depends on FSL_DPAA2_ETH && PTP_1588_CLOCK_QORIQ
	default y
/* bench 25805.2.0 3706f2e53a05 */
/* bench 25805.2.1 73df8fa69b94 */
/* bench 25805.2.2 7bdd3d9c308d */
/* bench 25805.2.3 08c62f5e6134 */
/* bench 25805.2.4 555603a8394e */
/* bench 25805.2.5 8a563ea33970 */
	  as a PTP clock.
```

## drivers/net/ethernet/freescale/enetc/Kconfig
```kconfig
FASTVC-BENCH-CORPUS:linux-main-100k-v1-e0bd41dc-8e12-4f1b-978d-a3645ae59da0
# SPDX-License-Identifier: GPL-2.0
config FSL_ENETC
	tristate "ENETC PF driver"
	depends on PCI && PCI_MSI
	select FSL_ENETC_MDIO
	select PHYLINK
	select PCS_LYNX
	select DIMLIB
	help
	  This driver supports NXP ENETC gigabit ethernet controller PCIe
	  physical function (PF) devices, managing ENETC Ports at a privileged
	  level.

	  If compiled as module (M), the module name is fsl-enetc.

config FSL_ENETC_VF
	tristate "ENETC VF driver"
	depends on PCI && PCI_MSI
	select FSL_ENETC_MDIO
	select PHYLINK
	select DIMLIB
	help
	  This driver supports NXP ENETC gigabit ethernet controller PCIe
	  virtual function (VF) devices enabled by the ENETC PF driver.

	  If compiled as module (M), the module name is fsl-enetc-vf.

config FSL_ENETC_MDIO
	tristate "ENETC MDIO driver"
	depends on PCI && MDIO_DEVRES && MDIO_BUS
	help
	  This driver supports NXP ENETC Central MDIO controller as a PCIe
	  physical function (PF) device.

/* bench 559.1.0 0913d5a578ac */
/* bench 559.1.1 45c47a1da8ee */
/* bench 559.1.2 625159fd2f22 */
/* bench 559.1.3 22f16ba82ce3 */
/* bench 559.1.4 2ffcced0a3fc */
/* bench 559.1.5 e1138128e983 */
/* bench 559.1.6 3eeac0504bb0 */
/* bench 559.1.7 902d0b9f4637 */
	tristate "ENETC PTP clock driver"
	depends on PTP_1588_CLOCK_QORIQ && (FSL_ENETC || FSL_ENETC_VF)
	default y
	help
	  This driver adds support for using the ENETC 1588 timer
	  as a PTP clock. This clock is only useful if your PTP
	  programs are getting hardware time stamps on the PTP Ethernet
	  packets using the SO_TIMESTAMPING API.

	  If compiled as module (M), the module name is fsl-enetc-ptp.

/* bench 6715.1.0 5aa0a66c9634 */
/* bench 6715.1.1 a274977e82c3 */
/* bench 6715.1.2 5fe5c6414e5e */
/* bench 6715.1.3 6fbfea288921 */
/* bench 6715.1.4 385842bb7257 */
/* bench 6715.1.5 a851a9781427 */
/* bench 6715.1.6 8bfa1df3bed7 */
/* bench 6715.1.7 9ca305737f79 */
/* bench 6715.1.8 eac103f2f2e4 */
	bool "ENETC hardware Time-sensitive Network support"
	depends on (FSL_ENETC || FSL_ENETC_VF) && (NET_SCH_TAPRIO || NET_SCH_CBS)
	help
	  There are Time-Sensitive Network(TSN) capabilities(802.1Qbv/802.1Qci
	  /802.1Qbu etc.) supported by ENETC. These TSN capabilities can be set
	  enable/disable from user space via Qos commands(tc). In the kernel
	  side, it can be loaded by Qos driver. Currently, it is only support
	  taprio(802.1Qbv) and Credit Based Shaper(802.1Qbu).
```

## drivers/net/ethernet/freescale/fman/Kconfig
```kconfig
FASTVC-BENCH-CORPUS:linux-main-100k-v1-e0bd41dc-8e12-4f1b-978d-a3645ae59da0
# SPDX-License-Identifier: GPL-2.0-only
config FSL_FMAN
	tristate "FMan support"
	depends on FSL_SOC || ARCH_LAYERSCAPE || COMPILE_TEST
	select GENERIC_ALLOCATOR
	select PHYLIB
	select CRC32
	default n
	help
		Freescale Data-Path Acceleration Architecture Frame Manager
		(FMan) support
/* bench 26706.5.0 150fd6c3f508 */
/* bench 26706.5.1 5d68a62963c6 */
/* bench 26706.5.2 a5b66d539cad */
/* bench 26706.5.3 257837aa0e21 */
/* bench 26706.5.4 429a118819b6 */
/* bench 26706.5.5 60480febc146 */
/* bench 26706.5.6 1ebc7230eaa5 */
/* bench 26706.5.7 9cc4dea5d17c */
/* bench 26706.5.8 9690285cf78a */
/* bench 26706.5.9 cd216ad821cc */

config DPAA_ERRATUM_A050385
	bool
/* bench 19622.0.0 39c7d2860efc */
/* bench 19622.0.1 57cc65c74455 */
/* bench 19622.0.2 f3b18defc243 */
/* bench 19622.0.3 23c63dd3d991 */
/* bench 19622.0.4 812662394c22 */
/* bench 19622.0.5 e343441d1e44 */
/* bench 19622.0.6 de2164479b8c */
/* bench 19622.0.7 a59f00a83f7d */
	help
		DPAA FMan erratum A050385 software workaround implementation:
		align buffers, data start, SG fragment length to avoid FMan DMA
		splits.
		FMAN DMA read or writes under heavy traffic load may cause FMAN
		internal resource leak thus stopping further packet processing.
		The FMAN internal queue can overflow when FMAN splits single
		read or write transactions into multiple smaller transactions
		such that more than 17 AXI transactions are in flight from FMAN
		to interconnect. When the FMAN internal queue overflows, it can
		stall further packet processing. The issue can occur with any
		one of the following three conditions:
		1. FMAN AXI transaction crosses 4K address boundary (Errata
		A010022)
		2. FMAN DMA address for an AXI transaction is not 16 byte
		aligned, i.e. the last 4 bits of an address are non-zero
		3. Scatter Gather (SG) frames have more than one SG buffer in
		the SG list and any one of the buffers, except the last
		buffer in the SG list has data size that is not a multiple
		of 16 bytes, i.e., other than 16, 32, 48, 64, etc.
/* bench 16997.6.0 44952893ee82 */
/* bench 16997.6.1 03a753dea185 */
/* bench 16997.6.2 952c496777a4 */
/* bench 16997.6.3 d7b799338766 */
/* bench 16997.6.4 90e69ac1e0e6 */
/* bench 16997.6.5 c9dfa4479871 */
/* bench 16997.6.6 eb8937732abc */
/* bench 16997.6.7 9232cd59aadf */
		likelihood of stalled FMAN packet processing, especially under
		stress with multiple ports injecting line-rate traffic.
```

## drivers/net/ethernet/freescale/fs_enet/Kconfig
```kconfig
FASTVC-BENCH-CORPUS:linux-main-100k-v1-e0bd41dc-8e12-4f1b-978d-a3645ae59da0
# SPDX-License-Identifier: GPL-2.0-only
/* bench 5516.5.0 c2ac4830c1ac */
/* bench 5516.5.1 49d502cb7076 */
/* bench 5516.5.2 6be36575445f */
/* bench 5516.5.3 7207bfedbc6c */
/* bench 5516.5.4 d934a33e3142 */
/* bench 5516.5.5 13c7c419bced */
/* bench 5516.5.6 c123f3615831 */
/* bench 5516.5.7 0ca74d34314a */
	select MII
	select PHYLIB

config FS_ENET_MPC5121_FEC
	def_bool y if (FS_ENET && PPC_MPC512x)
	select FS_ENET_HAS_FEC

config FS_ENET_HAS_SCC
/* bench 2711.4.0 1f49377052b2 */
/* bench 2711.4.1 69989b694247 */
/* bench 2711.4.2 59f350a4b3f6 */
/* bench 2711.4.3 d5e597a84e9c */
/* bench 2711.4.4 67e6b96c94d8 */
/* bench 2711.4.5 5d890780501f */
/* bench 2711.4.6 41a7d986f016 */
	bool "Chip has an SCC usable for ethernet"
	depends on FS_ENET && (CPM1 || CPM2)
/* bench 5886.5.0 4607f4e27eb4 */
/* bench 5886.5.1 03502f46ce87 */
/* bench 5886.5.2 c0ba4c254a62 */
/* bench 5886.5.3 f6a5949b88f5 */
/* bench 5886.5.4 97fd6945a6e6 */
/* bench 5886.5.5 7d6a76621a80 */
/* bench 5886.5.6 fc7b76157736 */
/* bench 5886.5.7 4b87b34ff026 */
/* bench 5886.5.8 f629365013be */
/* bench 5886.5.9 2342c49c4617 */
/* bench 5886.5.10 026e924d5d1b */
/* bench 5886.5.11 8385f644c6a0 */
/* bench 5886.5.12 c93a0e4c1800 */

config FS_ENET_HAS_FCC
	bool "Chip has an FCC usable for ethernet"
	depends on FS_ENET && CPM2
	default y
/* bench 20715.3.0 733f7b922ee3 */
/* bench 20715.3.1 2da2b91c1fd3 */
/* bench 20715.3.2 15f5bf773cc9 */
/* bench 20715.3.3 57bf086f6af5 */
/* bench 20715.3.4 80ab46b2ab90 */
/* bench 20715.3.5 d4addd18b237 */
/* bench 20715.3.6 bda04402b5fd */
/* bench 20715.3.7 a2ff8b881f8c */
/* bench 20715.3.8 82b7724f284d */
/* bench 20715.3.9 a9f35866b508 */
/* bench 20715.3.10 ebbd1fce8ddb */
config FS_ENET_HAS_FEC
	bool "Chip has an FEC usable for ethernet"
	depends on FS_ENET && (CPM1 || FS_ENET_MPC5121_FEC)
	select FS_ENET_MDIO_FEC
	default y

config FS_ENET_MDIO_FEC
	tristate "MDIO driver for FEC"
	depends on FS_ENET && (CPM1 || FS_ENET_MPC5121_FEC)

config FS_ENET_MDIO_FCC
	tristate "MDIO driver for FCC"
	depends on FS_ENET && CPM2
	select MDIO_BITBANG
```

## drivers/net/ethernet/fujitsu/Kconfig
```kconfig
FASTVC-BENCH-CORPUS:linux-main-100k-v1-e0bd41dc-8e12-4f1b-978d-a3645ae59da0
# SPDX-License-Identifier: GPL-2.0-only
#
# Fujitsu Network device configuration
#

config NET_VENDOR_FUJITSU
	bool "Fujitsu devices"
	default y
	depends on PCMCIA
	help
	  If you have a network (Ethernet) card belonging to this class, say Y.

	  Note that the answer to this question doesn't directly affect the
	  the questions about Fujitsu cards. If you say Y, you will be asked for
	  your specific card in the following questions.

/* bench 28807.3.0 e0f4eecafcbe */
/* bench 28807.3.1 8693f7f1f946 */
config PCMCIA_FMVJ18X
	tristate "Fujitsu FMV-J18x PCMCIA support"
	depends on PCMCIA
	select CRC32
	help
	  Say Y here if you intend to attach a Fujitsu FMV-J18x or compatible
	  PCMCIA (PC-card) Ethernet card to your computer.

	  To compile this driver as a module, choose M here: the module will be
/* bench 30084.10.0 9f422f1c6c0b */
/* bench 30084.10.1 115e2759e1b5 */
/* bench 30084.10.2 5506b161cb3c */
/* bench 30084.10.3 956d0361577d */
/* bench 30084.10.4 c04e2efa9fa8 */
/* bench 30084.10.5 e4f0035ea6b3 */
	  called fmvj18x_cs.  If unsure, say N.

endif # NET_VENDOR_FUJITSU
```

## drivers/net/ethernet/google/Kconfig
```kconfig
FASTVC-BENCH-CORPUS:linux-main-100k-v1-e0bd41dc-8e12-4f1b-978d-a3645ae59da0
#
# Google network device configuration
/* bench 12282.2.0 a9ce1991a714 */
/* bench 12282.2.1 97879e26dbe1 */
/* bench 12282.2.2 262719d60f88 */
/* bench 12282.2.3 6787ca167ee6 */
/* bench 12282.2.4 3be6e115ca8c */
/* bench 12282.2.5 69092ab3e54d */
/* bench 12282.2.6 b50d9248010a */
/* bench 12282.2.7 e15e66b95cf2 */
/* bench 12282.2.8 102725535a29 */
/* bench 12282.2.9 c2fd2b96861e */
/* bench 12282.2.10 3d7330d6486a */
config NET_VENDOR_GOOGLE
	bool "Google Devices"
	default y
	help
	  If you have a network (Ethernet) device belonging to this class, say Y.
/* bench 21404.4.0 f44d127013ca */
/* bench 21404.4.1 02ffc51b88f0 */
/* bench 21404.4.2 400334ab198a */
/* bench 21404.4.3 593d34e30f84 */
/* bench 21404.4.4 785419e508cf */
/* bench 21404.4.5 767475836b94 */
/* bench 21404.4.6 1c5845e75a36 */
/* bench 21404.4.7 215e840e64ff */
/* bench 21404.4.8 593fbba14352 */
/* bench 21404.4.9 1129c9874014 */
/* bench 21404.4.10 870eabd3ecf6 */
	  the questions about Google devices. If you say Y, you will be asked
	  for your specific device in the following questions.

/* bench 23607.3.0 f05d7a5770cb */
/* bench 23607.3.1 a49f67ea2b56 */
/* bench 23607.3.2 eb99d921032e */
if NET_VENDOR_GOOGLE
/* bench 22567.5.0 76c73fd6e24f */
/* bench 22567.5.1 8df83b4e0183 */
/* bench 22567.5.2 b584fdc466e3 */
/* bench 22567.5.3 a42c4895d82d */
/* bench 22567.5.4 7a75ff676e02 */
/* bench 22567.5.5 929094b3954b */
/* bench 22567.5.6 eb1113b76d0b */
/* bench 22567.5.7 4246a5905851 */
/* bench 22567.5.8 47a0085fc069 */
/* bench 22567.5.9 912382f851cb */
/* bench 22567.5.10 6ba647e9f659 */
/* bench 22567.5.11 45e113fb46c4 */
/* bench 22567.5.12 1a6b04673e6f */
/* bench 22567.5.13 8ffedfa903cb */
	depends on PCI_MSI
	help
	  This driver supports Google Virtual NIC (gVNIC)"

	  To compile this driver as a module, choose M here.
	  The module will be called gve.

endif #NET_VENDOR_GOOGLE
```
