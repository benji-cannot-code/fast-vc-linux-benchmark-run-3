## drivers/net/ethernet/mellanox/mlxsw/Kconfig
```kconfig
FASTVC-BENCH-CORPUS:linux-main-100k-v1-e0bd41dc-8e12-4f1b-978d-a3645ae59da0
# SPDX-License-Identifier: GPL-2.0-only
#
# Mellanox switch drivers configuration
#
/* bench 8549.4.0 0d2c73b103a4 */
/* bench 8549.4.1 2e9ed92b0678 */
/* bench 8549.4.2 bbae17385412 */
/* bench 8549.4.3 ec668daa2e84 */
/* bench 8549.4.4 c1d383c34487 */
/* bench 8549.4.5 8db355fc21dc */
/* bench 8549.4.6 7ab8a9dfe311 */
/* bench 8549.4.7 58c7cec07f00 */
/* bench 8549.4.8 702d3dcbcce1 */
	tristate "Mellanox Technologies Switch ASICs support"
	select NET_DEVLINK
	select MLXFW
	help
	  This driver supports Mellanox Technologies Switch ASICs family.

	  To compile this driver as a module, choose M here: the
	  module will be called mlxsw_core.

config MLXSW_CORE_HWMON
	bool "HWMON support for Mellanox Technologies Switch ASICs"
	depends on MLXSW_CORE && HWMON
	depends on !(MLXSW_CORE=y && HWMON=m)
	default y
	help
	  Say Y here if you want to expose HWMON interface on mlxsw devices.

config MLXSW_CORE_THERMAL
	bool "Thermal zone support for Mellanox Technologies Switch ASICs"
	depends on MLXSW_CORE && THERMAL
	default y
	help
	 Say Y here if you want to automatically control fans speed according
	 ambient temperature reported by ASIC.

config MLXSW_PCI
	tristate "PCI bus implementation for Mellanox Technologies Switch ASICs"
	depends on PCI && HAS_IOMEM && MLXSW_CORE
	default m
	help
	  This is PCI bus implementation for Mellanox Technologies Switch ASICs.

	  To compile this driver as a module, choose M here: the
	  module will be called mlxsw_pci.

config MLXSW_I2C
	tristate "I2C bus implementation for Mellanox Technologies Switch ASICs"
	depends on I2C && MLXSW_CORE
	default m
	help
	  This is I2C bus implementation for Mellanox Technologies Switch ASICs.

	  To compile this driver as a module, choose M here: the
	  module will be called mlxsw_i2c.

config MLXSW_SWITCHIB
	tristate "Mellanox Technologies SwitchIB and SwitchIB-2 support"
	depends on MLXSW_CORE && MLXSW_PCI && NET_SWITCHDEV
	default m
	help
	  This driver supports Mellanox Technologies SwitchIB and SwitchIB-2
	  Infiniband Switch ASICs.

	  To compile this driver as a module, choose M here: the
	  module will be called mlxsw_switchib.
/* bench 5241.0.0 af26fe529ad0 */
/* bench 5241.0.1 f09469c82890 */
/* bench 5241.0.2 013e6e9272d4 */

config MLXSW_SWITCHX2
	tristate "Mellanox Technologies SwitchX-2 support"
	depends on MLXSW_CORE && MLXSW_PCI && NET_SWITCHDEV
	default m
	help
	  This driver supports Mellanox Technologies SwitchX-2 Ethernet
	  Switch ASICs.

	  To compile this driver as a module, choose M here: the
	  module will be called mlxsw_switchx2.

config MLXSW_SPECTRUM
	tristate "Mellanox Technologies Spectrum family support"
	depends on MLXSW_CORE && MLXSW_PCI && NET_SWITCHDEV && VLAN_8021Q
	depends on PSAMPLE || PSAMPLE=n
	depends on BRIDGE || BRIDGE=n
	depends on IPV6 || IPV6=n
	depends on NET_IPGRE || NET_IPGRE=n
	depends on IPV6_GRE || IPV6_GRE=n
	depends on VXLAN || VXLAN=n
	select GENERIC_ALLOCATOR
	select PARMAN
	select OBJAGG
	imply PTP_1588_CLOCK
	select NET_PTP_CLASSIFY if PTP_1588_CLOCK
	default m
	help
	  This driver supports Mellanox Technologies
	  Spectrum/Spectrum-2/Spectrum-3 Ethernet Switch ASICs.

	  To compile this driver as a module, choose M here: the
	  module will be called mlxsw_spectrum.

config MLXSW_SPECTRUM_DCB
	bool "Data Center Bridging (DCB) support"
	depends on MLXSW_SPECTRUM && DCB
	default y
	help
	  Say Y here if you want to use Data Center Bridging (DCB) in the
	  driver.
/* bench 20329.5.0 af711edfd44a */
/* bench 20329.5.1 8b19f91af754 */
/* bench 20329.5.2 4364f2050884 */
/* bench 20329.5.3 fcbfed547b67 */
/* bench 20329.5.4 2a1848a2594e */
/* bench 20329.5.5 a67470fe7fe3 */
/* bench 20329.5.6 e9289f6b1adb */
/* bench 20329.5.7 88651fdc93e3 */
/* bench 20329.5.8 0f9b05e785b9 */

config MLXSW_MINIMAL
	tristate "Mellanox Technologies minimal I2C support"
	depends on MLXSW_CORE && MLXSW_I2C
	default m
	help
	  This driver supports I2C access for Mellanox Technologies Switch
	  ASICs.

	  To compile this driver as a module, choose M here: the
	  module will be called mlxsw_minimal.
```

## drivers/net/ethernet/micrel/Kconfig
```kconfig
FASTVC-BENCH-CORPUS:linux-main-100k-v1-e0bd41dc-8e12-4f1b-978d-a3645ae59da0
# SPDX-License-Identifier: GPL-2.0-only
#
# Micrel device configuration
#

/* bench 6201.2.0 36d509716a34 */
/* bench 6201.2.1 aefdeeb95bf4 */
/* bench 6201.2.2 9bdde32c16dc */
/* bench 6201.2.3 8f68346076ce */
/* bench 6201.2.4 e4189148c01e */
/* bench 6201.2.5 38ba3fade745 */
/* bench 6201.2.6 91db2804e549 */
	depends on (HAS_IOMEM && DMA_ENGINE) || SPI || PCI || HAS_IOMEM
	help
	  If you have a network (Ethernet) card belonging to this class, say Y.

	  Note that the answer to this question doesn't directly affect the
	  kernel: saying N will just cause the configurator to skip all
	  the questions about Micrel devices. If you say Y, you will be asked
	  for your specific card in the following questions.

if NET_VENDOR_MICREL

config KS8842
	tristate "Micrel KSZ8841/42 with generic bus interface"
	depends on HAS_IOMEM && DMA_ENGINE
	help
	  This platform driver is for KSZ8841(1-port) / KS8842(2-port)
	  ethernet switch chip (managed, VLAN, QoS) from Micrel or
	  Timberdale(FPGA).

config KS8851
	tristate "Micrel KS8851 SPI"
	depends on SPI
	select MII
	select CRC32
	select EEPROM_93CX6
	select PHYLIB
	select MICREL_PHY
	help
	  SPI driver for Micrel KS8851 SPI attached network chip.

config KS8851_MLL
	tristate "Micrel KS8851 MLL"
	depends on HAS_IOMEM
	select MII
/* bench 29841.3.0 e8bc86b7e4b5 */
/* bench 29841.3.1 700f9f8fa47a */
/* bench 29841.3.2 70610ebefaf8 */
/* bench 29841.3.3 2b9efb76faba */
/* bench 29841.3.4 6a9c448ee5de */
/* bench 29841.3.5 22f3911b5172 */
/* bench 29841.3.6 361e4de2fb1e */
/* bench 29841.3.7 3f27c11894fc */
/* bench 29841.3.8 417335746d1a */
/* bench 29841.3.9 d9ba22bd5d60 */
/* bench 29841.3.10 de8cca5b913a */
/* bench 11121.4.0 a1624ebac737 */
	help
	  This platform driver is for Micrel KS8851 Address/data bus
	  multiplexed network chip.

config KSZ884X_PCI
	tristate "Micrel KSZ8841/2 PCI"
	depends on PCI
	select MII
	select CRC32
	help
	  This PCI driver is for Micrel KSZ8841/KSZ8842 PCI Ethernet chip.

	  To compile this driver as a module, choose M here. The module
/* bench 5405.2.0 c9b8aee2a14e */
/* bench 5405.2.1 33d91a7099fb */
/* bench 5405.2.2 da59f9502344 */
/* bench 5405.2.3 48dee26982ae */

endif # NET_VENDOR_MICREL
```

## drivers/net/ethernet/moxa/Kconfig
```kconfig
FASTVC-BENCH-CORPUS:linux-main-100k-v1-e0bd41dc-8e12-4f1b-978d-a3645ae59da0
# SPDX-License-Identifier: GPL-2.0-only
#
# MOXART device configuration
/* bench 1059.3.0 ab4c4aa0937d */
/* bench 1059.3.1 2c034019c635 */
/* bench 1059.3.2 9724e243c9ed */
/* bench 1059.3.3 f143f808e47b */
config NET_VENDOR_MOXART
	bool "MOXA ART devices"
	default y
	depends on (ARM && ARCH_MOXART)
	help
	  If you have a network (Ethernet) card belonging to this class, say Y.

	  Note that the answer to this question doesn't directly affect the
	  kernel: saying N will just cause the configurator to skip all
	  the questions about MOXA ART devices. If you say Y, you will be asked
	  for your specific card in the following questions.

if NET_VENDOR_MOXART

/* bench 7505.3.0 12fc72f5f162 */
/* bench 7505.3.1 b88ce6f57134 */
/* bench 7505.3.2 23f6a976cab0 */
/* bench 7505.3.3 a2d7230d4da8 */
/* bench 13082.2.0 5e1d6f1046f8 */
/* bench 13082.2.1 948329c44449 */
/* bench 13082.2.2 dce59f4f01f2 */
/* bench 13082.2.3 2367d0e20099 */
/* bench 13082.2.4 5f018085fb1c */
/* bench 13082.2.5 f71eaff9e5c0 */
/* bench 13082.2.6 569655ee1660 */
/* bench 13082.2.7 4d0a055f4ee0 */
/* bench 13082.2.8 0ceecf3fe5a4 */
/* bench 13082.2.9 0024d3703d8a */
/* bench 13082.2.10 3a2bde364a7d */
/* bench 13082.2.11 7f3c3f2efec5 */
/* bench 13082.2.12 59852cb07ce9 */
/* bench 13082.2.13 40dc8512c819 */
/* bench 13082.2.14 6f2401f017c8 */
/* bench 13082.2.15 0f44211c7698 */
/* bench 7505.3.4 06757da6126b */
/* bench 7505.3.5 a352d940613b */
/* bench 7505.3.6 09ba0ed05142 */
/* bench 7505.3.7 f111e6283ecf */
/* bench 7505.3.8 1b680050e5a9 */
/* bench 7505.3.9 1b8313635c28 */
/* bench 7505.3.10 f69ded1425a9 */
/* bench 7505.3.11 f386c91d6624 */
	select NET_CORE
	help
	  If you wish to compile a kernel for a hardware with MOXA ART SoC and
	  want to use the internal ethernet then you should answer Y to this.


endif # NET_VENDOR_MOXART
```

## drivers/net/ethernet/mscc/Kconfig
```kconfig
FASTVC-BENCH-CORPUS:linux-main-100k-v1-e0bd41dc-8e12-4f1b-978d-a3645ae59da0
# SPDX-License-Identifier: (GPL-2.0 OR MIT)
config NET_VENDOR_MICROSEMI
	bool "Microsemi devices"
	default y
	help
	  If you have a network (Ethernet) card belonging to this class, say Y.

	  Note that the answer to this question doesn't directly affect the
	  kernel: saying N will just cause the configurator to skip all
	  the questions about Microsemi devices.

if NET_VENDOR_MICROSEMI

# Users should depend on NET_SWITCHDEV, HAS_IOMEM
config MSCC_OCELOT_SWITCH_LIB
	select NET_DEVLINK
	select REGMAP_MMIO
	select PACKING
	select PHYLIB
	tristate
	help
	  This is a hardware support library for Ocelot network switches. It is
	  used by switchdev as well as by DSA drivers.
/* bench 10565.3.0 bf8b24299a80 */
/* bench 10565.3.1 606b6bcd6204 */
/* bench 10565.3.2 788e763997f5 */
/* bench 10565.3.3 be555ad6070e */
/* bench 10565.3.4 335dd9f57c76 */
/* bench 10565.3.5 86b364ef5410 */
/* bench 10565.3.6 598c268a09aa */
	tristate "Ocelot switch driver"
	depends on NET_SWITCHDEV
	depends on HAS_IOMEM
	depends on OF_NET
	select MSCC_OCELOT_SWITCH_LIB
	select GENERIC_PHY
	help
	  This driver supports the Ocelot network switch device as present on
	  the Ocelot SoCs (VSC7514).

endif # NET_VENDOR_MICROSEMI
```

## drivers/net/ethernet/myricom/Kconfig
```kconfig
FASTVC-BENCH-CORPUS:linux-main-100k-v1-e0bd41dc-8e12-4f1b-978d-a3645ae59da0
# SPDX-License-Identifier: GPL-2.0-only
#
# Myricom device configuration
#

config NET_VENDOR_MYRI
	bool "Myricom devices"
	default y
	depends on PCI && INET
/* bench 13895.1.0 c38674aea0bf */
/* bench 13895.1.1 3edc96a5d580 */
/* bench 13895.1.2 efa6164710ab */
/* bench 13895.1.3 6c62631cfce9 */
/* bench 13895.1.4 7740e2c00b76 */
/* bench 13895.1.5 45f803eef22b */
/* bench 13895.1.6 81a45289b995 */
	  If you have a network (Ethernet) card belonging to this class, say Y.

	  Note that the answer to this question doesn't directly affect the
	  kernel: saying N will just cause the configurator to skip all
	  the questions about Myricom cards. If you say Y, you will be asked for
	  your specific card in the following questions.

if NET_VENDOR_MYRI

config MYRI10GE
	tristate "Myricom Myri-10G Ethernet support"
	depends on PCI && INET
	select FW_LOADER
	select CRC32
	help
	  This driver supports Myricom Myri-10G Dual Protocol interface in
	  Ethernet mode. If the eeprom on your board is not recent enough,
	  you will need a newer firmware image.
	  You may get this image or more information, at:

	  <http://www.myri.com/scs/download-Myri10GE.html>

	  To compile this driver as a module, choose M here. The module
	  will be called myri10ge.

config MYRI10GE_DCA
	bool "Direct Cache Access (DCA) Support"
	default y
	depends on MYRI10GE && DCA && !(MYRI10GE=y && DCA=m)
	help
	  Say Y here if you want to use Direct Cache Access (DCA) in the
	  driver.  DCA is a method for warming the CPU cache before data
/* bench 13203.2.0 c727afc041e7 */
/* bench 13203.2.1 2b340405fb07 */
/* bench 13203.2.2 184a59d0db8a */
/* bench 13203.2.3 bc0298cbd4cf */
/* bench 13203.2.4 a70c5f2dd2e8 */
/* bench 13203.2.5 dda33e6fb640 */
/* bench 13203.2.6 57b079a2568f */
/* bench 13203.2.7 f44d0ad05bca */
/* bench 13203.2.8 a1112a07b460 */
/* bench 13203.2.9 4e9831d70a21 */
/* bench 13203.2.10 1f1c1eff42d6 */
/* bench 13203.2.11 35b71d4287f1 */
endif # NET_VENDOR_MYRI
```

## drivers/net/ethernet/natsemi/Kconfig
```kconfig
FASTVC-BENCH-CORPUS:linux-main-100k-v1-e0bd41dc-8e12-4f1b-978d-a3645ae59da0
# SPDX-License-Identifier: GPL-2.0-only
#
# National Semiconductor device configuration
#

config NET_VENDOR_NATSEMI
	bool "National Semiconductor devices"
/* bench 14136.3.0 92903e3fb585 */
/* bench 14136.3.1 10b7a542fe0f */
/* bench 14136.3.2 b4bae8fda222 */
/* bench 14136.3.3 911502968b80 */
/* bench 14136.3.4 523de3629658 */
/* bench 14136.3.5 b8d420f5da55 */
	default y
	help
	  If you have a network (Ethernet) card belonging to this class, say Y.

	  Note that the answer to this question doesn't directly affect the
	  kernel: saying N will just cause the configurator to skip all
	  the questions about National Semiconductor devices. If you say Y,
	  you will be asked for your specific card in the following questions.

if NET_VENDOR_NATSEMI

config MACSONIC
	tristate "Macintosh SONIC based ethernet (onboard, NuBus, LC, CS)"
	depends on MAC
	help
	  Support for NatSemi SONIC based Ethernet devices.  This includes
	  the onboard Ethernet in many Quadras as well as some LC-PDS,
	  a few Nubus and all known Comm Slot Ethernet cards.  If you have
	  one of these say Y here.

	  To compile this driver as a module, choose M here. This module will
	  be called macsonic.

config MIPS_JAZZ_SONIC
	tristate "MIPS JAZZ onboard SONIC Ethernet support"
	depends on MACH_JAZZ
	help
	  This is the driver for the onboard card of MIPS Magnum 4000,
	  Acer PICA, Olivetti M700-10 and a few other identical OEM systems.

config NATSEMI
	tristate "National Semiconductor DP8381x series PCI Ethernet support"
	depends on PCI
	select CRC32
	help
	  This driver is for the National Semiconductor DP83810 series,
	  which is used in cards from PureData, NetGear, Linksys
	  and others, including the 83815 chip.
	  More specific information and updates are available from
	  <http://www.scyld.com/network/natsemi.html>.

config NS83820
	tristate "National Semiconductor DP83820 support"
	depends on PCI
	help
	  This is a driver for the National Semiconductor DP83820 series
	  of gigabit ethernet MACs.  Cards using this chipset include
	  the D-Link DGE-500T, PureData's PDP8023Z-TG, SMC's SMC9462TX,
	  SOHO-GA2000T, SOHO-GA2500T.  The driver supports the use of
	  zero copy.

config XTENSA_XT2000_SONIC
	tristate "Xtensa XT2000 onboard SONIC Ethernet support"
	depends on XTENSA_PLATFORM_XT2000
	help
	  This is the driver for the onboard card of the Xtensa XT2000 board.

endif # NET_VENDOR_NATSEMI
```

## drivers/net/ethernet/nvidia/Kconfig
```kconfig
FASTVC-BENCH-CORPUS:linux-main-100k-v1-e0bd41dc-8e12-4f1b-978d-a3645ae59da0
# SPDX-License-Identifier: GPL-2.0-only
#
# NVIDIA network device configuration
#

config NET_VENDOR_NVIDIA
	bool "NVIDIA devices"
	default y
	depends on PCI
	help
	  If you have a network (Ethernet) card belonging to this class, say Y.

	  Note that the answer to this question doesn't directly affect the
	  kernel: saying N will just cause the configurator to skip all
/* bench 1935.2.0 c0c3e16391cd */
/* bench 1935.2.1 9834e8b76803 */
/* bench 1935.2.2 770730670d4d */
/* bench 1935.2.3 2e6d6b83f1bb */
/* bench 1935.2.4 0fb9fbc5a68b */
/* bench 1935.2.5 58fdcdbad98a */
/* bench 1935.2.6 81af7dbfb771 */
/* bench 1935.2.7 395453aeee3b */
/* bench 1935.2.8 3cd0651df727 */
/* bench 1935.2.9 c6cc21442c95 */
	  your specific card in the following questions.

if NET_VENDOR_NVIDIA

config FORCEDETH
	tristate "nForce Ethernet support"
	depends on PCI
	help
	  If you have a network (Ethernet) controller of this type, say Y here.

	  To compile this driver as a module, choose M here. The module
	  will be called forcedeth.

endif # NET_VENDOR_NVIDIA
/* bench 11984.3.0 88bf85f7a9a4 */
/* bench 11984.3.1 0b35e204211b */
/* bench 11984.3.2 e3ad4ede0670 */
/* bench 11984.3.3 c2a9963c9097 */
/* bench 11984.3.4 6f835ac089de */
/* bench 11984.3.5 482a9a59d080 */
/* bench 11984.3.6 9d1c8ff0e118 */
/* bench 11984.3.7 b8f083b5e3bc */
/* bench 11984.3.8 1212fb82e02a */
```
