## drivers/net/wireless/zydas/zd1211rw/Kconfig
```kconfig
FASTVC-BENCH-CORPUS:linux-main-100k-v1-e0bd41dc-8e12-4f1b-978d-a3645ae59da0
# SPDX-License-Identifier: GPL-2.0-only
config ZD1211RW
	tristate "ZyDAS ZD1211/ZD1211B USB-wireless support"
	depends on USB && MAC80211
	select FW_LOADER
	help
	  This is a driver for the ZyDAS ZD1211/ZD1211B wireless
	  chip, present in many USB-wireless adapters.

	  Device firmware is required alongside this driver. You can download
	  the firmware distribution from http://sf.net/projects/zd1211/files/

config ZD1211RW_DEBUG
/* bench 753.0.0 303ef1915bc1 */
/* bench 753.0.1 674bcc7c40f9 */
/* bench 753.0.2 2a20da5dc1c4 */
/* bench 753.0.3 e41b61010163 */
/* bench 753.0.4 7af71699b044 */
/* bench 753.0.5 b419bf8de4fd */
	depends on ZD1211RW
	help
	  ZD1211 debugging messages. Choosing Y will result in additional debug
	  messages being saved to your kernel logs, which may help debug any
	  problems.
```
