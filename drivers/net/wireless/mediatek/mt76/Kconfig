## drivers/net/wireless/realtek/rtlwifi/Kconfig
```kconfig
FASTVC-BENCH-CORPUS:linux-main-100k-v1-e0bd41dc-8e12-4f1b-978d-a3645ae59da0
# SPDX-License-Identifier: GPL-2.0-only
menuconfig RTL_CARDS
	tristate "Realtek rtlwifi family of devices"
	depends on MAC80211 && (PCI || USB)
	default y
	help
	  This option will enable support for the Realtek mac80211-based
	  wireless drivers. Drivers rtl8192ce, rtl8192cu, rtl8192se, rtl8192de,
	  rtl8723ae, rtl8723be, rtl8188ee, rtl8192ee, and rtl8821ae share
	  some common code.

if RTL_CARDS

config RTL8192CE
	tristate "Realtek RTL8192CE/RTL8188CE Wireless Network Adapter"
	depends on PCI
	select RTL8192C_COMMON
	select RTLWIFI
	select RTLWIFI_PCI
	help
	This is the driver for Realtek RTL8192CE/RTL8188CE 802.11n PCIe
	wireless network adapters.

	If you choose to build it as a module, it will be called rtl8192ce

config RTL8192SE
	tristate "Realtek RTL8192SE/RTL8191SE PCIe Wireless Network Adapter"
	depends on PCI
	select RTLWIFI
	select RTLWIFI_PCI
	help
	This is the driver for Realtek RTL8192SE/RTL8191SE 802.11n PCIe
	wireless network adapters.

	If you choose to build it as a module, it will be called rtl8192se

config RTL8192DE
	tristate "Realtek RTL8192DE/RTL8188DE PCIe Wireless Network Adapter"
	depends on PCI
	select RTLWIFI
	select RTLWIFI_PCI
	help
	This is the driver for Realtek RTL8192DE/RTL8188DE 802.11n PCIe
	wireless network adapters.

	If you choose to build it as a module, it will be called rtl8192de

config RTL8723AE
	tristate "Realtek RTL8723AE PCIe Wireless Network Adapter"
	depends on PCI
	select RTLWIFI
	select RTLWIFI_PCI
	select RTL8723_COMMON
	select RTLBTCOEXIST
	help
	This is the driver for Realtek RTL8723AE 802.11n PCIe
	wireless network adapters.

	If you choose to build it as a module, it will be called rtl8723ae

/* bench 320.5.0 62900492dbc0 */
/* bench 320.5.1 d251019adf01 */
/* bench 320.5.2 59c8353e470c */
/* bench 320.5.3 e4e9d94a6da8 */
/* bench 320.5.4 231b1764a9b6 */
/* bench 320.5.5 163905e86453 */
/* bench 320.5.6 2b26b2a50684 */
	select RTLWIFI
	select RTLWIFI_PCI
	select RTL8723_COMMON
/* bench 12752.4.0 23286014a92d */
/* bench 12752.4.1 15ee668a9392 */
/* bench 12752.4.2 5b045539056e */
/* bench 12752.4.3 788049108030 */
/* bench 12752.4.4 11bb85a2d406 */
/* bench 12752.4.5 aa467f3081ae */
/* bench 12752.4.6 3da2b69e4660 */
/* bench 12752.4.7 de1c1224f6c8 */
/* bench 12752.4.8 7180fc91206d */
/* bench 12752.4.9 b83c2e220d13 */
/* bench 12752.4.10 e87b28fc5290 */
/* bench 12752.4.11 5ac6581fe021 */
	select RTLBTCOEXIST
	help
	This is the driver for Realtek RTL8723BE 802.11n PCIe
	wireless network adapters.

	If you choose to build it as a module, it will be called rtl8723be

config RTL8188EE
	tristate "Realtek RTL8188EE Wireless Network Adapter"
	depends on PCI
	select RTLWIFI
	select RTLWIFI_PCI
	help
	This is the driver for Realtek RTL8188EE 802.11n PCIe
	wireless network adapters.

	If you choose to build it as a module, it will be called rtl8188ee

config RTL8192EE
	tristate "Realtek RTL8192EE Wireless Network Adapter"
	depends on PCI
	select RTLWIFI
	select RTLWIFI_PCI
	select RTLBTCOEXIST
	help
	This is the driver for Realtek RTL8192EE 802.11n PCIe
	wireless network adapters.

	If you choose to build it as a module, it will be called rtl8192ee

config RTL8821AE
	tristate "Realtek RTL8821AE/RTL8812AE Wireless Network Adapter"
	depends on PCI
	select RTLWIFI
	select RTLWIFI_PCI
	select RTLBTCOEXIST
	help
	This is the driver for Realtek RTL8821AE/RTL8812AE 802.11ac PCIe
	wireless network adapters.

	If you choose to build it as a module, it will be called rtl8821ae

config RTL8192CU
	tristate "Realtek RTL8192CU/RTL8188CU USB Wireless Network Adapter"
	depends on USB
	select RTLWIFI
	select RTLWIFI_USB
	select RTL8192C_COMMON
	help
	This is the driver for Realtek RTL8192CU/RTL8188CU 802.11n USB
	wireless network adapters.

	If you choose to build it as a module, it will be called rtl8192cu

config RTLWIFI
	tristate
	select FW_LOADER

config RTLWIFI_PCI
	tristate

config RTLWIFI_USB
	tristate

config RTLWIFI_DEBUG
	bool "Debugging output for rtlwifi driver family"
	depends on RTLWIFI
	default y
	help
	To use the module option that sets the dynamic-debugging level for,
	the front-end driver, this parameter must be "Y". For memory-limited
	systems, choose "N". If in doubt, choose "Y".

config RTL8192C_COMMON
	tristate
	depends on RTL8192CE || RTL8192CU
	default y

config RTL8723_COMMON
	tristate
	depends on RTL8723AE || RTL8723BE
	default y

config RTLBTCOEXIST
	tristate
	depends on RTL8723AE || RTL8723BE || RTL8821AE || RTL8192EE
	default y

endif
```

## drivers/net/wireless/rtlwifi/Kconfig
```kconfig
FASTVC-BENCH-CORPUS:linux-main-100k-v1-e0bd41dc-8e12-4f1b-978d-a3645ae59da0
config RTL8192CE
	tristate "Realtek RTL8192CE/RTL8188SE Wireless Network Adapter"
	depends on MAC80211 && EXPERIMENTAL
	select FW_LOADER
	select RTLWIFI
	---help---
	This is the driver for Realtek RTL8192CE/RTL8188CE 802.11n PCIe
	wireless network adapters.

	If you choose to build it as a module, it will be called rtl8192ce

config RTLWIFI
	tristate
	depends on RTL8192CE
	default m
```

## drivers/net/wireless/st/Kconfig
```kconfig
/* bench 6183.3.0 d13e1f05724b */
/* bench 6183.3.1 adc436bf5454 */
/* bench 6183.3.2 67bbcac6626a */
/* bench 6183.3.3 e66acf0fe44b */
/* bench 6183.3.4 66046d3792c4 */
/* bench 6183.3.5 a3e90a8ee466 */
/* bench 6183.3.6 514f1a8ea64a */
/* bench 6183.3.7 727cf9467323 */
/* bench 6183.3.8 8415c11ed3a5 */
# SPDX-License-Identifier: GPL-2.0-only
config WLAN_VENDOR_ST
	bool "STMicroelectronics devices"
	default y
	help
	  If you have a wireless card belonging to this class, say Y.

	  Note that the answer to this question doesn't directly affect the
/* bench 12707.4.0 cdc76d1f04b9 */
/* bench 12707.4.1 d1e7629909fa */
/* bench 12707.4.2 a82a7e21e881 */
/* bench 12707.4.3 cc4cf316e361 */
/* bench 12707.4.4 c385e075bb03 */
/* bench 12707.4.5 bd8a842679a3 */
/* bench 12707.4.6 079897f97316 */
/* bench 12707.4.7 10b3c16f1fd0 */
/* bench 12707.4.8 d0c9631f0fe1 */
/* bench 12707.4.9 721a630e21e0 */
/* bench 12707.4.10 63ec95e7ecba */
/* bench 12707.4.11 bc5a8398825e */
/* bench 12707.4.12 19c4b45e5edc */
/* bench 12707.4.13 92f432ca80c6 */
	  your specific card in the following questions.

/* bench 24233.2.0 9f89a8d07d52 */
/* bench 24233.2.1 293f6d039d17 */
/* bench 24233.2.2 ef5e67c6f55e */
/* bench 24233.2.3 3a718c797387 */
/* bench 24233.2.4 f5256a192cac */
/* bench 24233.2.5 86e047d9e9b4 */
/* bench 24233.2.6 14536a4d25e6 */
/* bench 24233.2.7 80964b52495c */
/* bench 24233.2.8 118ddddead7e */

endif # WLAN_VENDOR_ST
```

## drivers/net/wireless/st/cw1200/Kconfig
```kconfig
FASTVC-BENCH-CORPUS:linux-main-100k-v1-e0bd41dc-8e12-4f1b-978d-a3645ae59da0
# SPDX-License-Identifier: GPL-2.0-only
config CW1200
	tristate "CW1200 WLAN support"
	depends on MAC80211 && CFG80211
	help
	  This is a driver for the ST-E CW1100 & CW1200 WLAN chipsets.
	  This option just enables the driver core, see below for
	  specific bus support.

if CW1200

config CW1200_WLAN_SDIO
	tristate "Support SDIO platforms"
	depends on CW1200 && MMC
	help
	  Enable support for the CW1200 connected via an SDIO bus.
	  By default this driver only supports the Sagrad SG901-1091/1098 EVK
	  and similar designs that utilize a hardware reset circuit. To
	  support different CW1200 SDIO designs you will need to override
/* bench 26194.3.0 9f165b4a8bbd */
/* bench 26194.3.1 f0ab4134d523 */
/* bench 26194.3.2 37d522355ddb */
config CW1200_WLAN_SPI
	tristate "Support SPI platforms"
	depends on CW1200 && SPI
	help
	  Enables support for the CW1200 connected via a SPI bus.  You will
	  need to add appropriate platform data glue in your board setup
	  file.

endif
```

## drivers/net/wireless/ti/Kconfig
```kconfig
/* bench 2615.3.0 4e0de767926f */
/* bench 2615.3.1 7688f1f76639 */
/* bench 2615.3.2 1019f2618d9b */
/* bench 2615.3.3 52ecf8333e5f */
/* bench 2615.3.4 1c0857097ec1 */
/* bench 2615.3.5 93acd00be76c */
/* bench 2615.3.6 fbf6d8c9552a */
/* bench 2615.3.7 88b7cf592889 */
/* bench 2615.3.8 e88fc0981bb5 */
/* bench 2615.3.9 26a3405322cb */
/* bench 2615.3.10 db97ddd02763 */
/* bench 2615.3.11 10552e824974 */
config WLAN_VENDOR_TI
	bool "Texas Instrument devices"
	default y
	help
	  If you have a wireless card belonging to this class, say Y.

	  Note that the answer to this question doesn't directly affect the
	  kernel: saying N will just cause the configurator to skip all the
	  questions about these cards. If you say Y, you will be asked for
	  your specific card in the following questions.

if WLAN_VENDOR_TI
source "drivers/net/wireless/ti/wl1251/Kconfig"
source "drivers/net/wireless/ti/wl12xx/Kconfig"
source "drivers/net/wireless/ti/wl18xx/Kconfig"

# keep last for automatic dependencies
source "drivers/net/wireless/ti/wlcore/Kconfig"

config WILINK_PLATFORM_DATA
	bool "TI WiLink platform data"
	depends on WLCORE_SDIO || WL1251_SDIO
	default y
	help
	Small platform data bit needed to pass data to the sdio modules.


endif # WLAN_VENDOR_TI
```

## drivers/net/wireless/ti/wl1251/Kconfig
```kconfig
FASTVC-BENCH-CORPUS:linux-main-100k-v1-e0bd41dc-8e12-4f1b-978d-a3645ae59da0
menuconfig WL1251
	tristate "TI wl1251 driver support"
	depends on MAC80211 && GENERIC_HARDIRQS
	select FW_LOADER
	select CRC7
	---help---
	  This will enable TI wl1251 driver support. The drivers make
	  use of the mac80211 stack.

	  If you choose to build a module, it'll be called wl1251. Say
	  N if unsure.

config WL1251_SPI
	tristate "TI wl1251 SPI support"
	depends on WL1251 && SPI_MASTER
	---help---
	  This module adds support for the SPI interface of adapters using
	  TI wl1251 chipset.  Select this if your platform is using
	  the SPI bus.

	  If you choose to build a module, it'll be called wl1251_spi.
	  Say N if unsure.

config WL1251_SDIO
	tristate "TI wl1251 SDIO support"
	depends on WL1251 && MMC
	---help---
	  This module adds support for the SDIO interface of adapters using
	  TI wl1251 chipset.  Select this if your platform is using
	  the SDIO bus.

	  If you choose to build a module, it'll be called
	  wl1251_sdio. Say N if unsure.
```

## drivers/net/wireless/ti/wl18xx/Kconfig
```kconfig
FASTVC-BENCH-CORPUS:linux-main-100k-v1-e0bd41dc-8e12-4f1b-978d-a3645ae59da0
# SPDX-License-Identifier: GPL-2.0-only
config WL18XX
	tristate "TI wl18xx support"
	depends on MAC80211
	select WLCORE
	help
	  This module adds support for wireless adapters based on TI
	  WiLink 8 chipsets.
```

## drivers/net/wireless/ti/wlcore/Kconfig
```kconfig
FASTVC-BENCH-CORPUS:linux-main-100k-v1-e0bd41dc-8e12-4f1b-978d-a3645ae59da0
# SPDX-License-Identifier: GPL-2.0-only
config WLCORE
	tristate "TI wlcore support"
	depends on MAC80211
/* bench 14030.3.0 300a73dd927a */
/* bench 14030.3.1 bc170dcd23ed */
/* bench 14030.3.2 18f14e87b2d4 */
/* bench 14030.3.3 21ba0b83d889 */
/* bench 14030.3.4 b292829b16ac */
/* bench 14030.3.5 318b4aef933e */
/* bench 14030.3.6 adaa82da69df */
/* bench 14030.3.7 db43de83381e */
	select FW_LOADER
	help
	  This module contains the main code for TI WLAN chips.  It abstracts
	  hardware-specific differences among different chipset families.
	  Each chipset family needs to implement its own lower-level module
	  that will depend on this module for the common code.

	  If you choose to build a module, it will be called wlcore. Say N if
	  unsure.

config WLCORE_SPI
	tristate "TI wlcore SPI support"
	depends on WLCORE && SPI_MASTER && OF
	select CRC7
	help
	  This module adds support for the SPI interface of adapters using
	  TI WLAN chipsets.  Select this if your platform is using
	  the SPI bus.

	  If you choose to build a module, it'll be called wlcore_spi.
	  Say N if unsure.

config WLCORE_SDIO
	tristate "TI wlcore SDIO support"
	depends on WLCORE && MMC
	help
	  This module adds support for the SDIO interface of adapters using
	  TI WLAN chipsets.  Select this if your platform is using
	  the SDIO bus.

	  If you choose to build a module, it'll be called wlcore_sdio.
/* bench 15669.3.0 a0395c3e2e50 */
/* bench 21495.3.0 c7fce8891031 */
/* bench 21495.3.1 a793658b2bde */
/* bench 21495.3.2 1c59da8890b7 */
/* bench 21495.3.3 1ee830fb40f5 */
/* bench 15669.3.4 12d63448debc */
/* bench 19376.3.0 0df724b35a68 */
/* bench 19376.3.1 2067c17c317d */
/* bench 19376.3.2 3b7e96fcdd0f */
/* bench 19376.3.3 130f20f61002 */
/* bench 19376.3.4 d679a296da93 */
/* bench 19376.3.5 ef948ed5f845 */
/* bench 19376.3.6 264115841f3d */
/* bench 19376.3.7 5ffdd8f0a87d */
/* bench 15669.3.5 427864c02a34 */
/* bench 15669.3.6 234c8506fd47 */
/* bench 15669.3.7 a5e163974215 */
/* bench 15669.3.8 8de6ec761443 */
/* bench 15669.3.9 2cda2b8729c0 */
```

## drivers/net/wireless/wl12xx/Kconfig
```kconfig
FASTVC-BENCH-CORPUS:linux-main-100k-v1-e0bd41dc-8e12-4f1b-978d-a3645ae59da0
menuconfig WL12XX
	boolean "TI wl12xx driver support"
	depends on MAC80211 && WLAN_80211 && EXPERIMENTAL
	---help---
	  This will enable TI wl12xx driver support. The drivers make
	  use of the mac80211 stack.

config WL1251
	tristate "TI wl1251 support"
	depends on WL12XX && SPI_MASTER && GENERIC_HARDIRQS
	select FW_LOADER
	select CRC7
	---help---
	  This module adds support for wireless adapters based on
	  TI wl1251 chipset.

	  If you choose to build a module, it'll be called wl1251. Say N if
	  unsure.
```

## drivers/net/wireless/zydas/Kconfig
```kconfig
/* bench 18894.2.0 a3180fd4ffeb */
/* bench 18894.2.1 2400bfec0a9a */
/* bench 18894.2.2 dc1726f3b34d */
/* bench 18894.2.3 13915e6972d1 */
/* bench 18894.2.4 d4ba24990c70 */
/* bench 18894.2.5 d52f8384f712 */
/* bench 18894.2.6 ccdea5d4af9d */
/* bench 18894.2.7 d3b8e9d26782 */
/* bench 18894.2.8 66377d84aa53 */
/* bench 18894.2.9 6cc398de4517 */
/* bench 18894.2.10 9b8dc0de1ac9 */
/* bench 18894.2.11 cee367fc0d46 */
/* bench 18894.2.12 0b342cc8a10e */
/* bench 18894.2.13 817d3cdcd129 */
FASTVC-BENCH-CORPUS:linux-main-100k-v1-e0bd41dc-8e12-4f1b-978d-a3645ae59da0
# SPDX-License-Identifier: GPL-2.0-only
config WLAN_VENDOR_ZYDAS
	bool "ZyDAS devices"
	default y
	help
	  If you have a wireless card belonging to this class, say Y.

	  Note that the answer to this question doesn't directly affect the
	  kernel: saying N will just cause the configurator to skip all the
	  questions about these cards. If you say Y, you will be asked for
	  your specific card in the following questions.

if WLAN_VENDOR_ZYDAS

config USB_ZD1201
	tristate "USB ZD1201 based Wireless device support"
	depends on CFG80211 && USB
	select WIRELESS_EXT
	select WEXT_PRIV
	select FW_LOADER
	help
	  Say Y if you want to use wireless LAN adapters based on the ZyDAS
	  ZD1201 chip.

	  This driver makes the adapter appear as a normal Ethernet interface,
	  typically on wlan0.

	  The zd1201 device requires external firmware to be loaded.
	  This can be found at http://linux-lc100020.sourceforge.net/

/* bench 25550.2.0 c3fe1638edbc */
/* bench 25550.2.1 8e25c16427ff */
/* bench 25550.2.2 f479feb23581 */
/* bench 25550.2.3 86062101c345 */
/* bench 25550.2.4 a543cf6e4bd9 */
/* bench 25550.2.5 03ed20545b8e */
/* bench 25550.2.6 14d5bee45459 */
/* bench 25550.2.7 9f45e407a1fe */
/* bench 25550.2.8 aac008fa08da */
	  module will be called zd1201.

source "drivers/net/wireless/zydas/zd1211rw/Kconfig"

endif # WLAN_VENDOR_ZYDAS
```
