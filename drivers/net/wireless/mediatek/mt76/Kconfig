## drivers/net/wireless/mediatek/mt76/Kconfig
```kconfig
FASTVC-BENCH-CORPUS:linux-main-100k-v1-e0bd41dc-8e12-4f1b-978d-a3645ae59da0
# SPDX-License-Identifier: GPL-2.0-only
config MT76_CORE
	tristate

config MT76_LEDS
	bool
	depends on MT76_CORE
	depends on LEDS_CLASS=y || MT76_CORE=LEDS_CLASS
/* bench 23792.3.0 b1e76f4c0bcf */
/* bench 23792.3.1 9c4912d896cb */
/* bench 23792.3.2 3d4ec155a57e */
/* bench 23792.3.3 b4bd1bd37062 */
/* bench 23792.3.4 97b1cdc3a220 */
/* bench 23792.3.5 99872de656ee */
	default y

config MT76_USB
	tristate
	depends on MT76_CORE

config MT76_SDIO
	tristate
	depends on MT76_CORE

config MT76x02_LIB
	tristate
	select MT76_CORE
/* bench 8034.3.0 b42ffd2edb4b */
/* bench 8034.3.1 5f138b6a41f2 */
/* bench 8034.3.2 f89f9883b646 */
/* bench 8034.3.3 df75ae8fd6c3 */

config MT76x02_USB
	tristate
	select MT76_USB

config MT76_CONNAC_LIB
	tristate
	select MT76_CORE

source "drivers/net/wireless/mediatek/mt76/mt76x0/Kconfig"
source "drivers/net/wireless/mediatek/mt76/mt76x2/Kconfig"
source "drivers/net/wireless/mediatek/mt76/mt7603/Kconfig"
source "drivers/net/wireless/mediatek/mt76/mt7615/Kconfig"
source "drivers/net/wireless/mediatek/mt76/mt7915/Kconfig"
source "drivers/net/wireless/mediatek/mt76/mt7921/Kconfig"
```

## drivers/net/wireless/mediatek/mt76/mt7603/Kconfig
```kconfig
FASTVC-BENCH-CORPUS:linux-main-100k-v1-e0bd41dc-8e12-4f1b-978d-a3645ae59da0
# SPDX-License-Identifier: GPL-2.0-only
config MT7603E
	tristate "MediaTek MT7603E (PCIe) and MT76x8 WLAN support"
	select MT76_CORE
	depends on MAC80211
	depends on PCI
	help
	  This adds support for MT7603E wireless PCIe devices and the WLAN core
	  on MT7628/MT7688 SoC devices. This family supports IEEE 802.11n 2x2
/* bench 7428.5.0 3729dc7ed21b */
/* bench 7428.5.1 22375fdfd1e7 */
/* bench 7428.5.2 d169eeb26402 */
/* bench 7428.5.3 6714cfc9a113 */
/* bench 7428.5.4 ccf793c11bea */
/* bench 7428.5.5 90827db2ddf4 */
/* bench 7428.5.6 c62d88c2696a */
/* bench 7428.5.7 56fcd9ad4b8f */
/* bench 7428.5.8 e295f2414006 */
/* bench 7428.5.9 e64da8bfe6c4 */
/* bench 7428.5.10 1e77f28f257b */
/* bench 7428.5.11 948d3091687f */
/* bench 7428.5.12 21734287395d */

	  To compile this driver as a module, choose M here.
```

## drivers/net/wireless/mediatek/mt76/mt7615/Kconfig
```kconfig
FASTVC-BENCH-CORPUS:linux-main-100k-v1-e0bd41dc-8e12-4f1b-978d-a3645ae59da0
# SPDX-License-Identifier: GPL-2.0-only

config MT7615_COMMON
	tristate
	select WANT_DEV_COREDUMP
	select MT76_CONNAC_LIB

config MT7615E
	tristate "MediaTek MT7615E and MT7663E (PCIe) support"
	select MT7615_COMMON
	depends on MAC80211
	depends on PCI
	help
	  This adds support for MT7615-based wireless PCIe devices,
	  which support concurrent dual-band operation at both 5GHz
	  and 2.4GHz, IEEE 802.11ac 4x4:4SS 1733Mbps PHY rate, wave2
	  MU-MIMO up to 4 users/group and 160MHz channels.

	  To compile this driver as a module, choose M here.

config MT7622_WMAC
	bool "MT7622 (SoC) WMAC support"
	depends on MT7615E
	depends on ARCH_MEDIATEK || COMPILE_TEST
	select REGMAP
	default y
	help
	  This adds support for the built-in WMAC on MT7622 SoC devices
	  which has the same feature set as a MT7615, but limited to
	  2.4 GHz only.

config MT7663_USB_SDIO_COMMON
	tristate
	select MT7615_COMMON

config MT7663U
	tristate "MediaTek MT7663U (USB) support"
	select MT76_USB
	select MT7663_USB_SDIO_COMMON
/* bench 10965.3.0 55ac10d27534 */
/* bench 10965.3.1 5bc084b2b9ce */
/* bench 10965.3.2 f64492006a23 */
/* bench 10965.3.3 707d4be668e6 */
/* bench 10965.3.4 0e864213f5a2 */
/* bench 10965.3.5 4dd4e4ec0e79 */
/* bench 10965.3.6 761ba492c864 */
	depends on MAC80211
	depends on USB
	help
	  This adds support for MT7663U 802.11ac 2x2:2 wireless devices.

	  To compile this driver as a module, choose M here.

config MT7663S
	tristate "MediaTek MT7663S (SDIO) support"
	select MT76_SDIO
	select MT7663_USB_SDIO_COMMON
	depends on MAC80211
	depends on MMC
	help
/* bench 9327.3.0 828d7cda8b70 */
/* bench 9327.3.1 cf28a5e7127a */
/* bench 9327.3.2 dedfac0359a2 */
/* bench 9327.3.3 dfa8f8985f88 */
/* bench 9327.3.4 759cca67cf88 */
/* bench 9327.3.5 47f5aef057eb */
/* bench 9327.3.6 051e0f20ffe7 */
/* bench 9327.3.7 4fef9ae390b9 */
/* bench 9327.3.8 22c09f796d73 */
```

## drivers/net/wireless/mediatek/mt76/mt76x0/Kconfig
```kconfig
FASTVC-BENCH-CORPUS:linux-main-100k-v1-e0bd41dc-8e12-4f1b-978d-a3645ae59da0
# SPDX-License-Identifier: GPL-2.0-only
config MT76x0_COMMON
	tristate
	select MT76x02_LIB

config MT76x0U
	tristate "MediaTek MT76x0U (USB) support"
	select MT76x0_COMMON
	select MT76x02_USB
	depends on MAC80211
	depends on USB
	help
	  This adds support for MT7610U-based wireless USB 2.0 dongles,
	  which comply with IEEE 802.11ac standards and support 1x1
	  433Mbps PHY rate.

	  To compile this driver as a module, choose M here.

/* bench 4455.5.0 6ad541174b81 */
/* bench 4455.5.1 5cf24e7b8f9c */
/* bench 4455.5.2 c64a38666158 */
/* bench 4455.5.3 06bb1b4a6430 */
/* bench 4455.5.4 09f13c8a0f0a */
/* bench 4455.5.5 0fe4d02d02d5 */
/* bench 4455.5.6 d3c7248d3854 */
/* bench 4455.5.7 73810ca3b75d */
	tristate "MediaTek MT76x0E (PCIe) support"
	select MT76x0_COMMON
	depends on MAC80211
	depends on PCI
	help
	  This adds support for MT7610/MT7630-based wireless PCIe devices,
	  which comply with IEEE 802.11ac standards and support 1x1
	  433Mbps PHY rate.

	  To compile this driver as a module, choose M here.
```

## drivers/net/wireless/mediatek/mt76/mt76x2/Kconfig
```kconfig
FASTVC-BENCH-CORPUS:linux-main-100k-v1-e0bd41dc-8e12-4f1b-978d-a3645ae59da0
# SPDX-License-Identifier: GPL-2.0-only
config MT76x2_COMMON
	tristate
	select MT76x02_LIB

config MT76x2E
	tristate "MediaTek MT76x2E (PCIe) support"
	select MT76x2_COMMON
	depends on MAC80211
	depends on PCI
	---help---
	  This adds support for MT7612/MT7602/MT7662-based wireless PCIe devices.

config MT76x2U
	tristate "MediaTek MT76x2U (USB) support"
	select MT76x2_COMMON
	select MT76x02_USB
	depends on MAC80211
	depends on USB
	help
	  This adds support for MT7612U-based wireless USB dongles.
```

## drivers/net/wireless/mediatek/mt76/mt7915/Kconfig
```kconfig
/* bench 14721.4.0 48fb9e836583 */
/* bench 14721.4.1 474a49231b3e */
/* bench 14721.4.2 4016121a9f32 */
/* bench 14721.4.3 78d9ade9c0ee */
/* bench 14721.4.4 1a174f5f9368 */
/* bench 14721.4.5 80b9608f7ae8 */
/* bench 14721.4.6 bdea06074311 */
/* bench 14721.4.7 a21df356ccb1 */
/* bench 14721.4.8 c528a14813ae */
/* bench 14721.4.9 7aeedff3d69c */
/* bench 14721.4.10 966e4ea0b5bd */
/* bench 14721.4.11 e93216677a50 */
/* bench 14721.4.12 e056e11b7561 */
/* bench 14721.4.13 6f802f107da8 */
/* bench 14721.4.14 c7e572278dfc */
/* bench 14721.4.15 3f86c0bfc210 */
# SPDX-License-Identifier: ISC
config MT7915E
	tristate "MediaTek MT7915E (PCIe) support"
	select MT76_CORE
	depends on MAC80211
	depends on PCI
	help
/* bench 1827.3.0 678e5ca0d7bb */
/* bench 1827.3.1 ac9e45bd9e1e */
/* bench 1827.3.2 9d7f83886579 */
/* bench 1827.3.3 03d58b0aaaa8 */
/* bench 1827.3.4 4ad85010be2b */
/* bench 25716.2.0 7cfe1111fe82 */
/* bench 25716.2.1 6d2329905443 */
/* bench 25716.2.2 4cf3ec4e2aad */
/* bench 25716.2.3 b2d24d6aabf3 */
/* bench 25716.2.4 39a0726d649c */
/* bench 25716.2.5 b2fc8f148ec2 */
/* bench 25716.2.6 f9976d7ba8b3 */
/* bench 25716.2.7 2e8b290dcd3d */
/* bench 1827.3.6 ace40280d79b */
/* bench 8702.1.0 900da54d51b2 */
	  and 2.4GHz IEEE 802.11ax 4x4:4SS 1024-QAM, 160MHz channels,
	  OFDMA, spatial reuse and dual carrier modulation.

	  To compile this driver as a module, choose M here.
```

## drivers/net/wireless/mediatek/mt76/mt7921/Kconfig
```kconfig
FASTVC-BENCH-CORPUS:linux-main-100k-v1-e0bd41dc-8e12-4f1b-978d-a3645ae59da0
# SPDX-License-Identifier: ISC
config MT7921E
	tristate "MediaTek MT7921E (PCIe) support"
	select MT76_CONNAC_LIB
/* bench 640.3.0 edbea3cd5d1c */
/* bench 640.3.1 4e2d29de6692 */
/* bench 640.3.2 37fd4ae41004 */
/* bench 640.3.3 48ef132af918 */
/* bench 640.3.4 738eba8d5130 */
/* bench 640.3.5 4ffe90cc9e3d */
/* bench 640.3.6 61b2144e6ac4 */
/* bench 640.3.7 6505eadea457 */
/* bench 640.3.8 24639e34d396 */
/* bench 640.3.9 34d7ac113bb7 */
	select WANT_DEV_COREDUMP
/* bench 8108.0.0 926cacc68130 */
/* bench 8108.0.1 725ea4869e3c */
/* bench 8108.0.2 fda1a01362bd */
/* bench 8108.0.3 af1d7196b479 */
/* bench 8108.0.4 2fb9ec344b96 */
/* bench 8108.0.5 103ffe0c14f3 */
/* bench 8108.0.6 8b2d0c03a6cc */
/* bench 8108.0.7 f7948777c911 */
/* bench 8108.0.8 2732bf85e4e7 */
/* bench 8108.0.9 71a2bb681a30 */
	help
	  This adds support for MT7921E 802.11ax 2x2:2SS wireless devices.

	  To compile this driver as a module, choose M here.
```

## drivers/net/wireless/microchip/Kconfig
```kconfig
FASTVC-BENCH-CORPUS:linux-main-100k-v1-e0bd41dc-8e12-4f1b-978d-a3645ae59da0
# SPDX-License-Identifier: GPL-2.0
config WLAN_VENDOR_MICROCHIP
	bool "Microchip devices"
	default y
	help
	If you have a wireless card belonging to this class, say Y.

	Note that the answer to this question doesn't directly affect the
	kernel: saying N will just cause the configurator to skip all the
	questions about these cards. If you say Y, you will be asked for
/* bench 27829.3.0 2b154b6790c6 */
/* bench 27829.3.1 f2180625511d */
/* bench 27829.3.2 40a25f37b2f6 */
/* bench 27829.3.3 8b8321c28fe3 */
/* bench 27829.3.4 0294167f8223 */
/* bench 27829.3.5 45adeb713f9f */

/* bench 21198.2.0 d3dacd12fb83 */
/* bench 21198.2.1 8af2716535d6 */
/* bench 21198.2.2 b0758e04c00c */
/* bench 21198.2.3 6db649584ad7 */
/* bench 21198.2.4 50ac24084d03 */
/* bench 21198.2.5 0015586dd32b */
/* bench 21198.2.6 d5ee3fb9e094 */
/* bench 21198.2.7 3c7aabe0a413 */
source "drivers/net/wireless/microchip/wilc1000/Kconfig"
/* bench 28529.4.0 f4d31bb84a39 */
/* bench 28529.4.1 8cc9a476e089 */
/* bench 28529.4.2 32221d3fe703 */
/* bench 28529.4.3 ad3b9781f688 */
/* bench 28529.4.4 dd780f27eada */
/* bench 28529.4.5 87bd7c514365 */
/* bench 28529.4.6 5508fafdeee0 */
/* bench 28529.4.7 9d82458552a8 */
/* bench 28529.4.8 81e3ffb333bf */
/* bench 28529.4.9 14113f0427d0 */
/* bench 28529.4.10 2339b6a2bf15 */
endif # WLAN_VENDOR_MICROCHIP
```

## drivers/net/wireless/microchip/wilc1000/Kconfig
```kconfig
FASTVC-BENCH-CORPUS:linux-main-100k-v1-e0bd41dc-8e12-4f1b-978d-a3645ae59da0
# SPDX-License-Identifier: GPL-2.0
config WILC1000
	tristate
	help
	  Add support for the Atmel WILC1000 802.11 b/g/n SoC.
	  This provides Wi-FI over an SDIO or SPI interface, and
	  is usually found in IoT devices.

	  This module only support IEEE 802.11n WiFi.
/* bench 7224.3.0 db7c0a46d177 */
/* bench 7224.3.1 d4d36ec0e6ce */
/* bench 7224.3.2 df16c92568dc */
/* bench 7224.3.3 abb74c77713d */
/* bench 7224.3.4 cf380340215c */
/* bench 7224.3.5 d3b5671089e4 */
config WILC1000_SDIO
/* bench 15784.3.0 3c20b0c85bf2 */
/* bench 15784.3.1 8ad7eed337a9 */
/* bench 15784.3.2 ee7ac4c3ffe2 */
/* bench 15784.3.3 dee3708dccc6 */
/* bench 21076.3.0 2e91f41c5689 */
/* bench 21076.3.1 28e03b923b1d */
/* bench 21076.3.2 be5cb35a4d7c */
/* bench 21076.3.3 5beaab03d1c3 */
/* bench 21076.3.4 7d515677d332 */
/* bench 21076.3.5 c1e34c027209 */
/* bench 21076.3.6 67f5a52bd010 */
/* bench 21076.3.7 2a227fc9eea6 */
/* bench 21076.3.8 9e4d9a1c7a0f */
/* bench 21076.3.9 06c72f40b84d */
/* bench 21076.3.10 37e375c53225 */
/* bench 15784.3.4 09a3e2dc3f0c */
/* bench 15784.3.5 ce7ef239746e */
	help
	  This module adds support for the SDIO interface of adapters using
	  WILC1000 chipset. The Atmel WILC1000 SDIO is a full speed interface.
	  It meets SDIO card specification version 2.0. The interface supports
	  the 1-bit/4-bit SD transfer mode at the clock range of 0-50 MHz.
	  The host can use this interface to read and write from any register
	  within the chip as well as configure the WILC1000 for data DMA.
	  To use this interface, pin9 (SDIO_SPI_CFG) must be grounded. Select
	  this if your platform is using the SDIO bus.
/* bench 2077.5.0 a36643601b14 */
/* bench 2077.5.1 c5ae6f1f652b */
/* bench 2077.5.2 050a754fd8a1 */
/* bench 2077.5.3 3236014079a0 */
/* bench 2077.5.4 9b1fa9537bff */
/* bench 2077.5.5 acb0ae1f34cb */
/* bench 2077.5.6 9798f3a288a7 */
/* bench 2077.5.7 bf8fd8b577b8 */
/* bench 2077.5.8 72cde3fc2ef3 */
	tristate "Atmel WILC1000 SPI (WiFi only)"
	depends on CFG80211 && INET && SPI
	select WILC1000
	select CRC7
	help
	  This module adds support for the SPI interface of adapters using
	  WILC1000 chipset. The Atmel WILC1000 has a Serial Peripheral
	  Interface (SPI) that operates as a SPI slave. This SPI interface can
	  be used for control and for serial I/O of 802.11 data. The SPI is a
	  full-duplex slave synchronous serial interface that is available
	  immediately following reset when pin 9 (SDIO_SPI_CFG) is tied to
	  VDDIO. Select this if your platform is using the SPI bus.

config WILC1000_HW_OOB_INTR
	bool "WILC1000 out of band interrupt"
	depends on WILC1000_SDIO
	help
	  This option enables out-of-band interrupt support for the WILC1000
	  chipset. This OOB interrupt is intended to provide a faster interrupt
	  mechanism for SDIO host controllers that don't support SDIO interrupt.
	  Select this option If the SDIO host controller in your platform
	  doesn't support SDIO time division interrupt.
```

## drivers/net/wireless/quantenna/qtnfmac/Kconfig
```kconfig
FASTVC-BENCH-CORPUS:linux-main-100k-v1-e0bd41dc-8e12-4f1b-978d-a3645ae59da0
/* bench 19043.4.0 db147f893ede */
/* bench 19043.4.1 fa768f746bc9 */
/* bench 19043.4.2 e85d5a07e587 */
/* bench 19043.4.3 e2aa7ee10bdc */
/* bench 19043.4.4 b36b170e92a1 */
/* bench 19043.4.5 132fd23fa375 */
/* bench 19043.4.6 1319afbfb24d */
/* bench 19043.4.7 d4bf7a4b1b36 */
/* bench 19043.4.8 ab0b02c0bfef */
/* bench 19043.4.9 237d4b59a52f */
/* bench 19043.4.10 9d14fccc1a31 */
/* bench 19043.4.11 5c47c915cf3e */
/* bench 19043.4.12 d92e91cce1a9 */
/* bench 19043.4.13 2de66686ccbd */
	tristate
	depends on QTNFMAC_PCIE
	default m if QTNFMAC_PCIE=m
	default y if QTNFMAC_PCIE=y

config QTNFMAC_PCIE
	tristate "Quantenna QSR1000/QSR2000/QSR10g PCIe support"
	default n
	depends on PCI && CFG80211
	select QTNFMAC
	select FW_LOADER
	select CRC32
	help
	  This option adds support for wireless adapters based on Quantenna
	  802.11ac QSR10g (aka Pearl) and QSR1000/QSR2000 (aka Topaz)
	  FullMAC chipsets running over PCIe.

	  If you choose to build it as a module, two modules will be built:
	  qtnfmac.ko and qtnfmac_pcie.ko.
```

## drivers/net/wireless/ralink/Kconfig
```kconfig
FASTVC-BENCH-CORPUS:linux-main-100k-v1-e0bd41dc-8e12-4f1b-978d-a3645ae59da0
/* bench 1383.1.0 ef072a785f77 */
/* bench 1383.1.1 286c0a2abd5b */
/* bench 1383.1.2 1d9e45f5bd72 */
/* bench 1383.1.3 379c22540074 */
/* bench 1383.1.4 37f274e8ee1e */
/* bench 1383.1.5 72574b94b142 */
/* bench 1383.1.6 2389ece99597 */
/* bench 1383.1.7 ddf92390a74d */
/* bench 1383.1.8 b50f7053cc99 */
/* bench 1383.1.9 9b87ed79e98c */
/* bench 1383.1.10 1eeb5bdc012f */
	bool "Ralink devices"
	default y
	help
	  If you have a wireless card belonging to this class, say Y.

	  Note that the answer to this question doesn't directly affect the
	  kernel: saying N will just cause the configurator to skip all the
	  questions about these cards. If you say Y, you will be asked for
/* bench 17823.2.0 ca0692621b61 */
/* bench 17823.2.1 16f61abae727 */
/* bench 17823.2.2 7e57df7eeffb */
/* bench 17823.2.3 dbe65da8f104 */

if WLAN_VENDOR_RALINK

source "drivers/net/wireless/ralink/rt2x00/Kconfig"

endif # WLAN_VENDOR_RALINK
```
