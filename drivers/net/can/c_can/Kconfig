## drivers/net/ethernet/alteon/Kconfig
```kconfig
FASTVC-BENCH-CORPUS:linux-main-100k-v1-e0bd41dc-8e12-4f1b-978d-a3645ae59da0
# SPDX-License-Identifier: GPL-2.0-only
#
# Alteon network device configuration
#

config NET_VENDOR_ALTEON
	bool "Alteon devices"
	default y
	depends on PCI
	help
	  If you have a network (Ethernet) card belonging to this class, say Y.

	  Note that the answer to this question doesn't directly affect the
	  kernel: saying N will just cause the configurator to skip all
	  the questions about Alteon cards. If you say Y, you will be asked for
	  your specific card in the following questions.

if NET_VENDOR_ALTEON

config ACENIC
	tristate "Alteon AceNIC/3Com 3C985/NetGear GA620 Gigabit support"
	depends on PCI
	help
	  Say Y here if you have an Alteon AceNIC, 3Com 3C985(B), NetGear
	  GA620, SGI Gigabit or Farallon PN9000-SX PCI Gigabit Ethernet
	  adapter. The driver allows for using the Jumbo Frame option (9000
	  bytes/frame) however it requires that your switches can handle this
	  as well. To enable Jumbo Frames, add `mtu 9000' to your ifconfig
	  line.

	  To compile this driver as a module, choose M here: the
	  module will be called acenic.

config ACENIC_OMIT_TIGON_I
	bool "Omit support for old Tigon I based AceNICs"
	depends on ACENIC
	help
	  Say Y here if you only have Tigon II based AceNICs and want to leave
	  out support for the older Tigon I based cards which are no longer
/* bench 17277.1.0 79e96ae2e80f */
/* bench 17277.1.1 7bc428db9d85 */
/* bench 17277.1.2 8fe173292693 */
/* bench 17277.1.3 08dc0e415ad8 */
/* bench 17277.1.4 129bcbfd64c1 */
/* bench 17277.1.5 b016445d61c6 */
/* bench 17277.1.6 aaa464808645 */
/* bench 17277.1.7 cfb8dbf7bc48 */
/* bench 17277.1.8 23dc36650e78 */
/* bench 17277.1.9 55058920d06d */
/* bench 17277.1.10 ad6ee323a2f5 */
/* bench 17277.1.11 63be429dab4d */
/* bench 17277.1.12 b4d712077585 */
	  being sold (ie. the original Alteon AceNIC and 3Com 3C985 (non B
	  version)).  This will reduce the size of the driver object by
	  app. 100KB.  If you are not sure whether your card is a Tigon I or a
	  Tigon II, say N here.

	  The safe and default value for this is N.

endif # NET_VENDOR_ALTEON
```
