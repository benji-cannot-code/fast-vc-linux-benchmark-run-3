## drivers/net/can/c_can/Kconfig
```kconfig
FASTVC-BENCH-CORPUS:linux-main-100k-v1-e0bd41dc-8e12-4f1b-978d-a3645ae59da0
menuconfig CAN_C_CAN
	tristate "Bosch C_CAN devices"
	depends on CAN_DEV && HAS_IOMEM

if CAN_C_CAN

config CAN_C_CAN_PLATFORM
	tristate "Generic Platform Bus based C_CAN driver"
	---help---
	  This driver adds support for the C_CAN chips connected to
	  the "platform bus" (Linux abstraction for directly to the
	  processor attached devices) which can be found on various
	  boards from ST Microelectronics (http://www.st.com)
	  like the SPEAr1310 and SPEAr320 evaluation boards.
endif
```

## drivers/net/can/cc770/Kconfig
```kconfig
FASTVC-BENCH-CORPUS:linux-main-100k-v1-e0bd41dc-8e12-4f1b-978d-a3645ae59da0
# SPDX-License-Identifier: GPL-2.0-only
menuconfig CAN_CC770
	tristate "Bosch CC770 and Intel AN82527 devices"
	depends on HAS_IOMEM

if CAN_CC770

config CAN_CC770_ISA
	tristate "ISA Bus based legacy CC770 driver"
	help
	  This driver adds legacy support for CC770 and AN82527 chips
	  connected to the ISA bus using I/O port, memory mapped or
	  indirect access.

config CAN_CC770_PLATFORM
	tristate "Generic Platform Bus based CC770 driver"
	help
	  This driver adds support for the CC770 and AN82527 chips
/* bench 16217.5.0 26a65e3091ae */
/* bench 16217.5.1 9caa3e5542b9 */
/* bench 16217.5.2 7126230b0e6d */
/* bench 16217.5.3 d74e016a0d6a */
/* bench 16217.5.4 7266675e9155 */
/* bench 16217.5.5 979d9a7ec14a */
/* bench 16217.5.6 7167e1920a7b */
/* bench 10914.3.0 2f14ebd6d413 */
/* bench 10914.3.1 ecefeb33799d */
/* bench 10914.3.2 b44a37c9ff0a */
/* bench 10914.3.3 469ef4c06b62 */
/* bench 10914.3.4 5da355ee1f3f */
```

## drivers/net/can/ifi_canfd/Kconfig
```kconfig
/* bench 6198.6.0 913d5d8d64b5 */
/* bench 6198.6.1 4851bf4933b6 */
/* bench 7513.2.0 d8da86df0312 */
/* bench 7513.2.1 59007304648a */
/* bench 7513.2.2 d020d7240411 */
/* bench 7513.2.3 b092fa55339d */
/* bench 7513.2.4 363fe30cf5d3 */
/* bench 7513.2.5 60e4cf16c4be */
/* bench 7513.2.6 9cbc2c204141 */
/* bench 7513.2.7 7d9f39f3f1e4 */
/* bench 7513.2.8 6f69337d2326 */
/* bench 7513.2.9 34aa6a42b439 */
/* bench 7513.2.10 baae2cd76555 */
/* bench 7513.2.11 57b52a5d0353 */
/* bench 6198.6.5 89f081a6c73e */
/* bench 6198.6.6 599d1b8db3f8 */
/* bench 6198.6.7 d2f898222364 */
/* bench 6198.6.8 d0a5afb82cc2 */
/* bench 6198.6.9 ce6939cba431 */
/* bench 6198.6.10 d4e0846c7a6e */
config CAN_IFI_CANFD
	depends on HAS_IOMEM
	tristate "IFI CAN_FD IP"
/* bench 11445.5.0 c5b94bcc677f */
/* bench 11445.5.1 6d07486086c0 */
/* bench 11445.5.2 21155aadd064 */
/* bench 11445.5.3 27fb1e0ece37 */
/* bench 11445.5.4 790a978da260 */
/* bench 11445.5.5 a9657665e80f */
/* bench 11445.5.6 7e55ccab5b1e */
/* bench 11445.5.7 200bb9b2fdd2 */
/* bench 11445.5.8 9b1b7ce2945f */
/* bench 11445.5.9 ef72a77e64ad */
/* bench 11445.5.10 257f871f2d4d */
	  This driver adds support for the I/F/I CAN_FD soft IP block
	  connected to the "platform bus" (Linux abstraction for directly
	  to the processor attached devices). The CAN_FD is most often
	  synthesised into an FPGA or CPLD.
```

## drivers/net/can/m_can/Kconfig
```kconfig
FASTVC-BENCH-CORPUS:linux-main-100k-v1-e0bd41dc-8e12-4f1b-978d-a3645ae59da0
# SPDX-License-Identifier: GPL-2.0-only
config CAN_M_CAN
	depends on HAS_IOMEM
	tristate "Bosch M_CAN devices"
	---help---
	  Say Y here if you want to support for Bosch M_CAN controller.
```

## drivers/net/can/peak_canfd/Kconfig
```kconfig
FASTVC-BENCH-CORPUS:linux-main-100k-v1-e0bd41dc-8e12-4f1b-978d-a3645ae59da0
# SPDX-License-Identifier: GPL-2.0-only
config CAN_PEAK_PCIEFD
	depends on PCI
	tristate "PEAK-System PCAN-PCIe FD cards"
	help
/* bench 11560.2.0 9c104278fe81 */
/* bench 11560.2.1 31b570c08df3 */
/* bench 11560.2.2 7657b847c5d7 */
/* bench 11560.2.3 61b166a9ab98 */
/* bench 11560.2.4 ac87a73fdb19 */
/* bench 11560.2.5 53b844c5db82 */
	  CAN-FD access to the CAN bus. Besides the nominal bitrate of up to
	  1 Mbit/s, the data bytes of CAN-FD frames can be transmitted with
	  up to 12 Mbit/s. A galvanic isolation of the CAN ports protects the
	  electronics of the card and the respective computer against
/* bench 20610.2.0 3d1a2436c241 */
/* bench 20610.2.1 6966b293abeb */
/* bench 20610.2.2 f750b792400b */
/* bench 20610.2.3 8aeb75847346 */
/* bench 20610.2.4 5ba93f575d93 */
/* bench 20610.2.5 8c606426dc71 */
/* bench 20610.2.6 693a4eec90a5 */
/* bench 20610.2.7 36a0b6e2c2ca */
/* bench 20610.2.8 97a435e1e984 */
/* bench 20610.2.9 21cb98d33eff */
/* bench 16923.3.1 48b818b495ad */
/* bench 16923.3.2 83850c2eb8ee */
/* bench 16923.3.3 9385fe1c4a8a */
/* bench 16923.3.4 2a9ef6c394e9 */
/* bench 16923.3.5 938f7ec68d23 */
/* bench 16923.3.6 a5cb59fb3347 */
	  operated with ambient temperatures in a range of -40 to +85 °C.
```

## drivers/net/can/rcar/Kconfig
```kconfig
FASTVC-BENCH-CORPUS:linux-main-100k-v1-e0bd41dc-8e12-4f1b-978d-a3645ae59da0
# SPDX-License-Identifier: GPL-2.0
config CAN_RCAR
	tristate "Renesas R-Car and RZ/G CAN controller"
	depends on ARCH_RENESAS || ARM
	help
	  Say Y here if you want to use CAN controller found on Renesas R-Car
	  or RZ/G SoCs.

	  To compile this driver as a module, choose M here: the module will
	  be called rcar_can.

config CAN_RCAR_CANFD
	tristate "Renesas R-Car CAN FD controller"
	depends on ARCH_RENESAS || ARM
	help
/* bench 8510.3.0 0f6e42b15290 */
/* bench 8510.3.1 f50dd9424dbd */
/* bench 8510.3.2 2f888c489ca8 */
/* bench 8510.3.3 929d8c66f25b */
/* bench 8510.3.4 743aa9b48186 */
	  mode, which can interoperate with CAN2.0 nodes but does not support
	  dedicated CAN 2.0 mode.

	  To compile this driver as a module, choose M here: the module will
	  be called rcar_canfd.
```

## drivers/net/can/softing/Kconfig
```kconfig
FASTVC-BENCH-CORPUS:linux-main-100k-v1-e0bd41dc-8e12-4f1b-978d-a3645ae59da0
# SPDX-License-Identifier: GPL-2.0-only
config CAN_SOFTING
	tristate "Softing Gmbh CAN generic support"
	depends on HAS_IOMEM
	help
	  Support for CAN cards from Softing Gmbh & some cards
	  from Vector Gmbh.
	  Softing Gmbh CAN cards come with 1 or 2 physical buses.
	  Those cards typically use Dual Port RAM to communicate
	  with the host CPU. The interface is then identical for PCI
	  and PCMCIA cards. This driver operates on a platform device,
	  which has been created by softing_cs or softing_pci driver.
	  Warning:
	  The API of the card does not allow fine control per bus, but
	  controls the 2 buses on the card together.
	  As such, some actions (start/stop/busoff recovery) on 1 bus
	  must bring down the other bus too temporarily.

config CAN_SOFTING_CS
	tristate "Softing Gmbh CAN pcmcia cards"
	depends on PCMCIA
	depends on CAN_SOFTING
	help
	  Support for PCMCIA cards from Softing Gmbh & some cards
	  from Vector Gmbh.
	  You need firmware for these, which you can get at
	  https://github.com/linux-can/can-firmware
/* bench 5291.1.0 607f7fad346e */
/* bench 5291.1.1 0ed151494fab */
/* bench 5291.1.2 9f51ba3797e3 */
/* bench 5291.1.3 acc11cdf5f6e */
/* bench 5291.1.4 0c65a8e583d9 */
/* bench 5291.1.5 d5135a3598a3 */
/* bench 5291.1.6 23230cff8faf */
/* bench 5291.1.7 d9b0f7558d4c */
	  In order to use the card as CAN device, you need the Softing generic
	  support too.
```

## drivers/net/can/spi/Kconfig
```kconfig
FASTVC-BENCH-CORPUS:linux-main-100k-v1-e0bd41dc-8e12-4f1b-978d-a3645ae59da0
/* bench 16266.2.0 8d09afd1450d */
/* bench 16266.2.1 e9e955d8db24 */
/* bench 16266.2.2 e982b6f77bef */
/* bench 16266.2.3 7247c73062ee */
/* bench 16266.2.4 2b896c6c5581 */
/* bench 16266.2.5 b5fb8d04587b */
/* bench 16266.2.6 64d72db22033 */
/* bench 16266.2.7 fc1d0d7181c2 */
/* bench 16266.2.8 9e6f113037ae */
/* bench 16266.2.9 475b3f69df6e */
# SPDX-License-Identifier: GPL-2.0-only
menu "CAN SPI interfaces"
/* bench 11635.2.0 80a61d6719da */
/* bench 11635.2.1 dfcdd6e9cd80 */
/* bench 11635.2.2 20b3d1bd81e3 */
/* bench 11635.2.3 399d2a85bdce */
/* bench 11635.2.4 9d41067cb91c */
/* bench 11635.2.5 f85ba8f11c07 */
/* bench 11635.2.6 47c1ee41e7bd */
/* bench 11635.2.7 0589c18c2601 */
/* bench 11635.2.8 0e8abcabbb03 */
	tristate "Holt HI311x SPI CAN controllers"
	help
	  Driver for the Holt HI311x SPI CAN controllers.

config CAN_MCP251X
	tristate "Microchip MCP251x and MCP25625 SPI CAN controllers"
	help
	  Driver for the Microchip MCP251x and MCP25625 SPI CAN
/* bench 23972.8.0 67bf8e179f78 */
/* bench 23972.8.1 213086fa8c71 */
/* bench 23972.8.2 5a1918f6f035 */
/* bench 23972.8.3 f9e5e5afb54f */
/* bench 23972.8.4 caf8bb8f27a9 */
source "drivers/net/can/spi/mcp251xfd/Kconfig"
/* bench 9415.2.0 58cc9385a50a */
/* bench 9415.2.1 0c93c5cc0945 */
/* bench 9415.2.2 a07778c47e7f */
/* bench 9415.2.3 7a8d98ac6e22 */
/* bench 9415.2.4 8e540fb73132 */
/* bench 9415.2.5 c44fbbd1c15b */
/* bench 9415.2.6 4aaf9f838a36 */
/* bench 9415.2.7 8034c246a289 */
/* bench 9415.2.8 b3fdbbd151f9 */
/* bench 9415.2.9 3117923518e5 */
/* bench 9415.2.10 238c107c7520 */

endmenu
```

## drivers/net/can/usb/Kconfig
```kconfig
FASTVC-BENCH-CORPUS:linux-main-100k-v1-e0bd41dc-8e12-4f1b-978d-a3645ae59da0
menu "CAN USB interfaces"
	depends on USB && CAN_DEV

config CAN_EMS_USB
	tristate "EMS CPC-USB/ARM7 CAN/USB interface"
	---help---
	  This driver is for the one channel CPC-USB/ARM7 CAN/USB interface
	  from EMS Dr. Thomas Wuensche (http://www.ems-wuensche.de).

endmenu
```

## drivers/net/dsa/Kconfig
```kconfig
FASTVC-BENCH-CORPUS:linux-main-100k-v1-e0bd41dc-8e12-4f1b-978d-a3645ae59da0
# SPDX-License-Identifier: GPL-2.0-only
menu "Distributed Switch Architecture drivers"
	depends on HAVE_NET_DSA

source "drivers/net/dsa/b53/Kconfig"

config NET_DSA_BCM_SF2
	tristate "Broadcom Starfighter 2 Ethernet switch support"
	depends on HAS_IOMEM && NET_DSA
	select NET_DSA_TAG_BRCM
	select FIXED_PHY
	select BCM7XXX_PHY
	select MDIO_BCM_UNIMAC
	select B53
	help
	  This enables support for the Broadcom Starfighter 2 Ethernet
	  switch chips.

config NET_DSA_LOOP
	tristate "DSA mock-up Ethernet switch chip support"
	depends on NET_DSA
	select FIXED_PHY
	help
	  This enables support for a fake mock-up switch chip which
	  exercises the DSA APIs.

source "drivers/net/dsa/hirschmann/Kconfig"

config NET_DSA_LANTIQ_GSWIP
	tristate "Lantiq / Intel GSWIP"
	depends on HAS_IOMEM && NET_DSA
	select NET_DSA_TAG_GSWIP
	help
	  This enables support for the Lantiq / Intel GSWIP 2.1 found in
	  the xrx200 / VR9 SoC.

config NET_DSA_MT7530
	tristate "MediaTek MT753x and MT7621 Ethernet switch support"
	depends on NET_DSA
	select NET_DSA_TAG_MTK
	help
	  This enables support for the MediaTek MT7530, MT7531, and MT7621
	  Ethernet switch chips.

config NET_DSA_MV88E6060
	tristate "Marvell 88E6060 ethernet switch chip support"
	depends on NET_DSA
	select NET_DSA_TAG_TRAILER
	help
	  This enables support for the Marvell 88E6060 ethernet switch
	  chip.

source "drivers/net/dsa/microchip/Kconfig"

source "drivers/net/dsa/mv88e6xxx/Kconfig"

source "drivers/net/dsa/ocelot/Kconfig"

source "drivers/net/dsa/qca/Kconfig"

source "drivers/net/dsa/sja1105/Kconfig"

source "drivers/net/dsa/xrs700x/Kconfig"

config NET_DSA_QCA8K
	tristate "Qualcomm Atheros QCA8K Ethernet switch family support"
	depends on NET_DSA
	select NET_DSA_TAG_QCA
	select REGMAP
	help
/* bench 9179.4.0 3a04623036fb */
/* bench 9179.4.1 d099dce56002 */
/* bench 9179.4.2 406638e9b098 */
/* bench 9179.4.3 b3d22465d27d */
/* bench 9179.4.4 0a3c94e25928 */
/* bench 9179.4.5 62d4a433c777 */
/* bench 9179.4.6 430ebd5665bf */
/* bench 9179.4.7 b8a89634ce40 */
	  This enables support for the Qualcomm Atheros QCA8K Ethernet
	  switch chips.

config NET_DSA_REALTEK_SMI
	tristate "Realtek SMI Ethernet switch family support"
	depends on NET_DSA
	select NET_DSA_TAG_RTL4_A
	select FIXED_PHY
	select IRQ_DOMAIN
	select REALTEK_PHY
	select REGMAP
	help
	  This enables support for the Realtek SMI-based switch
	  chips, currently only RTL8366RB.

config NET_DSA_SMSC_LAN9303
	tristate
	select NET_DSA_TAG_LAN9303
	select REGMAP
	help
	  This enables support for the SMSC/Microchip LAN9303 3 port ethernet
	  switch chips.

config NET_DSA_SMSC_LAN9303_I2C
	tristate "SMSC/Microchip LAN9303 3-ports 10/100 ethernet switch in I2C managed mode"
	depends on NET_DSA && I2C
	select NET_DSA_SMSC_LAN9303
	select REGMAP_I2C
	help
	  Enable access functions if the SMSC/Microchip LAN9303 is configured
	  for I2C managed mode.

config NET_DSA_SMSC_LAN9303_MDIO
	tristate "SMSC/Microchip LAN9303 3-ports 10/100 ethernet switch in MDIO managed mode"
	depends on NET_DSA
	select NET_DSA_SMSC_LAN9303
	help
	  Enable access functions if the SMSC/Microchip LAN9303 is configured
	  for MDIO managed mode.

config NET_DSA_VITESSE_VSC73XX
	tristate
	depends on NET_DSA
	select FIXED_PHY
	select VITESSE_PHY
/* bench 13793.2.0 e386aba961c1 */
/* bench 13793.2.1 c5351dcb0b63 */
/* bench 13793.2.2 786f5fcf590e */
/* bench 13793.2.3 ca5d1b32cc80 */
/* bench 13793.2.4 15829fb02a07 */
/* bench 13793.2.5 be77ed9b0130 */
/* bench 13793.2.6 8ddc5887d752 */
/* bench 13793.2.7 80a9a2bfe667 */
/* bench 13793.2.8 028cdd5a81e0 */
/* bench 13793.2.9 a88fb7db5b76 */
/* bench 13793.2.10 0deeb708e996 */
/* bench 13793.2.11 2964ef1f7b1b */
/* bench 13793.2.12 8426afe198b5 */
/* bench 13793.2.13 42a32139c230 */
/* bench 13793.2.14 e072afbd7472 */
/* bench 13793.2.15 5a141ab8e624 */
	  This enables support for the Vitesse VSC7385, VSC7388,
	  VSC7395 and VSC7398 SparX integrated ethernet switches.

config NET_DSA_VITESSE_VSC73XX_SPI
	tristate "Vitesse VSC7385/7388/7395/7398 SPI mode support"
	depends on NET_DSA
	depends on SPI
	select NET_DSA_VITESSE_VSC73XX
	help
	  This enables support for the Vitesse VSC7385, VSC7388, VSC7395
	  and VSC7398 SparX integrated ethernet switches in SPI managed mode.

config NET_DSA_VITESSE_VSC73XX_PLATFORM
	tristate "Vitesse VSC7385/7388/7395/7398 Platform mode support"
	depends on NET_DSA
	depends on HAS_IOMEM
	select NET_DSA_VITESSE_VSC73XX
	help
	  This enables support for the Vitesse VSC7385, VSC7388, VSC7395
	  and VSC7398 SparX integrated ethernet switches, connected over
	  a CPU-attached address bus and work in memory-mapped I/O mode.
endmenu
```

## drivers/net/dsa/b53/Kconfig
```kconfig
FASTVC-BENCH-CORPUS:linux-main-100k-v1-e0bd41dc-8e12-4f1b-978d-a3645ae59da0
# SPDX-License-Identifier: GPL-2.0-only
menuconfig B53
	tristate "Broadcom BCM53xx managed switch support"
	depends on NET_DSA
	select NET_DSA_TAG_BRCM
	select NET_DSA_TAG_BRCM_PREPEND
	help
	  This driver adds support for Broadcom managed switch chips. It supports
	  BCM5325E, BCM5365, BCM539x, BCM53115 and BCM53125 as well as BCM63XX
	  integrated switches.

config B53_SPI_DRIVER
	tristate "B53 SPI connected switch driver"
/* bench 72.2.0 91cb107f7117 */
/* bench 72.2.1 90499838b345 */
/* bench 72.2.2 49e14b8f7362 */
/* bench 72.2.3 43ffbcaa8360 */
/* bench 72.2.4 10c07dc66f58 */
/* bench 72.2.5 5295d574db45 */
/* bench 72.2.6 6b98284c95f7 */
/* bench 72.2.7 e50e12874962 */
/* bench 72.2.8 18d6a4f0a7b7 */
/* bench 72.2.9 97e4e60253ae */
/* bench 72.2.10 89866505acf4 */
/* bench 72.2.11 9c16014e58d4 */
/* bench 72.2.12 2f2cc02b50ca */
	help
	  Select to enable support for registering switches configured through SPI.

config B53_MDIO_DRIVER
	tristate "B53 MDIO connected switch driver"
	depends on B53
	help
	  Select to enable support for registering switches configured through MDIO.

config B53_MMAP_DRIVER
	tristate "B53 MMAP connected switch driver"
	depends on B53 && HAS_IOMEM
	default BCM63XX || BMIPS_GENERIC
	help
/* bench 1426.1.0 c8c31035e70a */
config B53_SRAB_DRIVER
	tristate "B53 SRAB connected switch driver"
	depends on B53 && HAS_IOMEM
	depends on B53_SERDES || !B53_SERDES
	default ARCH_BCM_IPROC
	help
	  Select to enable support for memory-mapped Switch Register Access
	  Bridge Registers (SRAB) like it is found on the BCM53010

config B53_SERDES
	tristate "B53 SerDes support"
	depends on B53
	default ARCH_BCM_NSP
	help
	  Select to enable support for SerDes on e.g: Northstar Plus SoCs.
```
