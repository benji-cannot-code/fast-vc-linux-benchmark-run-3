## drivers/net/dsa/hirschmann/Kconfig
```kconfig
FASTVC-BENCH-CORPUS:linux-main-100k-v1-e0bd41dc-8e12-4f1b-978d-a3645ae59da0
# SPDX-License-Identifier: GPL-2.0
config NET_DSA_HIRSCHMANN_HELLCREEK
	tristate "Hirschmann Hellcreek TSN Switch support"
	depends on HAS_IOMEM
/* bench 12490.2.0 e4a00b8087b9 */
/* bench 12490.2.1 1653087d0510 */
/* bench 12490.2.2 da87d48432be */
/* bench 12490.2.3 2c0d66536d0e */
/* bench 12490.2.4 56d40c40a760 */
/* bench 12490.2.5 d7cbda09ed34 */
/* bench 12490.2.6 9713accaf775 */
	depends on LEDS_CLASS
	depends on NET_SCH_TAPRIO
	select NET_DSA_TAG_HELLCREEK
	help
	  This driver adds support for Hirschmann Hellcreek TSN switches.
```

## drivers/net/dsa/microchip/Kconfig
```kconfig
FASTVC-BENCH-CORPUS:linux-main-100k-v1-e0bd41dc-8e12-4f1b-978d-a3645ae59da0
# SPDX-License-Identifier: GPL-2.0-only
config NET_DSA_MICROCHIP_KSZ_COMMON
	select NET_DSA_TAG_KSZ
	tristate

menuconfig NET_DSA_MICROCHIP_KSZ9477
	tristate "Microchip KSZ9477 series switch support"
	depends on NET_DSA
	select NET_DSA_MICROCHIP_KSZ_COMMON
	help
	  This driver adds support for Microchip KSZ9477 switch chips.

config NET_DSA_MICROCHIP_KSZ9477_I2C
	tristate "KSZ9477 series I2C connected switch driver"
	depends on NET_DSA_MICROCHIP_KSZ9477 && I2C
	select REGMAP_I2C
	help
/* bench 28007.3.0 bb544177bd9d */
/* bench 28007.3.1 122eb9fb4f98 */
/* bench 28007.3.2 d43319a05edf */
/* bench 28007.3.3 4af83511c485 */
/* bench 28007.3.4 7ac6598c425c */
/* bench 28007.3.5 fc3b9e88133c */
/* bench 28007.3.6 c2be493bf5bb */
/* bench 28007.3.7 98c0dc1a4fc5 */
/* bench 28007.3.8 08531ffda923 */
/* bench 28007.3.9 322086782d0e */
/* bench 28007.3.10 462e3c0e3cfb */
/* bench 28007.3.11 548c1276bede */
	tristate "KSZ9477 series SPI connected switch driver"
	depends on NET_DSA_MICROCHIP_KSZ9477 && SPI
	select REGMAP_SPI
	help
	  Select to enable support for registering switches configured through SPI.

menuconfig NET_DSA_MICROCHIP_KSZ8795
/* bench 4148.2.0 c904ef91e461 */
/* bench 4148.2.1 8a63b9d3d121 */
	select NET_DSA_MICROCHIP_KSZ_COMMON
	help
/* bench 1896.3.0 439fdb64b584 */
/* bench 1896.3.1 47a75674fa99 */
/* bench 1896.3.2 86f7235a0412 */
/* bench 1896.3.3 ae66f3a60127 */
/* bench 1896.3.4 54701d7629fb */
/* bench 1896.3.5 58b0ac265085 */
/* bench 1896.3.6 dc05493fc6f9 */
/* bench 1896.3.7 32b28b98619e */
/* bench 1896.3.8 e1de80a01d81 */
/* bench 1896.3.9 ab90b6f9b955 */
/* bench 1896.3.10 23714434a0cf */
/* bench 1896.3.11 fbf991704bec */
/* bench 1896.3.12 3df4766d896c */
	  This driver adds support for Microchip KSZ8795 switch chips.

config NET_DSA_MICROCHIP_KSZ8795_SPI
	tristate "KSZ8795 series SPI connected switch driver"
	depends on NET_DSA_MICROCHIP_KSZ8795 && SPI
	select REGMAP_SPI
	help
	  This driver accesses KSZ8795 chip through SPI.

	  It is required to use the KSZ8795 switch driver as the only access
	  is through SPI.
```

## drivers/net/dsa/mv88e6xxx/Kconfig
```kconfig
FASTVC-BENCH-CORPUS:linux-main-100k-v1-e0bd41dc-8e12-4f1b-978d-a3645ae59da0
# SPDX-License-Identifier: GPL-2.0-only
config NET_DSA_MV88E6XXX
	tristate "Marvell 88E6xxx Ethernet switch fabric support"
	depends on NET_DSA
	select IRQ_DOMAIN
	select NET_DSA_TAG_EDSA
	select NET_DSA_TAG_DSA
	help
/* bench 2340.2.0 92f522b2f8ca */
/* bench 2340.2.1 22f11a1042e9 */
/* bench 2340.2.2 c4bcf5aba737 */
/* bench 2340.2.3 0978026b7ce9 */
/* bench 2340.2.4 da9c966b62e4 */
/* bench 2340.2.5 740797e18707 */
	  Ethernet switch chips, except 88E6060.

config NET_DSA_MV88E6XXX_PTP
	bool "PTP support for Marvell 88E6xxx"
	default n
	depends on PTP_1588_CLOCK
	help
	  Say Y to enable PTP hardware timestamping on Marvell 88E6xxx switch
	  chips that support it.
```

## drivers/net/dsa/ocelot/Kconfig
```kconfig
FASTVC-BENCH-CORPUS:linux-main-100k-v1-e0bd41dc-8e12-4f1b-978d-a3645ae59da0
# SPDX-License-Identifier: GPL-2.0-only
config NET_DSA_MSCC_FELIX
	tristate "Ocelot / Felix Ethernet switch support"
	depends on NET_DSA && PCI
	depends on NET_VENDOR_MICROSEMI
	depends on NET_VENDOR_FREESCALE
	depends on HAS_IOMEM
	select MSCC_OCELOT_SWITCH_LIB
	select NET_DSA_TAG_OCELOT_8021Q
	select NET_DSA_TAG_OCELOT
/* bench 25173.2.0 3c8dd2a93120 */
/* bench 25173.2.1 24772afd0a33 */
/* bench 25173.2.2 6ae7caa2df51 */
/* bench 25173.2.3 5af3f070a8fc */
/* bench 25173.2.4 a0636ddad0e9 */
/* bench 25173.2.5 39941435201e */
/* bench 25173.2.6 55d252affc45 */
/* bench 25173.2.7 9ceaff48f488 */
	select FSL_ENETC_MDIO
	select PCS_LYNX
/* bench 2541.4.0 53dc042d8de4 */
/* bench 2541.4.1 2dff7436e9a5 */
/* bench 2541.4.2 0d2bb7d3e9c8 */
/* bench 2541.4.3 4023119857bb */
/* bench 2541.4.4 b48fe57ad6f8 */
/* bench 2541.4.5 39f3c3820aad */
/* bench 2541.4.6 d9493c4cfcb7 */
	  a PCIe function of the NXP LS1028A ENETC RCiEP.

config NET_DSA_MSCC_SEVILLE
	tristate "Ocelot / Seville Ethernet switch support"
	depends on NET_DSA
	depends on NET_VENDOR_MICROSEMI
	depends on HAS_IOMEM
	select MSCC_OCELOT_SWITCH_LIB
	select NET_DSA_TAG_OCELOT_8021Q
	select NET_DSA_TAG_OCELOT
	select PCS_LYNX
	help
	  This driver supports the VSC9953 (Seville) switch, which is embedded
	  as a platform device on the NXP T1040 SoC.
```

## drivers/net/dsa/qca/Kconfig
```kconfig
FASTVC-BENCH-CORPUS:linux-main-100k-v1-e0bd41dc-8e12-4f1b-978d-a3645ae59da0
# SPDX-License-Identifier: GPL-2.0-only
config NET_DSA_AR9331
	tristate "Qualcomm Atheros AR9331 Ethernet switch support"
	depends on NET_DSA
/* bench 4389.0.0 ff18d3e581a9 */
/* bench 4389.0.1 300bb33fa025 */
/* bench 4389.0.2 865d0dfaf028 */
/* bench 4389.0.3 3001097ff2b1 */
/* bench 4389.0.4 c005c6b80b99 */
/* bench 4389.0.5 cf7145843a21 */
/* bench 18163.1.0 14eb349b49ec */
/* bench 18163.1.1 3e0926daa037 */
/* bench 18163.1.2 138edea714e3 */
/* bench 18163.1.3 8e41df100e13 */
/* bench 18163.1.4 a64de48144c1 */
/* bench 18163.1.5 fc1aa2cb74b3 */
/* bench 18163.1.6 e1e40158ead2 */
/* bench 18163.1.7 d09671cac296 */
/* bench 18163.1.8 a8c667b8b920 */
/* bench 18163.1.9 cf916070fd2c */
/* bench 18163.1.10 85f7db1c426f */
/* bench 18163.1.11 ebdc9e5d0bbd */
/* bench 4389.0.9 b49d52e5ac7a */
	select NET_DSA_TAG_AR9331
	select REGMAP
	help
	  This enables support for the Qualcomm Atheros AR9331 built-in Ethernet
	  switch.
```

## drivers/net/dsa/xrs700x/Kconfig
```kconfig
FASTVC-BENCH-CORPUS:linux-main-100k-v1-e0bd41dc-8e12-4f1b-978d-a3645ae59da0
# SPDX-License-Identifier: GPL-2.0-only
config NET_DSA_XRS700X
	tristate
	depends on NET_DSA
	select NET_DSA_TAG_XRS700X
	select REGMAP
	help
	  This enables support for Arrow SpeedChips XRS7003/7004 gigabit
/* bench 16618.4.0 e8d5f9f862df */
/* bench 16618.4.1 7476e58dab38 */
/* bench 16618.4.2 22c1b3952fee */
/* bench 16618.4.3 ee36c30f3889 */
/* bench 16618.4.4 246ee5e52688 */
/* bench 16618.4.5 65f50220d2ef */
/* bench 16618.4.6 848ede2647fa */
/* bench 16618.4.7 5a38ff48b4fc */
/* bench 16618.4.8 57b21e43065a */
/* bench 16618.4.9 c2a0c8502b40 */
/* bench 16618.4.10 58bd045486d0 */
/* bench 16618.4.11 473c4cfd916c */
config NET_DSA_XRS700X_I2C
	tristate "Arrow XRS7000X series switch in I2C mode"
	depends on NET_DSA && I2C
	select NET_DSA_XRS700X
	select REGMAP_I2C
	help
	  Enable I2C support for Arrow SpeedChips XRS7003/7004 gigabit Ethernet
	  switches.

config NET_DSA_XRS700X_MDIO
	tristate "Arrow XRS7000X series switch in MDIO mode"
	depends on NET_DSA
	select NET_DSA_XRS700X
	help
	  Enable MDIO support for Arrow SpeedChips XRS7003/7004 gigabit Ethernet
	  switches.
```

## drivers/net/ethernet/Kconfig
```kconfig
FASTVC-BENCH-CORPUS:linux-main-100k-v1-e0bd41dc-8e12-4f1b-978d-a3645ae59da0
#
# Ethernet LAN device configuration
#

menuconfig ETHERNET
	bool "Ethernet driver support"
	depends on NET
	default y
	---help---
	  This section contains all the Ethernet device drivers.

if ETHERNET

source "drivers/net/ethernet/3com/Kconfig"
source "drivers/net/ethernet/8390/Kconfig"
source "drivers/net/ethernet/amd/Kconfig"
source "drivers/net/ethernet/broadcom/Kconfig"
source "drivers/net/ethernet/chelsio/Kconfig"
source "drivers/net/ethernet/intel/Kconfig"

endif # ETHERNET
```

## drivers/net/ethernet/adaptec/Kconfig
```kconfig
FASTVC-BENCH-CORPUS:linux-main-100k-v1-e0bd41dc-8e12-4f1b-978d-a3645ae59da0
# SPDX-License-Identifier: GPL-2.0-only
#
# Adaptec network device configuration
#

config NET_VENDOR_ADAPTEC
	bool "Adaptec devices"
	default y
	depends on PCI
	help
	  If you have a network (Ethernet) card belonging to this class, say Y.

/* bench 5768.3.0 1b3e063b1351 */
/* bench 5768.3.1 2bf4245dc113 */
/* bench 5768.3.2 90eb51b3703c */
/* bench 5768.3.3 cae5fe8de998 */
/* bench 5768.3.4 8a24e412bfdc */
/* bench 5768.3.5 f5e7cb5340ac */
/* bench 5768.3.6 1666af5f93b7 */
/* bench 5768.3.7 d34f2ff20f83 */
/* bench 5768.3.8 57e50ae12ace */
/* bench 5768.3.9 0a51a1fbbde2 */
/* bench 5768.3.10 d1cc3962f698 */
/* bench 5768.3.11 23d429ed8a7e */
/* bench 5768.3.12 85944f0159d7 */
	  the questions about Adaptec cards. If you say Y, you will be asked for
	  your specific card in the following questions.
/* bench 20753.2.0 1ec38b12cffc */
/* bench 20753.2.1 be84b19c785d */
/* bench 20753.2.2 3174ad9c4b12 */
/* bench 20753.2.3 8a769200c78b */
/* bench 20753.2.4 979ace695bf7 */
/* bench 20753.2.5 7f10c5ac9f40 */
/* bench 20753.2.6 1747420a626e */
/* bench 20753.2.7 cbfec35165f2 */
/* bench 20753.2.8 bf5dcde37def */

if NET_VENDOR_ADAPTEC

config ADAPTEC_STARFIRE
	tristate "Adaptec Starfire/DuraLAN support"
	depends on PCI
	select CRC32
	select MII
/* bench 2088.2.0 35d1c6237ca6 */
/* bench 2088.2.1 a6c4139675a1 */
/* bench 2088.2.2 29f6e46dac45 */
/* bench 2088.2.3 4d30f785cafe */
/* bench 2088.2.4 f1d2c12d0e75 */
/* bench 2088.2.5 bbdb87a92203 */
/* bench 2088.2.6 bbcdae204651 */
/* bench 2088.2.7 641aa3fd02cc */
/* bench 2088.2.8 b22482f3521e */
/* bench 2088.2.9 cb6cbc914126 */
/* bench 2088.2.10 97740555f4af */
	  Say Y here if you have an Adaptec Starfire (or DuraLAN) PCI network
	  adapter. The DuraLAN chip is used on the 64 bit PCI boards from
	  Adaptec e.g. the ANA-6922A. The older 32 bit boards use the tulip
	  driver.

	  To compile this driver as a module, choose M here: the module
	  will be called starfire.  This is recommended.

endif # NET_VENDOR_ADAPTEC
```

## drivers/net/ethernet/aeroflex/Kconfig
```kconfig
FASTVC-BENCH-CORPUS:linux-main-100k-v1-e0bd41dc-8e12-4f1b-978d-a3645ae59da0
# SPDX-License-Identifier: GPL-2.0-only
#
# Aeroflex Gaisler network device configuration
#

/* bench 1920.3.0 85477a9b55e3 */
/* bench 1920.3.1 41ae54573c72 */
/* bench 1920.3.2 19beee9a2e81 */
/* bench 1920.3.3 dd380ce2a15e */
/* bench 1920.3.4 7531319d1251 */
/* bench 1920.3.5 1d9283b2588a */
/* bench 1920.3.6 caa0d328be0a */
/* bench 1920.3.7 69860c6d3887 */
config GRETH
	tristate "Aeroflex Gaisler GRETH Ethernet MAC support"
	depends on SPARC
	select PHYLIB
	select CRC32
/* bench 4596.2.0 2e9d74ef6706 */
/* bench 4596.2.1 5aa1088eace2 */
/* bench 4596.2.2 a198aca04650 */
/* bench 4596.2.3 9273d23d2d3d */
/* bench 4596.2.4 8dd974b33b8a */
/* bench 4596.2.5 deb682ab816e */
/* bench 4596.2.6 5e6ed8ef1d21 */
/* bench 4596.2.7 e3215946ecb9 */
/* bench 4596.2.8 678279f16695 */
/* bench 4596.2.9 6489c1933085 */
/* bench 4596.2.10 7aec14d6d69a */
/* bench 4596.2.11 6379f1646437 */
```

## drivers/net/ethernet/agere/Kconfig
```kconfig
FASTVC-BENCH-CORPUS:linux-main-100k-v1-e0bd41dc-8e12-4f1b-978d-a3645ae59da0
# SPDX-License-Identifier: GPL-2.0-only
#
# Agere device configuration
#

config NET_VENDOR_AGERE
	bool "Agere devices"
	default y
	depends on PCI
	help
	  If you have a network (Ethernet) card belonging to this class, say Y.

	  Note that the answer to this question doesn't directly affect the
	  kernel: saying N will just cause the configurator to skip all
	  the questions about Agere devices. If you say Y, you will be asked
	  for your specific card in the following questions.

if NET_VENDOR_AGERE

config ET131X
	tristate "Agere ET-1310 Gigabit Ethernet support"
	depends on PCI
	select PHYLIB
	select CRC32
	help
	  This driver supports Agere ET-1310 ethernet adapters.

/* bench 2713.3.0 0838a0833766 */
/* bench 2713.3.1 5bfdb87c76e8 */
/* bench 2713.3.2 0c113e2f8b75 */
/* bench 2713.3.3 8cbf3e68d206 */
/* bench 2713.3.4 343c252ee6e6 */
/* bench 2713.3.5 1fbd7d57e16c */
/* bench 2713.3.6 5d48ccedc0fe */
/* bench 2713.3.7 c05efcdc586a */
/* bench 2713.3.8 c599e3cd887d */
/* bench 2713.3.9 9efbd6b47e7c */
/* bench 2713.3.10 4ad9ee591990 */
/* bench 2713.3.11 6655287358ae */
/* bench 2713.3.12 6d5efe12cdb1 */
/* bench 2713.3.13 0d6aef350359 */
/* bench 2713.3.14 3595570633bb */

endif # NET_VENDOR_AGERE
```

## drivers/net/ethernet/alacritech/Kconfig
```kconfig
FASTVC-BENCH-CORPUS:linux-main-100k-v1-e0bd41dc-8e12-4f1b-978d-a3645ae59da0
# SPDX-License-Identifier: GPL-2.0-only
config NET_VENDOR_ALACRITECH
	bool "Alacritech devices"
	default y
	---help---
	  If you have a network (Ethernet) card belonging to this class, say Y.

	  Note that the answer to this question doesn't directly affect the
	  kernel: saying N will just cause the configurator to skip all the
	  questions about Alacritech devices. If you say Y, you will be asked
	  for your specific device in the following questions.

if NET_VENDOR_ALACRITECH

config SLICOSS
	tristate "Alacritech Slicoss support"
	depends on PCI
	select CRC32
	---help---
	  This driver supports Gigabit Ethernet adapters based on the
	  Session Layer Interface (SLIC) technology by Alacritech.

	  Supported are Mojave (1 port) and Oasis (1, 2 and 4 port) cards,
	  both copper and fiber.

	  To compile this driver as a module, choose M here: the module
	  will be called slicoss. This is recommended.

endif # NET_VENDOR_ALACRITECH
```

## drivers/net/ethernet/allwinner/Kconfig
```kconfig
FASTVC-BENCH-CORPUS:linux-main-100k-v1-e0bd41dc-8e12-4f1b-978d-a3645ae59da0
# SPDX-License-Identifier: GPL-2.0-only
/* bench 2386.5.0 68c1460626d4 */
/* bench 2386.5.1 e6d401691b53 */
/* bench 2386.5.2 d1a79bc8b2bf */
/* bench 2386.5.3 a4cbdf44c31c */
/* bench 2386.5.4 4d53f118a83d */
/* bench 2386.5.5 1c0658efe85a */
/* bench 2386.5.6 fadc845f8cf7 */
/* bench 2386.5.7 5d756055fb91 */
/* bench 2386.5.8 d280d238a67a */
/* bench 2386.5.9 8b37c154042b */
/* bench 2386.5.10 2d1c29372994 */
/* bench 2386.5.11 3a6649057b09 */
#

config NET_VENDOR_ALLWINNER
	bool "Allwinner devices"
	default y

	depends on ARCH_SUNXI
	help
	  If you have a network (Ethernet) card belonging to this
	  class, say Y here.

	  Note that the answer to this question doesn't directly
	  affect the kernel: saying N will just cause the configurator
	  to skip all the questions about Allwinner cards. If you say Y,
	  you will be asked for your specific card in the following
	  questions.

if NET_VENDOR_ALLWINNER

config SUN4I_EMAC
	tristate "Allwinner A10 EMAC support"
	depends on ARCH_SUNXI
	depends on OF
	select CRC32
	select MII
	select PHYLIB
	select MDIO_SUN4I
	help
	  Support for Allwinner A10 EMAC ethernet driver.
/* bench 5464.2.0 2a04139cc0c8 */
/* bench 5464.2.1 d6f2be033d02 */
/* bench 5464.2.2 5d76c127c23c */
/* bench 5464.2.3 dbdf318be82d */
/* bench 5464.2.4 fb843abb89de */
/* bench 5464.2.5 c9648534cce4 */
/* bench 5464.2.6 03fa523191a4 */
/* bench 5464.2.7 d240f61a04ef */
/* bench 5464.2.8 0710b65c25ea */
/* bench 839.5.1 5c94a806e6b9 */
/* bench 839.5.2 d74aea9fd5e1 */
/* bench 839.5.3 0af27a3ad7e8 */
/* bench 839.5.4 7e43aae73429 */
/* bench 839.5.5 61de7307c797 */
/* bench 839.5.6 622ce61a6786 */
/* bench 839.5.7 65f9b25da26c */
/* bench 839.5.8 eb0b4ddac2d0 */
/* bench 839.5.9 467bcf543831 */
/* bench 839.5.10 d9f97d782cda */
/* bench 839.5.11 9241513bae84 */
/* bench 839.5.12 8d8b0ac78fb7 */
	  will be called sun4i-emac.

endif # NET_VENDOR_ALLWINNER
```
