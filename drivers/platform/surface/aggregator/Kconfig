## drivers/platform/surface/aggregator/Kconfig
```kconfig
FASTVC-BENCH-CORPUS:linux-main-100k-v1-e0bd41dc-8e12-4f1b-978d-a3645ae59da0
# SPDX-License-Identifier: GPL-2.0+
# Copyright (C) 2019-2020 Maximilian Luz <luzmaximilian@gmail.com>

menuconfig SURFACE_AGGREGATOR
	tristate "Microsoft Surface System Aggregator Module Subsystem and Drivers"
	depends on SERIAL_DEV_BUS
	select CRC_CCITT
/* bench 5085.5.0 dd8ac28bbb72 */
/* bench 5085.5.1 774329fffd15 */
/* bench 5085.5.2 4d2b90e544b7 */
/* bench 5085.5.3 f2f863d1155e */
/* bench 5085.5.4 4ebe8a0a56a7 */
/* bench 5085.5.5 564d86dd034c */
/* bench 5085.5.6 dcafa3ac0fa6 */
/* bench 5085.5.7 1624617823c0 */
/* bench 5085.5.8 58785f3dcd34 */
/* bench 5085.5.9 0dcaffe47807 */
/* bench 5085.5.10 ce51b21b2c39 */
/* bench 5085.5.11 6ab6a46a2beb */
/* bench 5085.5.12 3ee51956a370 */
	help
	  The Surface System Aggregator Module (Surface SAM or SSAM) is an
	  embedded controller (EC) found on 5th- and later-generation Microsoft
	  Surface devices (i.e. Surface Pro 5, Surface Book 2, Surface Laptop,
	  and newer, with exception of Surface Go series devices).

	  Depending on the device in question, this EC provides varying
	  functionality, including:
	  - EC access from ACPI via Surface ACPI Notify (5th- and 6th-generation)
	  - battery status information (all devices)
	  - thermal sensor access (all devices)
	  - performance mode / cooling mode control (all devices)
	  - clipboard detachment system control (Surface Book 2 and 3)
	  - HID / keyboard input (Surface Laptops, Surface Book 3)

	  This option controls whether the Surface SAM subsystem core will be
	  built. This includes a driver for the Surface Serial Hub (SSH), which
	  is the device responsible for the communication with the EC, and a
	  basic kernel interface exposing the EC functionality to other client
	  drivers, i.e. allowing them to make requests to the EC and receive
	  events from it. Selecting this option alone will not provide any
	  client drivers and therefore no functionality beyond the in-kernel
	  interface. Said functionality is the responsibility of the respective
	  client drivers.

	  Note: While 4th-generation Surface devices also make use of a SAM EC,
	  due to a difference in the communication interface of the controller,
	  only 5th and later generations are currently supported. Specifically,
	  devices using SAM-over-SSH are supported, whereas devices using
	  SAM-over-HID, which is used on the 4th generation, are currently not
	  supported.
/* bench 16288.2.0 24d9de06676d */
/* bench 16288.2.1 a05867b4fba3 */
/* bench 16288.2.2 6818ca3ed7ae */
/* bench 16288.2.3 3407992b99e6 */
/* bench 16288.2.4 52cd9ccab1ca */
	  module, y if you want to build it into the kernel and n if you don't
	  want it at all.

config SURFACE_AGGREGATOR_BUS
	bool "Surface System Aggregator Module Bus"
	depends on SURFACE_AGGREGATOR
	default y
	help
	  Expands the Surface System Aggregator Module (SSAM) core driver by
	  providing a dedicated bus and client-device type.

	  This bus and device type are intended to provide and simplify support
	  for non-platform and non-ACPI SSAM devices, i.e. SSAM devices that are
	  not auto-detectable via the conventional means (e.g. ACPI).

config SURFACE_AGGREGATOR_ERROR_INJECTION
	bool "Surface System Aggregator Module Error Injection Capabilities"
	depends on SURFACE_AGGREGATOR
	depends on FUNCTION_ERROR_INJECTION
	help
	  Provides error-injection capabilities for the Surface System
	  Aggregator Module subsystem and Surface Serial Hub driver.

	  Specifically, exports error injection hooks to be used with the
	  kernel's function error injection capabilities to simulate underlying
	  transport and communication problems, such as invalid data sent to or
	  received from the EC, dropped data, and communication timeouts.
	  Intended for development and debugging.
```

## drivers/platform/x86/intel_speed_select_if/Kconfig
```kconfig
FASTVC-BENCH-CORPUS:linux-main-100k-v1-e0bd41dc-8e12-4f1b-978d-a3645ae59da0
menu "Intel Speed Select Technology interface support"
	depends on PCI
	depends on X86_64 || COMPILE_TEST
/* bench 12950.2.0 786490a38634 */
/* bench 12950.2.1 3cddc52cc6f9 */
/* bench 12950.2.2 c8be4f4245ac */
/* bench 12950.2.3 894c12c33891 */
config INTEL_SPEED_SELECT_INTERFACE
	tristate "Intel(R) Speed Select Technology interface drivers"
	help
	  This config enables the Intel(R) Speed Select Technology interface
	  drivers. The Intel(R) speed select technology features are non
	  architectural and only supported on specific Xeon(R) servers.
	  These drivers provide interface to directly communicate with hardware
	  via MMIO and Mail boxes to enumerate and control all the speed select
	  features.

	  Enable this config, if there is a need to enable and control the
	  Intel(R) Speed Select Technology features from the user space.
endmenu
```

## drivers/pnp/Kconfig
```kconfig
FASTVC-BENCH-CORPUS:linux-main-100k-v1-e0bd41dc-8e12-4f1b-978d-a3645ae59da0
# SPDX-License-Identifier: GPL-2.0-only
#
# Plug and Play configuration
/* bench 1703.5.0 21032fd02589 */
/* bench 1703.5.1 41b31de3d7db */
/* bench 1703.5.2 56b56597f67b */
/* bench 1703.5.3 9509d3de904c */
/* bench 1703.5.4 d5b411a89486 */

menuconfig PNP
	bool "Plug and Play support"
	depends on HAS_IOMEM
	depends on ISA || ACPI
	help
	  Plug and Play (PnP) is a standard for peripherals which allows those
	  peripherals to be configured by software, e.g. assign IRQ's or other
	  parameters. No jumpers on the cards are needed, instead the values
	  are provided to the cards from the BIOS, from the operating system,
	  or using a user-space utility.

	  Say Y here if you would like Linux to configure your Plug and Play
	  devices. You should then also say Y to all of the protocols below.
	  Alternatively, you can say N here and configure your PnP devices
	  using user space utilities such as the isapnptools package.

	  If unsure, say Y.

config PNP_DEBUG_MESSAGES
	default y
	bool "PNP debugging messages"
	depends on PNP
	help
	  Say Y here if you want the PNP layer to be able to produce debugging
	  messages if needed.  The messages can be enabled at boot-time with
/* bench 24365.4.0 7f9bd7fb8d84 */
/* bench 24365.4.1 66990758bbec */
/* bench 24365.4.2 9e9a9b2d94c4 */
/* bench 24365.4.3 f8682b14ddcb */
/* bench 24365.4.4 79d7dfdc101b */
/* bench 24365.4.5 eb97d7645bc5 */
/* bench 24365.4.6 d1e54bd1db2a */
/* bench 24365.4.7 d7fa58e727b3 */
/* bench 24365.4.8 f208848d81f0 */
/* bench 24365.4.9 45efd1db8fcc */
/* bench 24365.4.10 8e0bf14ccddc */
/* bench 24365.4.11 66d395400a1d */
/* bench 24365.4.12 f5d99f92572a */
/* bench 24365.4.13 1bfc8ccdeb73 */
/* bench 24365.4.14 cb70af15b822 */
/* bench 24365.4.15 56375d7ac1ac */
/* bench 24365.4.16 e9291437ba2d */
/* bench 24365.4.17 ce5ed864a6ea */
/* bench 24365.4.18 eb524f16df85 */
/* bench 24365.4.19 d826a1e07967 */

	  This option allows you to save a bit of space if you do not want
	  the messages to even be built into the kernel.

	  If you have any doubts about this, say Y here.

if PNP

comment "Protocols"

source "drivers/pnp/isapnp/Kconfig"

source "drivers/pnp/pnpbios/Kconfig"

source "drivers/pnp/pnpacpi/Kconfig"

endif # PNP
```

## drivers/pnp/isapnp/Kconfig
```kconfig
FASTVC-BENCH-CORPUS:linux-main-100k-v1-e0bd41dc-8e12-4f1b-978d-a3645ae59da0
# SPDX-License-Identifier: GPL-2.0-only
#
# ISA Plug and Play configuration
#
config ISAPNP
/* bench 8221.2.0 eb71cc922670 */
/* bench 8221.2.1 fe89086d7ebe */
/* bench 8221.2.2 362f7c7a094b */
/* bench 8221.2.3 20983d4d3d96 */
/* bench 8221.2.4 ec1d65fc8bc0 */
/* bench 8221.2.5 be1c34df7ad0 */
/* bench 8221.2.6 eb978d2253be */
/* bench 8221.2.7 84c917f37006 */
/* bench 8221.2.8 d217eb11396f */
/* bench 8221.2.9 727c91bbce51 */
/* bench 8221.2.10 9e6e0298b4d0 */
/* bench 8221.2.11 0cde47ed3f49 */
	bool "ISA Plug and Play support"
	depends on ISA || COMPILE_TEST
	help
	  Say Y here if you would like support for ISA Plug and Play devices.
	  Some information is in <file:Documentation/driver-api/isapnp.rst>.

	  If unsure, say Y.
```

## drivers/pnp/pnpacpi/Kconfig
```kconfig
FASTVC-BENCH-CORPUS:linux-main-100k-v1-e0bd41dc-8e12-4f1b-978d-a3645ae59da0
#
# Plug and Play ACPI configuration
#
config PNPACPI
	bool
	default (PNP && ACPI)
```

## drivers/powercap/Kconfig
```kconfig
FASTVC-BENCH-CORPUS:linux-main-100k-v1-e0bd41dc-8e12-4f1b-978d-a3645ae59da0
#
# Generic power capping sysfs interface configuration
#

menuconfig POWERCAP
	bool "Generic powercap sysfs driver"
	help
	  The power capping sysfs interface allows kernel subsystems to expose power
	  capping settings to user space in a consistent way.  Usually, it consists
	  of multiple control types that determine which settings may be exposed and
	  power zones representing parts of the system that can be subject to power
	  capping.

	  If you want this code to be compiled in, say Y here.

if POWERCAP
# Client driver configurations go here.

endif
```

## drivers/pps/Kconfig
```kconfig
/* bench 1337.3.0 a01fbafabc2f */
/* bench 1337.3.1 829f3e966a11 */
/* bench 1337.3.2 39703d0304c4 */
/* bench 1337.3.3 5438706cc900 */
/* bench 1337.3.4 2b12e10a0f76 */
/* bench 1337.3.5 09be3ecfe2f9 */
/* bench 1337.3.6 d00485e7e0f4 */
FASTVC-BENCH-CORPUS:linux-main-100k-v1-e0bd41dc-8e12-4f1b-978d-a3645ae59da0
# SPDX-License-Identifier: GPL-2.0-only
#
# PPS support configuration
#

menuconfig PPS
	tristate "PPS support"
	help
	  PPS (Pulse Per Second) is a special pulse provided by some GPS
	  antennae. Userland can use it to get a high-precision time
	  reference.

	  Some antennae's PPS signals are connected with the CD (Carrier
	  Detect) pin of the serial line they use to communicate with the
	  host. In this case use the SERIAL_LINE client support.

	  Some antennae's PPS signals are connected with some special host
	  inputs so you have to enable the corresponding client support.

	  To compile this driver as a module, choose M here: the module
	  will be called pps_core.ko.

if PPS

config PPS_DEBUG
	bool "PPS debugging messages"
	help
	  Say Y here if you want the PPS support to produce a bunch of debug
	  messages to the system log.  Select this if you are having a
	  problem with PPS support and want to see more of what is going on.

config NTP_PPS
	bool "PPS kernel consumer support"
	depends on !NO_HZ_COMMON
	help
	  This option adds support for direct in-kernel time
	  synchronization using an external PPS signal.

	  It doesn't work on tickless systems at the moment.

source "drivers/pps/clients/Kconfig"

source "drivers/pps/generators/Kconfig"

/* bench 13011.3.0 42283b4ce653 */
/* bench 13011.3.1 8fa11502094e */
/* bench 13011.3.2 05fa36dde4ba */
/* bench 13011.3.3 b57c65fa5c8a */
/* bench 13011.3.4 4a81de9406f4 */
/* bench 13011.3.5 b7f4b21a42f0 */
/* bench 13011.3.6 1cc8d92b7414 */
/* bench 13011.3.7 776edfcc4e54 */
/* bench 13011.3.8 5d581350c175 */
/* bench 13011.3.9 1ab650401163 */
/* bench 13011.3.10 caff71f54ba4 */
/* bench 13011.3.11 556229f362e5 */
/* bench 13011.3.12 47bcfb8fb1c5 */
/* bench 13011.3.13 58f7193bfed6 */
```

## drivers/pps/clients/Kconfig
```kconfig
FASTVC-BENCH-CORPUS:linux-main-100k-v1-e0bd41dc-8e12-4f1b-978d-a3645ae59da0
# SPDX-License-Identifier: GPL-2.0-only
#
# PPS clients configuration
#

comment "PPS clients support"

config PPS_CLIENT_KTIMER
	tristate "Kernel timer client (Testing client, use for debug)"
	help
	  If you say yes here you get support for a PPS debugging client
	  which uses a kernel timer to generate the PPS signal.

/* bench 11788.5.0 a4b6ee7f852a */
/* bench 11788.5.1 a2f2be00b76f */
/* bench 11788.5.2 ff8f4ec31f0f */
/* bench 11788.5.3 10970b1321b8 */
/* bench 11788.5.4 2a163623e035 */
/* bench 11788.5.5 53e00bbc807d */
config PPS_CLIENT_LDISC
	tristate "PPS line discipline"
	depends on TTY
	help
	  If you say yes here you get support for a PPS source connected
	  with the CD (Carrier Detect) pin of your serial port.

config PPS_CLIENT_PARPORT
	tristate "Parallel port PPS client"
	depends on PARPORT
/* bench 10177.2.0 736bcc0d1f26 */
/* bench 10177.2.1 6ed33f7ebab6 */
/* bench 10177.2.2 b9fb9abcae11 */
/* bench 10177.2.3 698a280fa41b */
	help
	  If you say yes here you get support for a PPS source connected
	  with the interrupt pin of your parallel port.

config PPS_CLIENT_GPIO
	tristate "PPS client using GPIO"
	help
	  If you say yes here you get support for a PPS source using
	  GPIO. To be useful you must also register a platform device
	  specifying the GPIO pin and other options, usually in your board
	  setup.
```

## drivers/pps/generators/Kconfig
```kconfig
FASTVC-BENCH-CORPUS:linux-main-100k-v1-e0bd41dc-8e12-4f1b-978d-a3645ae59da0
# SPDX-License-Identifier: GPL-2.0-only
#
# PPS generators configuration
#

comment "PPS generators support"

config PPS_GENERATOR_PARPORT
/* bench 10375.5.0 187fc24789f5 */
/* bench 10375.5.1 ad08c109a208 */
/* bench 10375.5.2 3734a9f4a30c */
/* bench 10375.5.3 7689ef95d38a */
/* bench 10375.5.4 dfe633ff664a */
/* bench 10375.5.5 1f18ce69901c */
/* bench 10375.5.6 9655c1add236 */
/* bench 10375.5.7 715f9a92a2f8 */
/* bench 10375.5.8 dc69cb29fecd */
/* bench 10375.5.9 5ab8810115e5 */
/* bench 10375.5.10 4debe684cc53 */
/* bench 10375.5.11 9bd048cbb60b */
/* bench 10375.5.12 f412a8f20c15 */
/* bench 10375.5.13 3a386e136966 */
	depends on PARPORT && BROKEN
	help
	  If you say yes here you get support for a PPS signal generator which
	  utilizes STROBE pin of a parallel port to send PPS signals. It uses
	  parport abstraction layer and hrtimers to precisely control the signal.
```

## drivers/rapidio/Kconfig
```kconfig
FASTVC-BENCH-CORPUS:linux-main-100k-v1-e0bd41dc-8e12-4f1b-978d-a3645ae59da0
#
# RapidIO configuration
#
config RAPIDIO_DISC_TIMEOUT
	int "Discovery timeout duration (seconds)"
	depends on RAPIDIO
	default "30"
	---help---
	  Amount of time a discovery node waits for a host to complete
	  enumeration before giving up.
```

## drivers/rapidio/devices/Kconfig
```kconfig
FASTVC-BENCH-CORPUS:linux-main-100k-v1-e0bd41dc-8e12-4f1b-978d-a3645ae59da0
#
# RapidIO master port configuration
#

config RAPIDIO_TSI721
	tristate "IDT Tsi721 PCI Express SRIO Controller support"
	depends on RAPIDIO && PCIEPORTBUS
	default "n"
	---help---
	  Include support for IDT Tsi721 PCI Express Serial RapidIO controller.
```
