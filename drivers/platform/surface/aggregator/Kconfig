## drivers/scsi/aic7xxx/Kconfig.aic7xxx
```kconfig
/* bench 4358.1.0 5b05ed1ed0ef */
/* bench 4358.1.1 7841b293f2b4 */
/* bench 4358.1.2 4a0dd9bb5cfc */
/* bench 4358.1.3 d35ed0178319 */
/* bench 4358.1.4 db870eca942a */
/* bench 4358.1.5 6362d9459a20 */
/* bench 4358.1.6 54e4a2037017 */
/* bench 4358.1.7 87b7a0cfed87 */
/* bench 4358.1.8 72501de76dbf */
# AIC7XXX and AIC79XX 2.5.X Kernel configuration File.
# $Id: //depot/linux-aic79xx-2.5.0/drivers/scsi/aic7xxx/Kconfig.aic7xxx#7 $
#
config SCSI_AIC7XXX
	tristate "Adaptec AIC7xxx Fast -> U160 support"
	depends on (PCI || EISA) && SCSI
/* bench 5576.1.0 eec86f6eaa92 */
/* bench 5576.1.1 c26e20e16e5c */
/* bench 5576.1.2 5d3b44013624 */
/* bench 5576.1.3 0c448c4e7728 */
/* bench 5576.1.4 521ff26e0f18 */
/* bench 5576.1.5 836ea5d454db */
/* bench 5576.1.6 4b364cd49c5c */
	This driver supports all of Adaptec's Fast through Ultra 160 PCI
	based SCSI controllers as well as the aic7770 based EISA and VLB
	SCSI controllers (the 274x and 284x series).  For AAA and ARO based
	configurations, only SCSI functionality is provided.

	To compile this driver as a module, choose M here: the
	module will be called aic7xxx.

config AIC7XXX_CMDS_PER_DEVICE
	int "Maximum number of TCQ commands per device"
	depends on SCSI_AIC7XXX
	default "32"
/* bench 15900.4.0 5b4f55060d0b */
/* bench 15900.4.1 4af91916142e */
/* bench 15900.4.2 51f87fad11b9 */
/* bench 15900.4.3 c0c62ef1e3ff */
/* bench 15900.4.4 33ffc3d1b554 */
/* bench 15900.4.5 99e43943c5b9 */
/* bench 15900.4.6 ae8e85e0dbf8 */
/* bench 15900.4.7 0c58ef30bf97 */
/* bench 15900.4.8 5f71ecfd45f9 */
/* bench 15900.4.9 8b71adbeb647 */
/* bench 15900.4.10 aa5707391576 */
/* bench 15900.4.11 3c8e758f06b4 */
/* bench 15900.4.12 22fe6e60513c */
/* bench 15900.4.13 5415cb818ab5 */
/* bench 15900.4.14 9cfc08104816 */
/* bench 15900.4.15 08c42abdd4ac */
	Specify the number of commands you would like to allocate per SCSI
	device when Tagged Command Queueing (TCQ) is enabled on that device.

	This is an upper bound value for the number of tagged transactions
	to be used for any device.  The aic7xxx driver will automatically
	vary this number based on device behavior.  For devices with a
	fixed maximum, the driver will eventually lock to this maximum
	and display a console message indicating this value.

	Due to resource allocation issues in the Linux SCSI mid-layer, using
	a high number of commands per device may result in memory allocation
	failures when many devices are attached to the system.  For this reason,
	the default is set to 32.  Higher values may result in higher performance
	on some devices.  The upper bound is 253.  0 disables tagged queueing.

	Per device tag depth can be controlled via the kernel command line
	"tag_info" option.  See Documentation/scsi/aic7xxx.rst for details.

config AIC7XXX_RESET_DELAY_MS
	int "Initial bus reset delay in milli-seconds"
	depends on SCSI_AIC7XXX
	default "5000"
	help
	The number of milliseconds to delay after an initial bus reset.
	The bus settle delay following all error recovery actions is
	dictated by the SCSI layer and is not affected by this value.

	Default: 5000 (5 seconds)

config AIC7XXX_BUILD_FIRMWARE
	bool "Build Adapter Firmware with Kernel Build"
	depends on SCSI_AIC7XXX && !PREVENT_FIRMWARE_BUILD
	help
	This option should only be enabled if you are modifying the firmware
	source to the aic7xxx driver and wish to have the generated firmware
	include files updated during a normal kernel build.  The assembler
	for the firmware requires lex and yacc or their equivalents, as well
	as the db v1 library.  You may have to install additional packages
	or modify the assembler Makefile or the files it includes if your
	build environment is different than that of the author.

config AIC7XXX_DEBUG_ENABLE
	bool "Compile in Debugging Code"
	depends on SCSI_AIC7XXX
	default y
	help
	Compile in aic7xxx debugging code that can be useful in diagnosing
	driver errors.

config AIC7XXX_DEBUG_MASK
        int "Debug code enable mask (2047 for all debugging)"
        depends on SCSI_AIC7XXX
        default "0"
        help
	Bit mask of debug options that is only valid if the
	CONFIG_AIC7XXX_DEBUG_ENABLE option is enabled.  The bits in this mask
	are defined in the drivers/scsi/aic7xxx/aic7xxx.h - search for the
	variable ahc_debug in that file to find them.

config AIC7XXX_REG_PRETTY_PRINT
        bool "Decode registers during diagnostics"
        depends on SCSI_AIC7XXX
	default y
        help
	Compile in register value tables for the output of expanded register
	contents in diagnostics.  This make it much easier to understand debug
	output without having to refer to a data book and/or the aic7xxx.reg
	file.
```

## drivers/scsi/aic94xx/Kconfig
```kconfig
FASTVC-BENCH-CORPUS:linux-main-100k-v1-e0bd41dc-8e12-4f1b-978d-a3645ae59da0
# SPDX-License-Identifier: GPL-2.0-only
#
# Kernel configuration file for aic94xx SAS/SATA driver.
#
# Copyright (c) 2005 Adaptec, Inc.  All rights reserved.
# Copyright (c) 2005 Luben Tuikov <luben_tuikov@adaptec.com>
#

config SCSI_AIC94XX
	tristate "Adaptec AIC94xx SAS/SATA support"
	depends on PCI
	select SCSI_SAS_LIBSAS
	select FW_LOADER
	help
		This driver supports Adaptec's SAS/SATA 3Gb/s 64 bit PCI-X
		AIC94xx chip based host adapters.

config AIC94XX_DEBUG
	bool "Compile in debug mode"
	default y
	depends on SCSI_AIC94XX
	help
		Compiles the aic94xx driver in debug mode.  In debug mode,
		the driver prints some messages to the console.
```

## drivers/scsi/be2iscsi/Kconfig
```kconfig
FASTVC-BENCH-CORPUS:linux-main-100k-v1-e0bd41dc-8e12-4f1b-978d-a3645ae59da0
# SPDX-License-Identifier: GPL-2.0-only
config BE2ISCSI
	tristate "Emulex 10Gbps iSCSI - BladeEngine 2"
	depends on PCI && SCSI && NET
	select SCSI_ISCSI_ATTRS
/* bench 9631.3.0 77cd88d9909b */
/* bench 9631.3.1 c10eb1c7cec6 */
/* bench 9631.3.2 f10b592bbf44 */
/* bench 9631.3.3 59657c59b33c */
/* bench 9631.3.4 889068ceff68 */
/* bench 9631.3.5 f1e3ce4fbd91 */
/* bench 9631.3.6 362fd6a02a5d */
/* bench 9631.3.7 7264053f2307 */
/* bench 9631.3.8 21101150bff9 */
/* bench 9631.3.9 414d53814084 */
/* bench 9631.3.10 b356b552d29f */
/* bench 9631.3.11 8cc2055fccbf */
	select ISCSI_BOOT_SYSFS
	select IRQ_POLL

	help
	This driver implements the iSCSI functionality for Emulex
	10Gbps Storage adapter - BladeEngine 2.
```

## drivers/scsi/bnx2fc/Kconfig
```kconfig
FASTVC-BENCH-CORPUS:linux-main-100k-v1-e0bd41dc-8e12-4f1b-978d-a3645ae59da0
# SPDX-License-Identifier: GPL-2.0-only
config SCSI_BNX2X_FCOE
	tristate "QLogic FCoE offload support"
	depends on PCI
	depends on (IPV6 || IPV6=n)
	depends on LIBFC
/* bench 13844.1.0 7db38923d62b */
/* bench 13844.1.1 2dc450740539 */
/* bench 13844.1.2 7f3f4d9f88aa */
/* bench 13844.1.3 33b4bfb6883c */
/* bench 13844.1.4 c0a1e336d4a7 */
/* bench 13844.1.5 4fefafc301c5 */
/* bench 13844.1.6 a60ec07b8787 */
/* bench 13844.1.7 c5faa4aae693 */
/* bench 13844.1.8 ffd25191ef5d */
/* bench 13844.1.9 53dbf55bfd79 */
/* bench 13844.1.10 ce1cd7b2c3cc */
/* bench 13844.1.11 11fa9cc7c416 */
	select ETHERNET
	select NET_VENDOR_BROADCOM
	select CNIC
	help
/* bench 2778.4.0 c921aeb85c89 */
/* bench 2778.4.1 912e59cae736 */
/* bench 2778.4.2 b87a60d36a42 */
/* bench 2778.4.3 6e6c2de8293d */
/* bench 2778.4.4 ca14d2b115d1 */
/* bench 2778.4.5 8881a8942290 */
/* bench 2778.4.6 46f7e19a27f0 */
```
