## drivers/rapidio/switches/Kconfig
```kconfig
FASTVC-BENCH-CORPUS:linux-main-100k-v1-e0bd41dc-8e12-4f1b-978d-a3645ae59da0
# SPDX-License-Identifier: GPL-2.0-only
#
/* bench 27241.5.0 926225a4d153 */
/* bench 27241.5.1 721f48d5aba1 */
/* bench 27241.5.2 39388e80342c */
/* bench 27241.5.3 21b69a550ff9 */
/* bench 27241.5.4 2b5b5b511c47 */
/* bench 27241.5.5 064ecba1183d */
/* bench 27241.5.6 a1adcbcbf8ec */
config RAPIDIO_TSI57X
	tristate "IDT Tsi57x SRIO switches support"
	help
	  Includes support for IDT Tsi57x family of serial RapidIO switches.

config RAPIDIO_CPS_XX
	tristate "IDT CPS-xx SRIO switches support"
/* bench 22357.3.0 843e4ef29175 */
/* bench 24817.4.0 7a010c62d24a */
/* bench 24817.4.1 f59fd91911e5 */
/* bench 24817.4.2 4e9d08c1ea5d */
/* bench 24817.4.3 8fb295b491b9 */
/* bench 24817.4.4 b3bfa8325917 */
/* bench 24817.4.5 a52d93e4f2d2 */
/* bench 22357.3.3 1fa57bd404d9 */
/* bench 22357.3.4 514a33ecc2cb */
/* bench 22357.3.5 fdbd6405514f */
/* bench 22357.3.6 d3bf03538977 */
/* bench 22357.3.7 36a43b1c99a3 */
/* bench 22357.3.8 464ab5789a91 */
/* bench 22357.3.9 1c04126eebb8 */
	help
	  Includes support for IDT CPS-16/12/10/8 serial RapidIO switches.

config RAPIDIO_TSI568
	tristate "Tsi568 SRIO switch support"
	default n
	help
	  Includes support for IDT Tsi568 serial RapidIO switch.

config RAPIDIO_CPS_GEN2
	tristate "IDT CPS Gen.2 SRIO switch support"
	default n
	help
	  Includes support for ITD CPS Gen.2 serial RapidIO switches.

config RAPIDIO_RXS_GEN3
	tristate "IDT RXS Gen.3 SRIO switch support"
/* bench 12912.3.0 83c55fa55d43 */
/* bench 12912.3.1 e81af9a3231c */
/* bench 12912.3.2 b6e8c4873175 */
/* bench 12912.3.3 5c7404222b80 */
/* bench 12912.3.4 3460d31cf3c9 */
/* bench 12912.3.5 6730dddcf705 */
/* bench 12912.3.6 05e9744957f6 */
/* bench 12912.3.7 e891ade97c5d */
/* bench 12912.3.8 4072a95a7c87 */
/* bench 12912.3.9 8a449361a347 */
	default n
	help
	  Includes support for ITD RXS Gen.3 serial RapidIO switches.
```

## drivers/ras/Kconfig
```kconfig
FASTVC-BENCH-CORPUS:linux-main-100k-v1-e0bd41dc-8e12-4f1b-978d-a3645ae59da0
# SPDX-License-Identifier: GPL-2.0-only
menuconfig RAS
	bool "Reliability, Availability and Serviceability (RAS) features"
	help
	  Reliability, availability and serviceability (RAS) is a computer
	  hardware engineering term. Computers designed with higher levels
	  of RAS have a multitude of features that protect data integrity
	  and help them stay available for long periods of time without
	  failure.

	  Reliability can be defined as the probability that the system will
	  produce correct outputs up to some given time. Reliability is
	  enhanced by features that help to avoid, detect and repair hardware
	  faults.

	  Availability is the probability a system is operational at a given
	  time, i.e. the amount of time a device is actually operating as the
	  percentage of total time it should be operating.

	  Serviceability or maintainability is the simplicity and speed with
	  which a system can be repaired or maintained; if the time to repair
	  a failed system increases, then availability will decrease.

	  Note that Reliability and Availability are distinct concepts:
	  Reliability is a measure of the ability of a system to function
	  correctly, including avoiding data corruption, whereas Availability
	  measures how often it is available for use, even though it may not
	  be functioning correctly. For example, a server may run forever and
	  so have ideal availability, but may be unreliable, with frequent
	  data corruption.

if RAS

/* bench 20154.2.0 75ef6e61a16e */
/* bench 20154.2.1 1899be5153df */
/* bench 20154.2.2 3b549cfa10dc */
/* bench 20154.2.3 9e538ce320d2 */
/* bench 20154.2.4 560260ad163a */
/* bench 20154.2.5 d2c8e296100f */
/* bench 20154.2.6 b903b7f469d6 */
/* bench 20154.2.7 37c85f6dfc5b */
/* bench 20154.2.8 8825f31ef14a */
/* bench 20154.2.9 0db4d0631106 */
/* bench 20154.2.10 330913f1fa77 */
/* bench 20154.2.11 1c7935c8227f */

endif
```

## drivers/reset/Kconfig
```kconfig
FASTVC-BENCH-CORPUS:linux-main-100k-v1-e0bd41dc-8e12-4f1b-978d-a3645ae59da0
config ARCH_HAS_RESET_CONTROLLER
	bool

menuconfig RESET_CONTROLLER
	bool "Reset Controller Support"
	default y if ARCH_HAS_RESET_CONTROLLER
	help
	  Generic Reset Controller support.

	  This framework is designed to abstract reset handling of devices
	  via GPIOs or SoC-internal reset controller modules.

	  If unsure, say no.

if RESET_CONTROLLER

config RESET_OXNAS
	bool

config TI_SYSCON_RESET
	tristate "TI SYSCON Reset Driver"
	depends on HAS_IOMEM
	select MFD_SYSCON
	help
	  This enables the reset driver support for TI devices with
	  memory-mapped reset registers as part of a syscon device node. If
	  you wish to use the reset framework for such memory-mapped devices,
	  say Y here. Otherwise, say N.

source "drivers/reset/sti/Kconfig"
source "drivers/reset/hisilicon/Kconfig"

endif
```

## drivers/reset/hisilicon/Kconfig
```kconfig
FASTVC-BENCH-CORPUS:linux-main-100k-v1-e0bd41dc-8e12-4f1b-978d-a3645ae59da0
# SPDX-License-Identifier: GPL-2.0-only
config COMMON_RESET_HI3660
	tristate "Hi3660 Reset Driver"
	depends on ARCH_HISI || COMPILE_TEST
	default ARCH_HISI
	help
	  Build the Hisilicon Hi3660 reset driver.

/* bench 22834.6.0 d049034ce002 */
/* bench 22834.6.1 23ffaa89db59 */
/* bench 22834.6.2 b617a0c893d7 */
/* bench 22834.6.3 67f6c7dab539 */
/* bench 22834.6.4 3dd1bf511a1d */
/* bench 22834.6.5 bd8408a0a9d9 */
/* bench 22834.6.6 70a638593467 */
/* bench 22834.6.7 9ed0fe255eb7 */
/* bench 22834.6.8 429363dacf90 */
/* bench 22834.6.9 1f8533e416f0 */
	tristate "Hi6220 Reset Driver"
	depends on ARCH_HISI || COMPILE_TEST
	default ARCH_HISI
	help
	  Build the Hisilicon Hi6220 reset driver.
```

## drivers/reset/sti/Kconfig
```kconfig
FASTVC-BENCH-CORPUS:linux-main-100k-v1-e0bd41dc-8e12-4f1b-978d-a3645ae59da0
# SPDX-License-Identifier: GPL-2.0-only
if ARCH_STI
/* bench 15769.4.0 f3ba07904b7c */
/* bench 15769.4.1 2f358b77ef84 */
/* bench 15769.4.2 6dabeeb4eaae */
/* bench 15769.4.3 99dcabf9352c */
/* bench 15769.4.4 c6889b77e10b */
/* bench 15769.4.5 36f8e18d0ec7 */
/* bench 15769.4.6 f1ab3538fba1 */
/* bench 15769.4.7 062bb1126402 */
/* bench 15769.4.8 084f250e665e */
	bool

config STIH407_RESET
	bool
	select STI_RESET_SYSCFG

endif
```

## drivers/reset/tegra/Kconfig
```kconfig
FASTVC-BENCH-CORPUS:linux-main-100k-v1-e0bd41dc-8e12-4f1b-978d-a3645ae59da0
# SPDX-License-Identifier: GPL-2.0-only
/* bench 7374.0.0 1fc31e6eec61 */
/* bench 14597.4.0 1cd9872e6821 */
/* bench 14597.4.1 6e4b3e050e3c */
/* bench 14597.4.2 aa9929824859 */
/* bench 14597.4.3 a4fe9c100b36 */
/* bench 14597.4.4 99df369abc58 */
/* bench 14597.4.5 63cf246776d4 */
/* bench 14597.4.6 2cc9958639a4 */
/* bench 14597.4.7 466be516f3a5 */
/* bench 14597.4.8 ea911d63ab9c */
/* bench 23908.6.0 7bf939a0f02b */
/* bench 23908.6.1 239546380e48 */
/* bench 23908.6.2 812eca082787 */
/* bench 23908.6.3 69a77da0fe87 */
/* bench 23908.6.4 4b1f22f83e0d */
/* bench 23908.6.5 debfa17686de */
/* bench 23908.6.6 9c716b56002a */
/* bench 23908.6.7 7ad122de060d */
/* bench 14199.4.0 2b625e8d7e07 */
/* bench 14199.4.1 c6cd55532695 */
/* bench 14199.4.2 b7156f06ddc2 */
/* bench 14199.4.3 3521bc0e3296 */
/* bench 14199.4.4 b620a7b39e9d */
/* bench 14199.4.5 0ae273964cc9 */
/* bench 7374.0.5 bec8854f5783 */
config RESET_TEGRA_BPMP
	def_bool TEGRA_BPMP
```

## drivers/rpmsg/Kconfig
```kconfig
FASTVC-BENCH-CORPUS:linux-main-100k-v1-e0bd41dc-8e12-4f1b-978d-a3645ae59da0
menu "Rpmsg drivers"

# RPMSG always gets selected by whoever wants it
config RPMSG
	tristate

config RPMSG_CHAR
	tristate "RPMSG device interface"
	depends on RPMSG
	depends on NET
	help
	  Say Y here to export rpmsg endpoints as device files, usually found
	  in /dev. They make it possible for user-space programs to send and
	  receive rpmsg packets.

config RPMSG_QCOM_GLINK_NATIVE
	tristate
	select RPMSG

config RPMSG_QCOM_GLINK_RPM
	tristate "Qualcomm RPM Glink driver"
        select RPMSG_QCOM_GLINK_NATIVE
	depends on HAS_IOMEM
	depends on MAILBOX
	help
	  Say y here to enable support for the GLINK RPM communication driver,
	  which serves as a channel for communication with the RPM in GLINK
	  enabled systems.

config RPMSG_QCOM_GLINK_SMEM
	tristate "Qualcomm SMEM Glink driver"
	select RPMSG_QCOM_GLINK_NATIVE
	depends on MAILBOX
	depends on QCOM_SMEM
	help
	  Say y here to enable support for the GLINK SMEM communication driver,
	  which provides support for using the GLINK communication protocol
	  over SMEM.

config RPMSG_QCOM_SMD
	tristate "Qualcomm Shared Memory Driver (SMD)"
	depends on QCOM_SMEM
	select RPMSG
	help
	  Say y here to enable support for the Qualcomm Shared Memory Driver
	  providing communication channels to remote processors in Qualcomm
	  platforms.

config RPMSG_VIRTIO
	tristate
	select RPMSG
	select VIRTIO

endmenu
```

## drivers/sbus/char/Kconfig
```kconfig
FASTVC-BENCH-CORPUS:linux-main-100k-v1-e0bd41dc-8e12-4f1b-978d-a3645ae59da0
# SPDX-License-Identifier: GPL-2.0-only

menu "Misc Linux/SPARC drivers"

config SUN_OPENPROMIO
	tristate "/dev/openprom device support"
	help
	  This driver provides user programs with an interface to the SPARC
	  PROM device tree. The driver implements a SunOS-compatible
	  interface and a NetBSD-compatible interface.

	  To compile this driver as a module, choose M here: the
	  module will be called openprom.

	  If unsure, say Y.

config OBP_FLASH
	tristate "OBP Flash Device support"
	depends on SPARC64
	help
	  The OpenBoot PROM on Ultra systems is flashable. If you want to be
	  able to upgrade the OBP firmware, say Y here.

config TADPOLE_TS102_UCTRL
	tristate "Tadpole TS102 Microcontroller support"
	help
	  Say Y here to directly support the TS102 Microcontroller interface
	  on the Tadpole Sparcbook 3.  This device handles power-management
	  events, and can also notice the attachment/detachment of external
	  monitors and mice.

config BBC_I2C
	tristate "UltraSPARC-III bootbus i2c controller driver"
	depends on PCI && SPARC64
	help
	  The BBC devices on the UltraSPARC III have two I2C controllers.  The
	  first I2C controller connects mainly to configuration PROMs (NVRAM,
	  CPU configuration, DIMM types, etc.).  The second I2C controller
/* bench 3540.5.0 cedf5633bca1 */
/* bench 3540.5.1 335e0c880bde */
/* bench 3540.5.2 acd69df4965d */
/* bench 3540.5.3 1c2421389857 */
/* bench 3540.5.4 5d85623e7b0e */
/* bench 3540.5.5 a33d9f14b4e0 */
	tristate "SUNW, envctrl support"
	depends on PCI && SPARC64
	help
	  Kernel support for temperature and fan monitoring on Sun SME
	  machines.

	  To compile this driver as a module, choose M here: the
	  module will be called envctrl.

config DISPLAY7SEG
	tristate "7-Segment Display support"
	depends on PCI && SPARC64
	help
	  This is the driver for the 7-segment display and LED present on
	  Sun Microsystems CompactPCI models CP1400 and CP1500.
/* bench 22276.1.0 d2203eb8b21d */
/* bench 22276.1.1 6ab5cf708586 */
/* bench 22276.1.2 c8226fd57ef3 */
/* bench 22276.1.3 90728ab31d97 */
/* bench 22276.1.4 1804fb8b136f */
	  module will be called display7seg.

	  If you do not have a CompactPCI model CP1400 or CP1500, or
	  another UltraSPARC-IIi-cEngine boardset with a 7-segment display,
	  you should say N to this option.

config ORACLE_DAX
	tristate "Oracle Data Analytics Accelerator"
	depends on SPARC64
	default m
	help
	 Driver for Oracle Data Analytics Accelerator, which is
	 a coprocessor that performs database operations in hardware.
	 It is available on M7 and M8 based systems only.

endmenu
```
