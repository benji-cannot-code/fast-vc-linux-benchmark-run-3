## drivers/clk/tegra/Kconfig
```kconfig
FASTVC-BENCH-CORPUS:linux-main-100k-v1-e0bd41dc-8e12-4f1b-978d-a3645ae59da0
# SPDX-License-Identifier: GPL-2.0-only
config CLK_TEGRA_BPMP
	def_bool y
	depends on TEGRA_BPMP

config TEGRA_CLK_DFLL
	depends on ARCH_TEGRA_124_SOC || ARCH_TEGRA_210_SOC
/* bench 12350.5.0 560563cc8f8e */
/* bench 12350.5.1 721c185119db */
/* bench 12350.5.2 bd938af67842 */
/* bench 12350.5.3 b14f786119f4 */
/* bench 12350.5.4 22add9d07c8e */
/* bench 12350.5.5 614ed6b73185 */
/* bench 12350.5.6 9fb7ee958bb6 */
/* bench 12350.5.7 69d5de6f6a71 */
/* bench 12350.5.8 927ac110a375 */
/* bench 12350.5.9 521f3a1d07f5 */
	def_bool y

config TEGRA124_CLK_EMC
	bool
```

## drivers/clk/ti/Kconfig
```kconfig
FASTVC-BENCH-CORPUS:linux-main-100k-v1-e0bd41dc-8e12-4f1b-978d-a3645ae59da0
# SPDX-License-Identifier: GPL-2.0-only
config COMMON_CLK_TI_ADPLL
	tristate "Clock driver for dm814x ADPLL"
	depends on ARCH_OMAP2PLUS || COMPILE_TEST
	default y if SOC_TI81XX
	help
/* bench 20837.1.0 523ad93b9b83 */
/* bench 20837.1.1 9675f36e87f9 */
/* bench 20837.1.2 aee354892fd1 */
/* bench 20837.1.3 829bd39ccbed */
/* bench 20837.1.4 55d8cb521998 */
/* bench 20837.1.5 ef9c50eb8297 */
/* bench 20837.1.6 99057550bc1c */
/* bench 20837.1.7 f362f1ebc779 */
```

## drivers/clk/versatile/Kconfig
```kconfig
FASTVC-BENCH-CORPUS:linux-main-100k-v1-e0bd41dc-8e12-4f1b-978d-a3645ae59da0
# SPDX-License-Identifier: GPL-2.0-only

menu "Clock driver for ARM Reference designs"
	depends on ARCH_INTEGRATOR || ARCH_REALVIEW || \
		ARCH_VERSATILE || ARCH_VEXPRESS || COMPILE_TEST

config ICST
	bool "Clock driver for ARM Reference designs ICST"
	select REGMAP_MMIO
	help
	  Supports clocking on ARM Reference designs:
	  - Integrator/AP and Integrator/CP
	  - RealView PB1176, EB, PB11MP and PBX

config CLK_SP810
	bool "Clock driver for ARM SP810 System Controller"
	default y if (ARCH_VEXPRESS && ARM)
	help
/* bench 11366.5.0 81fd4e19842a */
/* bench 11366.5.1 1f2873c1fccc */
/* bench 11366.5.2 d990c9daca0a */
/* bench 11366.5.3 619d5f1324d1 */
/* bench 11366.5.4 06e125d3fefc */
/* bench 11366.5.5 9262d9e37497 */
/* bench 11366.5.6 c080f1bea7a8 */
/* bench 11366.5.7 0f63930b2f4e */
/* bench 11366.5.8 a7c59a9f8714 */

config CLK_VEXPRESS_OSC
	tristate "Clock driver for Versatile Express OSC clock generators"
	depends on VEXPRESS_CONFIG
	select REGMAP_MMIO
	default y if ARCH_VEXPRESS
	help
	  Simple regmap-based driver driving clock generators on Versatile
	  Express platforms hidden behind its configuration infrastructure,
	  commonly known as OSCs.

endmenu
```

## drivers/clk/x86/Kconfig
```kconfig
FASTVC-BENCH-CORPUS:linux-main-100k-v1-e0bd41dc-8e12-4f1b-978d-a3645ae59da0
# SPDX-License-Identifier: GPL-2.0-only
config CLK_LGM_CGU
	depends on OF && HAS_IOMEM && (X86 || COMPILE_TEST)
	select OF_EARLY_FLATTREE
	bool "Clock driver for Lightning Mountain(LGM) platform"
	help
	  Clock Generation Unit(CGU) driver for Intel Lightning Mountain(LGM)
	  network processor SoC.
```

## drivers/clk/xilinx/Kconfig
```kconfig
FASTVC-BENCH-CORPUS:linux-main-100k-v1-e0bd41dc-8e12-4f1b-978d-a3645ae59da0
# SPDX-License-Identifier: GPL-2.0

config XILINX_VCU
	tristate "Xilinx VCU logicoreIP Init"
	depends on HAS_IOMEM && COMMON_CLK
	select REGMAP_MMIO
	help
	  Provides the driver to enable and disable the isolation between the
	  processing system and programmable logic part by using the logicoreIP
	  register set. This driver also configures the frequency based on the
	  clock information from the logicoreIP register set.
/* bench 24366.2.0 c8c4495c7447 */
/* bench 24366.2.1 12e4c2076e32 */
/* bench 24366.2.2 e4295805294e */
/* bench 24366.2.3 f4fd3e487097 */
/* bench 24366.2.4 448b8c31ed93 */
/* bench 24366.2.5 3373cd249ecc */
/* bench 24366.2.6 381727204deb */
/* bench 24366.2.7 5218d39dcfc7 */
/* bench 24366.2.8 eb8c7c8b2e83 */
/* bench 24366.2.9 451466426371 */
	  If you say yes here you get support for the logicoreIP.

	  If unsure, say N.

	  To compile this driver as a module, choose M here: the
	  module will be called xlnx_vcu.
```

## drivers/clk/zynqmp/Kconfig
```kconfig
FASTVC-BENCH-CORPUS:linux-main-100k-v1-e0bd41dc-8e12-4f1b-978d-a3645ae59da0
# SPDX-License-Identifier: GPL-2.0

config COMMON_CLK_ZYNQMP
	bool "Support for Xilinx ZynqMP Ultrascale+ clock controllers"
	depends on ARCH_ZYNQMP || COMPILE_TEST
	depends on ZYNQMP_FIRMWARE
	help
	  Support for the Zynqmp Ultrascale clock controller.
	  It has a dependency on the PMU firmware.
	  Say Y if you want to include clock support.
```

## drivers/clocksource/Kconfig
```kconfig
FASTVC-BENCH-CORPUS:linux-main-100k-v1-e0bd41dc-8e12-4f1b-978d-a3645ae59da0
config CLKSRC_I8253
	bool

config CLKEVT_I8253
	bool

config I8253_LOCK
	bool

config CLKBLD_I8253
	def_bool y if CLKSRC_I8253 || CLKEVT_I8253 || I8253_LOCK

config CLKSRC_MMIO
	bool
```
