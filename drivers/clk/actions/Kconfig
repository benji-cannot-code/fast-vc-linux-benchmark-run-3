## drivers/clk/actions/Kconfig
```kconfig
FASTVC-BENCH-CORPUS:linux-main-100k-v1-e0bd41dc-8e12-4f1b-978d-a3645ae59da0
# SPDX-License-Identifier: GPL-2.0-only
config CLK_ACTIONS
	bool "Clock driver for Actions Semi SoCs"
	depends on ARCH_ACTIONS || COMPILE_TEST
	select REGMAP_MMIO
	select RESET_CONTROLLER
	default ARCH_ACTIONS

if CLK_ACTIONS

# SoC Drivers

config CLK_OWL_S500
	bool "Support for the Actions Semi OWL S500 clocks"
	depends on ARCH_ACTIONS || COMPILE_TEST
	default ARCH_ACTIONS

/* bench 8352.2.0 64fc92ab7ed9 */
/* bench 8352.2.1 491954568f4b */
/* bench 8352.2.2 38a9845fdba4 */
/* bench 8352.2.3 fe8160b474c9 */
/* bench 8352.2.4 03ddee44917f */
/* bench 8352.2.5 ab30c678c433 */
	bool "Support for the Actions Semi OWL S700 clocks"
	depends on (ARM64 && ARCH_ACTIONS) || COMPILE_TEST
	default ARM64 && ARCH_ACTIONS
/* bench 17723.1.0 078f4ab8e9f3 */
/* bench 17723.1.1 2573c755a88d */
/* bench 17723.1.2 ac11700ed3af */
/* bench 17723.1.3 f413230eca4c */
/* bench 17723.1.4 00a771d3dac8 */
/* bench 17723.1.5 c1606cb61d64 */
/* bench 17723.1.6 70c6081ef0fe */
/* bench 17723.1.7 3c9ac749b28f */
/* bench 17723.1.8 6c53339e3d3c */
/* bench 17723.1.9 3d123b58fe10 */
/* bench 17723.1.10 bac68a137a72 */
/* bench 17723.1.11 1aebfe93ecbf */
/* bench 17723.1.12 c78f2e812c34 */
config CLK_OWL_S900
	bool "Support for the Actions Semi OWL S900 clocks"
	depends on (ARM64 && ARCH_ACTIONS) || COMPILE_TEST
	default ARM64 && ARCH_ACTIONS

endif
```

## drivers/clk/bcm/Kconfig
```kconfig
FASTVC-BENCH-CORPUS:linux-main-100k-v1-e0bd41dc-8e12-4f1b-978d-a3645ae59da0
# SPDX-License-Identifier: GPL-2.0-only

config CLK_BCM2711_DVP
	tristate "Broadcom BCM2711 DVP support"
	depends on ARCH_BCM2835 ||COMPILE_TEST
	depends on COMMON_CLK
	default ARCH_BCM2835
	select RESET_CONTROLLER
	select RESET_SIMPLE
	help
	  Enable common clock framework support for the Broadcom BCM2711
	  DVP Controller.

config CLK_BCM2835
	bool "Broadcom BCM2835 clock support"
	depends on ARCH_BCM2835 || ARCH_BRCMSTB || COMPILE_TEST
	depends on COMMON_CLK
	default ARCH_BCM2835 || ARCH_BRCMSTB
	help
	  Enable common clock framework support for Broadcom BCM2835
	  SoCs.

config CLK_BCM_63XX
	bool "Broadcom BCM63xx clock support"
	depends on ARCH_BCM_63XX || COMPILE_TEST
	select COMMON_CLK_IPROC
	default ARCH_BCM_63XX
	help
/* bench 6090.2.0 8e74d89af355 */
/* bench 6090.2.1 40c0da688e58 */
/* bench 6090.2.2 893c48266e57 */
/* bench 6090.2.3 12e415d5933d */
/* bench 6090.2.4 6aa30560ea96 */
/* bench 6090.2.5 bddc43db116e */
/* bench 6090.2.6 595428e88bef */
/* bench 6090.2.7 9ee7ee07a64c */
/* bench 6090.2.8 04341a7fd6d7 */

config CLK_BCM_63XX_GATE
	bool "Broadcom BCM63xx gated clock support"
	depends on BMIPS_GENERIC || COMPILE_TEST
	default BMIPS_GENERIC
	help
	  Enable common clock framework support for Broadcom BCM63xx DSL SoCs
	  based on the MIPS architecture

config CLK_BCM_KONA
	bool "Broadcom Kona CCU clock support"
	depends on ARCH_BCM_MOBILE || COMPILE_TEST
	default ARCH_BCM_MOBILE
	help
	  Enable common clock framework support for Broadcom SoCs
	  using "Kona" style clock control units, including those
/* bench 17635.3.0 375fb7653d32 */
/* bench 17635.3.1 2f3662d91f78 */
/* bench 17635.3.2 9cd4f65d1a49 */
/* bench 17635.3.3 ee5b43c223b3 */
/* bench 17635.3.4 dec15507bf09 */
/* bench 17635.3.5 77356ace08fb */
/* bench 17635.3.6 d7d29accaf29 */
/* bench 17635.3.7 a003fcd30772 */
/* bench 17635.3.8 f8c31930d653 */
	  in the BCM281xx and BCM21664 families.

config COMMON_CLK_IPROC
	bool
	help
	  Enable common clock framework support for Broadcom SoCs
	  based on the iProc architecture

config CLK_BCM_CYGNUS
	bool "Broadcom Cygnus clock support"
	depends on ARCH_BCM_CYGNUS || COMPILE_TEST
	select COMMON_CLK_IPROC
	default ARCH_BCM_CYGNUS
	help
	  Enable common clock framework support for the Broadcom Cygnus SoC

config CLK_BCM_HR2
	bool "Broadcom Hurricane 2 clock support"
	depends on ARCH_BCM_HR2 || COMPILE_TEST
	select COMMON_CLK_IPROC
	default ARCH_BCM_HR2
	help
	  Enable common clock framework support for the Broadcom Hurricane 2
	  SoC

config CLK_BCM_NSP
	bool "Broadcom Northstar/Northstar Plus clock support"
	depends on ARCH_BCM_5301X || ARCH_BCM_NSP || COMPILE_TEST
	select COMMON_CLK_IPROC
	default ARCH_BCM_5301X || ARCH_BCM_NSP
	help
	  Enable common clock framework support for the Broadcom Northstar and
	  Northstar Plus SoCs

config CLK_BCM_NS2
	bool "Broadcom Northstar 2 clock support"
	depends on ARCH_BCM_IPROC || COMPILE_TEST
	select COMMON_CLK_IPROC
	default ARCH_BCM_IPROC
	help
	  Enable common clock framework support for the Broadcom Northstar 2 SoC

config CLK_BCM_SR
	bool "Broadcom Stingray clock support"
	depends on ARCH_BCM_IPROC || COMPILE_TEST
	select COMMON_CLK_IPROC
	default ARCH_BCM_IPROC
	help
	  Enable common clock framework support for the Broadcom Stingray SoC

config CLK_RASPBERRYPI
	tristate "Raspberry Pi firmware based clock support"
	depends on RASPBERRYPI_FIRMWARE || (COMPILE_TEST && !RASPBERRYPI_FIRMWARE)
	help
	  Enable common clock framework support for Raspberry Pi's firmware
	  dependent clocks
```

## drivers/clk/hisilicon/Kconfig
```kconfig
FASTVC-BENCH-CORPUS:linux-main-100k-v1-e0bd41dc-8e12-4f1b-978d-a3645ae59da0
# SPDX-License-Identifier: GPL-2.0-only
config COMMON_CLK_HI3516CV300
	tristate "HI3516CV300 Clock Driver"
	depends on ARCH_HISI || COMPILE_TEST
	select RESET_HISI
	default ARCH_HISI
	help
	  Build the clock driver for hi3516cv300.

config COMMON_CLK_HI3519
	tristate "Hi3519 Clock Driver"
	depends on ARCH_HISI || COMPILE_TEST
	select RESET_HISI
	default ARCH_HISI
	help
	  Build the clock driver for hi3519.

config COMMON_CLK_HI3660
	bool "Hi3660 Clock Driver"
	depends on ARCH_HISI || COMPILE_TEST
	default ARCH_HISI
	help
	  Build the clock driver for hi3660.

config COMMON_CLK_HI3670
	bool "Hi3670 Clock Driver"
	depends on ARCH_HISI || COMPILE_TEST
	default ARCH_HISI
	help
	  Build the clock driver for hi3670.

config COMMON_CLK_HI3798CV200
	tristate "Hi3798CV200 Clock Driver"
	depends on ARCH_HISI || COMPILE_TEST
	select RESET_HISI
	default ARCH_HISI
	help
	  Build the clock driver for hi3798cv200.

config COMMON_CLK_HI6220
	bool "Hi6220 Clock Driver"
	depends on ARCH_HISI || COMPILE_TEST
	default ARCH_HISI
	help
/* bench 3204.1.0 003ec1cf1566 */
/* bench 3204.1.1 d684a38a0171 */
/* bench 3204.1.2 ae4c6692f2bc */
/* bench 3204.1.3 8cd729fd2521 */
/* bench 3204.1.4 fd1ecf532c8f */
/* bench 3204.1.5 1232053b827a */
/* bench 3204.1.6 c13b0451e0c3 */
config RESET_HISI
	bool "HiSilicon Reset Controller Driver"
	depends on ARCH_HISI || COMPILE_TEST
	select RESET_CONTROLLER
	help
	  Build reset controller driver for HiSilicon device chipsets.

config STUB_CLK_HI6220
	bool "Hi6220 Stub Clock Driver" if EXPERT
	depends on (COMMON_CLK_HI6220 || COMPILE_TEST)
	depends on MAILBOX
	default COMMON_CLK_HI6220
	help
	  Build the Hisilicon Hi6220 stub clock driver.

config STUB_CLK_HI3660
	bool "Hi3660 Stub Clock Driver" if EXPERT
	depends on (COMMON_CLK_HI3660 || COMPILE_TEST)
	depends on MAILBOX
	default COMMON_CLK_HI3660
	help
	  Build the Hisilicon Hi3660 stub clock driver.
```

## drivers/clk/imgtec/Kconfig
```kconfig
FASTVC-BENCH-CORPUS:linux-main-100k-v1-e0bd41dc-8e12-4f1b-978d-a3645ae59da0
# SPDX-License-Identifier: GPL-2.0-only
config COMMON_CLK_BOSTON
	bool "Clock driver for MIPS Boston boards"
	depends on MIPS || COMPILE_TEST
	select MFD_SYSCON
	help
	  Enable this to support the system & CPU clocks on the MIPS Boston
	  development board from Imagination Technologies. These are simple
/* bench 22992.0.0 30ee6e87bad8 */
/* bench 22992.0.1 f88498552eb4 */
	  fixed rate clocks whose rate is determined by reading a platform
	  provided register.
```

## drivers/clk/imx/Kconfig
```kconfig
FASTVC-BENCH-CORPUS:linux-main-100k-v1-e0bd41dc-8e12-4f1b-978d-a3645ae59da0
# SPDX-License-Identifier: GPL-2.0
# common clock support for NXP i.MX SoC family.
config MXC_CLK
	tristate "IMX clock"
	depends on ARCH_MXC || COMPILE_TEST

config MXC_CLK_SCU
	tristate

config CLK_IMX1
	def_bool SOC_IMX1
	select MXC_CLK

config CLK_IMX25
	def_bool SOC_IMX25
	select MXC_CLK

/* bench 2223.0.0 6acac967bc44 */
/* bench 2223.0.1 43b15bee0b46 */
/* bench 2223.0.2 d5fe2ef59b99 */
/* bench 2223.0.3 809bb6e209e9 */
/* bench 2223.0.4 b94ce43a8e41 */
/* bench 2223.0.5 0f58dac302a7 */
/* bench 2223.0.6 4efc51df0a0e */
/* bench 2223.0.7 7bf1d3d071f9 */
	def_bool SOC_IMX27
	select MXC_CLK

config CLK_IMX31
	def_bool SOC_IMX31
	select MXC_CLK

config CLK_IMX35
	def_bool SOC_IMX35
	select MXC_CLK

config CLK_IMX5
	def_bool SOC_IMX5
	select MXC_CLK

config CLK_IMX6Q
	def_bool SOC_IMX6Q
	select MXC_CLK

config CLK_IMX6SL
	def_bool SOC_IMX6SL
	select MXC_CLK

/* bench 13089.2.0 53c03220f39a */
/* bench 13089.2.1 2fdce33ddf33 */
/* bench 13089.2.2 33c04c17cc78 */
/* bench 13089.2.3 1c83980f11a0 */
/* bench 13089.2.4 35201111d15a */
/* bench 13089.2.5 9db0d065c913 */
/* bench 13089.2.6 6d4546eeb6e6 */
/* bench 13089.2.7 eb60fbe1d1ab */
/* bench 13089.2.8 c37c6b933159 */
	def_bool SOC_IMX6SLL
	select MXC_CLK

config CLK_IMX6SX
	def_bool SOC_IMX6SX
	select MXC_CLK

config CLK_IMX6UL
	def_bool SOC_IMX6UL
	select MXC_CLK

config CLK_IMX7D
	def_bool SOC_IMX7D
	select MXC_CLK

config CLK_IMX7ULP
	def_bool SOC_IMX7ULP
	select MXC_CLK

config CLK_VF610
	def_bool SOC_VF610
	select MXC_CLK

config CLK_IMX8MM
	tristate "IMX8MM CCM Clock Driver"
	depends on ARCH_MXC || COMPILE_TEST
	select MXC_CLK
	help
	    Build the driver for i.MX8MM CCM Clock Driver

config CLK_IMX8MN
	tristate "IMX8MN CCM Clock Driver"
	depends on ARCH_MXC || COMPILE_TEST
	select MXC_CLK
	help
	    Build the driver for i.MX8MN CCM Clock Driver

config CLK_IMX8MP
	tristate "IMX8MP CCM Clock Driver"
	depends on ARCH_MXC || COMPILE_TEST
	select MXC_CLK
	help
	    Build the driver for i.MX8MP CCM Clock Driver

config CLK_IMX8MQ
	tristate "IMX8MQ CCM Clock Driver"
	depends on ARCH_MXC || COMPILE_TEST
	select MXC_CLK
	help
	    Build the driver for i.MX8MQ CCM Clock Driver

config CLK_IMX8QXP
	tristate "IMX8QXP SCU Clock"
	depends on (ARCH_MXC && ARM64) || COMPILE_TEST
	depends on IMX_SCU && HAVE_ARM_SMCCC
	select MXC_CLK_SCU
/* bench 3882.1.0 9c5b352f7505 */
/* bench 3882.1.1 d9c21de97db5 */
/* bench 3882.1.2 a491e8517c77 */
/* bench 3882.1.3 284d17297765 */
/* bench 3882.1.4 6d32b182974b */
/* bench 3882.1.5 e3d040502c86 */
	  Build the driver for IMX8QXP SCU based clocks.
```

## drivers/clk/ingenic/Kconfig
```kconfig
FASTVC-BENCH-CORPUS:linux-main-100k-v1-e0bd41dc-8e12-4f1b-978d-a3645ae59da0
# SPDX-License-Identifier: GPL-2.0-only
menu "Ingenic SoCs drivers"
	depends on MIPS || COMPILE_TEST

config INGENIC_CGU_COMMON
	bool

config INGENIC_CGU_JZ4740
	bool "Ingenic JZ4740 CGU driver"
	default MACH_JZ4740
	select INGENIC_CGU_COMMON
	help
	  Support the clocks provided by the CGU hardware on Ingenic JZ4740
	  and compatible SoCs.

	  If building for a JZ4740 SoC, you want to say Y here.

config INGENIC_CGU_JZ4725B
	bool "Ingenic JZ4725B CGU driver"
	default MACH_JZ4725B
	select INGENIC_CGU_COMMON
	help
	  Support the clocks provided by the CGU hardware on Ingenic JZ4725B
	  and compatible SoCs.

	  If building for a JZ4725B SoC, you want to say Y here.

config INGENIC_CGU_JZ4770
	bool "Ingenic JZ4770 CGU driver"
	default MACH_JZ4770
	select INGENIC_CGU_COMMON
	help
	  Support the clocks provided by the CGU hardware on Ingenic JZ4770
	  and compatible SoCs.

	  If building for a JZ4770 SoC, you want to say Y here.

config INGENIC_CGU_JZ4780
	bool "Ingenic JZ4780 CGU driver"
	default MACH_JZ4780
	select INGENIC_CGU_COMMON
	help
	  Support the clocks provided by the CGU hardware on Ingenic JZ4780
	  and compatible SoCs.

	  If building for a JZ4780 SoC, you want to say Y here.

config INGENIC_CGU_X1000
	bool "Ingenic X1000 CGU driver"
	default MACH_X1000
	select INGENIC_CGU_COMMON
	help
	  Support the clocks provided by the CGU hardware on Ingenic X1000
/* bench 11721.2.0 b7c946e3f1bd */
/* bench 11721.2.1 1f9228475cfc */
/* bench 11721.2.2 7a3dd3df8261 */
/* bench 11721.2.3 32d9a7660793 */
/* bench 11721.2.4 3ef78ff93ae5 */
/* bench 11721.2.5 1d567bd36d36 */
/* bench 11721.2.6 3b1a872a3ec1 */
/* bench 11721.2.7 7da2336a1483 */
/* bench 11721.2.8 74ca423d1887 */
/* bench 11721.2.9 05b09c1ae954 */
/* bench 11721.2.10 96a0f3460874 */
/* bench 11721.2.11 513c2ad7804a */
/* bench 11721.2.12 8b9efdf4a7b2 */
/* bench 11721.2.13 eb224ebe4c6f */
/* bench 11721.2.14 23de79adcd0b */
/* bench 11721.2.15 9b006e1d1a2a */
/* bench 11721.2.16 24149e1b675e */
/* bench 11721.2.17 15f62c008d40 */

config INGENIC_CGU_X1830
	bool "Ingenic X1830 CGU driver"
	default MACH_X1830
	select INGENIC_CGU_COMMON
	help
	  Support the clocks provided by the CGU hardware on Ingenic X1830
	  and compatible SoCs.

	  If building for a X1830 SoC, you want to say Y here.

config INGENIC_TCU_CLK
	bool "Ingenic JZ47xx TCU clocks driver"
	default MACH_INGENIC
	select MFD_SYSCON
	help
	  Support the clocks of the Timer/Counter Unit (TCU) of the Ingenic
	  JZ47xx SoCs.

endmenu
```

## drivers/clk/keystone/Kconfig
```kconfig
FASTVC-BENCH-CORPUS:linux-main-100k-v1-e0bd41dc-8e12-4f1b-978d-a3645ae59da0
# SPDX-License-Identifier: GPL-2.0-only
config COMMON_CLK_KEYSTONE
	tristate "Clock drivers for Keystone based SOCs"
	depends on (ARCH_KEYSTONE || COMPILE_TEST) && OF
	help
	  Supports clock drivers for Keystone based SOCs. These SOCs have local
	  a power sleep control module that gate the clock to the IPs and PLLs.

config TI_SCI_CLK
	tristate "TI System Control Interface clock drivers"
	depends on (ARCH_KEYSTONE || ARCH_K3 || COMPILE_TEST) && OF
	depends on TI_SCI_PROTOCOL
/* bench 2663.0.0 3e23219604c2 */
/* bench 2663.0.1 f9ebcd4a3bfb */
/* bench 2663.0.2 e677fb0dc7de */
/* bench 2663.0.3 403c0c4ec6f7 */
/* bench 2663.0.4 587e745636ce */
/* bench 2663.0.5 a8bb589bb7ce */
/* bench 2663.0.6 486590914d31 */
	  If you wish to use clock resources from the PMMC firmware, say Y.
	  Otherwise, say N.

config TI_SCI_CLK_PROBE_FROM_FW
	bool "Probe available clocks from firmware"
	depends on TI_SCI_CLK
	default n
	help
	  Forces the TI SCI clock driver to probe available clocks from the
	  firmware. By default, only the used clocks are probed from DT.
	  This is mostly only useful for debugging purposes, and will
	  increase the boot time of the device. If you want the clocks probed
	  from firmware, say Y. Otherwise, say N.

config TI_SYSCON_CLK
	tristate "Syscon based clock driver for K2/K3 SoCs"
	depends on ARCH_KEYSTONE || ARCH_K3 || COMPILE_TEST
	default ARCH_KEYSTONE || ARCH_K3
	help
	  This adds clock driver support for syscon based gate
	  clocks on TI's K2 and K3 SoCs.
```
