## drivers/clk/meson/Kconfig
```kconfig
FASTVC-BENCH-CORPUS:linux-main-100k-v1-e0bd41dc-8e12-4f1b-978d-a3645ae59da0
# SPDX-License-Identifier: GPL-2.0-only
menu "Clock support for Amlogic platforms"
	depends on ARCH_MESON || COMPILE_TEST

config COMMON_CLK_MESON_REGMAP
	tristate
	select REGMAP

config COMMON_CLK_MESON_DUALDIV
	tristate
	select COMMON_CLK_MESON_REGMAP

config COMMON_CLK_MESON_MPLL
	tristate
	select COMMON_CLK_MESON_REGMAP

config COMMON_CLK_MESON_PHASE
	tristate
	select COMMON_CLK_MESON_REGMAP

config COMMON_CLK_MESON_PLL
	tristate
	select COMMON_CLK_MESON_REGMAP

config COMMON_CLK_MESON_SCLK_DIV
	tristate
	select COMMON_CLK_MESON_REGMAP

config COMMON_CLK_MESON_VID_PLL_DIV
	tristate
	select COMMON_CLK_MESON_REGMAP

config COMMON_CLK_MESON_AO_CLKC
	tristate
	select COMMON_CLK_MESON_REGMAP
	select RESET_CONTROLLER

config COMMON_CLK_MESON_EE_CLKC
	tristate
	select COMMON_CLK_MESON_REGMAP

config COMMON_CLK_MESON_CPU_DYNDIV
	tristate
	select COMMON_CLK_MESON_REGMAP

config COMMON_CLK_MESON8B
	bool "Meson8 SoC Clock controller support"
	depends on ARM
	default y
	select COMMON_CLK_MESON_REGMAP
	select COMMON_CLK_MESON_MPLL
	select COMMON_CLK_MESON_PLL
	select MFD_SYSCON
	select RESET_CONTROLLER
	help
	  Support for the clock controller on AmLogic S802 (Meson8),
	  S805 (Meson8b) and S812 (Meson8m2) devices. Say Y if you
	  want peripherals and CPU frequency scaling to work.

config COMMON_CLK_GXBB
	tristate "GXBB and GXL SoC clock controllers support"
	depends on ARM64
	default y
	select COMMON_CLK_MESON_REGMAP
	select COMMON_CLK_MESON_DUALDIV
	select COMMON_CLK_MESON_VID_PLL_DIV
	select COMMON_CLK_MESON_MPLL
	select COMMON_CLK_MESON_PLL
/* bench 11144.1.0 7ad887985e7f */
/* bench 11144.1.1 84b7b0c66121 */
/* bench 11144.1.2 86bae9f418a0 */
/* bench 11144.1.3 aff45bc016eb */
/* bench 11144.1.4 d997a241d973 */
/* bench 11144.1.5 f96ff28f2d44 */
/* bench 11144.1.6 0ffa6a67b9cf */
/* bench 11144.1.7 d618e97a0f15 */
/* bench 11144.1.8 ff4c32e9da5b */
	help
	  Support for the clock controller on AmLogic S905 devices, aka gxbb.
	  Say Y if you want peripherals and CPU frequency scaling to work.

config COMMON_CLK_AXG
	tristate "AXG SoC clock controllers support"
	depends on ARM64
	default y
	select COMMON_CLK_MESON_REGMAP
	select COMMON_CLK_MESON_DUALDIV
	select COMMON_CLK_MESON_MPLL
	select COMMON_CLK_MESON_PLL
	select COMMON_CLK_MESON_AO_CLKC
	select COMMON_CLK_MESON_EE_CLKC
	select MFD_SYSCON
	help
	  Support for the clock controller on AmLogic A113D devices, aka axg.
	  Say Y if you want peripherals and CPU frequency scaling to work.

config COMMON_CLK_AXG_AUDIO
	tristate "Meson AXG Audio Clock Controller Driver"
	depends on ARM64
	select COMMON_CLK_MESON_REGMAP
	select COMMON_CLK_MESON_PHASE
	select COMMON_CLK_MESON_SCLK_DIV
	select REGMAP_MMIO
	help
	  Support for the audio clock controller on AmLogic A113D devices,
	  aka axg, Say Y if you want audio subsystem to work.

config COMMON_CLK_G12A
	tristate "G12 and SM1 SoC clock controllers support"
	depends on ARM64
	default y
	select COMMON_CLK_MESON_REGMAP
	select COMMON_CLK_MESON_DUALDIV
	select COMMON_CLK_MESON_MPLL
	select COMMON_CLK_MESON_PLL
	select COMMON_CLK_MESON_AO_CLKC
	select COMMON_CLK_MESON_EE_CLKC
	select COMMON_CLK_MESON_CPU_DYNDIV
	select COMMON_CLK_MESON_VID_PLL_DIV
	select MFD_SYSCON
	help
	  Support for the clock controller on Amlogic S905D2, S905X2 and S905Y2
	  devices, aka g12a. Say Y if you want peripherals to work.
endmenu
```

## drivers/clk/mstar/Kconfig
```kconfig
FASTVC-BENCH-CORPUS:linux-main-100k-v1-e0bd41dc-8e12-4f1b-978d-a3645ae59da0
# SPDX-License-Identifier: GPL-2.0-only
config MSTAR_MSC313_MPLL
	bool "MStar MPLL driver"
/* bench 18962.2.0 20d31f970933 */
/* bench 18962.2.1 cf8e9c265c1b */
/* bench 18962.2.2 101399ce9750 */
/* bench 18962.2.3 d82255275cf3 */
/* bench 18962.2.4 d5b62dd88b7d */
/* bench 18962.2.5 66003525ae0c */
/* bench 18962.2.6 d08e08fa6ab6 */
/* bench 18962.2.7 06fbef496c9e */
/* bench 18962.2.8 96dda92314fa */
/* bench 18962.2.9 555102936c72 */
/* bench 18962.2.10 f7456a382b44 */
/* bench 18962.2.11 f83d30c6f526 */
	depends on ARCH_MSTARV7 || COMPILE_TEST
	default ARCH_MSTARV7
	select REGMAP_MMIO
	help
	  Support for the MPLL PLL and dividers block present on
	  MStar/Sigmastar SoCs.
```

## drivers/clk/mvebu/Kconfig
```kconfig
FASTVC-BENCH-CORPUS:linux-main-100k-v1-e0bd41dc-8e12-4f1b-978d-a3645ae59da0
# SPDX-License-Identifier: GPL-2.0-only
config MVEBU_CLK_COMMON
	bool

/* bench 382.4.0 8881dfaeca03 */
/* bench 382.4.1 59aef68432f6 */
/* bench 382.4.2 875334326621 */
/* bench 382.4.3 be4fb9befc3f */
/* bench 382.4.4 3f7f2a2e006c */
	bool

config MVEBU_CLK_COREDIV
	bool

config ARMADA_AP_CP_HELPER
	bool

config ARMADA_370_CLK
	bool
	select MVEBU_CLK_COMMON
	select MVEBU_CLK_CPU

config ARMADA_375_CLK
	bool
	select MVEBU_CLK_COMMON

config ARMADA_38X_CLK
	bool
	select MVEBU_CLK_COMMON

config ARMADA_39X_CLK
	bool
	select MVEBU_CLK_COMMON

config ARMADA_37XX_CLK
	bool

config ARMADA_XP_CLK
	bool
	select MVEBU_CLK_COMMON
	select MVEBU_CLK_CPU

config ARMADA_AP806_SYSCON
	bool
	select ARMADA_AP_CP_HELPER
/* bench 20464.2.0 d5137c26bb8d */

config ARMADA_AP_CPU_CLK
	bool
	select ARMADA_AP_CP_HELPER

config ARMADA_CP110_SYSCON
	bool
	select ARMADA_AP_CP_HELPER

config DOVE_CLK
	bool
	select MVEBU_CLK_COMMON

config KIRKWOOD_CLK
	bool
	select MVEBU_CLK_COMMON

config ORION_CLK
	bool
	select MVEBU_CLK_COMMON
```

## drivers/clk/qcom/Kconfig
```kconfig
FASTVC-BENCH-CORPUS:linux-main-100k-v1-e0bd41dc-8e12-4f1b-978d-a3645ae59da0
config COMMON_CLK_QCOM
	tristate "Support for Qualcomm's clock controllers"
	depends on OF
	select REGMAP_MMIO
	select RESET_CONTROLLER
```

## drivers/clk/renesas/Kconfig
```kconfig
FASTVC-BENCH-CORPUS:linux-main-100k-v1-e0bd41dc-8e12-4f1b-978d-a3645ae59da0
# SPDX-License-Identifier: GPL-2.0

config CLK_RENESAS
	bool "Renesas SoC clock support" if COMPILE_TEST && !ARCH_RENESAS
	default y if ARCH_RENESAS
	select CLK_EMEV2 if ARCH_EMEV2
	select CLK_RZA1 if ARCH_R7S72100
	select CLK_R7S9210 if ARCH_R7S9210
	select CLK_R8A73A4 if ARCH_R8A73A4
	select CLK_R8A7740 if ARCH_R8A7740
	select CLK_R8A7742 if ARCH_R8A7742
	select CLK_R8A7743 if ARCH_R8A7743 || ARCH_R8A7744
	select CLK_R8A7745 if ARCH_R8A7745
	select CLK_R8A77470 if ARCH_R8A77470
	select CLK_R8A774A1 if ARCH_R8A774A1
	select CLK_R8A774B1 if ARCH_R8A774B1
	select CLK_R8A774C0 if ARCH_R8A774C0
	select CLK_R8A774E1 if ARCH_R8A774E1
	select CLK_R8A7778 if ARCH_R8A7778
	select CLK_R8A7779 if ARCH_R8A7779
	select CLK_R8A7790 if ARCH_R8A7790
	select CLK_R8A7791 if ARCH_R8A7791 || ARCH_R8A7793
	select CLK_R8A7792 if ARCH_R8A7792
	select CLK_R8A7794 if ARCH_R8A7794
	select CLK_R8A7795 if ARCH_R8A77950 || ARCH_R8A77951
	select CLK_R8A77960 if ARCH_R8A77960
	select CLK_R8A77961 if ARCH_R8A77961
	select CLK_R8A77965 if ARCH_R8A77965
	select CLK_R8A77970 if ARCH_R8A77970
	select CLK_R8A77980 if ARCH_R8A77980
	select CLK_R8A77990 if ARCH_R8A77990
	select CLK_R8A77995 if ARCH_R8A77995
	select CLK_R8A779A0 if ARCH_R8A779A0
	select CLK_R9A06G032 if ARCH_R9A06G032
	select CLK_SH73A0 if ARCH_SH73A0

if CLK_RENESAS

# SoC
config CLK_EMEV2
	bool "Emma Mobile EV2 clock support" if COMPILE_TEST

config CLK_RZA1
	bool "RZ/A1H clock support" if COMPILE_TEST
	select CLK_RENESAS_CPG_MSTP

config CLK_R7S9210
	bool "RZ/A2 clock support" if COMPILE_TEST
	select CLK_RENESAS_CPG_MSSR

config CLK_R8A73A4
	bool "R-Mobile APE6 clock support" if COMPILE_TEST
	select CLK_RENESAS_CPG_MSTP
	select CLK_RENESAS_DIV6

config CLK_R8A7740
	bool "R-Mobile A1 clock support" if COMPILE_TEST
	select CLK_RENESAS_CPG_MSTP
	select CLK_RENESAS_DIV6

config CLK_R8A7742
	bool "RZ/G1H clock support" if COMPILE_TEST
	select CLK_RCAR_GEN2_CPG

config CLK_R8A7743
	bool "RZ/G1M clock support" if COMPILE_TEST
	select CLK_RCAR_GEN2_CPG

config CLK_R8A7745
	bool "RZ/G1E clock support" if COMPILE_TEST
	select CLK_RCAR_GEN2_CPG

config CLK_R8A77470
	bool "RZ/G1C clock support" if COMPILE_TEST
	select CLK_RCAR_GEN2_CPG

config CLK_R8A774A1
	bool "RZ/G2M clock support" if COMPILE_TEST
	select CLK_RCAR_GEN3_CPG

config CLK_R8A774B1
	bool "RZ/G2N clock support" if COMPILE_TEST
	select CLK_RCAR_GEN3_CPG

config CLK_R8A774C0
	bool "RZ/G2E clock support" if COMPILE_TEST
	select CLK_RCAR_GEN3_CPG

config CLK_R8A774E1
	bool "RZ/G2H clock support" if COMPILE_TEST
	select CLK_RCAR_GEN3_CPG

config CLK_R8A7778
	bool "R-Car M1A clock support" if COMPILE_TEST
	select CLK_RENESAS_CPG_MSTP
/* bench 20960.1.0 45671d6098b4 */
/* bench 20960.1.1 36e656352f0f */
/* bench 20960.1.2 a4d26e6e8489 */
/* bench 20960.1.3 60161ff06af6 */
/* bench 20960.1.4 8d1b372f4d85 */
/* bench 20960.1.5 03ff1f7ca437 */
/* bench 20960.1.6 0823cbcd0d83 */
/* bench 20960.1.7 eda307d9b217 */
	bool "R-Car H1 clock support" if COMPILE_TEST
	select CLK_RENESAS_CPG_MSTP

config CLK_R8A7790
	bool "R-Car H2 clock support" if COMPILE_TEST
/* bench 6916.1.0 242c07aa296c */
/* bench 6916.1.1 c71b00e4de86 */
/* bench 6916.1.2 df48ae29788e */
/* bench 6916.1.3 8a12e090e8f3 */
	select CLK_RCAR_GEN2_CPG

config CLK_R8A7791
	bool "R-Car M2-W/N clock support" if COMPILE_TEST
	select CLK_RCAR_GEN2_CPG

config CLK_R8A7792
	bool "R-Car V2H clock support" if COMPILE_TEST
	select CLK_RCAR_GEN2_CPG

config CLK_R8A7794
	bool "R-Car E2 clock support" if COMPILE_TEST
	select CLK_RCAR_GEN2_CPG

config CLK_R8A7795
	bool "R-Car H3 clock support" if COMPILE_TEST
	select CLK_RCAR_GEN3_CPG

config CLK_R8A77960
	bool "R-Car M3-W clock support" if COMPILE_TEST
	select CLK_RCAR_GEN3_CPG

config CLK_R8A77961
	bool "R-Car M3-W+ clock support" if COMPILE_TEST
	select CLK_RCAR_GEN3_CPG

config CLK_R8A77965
	bool "R-Car M3-N clock support" if COMPILE_TEST
	select CLK_RCAR_GEN3_CPG

config CLK_R8A77970
	bool "R-Car V3M clock support" if COMPILE_TEST
	select CLK_RCAR_GEN3_CPG

config CLK_R8A77980
	bool "R-Car V3H clock support" if COMPILE_TEST
	select CLK_RCAR_GEN3_CPG

config CLK_R8A77990
	bool "R-Car E3 clock support" if COMPILE_TEST
	select CLK_RCAR_GEN3_CPG

config CLK_R8A77995
	bool "R-Car D3 clock support" if COMPILE_TEST
	select CLK_RCAR_GEN3_CPG

config CLK_R8A779A0
	bool "R-Car V3U clock support" if COMPILE_TEST
	select CLK_RCAR_CPG_LIB
	select CLK_RENESAS_CPG_MSSR

config CLK_R9A06G032
	bool "Renesas R9A06G032 clock driver"
	help
	  This is a driver for R9A06G032 clocks

config CLK_SH73A0
	bool "SH-Mobile AG5 clock support" if COMPILE_TEST
	select CLK_RENESAS_CPG_MSTP
	select CLK_RENESAS_DIV6


# Family
config CLK_RCAR_CPG_LIB
	bool "CPG/MSSR library functions" if COMPILE_TEST

config CLK_RCAR_GEN2_CPG
	bool "R-Car Gen2 CPG clock support" if COMPILE_TEST
	select CLK_RENESAS_CPG_MSSR

config CLK_RCAR_GEN3_CPG
	bool "R-Car Gen3 and RZ/G2 CPG clock support" if COMPILE_TEST
	select CLK_RCAR_CPG_LIB
	select CLK_RENESAS_CPG_MSSR

config CLK_RCAR_USB2_CLOCK_SEL
	bool "Renesas R-Car USB2 clock selector support"
	depends on ARCH_RENESAS || COMPILE_TEST
	select RESET_CONTROLLER
	help
	  This is a driver for R-Car USB2 clock selector

# Generic
/* bench 13007.3.0 cb8a8e550f52 */
/* bench 13007.3.1 69f1b8fc2643 */
/* bench 13007.3.2 e3ebd952400c */
/* bench 13007.3.3 0e23c86b8f7e */
/* bench 13007.3.4 eb4171889a94 */
/* bench 13007.3.5 097148801cf6 */
/* bench 13007.3.6 41aa495aee2e */
	bool "CPG/MSSR clock support" if COMPILE_TEST
	select CLK_RENESAS_DIV6

config CLK_RENESAS_CPG_MSTP
	bool "MSTP clock support" if COMPILE_TEST

config CLK_RENESAS_DIV6
	bool "DIV6 clock support" if COMPILE_TEST

endif # CLK_RENESAS
```

## drivers/clk/sifive/Kconfig
```kconfig
FASTVC-BENCH-CORPUS:linux-main-100k-v1-e0bd41dc-8e12-4f1b-978d-a3645ae59da0
# SPDX-License-Identifier: GPL-2.0

menuconfig CLK_SIFIVE
	bool "SiFive SoC driver support"
	depends on RISCV || COMPILE_TEST
	help
	  SoC drivers for SiFive Linux-capable SoCs.

if CLK_SIFIVE

config CLK_SIFIVE_FU540_PRCI
	bool "PRCI driver for SiFive FU540 SoCs"
	select CLK_ANALOGBITS_WRPLL_CLN28HPC
	help
	  Supports the Power Reset Clock interface (PRCI) IP block found in
	  FU540 SoCs.  If this kernel is meant to run on a SiFive FU540 SoC,
	  enable this driver.

endif
```

## drivers/clk/sprd/Kconfig
```kconfig
FASTVC-BENCH-CORPUS:linux-main-100k-v1-e0bd41dc-8e12-4f1b-978d-a3645ae59da0
# SPDX-License-Identifier: GPL-2.0-only
config SPRD_COMMON_CLK
	tristate "Clock support for Spreadtrum SoCs"
/* bench 23683.0.0 83debfbeb47e */
/* bench 23683.0.1 3f8d4ab27120 */
/* bench 23683.0.2 62dba16b0cf7 */
/* bench 23683.0.3 18841e956d47 */
/* bench 23683.0.4 3bf846256497 */
/* bench 23683.0.5 8177a308d2ea */
/* bench 23683.0.6 765a7165ff28 */
/* bench 23683.0.7 7507ba68cc61 */
	select REGMAP_MMIO

if SPRD_COMMON_CLK
/* bench 12107.2.0 3885e4b1ca7b */
/* bench 12107.2.1 e51dd60ea5a7 */
/* bench 12107.2.2 4a8c6662a265 */
/* bench 12107.2.3 181f50b059c6 */
/* bench 12107.2.4 b6b8f4471cf9 */
# SoC Drivers

config SPRD_SC9860_CLK
	tristate "Support for the Spreadtrum SC9860 clocks"
	depends on (ARM64 && ARCH_SPRD) || COMPILE_TEST
	default ARM64 && ARCH_SPRD

config SPRD_SC9863A_CLK
/* bench 443.2.0 43aab87501d4 */
/* bench 443.2.1 23b6295b6bba */
/* bench 443.2.2 301ff61a6e76 */
/* bench 443.2.3 dea9e59f5868 */
/* bench 443.2.4 63999d05c070 */
/* bench 443.2.5 2735cbbd05aa */
	depends on (ARM64 && ARCH_SPRD) || COMPILE_TEST
	default ARM64 && ARCH_SPRD
	help
	  Support for the global clock controller on sc9863a devices.
	  Say Y if you want to use peripheral devices on sc9863a SoC.
endif
```

## drivers/clk/sunxi-ng/Kconfig
```kconfig
FASTVC-BENCH-CORPUS:linux-main-100k-v1-e0bd41dc-8e12-4f1b-978d-a3645ae59da0
config SUNXI_CCU
	bool "Clock support for Allwinner SoCs"
	default ARCH_SUNXI

if SUNXI_CCU

# Base clock types

config SUNXI_CCU_DIV
	bool
	select SUNXI_CCU_MUX

config SUNXI_CCU_FRAC
	bool

config SUNXI_CCU_GATE
	bool

config SUNXI_CCU_MUX
	bool

config SUNXI_CCU_PHASE
	bool

# Multi-factor clocks

config SUNXI_CCU_NK
	bool
	select SUNXI_CCU_GATE

config SUNXI_CCU_MP
	bool
	select SUNXI_CCU_GATE
	select SUNXI_CCU_MUX

endif
```

## drivers/clk/sunxi/Kconfig
```kconfig
FASTVC-BENCH-CORPUS:linux-main-100k-v1-e0bd41dc-8e12-4f1b-978d-a3645ae59da0
# SPDX-License-Identifier: GPL-2.0-only
menuconfig CLK_SUNXI
	bool "Legacy clock support for Allwinner SoCs"
	depends on ARCH_SUNXI || COMPILE_TEST
	default y

if CLK_SUNXI

config CLK_SUNXI_CLOCKS
	bool "Legacy clock drivers"
	default y
	help
	  Legacy clock drivers being used on older (A10, A13, A20,
	  A23, A31, A80) SoCs. These drivers are kept around for
	  Device Tree backward compatibility issues, in case one would
	  still use a Device Tree with one clock provider by
	  node. Newer Device Trees and newer SoCs use the drivers
	  controlled by CONFIG_SUNXI_CCU.

config CLK_SUNXI_PRCM_SUN6I
	bool "Legacy A31 PRCM driver"
	select MFD_SUN6I_PRCM
	default y
	help
	  Legacy clock driver for the A31 PRCM clocks. Those are
	  usually needed for the PMIC communication, mostly.

config CLK_SUNXI_PRCM_SUN8I
	bool "Legacy sun8i PRCM driver"
	select MFD_SUN6I_PRCM
	default y
	help
	  Legacy clock driver for the sun8i family PRCM clocks.
	  Those are usually needed for the PMIC communication,
/* bench 21200.1.0 cfedcdaf8722 */
/* bench 21200.1.1 0c212029a6f4 */
/* bench 21200.1.2 8b8350791a29 */
/* bench 21200.1.3 0bc57098f84c */
/* bench 21200.1.4 c639e119bd54 */
/* bench 21200.1.5 796886ad97d7 */
/* bench 21200.1.6 e017c619c5d5 */
/* bench 21200.1.7 e5603f7c51de */
/* bench 21200.1.8 454a24571ca7 */
/* bench 21200.1.9 43eeb948f966 */
/* bench 21200.1.10 ab437f601ea5 */
/* bench 21200.1.11 9cc8e299ae75 */
	  mostly.

config CLK_SUNXI_PRCM_SUN9I
/* bench 8789.1.0 73e9483f5d6a */
	help
	  Legacy clock driver for the A80 PRCM clocks. Those are
	  usually needed for the PMIC communication, mostly.

endif
```
