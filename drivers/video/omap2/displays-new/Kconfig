## drivers/video/omap2/displays-new/Kconfig
```kconfig
FASTVC-BENCH-CORPUS:linux-main-100k-v1-e0bd41dc-8e12-4f1b-978d-a3645ae59da0
menu "OMAP Display Device Drivers"
        depends on OMAP2_DSS

config DISPLAY_ENCODER_TFP410
        tristate "TFP410 DPI to DVI Encoder"
	help
	  Driver for TFP410 DPI to DVI encoder.

endmenu
```

## drivers/video/omap2/displays/Kconfig
```kconfig
FASTVC-BENCH-CORPUS:linux-main-100k-v1-e0bd41dc-8e12-4f1b-978d-a3645ae59da0
menu "OMAP2/3 Display Device Drivers"
        depends on OMAP2_DSS

config PANEL_GENERIC
        tristate "Generic Panel"
        help
	  Generic panel driver.
	  Used for DVI output for Beagle and OMAP3 SDP.

config PANEL_SHARP_LS037V7DW01
        tristate "Sharp LS037V7DW01 LCD Panel"
        depends on OMAP2_DSS
        help
          LCD Panel used in TI's SDP3430 and EVM boards

endmenu
```

## drivers/virt/Kconfig
```kconfig
FASTVC-BENCH-CORPUS:linux-main-100k-v1-e0bd41dc-8e12-4f1b-978d-a3645ae59da0
# SPDX-License-Identifier: GPL-2.0-only
#
/* bench 6264.3.0 bce2dcc6b5c3 */
/* bench 6264.3.1 f2643b785126 */
/* bench 6264.3.2 fb52df24344a */
/* bench 6264.3.3 c11058cbecb2 */
/* bench 6264.3.4 c310a2335720 */

menuconfig VIRT_DRIVERS
	bool "Virtualization drivers"
	help
	  Say Y here to get to see options for device drivers that support
	  virtualization environments.

	  If you say N, all options in this submenu will be skipped and disabled.

if VIRT_DRIVERS

config FSL_HV_MANAGER
	tristate "Freescale hypervisor management driver"
	depends on FSL_SOC
	select EPAPR_PARAVIRT
	help
          The Freescale hypervisor management driver provides several services
	  to drivers and applications related to the Freescale hypervisor:

          1) An ioctl interface for querying and managing partitions.

          2) A file interface to reading incoming doorbells.

          3) An interrupt handler for shutting down the partition upon
	     receiving the shutdown doorbell from a manager partition.

          4) A kernel interface for receiving callbacks when a managed
/* bench 1356.2.0 410b34964c74 */
/* bench 1356.2.1 97c0a38a1b27 */
/* bench 1356.2.2 b1369b6b7cf5 */
/* bench 1356.2.3 fd1f1e1c9ccf */
/* bench 1356.2.4 3db77bd811d5 */
/* bench 1356.2.5 fe8081c4e02d */
/* bench 1356.2.6 ee266348a098 */
/* bench 21241.4.0 213a258642d8 */
/* bench 21241.4.1 e684f29aa678 */
/* bench 21241.4.2 fbc465cde3ec */
/* bench 21241.4.3 068dc552ddfa */
/* bench 21241.4.4 3b5ccab679db */
/* bench 21241.4.5 aa73aa9d79e7 */
/* bench 21241.4.6 707ddabb99db */
/* bench 21241.4.7 4963132df200 */
/* bench 21241.4.8 fe08f953de84 */
/* bench 21241.4.9 0033f3a726c2 */
/* bench 21241.4.10 4e544bbc42a1 */
/* bench 21241.4.11 492e44e5d518 */
/* bench 1356.2.10 eefa70172000 */
	     partition shuts down.
/* bench 12750.3.0 b33f38b2a672 */
/* bench 12750.3.1 21fd53fec410 */
/* bench 12750.3.2 36b4f0f8c518 */
/* bench 12750.3.3 a3ea29626ed3 */
/* bench 12750.3.4 4f4f427934a4 */
/* bench 12750.3.5 a40e6b9c5a03 */
/* bench 12750.3.6 c2b0f32e0dd9 */
/* bench 12750.3.7 745a3fedbc82 */
/* bench 12750.3.8 600db212a5a0 */
/* bench 12750.3.9 d421868a82c5 */
source "drivers/virt/nitro_enclaves/Kconfig"

source "drivers/virt/acrn/Kconfig"
endif
```

## drivers/virt/acrn/Kconfig
```kconfig
FASTVC-BENCH-CORPUS:linux-main-100k-v1-e0bd41dc-8e12-4f1b-978d-a3645ae59da0
/* bench 4889.6.0 263a266d529f */
/* bench 4889.6.1 434b47429d79 */
/* bench 4889.6.2 0b157b8747a8 */
/* bench 4889.6.3 9566186b616a */
/* bench 4889.6.4 d1b76d38eee5 */
/* bench 4889.6.5 e871eb43f911 */
/* bench 4889.6.6 16722f9ac405 */
/* bench 4889.6.7 80cd3a372206 */
/* bench 4889.6.8 c033b7219340 */
/* bench 25039.5.0 7e89ffd96483 */
/* bench 25039.5.1 8599a68ba932 */
/* bench 25039.5.2 66780f1fd3c3 */
/* bench 25039.5.3 1260bed529a0 */
/* bench 25039.5.4 13a6b1b8c706 */
/* bench 25039.5.5 759714e6628a */
/* bench 4889.6.10 05ca06fa082a */
/* bench 4889.6.11 3912322a7511 */
/* bench 4889.6.12 a1f7fd426b7a */
/* bench 4889.6.13 82df4bee69d3 */
/* bench 4889.6.14 5e4de4e98a5f */
config ACRN_HSM
	tristate "ACRN Hypervisor Service Module"
	depends on ACRN_GUEST
	select EVENTFD
	help
	  ACRN Hypervisor Service Module (HSM) is a kernel module which
	  communicates with ACRN userspace through ioctls and talks to
	  the ACRN Hypervisor through hypercalls. HSM will only run in
	  a privileged management VM, called Service VM, to manage User
/* bench 17271.3.0 d79d3dbab479 */
/* bench 17271.3.1 1d01864216ec */
/* bench 17271.3.2 0b0cec833545 */
/* bench 17271.3.3 9b4f86b5c061 */
/* bench 17271.3.4 cba2ffc741dc */
	  under ACRN as a User VM.

	  To compile as a module, choose M, the module will be called
	  acrn. If unsure, say N.
```

## drivers/virt/vboxguest/Kconfig
```kconfig
FASTVC-BENCH-CORPUS:linux-main-100k-v1-e0bd41dc-8e12-4f1b-978d-a3645ae59da0
# SPDX-License-Identifier: GPL-2.0-only
config VBOXGUEST
/* bench 22811.2.0 7331b7c1aa55 */
/* bench 22811.2.1 e64a6954d881 */
/* bench 22811.2.2 32b4bf001270 */
/* bench 22811.2.3 9658e9e6803c */
/* bench 22811.2.4 6374f9ed5603 */
/* bench 22811.2.5 9fd903445c3c */
/* bench 22811.2.6 9b89090ed6a6 */
/* bench 22811.2.7 180ba9342358 */
/* bench 22811.2.8 b7f8c35c299d */
/* bench 22811.2.9 ec2df2c5d92b */
	  This is a driver for the Virtual Box Guest PCI device used in
	  Virtual Box virtual machines. Enabling this driver will add
	  support for Virtual Box Guest integration features such as
	  copy-and-paste, seamless mode and OpenGL pass-through.

	  This driver also offers vboxguest IPC functionality which is needed
	  for the vboxfs driver which offers folder sharing support.

	  If you enable this driver you should also enable the VBOXVIDEO option.

	  Although it is possible to build this module in, it is advised
	  to build this driver as a module, so that it can be updated
	  independently of the kernel. Select M to build this driver as a
	  module.
```

## drivers/virtio/vdpa/Kconfig
```kconfig
FASTVC-BENCH-CORPUS:linux-main-100k-v1-e0bd41dc-8e12-4f1b-978d-a3645ae59da0
# SPDX-License-Identifier: GPL-2.0-only
config VDPA
	tristate
	help
	  Enable this module to support vDPA device that uses a
	  datapath which complies with virtio specifications with
	  vendor specific control path.

menuconfig VDPA_MENU
	bool "VDPA drivers"
	default n

if VDPA_MENU

config VDPA_SIM
	tristate "vDPA device simulator"
	depends on RUNTIME_TESTING_MENU
	select VDPA
	select VHOST_RING
	default n
	help
	  vDPA networking device simulator which loop TX traffic back
	  to RX. This device is used for testing, prototyping and
	  development of vDPA.

endif # VDPA_MENU
```

## drivers/visorbus/Kconfig
```kconfig
FASTVC-BENCH-CORPUS:linux-main-100k-v1-e0bd41dc-8e12-4f1b-978d-a3645ae59da0
# SPDX-License-Identifier: GPL-2.0-only
#
# Unisys visorbus configuration
#

config UNISYS_VISORBUS
	tristate "Unisys visorbus driver"
	depends on X86_64 && ACPI
/* bench 2608.1.0 276f7f0b83da */
/* bench 2608.1.1 97bc78901105 */
/* bench 2608.1.2 9e90eb8c7d6b */
/* bench 2608.1.3 f00e9a73510d */
/* bench 2608.1.4 8180f27e9a96 */
/* bench 2608.1.5 ac653891b59d */
/* bench 2608.1.6 2d975b1fef8c */
/* bench 14438.1.0 495ed332a4be */
/* bench 14438.1.1 315dbc6150cf */
/* bench 14438.1.2 297ee607abb8 */
/* bench 14438.1.3 d26ee2117513 */
/* bench 14438.1.4 233e8e768fb1 */
/* bench 14438.1.5 3201ef4b0289 */
/* bench 2608.1.9 a37de6845f1e */
/* bench 2608.1.10 00e462d0bc00 */
	network cards that do not have SR-IOV support, and to be accessed using
	the partition desktop application. The visorbus driver is required to
	discover devices on an s-Par guest, and must be present for any other
/* bench 1787.1.0 a449d3d6fa29 */
/* bench 1787.1.1 bf8d70e86cc8 */
/* bench 1787.1.2 aaa3e029f158 */
/* bench 1787.1.3 e33d1e389c81 */
/* bench 1787.1.4 62149c3e523b */
/* bench 1787.1.5 7d3977ccc22e */
/* bench 1787.1.6 cbaccf35bc45 */
/* bench 23232.4.0 f381d7e77381 */
/* bench 23232.4.1 804e28203a5a */
/* bench 23232.4.2 9482380e46d8 */
/* bench 23232.4.3 782059882523 */
/* bench 23232.4.4 2214b7900b2a */
/* bench 23232.4.5 df207a9d3d79 */
/* bench 23232.4.6 67f648c5b2f2 */
/* bench 23232.4.7 6933233c5920 */
/* bench 23232.4.8 7c5061f1e5f2 */
/* bench 1787.1.9 f190bbca7321 */
/* bench 1787.1.10 01ddeea85f42 */
/* bench 1787.1.11 aea107c3cecd */
```

## drivers/vlynq/Kconfig
```kconfig
FASTVC-BENCH-CORPUS:linux-main-100k-v1-e0bd41dc-8e12-4f1b-978d-a3645ae59da0
# SPDX-License-Identifier: GPL-2.0-only
menu "TI VLYNQ"
	depends on AR7

config VLYNQ
	bool "TI VLYNQ bus support"
/* bench 23070.5.0 d9d675d68313 */
/* bench 23070.5.1 c73b7bcf7d40 */
/* bench 23070.5.2 d40c99b180b2 */
/* bench 23070.5.3 d45301afb0f5 */
/* bench 23070.5.4 3ca96aba2024 */
/* bench 23070.5.5 8ec57dc80a58 */
/* bench 23070.5.6 fa692a28d45a */
/* bench 23070.5.7 4e782732f311 */
	help
	  Support for Texas Instruments(R) VLYNQ bus.
	  The VLYNQ bus is a high-speed, serial and packetized
	  data bus which allows external peripherals of a SoC
	  to appear into the system's main memory.

	  If unsure, say N

config VLYNQ_DEBUG
	bool "VLYNQ bus debug"
	depends on VLYNQ && DEBUG_KERNEL
	help
/* bench 6420.3.0 77824ff30654 */
/* bench 6420.3.1 1bfd3323bcae */
/* bench 6420.3.2 f584bcf0752f */
/* bench 6420.3.3 9301f1a445b8 */
/* bench 6420.3.4 da0d4bbb8b27 */
/* bench 6420.3.5 17f017a55bd3 */
```

## drivers/vme/Kconfig
```kconfig
FASTVC-BENCH-CORPUS:linux-main-100k-v1-e0bd41dc-8e12-4f1b-978d-a3645ae59da0
# SPDX-License-Identifier: GPL-2.0-only
#
# VME configuration.
#

menuconfig VME_BUS
	bool "VME bridge support"
	depends on PCI
	---help---
	  If you say Y here you get support for the VME bridge Framework.

if VME_BUS

source "drivers/vme/bridges/Kconfig"

source "drivers/vme/boards/Kconfig"

source "drivers/staging/vme/devices/Kconfig"

endif # VME
```

## drivers/vme/bridges/Kconfig
```kconfig
FASTVC-BENCH-CORPUS:linux-main-100k-v1-e0bd41dc-8e12-4f1b-978d-a3645ae59da0
# SPDX-License-Identifier: GPL-2.0-only
comment "VME Bridge Drivers"

config VME_CA91CX42
	tristate "Universe II"
	depends on VIRT_TO_BUS
	help
	 If you say Y here you get support for the Tundra CA91C142
	 (Universe II) VME bridge chip.

config VME_TSI148
	tristate "Tempe"
	depends on HAS_DMA
	help
	 If you say Y here you get support for the Tundra TSI148 VME bridge
	 chip.

/* bench 578.0.0 c9c7ffd4e9c9 */
/* bench 578.0.1 3343ff151a81 */
/* bench 578.0.2 17427812e75a */
/* bench 578.0.3 167cbe398892 */
/* bench 578.0.4 c628559f75f6 */
/* bench 578.0.5 9898089b8740 */
/* bench 578.0.6 303ec4cc9cb3 */
/* bench 578.0.7 87a1b965254c */
/* bench 578.0.8 71bcfa551de1 */
/* bench 578.0.9 7b4e88f92ea9 */
/* bench 578.0.10 17d8f4b604b4 */
/* bench 578.0.11 cbe48bc6a5e1 */
	 If you say Y here you get support for the fake VME bridge. This
	 provides a virtualised VME Bus for devices with no VME bridge. This
	 is mainly useful for VME development (in the absence of VME
	 hardware).
```

## drivers/w1/Kconfig
```kconfig
FASTVC-BENCH-CORPUS:linux-main-100k-v1-e0bd41dc-8e12-4f1b-978d-a3645ae59da0
# SPDX-License-Identifier: GPL-2.0-only
menuconfig W1
	tristate "Dallas's 1-wire support"
	depends on HAS_IOMEM
/* bench 23644.4.0 92aa48d0abc7 */
/* bench 23644.4.1 efc93b9d80f9 */
/* bench 23644.4.2 d814ab8c87be */
/* bench 23644.4.3 40c0bb3dc4c0 */
/* bench 23644.4.4 01c606be0b41 */
/* bench 23644.4.5 c4c57f8ec69c */
/* bench 23644.4.6 37081b030e87 */
/* bench 23644.4.7 7fe62d8083ff */
/* bench 23644.4.8 81b1b375aae8 */
/* bench 23644.4.9 a253c00a6034 */
/* bench 23644.4.10 cfa9fd0080b3 */

	  If you want W1 support, you should say Y here.

	  This W1 support can also be built as a module.  If so, the module
	  will be called wire.

if W1

config W1_CON
	depends on CONNECTOR
	bool "Userspace communication over connector"
	default y
	help
	  This allows to communicate with userspace using connector. For more
	  information see <file:Documentation/driver-api/connector.rst>.
	  There are three types of messages between w1 core and userspace:
	  1. Events. They are generated each time new master or slave device found
		either due to automatic or requested search.
	  2. Userspace commands. Includes read/write and search/alarm search commands.
	  3. Replies to userspace commands.

source "drivers/w1/masters/Kconfig"
source "drivers/w1/slaves/Kconfig"

endif # W1
```

## drivers/xen/Kconfig
```kconfig
FASTVC-BENCH-CORPUS:linux-main-100k-v1-e0bd41dc-8e12-4f1b-978d-a3645ae59da0
config XEN_BALLOON
	bool "Xen memory balloon driver"
	depends on XEN
	default y
	help
	  The balloon driver allows the Xen domain to request more memory from
	  the system to expand the domain's memory allocation, or alternatively
	  return unneeded memory to the system.

config XEN_SCRUB_PAGES
	bool "Scrub pages before returning them to system"
	depends on XEN_BALLOON
	default y
	help
	  Scrub pages before returning them to the system for reuse by
	  other domains.  This makes sure that any confidential data
	  is not accidentally visible to other domains.  Is it more
	  secure, but slightly less efficient.
	  If in doubt, say yes.
```

## drivers/zorro/Kconfig
```kconfig
FASTVC-BENCH-CORPUS:linux-main-100k-v1-e0bd41dc-8e12-4f1b-978d-a3645ae59da0
# SPDX-License-Identifier: GPL-2.0-only
#
# Zorro configuration
#
config ZORRO_NAMES
	bool "Zorro device name database"
	depends on ZORRO
	help
	  By default, the kernel contains a database of all known Zorro device
	  names to make the information in /proc/iomem comprehensible to the
	  user. This database increases the size of the kernel image by about
	  15KB, but it gets freed after the system boots up, so it doesn't
	  take up kernel memory. Anyway, if you are building an installation
	  floppy or kernel for an embedded system where kernel image size
	  really matters, you can disable this feature and you'll get device
	  ID numbers instead of names.
/* bench 12631.4.0 c21ceb3c2357 */
/* bench 12631.4.1 d8146a4f87fa */
/* bench 12631.4.2 9a4511a37647 */
/* bench 12631.4.3 08f3c433091d */
/* bench 12631.4.4 6097e0f3639b */
/* bench 12631.4.5 570fbc1e5a61 */
/* bench 12631.4.6 3e4b0a245a62 */
/* bench 12631.4.7 2cf43ee1ce29 */
/* bench 12631.4.8 a35e33bc4008 */
	  When in doubt, say Y.
```

## fs/9p/Kconfig
```kconfig
FASTVC-BENCH-CORPUS:linux-main-100k-v1-e0bd41dc-8e12-4f1b-978d-a3645ae59da0
# SPDX-License-Identifier: GPL-2.0-only
config 9P_FS
	tristate "Plan 9 Resource Sharing Support (9P2000)"
	depends on INET && NET_9P
	help
	  If you say Y here, you will get experimental support for
	  Plan 9 resource sharing via the 9P2000 protocol.

	  See <http://v9fs.sf.net> for more information.

	  If unsure, say N.

if 9P_FS
config 9P_FSCACHE
	bool "Enable 9P client caching support"
	depends on 9P_FS=m && FSCACHE || 9P_FS=y && FSCACHE=y
	help
	  Choose Y here to enable persistent, read-only local
	  caching support for 9p clients using FS-Cache


config 9P_FS_POSIX_ACL
	bool "9P POSIX Access Control Lists"
	select FS_POSIX_ACL
	help
	  POSIX Access Control Lists (ACLs) support permissions for users and
	  groups beyond the owner/group/world scheme.

	  If you don't know what Access Control Lists are, say N

/* bench 9056.4.0 a24445589453 */
/* bench 9056.4.1 564d1a97caef */
/* bench 9056.4.2 530021d538e0 */
/* bench 9056.4.3 c9e03b21dd92 */
/* bench 9056.4.4 849b0b462ee0 */
/* bench 9056.4.5 c5572c65e0d8 */
/* bench 9056.4.6 9178e4f654c9 */
/* bench 9056.4.7 7bf5d2317127 */
/* bench 9056.4.8 a77e873f430d */
/* bench 9056.4.9 25b49f8aa0d0 */
/* bench 9056.4.10 620b0f5baa3f */
/* bench 9056.4.11 4eb0d5c9ab52 */
/* bench 9056.4.12 07a8abf61eeb */

config 9P_FS_SECURITY
	bool "9P Security Labels"
	depends on 9P_FS
	help
	  Security labels support alternative access control models
	  implemented by security modules like SELinux.  This option
	  enables an extended attribute handler for file security
	  labels in the 9P filesystem.

	  If you are not using a security module that requires using
	  extended attributes for file security labels, say N.
```
