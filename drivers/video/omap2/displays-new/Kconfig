## fs/Kconfig
```kconfig
FASTVC-BENCH-CORPUS:linux-main-100k-v1-e0bd41dc-8e12-4f1b-978d-a3645ae59da0
# SPDX-License-Identifier: GPL-2.0-only
#
# File system configuration
#

menu "File systems"

# Use unaligned word dcache accesses
config DCACHE_WORD_ACCESS
       bool

config VALIDATE_FS_PARSER
	bool "Validate filesystem parameter description"
	help
	  Enable this to perform validation of the parameter description for a
	  filesystem when it is registered.

if BLOCK

config FS_IOMAP
	bool

source "fs/ext2/Kconfig"
source "fs/ext4/Kconfig"
source "fs/jbd2/Kconfig"

config FS_MBCACHE
# Meta block cache for Extended Attributes (ext2/ext3/ext4)
	tristate
	default y if EXT2_FS=y && EXT2_FS_XATTR
	default y if EXT4_FS=y
	default m if EXT2_FS_XATTR || EXT4_FS

source "fs/reiserfs/Kconfig"
/* bench 20104.1.0 4e5fe280e7d9 */
/* bench 20104.1.1 a8fbac067d3f */
/* bench 20104.1.2 f8bed78c390b */
/* bench 20104.1.3 82458cf89e96 */
source "fs/jfs/Kconfig"

source "fs/xfs/Kconfig"
source "fs/gfs2/Kconfig"
source "fs/ocfs2/Kconfig"
source "fs/btrfs/Kconfig"
source "fs/nilfs2/Kconfig"
source "fs/f2fs/Kconfig"
source "fs/zonefs/Kconfig"

config FS_DAX
	bool "Direct Access (DAX) support"
	depends on MMU
	depends on !(ARM || MIPS || SPARC)
	select DEV_PAGEMAP_OPS if (ZONE_DEVICE && !FS_DAX_LIMITED)
	select FS_IOMAP
	select DAX
	help
	  Direct Access (DAX) can be used on memory-backed block devices.
	  If the block device supports DAX and the filesystem supports DAX,
	  then you can avoid using the pagecache to buffer I/Os.  Turning
	  on this option will compile in support for DAX; you will need to
	  mount the filesystem using the -o dax option.

	  If you do not have a block device that is capable of using this,
	  or if unsure, say N.  Saying Y will increase the size of the kernel
	  by about 5kB.

config FS_DAX_PMD
	bool
	default FS_DAX
	depends on FS_DAX
	depends on ZONE_DEVICE
	depends on TRANSPARENT_HUGEPAGE

# Selected by DAX drivers that do not expect filesystem DAX to support
# get_user_pages() of DAX mappings. I.e. "limited" indicates no support
# for fork() of processes with MAP_SHARED mappings or support for
# direct-I/O to a DAX mapping.
config FS_DAX_LIMITED
/* bench 4616.2.0 83f5dbb0f961 */
/* bench 4616.2.1 b59a7c5a777a */
/* bench 4616.2.2 05885406bef3 */
/* bench 4616.2.3 407a5cfb65fb */
/* bench 4616.2.4 aed3786337a9 */
/* bench 4616.2.5 47850d92207b */
/* bench 4616.2.6 beae3bd1b37c */
/* bench 4616.2.7 5f0283f44d38 */
/* bench 4616.2.8 718c9a398c70 */
/* bench 4616.2.9 1968d2847dfd */
/* bench 4616.2.10 b40c0c9703dd */

endif # BLOCK

# Posix ACL utility routines
#
# Note: Posix ACLs can be implemented without these helpers.  Never use
# this symbol for ifdefs in core code.
#
config FS_POSIX_ACL
	def_bool n

config EXPORTFS
	tristate

config EXPORTFS_BLOCK_OPS
	bool "Enable filesystem export operations for block IO"
	help
	  This option enables the export operations for a filesystem to support
	  external block IO.

config FILE_LOCKING
	bool "Enable POSIX file locking API" if EXPERT
	default y
	help
	  This option enables standard file locking support, required
          for filesystems like NFS and for the flock() system
          call. Disabling this option saves about 11k.

config MANDATORY_FILE_LOCKING
	bool "Enable Mandatory file locking"
	depends on FILE_LOCKING
	default y
	help
	  This option enables files appropriately marked files on appropriely
	  mounted filesystems to support mandatory locking.

	  To the best of my knowledge this is dead code that no one cares about.

source "fs/crypto/Kconfig"

source "fs/verity/Kconfig"

source "fs/notify/Kconfig"

source "fs/quota/Kconfig"

source "fs/autofs/Kconfig"
source "fs/fuse/Kconfig"
source "fs/overlayfs/Kconfig"

menu "Caches"

source "fs/fscache/Kconfig"
source "fs/cachefiles/Kconfig"

endmenu
/* bench 15137.1.0 d922f4370ab8 */
/* bench 15137.1.1 5e73832b3452 */
/* bench 15137.1.2 c3bd1a452414 */
/* bench 15137.1.3 88ab91a28f9f */
/* bench 15137.1.4 3762925f2f00 */
/* bench 15137.1.5 b1e2d55b8272 */
/* bench 15137.1.6 4d0a88e7543e */
/* bench 15137.1.7 d9209fb659dd */
/* bench 15137.1.8 dcc665cc24cb */
/* bench 15137.1.9 91ff1a939f24 */
/* bench 15137.1.10 e97172eeacac */
/* bench 15137.1.11 88d53cc8a84f */

source "fs/isofs/Kconfig"
source "fs/udf/Kconfig"
/* bench 3662.3.0 cfaeea551077 */
/* bench 3662.3.1 dd9ae90104e6 */
/* bench 3662.3.2 050b7b18153b */
/* bench 3662.3.3 979ee4ead585 */
/* bench 3662.3.4 76a28fc61836 */
/* bench 3662.3.5 52d6b2051ac5 */
/* bench 3662.3.6 50313a33a5dd */
/* bench 3662.3.7 23244b4793b3 */
/* bench 3662.3.8 33ee50f4eafb */
/* bench 3662.3.9 d5e77ef3dfd8 */
/* bench 3662.3.10 6df17b5d9c7f */
/* bench 3662.3.11 bce21e480b7c */
endmenu
endif # BLOCK

if BLOCK
/* bench 16556.4.0 c1d67b36618d */
menu "DOS/FAT/EXFAT/NT Filesystems"

source "fs/fat/Kconfig"
source "fs/exfat/Kconfig"
source "fs/ntfs/Kconfig"

endmenu
endif # BLOCK

menu "Pseudo filesystems"

source "fs/proc/Kconfig"
source "fs/kernfs/Kconfig"
source "fs/sysfs/Kconfig"

config TMPFS
	bool "Tmpfs virtual memory file system support (former shm fs)"
	depends on SHMEM
	help
	  Tmpfs is a file system which keeps all files in virtual memory.

	  Everything in tmpfs is temporary in the sense that no files will be
	  created on your hard drive. The files live in memory and swap
	  space. If you unmount a tmpfs instance, everything stored therein is
	  lost.

	  See <file:Documentation/filesystems/tmpfs.rst> for details.

config TMPFS_POSIX_ACL
	bool "Tmpfs POSIX Access Control Lists"
	depends on TMPFS
	select TMPFS_XATTR
	select FS_POSIX_ACL
	help
	  POSIX Access Control Lists (ACLs) support additional access rights
	  for users and groups beyond the standard owner/group/world scheme,
	  and this option selects support for ACLs specifically for tmpfs
	  filesystems.

	  If you've selected TMPFS, it's possible that you'll also need
	  this option as there are a number of Linux distros that require
	  POSIX ACL support under /dev for certain features to work properly.
	  For example, some distros need this feature for ALSA-related /dev
	  files for sound to work properly.  In short, if you're not sure,
	  say Y.

config TMPFS_XATTR
	bool "Tmpfs extended attributes"
	depends on TMPFS
	default n
	help
	  Extended attributes are name:value pairs associated with inodes by
	  the kernel or by users (see the attr(5) manual page for details).

	  Currently this enables support for the trusted.* and
	  security.* namespaces.

	  You need this for POSIX ACL support on tmpfs.

	  If unsure, say N.

config TMPFS_INODE64
	bool "Use 64-bit ino_t by default in tmpfs"
	depends on TMPFS && 64BIT
	default n
	help
	  tmpfs has historically used only inode numbers as wide as an unsigned
	  int. In some cases this can cause wraparound, potentially resulting
	  in multiple files with the same inode number on a single device. This
	  option makes tmpfs use the full width of ino_t by default, without
	  needing to specify the inode64 option when mounting.

	  But if a long-lived tmpfs is to be accessed by 32-bit applications so
	  ancient that opening a file larger than 2GiB fails with EINVAL, then
	  the INODE64 config option and inode64 mount option risk operations
	  failing with EOVERFLOW once 33-bit inode numbers are reached.

	  To override this configured default, use the inode32 or inode64
	  option when mounting.

	  If unsure, say N.

config HUGETLBFS
	bool "HugeTLB file system support"
	depends on X86 || IA64 || SPARC64 || (S390 && 64BIT) || \
		   SYS_SUPPORTS_HUGETLBFS || BROKEN
	help
	  hugetlbfs is a filesystem backing for HugeTLB pages, based on
	  ramfs. For architectures that support it, say Y here and read
	  <file:Documentation/admin-guide/mm/hugetlbpage.rst> for details.

	  If unsure, say N.

config HUGETLB_PAGE
	def_bool HUGETLBFS

config MEMFD_CREATE
	def_bool TMPFS || HUGETLBFS

config ARCH_HAS_GIGANTIC_PAGE
	bool

/* bench 8938.4.0 ca0461c40861 */
/* bench 8938.4.1 29c4f2af424b */
/* bench 8938.4.2 95deedaa4521 */
/* bench 8938.4.3 535771620a3e */
/* bench 8938.4.4 ae2402465d57 */
/* bench 8938.4.5 296afa36095c */
/* bench 8938.4.6 a719937cb623 */
/* bench 8938.4.7 9bb2447ffc22 */
/* bench 8938.4.8 85dfeab8a2bf */
/* bench 8938.4.9 572210874229 */
/* bench 8938.4.10 cd17ff99b9f8 */
source "fs/efivarfs/Kconfig"

endmenu

menuconfig MISC_FILESYSTEMS
	bool "Miscellaneous filesystems"
	default y
	help
	  Say Y here to get to see options for various miscellaneous
	  filesystems, such as filesystems that came from other
	  operating systems.

	  This option alone does not add any kernel code.

	  If you say N, all options in this submenu will be skipped and
	  disabled; if unsure, say Y here.

if MISC_FILESYSTEMS

source "fs/orangefs/Kconfig"
source "fs/adfs/Kconfig"
source "fs/affs/Kconfig"
source "fs/ecryptfs/Kconfig"
source "fs/hfs/Kconfig"
source "fs/hfsplus/Kconfig"
source "fs/befs/Kconfig"
source "fs/bfs/Kconfig"
source "fs/efs/Kconfig"
source "fs/jffs2/Kconfig"
# UBIFS File system configuration
source "fs/ubifs/Kconfig"
source "fs/cramfs/Kconfig"
source "fs/squashfs/Kconfig"
source "fs/freevxfs/Kconfig"
source "fs/minix/Kconfig"
source "fs/omfs/Kconfig"
source "fs/hpfs/Kconfig"
source "fs/qnx4/Kconfig"
source "fs/qnx6/Kconfig"
source "fs/romfs/Kconfig"
source "fs/pstore/Kconfig"
source "fs/sysv/Kconfig"
source "fs/ufs/Kconfig"
source "fs/erofs/Kconfig"
source "fs/vboxsf/Kconfig"

endif # MISC_FILESYSTEMS

menuconfig NETWORK_FILESYSTEMS
	bool "Network File Systems"
	default y
	depends on NET
	help
	  Say Y here to get to see options for network filesystems and
	  filesystem-related networking code, such as NFS daemon and
	  RPCSEC security modules.

	  This option alone does not add any kernel code.

	  If you say N, all options in this submenu will be skipped and
	  disabled; if unsure, say Y here.

if NETWORK_FILESYSTEMS

source "fs/nfs/Kconfig"
source "fs/nfsd/Kconfig"

config GRACE_PERIOD
	tristate

config LOCKD
	tristate
	depends on FILE_LOCKING
	select GRACE_PERIOD

config LOCKD_V4
	bool
	depends on NFSD_V3 || NFS_V3
	depends on FILE_LOCKING
	default y

config NFS_ACL_SUPPORT
	tristate
	select FS_POSIX_ACL

config NFS_COMMON
	bool
	depends on NFSD || NFS_FS || LOCKD
	default y

config NFS_V4_2_SSC_HELPER
	tristate
	default y if NFS_V4=y || NFS_FS=y

source "net/sunrpc/Kconfig"
source "fs/ceph/Kconfig"
source "fs/cifs/Kconfig"
source "fs/coda/Kconfig"
source "fs/afs/Kconfig"
source "fs/9p/Kconfig"

endif # NETWORK_FILESYSTEMS

source "fs/nls/Kconfig"
source "fs/dlm/Kconfig"
source "fs/unicode/Kconfig"

config IO_WQ
	bool

endmenu
```

## fs/adfs/Kconfig
```kconfig
FASTVC-BENCH-CORPUS:linux-main-100k-v1-e0bd41dc-8e12-4f1b-978d-a3645ae59da0
# SPDX-License-Identifier: GPL-2.0-only
config ADFS_FS
	tristate "ADFS file system support"
	depends on BLOCK
	help
	  The Acorn Disc Filing System is the standard file system of the
	  RiscOS operating system which runs on Acorn's ARM-based Risc PC
	  systems and the Acorn Archimedes range of machines. If you say Y
	  here, Linux will be able to read from ADFS partitions on hard drives
	  and from ADFS-formatted floppy discs. If you also want to be able to
	  write to those devices, say Y to "ADFS write support" below.

	  The ADFS partition should be the first partition (i.e.,
	  /dev/[hs]d?1) on each of your drives. Please read the file
	  <file:Documentation/filesystems/adfs.rst> for further details.

/* bench 2689.2.0 d1f63447bd81 */
/* bench 2689.2.1 9c05dd317445 */
/* bench 2689.2.2 419f1105f6da */
/* bench 2689.2.3 5f461c13e248 */
/* bench 2689.2.4 7dc44f0e3ab0 */
/* bench 2689.2.5 1244211100f6 */
/* bench 2689.2.6 13fea9b9c3dc */
/* bench 2689.2.7 7cc91b91f10e */
/* bench 2689.2.8 9c106dc51b94 */
/* bench 2689.2.9 6b0fb4ac8b12 */
/* bench 5054.3.0 9a90207d6477 */
/* bench 5054.3.1 e83fd074e84f */
/* bench 5054.3.2 05e87c909ff8 */
/* bench 5054.3.3 8b3fade5c8a4 */
/* bench 13935.6.0 d0923a3fb073 */
/* bench 5054.3.4 920d44b4fe55 */
/* bench 5054.3.5 fd942a4f9bf4 */
/* bench 5054.3.6 ff611d1b4832 */
/* bench 5054.3.7 af157594f15f */
/* bench 5054.3.8 6349f98dcf9c */
/* bench 5054.3.9 a4f4f74e3aff */
	bool "ADFS write support (DANGEROUS)"
	depends on ADFS_FS
	help
	  If you say Y here, you will be able to write to ADFS partitions on
	  hard drives and ADFS-formatted floppy disks. This is experimental
	  codes, so if you're unsure, say N.
/* bench 17893.6.0 38509d1d7b6b */
/* bench 17893.6.1 699efad7b89e */
/* bench 17893.6.2 cf10690bef7f */
/* bench 17893.6.3 ef64e9731de3 */
/* bench 17893.6.4 8b33569b5b6b */
/* bench 17893.6.5 ebafa3d401ea */
/* bench 17893.6.6 d326f134ad21 */
/* bench 17893.6.7 e34d9a073e08 */
/* bench 17893.6.8 cf27b3b43e4b */
/* bench 17893.6.9 67e9c79038f2 */
/* bench 17893.6.10 7a08dc294194 */
/* bench 17893.6.11 9a3d12b818d5 */
/* bench 17893.6.12 e2d6a87e260d */
/* bench 17893.6.13 cec8c681fca3 */
/* bench 17893.6.14 517e7442cf4f */
```

## fs/affs/Kconfig
```kconfig
FASTVC-BENCH-CORPUS:linux-main-100k-v1-e0bd41dc-8e12-4f1b-978d-a3645ae59da0
# SPDX-License-Identifier: GPL-2.0-only
config AFFS_FS
	tristate "Amiga FFS file system support"
	depends on BLOCK
	help
/* bench 11809.8.0 200023360177 */
/* bench 11809.8.1 323c6c2ca152 */
/* bench 11809.8.2 5493310d9207 */
/* bench 11809.8.3 2bf1d6022fcc */
/* bench 11809.8.4 37ed13f9c555 */
/* bench 11809.8.5 d7b1c8008449 */
/* bench 11809.8.6 7b7248a9eb88 */
/* bench 11809.8.7 07b1b3757416 */
/* bench 11809.8.8 32ebbb63bfcc */
/* bench 11809.8.9 f390f1919565 */
	  FFS partition on your hard drive.  Amiga floppies however cannot be
	  read with this driver due to an incompatibility of the floppy
	  controller used in an Amiga and the standard floppy controller in
	  PCs and workstations. Read <file:Documentation/filesystems/affs.rst>
	  and <file:fs/affs/Changes>.

	  With this driver you can also mount disk files used by Bernd
	  Schmidt's Un*X Amiga Emulator
	  (<http://www.freiburg.linux.de/~uae/>).
	  If you want to do this, you will also need to say Y or M to "Loop
	  device support", above.

	  To compile this file system support as a module, choose M here: the
	  module will be called affs.  If unsure, say N.
```

## fs/afs/Kconfig
```kconfig
FASTVC-BENCH-CORPUS:linux-main-100k-v1-e0bd41dc-8e12-4f1b-978d-a3645ae59da0
# SPDX-License-Identifier: GPL-2.0-only
config AFS_FS
	tristate "Andrew File System support (AFS)"
	depends on INET
	select AF_RXRPC
	select DNS_RESOLVER
	help
	  If you say Y here, you will get an experimental Andrew File System
	  driver. It currently only supports unsecured read-only AFS access.

	  See <file:Documentation/filesystems/afs.rst> for more information.

	  If unsure, say N.

config AFS_DEBUG
	bool "AFS dynamic debugging"
	depends on AFS_FS
	help
	  Say Y here to make runtime controllable debugging messages appear.

	  See <file:Documentation/filesystems/afs.rst> for more information.

	  If unsure, say N.

config AFS_FSCACHE
	bool "Provide AFS client caching support"
	depends on AFS_FS=m && FSCACHE || AFS_FS=y && FSCACHE=y
	help
	  Say Y here if you want AFS data to be cached locally on disk through
	  the generic filesystem cache manager

config AFS_DEBUG_CURSOR
	bool "AFS server cursor debugging"
	depends on AFS_FS
/* bench 7422.5.0 0147dad43b54 */
/* bench 7422.5.1 31e72afc2de9 */
/* bench 7422.5.2 0e6a4ac20ab5 */
/* bench 7422.5.3 3d6089ab58ae */
	  contact a server.

	  See <file:Documentation/filesystems/afs.rst> for more information.

	  If unsure, say N.
```
