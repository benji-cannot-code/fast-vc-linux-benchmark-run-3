## drivers/staging/mt7621-pinctrl/Kconfig
```kconfig
FASTVC-BENCH-CORPUS:linux-main-100k-v1-e0bd41dc-8e12-4f1b-978d-a3645ae59da0
# SPDX-License-Identifier: GPL-2.0
config PINCTRL_RT2880
	bool "RT2800 pinctrl driver for RALINK/Mediatek SOCs"
	depends on RALINK
	select PINMUX
	select GENERIC_PINCONF
```

## drivers/staging/mt7621-spi/Kconfig
```kconfig
FASTVC-BENCH-CORPUS:linux-main-100k-v1-e0bd41dc-8e12-4f1b-978d-a3645ae59da0
config SPI_MT7621
	tristate "MediaTek MT7621 SPI Controller"
	depends on RALINK
	help
	  This selects a driver for the MediaTek MT7621 SPI Controller.
```

## drivers/staging/netwave/Kconfig
```kconfig
FASTVC-BENCH-CORPUS:linux-main-100k-v1-e0bd41dc-8e12-4f1b-978d-a3645ae59da0
config PCMCIA_NETWAVE
	tristate "Xircom Netwave AirSurfer Pcmcia wireless support"
	depends on PCMCIA && WLAN
	select WIRELESS_EXT
	select WEXT_PRIV
	help
	  Say Y here if you intend to attach this type of PCMCIA (PC-card)
	  wireless Ethernet networking card to your computer.

	  To compile this driver as a module, choose M here: the module will be
	  called netwave_cs.  If unsure, say N.
```

## drivers/staging/nokia_h4p/Kconfig
```kconfig
FASTVC-BENCH-CORPUS:linux-main-100k-v1-e0bd41dc-8e12-4f1b-978d-a3645ae59da0
config BT_NOKIA_H4P
	tristate "HCI driver with H4 Nokia extensions"
	depends on BT && ARCH_OMAP
	help
	  Bluetooth HCI driver with H4 extensions.  This driver provides
	  support for H4+ Bluetooth chip with vendor-specific H4 extensions.

	  Say Y here to compile support for h4 extended devices into the kernel
	  or say M to compile it as module (btnokia_h4p).
```

## drivers/staging/nvec/Kconfig
```kconfig
FASTVC-BENCH-CORPUS:linux-main-100k-v1-e0bd41dc-8e12-4f1b-978d-a3645ae59da0
# SPDX-License-Identifier: GPL-2.0
config MFD_NVEC
	tristate "NV Tegra Embedded Controller SMBus Interface"
	depends on I2C && GPIOLIB && ARCH_TEGRA
	select MFD_CORE
	help
	    Say Y here to enable support for a nVidia compliant embedded
	    controller.

	    To compile this driver as a module, say M here: the module will be
	    called mfd-nvec

config KEYBOARD_NVEC
	tristate "Keyboard on nVidia compliant EC"
	depends on MFD_NVEC && INPUT
	help
	  Say Y here to enable support for a keyboard connected to
	  a nVidia compliant embedded controller.

	  To compile this driver as a module, say M here: the module will be
	  called keyboard-nvec

config SERIO_NVEC_PS2
	tristate "PS2 on nVidia EC"
	depends on MFD_NVEC && SERIO
	help
/* bench 17696.4.0 43937980a151 */
/* bench 17696.4.1 2e4039d1b20c */
/* bench 17696.4.2 da9ae9eb9c7a */
/* bench 17696.4.3 1b3208dbb7b1 */
/* bench 17696.4.4 9adacbb8e5d8 */
/* bench 17696.4.5 0f73db16506d */

	  To compile this driver as a module, say M here: the module will be
	  called serio-nvec-ps2


config NVEC_POWER
	tristate "NVEC charger and battery"
	depends on MFD_NVEC && POWER_SUPPLY
	help
	  Say Y to enable support for battery and charger interface for
	  nVidia compliant embedded controllers.

	  To compile this driver as a module, say M here: the module will be
	  called nvec-power


config NVEC_PAZ00
	tristate "Support for OEM specific functions on Compal PAZ00 based devices"
	depends on MFD_NVEC && LEDS_CLASS
	help
/* bench 6305.3.0 ea3498e91f6f */
/* bench 6305.3.1 f212fb218814 */
/* bench 6305.3.2 521457423591 */
/* bench 6305.3.3 6598606b974f */
/* bench 6305.3.4 51362ee8b8c8 */
/* bench 6305.3.5 4e859df0afe3 */
/* bench 6305.3.6 ab66adf2c33b */
/* bench 6305.3.7 04c6e879b8ba */
/* bench 6305.3.8 eccbf678175a */
	  To compile this driver as a module, say M here: the module will be
	  called nvec-paz00
```

## drivers/staging/octeon-usb/Kconfig
```kconfig
FASTVC-BENCH-CORPUS:linux-main-100k-v1-e0bd41dc-8e12-4f1b-978d-a3645ae59da0
/* bench 23681.5.0 7730d247aaf4 */
/* bench 23681.5.1 8bcc6a596f95 */
/* bench 14380.3.2 a3c94b1ffe2b */
/* bench 14380.3.3 ed6c801f0fe9 */
/* bench 14380.3.4 8baf8025e3fc */
/* bench 14380.3.5 53e93bc47330 */
/* bench 14380.3.6 4355fa10f03a */
/* bench 14380.3.7 835799f780ab */
/* bench 14380.3.8 6b979d2d4ea7 */
/* bench 14380.3.9 f22f36d97cf5 */
config OCTEON_USB
	tristate "Cavium Networks Octeon USB support"
	depends on CAVIUM_OCTEON_SOC && USB
	help
	  This driver supports USB host controller on some Cavium
	  Networks' products in the Octeon family.

	  To compile this driver as a module, choose M here. The module
	  will be called octeon-hcd.
```

## drivers/staging/octeon/Kconfig
```kconfig
FASTVC-BENCH-CORPUS:linux-main-100k-v1-e0bd41dc-8e12-4f1b-978d-a3645ae59da0
# SPDX-License-Identifier: GPL-2.0
config OCTEON_ETHERNET
	tristate "Cavium Networks Octeon Ethernet support"
	depends on CAVIUM_OCTEON_SOC || COMPILE_TEST
	depends on NETDEVICES
	select PHYLIB
	select MDIO_OCTEON
/* bench 19748.4.0 87d0e2682c1f */
/* bench 19748.4.1 f934f33cce1a */
/* bench 19748.4.2 589a7a338c6d */
/* bench 19748.4.3 976e516c0739 */
/* bench 19748.4.4 c42565cbacb0 */
/* bench 19748.4.5 f62e38bf92ee */
	  CN3XXX and CN5XXX Octeon processors.

	  To compile this driver as a module, choose M here.  The module
	  will be called octeon-ethernet.
```

## drivers/staging/ozwpan/Kconfig
```kconfig
FASTVC-BENCH-CORPUS:linux-main-100k-v1-e0bd41dc-8e12-4f1b-978d-a3645ae59da0
config USB_WPAN_HCD
	tristate "USB over WiFi Host Controller"
	depends on USB && NET
	help
	  A driver for USB Host Controllers that are compatible with
	  Ozmo Devices USB over WiFi technology.

	  To compile this driver a module, choose M here: the module
	  will be called "ozwpan".
```

## drivers/staging/p9auth/Kconfig
```kconfig
FASTVC-BENCH-CORPUS:linux-main-100k-v1-e0bd41dc-8e12-4f1b-978d-a3645ae59da0
config PLAN9AUTH
	tristate "Plan 9 style capability device implementation"
	default n
	depends on CRYPTO
	help
	  This module implements the Plan 9 style capability device.

	  To compile this driver as a module, choose
	  M here: the module will be called p9auth.
```

## drivers/staging/pcc-acpi/Kconfig
```kconfig
FASTVC-BENCH-CORPUS:linux-main-100k-v1-e0bd41dc-8e12-4f1b-978d-a3645ae59da0
config PCC_ACPI
	tristate "Panasonic ACPI Hotkey support"
	depends on ACPI
	default n
	---help---
	  This driver provides support for Panasonic hotkeys through the
	  ACPI interface.  This works for the Panasonic R1 (N variant),
	  R2, R3, T2, W2, and Y2 laptops.

	  To compile this driver as a module, choose M here. The module
	  will be called pcc-acpi.
```

## drivers/staging/phison/Kconfig
```kconfig
FASTVC-BENCH-CORPUS:linux-main-100k-v1-e0bd41dc-8e12-4f1b-978d-a3645ae59da0
config IDE_PHISON
	tristate "PCIE ATA PS5000 IDE support"
	depends on PCI && ATA && ATA_SFF
	---help---
	  This is an experimental driver for PS5000 IDE driver.
```

## drivers/staging/pi433/Kconfig
```kconfig
FASTVC-BENCH-CORPUS:linux-main-100k-v1-e0bd41dc-8e12-4f1b-978d-a3645ae59da0
# SPDX-License-Identifier: GPL-2.0
config PI433
	tristate "Pi433 - a 433MHz radio module for Raspberry Pi"
	depends on SPI
	help
	  This option allows you to enable support for the radio module Pi433.
/* bench 22594.5.0 744158af017a */
/* bench 22594.5.1 b588e9a1f180 */
/* bench 22594.5.2 4a27b418366e */
/* bench 22594.5.3 cb83c2e31fe6 */
/* bench 22594.5.4 f337371107a9 */
	  or compatible. It extends the Raspberry Pi with the option, to
	  send and receive data in the 433MHz ISM band - for example to
	  communicate between two systems without using ethernet or bluetooth
	  or for control or read sockets, actors, sensors, widely available
	  for low price.

	  For details or the option to buy, please visit https://pi433.de/en.html

	  If in doubt, say N here, but saying yes most probably won't hurt
```

## drivers/staging/poch/Kconfig
```kconfig
FASTVC-BENCH-CORPUS:linux-main-100k-v1-e0bd41dc-8e12-4f1b-978d-a3645ae59da0
config POCH
	tristate "Redrapids Pocket Change CardBus support"
	depends on PCI && UIO
	default N
	---help---
	  Enable support for Redrapids Pocket Change CardBus devices.
```

## drivers/staging/qlge/Kconfig
```kconfig
FASTVC-BENCH-CORPUS:linux-main-100k-v1-e0bd41dc-8e12-4f1b-978d-a3645ae59da0
# SPDX-License-Identifier: GPL-2.0

config QLGE
/* bench 21549.4.0 0d1b3f0547f1 */
/* bench 21549.4.1 9f059db603d3 */
/* bench 21549.4.2 41d08766fb93 */
/* bench 21549.4.3 8420e4058a78 */
/* bench 21549.4.4 d08c4908b46a */
/* bench 21549.4.5 683c8ebf467e */
/* bench 21549.4.6 71975f917587 */
/* bench 21549.4.7 9951ef5c68f2 */
/* bench 21549.4.8 e9438a1b4def */
/* bench 21549.4.9 493383c11d71 */
	help
	This driver supports QLogic ISP8XXX 10Gb Ethernet cards.

	To compile this driver as a module, choose M here. The module will be
	called qlge.
```

## drivers/staging/quickstart/Kconfig
```kconfig
FASTVC-BENCH-CORPUS:linux-main-100k-v1-e0bd41dc-8e12-4f1b-978d-a3645ae59da0
config ACPI_QUICKSTART
	tristate "ACPI Quickstart key driver"
	depends on ACPI && INPUT
	help
	  Say Y here if you have a platform that supports the ACPI
	  quickstart key protocol.

	  To compile this driver as a module, choose M here: the module will be
	  called quickstart.
```

## drivers/staging/ralink-gdma/Kconfig
```kconfig
FASTVC-BENCH-CORPUS:linux-main-100k-v1-e0bd41dc-8e12-4f1b-978d-a3645ae59da0
# SPDX-License-Identifier: GPL-2.0
config DMA_RALINK
	tristate "RALINK DMA support"
	depends on RALINK && !SOC_RT288X
/* bench 15605.4.0 358f098aa27e */
/* bench 15605.4.1 340e54527036 */
/* bench 15605.4.2 6270bccf7a43 */
/* bench 19900.4.0 066187cbc6d9 */
/* bench 19900.4.1 a78ab332921f */
/* bench 19900.4.2 6def284eeb97 */
/* bench 19900.4.3 bec4976180f2 */
/* bench 9759.1.0 c25453b8467e */
/* bench 9759.1.1 ebb917105ab8 */
/* bench 26961.4.0 cc75b793dc73 */
/* bench 26961.4.1 6008f6aab8be */
/* bench 26961.4.2 48d6bf5223b6 */
/* bench 26961.4.3 c029f44d622f */
/* bench 26961.4.4 39f0db14ffbb */
/* bench 9759.1.4 5535ae184b0c */
/* bench 9759.1.5 b6caf3b5858b */
	select DMA_VIRTUAL_CHANNELS
```

## drivers/staging/ramster/Kconfig
```kconfig
FASTVC-BENCH-CORPUS:linux-main-100k-v1-e0bd41dc-8e12-4f1b-978d-a3645ae59da0
config RAMSTER
	bool "Cross-machine RAM capacity sharing, aka peer-to-peer tmem"
	depends on (CLEANCACHE || FRONTSWAP) && CONFIGFS_FS=y && !ZCACHE && CRYPTO=y && !HIGHMEM && NET
	select ZSMALLOC
	select CRYPTO_LZO
	default n
	help
	  RAMster allows RAM on other machines in a cluster to be utilized
	  dynamically and symmetrically instead of swapping to a local swap
	  disk, thus improving performance on memory-constrained workloads
	  while minimizing total RAM across the cluster.  RAMster, like
	  zcache, compresses swap pages into local RAM, but then remotifies
	  the compressed pages to another node in the RAMster cluster.
```

## drivers/staging/ramzswap/Kconfig
```kconfig
FASTVC-BENCH-CORPUS:linux-main-100k-v1-e0bd41dc-8e12-4f1b-978d-a3645ae59da0
config RAMZSWAP
	tristate "Compressed in-memory swap device (ramzswap)"
	depends on SWAP
	select LZO_COMPRESS
	select LZO_DECOMPRESS
	default n
	help
	  Creates virtual block devices which can be used (only) as a swap
	  disks. Pages swapped to these disks are compressed and stored in
	  memory itself.

	  See ramzswap.txt for more information.
	  Project home: http://compcache.googlecode.com/

config RAMZSWAP_STATS
	bool "Enable ramzswap stats"
	depends on RAMZSWAP
	default y
	help
	  Enable statistics collection for ramzswap. This adds only a minimal
	  overhead. In unsure, say Y.
```

## drivers/staging/rar/Kconfig
```kconfig
FASTVC-BENCH-CORPUS:linux-main-100k-v1-e0bd41dc-8e12-4f1b-978d-a3645ae59da0
#
# RAR device configuration
#

menu "RAR Register Driver"
#
#	Restricted Access Register Manager
#
config RAR_REGISTER
	tristate "Restricted Access Region Register Driver"
	default n
	---help---
		This driver allows other kernel drivers access to the
		contents of the restricted access region control
		registers.

endmenu
```

## drivers/staging/rdma/ehca/Kconfig
```kconfig
FASTVC-BENCH-CORPUS:linux-main-100k-v1-e0bd41dc-8e12-4f1b-978d-a3645ae59da0
config INFINIBAND_EHCA
	tristate "eHCA support"
	depends on IBMEBUS
	---help---
	This driver supports the deprecated IBM pSeries eHCA InfiniBand
	adapter.

	To compile the driver as a module, choose M here. The module
	will be called ib_ehca.
```

## drivers/staging/rdma/ipath/Kconfig
```kconfig
FASTVC-BENCH-CORPUS:linux-main-100k-v1-e0bd41dc-8e12-4f1b-978d-a3645ae59da0
config INFINIBAND_IPATH
	tristate "QLogic HTX HCA support"
	depends on 64BIT && NET && HT_IRQ
	---help---
	This is a driver for the deprecated QLogic Hyper-Transport
	IB host channel adapter (model QHT7140),
	including InfiniBand verbs support.  This driver allows these
	devices to be used with both kernel upper level protocols such
	as IP-over-InfiniBand as well as with userspace applications
	(in conjunction with InfiniBand userspace access).
	For QLogic PCIe QLE based cards, use the QIB driver instead.

	If you have this hardware you will need to boot with PAT disabled
	on your x86-64 systems, use the nopat kernel parameter.

	Note that this driver will soon be removed entirely from the kernel.
```

## drivers/staging/rspiusb/Kconfig
```kconfig
FASTVC-BENCH-CORPUS:linux-main-100k-v1-e0bd41dc-8e12-4f1b-978d-a3645ae59da0
config USB_RSPI
	tristate "Princeton Instruments USB camera support"
	default n
	depends on USB && BROKEN
	help
	  This driver is for the Princeton Instruments USB camera device.
```

## drivers/staging/rt2860/Kconfig
```kconfig
FASTVC-BENCH-CORPUS:linux-main-100k-v1-e0bd41dc-8e12-4f1b-978d-a3645ae59da0
config RT2860
	tristate "Ralink 2860/3090 wireless support"
	depends on PCI && X86 && WLAN
	select WIRELESS_EXT
	select WEXT_PRIV
	---help---
	  This is an experimental driver for the Ralink 2860 and 3090
	  wireless chips.
```
