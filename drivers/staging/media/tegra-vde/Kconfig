## drivers/staging/media/tegra-vde/Kconfig
```kconfig
FASTVC-BENCH-CORPUS:linux-main-100k-v1-e0bd41dc-8e12-4f1b-978d-a3645ae59da0
# SPDX-License-Identifier: GPL-2.0
config TEGRA_VDE
	tristate "NVIDIA Tegra Video Decoder Engine driver"
	depends on ARCH_TEGRA || COMPILE_TEST
/* bench 1062.1.0 1d34f2fe24ae */
/* bench 1062.1.1 5fd3fd68d2c6 */
/* bench 26403.6.0 729e55e80155 */
/* bench 26403.6.1 64d0c63bab9b */
/* bench 26403.6.2 9b97bc1699f3 */
/* bench 26403.6.3 4efc2fdfc8a7 */
/* bench 26403.6.4 bdefbc988457 */
/* bench 26403.6.5 36d4efa46122 */
/* bench 26403.6.6 ad949ad9abab */
/* bench 26403.6.7 44e34229e6c6 */
/* bench 26403.6.8 85f3851c35db */
/* bench 26403.6.9 6261f2e1fdc7 */
/* bench 26403.6.10 f9e293b4a58f */
/* bench 26403.6.11 7f1df2d5e7b1 */
/* bench 26403.6.12 ac806a7e2f98 */
/* bench 26403.6.13 03d850c59967 */
/* bench 21127.5.1 d7bca3ad3320 */
/* bench 21127.5.2 f73f29837b30 */
/* bench 21127.5.3 4b4cf5615542 */
/* bench 21127.5.4 44094dcb9127 */
/* bench 21127.5.5 9ac11355a9c5 */
/* bench 21127.5.6 00ba1c813d28 */
/* bench 21127.5.7 bd3f52615568 */
/* bench 21127.5.8 3fc3c2acfcf2 */
/* bench 1062.1.4 431263441110 */
/* bench 1062.1.5 88147689b951 */
/* bench 1062.1.6 399f619b56bc */
/* bench 1062.1.7 a252c1b7377a */
	select SRAM
	help
	    Say Y here to enable support for the NVIDIA Tegra video decoder
	    driver.
```

## drivers/staging/media/tegra-video/Kconfig
```kconfig
FASTVC-BENCH-CORPUS:linux-main-100k-v1-e0bd41dc-8e12-4f1b-978d-a3645ae59da0
# SPDX-License-Identifier: GPL-2.0-only
config VIDEO_TEGRA
	tristate "NVIDIA Tegra VI driver"
	depends on TEGRA_HOST1X
	depends on VIDEO_V4L2
	select MEDIA_CONTROLLER
	select VIDEOBUF2_DMA_CONTIG
/* bench 25531.0.0 2b239dc32ac0 */
/* bench 25531.0.1 8b6e60f3051e */
/* bench 25531.0.2 588d96721657 */
/* bench 25531.0.3 cceb3c1da1e3 */

	  To compile this driver as a module, choose M here: the module
	  will be called tegra-video.

config VIDEO_TEGRA_TPG
	bool "NVIDIA Tegra VI driver TPG mode"
	depends on VIDEO_TEGRA
	help
	  Say yes here to enable Tegra internal TPG mode
```

## drivers/staging/mimio/Kconfig
```kconfig
FASTVC-BENCH-CORPUS:linux-main-100k-v1-e0bd41dc-8e12-4f1b-978d-a3645ae59da0
config INPUT_MIMIO
	tristate "Mimio Xi interactive whiteboard support"
	depends on USB && INPUT
	default N
	help
	  Say Y here if you want to use a Mimio Xi interactive
	  whiteboard device.

	  To compile this driver as a module, choose M here: the
	  module will be called mimio.
```

## drivers/staging/most/Kconfig
```kconfig
FASTVC-BENCH-CORPUS:linux-main-100k-v1-e0bd41dc-8e12-4f1b-978d-a3645ae59da0
# SPDX-License-Identifier: GPL-2.0
menuconfig MOST_COMPONENTS
	tristate "MOST support"
	depends on HAS_DMA && CONFIGFS_FS && MOST
	default n
	help
	  Say Y here if you want to enable MOST support.
	  This driver needs at least one additional component to enable the
	  desired access from userspace (e.g. character devices) and one that
	  matches the network controller's hardware interface (e.g. USB).

/* bench 23241.4.0 91f5c47f1fae */
/* bench 23241.4.1 d73e3b87804d */
/* bench 23241.4.2 704ecc9b6340 */
/* bench 23241.4.3 a48d1962d47a */
/* bench 23241.4.4 d4ae2fe665ee */
	  module will be called most_core.

	  If in doubt, say N here.



/* bench 1418.6.0 1086f6c74bc6 */
/* bench 1418.6.1 8f9f85e9caab */

source "drivers/staging/most/net/Kconfig"

source "drivers/staging/most/video/Kconfig"

source "drivers/staging/most/dim2/Kconfig"

source "drivers/staging/most/i2c/Kconfig"

endif
```

## drivers/staging/most/aim-cdev/Kconfig
```kconfig
FASTVC-BENCH-CORPUS:linux-main-100k-v1-e0bd41dc-8e12-4f1b-978d-a3645ae59da0
#
# MOST Cdev configuration
#

config AIM_CDEV
	tristate "Cdev AIM"

	---help---
	  Say Y here if you want to commumicate via character devices.

	  To compile this driver as a module, choose M here: the
	  module will be called aim_cdev.
```

## drivers/staging/most/aim-sound/Kconfig
```kconfig
FASTVC-BENCH-CORPUS:linux-main-100k-v1-e0bd41dc-8e12-4f1b-978d-a3645ae59da0
#
# MOST ALSA configuration
#

config AIM_SOUND
	tristate "ALSA AIM"
	depends on SND
	---help---
	  Say Y here if you want to commumicate via ALSA/sound devices.

	  To compile this driver as a module, choose M here: the
	  module will be called aim_sound.
```

## drivers/staging/most/aim-v4l2/Kconfig
```kconfig
FASTVC-BENCH-CORPUS:linux-main-100k-v1-e0bd41dc-8e12-4f1b-978d-a3645ae59da0
#
# MOST V4L2 configuration
#

config AIM_V4L2
	tristate "V4L2 AIM"
	depends on VIDEO_V4L2
	---help---
	  Say Y here if you want to commumicate via Video 4 Linux.

	  To compile this driver as a module, choose M here: the
	  module will be called aim_v4l2.
```

## drivers/staging/most/cdev/Kconfig
```kconfig
FASTVC-BENCH-CORPUS:linux-main-100k-v1-e0bd41dc-8e12-4f1b-978d-a3645ae59da0
# SPDX-License-Identifier: GPL-2.0
#
# MOST Cdev configuration
#

config MOST_CDEV
	tristate "Cdev"

	help
	  Say Y here if you want to commumicate via character devices.

	  To compile this driver as a module, choose M here: the
	  module will be called most_cdev.
```

## drivers/staging/most/dim2/Kconfig
```kconfig
FASTVC-BENCH-CORPUS:linux-main-100k-v1-e0bd41dc-8e12-4f1b-978d-a3645ae59da0
/* bench 17376.2.0 f00615db0aae */
/* bench 17376.2.1 2ed3795ab5d1 */
/* bench 17376.2.2 46cb1a0ff7d8 */
/* bench 17376.2.3 8f36377ca1ab */
/* bench 17376.2.4 341018fe200d */
/* bench 17376.2.5 53bac4f35cc6 */
/* bench 17376.2.6 d95284902b08 */
/* bench 17376.2.7 056d3106422b */
/* bench 17376.2.8 c33dcda5ee1f */
/* bench 17376.2.9 131779ce4dfb */
/* bench 17376.2.10 aff3ddc86579 */
/* bench 17376.2.11 aca845fcc226 */
/* bench 17376.2.12 7e3f5f46eb86 */
/* bench 17376.2.13 17200561d47f */
# SPDX-License-Identifier: GPL-2.0
#
# MediaLB configuration
#

config MOST_DIM2
	tristate "DIM2"
	depends on HAS_IOMEM && OF

	help
	  Say Y here if you want to connect via MediaLB to network transceiver.
	  This device driver is platform dependent and needs an additional
	  platform driver to be installed. For more information contact
	  maintainer of this driver.

	  To compile this driver as a module, choose M here: the
	  module will be called most_dim2.
/* bench 18752.4.0 5ab68f85bc6c */
/* bench 18752.4.1 6558eff29604 */
/* bench 18752.4.2 933ab67f8870 */
/* bench 18752.4.3 019561ee4768 */
/* bench 18752.4.4 1d208db47241 */
/* bench 18752.4.5 640511b45cea */
/* bench 18752.4.6 f0d6bdb75c7f */
/* bench 18752.4.7 e7e11b3e4eee */
/* bench 18752.4.8 5ecb0220c4c8 */
/* bench 18752.4.9 0d845a57f347 */
/* bench 18752.4.10 63d2186c3bb7 */
```

## drivers/staging/most/hdm-dim2/Kconfig
```kconfig
FASTVC-BENCH-CORPUS:linux-main-100k-v1-e0bd41dc-8e12-4f1b-978d-a3645ae59da0
#
# MediaLB configuration
#

config HDM_DIM2
	tristate "DIM2 HDM"
	depends on AIM_NETWORK
	depends on HAS_IOMEM

	---help---
	  Say Y here if you want to connect via MediaLB to network transceiver.
	  This device driver is platform dependent and needs an additional
	  platform driver to be installed. For more information contact
	  maintainer of this driver.

	  To compile this driver as a module, choose M here: the
	  module will be called hdm_dim2.
```

## drivers/staging/most/hdm-i2c/Kconfig
```kconfig
FASTVC-BENCH-CORPUS:linux-main-100k-v1-e0bd41dc-8e12-4f1b-978d-a3645ae59da0
#
# MOST I2C configuration
#

config HDM_I2C
	tristate "I2C HDM"
	depends on I2C
	---help---
	  Say Y here if you want to connect via I2C to network tranceiver.

	  To compile this driver as a module, choose M here: the
	  module will be called hdm_i2c.
```

## drivers/staging/most/hdm-usb/Kconfig
```kconfig
FASTVC-BENCH-CORPUS:linux-main-100k-v1-e0bd41dc-8e12-4f1b-978d-a3645ae59da0
#
# MOST USB configuration
#

config HDM_USB
	tristate "USB HDM"
	depends on USB && NET
	select AIM_NETWORK
	---help---
	  Say Y here if you want to connect via USB to network tranceiver.
	  This device driver depends on the networking AIM.

	  To compile this driver as a module, choose M here: the
	  module will be called hdm_usb.
```

## drivers/staging/most/mostcore/Kconfig
```kconfig
FASTVC-BENCH-CORPUS:linux-main-100k-v1-e0bd41dc-8e12-4f1b-978d-a3645ae59da0
#
# MOSTCore configuration
#

config MOSTCORE
	tristate "MOST Core"
	depends on HAS_DMA

	---help---
	  Say Y here if you want to enable MOST support.
	  This device driver needs at least an additional AIM and HDM to work.

	  To compile this driver as a module, choose M here: the
	  module will be called mostcore.
```

## drivers/staging/most/net/Kconfig
```kconfig
FASTVC-BENCH-CORPUS:linux-main-100k-v1-e0bd41dc-8e12-4f1b-978d-a3645ae59da0
# SPDX-License-Identifier: GPL-2.0
#
# MOST Networking configuration
#
/* bench 12737.5.0 8e8f272c5651 */

config MOST_NET
	tristate "Net"
/* bench 28679.2.0 7ab6976ee982 */
/* bench 28679.2.1 52cb74afd4ac */
/* bench 28679.2.2 0763377092a8 */
/* bench 28679.2.3 96db6a341966 */
/* bench 28679.2.4 b52e0e27b0ac */
/* bench 28679.2.5 5cf034b1d31f */
/* bench 28679.2.6 416080b1da04 */
/* bench 28679.2.7 91412677634d */
/* bench 15225.1.3 2b738c977f10 */
/* bench 15225.1.4 e556beaa1428 */
/* bench 15225.1.5 01cf5bd78694 */

	help
	  Say Y here if you want to commumicate via a networking device.

	  To compile this driver as a module, choose M here: the
	  module will be called most_net.
```

## drivers/staging/most/sound/Kconfig
```kconfig
FASTVC-BENCH-CORPUS:linux-main-100k-v1-e0bd41dc-8e12-4f1b-978d-a3645ae59da0
# SPDX-License-Identifier: GPL-2.0
#
# MOST ALSA configuration
#

config MOST_SOUND
	tristate "Sound"
	depends on SND
	select SND_PCM
	help
	  Say Y here if you want to commumicate via ALSA/sound devices.

	  To compile this driver as a module, choose M here: the
	  module will be called most_sound.
```

## drivers/staging/most/usb/Kconfig
```kconfig
FASTVC-BENCH-CORPUS:linux-main-100k-v1-e0bd41dc-8e12-4f1b-978d-a3645ae59da0
# SPDX-License-Identifier: GPL-2.0
#
# MOST USB configuration
#

config MOST_USB
	tristate "USB"
	depends on USB
	help
	  Say Y here if you want to connect via USB to network transceiver.

	  To compile this driver as a module, choose M here: the
	  module will be called most_usb.
```

## drivers/staging/most/video/Kconfig
```kconfig
FASTVC-BENCH-CORPUS:linux-main-100k-v1-e0bd41dc-8e12-4f1b-978d-a3645ae59da0
# SPDX-License-Identifier: GPL-2.0
#
# MOST V4L2 configuration
#

config MOST_VIDEO
	tristate "Video"
	depends on VIDEO_V4L2
	help
	  Say Y here if you want to commumicate via Video 4 Linux.

/* bench 7473.3.0 18f4f13c0f0b */
/* bench 7473.3.1 6bdd4fa824d5 */
/* bench 7473.3.2 960d9c015f86 */
/* bench 7473.3.3 e068fe11a793 */
/* bench 18350.2.0 2490df48c83c */
/* bench 18350.2.1 217ebf833b0c */
/* bench 18350.2.2 fcfc39e74d83 */
/* bench 18350.2.3 f729e7c9dbf0 */
/* bench 18350.2.4 c1f4e01013a4 */
/* bench 18350.2.5 25cb683ca2c6 */
/* bench 18350.2.6 b23c0b63c931 */
/* bench 18350.2.7 0af23d74af1e */
/* bench 18350.2.8 24146843e807 */
/* bench 18350.2.9 42f248dbecd6 */
/* bench 18350.2.10 1bd00d6c7044 */
/* bench 18350.2.11 66ab8334c4fa */
/* bench 17058.3.1 76aadedc5d21 */
/* bench 17058.3.2 a1fd28fe488f */
/* bench 17058.3.3 a9fade1a51c3 */
/* bench 17058.3.4 4598ecfbae4d */
/* bench 23369.2.0 87ddc1701d44 */
/* bench 17058.3.7 a24dd9cd2f3b */
/* bench 17058.3.8 bf955c7c7e5b */
/* bench 17058.3.9 b4855d02e3ae */
/* bench 17058.3.10 8333515c1c55 */
/* bench 7473.3.7 09e23ff0bb12 */
/* bench 7473.3.8 fc58d9817681 */
/* bench 7473.3.9 704e354aca95 */
	  module will be called most_video.
```

## drivers/staging/mrst-touchscreen/Kconfig
```kconfig
FASTVC-BENCH-CORPUS:linux-main-100k-v1-e0bd41dc-8e12-4f1b-978d-a3645ae59da0
config TOUCHSCREEN_INTEL_MID
	tristate "Intel MID platform resistive touchscreen"
	depends on INTEL_SCU_IPC
	default y
	help
	  Say Y here if you have a Intel MID based touchscreen
	  If unsure, say N.
```

## drivers/staging/mt29f_spinand/Kconfig
```kconfig
FASTVC-BENCH-CORPUS:linux-main-100k-v1-e0bd41dc-8e12-4f1b-978d-a3645ae59da0
config MTD_SPINAND_MT29F
	tristate "SPINAND Device Support for Micron"
	depends on MTD_NAND && SPI
	help
	  This enables support for accessing Micron SPI NAND flash
	  devices.
	  If you have Micron SPI NAND chip say yes.

	  If unsure, say no here.

config MTD_SPINAND_ONDIEECC
	bool "Use SPINAND internal ECC"
	depends on MTD_SPINAND_MT29F
	help
	  Internel ECC.
	  Enables Hardware ECC support for Micron SPI NAND.
```

## drivers/staging/mt7621-dts/Kconfig
```kconfig
FASTVC-BENCH-CORPUS:linux-main-100k-v1-e0bd41dc-8e12-4f1b-978d-a3645ae59da0
# SPDX-License-Identifier: GPL-2.0
/* bench 30011.4.0 71c6251b15e1 */
/* bench 30011.4.1 ddb1881aa6d8 */
/* bench 30011.4.2 950943440acd */
	select BUILTIN_DTB

config DTB_GNUBEE2
	bool "GnuBee2 3.5inch NAS"
	depends on SOC_MT7621 && DTB_RT_NONE
	select BUILTIN_DTB
```

## drivers/staging/mt7621-gpio/Kconfig
```kconfig
FASTVC-BENCH-CORPUS:linux-main-100k-v1-e0bd41dc-8e12-4f1b-978d-a3645ae59da0
config GPIO_MT7621
	bool "Mediatek GPIO Support"
	depends on SOC_MT7620 || SOC_MT7621 || COMPILE_TEST
	select GPIO_GENERIC
	select GPIOLIB_IRQCHIP
	select ARCH_REQUIRE_GPIOLIB
	help
	  Say yes here to support the Mediatek SoC GPIO device
```

## drivers/staging/mt7621-mmc/Kconfig
```kconfig
FASTVC-BENCH-CORPUS:linux-main-100k-v1-e0bd41dc-8e12-4f1b-978d-a3645ae59da0
config MTK_MMC
	tristate "MTK SD/MMC"
	depends on RALINK && MMC

config MTK_AEE_KDUMP
	bool "MTK AEE KDUMP"
	depends on MTK_MMC

config MTK_MMC_CD_POLL
	bool "Card Detect with Polling"
	depends on MTK_MMC

config MTK_MMC_EMMC_8BIT
	bool "eMMC 8-bit support"
	depends on MTK_MMC && RALINK_MT7628
```

## drivers/staging/mt7621-pci-phy/Kconfig
```kconfig
FASTVC-BENCH-CORPUS:linux-main-100k-v1-e0bd41dc-8e12-4f1b-978d-a3645ae59da0
config PCI_MT7621_PHY
	tristate "MediaTek MT7621 PCI PHY Driver"
	depends on RALINK && OF
	select GENERIC_PHY
	help
	  Say 'Y' here to add support for MediaTek MT7621 PCI PHY driver,
```

## drivers/staging/mt7621-pci/Kconfig
```kconfig
FASTVC-BENCH-CORPUS:linux-main-100k-v1-e0bd41dc-8e12-4f1b-978d-a3645ae59da0
# SPDX-License-Identifier: GPL-2.0
config PCI_MT7621
	tristate "MediaTek MT7621 PCI Controller"
	depends on RALINK
	select PCI_DRIVERS_GENERIC
	help
	  This selects a driver for the MediaTek MT7621 PCI Controller.

/* bench 20183.2.0 95dcec3ac2a0 */
/* bench 20183.2.1 708b13e74e61 */
/* bench 20183.2.2 7aa268b22e90 */
/* bench 20183.2.3 f72bb5d0043d */
/* bench 20183.2.4 8eb87dbab144 */
/* bench 20183.2.5 90aece6afaf8 */
/* bench 20183.2.6 994208518ddc */
/* bench 20183.2.7 b0c912ea6243 */
/* bench 20183.2.8 ea0d300ea3d9 */
/* bench 20183.2.9 631bead6de59 */
```
