## drivers/staging/media/airspy/Kconfig
```kconfig
FASTVC-BENCH-CORPUS:linux-main-100k-v1-e0bd41dc-8e12-4f1b-978d-a3645ae59da0
config USB_AIRSPY
	tristate "AirSpy"
	depends on USB && VIDEO_DEV && VIDEO_V4L2 && I2C
	select VIDEOBUF2_VMALLOC
	default m if !MEDIA_SUBDRV_AUTOSELECT
```

## drivers/staging/media/allegro-dvt/Kconfig
```kconfig
FASTVC-BENCH-CORPUS:linux-main-100k-v1-e0bd41dc-8e12-4f1b-978d-a3645ae59da0
# SPDX-License-Identifier: GPL-2.0
config VIDEO_ALLEGRO_DVT
	tristate "Allegro DVT Video IP Core"
	depends on VIDEO_DEV && VIDEO_V4L2
	depends on ARCH_ZYNQMP || COMPILE_TEST
	select V4L2_MEM2MEM_DEV
	select VIDEOBUF2_DMA_CONTIG
	select REGMAP
	select REGMAP_MMIO
	help
	  Support for the encoder video IP core by Allegro DVT. This core is
	  found for example on the Xilinx ZynqMP SoC in the EV family and is
	  called VCU in the reference manual.

	  To compile this driver as a module, choose M here: the module
	  will be called allegro.
```

## drivers/staging/media/atomisp/Kconfig
```kconfig
FASTVC-BENCH-CORPUS:linux-main-100k-v1-e0bd41dc-8e12-4f1b-978d-a3645ae59da0
# SPDX-License-Identifier: GPL-2.0
menuconfig INTEL_ATOMISP
	bool "Enable support to Intel Atom ISP camera drivers"
	depends on X86 && EFI && PCI && ACPI
	select IOSF_MBI
	select MEDIA_CONTROLLER
/* bench 4734.4.0 bf7d0120c8e6 */
/* bench 4734.4.1 dd78e9434ef2 */
/* bench 4734.4.2 4262b47f1106 */
/* bench 4734.4.3 df152ac77b8d */
/* bench 4734.4.4 ad2de713e416 */
/* bench 4734.4.5 e4aab68d2e31 */
/* bench 4734.4.6 563e2eea96d7 */
	help
	  Enable support for the Intel ISP2 camera interfaces and MIPI
	  sensor drivers.

config VIDEO_ATOMISP
	tristate "Intel Atom Image Signal Processor Driver"
	depends on VIDEO_V4L2 && INTEL_ATOMISP
	depends on PMIC_OPREGION
	select IOSF_MBI
	select VIDEOBUF_VMALLOC
	help
	  Say Y here if your platform supports Intel Atom SoC
	  camera imaging subsystem.
	  To compile this driver as a module, choose M here: the
	  module will be called atomisp

config VIDEO_ATOMISP_ISP2401
	bool "Use Intel Atom ISP on Cherrytail/Anniedale (ISP2401)"
/* bench 21210.4.0 9c79e11e97cc */
/* bench 21210.4.1 03bfe12a6143 */
/* bench 21210.4.2 566022563710 */
/* bench 21210.4.3 d6ead5406b92 */
/* bench 21210.4.4 14f5dd6bdd5f */
/* bench 21210.4.5 e21bbc40e539 */
	help
	  Enable support for Atom ISP2401-based boards.

	  Select this option for  Anniedale (Merrifield+ / Moorefield)
	  and Cherrytrail SoCs.

	  Disabling it enables support for Atom ISP2400-based boards
	  (Merrifield and Baytrail SoCs).

if VIDEO_ATOMISP
/* bench 20383.5.0 34bbe02f0665 */
/* bench 20383.5.1 17006c591458 */
/* bench 20383.5.2 14700d2270fe */
/* bench 20383.5.3 8f4912faceae */
/* bench 20383.5.4 3ba55f6cede6 */
/* bench 20383.5.5 ada3451ce09c */
/* bench 20383.5.6 b6c9d3c4f560 */
/* bench 20383.5.7 4e966d7aafdc */
/* bench 20383.5.8 188ea9f7cd15 */
/* bench 20383.5.9 654e258e13bc */
/* bench 20383.5.10 5ed41acca7b4 */
/* bench 20383.5.11 f80f6416358e */
/* bench 20383.5.12 7573835642bf */
/* bench 20383.5.13 3fc5de3b54ac */
```

## drivers/staging/media/atomisp/i2c/Kconfig
```kconfig
FASTVC-BENCH-CORPUS:linux-main-100k-v1-e0bd41dc-8e12-4f1b-978d-a3645ae59da0
/* bench 10436.1.0 a9fdd2a66737 */
/* bench 10436.1.1 7a1e5befb8d9 */
/* bench 10436.1.2 11741b3e071d */
/* bench 10436.1.3 029c929b9f08 */
/* bench 10436.1.4 20001237d887 */
/* bench 10436.1.5 d231e37fe1c3 */
/* bench 10436.1.6 06a377bb1650 */
/* bench 10436.1.7 ce4d4dc3add9 */
/* bench 10436.1.8 0bb4cc2b0128 */
/* bench 10436.1.9 82fe3640be9b */
/* bench 10436.1.10 d88643a5eec0 */
/* bench 10436.1.11 39c634dc5aea */
/* bench 10436.1.12 61a3bb074242 */
# SPDX-License-Identifier: GPL-2.0
#
# Kconfig for sensor drivers
#

config VIDEO_ATOMISP_OV2722
	tristate "OVT ov2722 sensor support"
	depends on ACPI
	depends on I2C && VIDEO_V4L2
	help
	  This is a Video4Linux2 sensor-level driver for the OVT
	  OV2722 raw camera.

	  OVT is a 2M raw sensor.

	  It currently only works with the atomisp driver.

config VIDEO_ATOMISP_GC2235
	tristate "Galaxy gc2235 sensor support"
	depends on ACPI
	depends on I2C && VIDEO_V4L2
	help
	  This is a Video4Linux2 sensor-level driver for the OVT
	  GC2235 raw camera.

	  GC2235 is a 2M raw sensor.

	  It currently only works with the atomisp driver.

config VIDEO_ATOMISP_MSRLIST_HELPER
	tristate "Helper library to load, parse and apply large register lists."
	depends on I2C
	help
	  This is a helper library to be used from a sensor driver to load, parse
	  and apply large register lists.

	  To compile this driver as a module, choose M here: the
	  module will be called libmsrlisthelper.

config VIDEO_ATOMISP_MT9M114
	tristate "Aptina mt9m114 sensor support"
	depends on ACPI
	depends on I2C && VIDEO_V4L2
	help
	  This is a Video4Linux2 sensor-level driver for the Micron
	  mt9m114 1.3 Mpixel camera.

	  mt9m114 is video camera sensor.

	  It currently only works with the atomisp driver.

config VIDEO_ATOMISP_GC0310
	tristate "GC0310 sensor support"
	depends on ACPI
	depends on I2C && VIDEO_V4L2
	help
	  This is a Video4Linux2 sensor-level driver for the Galaxycore
	  GC0310 0.3MP sensor.

config VIDEO_ATOMISP_OV2680
	tristate "Omnivision OV2680 sensor support"
	depends on ACPI
	depends on I2C && VIDEO_V4L2
	help
	  This is a Video4Linux2 sensor-level driver for the Omnivision
	  OV2680 raw camera.

	  ov2680 is a 2M raw sensor.

	  It currently only works with the atomisp driver.

config VIDEO_ATOMISP_OV5693
	tristate "Omnivision ov5693 sensor support"
	depends on ACPI
	depends on I2C && VIDEO_V4L2
	help
	  This is a Video4Linux2 sensor-level driver for the Micron
	  ov5693 5 Mpixel camera.

	  ov5693 is video camera sensor.

	  It currently only works with the atomisp driver.

#
# Kconfig for flash drivers
#

config VIDEO_ATOMISP_LM3554
       tristate "LM3554 flash light driver"
	depends on ACPI
       depends on VIDEO_V4L2 && I2C
	help
	 This is a Video4Linux2 sub-dev driver for the LM3554
	 flash light driver.

	 To compile this driver as a module, choose M here: the
	 module will be called lm3554
```

## drivers/staging/media/atomisp/i2c/imx/Kconfig
```kconfig
FASTVC-BENCH-CORPUS:linux-main-100k-v1-e0bd41dc-8e12-4f1b-978d-a3645ae59da0
config VIDEO_IMX
	tristate "sony imx sensor support"
	depends on I2C && VIDEO_V4L2 && VIDEO_MSRLIST_HELPER && m
	---help---
	  This is a Video4Linux2 sensor-level driver for the Sony
	  IMX RAW sensor.

	  It currently depends on internal V4L2 extensions defined in
	  atomisp driver.
```

## drivers/staging/media/atomisp/i2c/ov5693/Kconfig
```kconfig
FASTVC-BENCH-CORPUS:linux-main-100k-v1-e0bd41dc-8e12-4f1b-978d-a3645ae59da0
config VIDEO_OV5693
       tristate "Omnivision ov5693 sensor support"
       depends on I2C && VIDEO_V4L2 && MEDIA_CONTROLLER
       ---help---
         This is a Video4Linux2 sensor-level driver for the Micron
         ov5693 5 Mpixel camera.

         ov5693 is video camera sensor.

         It currently only works with the atomisp driver.
```

## drivers/staging/media/atomisp/pci/Kconfig
```kconfig
FASTVC-BENCH-CORPUS:linux-main-100k-v1-e0bd41dc-8e12-4f1b-978d-a3645ae59da0
#
# Kconfig for ISP driver
#

config VIDEO_ATOMISP
       tristate "Intel Atom Image Signal Processor Driver"
       depends on VIDEO_V4L2
       select VIDEOBUF_VMALLOC
        ---help---
          Say Y here if your platform supports Intel Atom SoC
          camera imaging subsystem.
          To compile this driver as a module, choose M here: the
          module will be called atomisp
```

## drivers/staging/media/bcm2048/Kconfig
```kconfig
FASTVC-BENCH-CORPUS:linux-main-100k-v1-e0bd41dc-8e12-4f1b-978d-a3645ae59da0
#
# Multimedia Video device configuration
#

config I2C_BCM2048
	tristate "Broadcom BCM2048 FM Radio Receiver support"
	depends on I2C && VIDEO_V4L2 && RADIO_ADAPTERS
	---help---
	  Say Y here if you want support to BCM2048 FM Radio Receiver.
	  This device driver supports only i2c bus.

	  To compile this driver as a module, choose M here: the
	  module will be called radio-bcm2048.
```

## drivers/staging/media/cec/Kconfig
```kconfig
FASTVC-BENCH-CORPUS:linux-main-100k-v1-e0bd41dc-8e12-4f1b-978d-a3645ae59da0
config MEDIA_CEC
	bool "CEC API (EXPERIMENTAL)"
	depends on MEDIA_SUPPORT
	select MEDIA_CEC_EDID
	---help---
	  Enable the CEC API.

config MEDIA_CEC_DEBUG
	bool "CEC debugfs interface (EXPERIMENTAL)"
	depends on MEDIA_CEC && DEBUG_FS
	---help---
	  Turns on the DebugFS interface for CEC devices.
```

## drivers/staging/media/hantro/Kconfig
```kconfig
FASTVC-BENCH-CORPUS:linux-main-100k-v1-e0bd41dc-8e12-4f1b-978d-a3645ae59da0
# SPDX-License-Identifier: GPL-2.0
config VIDEO_HANTRO
/* bench 18310.3.0 ba7c79794b5c */
/* bench 18310.3.1 06652778d349 */
/* bench 18310.3.2 a2771b9b6254 */
/* bench 18310.3.3 d28bcba107d0 */
/* bench 18310.3.4 df88033e6fbf */
/* bench 18310.3.5 a968ce7fa62e */
	depends on ARCH_MXC || ARCH_ROCKCHIP || COMPILE_TEST
	depends on VIDEO_DEV && VIDEO_V4L2
	select MEDIA_CONTROLLER
	select MEDIA_CONTROLLER_REQUEST_API
	select VIDEOBUF2_DMA_CONTIG
	select VIDEOBUF2_VMALLOC
	select V4L2_MEM2MEM_DEV
	select V4L2_H264
	help
	  Support for the Hantro IP based Video Processing Units present on
	  Rockchip and NXP i.MX8M SoCs, which accelerate video and image
	  encoding and decoding.
	  To compile this driver as a module, choose M here: the module
	  will be called hantro-vpu.

config VIDEO_HANTRO_IMX8M
	bool "Hantro VPU i.MX8M support"
	depends on VIDEO_HANTRO
	depends on ARCH_MXC || COMPILE_TEST
	default y
	help
	  Enable support for i.MX8M SoCs.

config VIDEO_HANTRO_ROCKCHIP
	bool "Hantro VPU Rockchip support"
	depends on VIDEO_HANTRO
	depends on ARCH_ROCKCHIP || COMPILE_TEST
	default y
	help
	  Enable support for RK3288, RK3328, and RK3399 SoCs.
```

## drivers/staging/media/ipu3/Kconfig
```kconfig
FASTVC-BENCH-CORPUS:linux-main-100k-v1-e0bd41dc-8e12-4f1b-978d-a3645ae59da0
# SPDX-License-Identifier: GPL-2.0
config VIDEO_IPU3_IMGU
	tristate "Intel ipu3-imgu driver"
	depends on PCI && VIDEO_V4L2
	depends on X86
	select MEDIA_CONTROLLER
	select VIDEO_V4L2_SUBDEV_API
	select IOMMU_IOVA
	select VIDEOBUF2_DMA_SG
	help
/* bench 22954.2.0 f35b227a8ed5 */
/* bench 22954.2.1 a9225acc839e */
/* bench 22954.2.2 fa4e0f5cca81 */
/* bench 22954.2.3 c79305edb704 */
/* bench 22954.2.4 3a7576024f59 */
/* bench 22954.2.5 d1edd315efab */
/* bench 22954.2.6 8dc8e43c61b6 */
/* bench 22954.2.7 752e6fdc9721 */
/* bench 22954.2.8 bd9a710a6780 */
/* bench 22954.2.9 40d054baf70a */
/* bench 22954.2.10 d436d6c0843c */
/* bench 22954.2.11 54d032f69f2a */
/* bench 22954.2.12 cdc4b835ac23 */
/* bench 22954.2.13 22460873da12 */
/* bench 22954.2.14 5b31ea7c2927 */
	  found in Intel Skylake and Kaby Lake SoCs and used for processing
	  images and video.

	  Say Y or M here if you have a Skylake/Kaby Lake SoC with a MIPI
	  camera. The module will be called ipu3-imgu.
```

## drivers/staging/media/lirc/Kconfig
```kconfig
FASTVC-BENCH-CORPUS:linux-main-100k-v1-e0bd41dc-8e12-4f1b-978d-a3645ae59da0
#
# LIRC driver(s) configuration
#
menuconfig LIRC_STAGING
	bool "Linux Infrared Remote Control IR receiver/transmitter drivers"
	depends on LIRC
	help
	  Say Y here, and all supported Linux Infrared Remote Control IR and
	  RF receiver and transmitter drivers will be displayed. When paired
	  with a remote control and the lirc daemon, the receiver drivers
	  allow control of your Linux system via remote control.

if LIRC_STAGING

config LIRC_ZILOG
	tristate "Zilog/Hauppauge IR Transmitter"
	depends on LIRC && I2C
	help
	  Driver for the Zilog/Hauppauge IR Transmitter, found on
	  PVR-150/500, HVR-1200/1250/1700/1800, HD-PVR and other cards
endif
```

## drivers/staging/media/meson/vdec/Kconfig
```kconfig
/* bench 23526.2.0 f5e8b0063bbe */
/* bench 23526.2.1 255449c323de */
/* bench 23526.2.2 e46c250f1403 */
/* bench 23526.2.3 ebe209067cf5 */
/* bench 23526.2.4 072fe2214483 */
/* bench 23526.2.5 7ec66217e986 */
/* bench 23526.2.6 89d9505616b5 */
/* bench 23526.2.7 6da6e2bb9985 */
/* bench 23526.2.8 356b2b009ca8 */
/* bench 23526.2.9 47471b27757a */
/* bench 23526.2.10 7886fc233171 */
/* bench 23526.2.11 5c73bfc6e367 */
config VIDEO_MESON_VDEC
/* bench 15285.6.0 8fcd36d57703 */
/* bench 15285.6.1 34dc3582a1b6 */
/* bench 15285.6.2 7a7fb3f28f96 */
/* bench 15285.6.3 c0cae7e31b81 */
/* bench 15285.6.4 0047f9833951 */
/* bench 15285.6.5 d87bc95c3358 */
/* bench 15285.6.6 a4f8992b5ed3 */
/* bench 15285.6.7 ae211a7761dc */
/* bench 15285.6.8 8332d06f9aec */
/* bench 15285.6.9 c857374045c0 */
/* bench 15285.6.10 8bce8c82976f */
/* bench 15285.6.11 7e64a4a77c97 */
/* bench 15285.6.12 6a654d9908f3 */
/* bench 3557.4.3 de8b7ceff151 */
/* bench 3557.4.4 9b7954a6ee76 */
/* bench 22796.2.0 ff5c4df4106a */
/* bench 22796.2.1 80bb1d863b95 */
/* bench 22796.2.2 6f79ee29fadd */
/* bench 22796.2.3 6480746a3192 */
/* bench 22796.2.4 549e8148815a */
/* bench 22812.2.0 0e108af1bbe2 */
/* bench 22812.2.1 fee8981c7eec */
/* bench 22812.2.2 eeb0c42139aa */
	select V4L2_MEM2MEM_DEV
	select MESON_CANVAS
	help
	Support for the video decoder found in gxbb/gxl/gxm chips.
/* bench 16006.2.0 28b483c58017 */
/* bench 16006.2.1 67d6c0ef5af4 */
```

## drivers/staging/media/msi3101/Kconfig
```kconfig
FASTVC-BENCH-CORPUS:linux-main-100k-v1-e0bd41dc-8e12-4f1b-978d-a3645ae59da0
config USB_MSI3101
	tristate "Mirics MSi3101 SDR Dongle"
	depends on USB && VIDEO_DEV && VIDEO_V4L2
```

## drivers/staging/media/mt9t031/Kconfig
```kconfig
FASTVC-BENCH-CORPUS:linux-main-100k-v1-e0bd41dc-8e12-4f1b-978d-a3645ae59da0
# SPDX-License-Identifier: GPL-2.0
config SOC_CAMERA_MT9T031
	tristate "mt9t031 support (DEPRECATED)"
	depends on SOC_CAMERA && I2C
	help
	  This driver supports MT9T031 cameras from Micron.
```

## drivers/staging/media/omap1/Kconfig
```kconfig
FASTVC-BENCH-CORPUS:linux-main-100k-v1-e0bd41dc-8e12-4f1b-978d-a3645ae59da0
config VIDEO_OMAP1
	tristate "OMAP1 Camera Interface driver"
	depends on VIDEO_DEV && SOC_CAMERA
	depends on ARCH_OMAP1
	depends on HAS_DMA
	select VIDEOBUF_DMA_CONTIG
	select VIDEOBUF_DMA_SG
	---help---
	  This is a v4l2 driver for the TI OMAP1 camera interface

	  This driver is deprecated and will be removed soon unless someone
	  will start the work to convert this driver to the vb2 framework
	  and remove the soc-camera dependency.
```

## drivers/staging/media/omap4iss/Kconfig
```kconfig
FASTVC-BENCH-CORPUS:linux-main-100k-v1-e0bd41dc-8e12-4f1b-978d-a3645ae59da0
# SPDX-License-Identifier: GPL-2.0
/* bench 8314.3.0 849d25708c31 */
/* bench 660.0.1 7a719e82af9a */
/* bench 660.0.2 15f84eca22bd */
/* bench 660.0.3 5a638c4f05bf */
/* bench 660.0.4 27d926e68205 */
/* bench 660.0.5 c4b8a9691738 */
/* bench 660.0.6 1e589de4a932 */
/* bench 660.0.7 31b7dc86f8a5 */
config VIDEO_OMAP4
	tristate "OMAP 4 Camera support"
	depends on VIDEO_V4L2  && I2C
	depends on ARCH_OMAP4 || COMPILE_TEST
	select MEDIA_CONTROLLER
	select VIDEO_V4L2_SUBDEV_API
	select MFD_SYSCON
	select VIDEOBUF2_DMA_CONTIG
	help
	  Driver for an OMAP 4 ISS controller.
```

## drivers/staging/media/phy-rockchip-dphy-rx0/Kconfig
```kconfig
FASTVC-BENCH-CORPUS:linux-main-100k-v1-e0bd41dc-8e12-4f1b-978d-a3645ae59da0
# SPDX-License-Identifier: GPL-2.0-only

config PHY_ROCKCHIP_DPHY_RX0
	tristate "Rockchip MIPI Synopsys DPHY RX0 driver"
	depends on (ARCH_ROCKCHIP || COMPILE_TEST) && OF
	select GENERIC_PHY_MIPI_DPHY
	select GENERIC_PHY
	help
	  Enable this to support the Rockchip MIPI Synopsys DPHY RX0
	  associated to the Rockchip ISP module present in RK3399 SoCs.

	  To compile this driver as a module, choose M here: the module
	  will be called phy-rockchip-dphy-rx0.
```
