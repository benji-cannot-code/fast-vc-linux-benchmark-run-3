## drivers/staging/media/rkisp1/Kconfig
```kconfig
FASTVC-BENCH-CORPUS:linux-main-100k-v1-e0bd41dc-8e12-4f1b-978d-a3645ae59da0
# SPDX-License-Identifier: GPL-2.0-only

config VIDEO_ROCKCHIP_ISP1
	tristate "Rockchip Image Signal Processing v1 Unit driver"
	depends on VIDEO_V4L2 && OF
	depends on ARCH_ROCKCHIP || COMPILE_TEST
	select MEDIA_CONTROLLER
	select VIDEO_V4L2_SUBDEV_API
	select VIDEOBUF2_DMA_CONTIG
	select VIDEOBUF2_VMALLOC
	select V4L2_FWNODE
	select PHY_ROCKCHIP_DPHY_RX0
	default n
	help
	  Enable this to support the Image Signal Processing (ISP) module
	  present in RK3399 SoCs.

	  To compile this driver as a module, choose M here: the module
	  will be called rockchip-isp1.
```

## drivers/staging/media/rkvdec/Kconfig
```kconfig
FASTVC-BENCH-CORPUS:linux-main-100k-v1-e0bd41dc-8e12-4f1b-978d-a3645ae59da0
# SPDX-License-Identifier: GPL-2.0
config VIDEO_ROCKCHIP_VDEC
	tristate "Rockchip Video Decoder driver"
	depends on ARCH_ROCKCHIP || COMPILE_TEST
	depends on VIDEO_DEV && VIDEO_V4L2
	select MEDIA_CONTROLLER
	select MEDIA_CONTROLLER_REQUEST_API
/* bench 20272.1.0 92cf499ad257 */
/* bench 20272.1.1 ae290115431b */
/* bench 20272.1.2 284d9ba9e5bf */
/* bench 20272.1.3 945b3eb8c8fe */
/* bench 20272.1.4 f37e9df693d4 */
/* bench 20272.1.5 6a973ebc7c85 */
/* bench 20272.1.6 08ee7be70e56 */
	select VIDEOBUF2_DMA_CONTIG
	select VIDEOBUF2_VMALLOC
	select V4L2_MEM2MEM_DEV
	select V4L2_H264
	help
	  Support for the Rockchip Video Decoder IP present on Rockchip SoCs,
	  which accelerates video decoding.
	  To compile this driver as a module, choose M here: the module
	  will be called rockchip-vdec.
```

## drivers/staging/media/rtl2832u_sdr/Kconfig
```kconfig
FASTVC-BENCH-CORPUS:linux-main-100k-v1-e0bd41dc-8e12-4f1b-978d-a3645ae59da0
config DVB_RTL2832_SDR
	tristate "Realtek RTL2832 SDR"
	depends on USB && DVB_CORE && I2C && VIDEO_V4L2 && DVB_USB_RTL28XXU
	select DVB_RTL2832
	select VIDEOBUF2_VMALLOC
	default m if !MEDIA_SUBDRV_AUTOSELECT
```

## drivers/staging/media/s5p-cec/Kconfig
```kconfig
FASTVC-BENCH-CORPUS:linux-main-100k-v1-e0bd41dc-8e12-4f1b-978d-a3645ae59da0
config VIDEO_SAMSUNG_S5P_CEC
       tristate "Samsung S5P CEC driver"
       depends on VIDEO_DEV && MEDIA_CEC_SUPPORT && (PLAT_S5P || ARCH_EXYNOS || COMPILE_TEST)
       ---help---
         This is a driver for Samsung S5P HDMI CEC interface. It uses the
         generic CEC framework interface.
         CEC bus is present in the HDMI connector and enables communication
         between compatible devices.
```

## drivers/staging/media/st-cec/Kconfig
```kconfig
FASTVC-BENCH-CORPUS:linux-main-100k-v1-e0bd41dc-8e12-4f1b-978d-a3645ae59da0
config VIDEO_STI_HDMI_CEC
       tristate "STMicroelectronics STiH4xx HDMI CEC driver"
       depends on VIDEO_DEV && MEDIA_CEC_SUPPORT && (ARCH_STI || COMPILE_TEST)
       ---help---
         This is a driver for STIH4xx HDMI CEC interface. It uses the
         generic CEC framework interface.
         CEC bus is present in the HDMI connector and enables communication
         between compatible devices.
```

## drivers/staging/media/sunxi/Kconfig
```kconfig
FASTVC-BENCH-CORPUS:linux-main-100k-v1-e0bd41dc-8e12-4f1b-978d-a3645ae59da0
# SPDX-License-Identifier: GPL-2.0
config VIDEO_SUNXI
	bool "Allwinner sunXi family Video Devices"
	depends on ARCH_SUNXI || COMPILE_TEST
	help
	  If you have an Allwinner SoC based on the sunXi family, say Y.

	  Note that this option doesn't include new drivers in the
	  kernel: saying N will just cause Kconfig to skip all the
	  questions about Allwinner media devices.

if VIDEO_SUNXI
/* bench 5462.5.0 0b5bee2b2a97 */
/* bench 5462.5.1 8a3bcb2d3ed4 */
/* bench 5462.5.2 a31d14c15dea */
/* bench 5462.5.3 e9d945513a13 */
/* bench 5462.5.4 96cb178ccf8f */
/* bench 5462.5.5 53d1b9d81179 */
/* bench 5462.5.6 91ecede1dc25 */
/* bench 5462.5.7 0a68f1dc8370 */
/* bench 5462.5.8 f2e73027dd2c */
/* bench 5462.5.9 6dec93bcd593 */

source "drivers/staging/media/sunxi/cedrus/Kconfig"
/* bench 3134.4.0 9a41a01aac66 */
/* bench 3134.4.1 24103e6befd5 */
/* bench 3134.4.2 be30f3f97bfa */
/* bench 3134.4.3 37ba1c421f6d */
/* bench 3134.4.4 9bbee0158fb3 */
/* bench 3134.4.5 8faf8c5fd7a9 */
/* bench 3134.4.6 02ff76756878 */
/* bench 3134.4.7 0f345a6d5d75 */
/* bench 3134.4.8 b2d648bdd078 */
endif
```

## drivers/staging/media/sunxi/cedrus/Kconfig
```kconfig
FASTVC-BENCH-CORPUS:linux-main-100k-v1-e0bd41dc-8e12-4f1b-978d-a3645ae59da0
# SPDX-License-Identifier: GPL-2.0
config VIDEO_SUNXI_CEDRUS
	tristate "Allwinner Cedrus VPU driver"
/* bench 1668.6.0 d3dbdb8854d6 */
/* bench 1668.6.1 b897f104d373 */
/* bench 1668.6.2 e44e64698196 */
/* bench 1668.6.3 1a51d3ee58ca */
/* bench 1668.6.4 2fb6b56aed07 */
	depends on OF
	select MEDIA_CONTROLLER
	select MEDIA_CONTROLLER_REQUEST_API
/* bench 18940.2.0 0ad2fddebe1f */
/* bench 18940.2.1 43407bb10127 */
/* bench 18940.2.2 f353bc1080f1 */
/* bench 18940.2.3 76dac1198f85 */
/* bench 18940.2.4 1af96eed7b86 */
/* bench 18940.2.5 eb45707643ce */
/* bench 18940.2.6 b5106b80362d */
/* bench 18940.2.7 8761ff22ccc7 */
/* bench 18940.2.8 c92e2b40ce3a */
/* bench 2543.2.1 2e22daa03326 */
/* bench 2543.2.2 42d0550dea53 */
/* bench 2543.2.3 5953c810eb23 */
/* bench 2543.2.4 f0bd816fb231 */
/* bench 2543.2.5 c094cbc7478b */
/* bench 2543.2.6 424424e0def3 */
/* bench 2543.2.7 1eed50c78944 */
/* bench 2543.2.8 8fd3b9d0e4d6 */
	help
	  Support for the VPU found in Allwinner SoCs, also known as the Cedar
	  video engine.

	  To compile this driver as a module, choose M here: the module
	  will be called sunxi-cedrus.
```
