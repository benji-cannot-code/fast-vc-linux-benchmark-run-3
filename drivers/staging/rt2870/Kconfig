## drivers/staging/sm7xx/Kconfig
```kconfig
FASTVC-BENCH-CORPUS:linux-main-100k-v1-e0bd41dc-8e12-4f1b-978d-a3645ae59da0
config FB_SM7XX
	tristate "Silicon Motion SM7XX Frame Buffer Support"
	depends on FB
	select FB_CFB_FILLRECT
	select FB_CFB_COPYAREA
	select FB_CFB_IMAGEBLIT
	help
	  Frame Buffer driver for the Silicon Motion SM7XX serial graphic card.
```
