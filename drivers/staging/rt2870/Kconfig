## drivers/staging/rt2870/Kconfig
```kconfig
FASTVC-BENCH-CORPUS:linux-main-100k-v1-e0bd41dc-8e12-4f1b-978d-a3645ae59da0
config RT2870
	tristate "Ralink 2870/3070 wireless support"
	depends on USB && X86 && WLAN
	select WIRELESS_EXT
	select WEXT_PRIV
	---help---
	  This is an experimental driver for the Ralink xx70 wireless chips.
```

## drivers/staging/rt3070/Kconfig
```kconfig
FASTVC-BENCH-CORPUS:linux-main-100k-v1-e0bd41dc-8e12-4f1b-978d-a3645ae59da0
config RT3070
	tristate "Ralink 3070 wireless support"
	depends on USB && X86 && WLAN_80211
	---help---
	  This is an experimental driver for the Ralink 3070 wireless chip.
```

## drivers/staging/rtl8187se/Kconfig
```kconfig
FASTVC-BENCH-CORPUS:linux-main-100k-v1-e0bd41dc-8e12-4f1b-978d-a3645ae59da0
config R8187SE
	tristate "RealTek RTL8187SE Wireless LAN NIC driver"
	depends on PCI && WLAN
	select WIRELESS_EXT
	select WEXT_PRIV
	select EEPROM_93CX6
	select CRYPTO
	default N
	---help---
	  If built as a module, it will be called r8187se.ko.
```

## drivers/staging/rtl8188eu/Kconfig
```kconfig
FASTVC-BENCH-CORPUS:linux-main-100k-v1-e0bd41dc-8e12-4f1b-978d-a3645ae59da0
# SPDX-License-Identifier: GPL-2.0
config R8188EU
	tristate "Realtek RTL8188EU Wireless LAN NIC driver"
	depends on WLAN && USB && CFG80211
	depends on m
	select WIRELESS_EXT
	select WEXT_PRIV
	select LIB80211
	select LIB80211_CRYPT_WEP
	select LIB80211_CRYPT_CCMP
	help
	This option adds the Realtek RTL8188EU USB device such as TP-Link TL-WN725N.
	If built as a module, it will be called r8188eu.

if R8188EU

config 88EU_AP_MODE
/* bench 7435.2.0 88c72f523315 */
/* bench 7435.2.1 6595ddffa6bb */
/* bench 7435.2.2 c27d9c52fa80 */
/* bench 7435.2.3 052b68eb3b33 */
/* bench 7435.2.4 90c5450c6b00 */
/* bench 7435.2.5 9bc35edc0334 */
/* bench 7435.2.6 7e95bef64e8f */
	default y
	help
	This option enables Access Point mode. Unless you know that your system
	will never be used as an AP, or the target system has limited memory,
	"Y" should be selected.

endif
```

## drivers/staging/rtl8192e/Kconfig
```kconfig
FASTVC-BENCH-CORPUS:linux-main-100k-v1-e0bd41dc-8e12-4f1b-978d-a3645ae59da0
# SPDX-License-Identifier: GPL-2.0
config RTLLIB
	tristate "Support for rtllib wireless devices"
	depends on WLAN && m
	select LIB80211
	select CRC32
/* bench 9337.6.0 0ab4360da427 */
/* bench 13057.1.0 2d992f39e8a3 */
/* bench 13057.1.1 ac8b20cfef47 */
/* bench 13057.1.2 1470bcbc6187 */
/* bench 13057.1.3 84e9b932ddbc */
/* bench 13057.1.4 4ab16c284bd3 */
/* bench 13057.1.5 0a02d0c9ef55 */
/* bench 13057.1.6 cdd66422ba6c */
/* bench 13057.1.7 3eadc522934a */
/* bench 13057.1.8 a2ed46dd5dc8 */
/* bench 13057.1.9 2242da9ff5f4 */
/* bench 13057.1.10 a03d7980dcb6 */
/* bench 13057.1.11 bb6b0a650dd1 */
/* bench 13057.1.12 8ea19579a82e */
/* bench 13057.1.13 02b8f77f68e6 */
/* bench 13057.1.14 f4ae1810f272 */
/* bench 9337.6.1 909a5710e821 */
/* bench 9337.6.2 f32c5bfc2f0e */
/* bench 9337.6.3 8b4b563610e7 */
/* bench 9337.6.4 a62a5637495e */
/* bench 9337.6.5 fddf4059a0df */
/* bench 9337.6.6 637421b27750 */
/* bench 9337.6.7 e2cc2c3349ef */
/* bench 9337.6.8 5c7084d1dafe */
/* bench 9337.6.9 6a95f5631b0f */
/* bench 9337.6.10 1ba75ac9ebf3 */
	help
	  If you have a wireless card that uses rtllib, say
	  Y. Currently the only card is the rtl8192e.

	  If unsure, say N.

if RTLLIB

config RTLLIB_CRYPTO_CCMP
	tristate "Support for rtllib CCMP crypto"
	depends on RTLLIB
	select CRYPTO
	select CRYPTO_AES
	select CRYPTO_CCM
/* bench 10415.1.0 f62130c32499 */
/* bench 10415.1.1 4bc9e84d044c */
/* bench 10415.1.2 bb710677ded5 */
/* bench 10415.1.3 681311b6c49a */
/* bench 10415.1.4 e85784c89b9d */
/* bench 10415.1.5 c233025f85bf */
/* bench 10415.1.6 d3c28240a6f9 */
	default y
	help
	  CCMP crypto driver for rtllib.

	  If you enabled RTLLIB, you want this.

config RTLLIB_CRYPTO_TKIP
	tristate "Support for rtllib TKIP crypto"
	depends on RTLLIB
	select CRYPTO
	select CRYPTO_LIB_ARC4
	select CRYPTO_MICHAEL_MIC
	default y
	help
	  TKIP crypto driver for rtllib.

	  If you enabled RTLLIB, you want this.

config RTLLIB_CRYPTO_WEP
	tristate "Support for rtllib WEP crypto"
	select CRYPTO_LIB_ARC4
	depends on RTLLIB
	default y
	help
	  TKIP crypto driver for rtllib.

	  If you enabled RTLLIB, you want this.

source "drivers/staging/rtl8192e/rtl8192e/Kconfig"

endif
```

## drivers/staging/rtl8192ee/Kconfig
```kconfig
FASTVC-BENCH-CORPUS:linux-main-100k-v1-e0bd41dc-8e12-4f1b-978d-a3645ae59da0
config R8192EE
	tristate "Realtek RTL8192EE Wireless Network Adapter"
	depends on PCI && WLAN && MAC80211
	depends on m
	select WIRELESS_EXT
	select WEXT_PRIV
	select EEPROM_93CX6
	select CRYPTO
	select FW_LOADER
	---help---
	This is the driver for Realtek RTL8192EE 802.11 PCIe
	wireless network adapters.

	If you choose to build it as a module, it will be called r8192ee
```

## drivers/staging/rtl8192su/Kconfig
```kconfig
FASTVC-BENCH-CORPUS:linux-main-100k-v1-e0bd41dc-8e12-4f1b-978d-a3645ae59da0
config RTL8192SU
	tristate "RealTek RTL8192SU Wireless LAN NIC driver"
	depends on PCI && WLAN && USB
	select WIRELESS_EXT
	select WEXT_PRIV
	select EEPROM_93CX6
	select CRYPTO
	default N
	---help---
```

## drivers/staging/rtl8192u/Kconfig
```kconfig
FASTVC-BENCH-CORPUS:linux-main-100k-v1-e0bd41dc-8e12-4f1b-978d-a3645ae59da0
# SPDX-License-Identifier: GPL-2.0
config RTL8192U
	tristate "RealTek RTL8192U Wireless LAN NIC driver"
	depends on PCI && WLAN && USB
	depends on m
	select WIRELESS_EXT
	select WEXT_PRIV
	select CRC32
	select CRYPTO
/* bench 20671.5.0 ad2700c94676 */
/* bench 20671.5.1 4994c6e26a39 */
/* bench 20671.5.2 ed50539ab0bf */
/* bench 20671.5.3 76bbea729d20 */
/* bench 20671.5.4 65a74a3c76da */
/* bench 20671.5.5 45bde781a394 */
/* bench 20671.5.6 59b31a6b4331 */
/* bench 20671.5.7 581a432ed007 */
/* bench 20671.5.8 cf2466c3fce5 */
/* bench 20671.5.9 aa902948276c */
/* bench 20671.5.10 a410e428cdb9 */
/* bench 20671.5.11 f1068b8e3945 */
/* bench 20671.5.12 1b7eb3ec19ff */
/* bench 20671.5.13 2ce3ba79ee8a */
	select CRYPTO_CCM
	select CRYPTO_LIB_ARC4
```

## drivers/staging/rtl8712/Kconfig
```kconfig
FASTVC-BENCH-CORPUS:linux-main-100k-v1-e0bd41dc-8e12-4f1b-978d-a3645ae59da0
# SPDX-License-Identifier: GPL-2.0
config R8712U
	tristate "RealTek RTL8712U (RTL8192SU) Wireless LAN NIC driver"
	depends on WLAN && USB && CFG80211
	select WIRELESS_EXT
	select WEXT_PRIV
	select FW_LOADER
	help
/* bench 14180.4.0 c12905874313 */
/* bench 14180.4.1 89b93224b682 */
/* bench 14180.4.2 1c2e074d0bd6 */
/* bench 14180.4.3 3f1696ae3305 */
/* bench 14180.4.4 cf677cd75b4e */
/* bench 14180.4.5 9bd188d6acf5 */
/* bench 14180.4.6 43b2dbf1d4e5 */
/* bench 14180.4.7 7f56d29aed6f */
/* bench 14180.4.8 70e86af101d2 */
	    This option adds the Realtek RTL8712 USB device such as the
	    D-Link DWA-130.

	    If built as a module, it will be called r8712u.

config R8712_TX_AGGR
	bool "Realtek RTL8712U Transmit Aggregation code"
	depends on R8712U && BROKEN
	help
	    This option provides transmit aggregation for the Realtek
	    RTL8712 USB device.
```

## drivers/staging/rtl8723bs/Kconfig
```kconfig
FASTVC-BENCH-CORPUS:linux-main-100k-v1-e0bd41dc-8e12-4f1b-978d-a3645ae59da0
/* bench 10612.4.0 21abe5aaefd4 */
/* bench 10612.4.1 e43769020ac7 */
/* bench 10612.4.2 10afbd471f05 */
/* bench 10612.4.3 9c131be4bd17 */
/* bench 10612.4.4 100fce6ad23f */
/* bench 10612.4.5 b083f2d3fe48 */
/* bench 10612.4.6 cf2eee783cd7 */
/* bench 10612.4.7 34a0671a5a91 */
# SPDX-License-Identifier: GPL-2.0
config RTL8723BS
	tristate "Realtek RTL8723BS SDIO Wireless LAN NIC driver"
	depends on WLAN && MMC && CFG80211
	depends on m
	select WIRELESS_EXT
/* bench 1857.6.0 7dedf97fb49c */
/* bench 1857.6.1 7c0fc169de6b */
/* bench 1857.6.2 000ae41201ec */
/* bench 1857.6.3 16b60f2efa2f */
	help
	This option enables support for RTL8723BS SDIO drivers, such as
/* bench 26189.1.0 96350966d3df */
/* bench 26189.1.1 d710e25aee42 */
/* bench 26189.1.2 b5ce6f929877 */
/* bench 26189.1.3 41b7062f4f50 */
/* bench 26189.1.4 a2937ff89aa0 */
/* bench 26189.1.5 16da42532781 */
/* bench 26189.1.6 820b86663f0a */
/* bench 26189.1.7 5a4b059113d9 */
/* bench 26189.1.8 2ad25a5d4174 */
/* bench 26189.1.9 e830915bc6a0 */
	If built as a module, it will be called r8723bs.
```

## drivers/staging/rtl8821ae/Kconfig
```kconfig
FASTVC-BENCH-CORPUS:linux-main-100k-v1-e0bd41dc-8e12-4f1b-978d-a3645ae59da0
config R8821AE
	tristate "RealTek RTL8821AE Wireless LAN NIC driver"
	depends on PCI && WLAN
	depends on m
	select WIRELESS_EXT
	select WEXT_PRIV
	select EEPROM_93CX6
	select CRYPTO
	default N
	---help---
	  If built as a module, it will be called r8821ae.ko.
```

## drivers/staging/rts5139/Kconfig
```kconfig
FASTVC-BENCH-CORPUS:linux-main-100k-v1-e0bd41dc-8e12-4f1b-978d-a3645ae59da0
config RTS5139
	tristate "Realtek RTS5139 USB card reader support"
	depends on USB && SCSI
	help
	  Say Y here to include driver code to support the Realtek
	  RTS5139 USB card readers.

	  If this driver is compiled as a module, it will be named rts5139.

config RTS5139_DEBUG
	bool "Realtek RTS5139 Card Reader verbose debug"
	depends on RTS5139
	help
	  Say Y here in order to have the rts5139 code generate
	  verbose debugging messages.
```

## drivers/staging/rts_pstor/Kconfig
```kconfig
FASTVC-BENCH-CORPUS:linux-main-100k-v1-e0bd41dc-8e12-4f1b-978d-a3645ae59da0
config RTS_PSTOR
	tristate "RealTek PCI-E Card Reader support"
	depends on PCI && SCSI
	help
	  Say Y here to include driver code to support the Realtek
	  PCI-E card readers.

	  If this driver is compiled as a module, it will be named rts_pstor.

config RTS_PSTOR_DEBUG
	bool "Realtek PCI-E Card Reader verbose debug"
	depends on RTS_PSTOR
	help
	  Say Y here in order to have the rts_pstor code generate
	  verbose debugging messages.
```

## drivers/staging/samsung-laptop/Kconfig
```kconfig
FASTVC-BENCH-CORPUS:linux-main-100k-v1-e0bd41dc-8e12-4f1b-978d-a3645ae59da0
config SAMSUNG_LAPTOP
	tristate "Samsung Laptop driver"
	default n
	depends on RFKILL && BACKLIGHT_CLASS_DEVICE && X86
	help
	  This module implements a driver for the N128 Samsung Laptop
	  providing control over the Wireless LED and the LCD backlight

	  To compile this driver as a module, choose
	  M here: the module will be called samsung-laptop.
```

## drivers/staging/sb105x/Kconfig
```kconfig
FASTVC-BENCH-CORPUS:linux-main-100k-v1-e0bd41dc-8e12-4f1b-978d-a3645ae59da0
config SB105X
	tristate "SystemBase PCI Multiport UART"
	select SERIAL_CORE
	depends on PCI && BROKEN
	help
	  A driver for the SystemBase Multi-2/PCI serial card

	  To compile this driver a module, choose M here: the module
	  will be called "sb105x".
```

## drivers/staging/sbe-2t3e3/Kconfig
```kconfig
FASTVC-BENCH-CORPUS:linux-main-100k-v1-e0bd41dc-8e12-4f1b-978d-a3645ae59da0
config SBE_2T3E3
	tristate "SBE wanPMC-2T3E3 support"
	depends on HDLC && PCI
	help
	  Driver for wanPMC-2T3E3 cards by SBE Inc.

	  If you have such a card, say Y here and see
	  <http://www.kernel.org/pub/linux/utils/net/hdlc/>.

	  To compile this as a module, choose M here: the
	  module will be called sbe-2t3e3.

	  If unsure, say N.
```

## drivers/staging/sep/Kconfig
```kconfig
FASTVC-BENCH-CORPUS:linux-main-100k-v1-e0bd41dc-8e12-4f1b-978d-a3645ae59da0
config DX_SEP
	tristate "Discretix SEP driver"
	depends on PCI
	help
	  Discretix SEP driver; used for the security processor subsystem
	  on board the Intel Mobile Internet Device and adds SEP availability
	  to the kernel crypto infrastructure

	  The driver's name is sep_driver.

	  If unsure, select N.
```

## drivers/staging/serial/Kconfig
```kconfig
FASTVC-BENCH-CORPUS:linux-main-100k-v1-e0bd41dc-8e12-4f1b-978d-a3645ae59da0
config SERIAL_68360_SMC
	bool "68360 SMC uart support"
	depends on M68360
	help
	  This driver supports the SMC serial ports of the Motorola 68360 CPU.

config SERIAL_68360_SCC
	bool "68360 SCC uart support"
	depends on M68360
	help
	  This driver supports the SCC serial ports of the Motorola 68360 CPU.

config SERIAL_68360
	bool
	depends on SERIAL_68360_SMC || SERIAL_68360_SCC
	default y
```

## drivers/staging/serqt_usb2/Kconfig
```kconfig
FASTVC-BENCH-CORPUS:linux-main-100k-v1-e0bd41dc-8e12-4f1b-978d-a3645ae59da0
config USB_SERIAL_QUATECH2
	tristate "USB Quatech ESU-100 8 Port Serial Driver"
	depends on USB_SERIAL
	help
	  Say Y here if you want to use the Quatech ESU-100 8 port usb to
	  serial adapter.

	  To compile this driver as a module, choose M here: the
	  module will be called serqt_usb2.
```

## drivers/staging/skein/Kconfig
```kconfig
FASTVC-BENCH-CORPUS:linux-main-100k-v1-e0bd41dc-8e12-4f1b-978d-a3645ae59da0
config CRYPTO_SKEIN
	tristate "Skein digest algorithm"
	depends on (X86 || UML_X86) && 64BIT && CRYPTO
	select CRYPTO_HASH
	select CRYPTO_ALGAPI
	help
	  Skein secure hash algorithm is one of 5 finalists from the NIST SHA3
	  competition.

	  Skein is optimized for modern, 64bit processors and is highly
	  customizable.  See:

	  http://www.skein-hash.info/sites/default/files/skein1.3.pdf

	  for more information. This module also contains the threefish block
	  cipher algorithm.
```

## drivers/staging/slicoss/Kconfig
```kconfig
FASTVC-BENCH-CORPUS:linux-main-100k-v1-e0bd41dc-8e12-4f1b-978d-a3645ae59da0
config SLICOSS
	tristate "Alacritech Gigabit IS-NIC support"
	depends on PCI && X86 && NET
	default n
	help
	  This driver supports Alacritech's IS-NIC gigabit ethernet cards.

	  This includes the following devices:
	    Mojave cards (single port PCI Gigabit) both copper and fiber
	    Oasis cards (single and dual port PCI-x Gigabit) copper and fiber
	    Kalahari cards (dual and quad port PCI-e Gigabit) copper and fiber

	  To compile this driver as a module, choose M here: the module
	  will be called slicoss.
```

## drivers/staging/sm750fb/Kconfig
```kconfig
FASTVC-BENCH-CORPUS:linux-main-100k-v1-e0bd41dc-8e12-4f1b-978d-a3645ae59da0
/* bench 1984.4.0 d8fe5fcd60a6 */
/* bench 1984.4.1 1583af493be5 */
/* bench 1984.4.2 a00a1c416889 */
/* bench 1984.4.3 9edfe6094f9a */
/* bench 1984.4.4 bf7306097aad */
/* bench 24920.3.0 7aee4915fac3 */
/* bench 24920.3.1 7e36393b6206 */
/* bench 24920.3.2 ae2b118f8cd1 */
/* bench 24920.3.3 0867d9e26693 */
/* bench 24920.3.4 52e800d8557f */
/* bench 24920.3.5 9ba503e8a231 */
/* bench 24920.3.6 12284e840ea9 */
/* bench 1984.4.6 0fddf781055d */
/* bench 18041.3.0 cf47d8f04a5e */
/* bench 18041.3.1 ed0ee1f7c44e */
/* bench 18041.3.2 f541e5824688 */
/* bench 18041.3.3 6d83018e9cc3 */
/* bench 18041.3.4 c6ea13beac18 */
/* bench 18041.3.5 8041a024f55c */
/* bench 18041.3.6 42999f45cbda */
/* bench 18041.3.7 07d8c8bebe4b */
/* bench 18041.3.8 a349d8d11e70 */
/* bench 18041.3.9 6c8baee330f5 */
/* bench 18041.3.10 aec14a6abf7e */
/* bench 18041.3.11 e257b1431184 */
/* bench 18041.3.12 eafc60f52623 */
/* bench 1984.4.8 8666624e9313 */
config FB_SM750
	tristate "Silicon Motion SM750 framebuffer support"
	depends on FB && PCI
	select FB_MODE_HELPERS
	select FB_CFB_FILLRECT
	select FB_CFB_COPYAREA
	select FB_CFB_IMAGEBLIT
	help
	  Frame buffer driver for the Silicon Motion SM750 chip
	  with 2D accelearion and dual head support.

	  This driver is also available as a module. The module will be
	  called sm750fb. If you want to compile it as a module, say M
	  here and read <file:Documentation/kbuild/modules.rst>.
/* bench 5329.7.0 df6d435c4843 */
/* bench 5329.7.1 71a7229a8b19 */
/* bench 5329.7.2 c830ed2b43f3 */
/* bench 5329.7.3 d995e474e209 */
/* bench 5329.7.4 c1b5d5aa3798 */
/* bench 18523.0.0 79564fe9e00e */
/* bench 18523.0.1 9d9ef4a1786d */
/* bench 18523.0.2 258e85327c84 */
/* bench 18523.0.3 c3eb0ee36ddc */
/* bench 18523.0.4 959ae9cd41c8 */
/* bench 18523.0.5 6cdc517ac872 */
/* bench 18523.0.6 c07219497a83 */
/* bench 18523.0.7 9304584e2a3b */
/* bench 5329.7.8 f2e4810bc3f6 */
/* bench 5329.7.9 89b0b3344dce */
/* bench 5329.7.10 fdef8c4e34e6 */
/* bench 5329.7.11 bd721a3de842 */
/* bench 5329.7.12 b2e6be160ba7 */
/* bench 5329.7.13 6de7b88814bb */
/* bench 5329.7.14 953c777ce208 */
```
