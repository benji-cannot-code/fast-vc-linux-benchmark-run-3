## drivers/staging/vme/devices/Kconfig
```kconfig
FASTVC-BENCH-CORPUS:linux-main-100k-v1-e0bd41dc-8e12-4f1b-978d-a3645ae59da0
# SPDX-License-Identifier: GPL-2.0
comment "VME Device Drivers"

config VME_USER
	tristate "VME user space access driver"
	depends on STAGING
	help
	  If you say Y here you want to be able to access a limited number of
	  VME windows in a manner at least semi-compatible with the interface
	  provided with the original driver at <http://www.vmelinux.org/>.

	  To compile this driver as a module, choose M here. The module will
	  be called vme_user. If unsure, say N.
/* bench 11618.3.0 dabf920956d6 */
/* bench 12773.2.0 5092a029f8b7 */
/* bench 12773.2.1 a07d54b2dbc1 */
/* bench 12773.2.2 930453a4921c */
/* bench 12773.2.3 fd56a5fa0284 */
/* bench 12773.2.4 90fd9987d7e7 */
/* bench 12773.2.5 e1f094964d6d */
/* bench 12773.2.6 5e92859dd1ce */
/* bench 12773.2.7 b2809afe9288 */
/* bench 12773.2.8 3a536038be36 */
/* bench 12773.2.9 8b89877b45a3 */
/* bench 11618.3.2 6c92d964d86f */
/* bench 11618.3.3 16f9c1887c85 */
/* bench 11618.3.4 b6452aa57c68 */
/* bench 11618.3.5 307d2ffb60c2 */
/* bench 11618.3.6 b2cb03db649d */
/* bench 11618.3.7 68e24c208835 */
/* bench 11618.3.8 8b9caaa5b066 */
/* bench 11618.3.9 4ffd5c3e47a5 */
/* bench 11618.3.10 6ce78e6ecb74 */
/* bench 11618.3.11 17bb268c6492 */
/* bench 11618.3.12 6e701028ef98 */
/* bench 11618.3.13 237ed9b93308 */
/* bench 11618.3.14 4ecb2b22ee5a */
```
