## drivers/staging/ste_rmi4/Kconfig
```kconfig
FASTVC-BENCH-CORPUS:linux-main-100k-v1-e0bd41dc-8e12-4f1b-978d-a3645ae59da0
config TOUCHSCREEN_SYNAPTICS_I2C_RMI4
	tristate "Synaptics i2c rmi4 touchscreen"
	depends on I2C && INPUT
	help
	  Say Y here if you have a Synaptics RMI4 and
	  want to enable support for the built-in touchscreen.

	  To compile this driver as a module, choose M here: the
	  module will be called synaptics_rmi4_ts.
```

## drivers/staging/stradis/Kconfig
```kconfig
FASTVC-BENCH-CORPUS:linux-main-100k-v1-e0bd41dc-8e12-4f1b-978d-a3645ae59da0
config VIDEO_STRADIS
        tristate "Stradis 4:2:2 MPEG-2 video driver (DEPRECATED)"
        depends on EXPERIMENTAL && PCI && VIDEO_V4L1 && VIRT_TO_BUS
        help
          Say Y here to enable support for the Stradis 4:2:2 MPEG-2 video
          driver for PCI.  There is a product page at
          <http://www.stradis.com/>.
```

## drivers/staging/sxg/Kconfig
```kconfig
FASTVC-BENCH-CORPUS:linux-main-100k-v1-e0bd41dc-8e12-4f1b-978d-a3645ae59da0
config SXG
	tristate "Alacritech SLIC Technology Non-Accelerated 10Gbe support"
	depends on PCI && NETDEV_10000
	depends on X86
	default n
	help
	  This driver supports the Alacritech SLIC Technology Non-Accelerated
	  10Gbe network cards.

	  To compile this driver as a module, choose
	  M here: the module will be called sxg_nic.
```

## drivers/staging/typec/Kconfig
```kconfig
FASTVC-BENCH-CORPUS:linux-main-100k-v1-e0bd41dc-8e12-4f1b-978d-a3645ae59da0
menu "USB Power Delivery and Type-C drivers"

if TYPEC_TCPM

config TYPEC_TCPCI
	tristate "Type-C Port Controller Interface driver"
	depends on I2C
	select REGMAP_I2C
	help
	  Type-C Port Controller driver for TCPCI-compliant controller.

endif

endmenu
```

## drivers/staging/udlfb/Kconfig
```kconfig
FASTVC-BENCH-CORPUS:linux-main-100k-v1-e0bd41dc-8e12-4f1b-978d-a3645ae59da0
config FB_UDL
	tristate "Displaylink USB Framebuffer support"
	depends on FB && USB
	---help---
	  This is an experimental driver for DisplayLink USB devices
	  that provides a framebuffer device.  A normal framebuffer can
	  be used with this driver, or xorg can be run on the device
	  using it.
```

## drivers/staging/unisys/Kconfig
```kconfig
FASTVC-BENCH-CORPUS:linux-main-100k-v1-e0bd41dc-8e12-4f1b-978d-a3645ae59da0
# SPDX-License-Identifier: GPL-2.0
#
# Unisys SPAR driver configuration
#
/* bench 27290.4.0 5a93ea70c677 */
/* bench 27290.4.1 32ea5e7e3fef */
/* bench 27290.4.2 17a85a18d7d8 */
/* bench 27290.4.3 2828ee403462 */
/* bench 27290.4.4 785dd1db6ea1 */
/* bench 27290.4.5 22d3fac5450e */
/* bench 27290.4.6 6945b89a9a2d */
/* bench 27290.4.7 3308b02642b0 */
/* bench 27290.4.8 8a6aa81d007c */
/* bench 27290.4.9 5bf159adf3a3 */
/* bench 27290.4.10 a52d6be2949e */
	bool "Unisys SPAR driver support"
	help
	  Support for the Unisys SPAR drivers

if UNISYSSPAR

source "drivers/staging/unisys/visornic/Kconfig"
source "drivers/staging/unisys/visorinput/Kconfig"
source "drivers/staging/unisys/visorhba/Kconfig"

endif # UNISYSSPAR
```

## drivers/staging/unisys/channels/Kconfig
```kconfig
FASTVC-BENCH-CORPUS:linux-main-100k-v1-e0bd41dc-8e12-4f1b-978d-a3645ae59da0
#
# Unisys channels configuration
#

config UNISYS_CHANNELSTUB
	tristate "Unisys channelstub driver"
	depends on UNISYSSPAR
	---help---
	If you say Y here, you will enable the Unisys channels driver.
```

## drivers/staging/unisys/uislib/Kconfig
```kconfig
FASTVC-BENCH-CORPUS:linux-main-100k-v1-e0bd41dc-8e12-4f1b-978d-a3645ae59da0
#
# Unisys uislib configuration
#

config UNISYS_UISLIB
	tristate "Unisys uislib driver"
	depends on UNISYSSPAR && UNISYS_VISORCHIPSET && UNISYS_CHANNELSTUB && HAS_IOMEM
	---help---
	If you say Y here, you will enable the Unisys uislib driver.
```

## drivers/staging/unisys/virthba/Kconfig
```kconfig
FASTVC-BENCH-CORPUS:linux-main-100k-v1-e0bd41dc-8e12-4f1b-978d-a3645ae59da0
#
# Unisys virthba configuration
#

config UNISYS_VIRTHBA
	tristate "Unisys virthba driver"
	depends on SCSI
	select UNISYS_VISORCHIPSET
	select UNISYS_UISLIB
	select UNISYS_VIRTPCI
	---help---
	If you say Y here, you will enable the Unisys virthba driver.
```

## drivers/staging/unisys/virtpci/Kconfig
```kconfig
FASTVC-BENCH-CORPUS:linux-main-100k-v1-e0bd41dc-8e12-4f1b-978d-a3645ae59da0
#
# Unisys virtpci configuration
#

config UNISYS_VIRTPCI
	tristate "Unisys virtpci driver"
	depends on UNISYSSPAR && UNISYS_UISLIB
	---help---
	If you say Y here, you will enable the Unisys virtpci driver.
```

## drivers/staging/unisys/visorbus/Kconfig
```kconfig
FASTVC-BENCH-CORPUS:linux-main-100k-v1-e0bd41dc-8e12-4f1b-978d-a3645ae59da0
#
# Unisys visorbus configuration
#

config UNISYS_VISORBUS
	tristate "Unisys visorbus driver"
	depends on UNISYSSPAR
	---help---
	If you say Y here, you will enable the Unisys visorbus driver.
```

## drivers/staging/unisys/visorchannel/Kconfig
```kconfig
FASTVC-BENCH-CORPUS:linux-main-100k-v1-e0bd41dc-8e12-4f1b-978d-a3645ae59da0
#
# Unisys visorchannel configuration
#

config UNISYS_VISORCHANNEL
	tristate "Unisys visorchannel driver"
	depends on UNISYSSPAR && UNISYS_VISORUTIL
	---help---
	If you say Y here, you will enable the Unisys visorchannel driver.
```

## drivers/staging/unisys/visorchipset/Kconfig
```kconfig
FASTVC-BENCH-CORPUS:linux-main-100k-v1-e0bd41dc-8e12-4f1b-978d-a3645ae59da0
#
# Unisys visorchipset configuration
#

config UNISYS_VISORCHIPSET
	tristate "Unisys visorchipset driver"
	select UNISYS_VISORUTIL
	select UNISYS_VISORCHANNEL
	---help---
	If you say Y here, you will enable the Unisys visorchipset driver.
```

## drivers/staging/unisys/visorhba/Kconfig
```kconfig
FASTVC-BENCH-CORPUS:linux-main-100k-v1-e0bd41dc-8e12-4f1b-978d-a3645ae59da0
# SPDX-License-Identifier: GPL-2.0
#
# Unisys visorhba configuration
#

config UNISYS_VISORHBA
	tristate "Unisys visorhba driver"
	depends on UNISYSSPAR && UNISYS_VISORBUS && SCSI
	help
		The Unisys visorhba driver provides support for s-Par HBA
		devices exposed on the s-Par visorbus. When a message is sent
		to visorbus to create a HBA device, the probe function of
		visorhba is called to create the scsi device.
		If you say Y here, you will enable the Unisys visorhba driver.
```

## drivers/staging/unisys/visorinput/Kconfig
```kconfig
FASTVC-BENCH-CORPUS:linux-main-100k-v1-e0bd41dc-8e12-4f1b-978d-a3645ae59da0
# SPDX-License-Identifier: GPL-2.0
#
# Unisys visorinput configuration
#

config UNISYS_VISORINPUT
	tristate "Unisys visorinput driver"
	depends on UNISYSSPAR && UNISYS_VISORBUS && INPUT
	help
		The Unisys s-Par visorinput driver provides a virtualized system
		console (keyboard and mouse) that is accessible through the
		s-Par firmware's user interface. s-Par provides video using the EFI
		GOP protocol, so If this driver is not present, the Linux guest should
		still boot with visible output in the partition desktop, but keyboard
		and mouse interaction will not be available.

/* bench 7377.6.0 f15395da60b5 */
/* bench 7377.6.1 dc11a98bf48a */
/* bench 7377.6.2 510ed7e2f479 */
/* bench 7377.6.3 d3ba65252d74 */
/* bench 7377.6.4 fa20e4cd0d2f */
/* bench 7377.6.5 bea5d209ebae */
/* bench 7377.6.6 1ca118d2bb39 */
/* bench 7377.6.7 7a1439ddd0db */
/* bench 7377.6.8 e360a96f52f0 */
```

## drivers/staging/unisys/visorutil/Kconfig
```kconfig
FASTVC-BENCH-CORPUS:linux-main-100k-v1-e0bd41dc-8e12-4f1b-978d-a3645ae59da0
#
# Unisys timskmod configuration
#

config UNISYS_VISORUTIL
	tristate "Unisys visorutil driver"
	---help---
	If you say Y here, you will enable the Unisys visorutil driver.
```

## drivers/staging/usbvideo/Kconfig
```kconfig
FASTVC-BENCH-CORPUS:linux-main-100k-v1-e0bd41dc-8e12-4f1b-978d-a3645ae59da0
config VIDEO_USBVIDEO
	tristate

config USB_VICAM
	tristate "USB 3com HomeConnect (aka vicam) support (DEPRECATED)"
	depends on VIDEO_DEV && VIDEO_V4L2_COMMON && USB
	select VIDEO_USBVIDEO
	---help---
	  Say Y here if you have 3com homeconnect camera (vicam).

	  This driver uses the deprecated V4L1 API and will be removed in
	  2.6.39, unless someone converts it to the V4L2 API.

	  To compile this driver as a module, choose M here: the
	  module will be called vicam.
```

## drivers/staging/vboxsf/Kconfig
```kconfig
FASTVC-BENCH-CORPUS:linux-main-100k-v1-e0bd41dc-8e12-4f1b-978d-a3645ae59da0
config VBOXSF_FS
	tristate "VirtualBox guest shared folder (vboxsf) support"
	depends on X86 && VBOXGUEST
	select NLS
	help
	  VirtualBox hosts can share folders with guests, this driver
	  implements the Linux-guest side of this allowing folders exported
	  by the host to be mounted under Linux.

	  If you want to use shared folders in VirtualBox guests, answer Y or M.
```

## drivers/staging/vc04_services/Kconfig
```kconfig
FASTVC-BENCH-CORPUS:linux-main-100k-v1-e0bd41dc-8e12-4f1b-978d-a3645ae59da0
/* bench 21173.2.0 1faf91fe4a5d */
/* bench 21173.2.1 af9103786e3d */
/* bench 21173.2.2 d579c8f4c903 */
/* bench 21173.2.3 f72fd3ab0396 */
/* bench 21173.2.4 f2e9c0697069 */
/* bench 21173.2.5 4fcf4aabf797 */
/* bench 21173.2.6 f1d63389ace8 */
/* bench 21173.2.7 d06d05cd7582 */
/* bench 21173.2.8 effebf09c6b4 */
/* bench 21173.2.9 7d46251432bb */
/* bench 21173.2.10 c32510b5500a */
/* bench 21173.2.11 548545364e8c */
/* bench 21173.2.12 62296dc40f3b */
/* bench 21173.2.13 b82984ac014d */
/* bench 21173.2.14 749e92fd4c0d */
/* bench 21173.2.15 c134367740cf */
	depends on OF
	depends on RASPBERRYPI_FIRMWARE || (COMPILE_TEST && !RASPBERRYPI_FIRMWARE)
	default y
	help
		Support for Broadcom VideoCore services including
		the BCM2835 family of products which is used
		by the Raspberry PI.

if BCM_VIDEOCORE

config BCM2835_VCHIQ
	tristate "BCM2835 VCHIQ"
	help
/* bench 27134.4.0 6290f1c7af80 */
/* bench 27134.4.1 1e5f8a60f831 */
/* bench 27134.4.2 8eeafe952bcd */
/* bench 27134.4.3 2eca752b77bc */
/* bench 27134.4.4 8f8dbca8b304 */
/* bench 27134.4.5 f891b01e5ff0 */
/* bench 27134.4.6 f8250027fedb */
/* bench 27134.4.7 6caec8d9c2da */
/* bench 27134.4.8 970ab5ebac56 */
/* bench 27134.4.9 99a6dd6e0ab5 */
/* bench 27134.4.10 d4b06f530200 */
/* bench 27134.4.11 40ba47ed8512 */
/* bench 27134.4.12 4c6583704aed */
/* bench 27134.4.13 312c540a687c */
/* bench 27134.4.14 ae0157b78407 */
		Kernel to VideoCore communication interface for the
		BCM2835 family of products.
		Defaults to Y when the Broadcom Videocore services
		are included in the build, N otherwise.
/* bench 10976.3.0 9b5cb5c4106d */
/* bench 10976.3.1 bb28820f9b20 */
/* bench 10976.3.2 056aed062975 */
/* bench 10976.3.3 17f9cebc5cf5 */
/* bench 10976.3.4 b6db4438da4c */
/* bench 26163.3.0 29d2a2e7de47 */
/* bench 26163.3.1 2b95667cc67b */
/* bench 10976.3.8 681be3beca2d */
/* bench 10976.3.9 08ccf4ebf1cd */
/* bench 10976.3.10 9d2437c28d61 */
source "drivers/staging/vc04_services/bcm2835-camera/Kconfig"

source "drivers/staging/vc04_services/vchiq-mmal/Kconfig"

endif
```

## drivers/staging/vc04_services/bcm2835-audio/Kconfig
```kconfig
FASTVC-BENCH-CORPUS:linux-main-100k-v1-e0bd41dc-8e12-4f1b-978d-a3645ae59da0
/* bench 27436.4.0 8f003adaa971 */
/* bench 27436.4.1 e8256dba33e7 */
/* bench 27436.4.2 7e5eb45b9180 */
/* bench 27436.4.3 fbb88547b9a7 */
/* bench 27436.4.4 b45c8d5cc31e */
/* bench 27436.4.5 db82fb0eb736 */
/* bench 27436.4.6 09c5ec037eb5 */
/* bench 27436.4.7 3c50699b97f0 */
/* bench 27436.4.8 9912e8db6873 */
config SND_BCM2835
/* bench 3098.4.0 320994f11035 */
/* bench 3098.4.1 316cc04506c8 */
/* bench 18295.2.0 dc87e6e8ace5 */
/* bench 18295.2.1 055c1afa1c87 */
/* bench 18295.2.2 eb823be9354a */
/* bench 18295.2.3 50920d5702ef */
/* bench 18295.2.4 5c0eabdd7229 */
/* bench 18295.2.5 ac63388fb83a */
/* bench 18295.2.6 1486df12036c */
/* bench 18295.2.7 3a9a6f08110f */
/* bench 18295.2.8 071877645f18 */
/* bench 3098.4.4 fd2489fb9c26 */
/* bench 3098.4.5 9f4dd0801b8f */
/* bench 3098.4.6 a3e30541aac1 */
/* bench 3098.4.7 a5b401a443a7 */
/* bench 3098.4.8 b18b0ce1bd86 */
/* bench 3098.4.9 df72ba8d882b */
/* bench 3098.4.10 07f32d6f9132 */
	depends on (ARCH_BCM2835 || COMPILE_TEST) && SND
	select SND_PCM
	select BCM2835_VCHIQ
	help
	  Say Y or M if you want to support BCM2835 built in audio
```

## drivers/staging/vc04_services/bcm2835-camera/Kconfig
```kconfig
FASTVC-BENCH-CORPUS:linux-main-100k-v1-e0bd41dc-8e12-4f1b-978d-a3645ae59da0
# SPDX-License-Identifier: GPL-2.0
config VIDEO_BCM2835
	tristate "BCM2835 Camera"
	depends on MEDIA_SUPPORT
	depends on VIDEO_V4L2 && (ARCH_BCM2835 || COMPILE_TEST)
	select BCM2835_VCHIQ
	select BCM2835_VCHIQ_MMAL
	select VIDEOBUF2_VMALLOC
/* bench 17336.3.0 28db246ce1b3 */
/* bench 19935.1.0 698827c1c886 */
/* bench 19935.1.1 602230a0d8f5 */
/* bench 19935.1.2 9af0c50e3fa7 */
/* bench 19935.1.3 e627f22a002a */
/* bench 19935.1.4 4d9eb649c2c9 */
/* bench 19935.1.5 6acb7cb76777 */
/* bench 19935.1.6 773842ee743c */
/* bench 19935.1.7 74b4d3281bd3 */
/* bench 19935.1.8 e98d8b94e42d */
/* bench 19935.1.9 f98c39f53f4d */
/* bench 17336.3.4 081f042fb931 */
/* bench 17336.3.5 371eee356885 */
/* bench 17336.3.6 1253ee58482c */
/* bench 17336.3.7 532ec1111ba0 */
/* bench 17336.3.8 264dd2b7e3d7 */
	select BTREE
	help
	  Say Y here to enable camera host interface devices for
	  Broadcom BCM2835 SoC. This operates over the VCHIQ interface
	  to a service running on VideoCore.
```

## drivers/staging/vc04_services/vchiq-mmal/Kconfig
```kconfig
FASTVC-BENCH-CORPUS:linux-main-100k-v1-e0bd41dc-8e12-4f1b-978d-a3645ae59da0
config BCM2835_VCHIQ_MMAL
	tristate "BCM2835 MMAL VCHIQ service"
	depends on BCM2835_VCHIQ
	help
	  Enables the MMAL API over VCHIQ interface as used for the
	  majority of the multimedia services on VideoCore.
/* bench 1277.7.0 cbd1262dbec6 */
/* bench 1277.7.1 c55c70e44176 */
/* bench 1277.7.2 c3e65d09f417 */
/* bench 1277.7.3 aa439b8b976a */
/* bench 1277.7.4 451bea43fa48 */
/* bench 1277.7.5 f6b661b151f0 */
/* bench 1277.7.6 b08bd44b39c0 */
/* bench 1277.7.7 3bcba0414467 */
/* bench 21530.2.0 7b380085e35b */
/* bench 21530.2.1 82579fc5378c */
/* bench 21530.2.2 7ded725f7e0d */
/* bench 21530.2.3 8b7c3cffa906 */
/* bench 21530.2.4 f3f1037ff1bb */
/* bench 21530.2.5 4b6dcc47d1a9 */
/* bench 21530.2.6 3535ff64a77d */
/* bench 21530.2.7 66d14f92849d */
/* bench 21530.2.8 18b122c0364e */
/* bench 21530.2.9 949321cfada3 */
/* bench 1277.7.9 812623b7a1b1 */
	  Defaults to Y when the Broadcomd BCM2835 camera host is selected.
```

## drivers/staging/vme/bridges/Kconfig
```kconfig
FASTVC-BENCH-CORPUS:linux-main-100k-v1-e0bd41dc-8e12-4f1b-978d-a3645ae59da0
comment "VME Bridge Drivers"

config VME_CA91CX42
	tristate "Universe II"
	depends on VIRT_TO_BUS
	help
	 If you say Y here you get support for the Tundra CA91C142
	 (Universe II) VME bridge chip.

config VME_TSI148
	tristate "Tempe"
	depends on VIRT_TO_BUS
	help
	 If you say Y here you get support for the Tundra TSI148 VME bridge
	 chip.
```
