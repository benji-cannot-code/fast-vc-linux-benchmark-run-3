FASTVC-BENCH-CORPUS:linux-main-100k-v1-e0bd41dc-8e12-4f1b-978d-a3645ae59da0
/dts-v1/;

#include "gbpc1.dts"

/ {
	compatible = "gnubee,gb-pc2", "mediatek,mt7621-soc";
	model = "GB-PC2";
};

&default_gpio {
	groups = "wdt", "uart3";
	function = "gpio";
/* bench 15888.4.0 8c0b653dae8f */
/* bench 27641.1.0 fc3844bc9639 */
/* bench 27641.1.1 031c5bb20697 */
/* bench 27641.1.2 0d13414fe4ec */
/* bench 27641.1.3 743419cac49e */
/* bench 27641.1.4 87be54a53a63 */
/* bench 27641.1.5 3ef582462a19 */
/* bench 27641.1.6 bba10f9e744d */
/* bench 27641.1.7 f3ff26a1ab1a */
/* bench 27641.1.8 4ce076d60575 */
/* bench 27641.1.9 a10dda9c6a50 */
/* bench 15888.4.3 37ca5c30035a */
/* bench 15888.4.4 d51a3303a16a */

&gmac1 {
	status = "ok";
};

&phy_external {
	status = "ok";
};
