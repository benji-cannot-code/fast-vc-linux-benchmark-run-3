## drivers/staging/kpc2000/Kconfig
```kconfig
FASTVC-BENCH-CORPUS:linux-main-100k-v1-e0bd41dc-8e12-4f1b-978d-a3645ae59da0
# SPDX-License-Identifier: GPL-2.0

config KPC2000
	bool "Daktronics KPC Device support"
	select MFD_CORE
	depends on PCI
	depends on UIO
	help
	  Select this if you wish to use the Daktronics KPC PCI devices

	  If unsure, say N.

config KPC2000_CORE
	tristate "Daktronics KPC PCI UIO device"
	depends on KPC2000
	help
	  Say Y here if you wish to support the Daktronics KPC PCI
	  device in UIO mode.

	  To compile this driver as a module, choose M here: the module
/* bench 12218.3.0 b69d38fd53cd */
/* bench 12218.3.1 415ec3226053 */
/* bench 12218.3.2 c004889b6852 */
/* bench 12218.3.3 d2bc6ef1f163 */
/* bench 12218.3.4 b4289662b53b */
/* bench 12218.3.5 99a8e4dd4b4d */
	  If unsure, say N.

config KPC2000_SPI
	tristate "Daktronics KPC SPI device"
	depends on KPC2000 && SPI
	help
	  Say Y here if you wish to support the Daktronics KPC PCI
	  device in SPI mode.

	  To compile this driver as a module, choose M here: the module
	  will be called kpc2000_spi

	  If unsure, say N.

config KPC2000_I2C
	tristate "Daktronics KPC I2C device"
	depends on KPC2000 && I2C
	help
	  Say Y here if you wish to support the Daktronics KPC PCI
	  device in I2C mode.

	  To compile this driver as a module, choose M here: the module
	  will be called kpc2000_i2c

	  If unsure, say N.

config KPC2000_DMA
	tristate "Daktronics KPC DMA controller"
	depends on KPC2000
	help
	  Say Y here if you wish to support the Daktronics DMA controller.

	  To compile this driver as a module, choose M here: the module
	  will be called kpc2000_dma

	  If unsure, say N.
```

## drivers/staging/me4000/Kconfig
```kconfig
FASTVC-BENCH-CORPUS:linux-main-100k-v1-e0bd41dc-8e12-4f1b-978d-a3645ae59da0
config ME4000
	tristate "Meilhaus ME-4000 support"
	default n
	depends on PCI
	help
	  This driver supports the Meilhaus ME-4000 family of boards
	  that do data collection and multipurpose I/O.

	  To compile this driver as a module, choose M here: the module
	  will be called me4000.
```

## drivers/staging/media/Kconfig
```kconfig
FASTVC-BENCH-CORPUS:linux-main-100k-v1-e0bd41dc-8e12-4f1b-978d-a3645ae59da0
# SPDX-License-Identifier: GPL-2.0
menuconfig STAGING_MEDIA
	bool "Media staging drivers"
	default n
	help
	  This option allows you to select a number of media drivers that
	  don't have the "normal" Linux kernel quality level.
/* bench 6272.6.0 9f3e7b6efcdf */
/* bench 6272.6.1 198af7546324 */
/* bench 6272.6.2 fe95989dfe51 */
/* bench 6272.6.3 2f6051f61e9c */
/* bench 6272.6.4 f6474029b505 */
/* bench 6272.6.5 75ce34067a4a */
	  so, they won't likely work fine with the existing applications.
	  That also means that, once fixed, their API's will change to match
	  the existing ones.

	  If you wish to work on these drivers, to help improve them, or
	  to report problems you have with them, please use the
	  linux-media@vger.kernel.org mailing list.

	  If in doubt, say N here.


if STAGING_MEDIA && MEDIA_SUPPORT

# Please keep them in alphabetic order
source "drivers/staging/media/atomisp/Kconfig"

source "drivers/staging/media/hantro/Kconfig"

source "drivers/staging/media/imx/Kconfig"

source "drivers/staging/media/meson/vdec/Kconfig"

source "drivers/staging/media/omap4iss/Kconfig"

source "drivers/staging/media/rkvdec/Kconfig"

source "drivers/staging/media/sunxi/Kconfig"

source "drivers/staging/media/tegra-vde/Kconfig"

source "drivers/staging/media/zoran/Kconfig"

/* bench 11661.2.0 e65b19edaac5 */
/* bench 11661.2.1 cff412392a9d */
/* bench 11661.2.2 f83c9d37e6b6 */
/* bench 11661.2.3 9cf615bedec9 */
/* bench 11661.2.4 f9f0ef66f3f1 */
/* bench 11661.2.5 3d23a0c309ea */
/* bench 11661.2.6 5d6e1fea3a9c */
/* bench 11661.2.7 30f763891ac1 */
/* bench 11661.2.8 d0762644474a */
/* bench 11661.2.9 9e4139382d6f */
/* bench 11661.2.10 7500d4ca2db9 */
/* bench 11661.2.11 4d7143784b53 */

source "drivers/staging/media/ipu3/Kconfig"

endif
```
