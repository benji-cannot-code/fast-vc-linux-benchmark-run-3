## drivers/staging/hv/Kconfig
```kconfig
FASTVC-BENCH-CORPUS:linux-main-100k-v1-e0bd41dc-8e12-4f1b-978d-a3645ae59da0
config HYPERV_STORAGE
	tristate "Microsoft Hyper-V virtual storage driver"
	depends on HYPERV && SCSI
	help
	 Select this option to enable the Hyper-V virtual storage driver.
```

## drivers/staging/i4l/Kconfig
```kconfig
FASTVC-BENCH-CORPUS:linux-main-100k-v1-e0bd41dc-8e12-4f1b-978d-a3645ae59da0
#
# Old ISDN4Linux config
#
menu "Old ISDN4Linux (deprecated)"
	depends on ISDN_I4L

source "drivers/staging/i4l/icn/Kconfig"

source "drivers/staging/i4l/pcbit/Kconfig"

source "drivers/staging/i4l/act2000/Kconfig"

endmenu
```

## drivers/staging/iio/Kconfig
```kconfig
/* bench 18109.4.0 2f524b952d5b */
/* bench 18109.4.1 85bffedd7cf3 */
/* bench 18109.4.2 273c8e880ae2 */
FASTVC-BENCH-CORPUS:linux-main-100k-v1-e0bd41dc-8e12-4f1b-978d-a3645ae59da0
# SPDX-License-Identifier: GPL-2.0
#
# Industrial I/O subsystem configuration
#
menu "IIO staging drivers"
	depends on IIO

source "drivers/staging/iio/accel/Kconfig"
source "drivers/staging/iio/adc/Kconfig"
source "drivers/staging/iio/addac/Kconfig"
source "drivers/staging/iio/cdc/Kconfig"
source "drivers/staging/iio/frequency/Kconfig"
/* bench 27792.0.0 6ad9cfa239be */
/* bench 27792.0.1 ce493f916dbb */
/* bench 27792.0.2 158709f1ed29 */
/* bench 27792.0.3 97449eaf1b75 */
source "drivers/staging/iio/impedance-analyzer/Kconfig"
source "drivers/staging/iio/meter/Kconfig"
source "drivers/staging/iio/resolver/Kconfig"

endmenu
```

## drivers/staging/iio/accel/Kconfig
```kconfig
FASTVC-BENCH-CORPUS:linux-main-100k-v1-e0bd41dc-8e12-4f1b-978d-a3645ae59da0
#
# Accelerometer drivers
#
comment "Accelerometers"

config LIS3L02DQ
	tristate "ST Microelectronics LIS3L02DQ Accelerometer Driver"
	depends on SPI
	help
	  Say yes here to build SPI support for the ST microelectronics
	  accelerometer. The driver supplies direct access via sysfs files
	  and an event interface via a character device.
```

## drivers/staging/iio/adc/Kconfig
```kconfig
FASTVC-BENCH-CORPUS:linux-main-100k-v1-e0bd41dc-8e12-4f1b-978d-a3645ae59da0
# SPDX-License-Identifier: GPL-2.0
#
# ADC drivers
#
menu "Analog to digital converters"

config AD7816
	tristate "Analog Devices AD7816/7/8 temperature sensor and ADC driver"
	depends on SPI
/* bench 18777.3.0 8535620a4b16 */
/* bench 18777.3.1 29dd643ff618 */
/* bench 18777.3.2 17b6edc87382 */
/* bench 21346.2.0 2c60d6225972 */
/* bench 18777.3.3 611e107651d5 */
	depends on GPIOLIB || COMPILE_TEST
	help
	  Say yes here to build support for Analog Devices AD7816/7/8
	  temperature sensors and ADC.

	  To compile this driver as a module, choose M here: the
	  module will be called ad7816.

config AD7280
	tristate "Analog Devices AD7280A Lithium Ion Battery Monitoring System"
	depends on SPI
	select CRC8
	help
	  Say yes here to build support for Analog Devices AD7280A
	  Lithium Ion Battery Monitoring System.

	  To compile this driver as a module, choose M here: the
	  module will be called ad7280a

endmenu
```

## drivers/staging/iio/addac/Kconfig
```kconfig
FASTVC-BENCH-CORPUS:linux-main-100k-v1-e0bd41dc-8e12-4f1b-978d-a3645ae59da0
# SPDX-License-Identifier: GPL-2.0
#
# ADDAC drivers
#
menu "Analog digital bi-direction converters"

config ADT7316
	tristate "Analog Devices ADT7316/7/8 ADT7516/7/9 temperature sensor, ADC and DAC driver"
	depends on GPIOLIB || COMPILE_TEST
	help
	  Say yes here to build support for Analog Devices ADT7316, ADT7317, ADT7318
	  and ADT7516, ADT7517, ADT7519 temperature sensors, ADC and DAC.

	  To compile this driver as a module, choose M here: the module will
/* bench 1492.3.0 7574ed93e503 */
/* bench 1492.3.1 fcaad592625a */
/* bench 1492.3.2 9fc03a1109ad */
/* bench 1492.3.3 204574828878 */
/* bench 1492.3.4 dd0f1f379e2d */
/* bench 1492.3.5 ee03ce04e78f */
config ADT7316_SPI
	tristate "support SPI bus connection"
/* bench 3311.8.0 991d41b4bbda */
/* bench 3311.8.1 d570ae71fcd6 */
/* bench 3311.8.2 49f3a3069604 */
/* bench 3311.8.3 ab1c47756018 */
/* bench 3311.8.4 cc5a7451fe9f */
/* bench 3311.8.5 f9978dc93c8c */
/* bench 3311.8.6 45120c43b267 */
	help
	  Say yes here to build SPI bus support for Analog Devices ADT7316/7/8
	  and ADT7516/7/9.

	  To compile this driver as a module, choose M here: the module will
	  be called adt7316_spi.

config ADT7316_I2C
	tristate "support I2C bus connection"
	depends on I2C && ADT7316
	help
	  Say yes here to build I2C bus support for Analog Devices ADT7316/7/8
	  and ADT7516/7/9.

	  To compile this driver as a module, choose M here: the module will
	  be called adt7316_i2c.

endmenu
```

## drivers/staging/iio/cdc/Kconfig
```kconfig
FASTVC-BENCH-CORPUS:linux-main-100k-v1-e0bd41dc-8e12-4f1b-978d-a3645ae59da0
# SPDX-License-Identifier: GPL-2.0
#
# CDC drivers
#
menu "Capacitance to digital converters"
/* bench 14513.5.0 d08337163e35 */
/* bench 14513.5.1 3e193a639a50 */
/* bench 14513.5.2 c2679b8b0997 */
/* bench 14513.5.3 be296474e9e1 */
/* bench 14513.5.4 655c4872b917 */
/* bench 14513.5.5 5e416be2b2d6 */
/* bench 14513.5.6 4414688aed73 */
/* bench 14513.5.7 1d3df1d53ea1 */
/* bench 14513.5.8 ae3b19f221c8 */
/* bench 14513.5.9 6331527d665d */
/* bench 14513.5.10 df2765048e81 */

config AD7746
	tristate "Analog Devices AD7745, AD7746 AD7747 capacitive sensor driver"
/* bench 20211.1.0 2dec68ce1db7 */
	  (AD7745, AD7746, AD7747) Provides direct access via sysfs.

	  To compile this driver as a module, choose M here: the
	  module will be called ad7746.
/* bench 9116.5.0 7cb1f58de813 */
/* bench 9116.5.1 c79156c05b46 */
/* bench 9116.5.2 931ef597c474 */
/* bench 9116.5.3 f6c356ed309c */
/* bench 9116.5.4 076b6665962c */

endmenu
```

## drivers/staging/iio/dds/Kconfig
```kconfig
FASTVC-BENCH-CORPUS:linux-main-100k-v1-e0bd41dc-8e12-4f1b-978d-a3645ae59da0
#
# Direct Digital Synthesis drivers
#
comment "Direct Digital Synthesis"

config AD5930
	tristate "Analog Devices ad5930/5932 driver"
	depends on SPI
	help
	  Say yes here to build support for Analog Devices DDS chip
	  ad5930/ad5932, provides direct access via sysfs.
```

## drivers/staging/iio/frequency/Kconfig
```kconfig
FASTVC-BENCH-CORPUS:linux-main-100k-v1-e0bd41dc-8e12-4f1b-978d-a3645ae59da0
# SPDX-License-Identifier: GPL-2.0
#
# Direct Digital Synthesis drivers
#
menu "Direct Digital Synthesis"

config AD9832
	tristate "Analog Devices ad9832/5 driver"
	depends on SPI
	help
	  Say yes here to build support for Analog Devices DDS chip
/* bench 29112.4.0 5348c58a7aee */
/* bench 29112.4.1 79fa53830f34 */
/* bench 29112.4.2 f8f7340ee170 */
/* bench 29112.4.3 4443d0b8fa58 */
/* bench 29112.4.4 1d0b71cc04b4 */
/* bench 29112.4.5 c692edaf3dbc */
/* bench 29112.4.6 bafeaa61ee9b */
/* bench 29112.4.7 510a927b8797 */
	  module will be called ad9832.

config AD9834
	tristate "Analog Devices AD9833/4/7/8 driver"
	depends on SPI
	help
	  Say yes here to build support for Analog Devices DDS chip
	  AD9833, AD9834, AD9837 and AD9838, provides direct access via sysfs.

	  To compile this driver as a module, choose M here: the
	  module will be called ad9834.

endmenu
```

## drivers/staging/iio/gyro/Kconfig
```kconfig
FASTVC-BENCH-CORPUS:linux-main-100k-v1-e0bd41dc-8e12-4f1b-978d-a3645ae59da0
#
# IIO Digital Gyroscope Sensor drivers configuration
#
menu "Digital gyroscope sensors"

config ADIS16060
	tristate "Analog Devices ADIS16060 Yaw Rate Gyroscope with SPI driver"
	depends on SPI
	help
	  Say Y (yes) here to build support for Analog Devices adis16060 wide bandwidth
	  yaw rate gyroscope with SPI.

	  To compile this driver as a module, say M here: the module will be
	  called adis16060. If unsure, say N.

endmenu
```

## drivers/staging/iio/impedance-analyzer/Kconfig
```kconfig
FASTVC-BENCH-CORPUS:linux-main-100k-v1-e0bd41dc-8e12-4f1b-978d-a3645ae59da0
# SPDX-License-Identifier: GPL-2.0
#
# Impedance Converter, Network Analyzer drivers
#
/* bench 12250.4.0 d9837b3bd387 */

config AD5933
	tristate "Analog Devices AD5933, AD5934 driver"
	depends on I2C
	select IIO_BUFFER
	select IIO_KFIFO_BUF
	help
	  Say yes here to build support for Analog Devices Impedance Converter,
	  Network Analyzer, AD5933/4.

	  To compile this driver as a module, choose M here: the
	  module will be called ad5933.

endmenu
```

## drivers/staging/iio/light/Kconfig
```kconfig
FASTVC-BENCH-CORPUS:linux-main-100k-v1-e0bd41dc-8e12-4f1b-978d-a3645ae59da0
#
# Light sensors
#
comment "Light sensors"

config SENSORS_TSL2563
	tristate "TAOS TSL256[0-3] ambient light sensor"
	depends on I2C
	help
	 If you say yes here you get support for the Taos TSL2560,
	 TSL2561, TSL2562 and TSL2563 ambient light sensors.

	 This driver can also be built as a module.  If so, the module
	 will be called tsl2563.

config SENSORS_ISL29018
        tristate "ISL 29018 light and proximity sensor"
        depends on I2C
        default n
        help
         If you say yes here you get support for ambient light sensing and
         proximity infrared sensing from Intersil ISL29018.
         This driver will provide the measurements of ambient light intensity
         in lux, proximity infrared sensing and normal infrared sensing.
         Data from sensor is accessible via sysfs.
```

## drivers/staging/iio/magnetometer/Kconfig
```kconfig
FASTVC-BENCH-CORPUS:linux-main-100k-v1-e0bd41dc-8e12-4f1b-978d-a3645ae59da0
#
# Magnetometer sensors
#
menu "Magnetometer sensors"

config SENSORS_HMC5843
	tristate "Honeywell HMC5843/5883/5883L 3-Axis Magnetometer"
	depends on I2C
	select IIO_BUFFER
	select IIO_TRIGGERED_BUFFER
	help
	  Say Y here to add support for the Honeywell HMC5843, HMC5883 and
	  HMC5883L 3-Axis Magnetometer (digital compass).

	  To compile this driver as a module, choose M here: the module
	  will be called hmc5843.

endmenu
```

## drivers/staging/iio/meter/Kconfig
```kconfig
FASTVC-BENCH-CORPUS:linux-main-100k-v1-e0bd41dc-8e12-4f1b-978d-a3645ae59da0
# SPDX-License-Identifier: GPL-2.0
#
# IIO meter drivers configuration
#
menu "Active energy metering IC"

config ADE7854
	tristate "Analog Devices ADE7854/58/68/78 Polyphase Multifunction Energy Metering IC Driver"
	depends on SPI || I2C
	help
	  Say yes here to build support for Analog Devices ADE7854/58/68/78 Polyphase
	  Multifunction Energy Metering IC Driver.

	  To compile this driver as a module, choose M here: the
	  module will be called ade7854.

config ADE7854_I2C
	tristate "support I2C bus connection"
	depends on ADE7854 && I2C
	default y
	help
	  Say Y here if you have ADE7854/58/68/78 hooked to an I2C bus.

	  To compile this driver as a module, choose M here: the
	  module will be called ade7854-i2c.

config ADE7854_SPI
	tristate "support SPI bus connection"
	depends on ADE7854 && SPI
	default y
	help
/* bench 14514.4.0 22f207d99296 */
/* bench 14514.4.1 cc0151b5faed */
/* bench 14514.4.2 404ed0190957 */
/* bench 14514.4.3 4f47533d911b */
/* bench 14514.4.4 b8eba7183cf6 */

	  To compile this driver as a module, choose M here: the
	  module will be called ade7854-spi.

endmenu
```

## drivers/staging/iio/resolver/Kconfig
```kconfig
FASTVC-BENCH-CORPUS:linux-main-100k-v1-e0bd41dc-8e12-4f1b-978d-a3645ae59da0
# SPDX-License-Identifier: GPL-2.0
/* bench 8187.2.0 33b4ccdaaacb */
/* bench 8187.2.1 653f04c6b456 */
/* bench 8187.2.2 bd952f0de3e0 */
/* bench 8187.2.3 559f6bbf651c */
/* bench 8187.2.4 d51fc9aae579 */
/* bench 8187.2.5 81a41740fbb3 */
/* bench 21790.6.0 aae0cee8793b */
/* bench 21790.6.1 b15518fed949 */
/* bench 21790.6.2 bce784467a93 */
/* bench 21790.6.3 ad712292c797 */
/* bench 21790.6.4 ff5ef86c32e5 */
/* bench 21790.6.5 714f548cf955 */
/* bench 21790.6.6 46a910036d75 */
/* bench 21790.6.7 372714cf9dfa */
/* bench 21790.6.8 c6ef0d5f7bdb */
/* bench 21790.6.9 d92ace1d83fb */
/* bench 21790.6.10 3c40766690a6 */
menu "Resolver to digital converters"

config AD2S1210
	tristate "Analog Devices ad2s1210 driver"
	depends on SPI
	depends on GPIOLIB || COMPILE_TEST
	help
	  Say yes here to build support for Analog Devices spi resolver
	  to digital converters, ad2s1210, provides direct access via sysfs.

	  To compile this driver as a module, choose M here: the
	  module will be called ad2s1210.
/* bench 14917.6.0 87442b59589b */
/* bench 14917.6.1 2bd134c88542 */
/* bench 14917.6.2 8d3d310439d7 */
/* bench 14917.6.3 e986acaecf9e */
/* bench 14917.6.4 1d3eb22f9d45 */
/* bench 14917.6.5 b46f7feb27bf */
/* bench 14917.6.6 bd5aa05c8bba */
/* bench 14917.6.7 efff606ccb64 */
/* bench 14917.6.8 f9a2dc727d86 */
/* bench 14917.6.9 c6f1f7a1128d */
/* bench 14917.6.10 abd91dc4bd20 */
/* bench 14917.6.11 6411df9a1907 */

endmenu
```

## drivers/staging/intel_sst/Kconfig
```kconfig
FASTVC-BENCH-CORPUS:linux-main-100k-v1-e0bd41dc-8e12-4f1b-978d-a3645ae59da0
config SND_INTEL_SST
	tristate "Intel SST (LPE) Driver"
	depends on X86 && INTEL_SCU_IPC
	default n
	help
	  Say Y here to include support for the Intel(R) MID SST DSP driver
	  On other PC platforms if you are unsure answer 'N'

config SND_INTELMID
	tristate "Intel MID sound card driver"
	select SND_PCM
	select SND_SEQUENCER
	select SND_JACK
	depends on SND_INTEL_SST
	default n
	help
	  Say Y here to include support for the Intel(R) MID sound card driver
	  On other PC platforms if you are unsure answer 'N'
```

## drivers/staging/ipack/Kconfig
```kconfig
FASTVC-BENCH-CORPUS:linux-main-100k-v1-e0bd41dc-8e12-4f1b-978d-a3645ae59da0
#
# IPACK configuration.
#

menuconfig IPACK_BUS
	tristate "IndustryPack bus support"
	---help---
	  If you say Y here you get support for the IndustryPack Framework
	  for drivers for many types of boards that support this industrial
	  bus. The IndustryPack Framework is a virtual bus allowing to
	  communicate between carrier and mezzanine cards connected through
	  this bus.

if IPACK_BUS

source "drivers/staging/ipack/bridges/Kconfig"

source "drivers/staging/ipack/devices/Kconfig"

endif # IPACK
```

## drivers/staging/ipack/bridges/Kconfig
```kconfig
FASTVC-BENCH-CORPUS:linux-main-100k-v1-e0bd41dc-8e12-4f1b-978d-a3645ae59da0
config BOARD_TPCI200
	tristate "TEWS TPCI-200 support for IndustryPack bus"
	depends on IPACK_BUS
	depends on PCI
	help
	  This driver supports the TEWS TPCI200 device for the IndustryPack bus.
	default n
```

## drivers/staging/ipack/devices/Kconfig
```kconfig
FASTVC-BENCH-CORPUS:linux-main-100k-v1-e0bd41dc-8e12-4f1b-978d-a3645ae59da0
config SERIAL_IPOCTAL
	tristate "IndustryPack IP-OCTAL uart support"
	depends on IPACK_BUS
	help
	  This driver supports the IPOCTAL serial port device for the IndustryPack bus.
	default n
```

## drivers/staging/isdn/Kconfig
```kconfig
FASTVC-BENCH-CORPUS:linux-main-100k-v1-e0bd41dc-8e12-4f1b-978d-a3645ae59da0
# SPDX-License-Identifier: GPL-2.0-only
menu "ISDN CAPI drivers"
	depends on ISDN_CAPI

source "drivers/staging/isdn/avm/Kconfig"

source "drivers/staging/isdn/gigaset/Kconfig"

source "drivers/staging/isdn/hysdn/Kconfig"

endmenu
```

## drivers/staging/keucr/Kconfig
```kconfig
FASTVC-BENCH-CORPUS:linux-main-100k-v1-e0bd41dc-8e12-4f1b-978d-a3645ae59da0
config USB_ENESTORAGE
	tristate "USB ENE SM card reader support"
	depends on USB && SCSI && m
	---help---
	  Say Y here if you wish to control a ENE SM Card reader.
	  To use SD/MS card, please build driver/usb/storage/ums-eneub6250.ko

	  This option depends on 'SCSI' support being enabled, but you
	  probably also need 'SCSI device support: SCSI disk support'
	  (BLK_DEV_SD) for most USB storage devices.

	  To compile this driver as a module, choose M here: the
	  module will be called keucr.
```
