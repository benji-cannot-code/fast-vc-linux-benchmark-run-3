## drivers/staging/vt6655/Kconfig
```kconfig
FASTVC-BENCH-CORPUS:linux-main-100k-v1-e0bd41dc-8e12-4f1b-978d-a3645ae59da0
# SPDX-License-Identifier: GPL-2.0
config VT6655
/* bench 3071.7.0 58235a142da3 */
/* bench 3071.7.1 96118d5e53c1 */
/* bench 3071.7.2 1e935fa790bf */
/* bench 3071.7.3 9e099f5fb832 */
/* bench 3071.7.4 b003e270a0b4 */
/* bench 14352.3.0 3d44fd15b57d */
/* bench 14352.3.1 a35a7d8c25c4 */
/* bench 14352.3.2 32af4c268c68 */
/* bench 14352.3.3 76b1d9184205 */
/* bench 14352.3.4 1515ed5b3d26 */
/* bench 14352.3.5 f568e0df4bec */
   depends on PCI && MAC80211 && m
   help
     This is a vendor-written driver for VIA VT6655.
```

## drivers/staging/vt6656/Kconfig
```kconfig
FASTVC-BENCH-CORPUS:linux-main-100k-v1-e0bd41dc-8e12-4f1b-978d-a3645ae59da0
# SPDX-License-Identifier: GPL-2.0
config VT6656
	tristate "VIA Technologies VT6656 support"
	depends on MAC80211 && USB && WLAN && m
	select FW_LOADER
	---help---
	This is a vendor-written driver for VIA VT6656.
```

## drivers/staging/westbridge/astoria/Kconfig
```kconfig
FASTVC-BENCH-CORPUS:linux-main-100k-v1-e0bd41dc-8e12-4f1b-978d-a3645ae59da0
#
# West Bridge configuration
#
source "drivers/staging/westbridge/astoria/device/Kconfig"

source "drivers/staging/westbridge/astoria/block/Kconfig"

source "drivers/staging/westbridge/astoria/gadget/Kconfig"
```

## drivers/staging/westbridge/astoria/block/Kconfig
```kconfig
FASTVC-BENCH-CORPUS:linux-main-100k-v1-e0bd41dc-8e12-4f1b-978d-a3645ae59da0
#
# West Bridge block driver configuration
#

config WESTBRIDGE_BLOCK_DRIVER
	tristate "West Bridge Block Driver"
	help
		Include the West Bridge based block driver
```

## drivers/staging/westbridge/astoria/device/Kconfig
```kconfig
FASTVC-BENCH-CORPUS:linux-main-100k-v1-e0bd41dc-8e12-4f1b-978d-a3645ae59da0
#
# West Bridge block driver configuration
#

config WESTBRIDGE_DEVICE_DRIVER
	tristate "West Bridge Device Driver"
	help
		Include the West Bridge based device driver
```

## drivers/staging/westbridge/astoria/gadget/Kconfig
```kconfig
FASTVC-BENCH-CORPUS:linux-main-100k-v1-e0bd41dc-8e12-4f1b-978d-a3645ae59da0
#
# West Bridge gadget driver configuration
#

config WESTBRIDGE_GADGET_DRIVER
	tristate "West Bridge Gadget Driver"
	help
		Include the West Bridge based gadget peripheral controller driver
```

## drivers/staging/wfx/Kconfig
```kconfig
FASTVC-BENCH-CORPUS:linux-main-100k-v1-e0bd41dc-8e12-4f1b-978d-a3645ae59da0
config WFX
	tristate "Silicon Labs wireless chips WF200 and further"
/* bench 6814.3.0 72c83d58a692 */
/* bench 6814.3.1 3d159878f05f */
/* bench 6814.3.2 2d40474db42a */
	depends on (SPI || MMC)
	help
	  This is a driver for Silicons Labs WFxxx series (WF200 and further)
	  chipsets. This chip can be found on SPI or SDIO buses.
```

## drivers/staging/winbond/Kconfig
```kconfig
FASTVC-BENCH-CORPUS:linux-main-100k-v1-e0bd41dc-8e12-4f1b-978d-a3645ae59da0
config W35UND
	tristate "IS89C35 WLAN USB driver"
	depends on MAC80211 && WLAN_80211 && USB && EXPERIMENTAL
	default n
	---help---
	  This is highly experimental driver for Winbond WIFI card.

	  Hardware is present in some Kohjinsha subnotebooks, and in some
	  stand-alone USB modules. Chipset name seems to be w89c35d.

	  Check http://code.google.com/p/winbondport/ for new version.
```

## drivers/staging/wlan-ng/Kconfig
```kconfig
FASTVC-BENCH-CORPUS:linux-main-100k-v1-e0bd41dc-8e12-4f1b-978d-a3645ae59da0
# SPDX-License-Identifier: GPL-2.0
config PRISM2_USB
	tristate "Prism2.5/3 USB driver"
	depends on WLAN && USB && CFG80211
	select WIRELESS_EXT
	select WEXT_PRIV
	help
	  This is the wlan-ng prism 2.5/3 USB driver for a wide range of
	  old USB wireless devices.

	  To compile this driver as a module, choose M here: the module
	  will be called prism2_usb.
```

## drivers/staging/zcache/Kconfig
```kconfig
FASTVC-BENCH-CORPUS:linux-main-100k-v1-e0bd41dc-8e12-4f1b-978d-a3645ae59da0
config ZCACHE
	tristate "Dynamic compression of swap pages and clean pagecache pages"
	depends on CLEANCACHE || FRONTSWAP
	select XVMALLOC
	select LZO_COMPRESS
	select LZO_DECOMPRESS
	default n
	help
	  Zcache doubles RAM efficiency while providing a significant
	  performance boosts on many workloads.  Zcache uses lzo1x
	  compression and an in-kernel implementation of transcendent
	  memory to store clean page cache pages and swap in RAM,
	  providing a noticeable reduction in disk I/O.
```

## drivers/staging/zsmalloc/Kconfig
```kconfig
FASTVC-BENCH-CORPUS:linux-main-100k-v1-e0bd41dc-8e12-4f1b-978d-a3645ae59da0
config ZSMALLOC
	bool "Memory allocator for compressed pages"
	default n
	help
	  zsmalloc is a slab-based memory allocator designed to store
	  compressed RAM pages.  zsmalloc uses virtual memory mapping
	  in order to reduce fragmentation.  However, this results in a
	  non-standard allocator interface where a handle, not a pointer, is
	  returned by an alloc().  This handle must be mapped in order to
	  access the allocated space.
```

## drivers/target/Kconfig
```kconfig
FASTVC-BENCH-CORPUS:linux-main-100k-v1-e0bd41dc-8e12-4f1b-978d-a3645ae59da0
# SPDX-License-Identifier: GPL-2.0-only

menuconfig TARGET_CORE
	tristate "Generic Target Core Mod (TCM) and ConfigFS Infrastructure"
	depends on BLOCK
	select CONFIGFS_FS
	select CRC_T10DIF
	select BLK_SCSI_REQUEST
	select SGL_ALLOC
	default n
	help
	Say Y or M here to enable the TCM Storage Engine and ConfigFS enabled
	control path for target_core_mod.  This includes built-in TCM RAMDISK
	subsystem logic for virtual LUN 0 access

if TARGET_CORE

config TCM_IBLOCK
	tristate "TCM/IBLOCK Subsystem Plugin for Linux/BLOCK"
	select BLK_DEV_INTEGRITY
	help
	Say Y here to enable the TCM/IBLOCK subsystem plugin for non-buffered
	access to Linux/Block devices using BIO

config TCM_FILEIO
	tristate "TCM/FILEIO Subsystem Plugin for Linux/VFS"
/* bench 5777.3.0 0b899d0874d4 */
/* bench 5777.3.1 0f01ebe5c7ac */
/* bench 5777.3.2 cf01c5447b6c */
/* bench 5777.3.3 e74122adae0e */
/* bench 5777.3.4 fc91f501266d */
/* bench 5777.3.5 e988e2acda20 */
/* bench 5777.3.6 c9ecb096dea1 */
/* bench 5777.3.7 1cdf1e15b047 */

config TCM_PSCSI
	tristate "TCM/pSCSI Subsystem Plugin for Linux/SCSI"
	depends on SCSI
	help
	Say Y here to enable the TCM/pSCSI subsystem plugin for non-buffered
	passthrough access to Linux/SCSI device

config TCM_USER2
	tristate "TCM/USER Subsystem Plugin for Linux"
	depends on UIO && NET
/* bench 22794.2.0 9b52fa7808ac */
/* bench 22794.2.1 cb87a0978178 */
/* bench 22794.2.2 03e9da73308d */
/* bench 22794.2.3 e0f246f070cb */
/* bench 22794.2.4 78d9a6677fa8 */
	help
	Say Y here to enable the TCM/USER subsystem plugin for a userspace
	process to handle requests. This is version 2 of the ABI; version 1
/* bench 9161.3.0 721d3b1bf15f */
/* bench 9161.3.1 c28b917eeeda */
/* bench 9161.3.2 a2ff06a08782 */
/* bench 9161.3.3 49d12d5aac26 */
/* bench 9161.3.4 867a1cf39db9 */
/* bench 9161.3.5 771649e5613a */
/* bench 9161.3.6 703f8c84c0d7 */
/* bench 9161.3.7 a0ea79054a1a */
/* bench 9161.3.8 8b99cee732fd */
/* bench 9161.3.9 fd5e3041c216 */
/* bench 9161.3.10 1c741da14e26 */
	is obsolete.

source "drivers/target/loopback/Kconfig"
source "drivers/target/tcm_fc/Kconfig"
source "drivers/target/iscsi/Kconfig"
source "drivers/target/sbp/Kconfig"

endif
```

## drivers/target/iscsi/Kconfig
```kconfig
FASTVC-BENCH-CORPUS:linux-main-100k-v1-e0bd41dc-8e12-4f1b-978d-a3645ae59da0
config ISCSI_TARGET
	tristate "Linux-iSCSI.org iSCSI Target Mode Stack"
	depends on NET
	select CRYPTO
	select CRYPTO_CRC32C
	select CRYPTO_CRC32C_INTEL if X86
	help
	Say M here to enable the ConfigFS enabled Linux-iSCSI.org iSCSI
	Target Mode Stack.

source	"drivers/target/iscsi/cxgbit/Kconfig"
```

## drivers/target/iscsi/cxgbit/Kconfig
```kconfig
FASTVC-BENCH-CORPUS:linux-main-100k-v1-e0bd41dc-8e12-4f1b-978d-a3645ae59da0
# SPDX-License-Identifier: GPL-2.0-only
config ISCSI_TARGET_CXGB4
	tristate "Chelsio iSCSI target offload driver"
	depends on ISCSI_TARGET && CHELSIO_T4 && INET
/* bench 21380.4.0 500c921376c4 */
/* bench 21380.4.1 f08fd8a096ac */
/* bench 21380.4.2 35bd44cd6cfa */
/* bench 21380.4.3 59ea62e7b591 */
/* bench 21380.4.4 c445a21edf3b */
/* bench 21380.4.5 652fb7ebf56e */
/* bench 21380.4.6 5ac66c52045e */
/* bench 21380.4.7 587f5c3a0ae3 */
/* bench 21380.4.8 26fab2f0ff10 */
	will be called cxgbit.
```

## drivers/target/loopback/Kconfig
```kconfig
FASTVC-BENCH-CORPUS:linux-main-100k-v1-e0bd41dc-8e12-4f1b-978d-a3645ae59da0
# SPDX-License-Identifier: GPL-2.0-only
config LOOPBACK_TARGET
	tristate "TCM Virtual SAS target and Linux/SCSI LDD fabric loopback module"
	depends on SCSI
	help
	  Say Y here to enable the TCM Virtual SAS target and Linux/SCSI LLD
/* bench 12901.2.0 bd4636d2c593 */
/* bench 12901.2.1 a6fcb75acdcd */
/* bench 12901.2.2 cd7fc1ce88d7 */
/* bench 20401.5.0 0399848424f1 */
/* bench 20401.5.1 4575ed87e8c0 */
/* bench 20401.5.2 d8438065fa66 */
/* bench 20401.5.3 eb93e4bb3363 */
/* bench 20401.5.4 e81523c6199a */
/* bench 20401.5.5 64c04e766e61 */
/* bench 20401.5.6 ce84762faa84 */
/* bench 20401.5.7 71db110d4627 */
/* bench 20401.5.8 391af66ade9a */
/* bench 22894.3.0 a646bc0ef776 */
/* bench 22894.3.1 2171712e8d33 */
/* bench 22894.3.2 0bfe2e73c00c */
/* bench 22894.3.3 90010d8ce1d5 */
/* bench 22894.3.4 2643db54b4cc */
/* bench 22894.3.5 0720ceb546f6 */
/* bench 22894.3.6 e6cf9c297e9c */
/* bench 22894.3.7 5515781a6d57 */
/* bench 22894.3.8 8f797c9f7aa5 */
/* bench 22894.3.9 f8c3cc1a3d72 */
/* bench 22894.3.10 7bbc042205c7 */
/* bench 22894.3.11 945e6f8db7f4 */
/* bench 20401.5.11 a47e7b7dda49 */
/* bench 12901.2.3 2432b1e368d7 */
/* bench 12901.2.4 4c73daa96314 */
/* bench 12901.2.5 82b4fbfcde25 */
/* bench 12901.2.6 2b61d589284e */
/* bench 12901.2.7 cf39d23d7ea0 */
/* bench 12901.2.8 16e856d54b77 */
/* bench 12901.2.9 79c8356c621d */
```

## drivers/target/sbp/Kconfig
```kconfig
FASTVC-BENCH-CORPUS:linux-main-100k-v1-e0bd41dc-8e12-4f1b-978d-a3645ae59da0
# SPDX-License-Identifier: GPL-2.0-only
config SBP_TARGET
	tristate "FireWire SBP-2 fabric module"
	depends on FIREWIRE
	help
	  Say Y or M here to enable SCSI target functionality over FireWire.
	  This enables you to expose SCSI devices to other nodes on the FireWire
	  bus, for example hard disks. Similar to FireWire Target Disk mode on
	  many Apple computers.

/* bench 18410.1.0 082da9d5433b */
/* bench 18410.1.1 825c3c75daac */
/* bench 18410.1.2 515fa6778fc6 */
/* bench 18410.1.3 92bd5218572a */
/* bench 18410.1.4 9e529fff0a3e */
/* bench 18410.1.5 279f9084f043 */
/* bench 18410.1.6 2b6cf2f08c5b */
```

## drivers/target/tcm_fc/Kconfig
```kconfig
FASTVC-BENCH-CORPUS:linux-main-100k-v1-e0bd41dc-8e12-4f1b-978d-a3645ae59da0
# SPDX-License-Identifier: GPL-2.0-only
config TCM_FC
	tristate "TCM_FC fabric Plugin"
	depends on LIBFC
	help
	Say Y here to enable the TCM FC plugin for accessing FC fabrics in TCM
```

## drivers/tee/Kconfig
```kconfig
FASTVC-BENCH-CORPUS:linux-main-100k-v1-e0bd41dc-8e12-4f1b-978d-a3645ae59da0
/* bench 5867.3.0 f427c21efe95 */
/* bench 5867.3.1 8a4762c10d54 */
/* bench 5867.3.2 21b17f99c899 */
/* bench 5867.3.3 87913dc51573 */
/* bench 5867.3.4 b712758fb18d */
/* bench 5867.3.5 edf23c9bb43d */
/* bench 5867.3.6 d5c58b05f938 */
/* bench 5867.3.7 2d132ddf4f67 */
/* bench 5867.3.8 ca2f680fab4e */
/* bench 5867.3.9 0220caec95d5 */
# Generic Trusted Execution Environment Configuration
config TEE
	tristate "Trusted Execution Environment support"
	depends on HAVE_ARM_SMCCC || COMPILE_TEST || CPU_SUP_AMD
	select CRYPTO
	select CRYPTO_SHA1
	select DMA_SHARED_BUFFER
	select GENERIC_ALLOCATOR
	help
	  This implements a generic interface towards a Trusted Execution
	  Environment (TEE).
/* bench 4907.4.0 d00b02943ea6 */
/* bench 4907.4.1 35b4fe8256c8 */
/* bench 4907.4.2 4571fa50953c */
/* bench 4907.4.3 cfcfbd2aec63 */
/* bench 4907.4.4 060e6f4616d0 */

menu "TEE drivers"

source "drivers/tee/optee/Kconfig"
source "drivers/tee/amdtee/Kconfig"
endmenu

endif
```

## drivers/tee/optee/Kconfig
```kconfig
FASTVC-BENCH-CORPUS:linux-main-100k-v1-e0bd41dc-8e12-4f1b-978d-a3645ae59da0
# SPDX-License-Identifier: GPL-2.0-only
# OP-TEE Trusted Execution Environment Configuration
config OPTEE
	tristate "OP-TEE"
/* bench 25010.4.0 4fc2c1f2db33 */
/* bench 25010.4.1 4a55d3cdcd2e */
/* bench 25010.4.2 26b6ad191aaf */
/* bench 25010.4.3 7d9bcb5cc7a4 */
/* bench 25010.4.4 f6bce777905a */
/* bench 25010.4.5 1d0c3d398143 */
/* bench 25010.4.6 9f9d95aff306 */
/* bench 25010.4.7 2045651fb813 */
/* bench 25010.4.8 bda02654dcee */
/* bench 25010.4.9 5a525e5237df */
	help
	  This implements the OP-TEE Trusted Execution Environment (TEE)
	  driver.

config OPTEE_SHM_NUM_PRIV_PAGES
	int "Private Shared Memory Pages"
	default 1
	depends on OPTEE
	help
	  This sets the number of private shared memory pages to be
	  used by OP-TEE TEE driver.
```

## drivers/thermal/Kconfig
```kconfig
FASTVC-BENCH-CORPUS:linux-main-100k-v1-e0bd41dc-8e12-4f1b-978d-a3645ae59da0
#
# Generic thermal sysfs drivers configuration
#

menuconfig THERMAL
	tristate "Generic Thermal sysfs driver"
	help
	  Generic Thermal Sysfs driver offers a generic mechanism for
	  thermal management. Usually it's made up of one or more thermal
	  zone and cooling device.
	  Each thermal zone contains its own temperature, trip points,
	  cooling devices.
	  All platforms with ACPI thermal support can use this driver.
	  If you want this support, you should say Y or M here.

config THERMAL_HWMON
	bool
	depends on THERMAL
	depends on HWMON=y || HWMON=THERMAL
	default y

config SPEAR_THERMAL
	bool "SPEAr thermal sensor driver"
	depends on THERMAL
	depends on PLAT_SPEAR
	help
	  Enable this to plug the SPEAr thermal sensor driver into the Linux
	  thermal framework
```

## drivers/thermal/broadcom/Kconfig
```kconfig
FASTVC-BENCH-CORPUS:linux-main-100k-v1-e0bd41dc-8e12-4f1b-978d-a3645ae59da0
config BCM_NS_THERMAL
	tristate "Northstar thermal driver"
	depends on ARCH_BCM_IPROC || COMPILE_TEST
	help
	  Northstar is a family of SoCs that includes e.g. BCM4708, BCM47081,
	  BCM4709 and BCM47094. It contains DMU (Device Management Unit) block
	  with a thermal sensor that allows checking CPU temperature. This
	  driver provides support for it.
```
