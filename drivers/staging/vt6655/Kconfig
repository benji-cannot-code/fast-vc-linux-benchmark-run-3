## drivers/thermal/intel/int340x_thermal/Kconfig
```kconfig
FASTVC-BENCH-CORPUS:linux-main-100k-v1-e0bd41dc-8e12-4f1b-978d-a3645ae59da0
# SPDX-License-Identifier: GPL-2.0-only
#
# ACPI INT340x thermal drivers configuration
#

config INT340X_THERMAL
	tristate "ACPI INT340X thermal drivers"
	depends on X86 && ACPI && PCI
	select THERMAL_GOV_USER_SPACE
	select ACPI_THERMAL_REL
	select ACPI_FAN
	select INTEL_SOC_DTS_IOSF_CORE
	select PROC_THERMAL_MMIO_RAPL if X86_64 && POWERCAP
	help
	  Newer laptops and tablets that use ACPI may have thermal sensors and
	  other devices with thermal control capabilities outside the core
	  CPU/SOC, for thermal safety reasons.
	  They are exposed for the OS to use via the INT3400 ACPI device object
	  as the master, and INT3401~INT340B ACPI device objects as the slaves.
	  Enable this to expose the temperature information and cooling ability
	  from these objects to userspace via the normal thermal framework.
	  This means that a wide range of applications and GUI widgets can show
	  the information to the user or use this information for making
	  decisions. For example, the Intel Thermal Daemon can use this
	  information to allow the user to select his laptop to run without
	  turning on the fans.

config ACPI_THERMAL_REL
	tristate
	depends on ACPI

if INT340X_THERMAL

/* bench 1388.5.0 2555a4b28b7d */
/* bench 1388.5.1 d04b0da833e9 */
/* bench 1388.5.2 f573e5bd62d6 */
/* bench 1388.5.3 96e2443de96b */
/* bench 1388.5.4 893e1bb3e4d3 */
/* bench 1388.5.5 6f75cffbaf7d */
/* bench 4960.3.0 3166e467872d */
/* bench 11861.5.0 2088c3c072d3 */
/* bench 11861.5.1 b466cf79c41f */
/* bench 11861.5.2 9f73552b64a2 */
/* bench 11861.5.3 8e9fc8a1674c */
/* bench 11861.5.4 4537437783a8 */
/* bench 11861.5.5 4c2e561e9457 */
/* bench 11861.5.6 ebb6237ea3df */
/* bench 11861.5.7 4ab1330682e9 */
/* bench 11861.5.8 52ace34adfe9 */
/* bench 11861.5.9 2e4eb7c65a74 */
/* bench 11861.5.10 f04e78dd3340 */
/* bench 11861.5.11 2390bc472dfb */
/* bench 11861.5.12 4f71b09788db */
/* bench 11861.5.13 c8a62d6789d3 */
/* bench 11861.5.14 b9426fe18e42 */
/* bench 11861.5.15 a6eca7150f46 */
/* bench 4960.3.2 268ca907a04f */
/* bench 4960.3.3 50eac5601992 */
/* bench 4960.3.4 c7e4ae6ab849 */
/* bench 4960.3.5 5b07db04ef2e */
/* bench 4960.3.6 29005551a846 */
	  that may or may not include touch support. The main function of
	  the display thermal device is to allow control of the display
	  brightness in order to address a thermal condition or to reduce
	  power consumed by display device.

config PROC_THERMAL_MMIO_RAPL
	tristate
	select INTEL_RAPL_CORE
endif
```

## drivers/thermal/qcom/Kconfig
```kconfig
FASTVC-BENCH-CORPUS:linux-main-100k-v1-e0bd41dc-8e12-4f1b-978d-a3645ae59da0
# SPDX-License-Identifier: GPL-2.0-only
/* bench 5068.3.0 52a63891aeaa */
	tristate "Qualcomm TSENS Temperature Alarm"
	depends on QCOM_QFPROM
	depends on ARCH_QCOM || COMPILE_TEST
	help
	  This enables the thermal sysfs driver for the TSENS device. It shows
	  up in Sysfs as a thermal zone with multiple trip points. Disabling the
	  thermal zone device via the mode file results in disabling the sensor.
	  Also able to set threshold temperature for both hot and cold and update
	  when a threshold is reached.
/* bench 17720.2.0 d4db2130e9da */
/* bench 17720.2.1 be96da7a7cb3 */
/* bench 17720.2.2 02eaf9994ad8 */
/* bench 17720.2.3 2e5b18d8913b */
/* bench 17720.2.4 4d69c1939490 */
/* bench 17720.2.5 5e520fe904d7 */
/* bench 17720.2.6 86de1cde93a2 */
/* bench 17720.2.7 26433f0506c1 */
/* bench 17720.2.8 1446cd1b8f97 */
/* bench 17720.2.9 5a79220a069d */
/* bench 17720.2.10 af7325e3f10f */
	tristate "Qualcomm SPMI PMIC Thermal Monitor ADC5"
	depends on OF && SPMI && IIO
	select REGMAP_SPMI
	select QCOM_VADC_COMMON
	help
	  This enables the thermal driver for the ADC thermal monitoring
	  device. It shows up as a thermal zone with multiple trip points.
	  Thermal client sets threshold temperature for both warm and cool and
	  gets updated when a threshold is reached.

config QCOM_SPMI_TEMP_ALARM
	tristate "Qualcomm SPMI PMIC Temperature Alarm"
	depends on OF && SPMI && IIO
	select REGMAP_SPMI
	help
	  This enables a thermal sysfs driver for Qualcomm plug-and-play (QPNP)
	  PMIC devices. It shows up in sysfs as a thermal sensor with multiple
/* bench 18370.5.0 2c7a51503292 */
/* bench 18370.5.1 d5d4bdf2a12f */
/* bench 18370.5.2 073f03e0c74e */
/* bench 18370.5.3 e2373c7bef87 */
	  trip points. The temperature reported by the thermal sensor reflects the
	  real time die temperature if an ADC is present or an estimate of the
	  temperature based upon the over temperature stage value.
```
