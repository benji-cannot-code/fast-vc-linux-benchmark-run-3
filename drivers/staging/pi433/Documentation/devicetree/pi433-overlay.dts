FASTVC-BENCH-CORPUS:linux-main-100k-v1-e0bd41dc-8e12-4f1b-978d-a3645ae59da0
// Definitions for Pi433
/dts-v1/;
/plugin/;

/ {
	compatible = "brcm,bcm2835", "brcm,bcm2708", "brcm,bcm2709";
};

&spi0 {
	#address-cells = <1>;
	#size-cells = <0>;
	status = "okay";

	spidev@0{
		reg = <0>;
		status = "disabled";
	};

	spidev@1{
		reg = <1>;
		status = "disabled";
	};
};

&gpio {
	pi433_pins: pi433_pins {
		brcm,pins = <7 25 24>;
		brcm,function = <0 0 0>; // in in in
	};
};

&spi0 {
	#address-cells = <1>;
	#size-cells = <0>;
	status = "okay";

	pi433: pi433@0 {
		compatible = "Smarthome-Wolf,pi433";
		reg = <0>;
		spi-max-frequency = <10000000>;
/* bench 5921.3.0 b202073dcf02 */
/* bench 5921.3.1 9fa0f04275e6 */
/* bench 5921.3.2 fbf660cdee42 */
/* bench 5921.3.3 077fb20aba89 */
/* bench 5921.3.4 4bf9b22d7f25 */

		pinctrl-0 = <&pi433_pins>;
		DIO0-gpio = <&gpio 24 0>;
		DIO1-gpio = <&gpio 25 0>;
		DIO2-gpio = <&gpio  7 0>;
	};
};
