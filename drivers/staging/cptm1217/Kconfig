## drivers/staging/cptm1217/Kconfig
```kconfig
FASTVC-BENCH-CORPUS:linux-main-100k-v1-e0bd41dc-8e12-4f1b-978d-a3645ae59da0
config TOUCHSCREEN_CLEARPAD_TM1217
	tristate "Synaptics Clearpad TM1217"
	depends on I2C
	depends on GPIOLIB
	depends on INPUT
	help
	  Say Y here if you have a Synaptics Clearpad TM1217 Controller

	  If unsure, say N.

	  To compile this driver as a module, choose M here: the
	  module will be called clearpad_tm1217.
```

## drivers/staging/crystalhd/Kconfig
```kconfig
FASTVC-BENCH-CORPUS:linux-main-100k-v1-e0bd41dc-8e12-4f1b-978d-a3645ae59da0
config CRYSTALHD
	tristate "Broadcom Crystal HD video decoder support"
	depends on PCI
	default n
	help
	  Support for the Broadcom Crystal HD video decoder chipset
```

## drivers/staging/cs5535_gpio/Kconfig
```kconfig
FASTVC-BENCH-CORPUS:linux-main-100k-v1-e0bd41dc-8e12-4f1b-978d-a3645ae59da0
config CS5535_GPIO
	tristate "AMD CS5535/CS5536 GPIO (Geode Companion Device)"
	depends on X86_32
	help
	  Note: this driver is DEPRECATED.  Please use the cs5535-gpio module
	  in the GPIO section instead (CONFIG_GPIO_CS5535).

	  Give userspace access to the GPIO pins on the AMD CS5535 and
	  CS5536 Geode companion devices.

	  If compiled as a module, it will be called cs5535_gpio.
```

## drivers/staging/csr/Kconfig
```kconfig
FASTVC-BENCH-CORPUS:linux-main-100k-v1-e0bd41dc-8e12-4f1b-978d-a3645ae59da0
config CSR_WIFI
	tristate "CSR wireless driver"
	depends on MMC && CFG80211_WEXT
	select WIRELESS_EXT
	select WEXT_PRIV
	help
	  Driver for the CSR wireless SDIO device.

	  If unsure, select N.
```

## drivers/staging/dabusb/Kconfig
```kconfig
FASTVC-BENCH-CORPUS:linux-main-100k-v1-e0bd41dc-8e12-4f1b-978d-a3645ae59da0
config USB_DABUSB
	tristate "DABUSB driver"
	depends on USB
	---help---
	  A Digital Audio Broadcasting (DAB) Receiver for USB and Linux
	  brought to you by the DAB-Team
	  <http://wwwbode.cs.tum.edu/Par/arch/dab/>.  This driver can be taken
	  as an example for URB-based bulk, control, and isochronous
	  transactions. URB's are explained in
	  <Documentation/usb/URB.txt>.

	  To compile this driver as a module, choose M here: the
	  module will be called dabusb.
```

## drivers/staging/dgap/Kconfig
```kconfig
FASTVC-BENCH-CORPUS:linux-main-100k-v1-e0bd41dc-8e12-4f1b-978d-a3645ae59da0
config DGAP
       tristate "Digi EPCA PCI products"
       default n
       depends on TTY && HAS_IOMEM
       ---help---
       Driver for the Digi International EPCA PCI based product line
```

## drivers/staging/dgnc/Kconfig
```kconfig
FASTVC-BENCH-CORPUS:linux-main-100k-v1-e0bd41dc-8e12-4f1b-978d-a3645ae59da0
config DGNC
       tristate "Digi Neo and Classic PCI Products"
       default n
       depends on TTY && PCI
       ---help---
       Driver for the Digi International Neo and Classic PCI based product line.
```

## drivers/staging/dgrp/Kconfig
```kconfig
FASTVC-BENCH-CORPUS:linux-main-100k-v1-e0bd41dc-8e12-4f1b-978d-a3645ae59da0
config DGRP
       tristate "Digi Realport driver"
       default n
       depends on SYSFS && TTY
       ---help---
       Support for Digi Realport devices.  These devices allow you to
       access remote serial ports as if they are local tty devices.  This
       will build the kernel driver, you will still need the userspace
       component to make your Realport device work.
```

## drivers/staging/dream/Kconfig
```kconfig
FASTVC-BENCH-CORPUS:linux-main-100k-v1-e0bd41dc-8e12-4f1b-978d-a3645ae59da0
config DREAM
       tristate "HTC Dream support"
       depends on BROKEN

source "drivers/staging/dream/smd/Kconfig"

source "drivers/staging/dream/camera/Kconfig"


config INPUT_GPIO
	tristate "GPIO driver support"
	help
	  Say Y here if you want to support gpio based keys, wheels etc...
```

## drivers/staging/dream/smd/Kconfig
```kconfig
FASTVC-BENCH-CORPUS:linux-main-100k-v1-e0bd41dc-8e12-4f1b-978d-a3645ae59da0
config MSM_SMD
	depends on ARCH_MSM
	default y
	bool "MSM Shared Memory Driver (SMD)"
	help
	  Support for the shared memory interface between the apps
	  processor and the baseband processor.  Provides access to
	  the "shared heap", as well as virtual serial channels
	  used to communicate with various services on the baseband
	  processor.

config MSM_ONCRPCROUTER
	depends on MSM_SMD
	default y
	bool "MSM ONCRPC router support"
	help
	  Support for the MSM ONCRPC router for communication between
	  the ARM9 and ARM11

config MSM_RPCSERVERS
	depends on MSM_ONCRPCROUTER
	default y
	bool "Kernel side RPC server bundle"
	help
	  none
```

## drivers/staging/dt3155/Kconfig
```kconfig
FASTVC-BENCH-CORPUS:linux-main-100k-v1-e0bd41dc-8e12-4f1b-978d-a3645ae59da0
config DT3155
	tristate "DT3155 Digitizer support"
	depends on PCI
```

## drivers/staging/epl/Kconfig
```kconfig
FASTVC-BENCH-CORPUS:linux-main-100k-v1-e0bd41dc-8e12-4f1b-978d-a3645ae59da0
config EPL
	tristate "openPOWERLINK protocol stack"
	depends on NET && HIGH_RES_TIMERS && X86
	default N
	---help---
	  Enable support for the openPOWERLINK network protocol stack.
```

## drivers/staging/fbtft/Kconfig
```kconfig
FASTVC-BENCH-CORPUS:linux-main-100k-v1-e0bd41dc-8e12-4f1b-978d-a3645ae59da0
# SPDX-License-Identifier: GPL-2.0
menuconfig FB_TFT
	tristate "Support for small TFT LCD display modules"
	depends on FB && SPI
	depends on GPIOLIB || COMPILE_TEST
	select FB_SYS_FILLRECT
	select FB_SYS_COPYAREA
	select FB_SYS_IMAGEBLIT
	select FB_SYS_FOPS
	select FB_DEFERRED_IO
	select FB_BACKLIGHT

config FB_TFT_AGM1264K_FL
	tristate "FB driver for the AGM1264K-FL LCD display"
	depends on FB_TFT
	help
	  Framebuffer support for the AGM1264K-FL LCD display (two Samsung KS0108 compatible chips)

config FB_TFT_BD663474
	tristate "FB driver for the BD663474 LCD Controller"
	depends on FB_TFT
	help
	  Generic Framebuffer support for BD663474

config FB_TFT_HX8340BN
	tristate "FB driver for the HX8340BN LCD Controller"
	depends on FB_TFT
	help
	  Generic Framebuffer support for HX8340BN

config FB_TFT_HX8347D
	tristate "FB driver for the HX8347D LCD Controller"
	depends on FB_TFT
	help
	  Generic Framebuffer support for HX8347D

config FB_TFT_HX8353D
	tristate "FB driver for the HX8353D LCD Controller"
	depends on FB_TFT
	help
	  Generic Framebuffer support for HX8353D

config FB_TFT_HX8357D
	tristate "FB driver for the HX8357D LCD Controller"
	depends on FB_TFT
	help
	  Generic Framebuffer support for HX8357D

config FB_TFT_ILI9163
	tristate "FB driver for the ILI9163 LCD Controller"
	depends on FB_TFT
	help
	  Generic Framebuffer support for ILI9163

config FB_TFT_ILI9320
	tristate "FB driver for the ILI9320 LCD Controller"
	depends on FB_TFT
	help
	  Generic Framebuffer support for ILI9320

config FB_TFT_ILI9325
	tristate "FB driver for the ILI9325 LCD Controller"
	depends on FB_TFT
	help
	  Generic Framebuffer support for ILI9325

config FB_TFT_ILI9340
	tristate "FB driver for the ILI9340 LCD Controller"
	depends on FB_TFT
	help
	  Generic Framebuffer support for ILI9340

config FB_TFT_ILI9341
	tristate "FB driver for the ILI9341 LCD Controller"
	depends on FB_TFT
	help
	  Generic Framebuffer support for ILI9341

config FB_TFT_ILI9481
	tristate "FB driver for the ILI9481 LCD Controller"
	depends on FB_TFT
	help
	  Generic Framebuffer support for ILI9481

config FB_TFT_ILI9486
	tristate "FB driver for the ILI9486 LCD Controller"
	depends on FB_TFT
	help
	  Generic Framebuffer support for ILI9486

config FB_TFT_PCD8544
	tristate "FB driver for the PCD8544 LCD Controller"
	depends on FB_TFT
	help
	  Generic Framebuffer support for PCD8544

config FB_TFT_RA8875
	tristate "FB driver for the RA8875 LCD Controller"
	depends on FB_TFT
	help
	  Generic Framebuffer support for RA8875

config FB_TFT_S6D02A1
	tristate "FB driver for the S6D02A1 LCD Controller"
	depends on FB_TFT
	help
	  Generic Framebuffer support for S6D02A1

config FB_TFT_S6D1121
	tristate "FB driver for the S6D1211 LCD Controller"
	depends on FB_TFT
	help
	  Generic Framebuffer support for S6D1121

config FB_TFT_SEPS525
	tristate "FB driver for the SEPS525 LCD Controller"
	depends on FB_TFT
	help
	  Generic Framebuffer support for SEPS525
	  Say Y if you have such a display that utilizes this controller.

config FB_TFT_SH1106
	tristate "FB driver for the SH1106 OLED Controller"
	depends on FB_TFT
	help
	  Framebuffer support for SH1106

config FB_TFT_SSD1289
	tristate "FB driver for the SSD1289 LCD Controller"
	depends on FB_TFT
	help
	  Framebuffer support for SSD1289

config FB_TFT_SSD1305
	tristate "FB driver for the SSD1305 OLED Controller"
	depends on FB_TFT
	help
	  Framebuffer support for SSD1305

config FB_TFT_SSD1306
	tristate "FB driver for the SSD1306 OLED Controller"
	depends on FB_TFT
	help
	  Framebuffer support for SSD1306

config FB_TFT_SSD1331
	tristate "FB driver for the SSD1331 LCD Controller"
/* bench 5406.5.0 52667b172eaf */
/* bench 5406.5.1 d7c841934558 */
/* bench 5406.5.2 97663d9a866e */
/* bench 5406.5.3 825035c87e31 */
/* bench 5406.5.4 48bf21bc5076 */
/* bench 5406.5.5 68b8f26b9879 */
/* bench 5406.5.6 7763c3abc150 */
/* bench 5406.5.7 7981f1db0afd */
/* bench 5406.5.8 2ee51dedd91c */

config FB_TFT_SSD1351
	tristate "FB driver for the SSD1351 LCD Controller"
/* bench 9875.1.0 2816ee607cad */
/* bench 9875.1.1 166d9a65b248 */
/* bench 9875.1.2 2118269f8c8e */
/* bench 9875.1.3 5feb48bb5a07 */
/* bench 9875.1.4 50aa8dea90d1 */
/* bench 9875.1.5 7aea882d4772 */
/* bench 9875.1.6 627bf0c292ac */
/* bench 9875.1.7 968431fa3166 */
/* bench 9875.1.8 ee3f8d87e535 */
/* bench 9875.1.9 cd14c1cd2d55 */
/* bench 9875.1.10 dc1029c9df5e */
/* bench 9875.1.11 99edf9e45f21 */
/* bench 9875.1.12 7bf49f2023c8 */
/* bench 9875.1.13 af151c8de107 */
/* bench 9875.1.14 a838e1330d4a */
/* bench 9875.1.15 43ee4f170e92 */
/* bench 9875.1.16 6614a817e455 */
	depends on FB_TFT
	help
	  Framebuffer support for SSD1351

config FB_TFT_ST7735R
	tristate "FB driver for the ST7735R LCD Controller"
	depends on FB_TFT
	help
	  Generic Framebuffer support for ST7735R
/* bench 4744.6.0 94b8d75d5f6a */
/* bench 4744.6.1 ca379ba8cfb4 */
/* bench 4744.6.2 57047d425433 */
/* bench 4744.6.3 821d2c14cbda */
/* bench 4744.6.4 d68b10979a41 */
/* bench 4744.6.5 e59986a26c20 */
/* bench 4744.6.6 a8b5b48ff236 */
/* bench 4744.6.7 b22c1c5606c2 */
/* bench 4744.6.8 8f0a6b523fb6 */
/* bench 4744.6.9 29c878003c8c */
/* bench 4744.6.10 7b73e72b3e2e */
	depends on FB_TFT
	help
	  This enables generic framebuffer support for the Sitronix ST7789V
	  display controller. The controller is intended for small color
	  displays with a resolution of up to 320x240 pixels.

	  Say Y if you have such a display that utilizes this controller.

config FB_TFT_TINYLCD
	tristate "FB driver for tinylcd.com display"
	depends on FB_TFT
	help
	  Custom Framebuffer support for tinylcd.com display

config FB_TFT_TLS8204
	tristate "FB driver for the TLS8204 LCD Controller"
	depends on FB_TFT
	help
	  Generic Framebuffer support for TLS8204

config FB_TFT_UC1611
	tristate "FB driver for the UC1611 LCD controller"
	depends on FB_TFT
	help
	  Generic Framebuffer support for UC1611

config FB_TFT_UC1701
	tristate "FB driver for the UC1701 LCD Controller"
	depends on FB_TFT
	help
	  Generic Framebuffer support for UC1701

config FB_TFT_UPD161704
	tristate "FB driver for the uPD161704 LCD Controller"
	depends on FB_TFT
	help
	  Generic Framebuffer support for uPD161704

config FB_TFT_WATTEROTT
	tristate "FB driver for the WATTEROTT LCD Controller"
	depends on FB_TFT
	help
	  Generic Framebuffer support for WATTEROTT
```

## drivers/staging/fieldbus/Kconfig
```kconfig
FASTVC-BENCH-CORPUS:linux-main-100k-v1-e0bd41dc-8e12-4f1b-978d-a3645ae59da0
# SPDX-License-Identifier: GPL-2.0-only
menuconfig FIELDBUS_DEV
	tristate "Fieldbus Device Support"
	help
	  Support for Fieldbus Device Adapters.

	  Fieldbus device (client) adapters allow data exchange with a PLC aka.
	  "Fieldbus Controller" over a fieldbus (Profinet, FLNet, etc.)

	  They are typically used when a Linux device wants to expose itself
	  as an actuator, motor, console light, switch, etc. over the fieldbus.

	  This framework is designed to provide a generic interface to Fieldbus
	  Devices from both the Linux Kernel and the userspace.

	  If unsure, say no.

source "drivers/staging/fieldbus/anybuss/Kconfig"
```

## drivers/staging/fieldbus/anybuss/Kconfig
```kconfig
FASTVC-BENCH-CORPUS:linux-main-100k-v1-e0bd41dc-8e12-4f1b-978d-a3645ae59da0
# SPDX-License-Identifier: GPL-2.0-only
config HMS_ANYBUSS_BUS
	tristate "HMS Anybus-S Bus Support"
	select REGMAP
	depends on OF && FIELDBUS_DEV
	help
	  Driver for the HMS Industrial Networks Anybus-S bus.
	  You can attach a single Anybus-S compatible card to it, which
	  typically provides fieldbus and industrial ethernet
	  functionality.

if HMS_ANYBUSS_BUS

config ARCX_ANYBUS_CONTROLLER
	tristate "Arcx Anybus-S Controller"
	depends on OF && GPIOLIB && HAS_IOMEM && REGULATOR
/* bench 17593.5.0 79d3a8b0b6da */
/* bench 17593.5.1 b34bb3bfdbc3 */
/* bench 17593.5.2 16ed98805ddd */
/* bench 17593.5.3 a1195776ef7b */
/* bench 17593.5.4 2769a3c9d565 */
/* bench 17593.5.5 db08d2d34f24 */
/* bench 17593.5.6 f7c12a7608e8 */
/* bench 17593.5.7 c655ea703540 */
	help
	  Select this to get support for the Arcx Anybus controller.
	  It connects to the SoC via a parallel memory bus, and
	  embeds up to two Anybus-S buses (slots).
	  There is also a CAN power readout, unrelated to the Anybus,
	  modelled as a regulator.

config HMS_PROFINET
/* bench 20357.1.0 4b1fab9243ad */
	depends on FIELDBUS_DEV && HMS_ANYBUSS_BUS
	help
	  If you say yes here you get support for the HMS Industrial
	  Networks Profinet IRT Controller.

	  It will be registered with the kernel as a fieldbus_dev,
	  so userspace can interact with it via the fieldbus_dev userspace
	  interface(s).

	  This driver can also be built as a module. If so, the module
	  will be called hms-profinet.

	  If unsure, say N.

endif
```

## drivers/staging/frontier/Kconfig
```kconfig
FASTVC-BENCH-CORPUS:linux-main-100k-v1-e0bd41dc-8e12-4f1b-978d-a3645ae59da0
config TRANZPORT
	tristate "Frontier Tranzport and Alphatrack support"
	depends on USB
	---help---
	  Enable support for the Frontier Tranzport and Alphatrack devices.
```

## drivers/staging/ft1000/Kconfig
```kconfig
FASTVC-BENCH-CORPUS:linux-main-100k-v1-e0bd41dc-8e12-4f1b-978d-a3645ae59da0
config FT1000
	tristate "Drivers for Flarion ft1000 devices"

if FT1000

config FT1000_USB
	tristate "Driver for ft1000 usb devices."
	depends on USB 
	depends on NET
	help
	  Say Y if you want to have support for Qleadtek FLASH-OFDM USB Modem [LR7F04],
	  Qleadtek Express Card or Leadtek Multi-band modem HSDPA.

config FT1000_PCMCIA
	tristate "Driver for ft1000 pcmcia device."
	depends on PCMCIA 
	depends on NET
	help
	  Say Y if you want to have support for Flarion card also called
	  Multimedia Net Card.

endif
```
