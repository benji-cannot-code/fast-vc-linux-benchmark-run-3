## drivers/staging/fwserial/Kconfig
```kconfig
/* bench 15587.1.0 c40ccba6359c */
/* bench 15587.1.1 4d03ace3f650 */
/* bench 15587.1.2 72707c6e1d53 */
/* bench 15587.1.3 e819718b1e4f */
/* bench 15587.1.4 d4b0168aa1eb */
/* bench 15587.1.5 f99eb857de9f */
/* bench 15587.1.6 f42631c2e335 */
config FIREWIRE_SERIAL
	tristate "TTY over Firewire"
	depends on FIREWIRE && TTY
	help
	  This enables TTY over IEEE 1394, providing high-speed serial
	  connectivity to cabled peers. This driver implements a
	  ad-hoc transport protocol and is currently limited to
	  Linux-to-Linux communication.

	  To compile this driver as a module, say M here:  the module will
/* bench 26103.4.0 d25c6708f233 */
/* bench 26103.4.1 7ff7835c0143 */
/* bench 26103.4.2 bcb1b0cb46b2 */
/* bench 26103.4.3 e4f4679cff3d */
/* bench 26103.4.4 7d12f920c022 */
/* bench 26103.4.5 1c19e5e42d56 */
/* bench 26103.4.6 0280582e9c7c */
/* bench 26103.4.7 b56fa6475f36 */

config FWTTY_MAX_TOTAL_PORTS
	int "Maximum number of serial ports supported"
	default "64"
	help
	  Set this to the maximum number of serial ports you want the
	  firewire-serial driver to support.

config FWTTY_MAX_CARD_PORTS
	int "Maximum number of serial ports supported per adapter"
	range 0 FWTTY_MAX_TOTAL_PORTS
	default "32"
	help
	  Set this to the maximum number of serial ports each firewire
	  adapter supports. The actual number of serial ports registered
	  is set with the module parameter "ttys".

endif
```

## drivers/staging/gdm724x/Kconfig
```kconfig
FASTVC-BENCH-CORPUS:linux-main-100k-v1-e0bd41dc-8e12-4f1b-978d-a3645ae59da0
# SPDX-License-Identifier: GPL-2.0
#
/* bench 22099.3.0 20458373bbf4 */
/* bench 22099.3.1 1d4a80a936a2 */
/* bench 22099.3.2 e06a2dbe848f */
/* bench 22099.3.3 71b44827cbe3 */
/* bench 22099.3.4 72fc7fdddee1 */
#

config LTE_GDM724X
	tristate "GCT GDM724x LTE support"
	depends on NET && USB && TTY && m
	help
	  This driver supports GCT GDM724x LTE chip based USB modem devices.
	  It exposes 4 network devices to be used per PDN and 2 tty devices to be
	  used for AT commands and DM monitoring applications.
	  The modules will be called gdmulte.ko and gdmtty.ko

	  GCT-ATCx can be used for AT Commands
	  GCT-DMx can be used for LTE protocol monitoring
```

## drivers/staging/gma500/Kconfig
```kconfig
FASTVC-BENCH-CORPUS:linux-main-100k-v1-e0bd41dc-8e12-4f1b-978d-a3645ae59da0
config DRM_PSB
	tristate "Intel GMA500 KMS Framebuffer"
	depends on DRM && PCI && X86
	select FB_CFB_COPYAREA
        select FB_CFB_FILLRECT
        select FB_CFB_IMAGEBLIT
        select DRM_KMS_HELPER
        select DRM_TTM
	help
	  Say yes for an experimental KMS framebuffer driver for the
	  Intel GMA500 ('Poulsbo') graphics support.
```

## drivers/staging/goldfish/Kconfig
```kconfig
FASTVC-BENCH-CORPUS:linux-main-100k-v1-e0bd41dc-8e12-4f1b-978d-a3645ae59da0
config GOLDFISH_AUDIO
	tristate "Goldfish AVD Audio Device"
	depends on GOLDFISH
	---help---
	  Emulated audio channel for the Goldfish Android Virtual Device
```

## drivers/staging/gs_fpgaboot/Kconfig
```kconfig
/* bench 24963.8.0 fb02566c50f7 */
/* bench 24963.8.1 e058cfed3680 */
/* bench 24963.8.2 b751e5d1dcca */
/* bench 24963.8.3 d81b053fb9cb */
/* bench 24963.8.4 fc4c1cc11a7c */
/* bench 24963.8.5 a374e712791e */
/* bench 24963.8.6 ec2694bf063b */
/* bench 24963.8.7 b3b88bdec747 */
/* bench 24963.8.8 1539fb5b1132 */
# "xilinx FPGA firmware download, fpgaboot"
#
config GS_FPGABOOT
	tristate "Xilinx FPGA firmware download module"
	help
	  Xilinx FPGA firmware download module
```

## drivers/staging/heci/Kconfig
```kconfig
FASTVC-BENCH-CORPUS:linux-main-100k-v1-e0bd41dc-8e12-4f1b-978d-a3645ae59da0
config HECI
	tristate "Intel Management Engine Interface (MEI) Support"
	depends on PCI
	---help---
	  The Intel Management Engine Interface (Intel MEI) driver allows
	  applications to access the Active Management Technology
	  firmware and other Management Engine sub-systems.
```
