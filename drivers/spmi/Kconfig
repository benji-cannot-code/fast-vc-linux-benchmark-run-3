## drivers/spmi/Kconfig
```kconfig
FASTVC-BENCH-CORPUS:linux-main-100k-v1-e0bd41dc-8e12-4f1b-978d-a3645ae59da0
#
# SPMI driver configuration
#
menuconfig SPMI
	tristate "SPMI support"
	help
	  SPMI (System Power Management Interface) is a two-wire
	  serial interface between baseband and application processors
	  and Power Management Integrated Circuits (PMIC).
```

## drivers/ssbi/Kconfig
```kconfig
FASTVC-BENCH-CORPUS:linux-main-100k-v1-e0bd41dc-8e12-4f1b-978d-a3645ae59da0
#
# SSBI bus support
#

menu "Qualcomm MSM SSBI bus support"

config SSBI
	tristate "Qualcomm Single-wire Serial Bus Interface (SSBI)"
	help
	  If you say yes to this option, support will be included for the
	  built-in SSBI interface on Qualcomm MSM family processors.

	  This is required for communicating with Qualcomm PMICs and
	  other devices that have the SSBI interface.

endmenu
```

## drivers/staging/Kconfig
```kconfig
FASTVC-BENCH-CORPUS:linux-main-100k-v1-e0bd41dc-8e12-4f1b-978d-a3645ae59da0
# SPDX-License-Identifier: GPL-2.0
menuconfig STAGING
	bool "Staging drivers"
	help
	  This option allows you to select a number of drivers that are
	  not of the "normal" Linux kernel quality level.  These drivers
	  are placed here in order to get a wider audience to make use of
	  them.  Please note that these drivers are under heavy
	  development, may or may not work, and may contain userspace
	  interfaces that most likely will be changed in the near
	  future.

	  Using any of these drivers will taint your kernel which might
	  affect support options from both the community, and various
	  commercial support organizations.

	  If you wish to work on these drivers, to help improve them, or
	  to report problems you have with them, please see the
	  drivers/staging/<driver_name>/TODO file to see what needs to be
	  worked on, and who to contact.

	  If in doubt, say N here.

/* bench 23995.6.0 4f376d0674f0 */
/* bench 23995.6.1 252ac8491cae */
/* bench 23995.6.2 581a56af4d1d */
/* bench 23995.6.3 e1673740c10e */
/* bench 23995.6.4 bc21061e09fe */
/* bench 23995.6.5 669bc8d3629a */
/* bench 23995.6.6 0f9316d7adfa */
/* bench 23995.6.7 183cda5c722b */
/* bench 23995.6.8 bb53b9a790ad */
/* bench 23995.6.9 531573c8adb8 */
/* bench 23995.6.10 d470ec1aa315 */
/* bench 23995.6.11 850d2ca9eda1 */
/* bench 23995.6.12 5d3732c0e9fb */
/* bench 23995.6.13 35a9babf09e4 */
/* bench 23995.6.14 c3b5ecbd233b */

if STAGING
/* bench 19932.4.0 c6ab8123afbb */
/* bench 19932.4.1 7434365263a0 */
/* bench 19932.4.2 6fdce0019af3 */
/* bench 19932.4.3 3eb3b10013cb */
/* bench 19932.4.4 fccbf10ec2ff */
/* bench 19932.4.5 69f2d55520c5 */
/* bench 19932.4.6 73854be7a85a */

source "drivers/staging/wlan-ng/Kconfig"

source "drivers/staging/olpc_dcon/Kconfig"

source "drivers/staging/rtl8192u/Kconfig"

source "drivers/staging/rtl8192e/Kconfig"

source "drivers/staging/rtl8723bs/Kconfig"

source "drivers/staging/rtl8712/Kconfig"

source "drivers/staging/rtl8188eu/Kconfig"

source "drivers/staging/rts5208/Kconfig"

source "drivers/staging/octeon/Kconfig"

source "drivers/staging/octeon-usb/Kconfig"

source "drivers/staging/vt6655/Kconfig"

source "drivers/staging/vt6656/Kconfig"

source "drivers/staging/iio/Kconfig"

source "drivers/staging/sm750fb/Kconfig"

source "drivers/staging/emxx_udc/Kconfig"

source "drivers/staging/nvec/Kconfig"

source "drivers/staging/media/Kconfig"

source "drivers/staging/android/Kconfig"

source "drivers/staging/board/Kconfig"

source "drivers/staging/gdm724x/Kconfig"

source "drivers/staging/fwserial/Kconfig"

source "drivers/staging/netlogic/Kconfig"

source "drivers/staging/gs_fpgaboot/Kconfig"

source "drivers/staging/unisys/Kconfig"

source "drivers/staging/clocking-wizard/Kconfig"

source "drivers/staging/fbtft/Kconfig"

source "drivers/staging/fsl-dpaa2/Kconfig"

source "drivers/staging/most/Kconfig"

source "drivers/staging/ks7010/Kconfig"

source "drivers/staging/greybus/Kconfig"

source "drivers/staging/vc04_services/Kconfig"

source "drivers/staging/pi433/Kconfig"

source "drivers/staging/mt7621-pci/Kconfig"

source "drivers/staging/mt7621-dma/Kconfig"

source "drivers/staging/ralink-gdma/Kconfig"

source "drivers/staging/mt7621-dts/Kconfig"

source "drivers/staging/axis-fifo/Kconfig"

source "drivers/staging/fieldbus/Kconfig"

source "drivers/staging/kpc2000/Kconfig"

source "drivers/staging/qlge/Kconfig"

source "drivers/staging/wfx/Kconfig"

source "drivers/staging/hikey9xx/Kconfig"

endif # STAGING
```

## drivers/staging/agnx/Kconfig
```kconfig
FASTVC-BENCH-CORPUS:linux-main-100k-v1-e0bd41dc-8e12-4f1b-978d-a3645ae59da0
config AGNX
	tristate "Wireless Airgo AGNX support"
	depends on WLAN_80211 && MAC80211
	---help---
	  This is an experimental driver for Airgo AGNX00 wireless chip.
```

## drivers/staging/altera-stapl/Kconfig
```kconfig
FASTVC-BENCH-CORPUS:linux-main-100k-v1-e0bd41dc-8e12-4f1b-978d-a3645ae59da0
config ALTERA_STAPL
	tristate "Altera FPGA firmware download module"
	depends on I2C
	default n
	help
	  An Altera FPGA module. Say Y when you want to support this tool.
```

## drivers/staging/altpciechdma/Kconfig
```kconfig
FASTVC-BENCH-CORPUS:linux-main-100k-v1-e0bd41dc-8e12-4f1b-978d-a3645ae59da0
config ALTERA_PCIE_CHDMA
	tristate "Altera PCI Express Chaining DMA driver"
	depends on PCI
	default N
	---help---
	  A reference driver that exercises the Chaining DMA logic reference
	  design generated along the Altera FPGA PCI Express soft or hard core,
	  only if instantiated using the MegaWizard, not the SOPC builder, of
	  Quartus 8.1.
```

## drivers/staging/android/Kconfig
```kconfig
FASTVC-BENCH-CORPUS:linux-main-100k-v1-e0bd41dc-8e12-4f1b-978d-a3645ae59da0
# SPDX-License-Identifier: GPL-2.0
menu "Android"

/* bench 10449.3.0 22df56466c5d */
/* bench 10449.3.1 d2f0a5795f69 */
/* bench 10449.3.2 db9281310cf2 */
/* bench 10449.3.3 10dec2290051 */
/* bench 10449.3.4 74fd1035208a */
/* bench 10449.3.5 1194c58266ea */
/* bench 10449.3.6 59d963d4048d */
/* bench 10449.3.7 eb1dec11a24b */
/* bench 10449.3.8 dd22e69fb120 */
/* bench 10449.3.9 4fc3fbe648ba */
/* bench 10449.3.10 db314609eed8 */
/* bench 10449.3.11 76c01171c760 */

config ASHMEM
	bool "Enable the Anonymous Shared Memory Subsystem"
	depends on SHMEM
	help
	  The ashmem subsystem is a new shared memory allocator, similar to
	  POSIX SHM but with different behavior and sporting a simpler
	  file-based API.

/* bench 8792.2.0 031c114d1bdc */
/* bench 8792.2.1 fbaf02471587 */
/* bench 8792.2.2 124afa53b673 */
/* bench 8792.2.3 babed91bd3bf */
/* bench 8792.2.4 9a8010e5b1e4 */
/* bench 8792.2.5 71649c0dbea2 */
endif # if ANDROID

endmenu
```

## drivers/staging/android/ion/Kconfig
```kconfig
FASTVC-BENCH-CORPUS:linux-main-100k-v1-e0bd41dc-8e12-4f1b-978d-a3645ae59da0
# SPDX-License-Identifier: GPL-2.0
menuconfig ION
	bool "Ion Memory Manager"
	depends on HAS_DMA && MMU
	select GENERIC_ALLOCATOR
	select DMA_SHARED_BUFFER
	help
	  Choose this option to enable the ION Memory Manager,
	  used by Android to efficiently allocate buffers
	  from userspace that can be shared between drivers.
	  If you're not using Android its probably safe to
	  say N here.

config ION_SYSTEM_HEAP
	bool "Ion system heap"
	depends on ION
	help
	  Choose this option to enable the Ion system heap. The system heap
	  is backed by pages from the buddy allocator. If in doubt, say Y.

config ION_CMA_HEAP
	bool "Ion CMA heap support"
	depends on ION && DMA_CMA
	help
	  Choose this option to enable CMA heaps with Ion. This heap is backed
	  by the Contiguous Memory Allocator (CMA). If your system has these
	  regions, you should say Y here.
```

## drivers/staging/android/ion/hisilicon/Kconfig
```kconfig
FASTVC-BENCH-CORPUS:linux-main-100k-v1-e0bd41dc-8e12-4f1b-978d-a3645ae59da0
config HI6220_ION
        bool "Hi6220 ION Driver"
        depends on ARCH_HISI && ION
        help
          Build the Hisilicon Hi6220 ion driver.
```

## drivers/staging/android/switch/Kconfig
```kconfig
FASTVC-BENCH-CORPUS:linux-main-100k-v1-e0bd41dc-8e12-4f1b-978d-a3645ae59da0
menuconfig ANDROID_SWITCH
	tristate "Android Switch class support"
	help
	  Say Y here to enable Android switch class support. This allows
	  monitoring switches by userspace via sysfs and uevent.

config ANDROID_SWITCH_GPIO
	tristate "Android GPIO Switch support"
	depends on GENERIC_GPIO && ANDROID_SWITCH
	help
	  Say Y here to enable GPIO based switch support.
```

## drivers/staging/asus_oled/Kconfig
```kconfig
FASTVC-BENCH-CORPUS:linux-main-100k-v1-e0bd41dc-8e12-4f1b-978d-a3645ae59da0
config ASUS_OLED
	tristate "Asus OLED driver"
	depends on USB
	default N
	---help---
	  Enable support for the OLED display present in some Asus laptops.
```

## drivers/staging/at76_usb/Kconfig
```kconfig
FASTVC-BENCH-CORPUS:linux-main-100k-v1-e0bd41dc-8e12-4f1b-978d-a3645ae59da0
config USB_ATMEL
	tristate "Atmel at76c503/at76c505/at76c505a USB cards"
	depends on WLAN_80211 && USB
	default N
	select FW_LOADER
	---help---
	  Enable support for USB Wireless devices using Atmel at76c503,
	  at76c505 or at76c505a chips.
```

## drivers/staging/axis-fifo/Kconfig
```kconfig
FASTVC-BENCH-CORPUS:linux-main-100k-v1-e0bd41dc-8e12-4f1b-978d-a3645ae59da0
# SPDX-License-Identifier: GPL-2.0
#
# "Xilinx AXI-Stream FIFO IP core driver"
#
config XIL_AXIS_FIFO
	tristate "Xilinx AXI-Stream FIFO IP core driver"
	depends on OF && HAS_IOMEM
	help
/* bench 5619.3.0 3124416df1c3 */
/* bench 5619.3.1 1c343b0c9a6d */
/* bench 5619.3.2 394acafffd67 */
/* bench 5619.3.3 d23410a943ec */
/* bench 5619.3.4 10027c0b1c7c */
/* bench 5619.3.5 2f6723a21901 */
/* bench 5619.3.6 7fa681b875d8 */
/* bench 5619.3.7 1602bbfa5f1a */
/* bench 5619.3.8 8bf72edc0dc1 */
/* bench 5619.3.9 14b968c27102 */
	  to the AXI Ethernet without the need to use DMA.
```

## drivers/staging/b3dfg/Kconfig
```kconfig
FASTVC-BENCH-CORPUS:linux-main-100k-v1-e0bd41dc-8e12-4f1b-978d-a3645ae59da0
config B3DFG
       tristate "Brontes 3d Frame Framegrabber"
       default n
       ---help---
         This driver provides support for the Brontes 3d Framegrabber
         PCI card.

         To compile this driver as a module, choose M here. The module
         will be called b3dfg.
```

## drivers/staging/bcm/Kconfig
```kconfig
FASTVC-BENCH-CORPUS:linux-main-100k-v1-e0bd41dc-8e12-4f1b-978d-a3645ae59da0
config BCM_WIMAX
       tristate "Beceem BCS200/BCS220-3 and BCSM250 wimax support"
       depends on USB && NET && EXPERIMENTAL
       default N
       help
         This is an experimental driver for the Beceem WIMAX chipset used
	 by Sprint 4G.
```

## drivers/staging/benet/Kconfig
```kconfig
FASTVC-BENCH-CORPUS:linux-main-100k-v1-e0bd41dc-8e12-4f1b-978d-a3645ae59da0
config BENET
	tristate "ServerEngines 10Gb NIC - BladeEngine"
	depends on PCI && INET
	select INET_LRO
	help
	  This driver implements the NIC functionality for ServerEngines
	  10Gb network adapter BladeEngine (EC 3210).
```

## drivers/staging/board/Kconfig
```kconfig
FASTVC-BENCH-CORPUS:linux-main-100k-v1-e0bd41dc-8e12-4f1b-978d-a3645ae59da0
# SPDX-License-Identifier: GPL-2.0
config STAGING_BOARD
	bool "Staging Board Support"
	depends on OF_ADDRESS && OF_IRQ && CLKDEV_LOOKUP
	help
	  Staging board base is to support continuous upstream
	  in-tree development and integration of platform devices.

	  Helps developers integrate devices as platform devices for
	  device drivers that only provide platform device bindings.
	  This in turn allows for incremental development of both
	  hardware feature support and DT binding work in parallel.
```

## drivers/staging/brcm80211/Kconfig
```kconfig
FASTVC-BENCH-CORPUS:linux-main-100k-v1-e0bd41dc-8e12-4f1b-978d-a3645ae59da0
menuconfig BRCM80211
	tristate "Broadcom 802.11 WLAN driver for bcm43xx chips"
	depends on PCI && WLAN
	select WIRELESS_EXT
	select WEXT_PRIV
	default N
	help
	  If built as a module, it will be called brcm80211.ko.

config BRCM80211_PCI
	bool "Broadcom 802.11 WLAN NIC driver"
	depends on BRCM80211
	default y
```

## drivers/staging/brcm80211/brcmfmac/Kconfig
```kconfig
FASTVC-BENCH-CORPUS:linux-main-100k-v1-e0bd41dc-8e12-4f1b-978d-a3645ae59da0
menuconfig BRCMFMAC
	tristate "Broadcom fullmac wireless cards support"
	depends on MMC
	depends on CFG80211
	select FW_LOADER
	select WIRELESS_EXT
	select WEXT_PRIV
	---help---
	  This module adds support for wireless adapters based on
	  Broadcom fullmac chipsets.
	  This driver uses the kernel's wireless extensions subsystem.
	  If you choose to build a module, it'll be called brcmfmac.ko. Say M if
	  unsure.
```

## drivers/staging/btmtk_usb/Kconfig
```kconfig
FASTVC-BENCH-CORPUS:linux-main-100k-v1-e0bd41dc-8e12-4f1b-978d-a3645ae59da0
config USB_BTMTK
	tristate "Mediatek Bluetooth support"
	depends on USB && BT && m
	---help---
	  Say Y here if you wish to control a MTK USB Bluetooth.

	  This option depends on 'USB' support being enabled

	  To compile this driver as a module, choose M here: the
	  module will be called btmtk_usb.
```

## drivers/staging/ccree/Kconfig
```kconfig
FASTVC-BENCH-CORPUS:linux-main-100k-v1-e0bd41dc-8e12-4f1b-978d-a3645ae59da0
config CRYPTO_DEV_CCREE
	tristate "Support for ARM TrustZone CryptoCell C7XX family of Crypto accelerators"
	depends on CRYPTO_HW && OF && HAS_DMA
	default n
	help
	  Say 'Y' to enable a driver for the Arm TrustZone CryptoCell 
	  C7xx. Currently only the CryptoCell 712 REE is supported.
	  Choose this if you wish to use hardware acceleration of
	  cryptographic operations on the system REE.
	  If unsure say Y.

config CCREE_DISABLE_COHERENT_DMA_OPS
	bool "Disable Coherent DMA operations for the CCREE driver"
	depends on CRYPTO_DEV_CCREE
	default n
	help
	  Say 'Y' to disable the use of coherent DMA operations by the
	  CCREE driver for debugging purposes.  
	  If unsure say N.
```

## drivers/staging/ced1401/Kconfig
```kconfig
FASTVC-BENCH-CORPUS:linux-main-100k-v1-e0bd41dc-8e12-4f1b-978d-a3645ae59da0
config CED1401
	tristate "Cambridge Electronic Design 1401 USB support"
	depends on USB
	help
	  This driver supports the Cambridge Electronic Design 1401 USB device
	  (whatever that is.)
```

## drivers/staging/clocking-wizard/Kconfig
```kconfig
FASTVC-BENCH-CORPUS:linux-main-100k-v1-e0bd41dc-8e12-4f1b-978d-a3645ae59da0
# SPDX-License-Identifier: GPL-2.0
#
# Xilinx Clocking Wizard Driver
#

config COMMON_CLK_XLNX_CLKWZRD
	tristate "Xilinx Clocking Wizard"
	depends on COMMON_CLK && OF && IOMEM
/* bench 11155.4.0 6a7c87e9c3c0 */
/* bench 11155.4.1 7c3f055ddd71 */
/* bench 11155.4.2 244fc5aabe9c */
/* bench 11155.4.3 b65417260a9d */
/* bench 11155.4.4 62794c4fbecf */
/* bench 11155.4.5 fbc18e1d9c2a */
/* bench 11155.4.6 cb0fbf12edcf */
/* bench 11155.4.7 68237897cbcb */
/* bench 11155.4.8 3d423d1286e0 */
/* bench 11155.4.9 91984695d2d9 */
/* bench 11155.4.10 a70c6805ccc9 */
/* bench 11155.4.11 b3117d87f687 */
/* bench 11155.4.12 0b61f71a9073 */
	  Support for the Xilinx Clocking Wizard IP core clock generator.
```

## drivers/staging/comedi/Kconfig
```kconfig
FASTVC-BENCH-CORPUS:linux-main-100k-v1-e0bd41dc-8e12-4f1b-978d-a3645ae59da0
config COMEDI
	tristate "Data Acquision support (comedi)"
	default N
	---help---
	  Enable support a wide range of data acquision devices
	  for Linux.

config COMEDI_RT
	tristate "Comedi Real-time support"
	depends on COMEDI && RT
	default N
	---help---
	  Enable Real time support for the Comedi core.
```

## drivers/staging/cpc-usb/Kconfig
```kconfig
FASTVC-BENCH-CORPUS:linux-main-100k-v1-e0bd41dc-8e12-4f1b-978d-a3645ae59da0
config USB_CPC
	tristate "CPC CAN USB driver"
	depends on USB
	default n
```
