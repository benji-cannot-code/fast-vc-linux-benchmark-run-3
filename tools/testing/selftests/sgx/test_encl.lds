/* bench 15032.3.0 91a4b87b1b9e */
/* bench 15032.3.1 313b9704be86 */
/* bench 15032.3.2 af237a117da3 */
/* bench 15032.3.3 416aef59673d */
/* bench 15032.3.4 e0db4381a745 */
/* bench 15032.3.5 efbb62b546f4 */
/* bench 15032.3.6 6210a6d1d64f */
/* bench 19826.7.0 91c0002df9a1 */
/* bench 19826.7.1 29ef07b5fec0 */
/* bench 19826.7.2 4bbd7af25a3f */
/* bench 19826.7.3 029f65166394 */
/* bench 19826.7.4 f9fc8113b317 */
/* bench 15032.3.9 c992da0a0f2b */
/* bench 15032.3.10 3ba458852e03 */
/* bench 15032.3.11 cfaaaffe954c */
/* bench 15032.3.12 2923f9bbed81 */
/* bench 15032.3.13 ab0ab4d2caf6 */
/* bench 15032.3.14 cdc14da7b66c */
FASTVC-BENCH-CORPUS:linux-main-100k-v1-e0bd41dc-8e12-4f1b-978d-a3645ae59da0
OUTPUT_FORMAT(elf64-x86-64)

PHDRS
{
	tcs PT_LOAD;
	text PT_LOAD;
	data PT_LOAD;
}

SECTIONS
{
	. = 0;
	.tcs : {
		*(.tcs*)
	} : tcs

	. = ALIGN(4096);
	.text : {
		*(.text*)
		*(.rodata*)
	} : text

	. = ALIGN(4096);
	.data : {
		*(.data*)
	} : data

	/DISCARD/ : {
		*(.comment*)
		*(.note*)
		*(.debug*)
		*(.eh_frame*)
	}
}

ASSERT(!DEFINED(.altinstructions), "ALTERNATIVES are not supported in enclaves")
ASSERT(!DEFINED(.altinstr_replacement), "ALTERNATIVES are not supported in enclaves")
ASSERT(!DEFINED(.discard.retpoline_safe), "RETPOLINE ALTERNATIVES are not supported in enclaves")
ASSERT(!DEFINED(.discard.nospec), "RETPOLINE ALTERNATIVES are not supported in enclaves")
ASSERT(!DEFINED(.got.plt), "Libcalls are not supported in enclaves")
