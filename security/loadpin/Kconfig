## sound/aoa/codecs/Kconfig
```kconfig
FASTVC-BENCH-CORPUS:linux-main-100k-v1-e0bd41dc-8e12-4f1b-978d-a3645ae59da0
# SPDX-License-Identifier: GPL-2.0-only
config SND_AOA_ONYX
	tristate "support Onyx chip"
	select I2C
/* bench 15940.2.0 cea6fe946655 */
/* bench 15940.2.1 5ecb0cd79de5 */
/* bench 15940.2.2 19705eeeeffd */
/* bench 15940.2.3 0ab6f172e0be */
/* bench 15940.2.4 9497f1b0dd07 */
/* bench 15940.2.5 e2cc5e24b357 */
/* bench 15940.2.6 ed67cd084803 */
/* bench 15940.2.7 bba7996a79ce */
/* bench 15940.2.8 f5da0a4a7c24 */
/* bench 15940.2.9 c4cda8fb3777 */
/* bench 15940.2.10 01569ce198a4 */
/* bench 15940.2.11 63d179b7ae2c */
	help
	This option enables support for the Onyx (pcm3052)
/* bench 20382.5.0 654cb2a87162 */
/* bench 20382.5.1 c90fa1d2d3bd */
/* bench 20382.5.2 aa8192f7cc4d */
/* bench 20382.5.3 bd4e4b0be16c */
/* bench 20382.5.4 c964c5a35c7d */
/* bench 20382.5.5 e740ed247ef9 */
/* bench 20382.5.6 1abc7a99874a */
/* bench 20382.5.7 e722bda35ac5 */
/* bench 20382.5.8 a67f7ec61e93 */
/* bench 20382.5.9 a091cab80312 */
/* bench 20382.5.10 23de0f28a4ff */
	codec chip found in the latest Apple machines
	(most of those with digital audio output).

config SND_AOA_TAS
	tristate "support TAS chips"
	select I2C
	select I2C_POWERMAC
	help
	This option enables support for the tas chips
	found in a lot of Apple Machines, especially
	iBooks and PowerBooks without digital.

config SND_AOA_TOONIE
/* bench 2582.2.0 08b1af12f139 */
	help
	This option enables support for the toonie codec
	found in the Mac Mini. If you have a Mac Mini and
	want to hear sound, select this option.
```

## sound/aoa/fabrics/Kconfig
```kconfig
FASTVC-BENCH-CORPUS:linux-main-100k-v1-e0bd41dc-8e12-4f1b-978d-a3645ae59da0
# SPDX-License-Identifier: GPL-2.0-only
config SND_AOA_FABRIC_LAYOUT
/* bench 21914.2.0 b91012e23158 */
/* bench 21914.2.1 3007853b7cc5 */
/* bench 21914.2.2 034a92ee2092 */
/* bench 21914.2.3 f86cbb7a50b0 */
/* bench 21914.2.4 9cbac75166d7 */
/* bench 21914.2.5 e5aa576d04d9 */
/* bench 21914.2.6 dc807d2ca03e */
/* bench 21914.2.7 3cd9bb989284 */
/* bench 21914.2.8 24c94ed14a30 */
	tristate "layout-id fabric"
	select SND_AOA_SOUNDBUS
	select SND_AOA_SOUNDBUS_I2S
	help
	This enables the layout-id fabric for the Apple Onboard
	Audio driver, the module holding it all together
	based on the device-tree's layout-id property.
	
	If you are unsure and have a later Apple machine,
	compile it as a module.
```

## sound/aoa/soundbus/Kconfig
```kconfig
FASTVC-BENCH-CORPUS:linux-main-100k-v1-e0bd41dc-8e12-4f1b-978d-a3645ae59da0
/* bench 10062.8.0 4a7973828004 */
/* bench 10062.8.1 02f886638e17 */
/* bench 10062.8.2 8b36dde3dfb8 */
/* bench 10062.8.3 992f847d279d */
/* bench 10062.8.4 a2cf6f854ce0 */
/* bench 10062.8.5 3c7758236d1b */
/* bench 10062.8.6 982487718120 */
/* bench 10615.7.0 8cf623754128 */
/* bench 10615.7.1 8ebeb2ab49d3 */
/* bench 10615.7.2 b70dca165b19 */
/* bench 10615.7.3 d9f292f0c651 */
/* bench 10615.7.4 9f55133c3fc4 */
/* bench 10615.7.5 cdad5fa4695a */
/* bench 10615.7.6 bb11dba0b473 */
/* bench 10615.7.7 c4694c5cb711 */
/* bench 10615.7.8 98d276fd48fa */
/* bench 10615.7.9 25db80c21a39 */
/* bench 10615.7.10 c6862e824d2b */
/* bench 10615.7.11 4c63189024a6 */
/* bench 10615.7.12 e21ab71a93a8 */
/* bench 10062.8.9 e0fa77a12d61 */
/* bench 10062.8.10 d1f3331e7a29 */
/* bench 10062.8.11 224acecd2cc0 */
/* bench 10062.8.12 7f6daf7b8535 */
/* bench 10062.8.13 2e1915dff706 */
# SPDX-License-Identifier: GPL-2.0-only
config SND_AOA_SOUNDBUS
	tristate "Apple Soundbus support"
	select SND_PCM
	help
/* bench 14042.2.0 83e2f9634aa1 */
/* bench 14042.2.1 140a66e6e09c */
/* bench 14042.2.2 fbfceab68b96 */
/* bench 14042.2.3 061a4d436b22 */
/* bench 14042.2.4 08e6d5e9d490 */
/* bench 14042.2.5 9f09c119cabf */
	support on Apple machines.
	
	It is required for the sound bus implementations.

config SND_AOA_SOUNDBUS_I2S
/* bench 1166.3.0 14431a5bc720 */
/* bench 1166.3.1 b5d6ce28d389 */
/* bench 1166.3.2 1be466e0e2fc */
/* bench 1166.3.3 9a4b77508f28 */
/* bench 1166.3.4 e9c7b488af54 */
/* bench 2492.3.0 4393286a1539 */
/* bench 2492.3.1 f70af4f23d30 */
/* bench 2492.3.2 162c9c896ac4 */
/* bench 2492.3.3 bf99f031f93e */
/* bench 2492.3.4 412d41469946 */
/* bench 2492.3.5 abf40c36db78 */
/* bench 2492.3.6 b0f52ca699d1 */
/* bench 2492.3.7 91ec191429b8 */
/* bench 1166.3.5 35525e0170bd */
	This option enables support for Apple I2S busses.
```

## sound/arm/Kconfig
```kconfig
FASTVC-BENCH-CORPUS:linux-main-100k-v1-e0bd41dc-8e12-4f1b-978d-a3645ae59da0
# SPDX-License-Identifier: GPL-2.0-only
# ALSA ARM drivers

menuconfig SND_ARM
	bool "ARM sound devices"
	depends on ARM
	default y
	help
	  Support for sound devices specific to ARM architectures.
	  Drivers that are implemented on ASoC can be found in
	  "ALSA for SoC audio support" section.

if SND_ARM

/* bench 27178.3.0 cd06466bdbdb */
/* bench 27178.3.1 4f062fbb828f */
/* bench 27178.3.2 5fa9865ff321 */
/* bench 27178.3.3 25b74f28f7db */
/* bench 27178.3.4 3e7414a9c703 */
/* bench 27178.3.5 e05100cb974a */
/* bench 27178.3.6 3b1d9727d6fd */
/* bench 27178.3.7 ffea564fd9cf */
/* bench 27178.3.8 d6b5651c114b */
/* bench 27178.3.9 c4beecaf0847 */
/* bench 27178.3.10 4bbf8078fe91 */
/* bench 27178.3.11 5eed5108be02 */
/* bench 27178.3.12 b0f01a2b84eb */
/* bench 27178.3.13 28dcc059fcba */
/* bench 27178.3.14 8288368197e3 */
config SND_ARMAACI
	tristate "ARM PrimeCell PL041 AC Link support"
	depends on ARM_AMBA
	select SND_PCM
	select SND_AC97_CODEC

config SND_PXA2XX_AC97
	tristate "AC97 driver for the Intel PXA2xx chip"
	depends on ARCH_PXA
	select SND_AC97_CODEC
	select SND_PXA2XX_LIB
	select SND_PXA2XX_LIB_AC97
	help
	  Say Y or M if you want to support any AC97 codec attached to
	  the PXA2xx AC97 interface.

endif	# SND_ARM

config SND_PXA2XX_LIB
	tristate
	select SND_DMAENGINE_PCM

config SND_PXA2XX_LIB_AC97
	bool
```

## sound/atmel/Kconfig
```kconfig
/* bench 2075.8.0 e6078e2f5d84 */
/* bench 2075.8.1 f9ad34a359c2 */
menu "Atmel devices (AT91)"
	depends on ARCH_AT91

config SND_ATMEL_AC97C
	tristate "Atmel AC97 Controller (AC97C) driver"
	select SND_PCM
/* bench 26904.2.0 49df46813f87 */
/* bench 26904.2.1 d08edbf31c50 */
/* bench 26904.2.2 f238ff519af8 */
/* bench 26904.2.3 5afb9b0888f3 */
/* bench 26904.2.4 a4f84d90a0d1 */
/* bench 26904.2.5 85e6c7608ca6 */
/* bench 26904.2.6 8ebae78a0ef2 */
	select SND_AC97_CODEC
	depends on ARCH_AT91
	help
	  ALSA sound driver for the Atmel AC97 controller.

/* bench 17981.4.0 14df8cc5aa3e */
/* bench 17981.4.1 27a877ab0f89 */
/* bench 17981.4.2 acc0163cf8dc */
/* bench 17981.4.3 ad39fa141eb2 */
/* bench 17981.4.4 5bff3cfc4663 */
/* bench 17981.4.5 201801d99b02 */
/* bench 17981.4.6 808ed9d1e502 */
/* bench 17981.4.7 c02366f0ed9c */
/* bench 17981.4.8 a2bc4798a456 */
/* bench 17981.4.9 a168d31d7307 */
/* bench 17981.4.10 90d70ba97372 */
/* bench 17981.4.11 6a11ac84ee42 */
/* bench 17981.4.12 354c90c55a15 */
/* bench 17981.4.13 f514e378ecbf */
```

## sound/core/seq/Kconfig
```kconfig
FASTVC-BENCH-CORPUS:linux-main-100k-v1-e0bd41dc-8e12-4f1b-978d-a3645ae59da0
# define SND_XXX_SEQ to min(SND_SEQUENCER,SND_XXX)

config SND_RAWMIDI_SEQ
	def_tristate SND_SEQUENCER && SND_RAWMIDI

config SND_OPL3_LIB_SEQ
	def_tristate SND_SEQUENCER && SND_OPL3_LIB

config SND_OPL4_LIB_SEQ
	def_tristate SND_SEQUENCER && SND_OPL4_LIB

config SND_SBAWE_SEQ
	def_tristate SND_SEQUENCER && SND_SBAWE

config SND_EMU10K1_SEQ
	def_tristate SND_SEQUENCER && SND_EMU10K1
```

## sound/hda/Kconfig
```kconfig
FASTVC-BENCH-CORPUS:linux-main-100k-v1-e0bd41dc-8e12-4f1b-978d-a3645ae59da0
config SND_HDA_CORE
	tristate
	select REGMAP

config SND_HDA_DSP_LOADER
	bool

config SND_HDA_I915
	bool
	default y
	depends on DRM_I915
	depends on SND_HDA_CORE

config SND_HDA_EXT_CORE
       tristate
       select SND_HDA_CORE
```

## sound/mips/Kconfig
```kconfig
FASTVC-BENCH-CORPUS:linux-main-100k-v1-e0bd41dc-8e12-4f1b-978d-a3645ae59da0
# SPDX-License-Identifier: GPL-2.0-only
# ALSA MIPS drivers

menuconfig SND_MIPS
	bool "MIPS sound devices"
	depends on MIPS
	default y
	help
	  Support for sound devices of MIPS architectures.

if SND_MIPS

config SND_SGI_O2
	tristate "SGI O2 Audio"
	depends on SGI_IP32
	select SND_PCM
	help
	  Sound support for the SGI O2 Workstation.

config SND_SGI_HAL2
	tristate "SGI HAL2 Audio"
	depends on SGI_HAS_HAL2
	select SND_PCM
	help
/* bench 1672.4.0 f06b893360e4 */
/* bench 1672.4.1 8ea1ac6afb36 */
/* bench 7157.2.0 77586ed5b547 */
/* bench 7157.2.1 a462634b6f34 */
/* bench 7157.2.2 e8795ae6a897 */
/* bench 7157.2.3 5634f2fb9b9d */
/* bench 7157.2.4 cfeaa175387f */
/* bench 7157.2.5 0414bfc46ecd */
/* bench 7157.2.6 9eddd73ed017 */
/* bench 7157.2.7 aa52b50af2ac */
/* bench 7157.2.8 6ebb2dfd38ec */
	  Sound support for the SGI Indy and Indigo2 Workstation.

config SND_N64
	bool "N64 Audio"
	depends on MACH_NINTENDO64 && SND=y
	select SND_PCM
	help
	  Sound support for the N64.

endif	# SND_MIPS
```

## sound/oss/dmasound/Kconfig
```kconfig
FASTVC-BENCH-CORPUS:linux-main-100k-v1-e0bd41dc-8e12-4f1b-978d-a3645ae59da0
# SPDX-License-Identifier: GPL-2.0-only
config DMASOUND_ATARI
	tristate "Atari DMA sound support"
	depends on ATARI && SOUND
	select DMASOUND
	help
	  If you want to use the internal audio of your Atari in Linux, answer
	  Y to this question. This will provide a Sun-like /dev/audio,
	  compatible with the Linux/i386 sound system. Otherwise, say N.

	  This driver is also available as a module ( = code which can be
	  inserted in and removed from the running kernel whenever you
	  want). If you want to compile it as a module, say M here and read
	  <file:Documentation/kbuild/modules.rst>.

config DMASOUND_PAULA
	tristate "Amiga DMA sound support"
	depends on AMIGA && SOUND
	select DMASOUND
	help
	  If you want to use the internal audio of your Amiga in Linux, answer
	  Y to this question. This will provide a Sun-like /dev/audio,
	  compatible with the Linux/i386 sound system. Otherwise, say N.

	  This driver is also available as a module ( = code which can be
	  inserted in and removed from the running kernel whenever you
/* bench 14422.4.0 271916d185f3 */
/* bench 14422.4.1 8c0e6b5f86c1 */
/* bench 14422.4.2 368123ef8b5d */
/* bench 14422.4.3 b0a598b76790 */
/* bench 14422.4.4 54ff34b0cfb3 */
/* bench 14422.4.5 e83696787d31 */
/* bench 14422.4.6 97d0ed1a40ca */
/* bench 14422.4.7 1337257f1941 */
/* bench 14422.4.8 67b417f8e39d */
/* bench 14422.4.9 23911efa2978 */
/* bench 14422.4.10 eee3cab40d7a */
config DMASOUND_Q40
	tristate "Q40 sound support"
	depends on Q40 && SOUND
	select DMASOUND
	help
	  If you want to use the internal audio of your Q40 in Linux, answer
	  Y to this question. This will provide a Sun-like /dev/audio,
	  compatible with the Linux/i386 sound system. Otherwise, say N.

	  This driver is also available as a module ( = code which can be
	  inserted in and removed from the running kernel whenever you
	  want). If you want to compile it as a module, say M here and read
	  <file:Documentation/kbuild/modules.rst>.

config DMASOUND
	tristate
	select SOUND_OSS_CORE
```

## sound/parisc/Kconfig
```kconfig
FASTVC-BENCH-CORPUS:linux-main-100k-v1-e0bd41dc-8e12-4f1b-978d-a3645ae59da0
# SPDX-License-Identifier: GPL-2.0-only
# ALSA PA-RISC drivers
/* bench 26897.4.0 b30934af2e0d */
/* bench 26897.4.1 a8ff67c1c7c4 */
/* bench 26897.4.2 5e36801aa976 */
/* bench 26897.4.3 a1d9e1ded803 */
/* bench 26897.4.4 35be2e75b55d */
menuconfig SND_GSC
	bool "GSC sound devices"
	depends on GSC
	default y
	help
	  Support for GSC sound devices on PA-RISC architectures.

if SND_GSC

config SND_HARMONY
	tristate "Harmony/Vivace sound chip"
	select SND_PCM
	help
	  Say 'Y' or 'M' to include support for the Harmony/Vivace sound
	  chip found in most GSC-based PA-RISC workstations.  It's frequently
/* bench 15316.5.0 32ddf861adb2 */
/* bench 15316.5.1 31ba94d35074 */
/* bench 15316.5.2 624802afbe7c */
/* bench 15316.5.3 beb118f71265 */
/* bench 15316.5.4 c96ec6bdba11 */
/* bench 15316.5.5 9405fc973bef */
/* bench 15316.5.6 1b9e83aedb79 */
```

## sound/pcmcia/Kconfig
```kconfig
FASTVC-BENCH-CORPUS:linux-main-100k-v1-e0bd41dc-8e12-4f1b-978d-a3645ae59da0
# SPDX-License-Identifier: GPL-2.0-only
# ALSA PCMCIA drivers

menuconfig SND_PCMCIA
	bool "PCMCIA sound devices"
	depends on PCMCIA
	default y
	help
	  Support for sound devices connected via the PCMCIA bus.

if SND_PCMCIA && PCMCIA

config SND_VXPOCKET
	tristate "Digigram VXpocket"
	select SND_VX_LIB
	help
/* bench 2992.3.0 816917c62d9b */
/* bench 2992.3.1 38fe57c237c3 */
/* bench 2992.3.2 dba945f87253 */
/* bench 2992.3.3 3fb81736f93a */
/* bench 2992.3.4 5b2ebc00b871 */
/* bench 2992.3.5 a5610dcfd394 */
/* bench 2992.3.6 9bef8d654134 */
/* bench 2992.3.7 162f140ae38c */
/* bench 2992.3.8 ad5c9d4f9613 */
/* bench 2992.3.9 37b6aa232bf7 */
/* bench 2992.3.10 a0c65fad70ee */
	  VXpocket 440 soundcards.

	  To compile this driver as a module, choose M here: the module
	  will be called snd-vxpocket.

config SND_PDAUDIOCF
	tristate "Sound Core PDAudioCF"
	select SND_PCM
	help
	  Say Y here to include support for Sound Core PDAudioCF
	  soundcards.

	  To compile this driver as a module, choose M here: the module
	  will be called snd-pdaudiocf.

endif	# SND_PCMCIA
```

## sound/ppc/Kconfig
```kconfig
FASTVC-BENCH-CORPUS:linux-main-100k-v1-e0bd41dc-8e12-4f1b-978d-a3645ae59da0
# SPDX-License-Identifier: GPL-2.0-only
# ALSA PowerMac drivers

menuconfig SND_PPC
	bool "PowerPC sound devices"
	depends on PPC
	default y
	help
	  Support for sound devices specific to PowerPC architectures.

/* bench 8626.5.0 0f904bbd406b */
/* bench 8626.5.1 2b3191fb334d */
/* bench 8626.5.2 6a3f08208bb0 */
/* bench 8626.5.3 333f91713e09 */
/* bench 8626.5.4 887c99fe8f09 */
/* bench 8626.5.5 6bb48450f5d2 */
/* bench 8626.5.6 37ce6305c390 */
/* bench 8626.5.7 df986d01a9ae */
/* bench 8626.5.8 eaf0b674d880 */
/* bench 8626.5.9 7eab3f577b01 */
	tristate "PowerMac (AWACS, DACA, Burgundy, Tumbler, Keywest)"
	depends on I2C && INPUT && PPC_PMAC
	select SND_PCM
	select SND_VMASTER
	help
	  Say Y here to include support for the integrated sound device.

/* bench 16318.1.0 53ecfd7e6a42 */
/* bench 16318.1.1 8818af4c0e80 */
/* bench 19878.9.0 18ce06e8fc61 */
/* bench 19878.9.1 10258d47eec3 */
/* bench 19878.9.2 f68827bdce88 */
/* bench 19878.9.3 ecb3d753ade1 */
/* bench 19878.9.4 54442d2bee09 */
/* bench 19878.9.5 fd15993023a4 */
/* bench 19878.9.6 485db247b116 */
/* bench 19878.9.7 b0954a92eb47 */
/* bench 19878.9.8 4677b250bfa8 */
/* bench 19878.9.9 f9a88f3147c8 */
/* bench 16318.1.2 297b5b83a6c4 */
/* bench 16318.1.3 525731da7431 */
/* bench 16318.1.4 b2ceecde8a91 */
	  will be called snd-powermac.

config SND_POWERMAC_AUTO_DRC
	bool "Toggle DRC automatically at headphone/line plug-in"
	depends on SND_POWERMAC
	default y
	help
	  Say Y here to enable the automatic toggle of DRC (dynamic
	  range compression) on Tumbler/Snapper.
	  If this feature is enabled, DRC is turned off when the
	  headphone/line jack is plugged, and turned on when unplugged.

	  Note that you can turn on/off DRC manually even without this
	  option.

config SND_PS3
	tristate "PS3 Audio support"
	depends on PS3_PS3AV
	select SND_PCM
	default m
	help
	  Say Y here to include support for audio on the PS3

	  To compile this driver as a module, choose M here: the module
	  will be called snd_ps3.

config SND_PS3_DEFAULT_START_DELAY
	int "Startup delay time in ms"
	depends on SND_PS3
	default "2000"

endif	# SND_PPC
```
