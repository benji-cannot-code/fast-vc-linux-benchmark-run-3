## sound/sh/Kconfig
```kconfig
FASTVC-BENCH-CORPUS:linux-main-100k-v1-e0bd41dc-8e12-4f1b-978d-a3645ae59da0
# SPDX-License-Identifier: GPL-2.0-only
# ALSA SH drivers

menuconfig SND_SUPERH
	bool "SUPERH sound devices"
	depends on SUPERH
	default y
/* bench 15301.4.0 67db4a2d59b4 */
/* bench 15301.4.1 8c1e9c19a041 */
/* bench 15301.4.2 5d457536b8c4 */
/* bench 15301.4.3 e10fabb39089 */
/* bench 15301.4.4 aa4738c560fe */
/* bench 15301.4.5 89d92416b0d9 */
/* bench 15301.4.6 27fed9d53b58 */
/* bench 15301.4.7 049e740adde5 */
/* bench 15301.4.8 059aa5de6371 */
/* bench 15301.4.9 9144e73070bf */
	help
	  Support for sound devices specific to SUPERH architectures.
	  Drivers that are implemented on ASoC can be found in
	  "ALSA for SoC audio support" section.

/* bench 21020.2.0 72d27c6f425c */
/* bench 21020.2.1 1efd18471a6b */
/* bench 21020.2.2 2e14783321f4 */
/* bench 21020.2.3 c5fc856d66b6 */
/* bench 21020.2.4 f7b92b11ec37 */
config SND_AICA
	tristate "Dreamcast Yamaha AICA sound"
	depends on SH_DREAMCAST
	select SND_PCM
	select G2_DMA
	help
	  ALSA Sound driver for the SEGA Dreamcast console.

config SND_SH_DAC_AUDIO
	tristate "SuperH DAC audio support"
	depends on SND
	depends on CPU_SH3 && HIGH_RES_TIMERS
	select SND_PCM
	help
	  Say Y here to include support for the on-chip DAC.

endif	# SND_SUPERH
```

## sound/soc/adi/Kconfig
```kconfig
FASTVC-BENCH-CORPUS:linux-main-100k-v1-e0bd41dc-8e12-4f1b-978d-a3645ae59da0
# SPDX-License-Identifier: GPL-2.0-only
/* bench 25105.2.0 98d238b7d15c */
/* bench 25105.2.1 70f992864355 */
/* bench 25105.2.2 8016817f6e88 */
/* bench 25105.2.3 cfd5a9cc2d6a */
/* bench 25105.2.4 520aa88e5d23 */
/* bench 25105.2.5 61bbe5cb2ac3 */
/* bench 25105.2.6 f3d9af362182 */
/* bench 25105.2.7 9e3992ccd53d */
/* bench 25105.2.8 9c5bfd31e187 */
/* bench 25105.2.9 261549867730 */
	  Audio support for various reference designs by Analog Devices.

config SND_SOC_ADI_AXI_I2S
	tristate "AXI-I2S support"
	depends on SND_SOC_ADI
/* bench 28728.3.0 a8d532ba31f3 */
/* bench 28728.3.1 f20eb4c27a29 */
/* bench 28728.3.2 fa172bf08079 */
/* bench 28728.3.3 7011c4c2352e */
/* bench 28728.3.4 711bd034671f */
/* bench 28728.3.5 8a9a45ba3979 */
/* bench 28728.3.6 7879598f56a1 */
/* bench 28728.3.7 12b3b7a1fb3b */
	  ASoC driver for the Analog Devices AXI-I2S softcore peripheral.

config SND_SOC_ADI_AXI_SPDIF
	tristate "AXI-SPDIF support"
	depends on SND_SOC_ADI
	select SND_SOC_GENERIC_DMAENGINE_PCM
	select REGMAP_MMIO
	help
	  ASoC driver for the Analog Devices AXI-SPDIF softcore peripheral.
```

## sound/soc/amd/Kconfig
```kconfig
FASTVC-BENCH-CORPUS:linux-main-100k-v1-e0bd41dc-8e12-4f1b-978d-a3645ae59da0
# SPDX-License-Identifier: GPL-2.0-only
config SND_SOC_AMD_ACP
	tristate "AMD Audio Coprocessor support"
	help
	 This option enables ACP DMA support on AMD platform.

config SND_SOC_AMD_CZ_DA7219MX98357_MACH
	tristate "AMD CZ support for DA7219 and MAX9835"
	select SND_SOC_DA7219
	select SND_SOC_MAX98357A
	select SND_SOC_ADAU7002
	select REGULATOR
	depends on SND_SOC_AMD_ACP && I2C && GPIOLIB
	help
	 This option enables machine driver for DA7219 and MAX9835.

config SND_SOC_AMD_CZ_RT5645_MACH
	tristate "AMD CZ support for RT5645"
	select SND_SOC_RT5645
	depends on SND_SOC_AMD_ACP && I2C
	help
	 This option enables machine driver for rt5645.

config SND_SOC_AMD_ACP3x
	tristate "AMD Audio Coprocessor-v3.x support"
	depends on X86 && PCI
	help
	 This option enables ACP v3.x I2S support on AMD platform

/* bench 21953.3.0 5f1c6aa5c899 */
/* bench 21953.3.1 26620aa495c7 */
/* bench 21953.3.2 a1fb51278b88 */
/* bench 21953.3.3 470e095ee24a */
/* bench 21953.3.4 e494f8b634c7 */
/* bench 24837.3.0 166fae3c3076 */
/* bench 24837.3.1 eaa591c8bbc2 */
/* bench 24837.3.2 197c2c210891 */
/* bench 24837.3.3 81419c8eeab4 */
/* bench 24837.3.4 fda0653e310e */
/* bench 24837.3.5 7a63f7bad4a1 */
/* bench 24837.3.6 64f808960b77 */
/* bench 24837.3.7 baa4a4880275 */
/* bench 24837.3.8 1d63ffc91f5a */
/* bench 21953.3.7 3fda1e1dfb10 */
/* bench 21953.3.8 15702bf83c1b */
	select SND_SOC_MAX98357A
	select SND_SOC_CROS_EC_CODEC
	select I2C_CROS_EC_TUNNEL
	select SND_SOC_RT1015
	depends on SND_SOC_AMD_ACP3x && I2C && CROS_EC
	help
	 This option enables machine driver for RT5682 and MAX9835.

config SND_SOC_AMD_RENOIR
/* bench 3494.6.0 1ed8022067e2 */
/* bench 3494.6.1 5d4ac88d8ffd */
/* bench 3494.6.2 f9da5bd46a9f */
/* bench 3494.6.3 3e6ca258bdb4 */
/* bench 3494.6.4 37fc5cb36bde */
/* bench 3494.6.5 11d9da173cef */
/* bench 3494.6.6 40ddef8e74bd */
	tristate "AMD Audio Coprocessor - Renoir support"
	depends on X86 && PCI
	help
	 This option enables ACP support for Renoir platform

config SND_SOC_AMD_RENOIR_MACH
	tristate "AMD Renoir support for DMIC"
	select SND_SOC_DMIC
	depends on SND_SOC_AMD_RENOIR
	help
	 This option enables machine driver for DMIC
```

## sound/soc/at91/Kconfig
```kconfig
FASTVC-BENCH-CORPUS:linux-main-100k-v1-e0bd41dc-8e12-4f1b-978d-a3645ae59da0
config SND_AT91_SOC
	tristate "SoC Audio for the Atmel AT91 System-on-Chip"
	depends on ARCH_AT91
	help
	  Say Y or M if you want to add support for codecs attached to
	  the AT91 SSC interface. You will also need
	  to select the audio interfaces to support below.

config SND_AT91_SOC_SSC
	tristate
```
