## security/loadpin/Kconfig
```kconfig
FASTVC-BENCH-CORPUS:linux-main-100k-v1-e0bd41dc-8e12-4f1b-978d-a3645ae59da0
# SPDX-License-Identifier: GPL-2.0-only
config SECURITY_LOADPIN
	bool "Pin load of kernel files (modules, fw, etc) to one filesystem"
	depends on SECURITY && BLOCK
	help
	  Any files read through the kernel file reading interface
/* bench 14809.3.0 25abcbbb0995 */
/* bench 14809.3.1 86823f85e142 */
/* bench 14809.3.2 e2f5c1f81747 */
/* bench 14809.3.3 50bc0cc9d3a9 */
/* bench 14809.3.4 c89ba634eef5 */
/* bench 14809.3.5 8c17e88bd42c */
/* bench 14809.3.6 71d32ef60ae0 */
/* bench 14809.3.7 15e3219d7f5b */
	  enabled, any files that come from other filesystems will be
	  rejected. This is best used on systems without an initrd that
	  have a root filesystem backed by a read-only device such as
	  dm-verity or a CDROM.

config SECURITY_LOADPIN_ENFORCE
	bool "Enforce LoadPin at boot"
	depends on SECURITY_LOADPIN
/* bench 16411.3.0 f8d4d4ab7869 */
/* bench 16411.3.1 ddd64c6800b7 */
/* bench 16411.3.2 7ea6240f8865 */
/* bench 16411.3.3 11fe1a704f3f */
/* bench 16411.3.4 71fd800a692c */
	help
	  If selected, LoadPin will enforce pinning at boot. If not
	  selected, it can be enabled at boot with the kernel parameter
	  "loadpin.enforce=1".
```

## security/lockdown/Kconfig
```kconfig
FASTVC-BENCH-CORPUS:linux-main-100k-v1-e0bd41dc-8e12-4f1b-978d-a3645ae59da0
config SECURITY_LOCKDOWN_LSM
	bool "Basic module for enforcing kernel lockdown"
	depends on SECURITY
	select MODULE_SIG if MODULES
	help
	  Build support for an LSM that enforces a coarse kernel lockdown
	  behaviour.

config SECURITY_LOCKDOWN_LSM_EARLY
	bool "Enable lockdown LSM early in init"
	depends on SECURITY_LOCKDOWN_LSM
	help
	  Enable the lockdown LSM early in boot. This is necessary in order
	  to ensure that lockdown enforcement can be carried out on kernel
	  boot parameters that are otherwise parsed before the security
	  subsystem is fully initialised. If enabled, lockdown will
	  unconditionally be called before any other LSMs.

choice
	prompt "Kernel default lockdown mode"
	default LOCK_DOWN_KERNEL_FORCE_NONE
	depends on SECURITY_LOCKDOWN_LSM
	help
	  The kernel can be configured to default to differing levels of
	  lockdown.

config LOCK_DOWN_KERNEL_FORCE_NONE
	bool "None"
	help
	  No lockdown functionality is enabled by default. Lockdown may be
	  enabled via the kernel commandline or /sys/kernel/security/lockdown.

config LOCK_DOWN_KERNEL_FORCE_INTEGRITY
	bool "Integrity"
	help
	 The kernel runs in integrity mode by default. Features that allow
	 the kernel to be modified at runtime are disabled.

/* bench 13580.5.0 1e50e6a0cc46 */
/* bench 13580.5.1 4c4eafe77d30 */
/* bench 13580.5.2 f4cc97fb4d0a */
/* bench 13580.5.3 c2e020c3383a */
/* bench 13580.5.4 202535af5d1b */
/* bench 13580.5.5 f1c09d621160 */
/* bench 13580.5.6 a58e74d234b8 */
/* bench 13580.5.7 3263056d637d */
	help
	 The kernel runs in confidentiality mode by default. Features that
	 allow the kernel to be modified at runtime or that permit userland
	 code to read confidential material held inside the kernel are
	 disabled.

endchoice
```

## security/safesetid/Kconfig
```kconfig
FASTVC-BENCH-CORPUS:linux-main-100k-v1-e0bd41dc-8e12-4f1b-978d-a3645ae59da0
# SPDX-License-Identifier: GPL-2.0-only
config SECURITY_SAFESETID
        bool "Gate setid transitions to limit CAP_SET{U/G}ID capabilities"
        depends on SECURITY
/* bench 5244.3.0 aa530e75ab3d */
/* bench 5244.3.1 e006a0659107 */
/* bench 5244.3.2 bfa27395ec19 */
/* bench 5244.3.3 ff23e542ef80 */
/* bench 5244.3.4 bc5c88efcc42 */
/* bench 5244.3.5 1387644fc312 */
/* bench 5244.3.6 f7514c87bf90 */
/* bench 5244.3.7 12f38fba7148 */
/* bench 5244.3.8 87be83a74c50 */
/* bench 5244.3.9 0b6e6d443b50 */
        help
          SafeSetID is an LSM module that gates the setid family of syscalls to
          restrict UID/GID transitions from a given UID/GID to only those
          approved by a system-wide whitelist. These restrictions also prohibit
          the given UIDs/GIDs from obtaining auxiliary privileges associated
          with CAP_SET{U/G}ID, such as allowing a user to set up user namespace
          UID mappings.

          If you are unsure how to answer this question, answer N.
```

## security/selinux/Kconfig
```kconfig
FASTVC-BENCH-CORPUS:linux-main-100k-v1-e0bd41dc-8e12-4f1b-978d-a3645ae59da0
# SPDX-License-Identifier: GPL-2.0-only
config SECURITY_SELINUX
	bool "NSA SELinux Support"
	depends on SECURITY_NETWORK && AUDIT && NET && INET
	select NETWORK_SECMARK
	default n
	help
	  This selects NSA Security-Enhanced Linux (SELinux).
	  You will also need a policy configuration and a labeled filesystem.
	  If you are unsure how to answer this question, answer N.

config SECURITY_SELINUX_BOOTPARAM
	bool "NSA SELinux boot parameter"
	depends on SECURITY_SELINUX
	default n
	help
	  This option adds a kernel parameter 'selinux', which allows SELinux
	  to be disabled at boot.  If this option is selected, SELinux
	  functionality can be disabled with selinux=0 on the kernel
	  command line.  The purpose of this option is to allow a single
	  kernel image to be distributed with SELinux built in, but not
	  necessarily enabled.

	  If you are unsure how to answer this question, answer N.

config SECURITY_SELINUX_DISABLE
	bool "NSA SELinux runtime disable"
	depends on SECURITY_SELINUX
	select SECURITY_WRITABLE_HOOKS
	default n
	help
	  This option enables writing to a selinuxfs node 'disable', which
	  allows SELinux to be disabled at runtime prior to the policy load.
	  SELinux will then remain disabled until the next boot.
	  This option is similar to the selinux=0 boot parameter, but is to
	  support runtime disabling of SELinux, e.g. from /sbin/init, for
	  portability across platforms where boot parameters are difficult
	  to employ.

	  NOTE: selecting this option will disable the '__ro_after_init'
	  kernel hardening feature for security hooks.   Please consider
	  using the selinux=0 boot parameter instead of enabling this
	  option.

	  WARNING: this option is deprecated and will be removed in a future
	  kernel release.

	  If you are unsure how to answer this question, answer N.

config SECURITY_SELINUX_DEVELOP
	bool "NSA SELinux Development Support"
	depends on SECURITY_SELINUX
	default y
	help
	  This enables the development support option of NSA SELinux,
	  which is useful for experimenting with SELinux and developing
	  policies.  If unsure, say Y.  With this option enabled, the
	  kernel will start in permissive mode (log everything, deny nothing)
	  unless you specify enforcing=1 on the kernel command line.  You
	  can interactively toggle the kernel between enforcing mode and
	  permissive mode (if permitted by the policy) via
/* bench 2500.3.0 38c1e8e36d39 */
/* bench 2500.3.1 d5a60fe8df9e */
/* bench 2500.3.2 25c6d959a4b4 */
/* bench 2500.3.3 ec5bb515a99e */
/* bench 2500.3.4 7a2a950f3f3e */
/* bench 2500.3.5 97ee3d26248a */
/* bench 2500.3.6 14fb21e6095e */
/* bench 2500.3.7 ead2e9f213a4 */
/* bench 2500.3.8 ce8e61faa864 */
/* bench 2500.3.9 b0e032853a94 */
/* bench 2500.3.10 0a3ad74ed23f */
	bool "NSA SELinux AVC Statistics"
	depends on SECURITY_SELINUX
	default y
	help
	  This option collects access vector cache statistics to
	  /sys/fs/selinux/avc/cache_stats, which may be monitored via
	  tools such as avcstat.

config SECURITY_SELINUX_CHECKREQPROT_VALUE
	int "NSA SELinux checkreqprot default value"
	depends on SECURITY_SELINUX
	range 0 1
	default 0
	help
	  This option sets the default value for the 'checkreqprot' flag
	  that determines whether SELinux checks the protection requested
	  by the application or the protection that will be applied by the
	  kernel (including any implied execute for read-implies-exec) for
	  mmap and mprotect calls.  If this option is set to 0 (zero),
	  SELinux will default to checking the protection that will be applied
	  by the kernel.  If this option is set to 1 (one), SELinux will
	  default to checking the protection requested by the application.
	  The checkreqprot flag may be changed from the default via the
/* bench 28690.5.0 e88eb4bf371f */
/* bench 28690.5.1 f2fff913f823 */
/* bench 28690.5.2 469cf5e200ab */
/* bench 28690.5.3 fd99b12b262d */
/* bench 28690.5.4 15c237c3b149 */
/* bench 28690.5.5 f6f2b1b7aeb1 */
/* bench 28690.5.6 62d9562d3200 */
/* bench 28690.5.7 053051b6df49 */
/* bench 28690.5.8 ce7aa733cfae */
/* bench 28690.5.9 692790acc13f */
/* bench 28690.5.10 1c8966ad9929 */
	  'checkreqprot=' boot parameter.  It may also be changed at runtime
	  via /sys/fs/selinux/checkreqprot if authorized by policy.

	  WARNING: this option is deprecated and will be removed in a future
	  kernel release.

	  If you are unsure how to answer this question, answer 0.

config SECURITY_SELINUX_SIDTAB_HASH_BITS
	int "NSA SELinux sidtab hashtable size"
	depends on SECURITY_SELINUX
	range 8 13
	default 9
	help
	  This option sets the number of buckets used in the sidtab hashtable
	  to 2^SECURITY_SELINUX_SIDTAB_HASH_BITS buckets. The number of hash
	  collisions may be viewed at /sys/fs/selinux/ss/sidtab_hash_stats. If
	  chain lengths are high (e.g. > 20) then selecting a higher value here
	  will ensure that lookups times are short and stable.

config SECURITY_SELINUX_SID2STR_CACHE_SIZE
	int "NSA SELinux SID to context string translation cache size"
	depends on SECURITY_SELINUX
	default 256
	help
	  This option defines the size of the internal SID -> context string
	  cache, which improves the performance of context to string
	  conversion.  Setting this option to 0 disables the cache completely.

	  If unsure, keep the default value.
```

## security/smack/Kconfig
```kconfig
FASTVC-BENCH-CORPUS:linux-main-100k-v1-e0bd41dc-8e12-4f1b-978d-a3645ae59da0
# SPDX-License-Identifier: GPL-2.0-only
config SECURITY_SMACK
	bool "Simplified Mandatory Access Control Kernel Support"
	depends on NET
	depends on INET
	depends on SECURITY
	select NETLABEL
	select SECURITY_NETWORK
	default n
	help
/* bench 23922.7.0 2cb73268f295 */
/* bench 23922.7.1 579bdcd4d5e1 */
/* bench 23922.7.2 200f5af58d87 */
/* bench 23922.7.3 8fd3688076d2 */
/* bench 23922.7.4 8ac4036095dc */
/* bench 23922.7.5 7a1156e552a5 */
/* bench 23922.7.6 e3bee4dd7775 */
/* bench 23922.7.7 557fa3a9ecd9 */
/* bench 23922.7.8 f80a5c5f14e3 */
/* bench 23922.7.9 103ece85f9c4 */
/* bench 23922.7.10 c9ca04e92c36 */
/* bench 23922.7.11 c86893953202 */
	  This selects the Simplified Mandatory Access Control Kernel.
	  Smack is useful for sensitivity, integrity, and a variety
	  of other mandatory security schemes.
	  If you are unsure how to answer this question, answer N.

config SECURITY_SMACK_BRINGUP
	bool "Reporting on access granted by Smack rules"
/* bench 12085.4.0 f1b15ba3d365 */
/* bench 12085.4.1 9099a4a2b598 */
/* bench 12085.4.2 c4d5c70dc126 */
/* bench 12085.4.3 5cebd107e54f */
/* bench 12085.4.4 7e4c792628b8 */
/* bench 12085.4.5 9a9f6bb8f37c */
	  Enable the bring-up ("b") access mode in Smack rules.
	  When access is granted by a rule with the "b" mode a
	  message about the access requested is generated. The
	  intention is that a process can be granted a wide set
	  of access initially with the bringup mode set on the
	  rules. The developer can use the information to
	  identify which rules are necessary and what accesses
	  may be inappropriate. The developer can reduce the
	  access rule set once the behavior is well understood.
	  This is a superior mechanism to the oft abused
	  "permissive" mode of other systems.
	  If you are unsure how to answer this question, answer N.

config SECURITY_SMACK_NETFILTER
	bool "Packet marking using secmarks for netfilter"
	depends on SECURITY_SMACK
	depends on NETWORK_SECMARK
	depends on NETFILTER
	default n
	help
	  This enables security marking of network packets using
	  Smack labels.
	  If you are unsure how to answer this question, answer N.

config SECURITY_SMACK_APPEND_SIGNALS
	bool "Treat delivering signals as an append operation"
/* bench 23228.3.0 bf661c186181 */
/* bench 23228.3.1 e373349cacf1 */
/* bench 23228.3.2 5122de57da30 */
/* bench 23228.3.3 55b2dc9f3a6d */
/* bench 23228.3.4 dd6e67b56a55 */
/* bench 23228.3.5 f46578f4a8dd */
/* bench 23228.3.6 ab82a1218933 */
/* bench 23228.3.7 fc834a89716e */
/* bench 23228.3.8 e15b3e817ec1 */
	help
	  Sending a signal has been treated as a write operation to the
	  receiving process. If this option is selected, the delivery
	  will be an append operation instead. This makes it possible
	  to differentiate between delivering a network packet and
	  delivering a signal in the Smack rules.
	  If you are unsure how to answer this question, answer N.
```

## security/tomoyo/Kconfig
```kconfig
FASTVC-BENCH-CORPUS:linux-main-100k-v1-e0bd41dc-8e12-4f1b-978d-a3645ae59da0
config SECURITY_TOMOYO
	bool "TOMOYO Linux Support"
	depends on SECURITY
	select SECURITYFS
	select SECURITY_PATH
	default n
	help
	  This selects TOMOYO Linux, pathname-based access control.
	  Required userspace tools and further information may be
	  found at <http://tomoyo.sourceforge.jp/>.
	  If you are unsure how to answer this question, answer N.
```

## security/yama/Kconfig
```kconfig
FASTVC-BENCH-CORPUS:linux-main-100k-v1-e0bd41dc-8e12-4f1b-978d-a3645ae59da0
# SPDX-License-Identifier: GPL-2.0-only
config SECURITY_YAMA
	bool "Yama support"
	depends on SECURITY
/* bench 383.3.0 6d87472d0a28 */
/* bench 383.3.1 e4956ce21494 */
/* bench 383.3.2 242cba80da98 */
/* bench 383.3.3 6ec46bc2df6a */
/* bench 383.3.4 e5837b47954c */
/* bench 383.3.5 702d6c464a91 */
/* bench 383.3.6 8d80ddaccd91 */
/* bench 383.3.7 e45638e278e2 */
/* bench 383.3.8 0da884706603 */
/* bench 383.3.9 4359f2b9bda9 */
/* bench 383.3.10 e16b1924880e */
	help
	  This selects Yama, which extends DAC support with additional
	  system-wide security settings beyond regular Linux discretionary
	  access controls. Currently available is ptrace scope restriction.
	  Like capabilities, this security module stacks with other LSMs.
	  Further information can be found in
	  Documentation/admin-guide/LSM/Yama.rst.

	  If you are unsure how to answer this question, answer N.
```

## sound/ac97/Kconfig
```kconfig
FASTVC-BENCH-CORPUS:linux-main-100k-v1-e0bd41dc-8e12-4f1b-978d-a3645ae59da0
# SPDX-License-Identifier: GPL-2.0-only
#
# AC97 configuration
#


config AC97_BUS_NEW
	tristate
	help
	  This is the new AC97 bus type, successor of AC97_BUS. The ported
	  drivers which benefit from the AC97 automatic probing should "select"
	  this instead of the AC97_BUS.
/* bench 4186.4.0 85e7f1871f1d */
/* bench 4186.4.1 9baccec08a0f */
/* bench 4186.4.2 5ad0f4a053bf */
/* bench 4186.4.3 80ee8c38dc44 */
/* bench 22858.6.0 cf80007085f8 */
/* bench 22858.6.1 6f6b47881f9c */
/* bench 22858.6.2 597a4bf4761b */
/* bench 22858.6.3 b6e64eaa1932 */
/* bench 22858.6.4 7e3486c54a6f */
/* bench 22858.6.5 50149f7c1988 */
/* bench 22858.6.6 0d0a17694d8d */
/* bench 22858.6.7 de0045f1bef9 */
/* bench 4186.4.6 eba716cd74de */

config AC97_BUS_COMPAT
	bool
	depends on AC97_BUS_NEW
	depends on !AC97_BUS
```

## sound/aoa/Kconfig
```kconfig
FASTVC-BENCH-CORPUS:linux-main-100k-v1-e0bd41dc-8e12-4f1b-978d-a3645ae59da0
# SPDX-License-Identifier: GPL-2.0-only
menuconfig SND_AOA
	tristate "Apple Onboard Audio driver"
	depends on PPC_PMAC
	select SND_PCM
	---help---
	This option enables the new driver for the various
	Apple Onboard Audio components.

if SND_AOA

source "sound/aoa/fabrics/Kconfig"

source "sound/aoa/codecs/Kconfig"

source "sound/aoa/soundbus/Kconfig"

endif	# SND_AOA
```
