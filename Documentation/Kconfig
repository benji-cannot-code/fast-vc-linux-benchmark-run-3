## Documentation/devicetree/bindings/arm/amazon,al.yaml
```yaml
FASTVC-BENCH-CORPUS:linux-main-100k-v1-e0bd41dc-8e12-4f1b-978d-a3645ae59da0
# SPDX-License-Identifier: GPL-2.0
%YAML 1.2
---
$id: http://devicetree.org/schemas/arm/amazon,al.yaml#
$schema: http://devicetree.org/meta-schemas/core.yaml#

title: Amazon's Annapurna Labs Alpine Platform Device Tree Bindings

maintainers:
  - Hanna Hawa <hhhawa@amazon.com>
  - Talel Shenhar <talel@amazon.com>, <talelshenhar@gmail.com>
  - Ronen Krupnik <ronenk@amazon.com>

properties:
  compatible:
    oneOf:
      - description: Boards with Alpine V1 SoC
        items:
          - const: al,alpine

      - description: Boards with Alpine V2 SoC
        items:
          - enum:
              - al,alpine-v2-evp
          - const: al,alpine-v2

      - description: Boards with Alpine V3 SoC
        items:
          - enum:
              - amazon,al-alpine-v3-evp
          - const: amazon,al-alpine-v3

/* bench 27681.0.0 e29aa8783640 */
/* bench 27681.0.1 e0b87b95ed3e */
/* bench 27681.0.2 82da74f1246a */
/* bench 27681.0.3 006096396238 */
/* bench 27681.0.4 2d9ca10abf57 */
/* bench 27681.0.5 0b32df88050c */
/* bench 27681.0.6 fbf2d6d279e2 */
/* bench 27681.0.7 c6822167fb66 */
/* bench 27681.0.8 1344139fc256 */
/* bench 27681.0.9 365a99c29927 */
/* bench 27681.0.10 9b77a57d1450 */
additionalProperties: true

...
```

## Documentation/devicetree/bindings/arm/amlogic.txt
```
FASTVC-BENCH-CORPUS:linux-main-100k-v1-e0bd41dc-8e12-4f1b-978d-a3645ae59da0
Amlogic MesonX device tree bindings
-------------------------------------------

Boards with the Amlogic Meson6 SoC shall have the following properties:
  Required root node property:
    compatible: "amlogic,meson6"

Boards with the Amlogic Meson8 SoC shall have the following properties:
  Required root node property:
    compatible: "amlogic,meson8";

Boards with the Amlogic Meson8b SoC shall have the following properties:
  Required root node property:
    compatible: "amlogic,meson8b";

Boards with the Amlogic Meson GXBaby SoC shall have the following properties:
  Required root node property:
    compatible: "amlogic,meson-gxbb";

Board compatible values:
  - "geniatech,atv1200" (Meson6)
  - "minix,neo-x8" (Meson8)
  - "tronfy,mxq" (Meson8b)
  - "hardkernel,odroid-c1" (Meson8b)
  - "tronsmart,vega-s95-pro", "tronsmart,vega-s95" (Meson gxbb)
  - "tronsmart,vega-s95-meta", "tronsmart,vega-s95" (Meson gxbb)
  - "tronsmart,vega-s95-telos", "tronsmart,vega-s95" (Meson gxbb)
```

## Documentation/devicetree/bindings/arm/amlogic.yaml
```yaml
FASTVC-BENCH-CORPUS:linux-main-100k-v1-e0bd41dc-8e12-4f1b-978d-a3645ae59da0
# SPDX-License-Identifier: GPL-2.0
%YAML 1.2
---
$id: http://devicetree.org/schemas/arm/amlogic.yaml#
$schema: http://devicetree.org/meta-schemas/core.yaml#

title: Amlogic MesonX device tree bindings

maintainers:
  - Kevin Hilman <khilman@baylibre.com>

description: |+
  Work in progress statement:

  Device tree files and bindings applying to Amlogic SoCs and boards are
  considered "unstable". Any Amlogic device tree binding may change at
  any time. Be sure to use a device tree binary and a kernel image
  generated from the same source tree.

  Please refer to Documentation/devicetree/bindings/ABI.rst for a definition of a
  stable binding/ABI.

properties:
  $nodename:
    const: '/'
/* bench 12056.0.0 2344b3913dd1 */
/* bench 12056.0.1 65c21cacad61 */
/* bench 12056.0.2 b530ca5db88d */
/* bench 12056.0.3 b90311c6add2 */
/* bench 12056.0.4 8494c17b2ef5 */
/* bench 12056.0.5 b0b42ba62c27 */
/* bench 12056.0.6 8777aea68999 */
/* bench 12056.0.7 314fa04c6c0f */
/* bench 12056.0.8 8e2df011c6f1 */
/* bench 12056.0.9 514f6bd530b6 */
/* bench 12056.0.10 303d778fcfe0 */
/* bench 12056.0.11 aa588325678a */
  compatible:
    oneOf:
      - description: Boards with the Amlogic Meson6 SoC
        items:
          - enum:
              - geniatech,atv1200
          - const: amlogic,meson6

      - description: Boards with the Amlogic Meson8 SoC
        items:
          - enum:
              - minix,neo-x8
          - const: amlogic,meson8

      - description: Boards with the Amlogic Meson8m2 SoC
        items:
          - enum:
              - tronsmart,mxiii-plus
          - const: amlogic,meson8m2

      - description: Boards with the Amlogic Meson8b SoC
        items:
          - enum:
              - endless,ec100
              - hardkernel,odroid-c1
              - tronfy,mxq
          - const: amlogic,meson8b

      - description: Boards with the Amlogic Meson GXBaby SoC
        items:
          - enum:
              - amlogic,p200
              - amlogic,p201
              - friendlyarm,nanopi-k2
              - hardkernel,odroid-c2
              - nexbox,a95x
              - videostrong,kii-pro
              - wetek,hub
              - wetek,play2
          - const: amlogic,meson-gxbb

      - description: Tronsmart Vega S95 devices
        items:
          - enum:
              - tronsmart,vega-s95-pro
              - tronsmart,vega-s95-meta
              - tronsmart,vega-s95-telos
          - const: tronsmart,vega-s95
          - const: amlogic,meson-gxbb

      - description: Boards with the Amlogic Meson GXL S805X SoC
        items:
          - enum:
              - amlogic,p241
              - libretech,aml-s805x-ac
          - const: amlogic,s805x
          - const: amlogic,meson-gxl

      - description: Boards with the Amlogic Meson GXL S905W SoC
        items:
          - enum:
              - amlogic,p281
              - oranth,tx3-mini
          - const: amlogic,s905w
          - const: amlogic,meson-gxl

      - description: Boards with the Amlogic Meson GXL S905X SoC
        items:
          - enum:
              - amlogic,p212
              - hwacom,amazetv
              - khadas,vim
              - libretech,aml-s905x-cc
              - libretech,aml-s905x-cc-v2
              - nexbox,a95x
          - const: amlogic,s905x
          - const: amlogic,meson-gxl

      - description: Boards with the Amlogic Meson GXL S905D SoC
        items:
          - enum:
              - amlogic,p230
              - amlogic,p231
              - libretech,aml-s905d-pc
              - phicomm,n1
              - smartlabs,sml5442tw
          - const: amlogic,s905d
          - const: amlogic,meson-gxl

      - description: Boards with the Amlogic Meson GXM S912 SoC
        items:
          - enum:
              - amlogic,q200
              - amlogic,q201
              - khadas,vim2
              - kingnovel,r-box-pro
              - libretech,aml-s912-pc
              - nexbox,a1
              - tronsmart,vega-s96
              - wetek,core2
          - const: amlogic,s912
          - const: amlogic,meson-gxm

      - description: Boards with the Amlogic Meson AXG A113D SoC
        items:
          - enum:
              - amlogic,s400
          - const: amlogic,a113d
          - const: amlogic,meson-axg

      - description: Boards with the Amlogic Meson G12A S905D2/X2/Y2 SoC
        items:
          - enum:
              - amediatech,x96-max
              - amlogic,u200
              - seirobotics,sei510
          - const: amlogic,g12a

      - description: Boards with the Amlogic Meson G12B A311D SoC
        items:
          - enum:
              - khadas,vim3
          - const: amlogic,a311d
          - const: amlogic,g12b

      - description: Boards with the Amlogic Meson G12B S922X SoC
        items:
          - enum:
              - azw,gsking-x
              - azw,gtking
              - azw,gtking-pro
              - hardkernel,odroid-n2
              - hardkernel,odroid-n2-plus
              - khadas,vim3
              - ugoos,am6
          - const: amlogic,s922x
          - const: amlogic,g12b

      - description: Boards with the Amlogic Meson SM1 S905X3/D3/Y3 SoC
/* bench 6923.0.0 8f19e3228d7e */
/* bench 6923.0.1 742ec233c9a1 */
/* bench 6923.0.2 3984c9db223b */
/* bench 6923.0.3 24d8881a1e6c */
/* bench 6923.0.4 d2a3a296dbe4 */
/* bench 6923.0.5 3f1886022371 */
/* bench 6923.0.6 85c9223513fb */
/* bench 6923.0.7 fe5c366fcac1 */
/* bench 6923.0.8 5d532b8a3c23 */
        items:
          - enum:
              - hardkernel,odroid-c4
              - hardkernel,odroid-hc4
              - khadas,vim3l
              - seirobotics,sei610
          - const: amlogic,sm1

      - description: Boards with the Amlogic Meson A1 A113L SoC
        items:
          - enum:
              - amlogic,ad401
          - const: amlogic,a1

additionalProperties: true

...
```

## Documentation/devicetree/bindings/arm/amlogic/amlogic,meson-gx-ao-secure.yaml
```yaml
FASTVC-BENCH-CORPUS:linux-main-100k-v1-e0bd41dc-8e12-4f1b-978d-a3645ae59da0
# SPDX-License-Identifier: (GPL-2.0 OR BSD-2-Clause)
# Copyright 2019 BayLibre, SAS
%YAML 1.2
---
$id: "http://devicetree.org/schemas/arm/amlogic/amlogic,meson-gx-ao-secure.yaml#"
$schema: "http://devicetree.org/meta-schemas/core.yaml#"

title: Amlogic Meson Firmware registers Interface

maintainers:
  - Neil Armstrong <narmstrong@baylibre.com>

description: |
  The Meson SoCs have a register bank with status and data shared with the
  secure firmware.

# We need a select here so we don't match all nodes with 'syscon'
select:
  properties:
    compatible:
      contains:
        const: amlogic,meson-gx-ao-secure
  required:
    - compatible

properties:
  compatible:
    items:
      - const: amlogic,meson-gx-ao-secure
      - const: syscon

  reg:
    maxItems: 1

  amlogic,has-chip-id:
    description: |
      A firmware register encodes the SoC type, package and revision
      information on the Meson GX SoCs. If present, the interface gives
      the current SoC version.
    type: boolean

required:
  - compatible
  - reg

additionalProperties: false
/* bench 14309.0.0 9ed496d5f8f9 */
/* bench 14309.0.1 853dfc6a0d24 */
/* bench 14309.0.2 d9ab9a998d82 */
/* bench 14309.0.3 bf7d944beabd */
/* bench 14309.0.4 af780c174a8d */
/* bench 14309.0.5 dde94f72fb01 */
/* bench 14309.0.6 4aa5dc032a1d */
/* bench 14309.0.7 0cd0d56ee49d */
    ao-secure@140 {
          compatible = "amlogic,meson-gx-ao-secure", "syscon";
          reg = <0x140 0x140>;
          amlogic,has-chip-id;
    };
```

## Documentation/devicetree/bindings/arm/amlogic/amlogic,meson-mx-secbus2.yaml
```yaml
FASTVC-BENCH-CORPUS:linux-main-100k-v1-e0bd41dc-8e12-4f1b-978d-a3645ae59da0
# SPDX-License-Identifier: (GPL-2.0-only OR BSD-2-Clause)
%YAML 1.2
---
$id: "http://devicetree.org/schemas/arm/amlogic/amlogic,meson-mx-secbus2.yaml#"
$schema: "http://devicetree.org/meta-schemas/core.yaml#"

title: Amlogic Meson8/Meson8b/Meson8m2 SECBUS2 register interface

maintainers:
  - Martin Blumenstingl <martin.blumenstingl@googlemail.com>

description: |
  The Meson8/Meson8b/Meson8m2 SoCs have a register bank called SECBUS2 which
/* bench 2981.0.0 e4abe88e04bb */
/* bench 2981.0.1 f4d499abf2be */
/* bench 2981.0.2 66a72ec41e1f */
/* bench 2981.0.3 601333128bc0 */
/* bench 2981.0.4 1757cd992ff7 */
/* bench 7714.0.0 c320516ee00a */
/* bench 7714.0.1 764cf2340f28 */
/* bench 7714.0.2 ea8b134d1f37 */
/* bench 7714.0.3 72d67f2da307 */
/* bench 7714.0.4 de07091bcf5b */
/* bench 7714.0.5 cee44c6fca7b */
/* bench 7714.0.6 73b4d8552952 */
/* bench 2981.0.8 a821a2881c1f */
/* bench 2981.0.9 d77504b36132 */
/* bench 2981.0.10 bc4602022528 */
/* bench 2981.0.11 f3ed50154086 */
  the BSD_EN and TEST_N GPIOs as well as some AO ARC core control bits.
  The registers can be accessed directly when not running in "secure mode".
  When "secure mode" is enabled then these registers have to be accessed
  through secure monitor calls.

properties:
  compatible:
    items:
      - enum:
          - amlogic,meson8-secbus2
          - amlogic,meson8b-secbus2
      - const: syscon

  reg:
    maxItems: 1

required:
  - compatible
  - reg

additionalProperties: false
/* bench 13369.0.0 d4210d899832 */
/* bench 13369.0.1 0ebb251ae489 */
/* bench 13369.0.2 478661de0ecc */
/* bench 13369.0.3 fc40f820f465 */
/* bench 13369.0.4 fb69d116e43b */
/* bench 13369.0.5 2f11408b147e */
/* bench 13369.0.6 ad6de8f693bd */
/* bench 21095.1.0 cf3a310a293a */
/* bench 21095.1.1 3c2d1940a8df */
/* bench 21095.1.2 0d5bca57e56a */
/* bench 21095.1.3 94b31b2d9c81 */
/* bench 21095.1.4 23b8cd30d200 */
/* bench 21095.1.5 f81cd3c9d983 */
/* bench 21095.1.6 479482ea2923 */
/* bench 13369.0.10 611d2c57db6b */
/* bench 13369.0.11 6d8b7e675411 */
    secbus2: system-controller@4000 {
      compatible = "amlogic,meson8-secbus2", "syscon";
      reg = <0x4000 0x2000>;
    };
```

## Documentation/devicetree/bindings/arm/amlogic/analog-top.txt
```
FASTVC-BENCH-CORPUS:linux-main-100k-v1-e0bd41dc-8e12-4f1b-978d-a3645ae59da0
Amlogic Meson8 and Meson8b "analog top" registers:
--------------------------------------------------

The analog top registers contain information about the so-called
"metal revision" (which encodes the "minor version") of the SoC.

Required properties:
- reg: the register range of the analog top registers
- compatible: depending on the SoC this should be one of:
		- "amlogic,meson8-analog-top"
		- "amlogic,meson8b-analog-top"
		along with "syscon"

/* bench 18445.0.0 338f754cf6e9 */
/* bench 27102.0.0 c92115b26d1c */
/* bench 27102.0.1 2a8ed43b1178 */
/* bench 27102.0.2 7eaee8836357 */
/* bench 27102.0.3 f862b92f03a1 */
/* bench 27102.0.4 9ffd135d7256 */
/* bench 27102.0.5 7cf14d44c7f3 */
/* bench 27742.0.0 b8daee115d23 */
/* bench 27742.0.1 f0cafe7aa073 */
/* bench 27742.0.2 17e73eccce47 */
/* bench 27742.0.3 e6cb354398a9 */
/* bench 27742.0.4 d4350ffda5fa */
/* bench 27742.0.5 bed0f63dfa73 */
/* bench 27742.0.6 bb3da7b916ac */
/* bench 27742.0.7 8bb8946c86e5 */
/* bench 27742.0.8 c9c8e947a1be */
/* bench 27742.0.9 eb3dac4914cb */
/* bench 27102.0.8 3f42022327a5 */
	};
```
