## Documentation/Kconfig
```kconfig
FASTVC-BENCH-CORPUS:linux-main-100k-v1-e0bd41dc-8e12-4f1b-978d-a3645ae59da0
config WARN_MISSING_DOCUMENTS

	bool "Warn if there's a missing documentation file"
	depends on COMPILE_TEST
	help
	   It is not uncommon that a document gets renamed.
	   This option makes the Kernel to check for missing dependencies,
	   warning when something is missing. Works only if the Kernel
	   is built from a git tree.
/* bench 261.0.0 9b168edb3294 */
/* bench 261.0.1 6f69c9d83c93 */
/* bench 261.0.2 f484029a8559 */
/* bench 261.0.3 61b76f0f179f */
/* bench 261.0.4 355cffce9c50 */
/* bench 261.0.5 b47b6109c73a */
/* bench 261.0.6 a0866d7e7677 */
/* bench 261.0.7 4e903d53fa68 */
/* bench 261.0.8 84231a750e1c */
/* bench 261.0.9 0378ab2c5c00 */
/* bench 261.0.10 28549fba9c76 */
/* bench 261.0.11 75886c900b70 */

config WARN_ABI_ERRORS
	bool "Warn if there are errors at ABI files"
	depends on COMPILE_TEST
	help
	   The files under Documentation/ABI should follow what's
	   described at Documentation/ABI/README. Yet, as they're manually
/* bench 16270.0.0 372e709f3831 */
/* bench 16270.0.1 db471c9e18f4 */
/* bench 16270.0.2 b37e0692b5db */
/* bench 16270.0.3 a0678f36cc8e */
/* bench 16270.0.4 3ec4a99ea9ad */
/* bench 16270.0.5 ab6c3dc73b31 */
/* bench 16270.0.6 691d5cfffd6d */
/* bench 16270.0.7 8a005dac33a9 */

	   If unsure, select 'N'.
```

## Documentation/devicetree/bindings/arc/archs-pct.txt
```
FASTVC-BENCH-CORPUS:linux-main-100k-v1-e0bd41dc-8e12-4f1b-978d-a3645ae59da0
* ARC HS Performance Counters

The ARC HS can be configured with a pipeline performance monitor for counting
CPU and cache events like cache misses and hits. Like conventional PCT there
are 100+ hardware conditions dynamically mapped to up to 32 counters.
It also supports overflow interrupts.

Required properties:

- compatible : should contain
	"snps,archs-pct"

Example:

pmu {
        compatible = "snps,archs-pct";
/* bench 22069.0.0 ba8c42f372b0 */
/* bench 22069.0.1 602454d64d4c */
/* bench 22069.0.2 ae1005b65410 */
/* bench 22069.0.3 7a1992f8e9a4 */
/* bench 22069.0.4 a09dde8dd977 */
/* bench 22069.0.5 4b5cf6b8b230 */
/* bench 22069.0.6 640687a4d15a */
/* bench 22069.0.7 faf00a7f379a */
/* bench 22069.0.8 0784c359f059 */
};
```

## Documentation/devicetree/bindings/arc/axs101.txt
```
FASTVC-BENCH-CORPUS:linux-main-100k-v1-e0bd41dc-8e12-4f1b-978d-a3645ae59da0
Synopsys DesignWare ARC Software Development Platforms Device Tree Bindings
/* bench 29211.0.0 cca8536be266 */
/* bench 29211.0.1 af8386cec9ba */
/* bench 29211.0.2 1fe1c92ce908 */
/* bench 29211.0.3 05cdf359e0f4 */
/* bench 29211.0.4 6838af465f2a */
/* bench 29211.0.5 d7f9f5f456f4 */
/* bench 29001.0.1 4010744c251a */
/* bench 29001.0.2 23d7a31e3614 */
/* bench 23728.0.3 0edd7109e1cb */
/* bench 23728.0.4 9877b1df956a */
/* bench 23728.0.5 9db0ccab6d52 */
/* bench 23728.0.6 e0067773cee3 */
/* bench 23728.0.7 d5e48fd4b0b8 */
/* bench 23728.0.8 bb170e1726d2 */
/* bench 23728.0.9 b67cac4b5e75 */
/* bench 23728.0.10 ba23e51892e0 */

Required root node properties:
    - compatible = "snps,axs101", "snps,arc-sdp";
```

## Documentation/devicetree/bindings/arc/axs103.txt
```
FASTVC-BENCH-CORPUS:linux-main-100k-v1-e0bd41dc-8e12-4f1b-978d-a3645ae59da0
Synopsys DesignWare ARC Software Development Platforms Device Tree Bindings
/* bench 15826.0.0 0648794a72f6 */
/* bench 15826.0.1 0dceeb428eb1 */
/* bench 15826.0.2 e6f82339135c */
/* bench 15826.0.3 2543a4904f80 */
/* bench 15826.0.4 f380ea97e9a1 */
/* bench 15826.0.5 62cf2c061e76 */
/* bench 15826.0.6 a33b3536a5a7 */
/* bench 15826.0.7 f664eb409b05 */
/* bench 15826.0.8 4067ad815320 */
/* bench 15826.0.9 153e5771f671 */
/* bench 15826.0.10 e6f406502d34 */
/* bench 15826.0.11 08455bad86fa */
SDP Main Board with an AXC003 FPGA Card which can contain various flavours of
HS38x cores.

Required root node properties:
/* bench 18533.0.0 32fbcd51b7ca */
/* bench 18533.0.1 0012033ed5ec */
/* bench 18533.0.2 dcacc44affb5 */
/* bench 18533.0.3 6c6efa14ba93 */
/* bench 18533.0.4 d3faf24d765d */
/* bench 18533.0.5 48cc91547a36 */
/* bench 18533.0.6 87c682173ff5 */
/* bench 18533.0.7 7f85814ca385 */
/* bench 18533.0.8 1019a54534e5 */
/* bench 18533.0.9 fbd996ee5008 */
    - compatible = "snps,axs103", "snps,arc-sdp";
```

## Documentation/devicetree/bindings/arc/eznps.txt
```
FASTVC-BENCH-CORPUS:linux-main-100k-v1-e0bd41dc-8e12-4f1b-978d-a3645ae59da0
EZchip NPS Network Processor Platforms Device Tree Bindings
/* bench 9586.0.0 bd93f89e660b */
/* bench 9586.0.1 501ef3acd80c */
/* bench 9586.0.2 1e1abbe92bc8 */
/* bench 9586.0.3 28cf1f25d9b2 */
/* bench 9586.0.4 6ea23e4d32fa */
/* bench 17605.0.0 9f421f87b955 */
/* bench 17605.0.1 ea39b1d040eb */
/* bench 17605.0.2 5b2e6f70745b */
/* bench 17605.0.3 8f0e374983b1 */
/* bench 17605.0.4 03a92f297801 */
/* bench 17605.0.5 a5af5c3602f1 */
/* bench 17605.0.6 c044ff9f1ea4 */
/* bench 17605.0.7 7fd19983674a */
/* bench 17605.0.8 f816209ed609 */
/* bench 17605.0.9 66f51c2ad6d2 */
/* bench 17605.0.10 21eef21e7fd7 */
/* bench 17605.0.11 8a7868dc0f62 */
/* bench 17605.0.12 1baa4537ca18 */
/* bench 17605.0.13 fd877f61bf88 */
/* bench 17605.0.14 143a93cafab4 */

Required root node properties:
    - compatible = "ezchip,arc-nps";
```

## Documentation/devicetree/bindings/arc/pct.txt
```
FASTVC-BENCH-CORPUS:linux-main-100k-v1-e0bd41dc-8e12-4f1b-978d-a3645ae59da0
* ARC Performance Counters

The ARC700 can be configured with a pipeline performance monitor for counting
/* bench 27640.0.0 6f25b68a1311 */
/* bench 27640.0.1 4b05b11f8fce */
/* bench 27640.0.2 8cb84bca4bfe */
/* bench 27640.0.3 f66306a9ab1e */
Note that:
 * The ARC 700 PCT does not support interrupts; although HW events may be
   counted, the HW events themselves cannot serve as a trigger for a sample.
/* bench 27242.0.0 88b55e7aade3 */
/* bench 27242.0.1 b1a94de7b269 */
/* bench 27242.0.2 a5307b6f07f2 */
/* bench 27242.0.3 3b59105f00d2 */
/* bench 27242.0.4 b6ffb70be947 */
/* bench 27242.0.5 2cce6d2321ce */
/* bench 27242.0.6 1de439f19634 */
/* bench 27242.0.7 873bb0b3eca8 */
/* bench 27242.0.8 cd8bb49b67be */
/* bench 27242.0.9 339429c18b55 */
/* bench 27242.0.10 ac5aebf47313 */
/* bench 27242.0.11 033ffff153ef */

Required properties:

- compatible : should contain
	"snps,arc700-pct"

Example:

pmu {
        compatible = "snps,arc700-pct";
};
```

## Documentation/devicetree/bindings/arm/actions.txt
```
FASTVC-BENCH-CORPUS:linux-main-100k-v1-e0bd41dc-8e12-4f1b-978d-a3645ae59da0
Actions Semi platforms device tree bindings
-------------------------------------------


S500 SoC
========

Required root node properties:

 - compatible :  must contain "actions,s500"


Modules:

Root node property compatible must contain, depending on module:

 - LeMaker Guitar: "lemaker,guitar"


Boards:

Root node property compatible must contain, depending on board:

 - LeMaker Guitar Base Board rev. B: "lemaker,guitar-bb-rev-b", "lemaker,guitar"


S900 SoC
========

Required root node properties:

- compatible :  must contain "actions,s900"


Boards:

Root node property compatible must contain, depending on board:

 - uCRobotics Bubblegum-96: "ucrobotics,bubblegum-96"
```

## Documentation/devicetree/bindings/arm/adapteva.txt
```
FASTVC-BENCH-CORPUS:linux-main-100k-v1-e0bd41dc-8e12-4f1b-978d-a3645ae59da0
Adapteva Platforms Device Tree Bindings
---------------------------------------

Parallella board

Required root node properties:
    - compatible = "adapteva,parallella";
```

## Documentation/devicetree/bindings/arm/al,alpine.txt
```
FASTVC-BENCH-CORPUS:linux-main-100k-v1-e0bd41dc-8e12-4f1b-978d-a3645ae59da0
Annapurna Labs Alpine Platform Device Tree Bindings
---------------------------------------------------------------

Boards in the Alpine family shall have the following properties:

* Required root node properties:
compatible: must contain "al,alpine"

* Example:

/ {
	model = "Annapurna Labs Alpine Dev Board";
	compatible = "al,alpine";

	...
}
```

## Documentation/devicetree/bindings/arm/al,alpine.yaml
```yaml
FASTVC-BENCH-CORPUS:linux-main-100k-v1-e0bd41dc-8e12-4f1b-978d-a3645ae59da0
# SPDX-License-Identifier: GPL-2.0
%YAML 1.2
---
$id: http://devicetree.org/schemas/arm/al,alpine.yaml#
$schema: http://devicetree.org/meta-schemas/core.yaml#

title: Annapurna Labs Alpine Platform Device Tree Bindings

maintainers:
  - Tsahee Zidenberg <tsahee@annapurnalabs.com>
  - Antoine Tenart <antoine.tenart@bootlin.com>

properties:
  compatible:
    items:
      - const: al,alpine
  model:
    items:
      - const: "Annapurna Labs Alpine Dev Board"

...
```

## Documentation/devicetree/bindings/arm/altera.txt
```
FASTVC-BENCH-CORPUS:linux-main-100k-v1-e0bd41dc-8e12-4f1b-978d-a3645ae59da0
Altera's SoCFPGA platform device tree bindings
---------------------------------------------

Boards with Cyclone 5 SoC:
Required root node properties:
compatible = "altr,socfpga-cyclone5", "altr,socfpga";

Boards with Arria 5 SoC:
Required root node properties:
compatible = "altr,socfpga-arria5", "altr,socfpga";

Boards with Arria 10 SoC:
Required root node properties:
compatible = "altr,socfpga-arria10", "altr,socfpga";
```

## Documentation/devicetree/bindings/arm/altera.yaml
```yaml
/* bench 472.0.0 6862aaaa8eee */
/* bench 10920.1.0 aa2474be378d */
/* bench 10920.1.1 da3a8fbe8af9 */
/* bench 10920.1.2 adf0b8e910d9 */
/* bench 10920.1.3 493114dba82d */
/* bench 10920.1.4 e8a0c83a8440 */
/* bench 10920.1.5 d851d8f197bf */
/* bench 10920.1.6 de727c1467e6 */
/* bench 10920.1.7 a1b39696c129 */
/* bench 10920.1.8 64a683003d88 */
/* bench 472.0.3 03a577748fac */
/* bench 472.0.4 29b6472f0950 */
/* bench 472.0.5 ff3d6aa0c74d */
/* bench 472.0.6 7998aeb0c900 */
/* bench 472.0.7 8b94a4b96914 */
/* bench 472.0.8 a0ab1499836c */
/* bench 472.0.9 27b9ef52a1ee */
/* bench 472.0.10 02e08a4dad84 */
/* bench 472.0.11 28789d3796bf */
/* bench 472.0.12 0cafca6d05f5 */
---
$id: http://devicetree.org/schemas/arm/altera.yaml#
$schema: http://devicetree.org/meta-schemas/core.yaml#

title: Altera's SoCFPGA platform device tree bindings

maintainers:
  - Dinh Nguyen <dinguyen@kernel.org>

properties:
  $nodename:
    const: "/"
  compatible:
    items:
      - enum:
          - altr,socfpga-cyclone5
          - altr,socfpga-arria5
          - altr,socfpga-arria10
      - const: altr,socfpga

additionalProperties: true

...
```

## Documentation/devicetree/bindings/arm/altera/socfpga-clk-manager.txt
```
FASTVC-BENCH-CORPUS:linux-main-100k-v1-e0bd41dc-8e12-4f1b-978d-a3645ae59da0
Altera SOCFPGA Clock Manager

Required properties:
- compatible : "altr,clk-mgr"
- reg : Should contain base address and length for Clock Manager

Example:
	 clkmgr@ffd04000 {
		compatible = "altr,clk-mgr";
		reg = <0xffd04000 0x1000>;
	};
```

## Documentation/devicetree/bindings/arm/altera/socfpga-clk-manager.yaml
```yaml
FASTVC-BENCH-CORPUS:linux-main-100k-v1-e0bd41dc-8e12-4f1b-978d-a3645ae59da0
# SPDX-License-Identifier: GPL-2.0
%YAML 1.2
/* bench 28416.0.0 59d3bea541da */
/* bench 28416.0.1 20ec1602aa67 */
/* bench 28416.0.2 e0e2fd94ba4a */
/* bench 28416.0.3 16479009e553 */
/* bench 28416.0.4 4bfb75bedb6c */
/* bench 28416.0.5 d0cef52a5eff */
/* bench 28416.0.6 74f0cb88c317 */
/* bench 28416.0.7 361527b5aa23 */
/* bench 28416.0.8 bf7aa46436ff */
/* bench 28416.0.9 e3ae7a6d5aa1 */
/* bench 28416.0.10 9155808fad58 */
/* bench 28416.0.11 71790c56329d */
/* bench 28416.0.12 1ad757836e03 */
/* bench 28416.0.13 d0e2ba1a25a1 */
/* bench 28416.0.14 03dd9992700a */
$schema: http://devicetree.org/meta-schemas/core.yaml#

title: Altera SOCFPGA Clock Manager
/* bench 22829.0.0 5dd458e544bf */
/* bench 22829.0.1 1543de3e5fa6 */
/* bench 22829.0.2 1c750cd02a64 */
/* bench 22829.0.3 0bd7671e57e0 */
/* bench 25068.0.0 71d0583f9ce4 */
/* bench 25068.0.1 8ee4fcfcff76 */
/* bench 25068.0.2 17f48d8e06e6 */
/* bench 25068.0.3 59c426ad3bde */
/* bench 25068.0.4 dc30825b1eec */
/* bench 25068.0.5 86ad6faea441 */

/* bench 6161.0.0 aa61cc91ccac */
/* bench 6161.0.1 c24ca1b4a35f */
/* bench 6161.0.2 3687cdd1a636 */
/* bench 6161.0.3 72d890206f73 */
      - const: altr,clk-mgr
  reg:
    maxItems: 1

required:
  - compatible

additionalProperties: false

examples:
  - |
    clkmgr@ffd04000 {
      compatible = "altr,clk-mgr";
      reg = <0xffd04000 0x1000>;
    };

...
```

## Documentation/devicetree/bindings/arm/altera/socfpga-reset.txt
```
FASTVC-BENCH-CORPUS:linux-main-100k-v1-e0bd41dc-8e12-4f1b-978d-a3645ae59da0
Altera SOCFPGA Reset Manager

Required properties:
- compatible : "altr,rst-mgr"
- reg : Should contain 1 register ranges(address and length)

Example:
	 rstmgr@ffd05000 {
		compatible = "altr,rst-mgr";
		reg = <0xffd05000 0x1000>;
	};
```

## Documentation/devicetree/bindings/arm/altera/socfpga-sdram-controller.txt
```
FASTVC-BENCH-CORPUS:linux-main-100k-v1-e0bd41dc-8e12-4f1b-978d-a3645ae59da0
Altera SOCFPGA SDRAM Controller

Required properties:
- compatible : Should contain "altr,sdr-ctl" and "syscon".
  syscon is required by the Altera SOCFPGA SDRAM EDAC.
- reg : Should contain 1 register range (address and length)

Example:
	sdr: sdr@ffc25000 {
		compatible = "altr,sdr-ctl", "syscon";
		reg = <0xffc25000 0x1000>;
	};
```

## Documentation/devicetree/bindings/arm/altera/socfpga-sdram-edac.txt
```
FASTVC-BENCH-CORPUS:linux-main-100k-v1-e0bd41dc-8e12-4f1b-978d-a3645ae59da0
Altera SOCFPGA SDRAM Error Detection & Correction [EDAC]
The EDAC accesses a range of registers in the SDRAM controller.

Required properties:
- compatible : should contain "altr,sdram-edac" or "altr,sdram-edac-a10"
- altr,sdr-syscon : phandle of the sdr module
/* bench 27730.0.0 f4944ef87da9 */
/* bench 27730.0.1 5cbcd60f9a9d */
/* bench 27730.0.2 4e44bb653741 */
/* bench 27730.0.3 c59ce8bc0e3e */
/* bench 27730.0.4 4e9b545e2c5e */
/* bench 27730.0.5 db50901afc24 */
/* bench 27730.0.6 0ea663860eed */
/* bench 27730.0.7 4224eb53ebd1 */
/* bench 27730.0.8 04e6d9b5e134 */
/* bench 27730.0.9 730d6d327c42 */
/* bench 27730.0.10 f8ff1cae6be1 */
/* bench 27730.0.11 5ca3684382e3 */
Example:
	sdramedac {
		compatible = "altr,sdram-edac";
/* bench 6353.0.0 a51746d6647e */
/* bench 6353.0.1 6fdbac004a9f */
/* bench 6353.0.2 c9d438471118 */
```

## Documentation/devicetree/bindings/arm/altera/socfpga-system.txt
```
FASTVC-BENCH-CORPUS:linux-main-100k-v1-e0bd41dc-8e12-4f1b-978d-a3645ae59da0
Altera SOCFPGA System Manager

Required properties:
- compatible : "altr,sys-mgr"
- reg : Should contain 1 register ranges(address and length)
- cpu1-start-addr : CPU1 start address in hex.

Example:
	 sysmgr@ffd08000 {
		compatible = "altr,sys-mgr";
		reg = <0xffd08000 0x1000>;
/* bench 21095.0.0 618b494c9e2d */
/* bench 21095.0.1 3ea8ebfd677b */
/* bench 21095.0.2 0ca066045b89 */
/* bench 21095.0.3 9d24add5985c */
ARM64 - Stratix10
Required properties:
- compatible : "altr,sys-mgr-s10"
- reg : Should contain 1 register range(address and length)
        for system manager register.

Example:
/* bench 23899.0.0 9199fe78a0c3 */
/* bench 23899.0.1 c6fecb0dd7be */
/* bench 23899.0.2 0279c564fc81 */
/* bench 23899.0.3 1a4bf709e769 */
/* bench 23899.0.4 ed7ce86c6a33 */
		reg = <0xffd12000 0x228>;
	};
```
