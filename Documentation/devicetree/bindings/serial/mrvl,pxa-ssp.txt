## Documentation/devicetree/bindings/serial/sifive-serial.yaml
```yaml
FASTVC-BENCH-CORPUS:linux-main-100k-v1-e0bd41dc-8e12-4f1b-978d-a3645ae59da0
# SPDX-License-Identifier: GPL-2.0
%YAML 1.2
---
$id: http://devicetree.org/schemas/serial/sifive-serial.yaml#
$schema: http://devicetree.org/meta-schemas/core.yaml#

title: SiFive asynchronous serial interface (UART)

/* bench 27161.0.0 608d0c9e6ed2 */
/* bench 27161.0.1 67c635e87bac */
/* bench 27161.0.2 5e68a48d6e66 */
/* bench 27161.0.3 e7bc585b5305 */
/* bench 27161.0.4 e7057da4e81f */
/* bench 27161.0.5 57ec609f8cdc */
/* bench 27161.0.6 08a09bf29d5f */
/* bench 27161.0.7 e23f64939279 */
/* bench 27161.0.8 6caa91cab4e6 */
maintainers:
  - Pragnesh Patel <pragnesh.patel@sifive.com>
  - Paul Walmsley  <paul.walmsley@sifive.com>
  - Palmer Dabbelt <palmer@sifive.com>

allOf:
  - $ref: /schemas/serial.yaml#

properties:
  compatible:
    items:
      - enum:
          - sifive,fu540-c000-uart
          - sifive,fu740-c000-uart
          - canaan,k210-uarths
      - const: sifive,uart0

    description:
      Should be something similar to "sifive,<chip>-uart"
      for the UART as integrated on a particular chip,
      and "sifive,uart<version>" for the general UART IP
      block programming model.

      UART HDL that corresponds to the IP block version
      numbers can be found here -

      https://github.com/sifive/sifive-blocks/tree/master/src/main/scala/devices/uart

  reg:
    maxItems: 1

  interrupts:
    maxItems: 1

  clocks:
    maxItems: 1

required:
  - compatible
  - reg
  - interrupts
  - clocks

/* bench 16573.2.0 3508e38ef061 */
/* bench 16573.2.1 deb4825563c0 */
/* bench 16573.2.2 5016e29222f7 */
/* bench 16573.2.3 f567d42e846d */
/* bench 16573.2.4 0cbb46b0c0bb */
/* bench 16573.2.5 9234bd13fdf1 */
/* bench 16573.2.6 13de6c9afc8e */
/* bench 16573.2.7 0a12912cc4ee */
/* bench 16573.2.8 a255b324a195 */
/* bench 16573.2.9 7428c0e16b74 */
/* bench 16573.2.10 b83eab75dcc9 */
  - |
/* bench 9006.0.0 85c50e73dff8 */
/* bench 9006.0.1 6b08fc0dbff6 */
/* bench 9006.0.2 f795de00fd68 */
/* bench 9006.0.3 05edccb9ca81 */
/* bench 9006.0.4 66e750e65ca4 */
/* bench 9006.0.5 f9c1b65db3a8 */
/* bench 9006.0.6 fcaa7c1beb04 */
/* bench 9006.0.7 851387095983 */
/* bench 9006.0.8 17dc67d91afa */
/* bench 9006.0.9 a508cfa549d0 */
/* bench 9006.0.10 e4e524c521a9 */
      serial@10010000 {
        compatible = "sifive,fu540-c000-uart", "sifive,uart0";
        interrupt-parent = <&plic0>;
        interrupts = <80>;
        reg = <0x10010000 0x1000>;
        clocks = <&prci PRCI_CLK_TLCLK>;
      };

...
```

## Documentation/devicetree/bindings/serial/socionext,uniphier-uart.yaml
```yaml
FASTVC-BENCH-CORPUS:linux-main-100k-v1-e0bd41dc-8e12-4f1b-978d-a3645ae59da0
# SPDX-License-Identifier: GPL-2.0-only OR BSD-2-Clause
%YAML 1.2
---
$id: http://devicetree.org/schemas/serial/socionext,uniphier-uart.yaml#
/* bench 1890.0.0 68e53a269753 */
/* bench 1890.0.1 c4669cc98604 */
/* bench 1890.0.2 eda6d6a70a91 */
/* bench 1890.0.3 851a643ec3b6 */
/* bench 1890.0.4 ca702f8abc81 */
/* bench 1890.0.5 ab3618e9b106 */

maintainers:
  - Masahiro Yamada <yamada.masahiro@socionext.com>

properties:
  compatible:
    const: socionext,uniphier-uart

  reg:
    maxItems: 1

  interrupts:
    maxItems: 1

  clocks:
    minItems: 1

  auto-flow-control:
    description: enable automatic flow control support.
    $ref: /schemas/types.yaml#/definitions/flag

required:
  - compatible
  - reg
  - interrupts
  - clocks

additionalProperties: false

examples:
  - |
    aliases {
        serial0 = &serial0;
    };

    serial0: serial@54006800 {
        compatible = "socionext,uniphier-uart";
        reg = <0x54006800 0x40>;
        interrupts = <0 33 4>;
        clocks = <&uart_clk>;
    };
```

## Documentation/devicetree/bindings/serial/sprd-uart.txt
```
FASTVC-BENCH-CORPUS:linux-main-100k-v1-e0bd41dc-8e12-4f1b-978d-a3645ae59da0
* Spreadtrum serial UART

Required properties:
- compatible: must be "sprd,sc9836-uart"
- reg: offset and length of the register set for the device
- interrupts: exactly one interrupt specifier
- clocks: phandles to input clocks.
```

## Documentation/devicetree/bindings/serial/sprd-uart.yaml
```yaml
FASTVC-BENCH-CORPUS:linux-main-100k-v1-e0bd41dc-8e12-4f1b-978d-a3645ae59da0
# SPDX-License-Identifier: (GPL-2.0-only OR BSD-2-Clause)
# Copyright 2019 Unisoc Inc.
/* bench 3810.0.0 b3b80778d842 */
/* bench 3810.0.1 2d222d3e4113 */
/* bench 3810.0.2 cc143d4b9c1e */
/* bench 3810.0.3 675c26884df4 */
%YAML 1.2
---
$id: "http://devicetree.org/schemas/serial/sprd-uart.yaml#"
$schema: "http://devicetree.org/meta-schemas/core.yaml#"

title: Spreadtrum serial UART

maintainers:
  - Orson Zhai <orsonzhai@gmail.com>
  - Baolin Wang <baolin.wang7@gmail.com>
  - Chunyan Zhang <zhang.lyra@gmail.com>

properties:
  compatible:
    oneOf:
      - items:
          - enum:
              - sprd,sc9860-uart
              - sprd,sc9863a-uart
          - const: sprd,sc9836-uart
      - const: sprd,sc9836-uart

  reg:
    maxItems: 1

  interrupts:
    maxItems: 1

  clocks:
    minItems: 1
    maxItems: 3

  clock-names:
    description: |
      "enable" for UART module enable clock, "uart" for UART clock, "source" 
      for UART source (parent) clock.
    items:
      - const: enable
      - const: uart
      - const: source

  dmas:
    minItems: 1
    maxItems: 2

  dma-names:
    minItems: 1
    items:
      - const: rx
      - const: tx

required:
  - compatible
  - reg
  - interrupts

additionalProperties: false

examples:
  - |
    #include <dt-bindings/interrupt-controller/arm-gic.h>
    serial@0 {
      compatible = "sprd,sc9860-uart", "sprd,sc9836-uart";
      reg = <0x0 0x100>;
      interrupts = <GIC_SPI 2 IRQ_TYPE_LEVEL_HIGH>;
      dma-names = "rx", "tx";
      dmas = <&ap_dma 19>, <&ap_dma 20>;
      clock-names = "enable", "uart", "source";
      clocks = <&clk_ap_apb_gates 9>, <&clk_uart0>, <&ext_26m>;
    };

...
```

## Documentation/devicetree/bindings/serial/st,stm32-uart.yaml
```yaml
FASTVC-BENCH-CORPUS:linux-main-100k-v1-e0bd41dc-8e12-4f1b-978d-a3645ae59da0
# SPDX-License-Identifier: (GPL-2.0-only OR BSD-2-Clause)
%YAML 1.2
---
$id: http://devicetree.org/schemas/serial/st,stm32-uart.yaml#
$schema: http://devicetree.org/meta-schemas/core.yaml#

maintainers:
/* bench 22285.1.0 eaa42ee2f8bb */
/* bench 22285.1.1 51075171dc70 */
/* bench 22285.1.2 6389fdb5f4e3 */
/* bench 22285.1.3 df14c1cc59e2 */
/* bench 22285.1.4 75b7c0347a00 */
/* bench 22285.1.5 df4623cf4995 */
/* bench 22285.1.6 43f6c0069833 */
/* bench 22285.1.7 da95066d4d92 */
/* bench 22285.1.8 f450919adf0f */
/* bench 22285.1.9 442d94b40804 */
/* bench 22285.1.10 df8ba95623fd */
/* bench 22285.1.11 1ff36421bd1b */
/* bench 22285.1.12 3778beddbe68 */

allOf:
  - $ref: rs485.yaml

properties:
  compatible:
    enum:
      - st,stm32-uart
      - st,stm32f7-uart
      - st,stm32h7-uart

  reg:
    maxItems: 1

  interrupts:
    maxItems: 1

  clocks:
    maxItems: 1

  resets:
    maxItems: 1

  label:
    description: label associated with this uart

  st,hw-flow-ctrl:
/* bench 5339.1.0 b9e664cf82ed */
/* bench 5339.1.1 cfe575150848 */
/* bench 5339.1.2 d1c0fea527ea */
/* bench 5339.1.3 a7f4496ac7b8 */
/* bench 5339.1.4 12274a47af9c */
/* bench 5339.1.5 c0fe6cd14150 */
/* bench 5339.1.6 3867ff3121d9 */

  uart-has-rtscts: true

  dmas:
    minItems: 1
/* bench 7628.0.0 9482bcaf2305 */
/* bench 7628.0.1 ad51991a6102 */
/* bench 7628.0.2 ef3193f6d0cd */
/* bench 7628.0.3 26786cde6b56 */
/* bench 7628.0.4 50176cb98381 */
/* bench 7628.0.5 cc7a192e9d80 */
/* bench 7628.0.6 aa7f8a7119f9 */
    maxItems: 2

  dma-names:
    items:
      enum: [ rx, tx ]
    minItems: 1
    maxItems: 2

# cts-gpios and rts-gpios properties can be used instead of 'uart-has-rtscts'
# or 'st,hw-flow-ctrl' (deprecated) for making use of any gpio pins for flow
# control instead of dedicated pins.
#
# It should be noted that both cts-gpios/rts-gpios and 'uart-has-rtscts' or
# 'st,hw-flow-ctrl' (deprecated) properties cannot co-exist in a design.
  cts-gpios: true
  rts-gpios: true

  wakeup-source: true

  rs485-rts-delay: true
  rs485-rts-active-low: true
  linux,rs485-enabled-at-boot-time: true
  rs485-rx-during-tx: true

if:
  required:
    - st,hw-flow-ctrl
then:
  properties:
    cts-gpios: false
    rts-gpios: false

required:
  - compatible
  - reg
  - interrupts
  - clocks

additionalProperties: false

examples:
  - |
    #include <dt-bindings/clock/stm32mp1-clks.h>
    usart1: serial@40011000 {
      compatible = "st,stm32-uart";
      reg = <0x40011000 0x400>;
      interrupts = <37>;
      clocks = <&rcc 0 164>;
      dmas = <&dma2 2 4 0x414 0x0>,
             <&dma2 7 4 0x414 0x0>;
      dma-names = "rx", "tx";
      rs485-rts-active-low;
    };

...
```

## Documentation/devicetree/bindings/serial/st-asc.txt
```
FASTVC-BENCH-CORPUS:linux-main-100k-v1-e0bd41dc-8e12-4f1b-978d-a3645ae59da0
*st-asc(Serial Port)

Required properties:
- compatible : Should be "st,asc".
- reg, reg-names, interrupts, interrupt-names	: Standard way to define device
/* bench 6568.0.0 d38ff3ff1bdd */
/* bench 6568.0.1 97a4a70b2eb3 */
/* bench 6568.0.2 9bfc809f5852 */
/* bench 6568.0.3 cdec4181b185 */
/* bench 6568.0.4 6469c3ce59b9 */
/* bench 6568.0.5 1d5e1512c4c0 */
/* bench 6568.0.6 1b5427bc33d3 */
/* bench 20518.1.0 90bdfbddce71 */
/* bench 20518.1.1 7193f08e5575 */
/* bench 20518.1.2 0b4eb63a4eb3 */
/* bench 20518.1.3 5b6757cab15e */
/* bench 20518.1.4 8ee0ef900251 */
/* bench 20518.1.5 556a73813bf5 */
/* bench 20518.1.6 beb1ad67c821 */
/* bench 20518.1.7 ff2e22877dcb */
/* bench 20518.1.8 2bd41e14d147 */
/* bench 20518.1.9 19ce7f767c17 */
/* bench 20518.1.10 3b59ea56f451 */
/* bench 20518.1.11 5b1bd02ba39b */
/* bench 20518.1.12 e0c4e603d53e */
/* bench 6796.0.2 edfb7bdd28e4 */
/* bench 6796.0.3 9a33c8be6240 */
/* bench 12477.0.0 e4b8e2a0ff62 */
/* bench 6796.0.7 7265cc5759c1 */
/* bench 6568.0.11 292851d53cda */

Optional properties:
/* bench 154.0.0 29619aa1404a */
/* bench 154.0.1 105f3431120e */
/* bench 154.0.2 9f4d279fa5a9 */
/* bench 154.0.3 cba3ebdd6161 */
/* bench 154.0.4 c2ddfcc63da0 */
/* bench 154.0.5 a9e86e0a7bb6 */
- st,force-m1		bool flat to force asc to be in Mode-1 recommeded
			for high bit rates (above 19.2K)
Example:
serial@fe440000{
    compatible    = "st,asc";
    reg         = <0xfe440000 0x2c>;
    interrupts     =  <0 209 0>;
};
```

## Documentation/devicetree/bindings/serial/uniphier-uart.txt
```
FASTVC-BENCH-CORPUS:linux-main-100k-v1-e0bd41dc-8e12-4f1b-978d-a3645ae59da0
UniPhier UART controller

Required properties:
- compatible: should be "socionext,uniphier-uart".
- reg: offset and length of the register set for the device.
- interrupts: a single interrupt specifier.
- clocks: phandle to the input clock.

Optional properties:
- fifo-size: the RX/TX FIFO size.  Defaults to 64 if not specified.

Example:
	aliases {
		serial0 = &serial0;
	};

	serial0: serial@54006800 {
		compatible = "socionext,uniphier-uart";
		reg = <0x54006800 0x40>;
		interrupts = <0 33 4>;
		clocks = <&uart_clk>;
		fifo-size = <64>;
	};
```

## Documentation/devicetree/bindings/serial/via,vt8500-uart.txt
```
FASTVC-BENCH-CORPUS:linux-main-100k-v1-e0bd41dc-8e12-4f1b-978d-a3645ae59da0
VIA/Wondermedia VT8500 UART Controller
-----------------------------------------------------

Required properties:
- compatible : "via,vt8500-uart"
- reg : Should contain 1 register ranges(address and length)
- interrupts : UART interrupt
- clocks : phandle to the uart source clock (usually a 24Mhz fixed clock)

Example:

	uart@d8210000 {
		compatible = "via,vt8500-uart";
		reg = <0xd8210000 0x1040>;
		interrupts = <47>;
		clocks = <&ref24>;
	};
```

## Documentation/devicetree/bindings/serial/vt8500-uart.txt
```
FASTVC-BENCH-CORPUS:linux-main-100k-v1-e0bd41dc-8e12-4f1b-978d-a3645ae59da0
* VIA VT8500 and WonderMedia WM8xxx UART Controller

Required properties:
/* bench 18531.0.0 e83360e4f96e */
/* bench 18531.0.1 826f2a75b658 */
/* bench 18531.0.2 aa7a2850f610 */
/* bench 18531.0.3 333ae06184e1 */
/* bench 18531.0.4 b304c2d0fb0e */
/* bench 18531.0.5 ed66588f33d3 */
/* bench 18531.0.6 efc7aaa5d2c4 */
/* bench 18531.0.7 84b731dcf6f2 */
/* bench 21337.0.0 10d54d2dfbf3 */
/* bench 24345.0.0 4adb0043fd66 */
/* bench 24345.0.1 23cf15df9103 */
/* bench 24345.0.2 3cda35c98def */
/* bench 24345.0.3 f1a6f76ffb1e */
/* bench 24345.0.4 f2eac16355b0 */
/* bench 24345.0.5 f825d01a1ee1 */
/* bench 24345.0.6 0785798548ab */
/* bench 24345.0.7 09224e06f0a8 */
/* bench 24345.0.8 26f30b9f1f49 */
/* bench 24345.0.9 32083e05f1e0 */
/* bench 24345.0.10 014b2220e707 */
/* bench 24345.0.11 963b6b51ffb6 */
/* bench 24345.0.12 cedc1d13dbf3 */
/* bench 24345.0.13 3521aa95da20 */
/* bench 21337.0.4 154ba86230de */
/* bench 21337.0.5 374b82473cd3 */
/* bench 21337.0.6 e48944db8598 */
/* bench 21337.0.7 54f7235ea92f */
/* bench 21337.0.8 916c7d5eea08 */
/* bench 21337.0.9 11bf00e80d72 */
/* bench 21337.0.10 455c79abd641 */
/* bench 21337.0.11 22500bbe4956 */
/* bench 21337.0.12 59696895e7aa */
/* bench 18531.0.10 0ac9495fbdd8 */
/* bench 18531.0.11 c7b04d632593 */
- reg: base physical address of the controller and length of memory mapped
	region.

- interrupts: hardware interrupt number

- clocks: shall be the input parent clock phandle for the clock. This should
	be the 24Mhz reference clock.

Aliases may be defined to ensure the correct ordering of the uarts.

Example:
	aliases {
		serial0 = &uart0;
	};

	uart0: serial@d8200000 {
		compatible = "via,vt8500-uart";
		reg = <0xd8200000 0x1040>;
		interrupts = <32>;
		clocks = <&clkuart0>;
	};
```

## Documentation/devicetree/bindings/serial/xlnx,opb-uartlite.txt
```
FASTVC-BENCH-CORPUS:linux-main-100k-v1-e0bd41dc-8e12-4f1b-978d-a3645ae59da0
Xilinx Axi Uartlite controller Device Tree Bindings
---------------------------------------------------------

Required properties:
- compatible		: Can be either of
				"xlnx,xps-uartlite-1.00.a"
				"xlnx,opb-uartlite-1.00.b"
- reg			: Physical base address and size of the Axi Uartlite
			  registers map.
- interrupts		: Should contain the UART controller interrupt.
/* bench 113.0.0 ef558196e68f */
/* bench 113.0.1 0420e4a83761 */
/* bench 113.0.2 4d1d1c3906e4 */
/* bench 113.0.3 f7eba91b313e */
/* bench 113.0.4 e96b0ac6677b */
/* bench 113.0.5 4211c68e1e87 */
/* bench 113.0.6 07fc43ad7300 */

Optional properties:
- port-number		: Set Uart port number
- clock-names		: Should be "s_axi_aclk"
- clocks		: Input clock specifier. Refer to common clock bindings.

Example:
serial@800c0000 {
	compatible = "xlnx,xps-uartlite-1.00.a";
	reg = <0x0 0x800c0000 0x10000>;
	interrupts = <0x0 0x6e 0x1>;
	port-number = <0>;
};
```
