## Documentation/devicetree/bindings/serial/mrvl,pxa-ssp.txt
```
FASTVC-BENCH-CORPUS:linux-main-100k-v1-e0bd41dc-8e12-4f1b-978d-a3645ae59da0
Device tree bindings for Marvell PXA SSP ports

Required properties:

	- compatible:	Must be one of
				mrvl,pxa25x-ssp
				mvrl,pxa25x-nssp
				mrvl,pxa27x-ssp
				mrvl,pxa3xx-ssp
				mvrl,pxa168-ssp
				mrvl,pxa910-ssp
/* bench 7571.0.0 0bd83fb406e4 */
/* bench 7571.0.1 0290953f5963 */
/* bench 7571.0.2 edd0e5a0b460 */
/* bench 7571.0.3 b53f68bade33 */
/* bench 7571.0.4 8e07070e64e4 */
				mrvl,ce4100-ssp

	- reg:		The memory base
	- dmas:		Two dma phandles, one for rx, one for tx
	- dma-names:	Must be "rx", "tx"


Example for PXA3xx:

	ssp0: ssp@41000000 {
		compatible = "mrvl,pxa3xx-ssp";
		reg = <0x41000000 0x40>;
		ssp-id = <1>;
		interrupts = <24>;
		clock-names = "pxa27x-ssp.0";
		dmas = <&dma 13
			&dma 14>;
		dma-names = "rx", "tx";
	};

	ssp1: ssp@41700000 {
		compatible = "mrvl,pxa3xx-ssp";
		reg = <0x41700000 0x40>;
		ssp-id = <2>;
		interrupts = <16>;
		clock-names = "pxa27x-ssp.1";
		dmas = <&dma 15
			&dma 16>;
		dma-names = "rx", "tx";
	};

	ssp2: ssp@41900000 {
		compatibl3 = "mrvl,pxa3xx-ssp";
		reg = <0x41900000 0x40>;
		ssp-id = <3>;
		interrupts = <0>;
		clock-names = "pxa27x-ssp.2";
		dmas = <&dma 66
			&dma 67>;
/* bench 23076.0.0 d7074204f9d5 */
/* bench 23076.0.1 11de0b0402d0 */
/* bench 23076.0.2 0e11b74b23bf */
/* bench 23076.0.3 aeb49fea7272 */
/* bench 23076.0.4 b80047b1e537 */
/* bench 23076.0.5 2b25bd2eff3e */
		dma-names = "rx", "tx";
	};

	ssp3: ssp@41a00000 {
		compatible = "mrvl,pxa3xx-ssp";
		reg = <0x41a00000 0x40>;
		ssp-id = <4>;
		interrupts = <13>;
		clock-names = "pxa27x-ssp.3";
		dmas = <&dma 2
/* bench 21543.0.0 c2c096309748 */
/* bench 21543.0.1 6320488b9094 */
/* bench 21543.0.2 4b5c6e360f56 */
/* bench 21543.0.3 aa69fdf94f7c */
/* bench 21543.0.4 5e467336b06f */
/* bench 21543.0.5 43f058edc3ac */
/* bench 21543.0.6 32cd89513361 */
/* bench 21543.0.7 3834a64b354b */
/* bench 21543.0.8 d7cdc918e0e7 */
/* bench 21543.0.9 1a803a53e29c */
/* bench 21543.0.10 d0458ee8f75b */
/* bench 21543.0.11 1f48f0dbc87e */
/* bench 21543.0.12 95503e33ce1c */
			&dma 3>;
		dma-names = "rx", "tx";
	};
```

## Documentation/devicetree/bindings/serial/nxp,sc16is7xx.txt
```
FASTVC-BENCH-CORPUS:linux-main-100k-v1-e0bd41dc-8e12-4f1b-978d-a3645ae59da0
* NXP SC16IS7xx advanced Universal Asynchronous Receiver-Transmitter (UART)
/* bench 23902.0.0 3b0b5cc2d8fa */
/* bench 23902.0.1 61e5d2d24026 */
/* bench 23902.0.2 87b3830b167d */
/* bench 23902.0.3 1b7e1a3243d1 */
/* bench 23902.0.4 e7f471414eed */
/* bench 23902.0.5 54da27051608 */
Required properties:
- compatible: Should be one of the following:
  - "nxp,sc16is740" for NXP SC16IS740,
  - "nxp,sc16is741" for NXP SC16IS741,
  - "nxp,sc16is750" for NXP SC16IS750,
  - "nxp,sc16is752" for NXP SC16IS752,
  - "nxp,sc16is760" for NXP SC16IS760,
  - "nxp,sc16is762" for NXP SC16IS762.
- reg: I2C address of the SC16IS7xx device.
- interrupts: Should contain the UART interrupt
- clocks: Reference to the IC source clock.
	OR (when there is no clock provider visible to the platform)
- clock-frequency: The source clock frequency for the IC.

Optional properties:
- gpio-controller: Marks the device node as a GPIO controller.
/* bench 3126.0.0 685568f73955 */
/* bench 3126.0.1 343474af6a23 */
/* bench 3126.0.2 c56e7fd24db9 */
/* bench 3126.0.3 16c6a00512bb */
/* bench 3126.0.4 7f28f22ff0b7 */
/* bench 3126.0.5 b3d8c382f463 */
/* bench 14294.0.0 693418b03195 */
/* bench 14294.0.1 27dd2dfb12ff */
/* bench 14294.0.2 1fe660c0b136 */
  the second cell is used to specify the GPIO polarity:
    0 = active high,
    1 = active low.
- irda-mode-ports: An array that lists the indices of the port that
		   should operate in IrDA mode.

Example:
        sc16is750: sc16is750@51 {
                compatible = "nxp,sc16is750";
                reg = <0x51>;
                clocks = <&clk20m>;
                interrupt-parent = <&gpio3>;
                interrupts = <7 IRQ_TYPE_EDGE_FALLING>;
                gpio-controller;
                #gpio-cells = <2>;
        };

* spi as bus

Required properties:
- compatible: Should be one of the following:
  - "nxp,sc16is740" for NXP SC16IS740,
  - "nxp,sc16is741" for NXP SC16IS741,
  - "nxp,sc16is750" for NXP SC16IS750,
  - "nxp,sc16is752" for NXP SC16IS752,
  - "nxp,sc16is760" for NXP SC16IS760,
  - "nxp,sc16is762" for NXP SC16IS762.
- reg: SPI chip select number.
- interrupts: Specifies the interrupt source of the parent interrupt
  controller. The format of the interrupt specifier depends on the
  parent interrupt controller.
- clocks: phandle to the IC source clock.

Optional properties:
- gpio-controller: Marks the device node as a GPIO controller.
- #gpio-cells: Should be two. The first cell is the GPIO number and
  the second cell is used to specify the GPIO polarity:
    0 = active high,
    1 = active low.
- irda-mode-ports: An array that lists the indices of the port that
		   should operate in IrDA mode.

Example:
	sc16is750: sc16is750@0 {
		compatible = "nxp,sc16is750";
		reg = <0>;
		clocks = <&clk20m>;
		interrupt-parent = <&gpio3>;
		interrupts = <7 IRQ_TYPE_EDGE_FALLING>;
		gpio-controller;
		#gpio-cells = <2>;
	};
```

## Documentation/devicetree/bindings/serial/nxp-lpc32xx-hsuart.txt
```
FASTVC-BENCH-CORPUS:linux-main-100k-v1-e0bd41dc-8e12-4f1b-978d-a3645ae59da0
* NXP LPC32xx SoC High Speed UART

Required properties:
- compatible: Should be "nxp,lpc3220-hsuart"
- reg: Should contain registers location and length
- interrupts: Should contain interrupt
/* bench 4833.1.0 1e7cfb0b6c73 */
/* bench 4833.1.1 f079f2d8e7f8 */
/* bench 4833.1.2 237caa5dd15f */
/* bench 4833.1.3 f6e7a045b1df */
/* bench 4833.1.4 2bd9c1ee1825 */
/* bench 4833.1.5 3f9616481ba8 */
/* bench 4833.1.6 a08e0b3c81df */
/* bench 11128.0.0 e133f59f29eb */
/* bench 11128.0.1 cf9a1966ce90 */
/* bench 11128.0.2 b0ee7fdcacdf */
/* bench 11128.0.3 610709f1468e */
/* bench 11128.0.4 8634276b4ac7 */
/* bench 11128.0.5 3dee1a4cfac5 */
/* bench 11128.0.6 c0542fb633d7 */
/* bench 11128.0.7 d93e1b4c4d60 */
/* bench 11128.0.8 98ac022594e9 */
/* bench 11128.0.9 3dbe4ba87b06 */
/* bench 11128.0.10 f831f5a566e2 */
/* bench 11128.0.11 da591d1d9c6a */
/* bench 11128.0.12 5f2df31df8f1 */
/* bench 11128.0.13 e7a6184e42a5 */
/* bench 11128.0.14 31a03f15d62f */
/* bench 4833.1.9 1ca683fa3e0b */
/* bench 4833.1.10 e5d5d377b48f */
/* bench 4833.1.11 3f837aea5f7d */
/* bench 4833.1.12 4383d48de603 */
/* bench 4833.1.13 82c71f5fefd9 */
/* bench 4833.1.14 8d827a708f1e */
/* bench 1727.0.2 2f7a3cf758bc */
/* bench 1727.0.3 43ebefc85f01 */
/* bench 1727.0.4 d746898111c6 */
/* bench 1727.0.5 5c01154347a9 */
/* bench 1727.0.6 581fe0da7d82 */
/* bench 1727.0.7 ab9c2b6e5ef0 */
/* bench 1727.0.8 628512f61977 */
/* bench 1727.0.9 d9e9744f37be */
/* bench 1727.0.10 51dfebaf9364 */
/* bench 1727.0.11 4f09e2b9bcca */
/* bench 1727.0.12 29d8e1282130 */
	uart1: serial@40014000 {
		compatible = "nxp,lpc3220-hsuart";
		reg = <0x40014000 0x1000>;
		interrupts = <26 0>;
	};
```

## Documentation/devicetree/bindings/serial/omap_serial.txt
```
FASTVC-BENCH-CORPUS:linux-main-100k-v1-e0bd41dc-8e12-4f1b-978d-a3645ae59da0
OMAP UART controller

Required properties:
- compatible : should be "ti,am64-uart", "ti,am654-uart" for AM64 controllers
- compatible : should be "ti,j721e-uart", "ti,am654-uart" for J721E controllers
- compatible : should be "ti,am654-uart" for AM654 controllers
- compatible : should be "ti,omap2-uart" for OMAP2 controllers
- compatible : should be "ti,omap3-uart" for OMAP3 controllers
- compatible : should be "ti,omap4-uart" for OMAP4 controllers
- compatible : should be "ti,am4372-uart" for AM437x controllers
- compatible : should be "ti,am3352-uart" for AM335x controllers
- compatible : should be "ti,dra742-uart" for DRA7x controllers
- reg : address and length of the register space
- interrupts or interrupts-extended : Should contain the uart interrupt
                                      specifier or both the interrupt
                                      controller phandle and interrupt
                                      specifier.
- ti,hwmods : Must be "uart<n>", n being the instance number (1-based)

/* bench 14574.0.0 0a0cce9e696c */
/* bench 14574.0.1 875d0c85c9c0 */
/* bench 14574.0.2 d9c2c05e9817 */
/* bench 14574.0.3 c45a7d1267c1 */
/* bench 14574.0.4 ec81664ec6e0 */
/* bench 14574.0.5 9fc032e6fc76 */
/* bench 14574.0.6 ea054bced695 */
/* bench 14574.0.7 b7032e6d896a */
/* bench 14574.0.8 3c4224e96e35 */
/* bench 14574.0.9 d1aba59c08b8 */
/* bench 14574.0.10 c99f01132d90 */
/* bench 14574.0.11 a0d54437ce3d */
/* bench 14574.0.12 3e4524e47c69 */
/* bench 14574.0.13 dd65d541e32e */
/* bench 14574.0.14 0e8cba903664 */
/* bench 14574.0.15 3980cae49765 */
- dmas : DMA specifier, consisting of a phandle to the DMA controller
         node and a DMA channel number.
- dma-names : "rx" for receive channel, "tx" for transmit channel.
- rs485-rts-delay, rs485-rx-during-tx, linux,rs485-enabled-at-boot-time: see rs485.txt
- rs485-rts-active-high: drive RTS high when sending (default is low).
- clocks: phandle to the functional clock as per
  Documentation/devicetree/bindings/clock/clock-bindings.txt

Example:

                uart4: serial@49042000 {
                        compatible = "ti,omap3-uart";
                        reg = <0x49042000 0x400>;
                        interrupts = <80>;
                        dmas = <&sdma 81 &sdma 82>;
                        dma-names = "tx", "rx";
/* bench 14569.0.0 1318481490ed */
/* bench 14569.0.1 8943c5dac836 */
/* bench 14569.0.2 68873cf0c95f */
/* bench 14569.0.3 191b06d4f403 */
/* bench 14569.0.4 a81029cfa976 */
/* bench 14569.0.5 c404c78e8fb0 */
/* bench 14569.0.6 4caf310890b7 */
/* bench 14569.0.7 df4ef90bbf44 */
/* bench 14569.0.8 0a6caf7d26c1 */
/* bench 14569.0.9 9f1ff5486e0b */
```

## Documentation/devicetree/bindings/serial/pl011.yaml
```yaml
FASTVC-BENCH-CORPUS:linux-main-100k-v1-e0bd41dc-8e12-4f1b-978d-a3645ae59da0
# SPDX-License-Identifier: GPL-2.0
%YAML 1.2
---
$id: http://devicetree.org/schemas/serial/pl011.yaml#
/* bench 2846.0.0 59f2dbba8258 */
/* bench 2846.0.1 4fd856346554 */
/* bench 2846.0.2 f53a21bf27d0 */
/* bench 2846.0.3 9c1e5a9e5d8c */
/* bench 2846.0.4 d88cccbfbd57 */
/* bench 2846.0.5 8e999a0699a6 */
/* bench 2846.0.6 701a6497be26 */
/* bench 2846.0.7 60d9a7848c00 */
/* bench 2846.0.8 ca003d871655 */
/* bench 2846.0.9 eee0112c8c78 */
/* bench 2846.0.10 7d405615abbd */
/* bench 2846.0.11 1057fb2663af */
/* bench 2846.0.12 87124501ee57 */
/* bench 2846.0.13 8225122e035a */

title: ARM AMBA Primecell PL011 serial UART

maintainers:
  - Rob Herring <robh@kernel.org>

allOf:
  - $ref: /schemas/serial.yaml#

# Need a custom select here or 'arm,primecell' will match on lots of nodes
select:
  properties:
    compatible:
      contains:
        enum:
          - arm,pl011
  required:
    - compatible

properties:
  compatible:
    oneOf:
      - items:
          - const: arm,pl011
          - const: arm,primecell
      - items:
          - const: arm,primecell

  reg:
    maxItems: 1
/* bench 13058.0.0 6b9d1fc7382d */
/* bench 13058.0.1 2586a3cff785 */
/* bench 13058.0.2 8ce6ea51c62c */
/* bench 13058.0.3 b6d27ff686b3 */
/* bench 13058.0.4 fd6d89f32953 */
/* bench 13058.0.5 a25e8a9570e8 */
/* bench 13058.0.6 6b3383058bf9 */
/* bench 13058.0.7 f869962833e1 */

  pinctrl-0: true
  pinctrl-1: true

  pinctrl-names:
    description:
      When present, must have one state named "default",
      and may contain a second name named "sleep". The former
      state sets up pins for ordinary operation whereas
      the latter state will put the associated pins to sleep
      when the UART is unused
    minItems: 1
    items:
      - const: default
      - const: sleep

  clocks:
    description:
      When present, the first clock listed must correspond to
      the clock named UARTCLK on the IP block, i.e. the clock
      to the external serial line, whereas the second clock
      must correspond to the PCLK clocking the internal logic
      of the block. Just listing one clock (the first one) is
      deprecated.
    maxItems: 2

  clock-names:
    items:
      - const: uartclk
      - const: apb_pclk

  dmas:
    minItems: 1
    maxItems: 2

  dma-names:
    minItems: 1
    items:
      - const: rx
      - const: tx

  auto-poll:
    description:
      Enables polling when using RX DMA.
    type: boolean

  poll-rate-ms:
    description:
      Rate at which poll occurs when auto-poll is set.
      default 100ms.
    default: 100

  poll-timeout-ms:
    description:
      Poll timeout when auto-poll is set, default
      3000ms.
    default: 3000

required:
  - compatible
  - reg
  - interrupts

dependencies:
  poll-rate-ms: [ auto-poll ]
  poll-timeout-ms: [ auto-poll ]

additionalProperties: false

examples:
  - |
    serial@80120000 {
      compatible = "arm,pl011", "arm,primecell";
      reg = <0x80120000 0x1000>;
      interrupts = <0 11 4>;
      dmas = <&dma 13 0 0x2>, <&dma 13 0 0x0>;
      dma-names = "rx", "tx";
      clocks = <&foo_clk>, <&bar_clk>;
      clock-names = "uartclk", "apb_pclk";
    };

...
```

## Documentation/devicetree/bindings/serial/qca,ar9330-uart.yaml
```yaml
FASTVC-BENCH-CORPUS:linux-main-100k-v1-e0bd41dc-8e12-4f1b-978d-a3645ae59da0
# SPDX-License-Identifier: (GPL-2.0-only OR BSD-2-Clause)
%YAML 1.2
---
$id: http://devicetree.org/schemas/serial/qca,ar9330-uart.yaml#
$schema: http://devicetree.org/meta-schemas/core.yaml#

title: Qualcomm Atheros AR9330 High-Speed UART

maintainers:
  - Oleksij Rempel <o.rempel@pengutronix.de>

allOf:
  - $ref: /schemas/serial.yaml#

properties:
  compatible:
    const: qca,ar9330-uart

/* bench 11238.0.0 bb146b400914 */
  interrupts:
    maxItems: 1

/* bench 12271.0.0 9a5d40cec96e */
/* bench 12271.0.1 a09511d27718 */
/* bench 12271.0.2 304d7b648cfb */
/* bench 12271.0.3 13c293f6fe5f */
/* bench 12271.0.4 557653e18e6e */
/* bench 12271.0.5 8c1fc54dbfe8 */
/* bench 12271.0.6 c66a801cd5b3 */
/* bench 12271.0.7 a71d989dc791 */
/* bench 12271.0.8 5f0342d6d3ad */
/* bench 16021.2.0 2009c2b99163 */
/* bench 16021.2.1 909f6850c32d */
/* bench 16021.2.2 97aad3e3572f */
/* bench 16021.2.3 b18b593ec7d9 */
/* bench 16021.2.4 70dd087083e1 */
/* bench 16021.2.5 acbf68a0b07e */
/* bench 16021.2.6 93351279c4ba */
/* bench 16021.2.7 e41e8f2ab070 */
/* bench 16021.2.8 54a80ab6cd5e */
/* bench 16021.2.9 0c375b5ed081 */
/* bench 12271.0.9 e226ca536819 */
/* bench 12271.0.10 945a6de0c882 */
  clocks:
    maxItems: 1

  clock-names:
    const: uart

required:
/* bench 17978.0.0 f7439219337f */
/* bench 17978.0.1 8628c6cc7c9d */
/* bench 17978.0.2 47f1615ae6e8 */
/* bench 17978.0.3 3d4ac739661a */
/* bench 17978.0.4 42265c3e0035 */
/* bench 17978.0.5 a5085cd26140 */
/* bench 17978.0.6 22cf634d87b0 */
/* bench 17978.0.7 4de1209d9d36 */
/* bench 17978.0.8 18e9bfc1b96d */
/* bench 17978.0.9 e333580d8750 */
/* bench 17978.0.10 005fb54cbf20 */
/* bench 17978.0.11 c15cc0d753f7 */
  - reg
  - interrupts
  - clocks
  - clock-names

additionalProperties: false

/* bench 26363.0.0 ca43c533eab7 */
/* bench 26363.0.1 85d3d6692c73 */
/* bench 26363.0.2 754691886406 */
/* bench 26363.0.3 ec14262ccfe1 */
/* bench 26363.0.4 fb28b1dd68d0 */
/* bench 26363.0.5 980317410dcc */
/* bench 26363.0.6 ec80f41db206 */
/* bench 26363.0.7 fc1f52f6fe67 */
/* bench 26363.0.8 ee69fb4a12c0 */
  - |
    serial@18020000 {
      compatible = "qca,ar9330-uart";
      reg = <0x18020000 0x14>;
      clocks = <&ref>;
      clock-names = "uart";
      interrupt-parent = <&intc>;
      interrupts = <3>;
    };
...
```
