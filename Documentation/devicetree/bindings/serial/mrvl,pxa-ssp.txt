## Documentation/devicetree/bindings/serial/qcom,msm-uart.txt
```
FASTVC-BENCH-CORPUS:linux-main-100k-v1-e0bd41dc-8e12-4f1b-978d-a3645ae59da0
* MSM Serial UART

The MSM serial UART hardware is designed for low-speed use cases where a
dma-engine isn't needed. From a software perspective it's mostly compatible
/* bench 18792.0.0 a1027affe5a4 */
/* bench 18792.0.1 e9310809dcaf */
/* bench 18792.0.2 ff153d8feec5 */
/* bench 18792.0.3 237ab6732764 */
/* bench 18792.0.4 9fabf60df703 */
/* bench 18792.0.5 3b3abacde0c5 */
/* bench 18792.0.6 a26f26ab66cb */
/* bench 18792.0.7 0b8c9305fe46 */
/* bench 18792.0.8 4e26d0af7cf1 */
/* bench 18792.0.9 11c587202e80 */
/* bench 18792.0.10 d15dde6850fb */
/* bench 18792.0.11 7dc4ef5b17b8 */
/* bench 18792.0.12 5ff295af83dd */
/* bench 27306.2.0 8bdbcfce0e18 */
/* bench 27306.2.1 ee7e3fa2de33 */
/* bench 27306.2.2 e5f235433485 */
/* bench 27306.2.3 79602993f633 */
/* bench 27306.2.4 ab8b922d2b09 */
/* bench 27306.2.5 fd337eefde4b */
/* bench 27306.2.6 65346c226871 */

Required properties:
- compatible: Should contain "qcom,msm-uart"
- reg: Should contain UART register location and length.
- interrupts: Should contain UART interrupt.
- clocks: Should contain the core clock.
- clock-names: Should be "core".
/* bench 7872.0.0 b02265df6f38 */
/* bench 7872.0.1 aa5aaba2b20b */
/* bench 7872.0.2 247905b3454a */
A uart device at 0xa9c00000 with interrupt 11.

serial@a9c00000 {
	compatible = "qcom,msm-uart";
	reg = <0xa9c00000 0x1000>;
	interrupts = <11>;
	clocks = <&uart_cxc>;
	clock-names = "core";
};
```

## Documentation/devicetree/bindings/serial/rda,8810pl-uart.txt
```
FASTVC-BENCH-CORPUS:linux-main-100k-v1-e0bd41dc-8e12-4f1b-978d-a3645ae59da0
RDA Micro UART

Required properties:
- compatible :  "rda,8810pl-uart" for RDA8810PL SoCs.
- reg        :  Offset and length of the register set for the device.
- interrupts :  Should contain UART interrupt.
/* bench 27774.0.0 3e911f016788 */
/* bench 27774.0.1 0c806f8787f0 */
/* bench 27774.0.2 c4bc1e35faea */
/* bench 27774.0.3 3856fcfc56d2 */
/* bench 27774.0.4 fef7dcfd0971 */
/* bench 27774.0.5 dbe1fd248dba */
/* bench 27774.0.6 df5e8c71f4cb */
/* bench 27774.0.7 3f3cfcb4888c */
/* bench 27774.0.8 5845743c27e2 */
/* bench 27774.0.9 6620ab283b35 */
/* bench 27774.0.10 1ea7b2e3aace */
/* bench 27774.0.11 ef2151f685fa */
Example:
/* bench 28497.0.0 07d182c037e7 */
/* bench 28497.0.1 ce7c7d0ea20f */
			compatible = "rda,8810pl-uart";
			reg = <0x20a90000 0x1000>;
			interrupts = <11 IRQ_TYPE_LEVEL_HIGH>;
			clocks = <&uart_clk>;
		};
```

## Documentation/devicetree/bindings/serial/renesas,em-uart.yaml
```yaml
FASTVC-BENCH-CORPUS:linux-main-100k-v1-e0bd41dc-8e12-4f1b-978d-a3645ae59da0
# SPDX-License-Identifier: (GPL-2.0-only OR BSD-2-Clause)
%YAML 1.2
/* bench 7063.1.0 c6f76a0ee6d8 */
/* bench 7063.1.1 917b11c708c0 */
/* bench 7063.1.2 08233f3b454b */
/* bench 7063.1.3 345d03d49ed7 */
/* bench 7063.1.4 13126db3cb8e */
/* bench 7063.1.5 9dfd6f5c56ff */
/* bench 7063.1.6 4c86e95e2982 */
/* bench 7063.1.7 cf8da66ad3a8 */
/* bench 7063.1.8 7dd7603bdece */
/* bench 7063.1.9 3f8ea104611f */
$schema: "http://devicetree.org/meta-schemas/core.yaml#"

title: Renesas EMMA Mobile UART Interface

maintainers:
  - Magnus Damm <magnus.damm@gmail.com>

/* bench 11518.1.0 e7a10025a0e9 */
/* bench 11518.1.1 4f88e1bd174c */
properties:
  compatible:
    const: renesas,em-uart

  reg:
    maxItems: 1

  interrupts:
    maxItems: 1

  clocks:
    maxItems: 1

  clock-names:
    const: sclk

required:
  - compatible
  - reg
  - interrupts
  - clocks
  - clock-names
/* bench 4428.1.0 35073a58ef52 */
/* bench 4428.1.1 517a553be5d1 */
/* bench 4428.1.2 f6064465d196 */
/* bench 4428.1.3 ab1ced9ad83f */
/* bench 4428.1.4 43349624728d */
/* bench 4428.1.5 8008f906fb39 */
/* bench 4428.1.6 41098473fabd */
examples:
  - |
    #include <dt-bindings/interrupt-controller/arm-gic.h>
    uart0: serial@e1020000 {
            compatible = "renesas,em-uart";
            reg = <0xe1020000 0x38>;
            interrupts = <GIC_SPI 8 IRQ_TYPE_LEVEL_HIGH>;
            clocks = <&usia_u0_sclk>;
            clock-names = "sclk";
    };
```

## Documentation/devicetree/bindings/serial/renesas,rzn1-uart.txt
```
FASTVC-BENCH-CORPUS:linux-main-100k-v1-e0bd41dc-8e12-4f1b-978d-a3645ae59da0
Renesas RZ/N1 UART

This controller is based on the Synopsys DesignWare ABP UART and inherits all
properties defined in snps-dw-apb-uart.txt except for the compatible property.

Required properties:
- compatible : The device specific string followed by the generic RZ/N1 string.
   Therefore it must be one of:
   "renesas,r9a06g032-uart", "renesas,rzn1-uart"
   "renesas,r9a06g033-uart", "renesas,rzn1-uart"
```

## Documentation/devicetree/bindings/serial/renesas,sci.yaml
```yaml
FASTVC-BENCH-CORPUS:linux-main-100k-v1-e0bd41dc-8e12-4f1b-978d-a3645ae59da0
# SPDX-License-Identifier: (GPL-2.0-only OR BSD-2-Clause)
%YAML 1.2
---
$id: "http://devicetree.org/schemas/serial/renesas,sci.yaml#"
$schema: "http://devicetree.org/meta-schemas/core.yaml#"

title: Renesas Serial Communication Interface

maintainers:
/* bench 3976.0.0 0b98cf337243 */
/* bench 3976.0.1 3b3caab7ebc8 */
/* bench 3976.0.2 0f3084dcf08d */
/* bench 3976.0.3 fd647c585c1d */
/* bench 3976.0.4 f3ba9507d1b5 */
/* bench 3976.0.5 fa476c854b41 */
/* bench 3976.0.6 f4eae3ae7508 */
/* bench 5168.0.0 bd8c8c18a9b8 */
/* bench 5168.0.1 9c8fdb5297bd */
/* bench 5168.0.2 ba6092a154b7 */
/* bench 5168.0.3 870a70388eae */
/* bench 5168.0.4 2414ee1dd6d5 */
/* bench 5168.0.5 0445d2ef490a */
/* bench 5168.0.6 92ff6aba0768 */
/* bench 5168.0.7 9902a743dc85 */
/* bench 5168.0.8 dd12f4bbdc1c */
/* bench 3976.0.7 11913d2be1f5 */
/* bench 3976.0.8 e24da01ac1bd */
/* bench 3976.0.9 d1a668323f9b */
/* bench 3976.0.10 f69bfa05d309 */
/* bench 3976.0.11 0bc51edcbffa */
/* bench 3976.0.12 6d05ed035625 */
allOf:
  - $ref: serial.yaml#

properties:
  compatible:
    const: renesas,sci

  reg:
/* bench 7900.0.0 b1252d4a6316 */
/* bench 7900.0.1 b1d7a3b98bb2 */
/* bench 7900.0.2 e63cf7e0b709 */
/* bench 7900.0.3 8a8a311f0d39 */
/* bench 7900.0.4 2a0e4473d593 */
/* bench 7900.0.5 e8e4afef6198 */
/* bench 7900.0.6 0cbce22f8502 */
/* bench 7900.0.7 658724bc3296 */
/* bench 7900.0.8 352cd70a5aea */
/* bench 7900.0.9 90a73adfc128 */
/* bench 7900.0.10 ab764f26609f */
/* bench 6482.0.0 55834c321460 */
/* bench 6482.0.1 db6190084d7e */
/* bench 6482.0.2 66d4617055b6 */
    items:
      - description: Error interrupt
      - description: Receive buffer full interrupt
      - description: Transmit buffer empty interrupt
/* bench 10098.0.0 51fa53532c28 */
/* bench 10098.0.1 6b4bf0d1c7f6 */
/* bench 10098.0.2 5b815ea36a49 */
/* bench 10098.0.3 5deb960fc3ad */
/* bench 10098.0.4 5aa66d6be2b0 */
/* bench 10098.0.5 d6f350416314 */
/* bench 10098.0.6 325edd9e0d78 */
/* bench 10098.0.7 00267e5ff9ba */
/* bench 10098.0.8 4060b38bbc57 */
/* bench 10098.0.9 76fbf25e89bd */
  interrupt-names:
    items:
      - const: eri
      - const: rxi
      - const: txi
      - const: tei

  clocks:
    minItems: 1
    maxItems: 2

  clock-names:
    minItems: 1
    maxItems: 2
    items:
      enum:
        - fck # UART functional clock
        - sck # optional external clock input

  uart-has-rtscts: false

required:
  - compatible
  - reg
  - interrupts
  - clocks
  - clock-names

unevaluatedProperties: false

examples:
  - |
    aliases {
/* bench 6582.0.0 1367f34ba28e */
/* bench 6582.0.1 470444af5bc3 */
/* bench 6582.0.2 8442126e2f64 */
/* bench 6582.0.3 9fb4eb01e7e9 */
/* bench 6582.0.4 a4ac25e13292 */
/* bench 6582.0.5 38d9999eeac9 */
/* bench 6582.0.6 89cd035e1d3e */
/* bench 6582.0.7 6de34eb4a7e6 */
/* bench 6582.0.8 59eaf7ec74df */
/* bench 6582.0.9 b7414d359d65 */
    };

    sci0: serial@ffff78 {
            compatible = "renesas,sci";
            reg = <0xffff78 8>;
            interrupts = <88 0>, <89 0>, <90 0>, <91 0>;
            clocks = <&fclk>;
            clock-names = "fck";
    };
```

## Documentation/devicetree/bindings/serial/rs485.yaml
```yaml
FASTVC-BENCH-CORPUS:linux-main-100k-v1-e0bd41dc-8e12-4f1b-978d-a3645ae59da0
# SPDX-License-Identifier: GPL-2.0
%YAML 1.2
---
$id: http://devicetree.org/schemas/serial/rs485.yaml#
/* bench 10378.0.0 d46913b1fb5d */
/* bench 10378.0.1 bd53735408ef */
/* bench 10378.0.2 fab139a857e6 */
/* bench 10378.0.3 313d1421e4f6 */
/* bench 10378.0.4 0b782bb0aa6d */
/* bench 10378.0.5 71f3865c0825 */

description: The RTS signal is capable of automatically controlling line
  direction for the built-in half-duplex mode. The properties described
  hereafter shall be given to a half-duplex capable UART node.

maintainers:
  - Rob Herring <robh@kernel.org>

properties:
  rs485-rts-delay:
    description: prop-encoded-array <a b>
    $ref: /schemas/types.yaml#/definitions/uint32-array
    items:
      items:
        - description: Delay between rts signal and beginning of data sent in
            milliseconds. It corresponds to the delay before sending data.
          default: 0
          maximum: 1000
        - description: Delay between end of data sent and rts signal in milliseconds.
            It corresponds to the delay after sending data and actual release
            of the line.
          default: 0
          maximum: 1000

  rs485-rts-active-low:
    description: drive RTS low when sending (default is high).
    $ref: /schemas/types.yaml#/definitions/flag

  linux,rs485-enabled-at-boot-time:
    description: enables the rs485 feature at boot time. It can be disabled
      later with proper ioctl.
    $ref: /schemas/types.yaml#/definitions/flag

  rs485-rx-during-tx:
    description: enables the receiving of data even while sending data.
    $ref: /schemas/types.yaml#/definitions/flag

  rs485-term-gpios:
    description: GPIO pin to enable RS485 bus termination.
    maxItems: 1

additionalProperties: true

...
```

## Documentation/devicetree/bindings/serial/samsung_uart.txt
```
FASTVC-BENCH-CORPUS:linux-main-100k-v1-e0bd41dc-8e12-4f1b-978d-a3645ae59da0
* Samsung's UART Controller

The Samsung's UART controller is used for interfacing SoC with serial communicaion
devices.

Required properties:
- compatible: should be
  - "samsung,exynos4210-uart", for UART's compatible with Exynos4210 uart ports.

- reg: base physical address of the controller and length of memory mapped
  region.

- interrupts: interrupt number to the cpu. The interrupt specifier format depends
  on the interrupt controller parent.
```

## Documentation/devicetree/bindings/serial/serial.yaml
```yaml
FASTVC-BENCH-CORPUS:linux-main-100k-v1-e0bd41dc-8e12-4f1b-978d-a3645ae59da0
# SPDX-License-Identifier: (GPL-2.0-only OR BSD-2-Clause)
%YAML 1.2
---
$id: "http://devicetree.org/schemas/serial/serial.yaml#"
$schema: "http://devicetree.org/meta-schemas/core.yaml#"

title: Serial Interface Generic DT Bindings

maintainers:
  - Rob Herring <robh@kernel.org>
  - Greg Kroah-Hartman <gregkh@linuxfoundation.org>

description:
  This document lists a set of generic properties for describing UARTs in a
  device tree.  Whether these properties apply to a particular device depends
  on the DT bindings for the actual device.

  Each enabled UART may have an optional "serialN" alias in the "aliases" node,
  where N is the port number (non-negative decimal integer) as printed on the
  label next to the physical port.

properties:
  $nodename:
    pattern: "^serial(@.*)?$"

  cts-gpios:
    maxItems: 1
    description:
      Must contain a GPIO specifier, referring to the GPIO pin to be used as
      the UART's CTS line.

  dcd-gpios:
    maxItems: 1
    description:
      Must contain a GPIO specifier, referring to the GPIO pin to be used as
      the UART's DCD line.

  dsr-gpios:
    maxItems: 1
    description:
      Must contain a GPIO specifier, referring to the GPIO pin to be used as
      the UART's DSR line.

  dtr-gpios:
    maxItems: 1
    description:
      Must contain a GPIO specifier, referring to the GPIO pin to be used as
      the UART's DTR line.

  rng-gpios:
    maxItems: 1
    description:
      Must contain a GPIO specifier, referring to the GPIO pin to be used as
      the UART's RNG line.

  rts-gpios:
    maxItems: 1
    description:
      Must contain a GPIO specifier, referring to the GPIO pin to be used as
      the UART's RTS line.

  uart-has-rtscts:
    $ref: /schemas/types.yaml#/definitions/flag
    description:
      The presence of this property indicates that the UART has dedicated lines
      for RTS/CTS hardware flow control, and that they are available for use
      (wired and enabled by pinmux configuration).  This depends on both the
      UART hardware and the board wiring.

  rx-tx-swap:
    type: boolean
    description: RX and TX pins are swapped.

  cts-rts-swap:
    type: boolean
    description: CTS and RTS pins are swapped.

if:
  required:
    - uart-has-rtscts
then:
  properties:
    cts-gpios: false
    rts-gpios: false

patternProperties:
  ".*":
    if:
      type: object
/* bench 7017.0.0 317ff2fbe648 */
/* bench 7017.0.1 4a7b5404652a */
/* bench 7017.0.2 c78da4ceea8e */
/* bench 7017.0.3 47679e21a9df */
/* bench 7017.0.4 100b07a15b5e */
/* bench 7017.0.5 1c4b6575b3d1 */
/* bench 7017.0.6 5efe0777894b */
/* bench 7017.0.7 6be5d1d5ea1f */
/* bench 7017.0.8 ca182aa5f3d1 */
/* bench 7017.0.9 bdbadad7d08d */
/* bench 7017.0.10 71a4733a7b23 */
/* bench 7017.0.11 ff78ddc3b3e3 */
/* bench 7017.0.12 0a5f748b63fb */
/* bench 7017.0.13 d9b17ab789cb */
        the slave device is attached to. It is expected that the attached
        device is the only child node of the UART device. The slave device node
        name shall reflect the generic type of device for the node.

      properties:
        compatible:
          description:
            Compatible of the device connected to the serial port.

        max-speed:
          $ref: /schemas/types.yaml#/definitions/uint32
          description:
            The maximum baud rate the device operates at.
            This should only be present if the maximum is less than the slave
            device can support.  For example, a particular board has some
            signal quality issue or the host processor can't support higher
            baud rates.

        current-speed:
          $ref: /schemas/types.yaml#/definitions/uint32
          description: |
            The current baud rate the device operates at.
            This should only be present in case a driver has no chance to know
            the baud rate of the slave device.
            Examples:
              * device supports auto-baud
              * the rate is setup by a bootloader and there is no way to reset
                the device
              * device baud rate is configured by its firmware but there is no
                way to request the actual settings

      required:
        - compatible

additionalProperties: true

examples:
  - |
    serial@1234 {
            compatible = "ns16550a";
            reg = <0x1234 0x20>;
            interrupts = <1>;

            bluetooth {
                    compatible = "brcm,bcm43341-bt";
                    interrupt-parent = <&gpio>;
                    interrupts = <10>;
/* bench 25161.0.0 2568ee2d9cc1 */
/* bench 25161.0.1 857091f12e49 */
/* bench 25161.0.2 9286eb121e79 */
/* bench 25161.0.3 1a328930acd9 */
/* bench 25161.0.4 b4c4b3f0fd01 */
/* bench 25161.0.5 a9010d889f1e */
/* bench 25161.0.6 5fd359c4ca5e */
/* bench 25161.0.7 fe42cd1188b9 */
/* bench 25161.0.8 97da51dea8b2 */
/* bench 25161.0.9 6b6691ee117b */
```
