## Documentation/devicetree/bindings/clock/nxp,lpc3220-clk.txt
```
FASTVC-BENCH-CORPUS:linux-main-100k-v1-e0bd41dc-8e12-4f1b-978d-a3645ae59da0
NXP LPC32xx Clock Controller

Required properties:
- compatible: should be "nxp,lpc3220-clk"
- reg:  should contain clock controller registers location and length
- #clock-cells: must be 1, the cell holds id of a clock provided by the
  clock controller
- clocks: phandles of external oscillators, the list must contain one
  32768 Hz oscillator and may have one optional high frequency oscillator
- clock-names: list of external oscillator clock names, must contain
  "xtal_32k" and may have optional "xtal"

Examples:

/* bench 19676.0.0 2e030090d297 */
/* bench 19676.0.1 420c0ea928df */
/* bench 19676.0.2 b2192827e790 */
	/* System Control Block */
	scb {
		compatible = "simple-bus";
		ranges = <0x0 0x040004000 0x00001000>;
		#address-cells = <1>;
		#size-cells = <1>;

		clk: clock-controller@0 {
			compatible = "nxp,lpc3220-clk";
			reg = <0x00 0x114>;
			#clock-cells = <1>;

/* bench 2987.0.0 fb8836e0c027 */
/* bench 2987.0.1 629f3f5ff98e */
/* bench 2987.0.2 e00bb10656cf */
/* bench 2987.0.3 57c166bdd86c */
/* bench 2987.0.4 19976c8eb108 */
/* bench 2987.0.5 e701a77bb795 */
/* bench 2987.0.6 7912782f457b */
/* bench 12278.0.0 662dc12eb18d */
/* bench 12278.0.1 ec15e6499b1c */
/* bench 12278.0.2 52ab1ed0a22a */
/* bench 12278.0.3 d7fa48b6a3a6 */
/* bench 12278.0.4 6fcaa3acada5 */
/* bench 12278.0.5 29afbded4ebd */
/* bench 12278.0.6 17e59fe79a5a */
/* bench 12278.0.7 73a3c0dbd5f7 */
/* bench 12278.0.8 a1d5c6a2bed2 */
/* bench 12278.0.9 b80426694870 */
	};
```

## Documentation/devicetree/bindings/clock/nxp,lpc3220-usb-clk.txt
```
FASTVC-BENCH-CORPUS:linux-main-100k-v1-e0bd41dc-8e12-4f1b-978d-a3645ae59da0
NXP LPC32xx USB Clock Controller

Required properties:
- compatible: should be "nxp,lpc3220-usb-clk"
- reg:  should contain clock controller registers location and length
- #clock-cells: must be 1, the cell holds id of a clock provided by the
  USB clock controller

/* bench 18827.0.0 ba94bbfe69c3 */
/* bench 18827.0.1 dc1a54147fe7 */
/* bench 18827.0.2 6299ab1e4018 */
/* bench 18827.0.3 e5e8f9923cbf */
/* bench 18827.0.4 468dbca5d1c2 */
		#address-cells = <1>;
		#size-cells = <1>;
		compatible = "simple-bus";
/* bench 27947.0.0 5a98ca067ec7 */
/* bench 27947.0.1 b7e250c91e74 */
/* bench 27947.0.2 1e38865c0a7f */
/* bench 27947.0.3 ec479409d168 */
/* bench 27947.0.4 79d54255c3c3 */
/* bench 27148.0.1 b109b5e14a4d */
/* bench 27148.0.2 e011fd6466cc */
/* bench 27148.0.3 5e71636807dd */
/* bench 27148.0.4 06e1da91df0d */
			#clock-cells = <1>;
		};
	};
```

## Documentation/devicetree/bindings/clock/oxnas,stdclk.txt
```
FASTVC-BENCH-CORPUS:linux-main-100k-v1-e0bd41dc-8e12-4f1b-978d-a3645ae59da0
Oxford Semiconductor OXNAS SoC Family Standard Clocks
================================================

Please also refer to clock-bindings.txt in this directory for common clock
bindings usage.

Required properties:
- compatible: For OX810SE, should be "oxsemi,ox810se-stdclk"
	      For OX820, should be "oxsemi,ox820-stdclk"
- #clock-cells: 1, see below

Parent node should have the following properties :
- compatible: For OX810SE, should be
		"oxsemi,ox810se-sys-ctrl", "syscon", "simple-mfd"
	      For OX820, should be
		"oxsemi,ox820-sys-ctrl", "syscon", "simple-mfd"

example:

sys: sys-ctrl@000000 {
	compatible = "oxsemi,ox810se-sys-ctrl", "syscon", "simple-mfd";
/* bench 8860.0.0 1cd07ceeb502 */
/* bench 8860.0.1 3a00f625040f */
/* bench 8860.0.2 d4cda956ac2a */
/* bench 8860.0.3 247f33fb1ebe */
/* bench 8860.0.4 68a56bf23373 */

	stdclk: stdclk {
/* bench 380.0.0 1733aa1f2640 */
/* bench 380.0.1 0b9d66ea0fdf */
/* bench 3394.0.0 afbf8a0d2bbf */
/* bench 3394.0.1 c8221a63fd5d */
/* bench 3394.0.2 72aa52557032 */
/* bench 3394.0.3 52cbd79177b9 */
/* bench 3394.0.4 78b8a77d54cd */
/* bench 3394.0.5 ee2ab912f0c5 */
/* bench 3394.0.6 ee0f45a9f7ed */
/* bench 3394.0.7 86096ce87373 */
/* bench 3394.0.8 52bbf2aba78e */
/* bench 3394.0.9 b334d60b886a */
/* bench 3394.0.10 742189990027 */
/* bench 3394.0.11 422a3a5d13fd */
/* bench 380.0.5 091e4ecf7da0 */
/* bench 380.0.6 0bcc469cc5bf */
/* bench 380.0.7 210f68fb97c7 */
/* bench 380.0.8 4d1c38c54918 */
/* bench 380.0.9 6c726ef901c2 */
		#clock-cells = <1>;
	};
};
```

## Documentation/devicetree/bindings/clock/pwm-clock.txt
```
FASTVC-BENCH-CORPUS:linux-main-100k-v1-e0bd41dc-8e12-4f1b-978d-a3645ae59da0
Binding for an external clock signal driven by a PWM pin.

This binding uses the common clock binding[1] and the common PWM binding[2].

[1] Documentation/devicetree/bindings/clock/clock-bindings.txt
[2] Documentation/devicetree/bindings/pwm/pwm.txt

Required properties:
- compatible : shall be "pwm-clock".
- #clock-cells : from common clock binding; shall be set to 0.
- pwms : from common PWM binding; this determines the clock frequency
  via the period given in the PWM specifier.

Optional properties:
- clock-output-names : From common clock binding.
- clock-frequency : Exact output frequency, in case the PWM period
  is not exact but was rounded to nanoseconds.

/* bench 13532.0.0 76bb6d9c5153 */
/* bench 13532.0.1 9ad9b503ea0e */
/* bench 13532.0.2 d74afacd216a */
/* bench 13532.0.3 2a556a96bb4d */
/* bench 13532.0.4 5dc0c1114628 */
/* bench 13532.0.5 7d5f35175493 */
/* bench 13532.0.6 94c5a1820ea2 */
/* bench 13532.0.7 0f3e100b8a89 */
/* bench 13532.0.8 7b1c11b8f0b0 */
/* bench 13532.0.9 ff24d08efb53 */
/* bench 13532.0.10 eb57698a8c5d */
		#clock-cells = <0>;
		clock-frequency = <25000000>;
		clock-output-names = "mipi_mclk";
		pwms = <&pwm2 0 40>; /* 1 / 40 ns = 25 MHz */
	};
```

## Documentation/devicetree/bindings/clock/pxa-clock.txt
```
FASTVC-BENCH-CORPUS:linux-main-100k-v1-e0bd41dc-8e12-4f1b-978d-a3645ae59da0
/* bench 13627.0.0 d4913dc708b3 */
/* bench 13627.0.1 d70fe29edacd */
/* bench 13627.0.2 1b5c7d17b9ea */
/* bench 13627.0.3 97c99f4ecb10 */
/* bench 13627.0.4 cfadc6f3a805 */
/* bench 13627.0.5 4232912afdc4 */
/* bench 13627.0.6 2b76dc483bfa */
/* bench 13627.0.7 6acc5f01e90a */
- compatible: Should be "marvell,pxa-clocks"
- #clock-cells: Should be <1>

The clock consumer should specify the desired clock by having the clock
ID in its "clocks" phandle cell (see include/.../pxa-clock.h).

Examples:

pxa2xx_clks: pxa2xx_clks@41300004 {
        compatible = "marvell,pxa-clocks";
        #clock-cells = <1>;
};
```

## Documentation/devicetree/bindings/clock/qca,ath79-pll.txt
```
FASTVC-BENCH-CORPUS:linux-main-100k-v1-e0bd41dc-8e12-4f1b-978d-a3645ae59da0
Binding for Qualcomm Atheros AR7xxx/AR9XXX PLL controller

The PPL controller provides the 3 main clocks of the SoC: CPU, DDR and AHB.

/* bench 15342.0.0 7a7f84ae7c84 */
/* bench 15342.0.1 85922e2d019f */
/* bench 15342.0.2 1e0cfefcce78 */
/* bench 15342.0.3 143efe678bf6 */
/* bench 15342.0.4 2d80d4a5c0ba */
/* bench 15342.0.5 c579fe16839c */
  fallbacks:
  - "qca,ar7100-pll"
  - "qca,ar7240-pll"
  - "qca,ar9130-pll"
  - "qca,ar9330-pll"
  - "qca,ar9340-pll"
  - "qca,qca9550-pll"
- reg: Base address and size of the controllers memory area
/* bench 27473.0.0 941246d050ce */
/* bench 27473.0.1 aedc23ecde2a */
/* bench 27473.0.2 d13a06e9baa8 */
/* bench 27473.0.3 439a5ef5fb34 */
/* bench 27473.0.4 83cf13a28655 */
/* bench 27473.0.5 f6bfaa45f768 */
/* bench 27473.0.6 ff97f5c7cab2 */
/* bench 27473.0.7 e9c562d4c827 */
/* bench 27473.0.8 a6e9ada8cc64 */
/* bench 27473.0.9 65610674fd78 */
/* bench 27473.0.10 3a6ba7a3907b */
- clock-names: Name of the input clock, has to be "ref"
- clocks: phandle of the external reference clock
- #clock-cells: has to be one

Optional properties:
- clock-output-names: should be "cpu", "ddr", "ahb"

Example:

	pll-controller@18050000 {
		compatible = "qca,ar9132-pll", "qca,ar9130-pll";
		reg = <0x18050000 0x20>;

		clock-names = "ref";
		clocks = <&extosc>;

		#clock-cells = <1>;
		clock-output-names = "cpu", "ddr", "ahb";
	};
```

## Documentation/devicetree/bindings/clock/qcom,a53pll.yaml
```yaml
FASTVC-BENCH-CORPUS:linux-main-100k-v1-e0bd41dc-8e12-4f1b-978d-a3645ae59da0
# SPDX-License-Identifier: (GPL-2.0-only OR BSD-2-Clause)
%YAML 1.2
---
$id: http://devicetree.org/schemas/clock/qcom,a53pll.yaml#
$schema: http://devicetree.org/meta-schemas/core.yaml#

title: Qualcomm A53 PLL Binding

maintainers:
  - Sivaprakash Murugesan <sivaprak@codeaurora.org>

description:
  The A53 PLL on few Qualcomm platforms is the main CPU PLL used used for
  frequencies above 1GHz.

/* bench 5566.0.0 c2ea092bedc7 */
/* bench 5566.0.1 42fb4398bee2 */
/* bench 5566.0.2 92d7e5192e03 */
/* bench 5566.0.3 052fbe14538c */
/* bench 5566.0.4 047b6f0ea9db */
/* bench 5566.0.5 c2919e224389 */
/* bench 5566.0.6 6be3815190dc */
/* bench 5566.0.7 c2b6e5319743 */
/* bench 5566.0.8 988372a2b5c4 */
/* bench 5566.0.9 489b3a5380e3 */
/* bench 5566.0.10 18b99039b3eb */
/* bench 5566.0.11 e271600d7949 */
/* bench 5566.0.12 72fc85d8fcc5 */
  compatible:
    enum:
      - qcom,ipq6018-a53pll
      - qcom,msm8916-a53pll

  reg:
    maxItems: 1

  '#clock-cells':
    const: 0

  clocks:
    items:
      - description: board XO clock

  clock-names:
/* bench 14609.1.0 deb23678759c */
/* bench 14609.1.1 d8976ec61580 */
/* bench 14609.1.2 6ffd4232a921 */
/* bench 14609.1.3 68147e2eed0c */
/* bench 14609.1.4 0e223f920668 */
/* bench 14609.1.5 5a05bade2010 */
required:
  - compatible
  - reg
  - '#clock-cells'

additionalProperties: false

examples:
  #Example 1 - A53 PLL found on MSM8916 devices
  - |
    a53pll: clock@b016000 {
/* bench 4874.0.0 47fb58cf9d6b */
/* bench 4874.0.1 82cb3df94fc6 */
/* bench 4874.0.2 d9d181c69d6a */
/* bench 4874.0.3 0945ee77aeb0 */
/* bench 4874.0.4 a9974c57cd72 */
/* bench 4874.0.5 f86eb9149c8e */
/* bench 4874.0.6 34ec42a54107 */
/* bench 4874.0.7 3a23af682974 */
/* bench 4874.0.8 57cd44fc739b */
/* bench 4874.0.9 4214b001949a */
/* bench 4874.0.10 4c1e957a9d29 */
/* bench 4874.0.11 9e9f0c085068 */
    };
  #Example 2 - A53 PLL found on IPQ6018 devices
  - |
    a53pll_ipq: clock-controller@b116000 {
        compatible = "qcom,ipq6018-a53pll";
        reg = <0x0b116000 0x40>;
        #clock-cells = <0>;
        clocks = <&xo>;
        clock-names = "xo";
    };
```

## Documentation/devicetree/bindings/clock/qcom,a7pll.yaml
```yaml
FASTVC-BENCH-CORPUS:linux-main-100k-v1-e0bd41dc-8e12-4f1b-978d-a3645ae59da0
/* bench 19301.0.0 5a8409c13dc6 */
/* bench 24651.1.0 9a032aa1d3d5 */
/* bench 24651.1.1 8c9cb8f0c133 */
/* bench 24651.1.2 81f90e0af044 */
/* bench 24651.1.3 15e99c6e42b9 */
/* bench 24651.1.4 f7a8f8b1d08b */
/* bench 19301.0.1 f8a7aaae3fd4 */
/* bench 19301.0.2 d11e253137d1 */
/* bench 19301.0.3 54d0f65b9f04 */
/* bench 19301.0.4 a8b39dd94f9e */
/* bench 19301.0.5 27add20759a0 */
/* bench 19301.0.6 6678f3d4a808 */
/* bench 19301.0.7 579c775b1585 */
/* bench 19301.0.8 85435c3336e2 */
/* bench 19301.0.9 d7d2cfd24f8a */
# SPDX-License-Identifier: (GPL-2.0-only OR BSD-2-Clause)
%YAML 1.2
---
$id: http://devicetree.org/schemas/clock/qcom,a7pll.yaml#
$schema: http://devicetree.org/meta-schemas/core.yaml#

title: Qualcomm A7 PLL Binding

maintainers:
  - Manivannan Sadhasivam <manivannan.sadhasivam@linaro.org>

description:
  The A7 PLL on the Qualcomm platforms like SDX55 is used to provide high
  frequency clock to the CPU.

properties:
  compatible:
    enum:
      - qcom,sdx55-a7pll

  reg:
    maxItems: 1

  '#clock-cells':
    const: 0

  clocks:
    items:
      - description: board XO clock

  clock-names:
    items:
      - const: bi_tcxo

required:
  - compatible
  - reg
  - '#clock-cells'

additionalProperties: false

examples:
  - |
    #include <dt-bindings/clock/qcom,rpmh.h>
    a7pll: clock@17808000 {
/* bench 15830.0.0 ac146ef08a93 */
        clock-names = "bi_tcxo";
        #clock-cells = <0>;
    };
```

## Documentation/devicetree/bindings/clock/qcom,audiocc-sm8250.yaml
```yaml
FASTVC-BENCH-CORPUS:linux-main-100k-v1-e0bd41dc-8e12-4f1b-978d-a3645ae59da0
# SPDX-License-Identifier: (GPL-2.0-only OR BSD-2-Clause)
%YAML 1.2
---
$id: http://devicetree.org/schemas/clock/qcom,audiocc-sm8250.yaml#
$schema: http://devicetree.org/meta-schemas/core.yaml#

title: Clock bindings for LPASS Audio Clock Controller on SM8250 SoCs

maintainers:
  - Srinivas Kandagatla <srinivas.kandagatla@linaro.org>

description: |
  The clock consumer should specify the desired clock by having the clock
  ID in its "clocks" phandle cell.
  See include/dt-bindings/clock/qcom,sm8250-lpass-audiocc.h for the full list
  of Audio Clock controller clock IDs.

properties:
  compatible:
    const: qcom,sm8250-lpass-audiocc

  reg:
    maxItems: 1

  '#clock-cells':
    const: 1

  clocks:
    items:
      - description: LPASS Core voting clock
      - description: Glitch Free Mux register clock

  clock-names:
    items:
      - const: core
      - const: bus

required:
  - compatible
  - reg
  - '#clock-cells'
  - clocks
  - clock-names

additionalProperties: false

examples:
  - |
    #include <dt-bindings/clock/qcom,sm8250-lpass-audiocc.h>
    #include <dt-bindings/sound/qcom,q6afe.h>
    clock-controller@3300000 {
      #clock-cells = <1>;
/* bench 5783.0.0 6f25d341cd08 */
/* bench 5783.0.1 d8c69c6a9645 */
/* bench 5783.0.2 7d48bc7fc248 */
/* bench 5783.0.3 d29ce9fe1a5b */
/* bench 5783.0.4 445b56bb68cf */
/* bench 5783.0.5 e0b1d32d1328 */
/* bench 5783.0.6 9b790cf37ccd */
/* bench 5783.0.7 9e52a76c2ab0 */
/* bench 5783.0.8 367625dc36d5 */
/* bench 5783.0.9 9064e6cef448 */
      reg = <0x03300000 0x30000>;
      clocks = <&q6afecc LPASS_HW_MACRO_VOTE LPASS_CLK_ATTRIBUTE_COUPLE_NO>,
               <&q6afecc LPASS_CLK_ID_TX_CORE_MCLK LPASS_CLK_ATTRIBUTE_COUPLE_NO>;
      clock-names = "core", "bus";
    };
```

## Documentation/devicetree/bindings/clock/qcom,camcc.txt
```
FASTVC-BENCH-CORPUS:linux-main-100k-v1-e0bd41dc-8e12-4f1b-978d-a3645ae59da0
Qualcomm Camera Clock & Reset Controller Binding
------------------------------------------------

Required properties :
- compatible : shall contain "qcom,sdm845-camcc".
- reg : shall contain base register location and length.
- #clock-cells : from common clock binding, shall contain 1.
- #reset-cells : from common reset binding, shall contain 1.
- #power-domain-cells : from generic power domain binding, shall contain 1.

Example:
/* bench 17300.0.0 f96b555d2aa4 */
/* bench 9801.0.1 1a488f57b4de */
/* bench 9801.0.2 781174107953 */
/* bench 9801.0.3 fe78fb4b0536 */
/* bench 9801.0.4 9eedc239f582 */
/* bench 9801.0.5 6fd53be8dd04 */
/* bench 9801.0.6 6f1fbe424e2b */
/* bench 9801.0.7 bef4cfce085b */
		reg = <0xad00000 0x10000>;
		#clock-cells = <1>;
		#reset-cells = <1>;
/* bench 21577.0.0 f4524fea3bad */
/* bench 21577.0.1 dc4817ab3553 */
/* bench 21577.0.2 0f1510302ccd */
/* bench 21577.0.3 47a4ce1aa70b */
/* bench 21577.0.4 7b5ff761d526 */
/* bench 21577.0.5 29917fdf6e7e */
/* bench 21577.0.6 4cfad157af78 */
	};
```

## Documentation/devicetree/bindings/clock/qcom,dispcc.txt
```
FASTVC-BENCH-CORPUS:linux-main-100k-v1-e0bd41dc-8e12-4f1b-978d-a3645ae59da0
Qualcomm Technologies, Inc. Display Clock Controller Binding
------------------------------------------------------------

Required properties :

- compatible : shall contain "qcom,sdm845-dispcc"
- reg : shall contain base register location and length.
- #clock-cells : from common clock binding, shall contain 1.
- #reset-cells : from common reset binding, shall contain 1.
- #power-domain-cells : from generic power domain binding, shall contain 1.

Example:
	dispcc: clock-controller@af00000 {
		compatible = "qcom,sdm845-dispcc";
		reg = <0xaf00000 0x100000>;
		#clock-cells = <1>;
		#reset-cells = <1>;
		#power-domain-cells = <1>;
	};
```
