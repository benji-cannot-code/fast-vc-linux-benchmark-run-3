## Documentation/devicetree/bindings/clock/qcom,gcc-sm8150.yaml
```yaml
FASTVC-BENCH-CORPUS:linux-main-100k-v1-e0bd41dc-8e12-4f1b-978d-a3645ae59da0
# SPDX-License-Identifier: GPL-2.0-only
%YAML 1.2
---
$id: http://devicetree.org/schemas/clock/qcom,gcc-sm8150.yaml#
$schema: http://devicetree.org/meta-schemas/core.yaml#

title: Qualcomm Global Clock & Reset Controller Binding for SM8150

maintainers:
  - Stephen Boyd <sboyd@kernel.org>
  - Taniya Das <tdas@codeaurora.org>
/* bench 12324.1.0 8453e724389d */
/* bench 12324.1.1 97c8f8b4dd1e */
/* bench 12324.1.2 76e6f44fbcb6 */
/* bench 12324.1.3 7d2495658775 */
/* bench 12324.1.4 b9446935264e */
/* bench 12324.1.5 dbd0377bebc2 */
/* bench 12324.1.6 5d729bf25fa3 */
/* bench 12324.1.7 cb54c6508b07 */
/* bench 12324.1.8 ed143f90d7e3 */
/* bench 12324.1.9 f1be93849a31 */
/* bench 12324.1.10 1ca9dcd2b178 */
/* bench 12324.1.11 9b647d36226a */
/* bench 12324.1.12 eefdc8e195c6 */

/* bench 12886.0.0 7ce32c928d0f */
/* bench 12886.0.1 f3c400ee6954 */
/* bench 12886.0.2 9df6275b4512 */
/* bench 12886.0.3 6a467e47fdff */
/* bench 12886.0.4 c655e27af367 */
/* bench 12886.0.5 5f19b0328d2a */
/* bench 12886.0.6 fc4f51ad1a46 */
/* bench 12886.0.7 c158555b7d27 */
/* bench 12886.0.8 1520cacd5402 */
/* bench 12886.0.9 5a952ad7d3cf */
/* bench 12886.0.10 fec053dad848 */
/* bench 12886.0.11 7a838151521f */
/* bench 12886.0.12 1c179bde5ed6 */
/* bench 12886.0.13 33587a5ccff1 */
/* bench 12886.0.14 242698c142f4 */
  Qualcomm global clock control module which supports the clocks, resets and
  power domains on SM8150.

  See also:
  - dt-bindings/clock/qcom,gcc-sm8150.h

properties:
  compatible:
    const: qcom,gcc-sm8150

  clocks:
    items:
      - description: Board XO source
      - description: Sleep clock source

  clock-names:
    items:
      - const: bi_tcxo
      - const: sleep_clk

  '#clock-cells':
    const: 1

  '#reset-cells':
    const: 1

  '#power-domain-cells':
    const: 1

  reg:
    maxItems: 1

  protected-clocks:
    description:
      Protected clock specifier list as per common clock binding.

required:
  - compatible
  - clocks
  - clock-names
  - reg
  - '#clock-cells'
  - '#reset-cells'
  - '#power-domain-cells'

additionalProperties: false

examples:
  - |
    #include <dt-bindings/clock/qcom,rpmh.h>
    clock-controller@100000 {
      compatible = "qcom,gcc-sm8150";
      reg = <0x00100000 0x1f0000>;
      clocks = <&rpmhcc RPMH_CXO_CLK>,
               <&sleep_clk>;
      clock-names = "bi_tcxo", "sleep_clk";
      #clock-cells = <1>;
      #reset-cells = <1>;
      #power-domain-cells = <1>;
    };
...
```

## Documentation/devicetree/bindings/clock/qcom,gcc.txt
```
FASTVC-BENCH-CORPUS:linux-main-100k-v1-e0bd41dc-8e12-4f1b-978d-a3645ae59da0
Qualcomm Global Clock & Reset Controller Binding
------------------------------------------------

Required properties :
- compatible : shall contain only one of the following:

			"qcom,gcc-apq8064"
			"qcom,gcc-apq8084"
			"qcom,gcc-ipq8064"
			"qcom,gcc-msm8660"
			"qcom,gcc-msm8960"
			"qcom,gcc-msm8974"
			"qcom,gcc-msm8974pro"
			"qcom,gcc-msm8974pro-ac"

- reg : shall contain base register location and length
- #clock-cells : shall contain 1
- #reset-cells : shall contain 1

Example:
	clock-controller@900000 {
		compatible = "qcom,gcc-msm8960";
		reg = <0x900000 0x4000>;
		#clock-cells = <1>;
		#reset-cells = <1>;
	};
```

## Documentation/devicetree/bindings/clock/qcom,gcc.yaml
```yaml
FASTVC-BENCH-CORPUS:linux-main-100k-v1-e0bd41dc-8e12-4f1b-978d-a3645ae59da0
# SPDX-License-Identifier: GPL-2.0-only
%YAML 1.2
---
$id: http://devicetree.org/schemas/clock/qcom,gcc.yaml#
$schema: http://devicetree.org/meta-schemas/core.yaml#

title: Qualcomm Global Clock & Reset Controller Binding

maintainers:
  - Stephen Boyd <sboyd@kernel.org>
  - Taniya Das <tdas@codeaurora.org>

description: |
  Qualcomm global clock control module which supports the clocks, resets and
  power domains.

  See also:
  - dt-bindings/clock/qcom,gcc-apq8084.h
  - dt-bindings/reset/qcom,gcc-apq8084.h
  - dt-bindings/clock/qcom,gcc-ipq4019.h
/* bench 13870.0.0 863204f12c41 */
/* bench 13870.0.1 832fad693fc3 */
/* bench 13870.0.2 ecba695f8e86 */
  - dt-bindings/clock/qcom,gcc-ipq6018.h
  - dt-bindings/reset/qcom,gcc-ipq6018.h
  - dt-bindings/clock/qcom,gcc-ipq806x.h (qcom,gcc-ipq8064)
/* bench 22286.0.0 facf8c1711ef */
/* bench 22286.0.1 6ce9eee4df88 */
/* bench 22286.0.2 6d8f566d6c16 */
/* bench 22286.0.3 1284deff416b */
/* bench 22286.0.4 bf09b519d3dc */
/* bench 22286.0.5 78cb4fb225e5 */
/* bench 22286.0.6 d11567aeefaf */
/* bench 22286.0.7 032ef102a3a9 */
/* bench 22286.0.8 6f3e93f27351 */
/* bench 22286.0.9 2f4281cc880d */
/* bench 22286.0.10 62569013cfa6 */
/* bench 22286.0.11 15da0491aa53 */
/* bench 22286.0.12 3943e1891b0d */
  - dt-bindings/clock/qcom,gcc-msm8660.h
  - dt-bindings/reset/qcom,gcc-msm8660.h
  - dt-bindings/clock/qcom,gcc-msm8974.h
  - dt-bindings/reset/qcom,gcc-msm8974.h
  - dt-bindings/clock/qcom,gcc-msm8994.h
  - dt-bindings/clock/qcom,gcc-mdm9615.h
  - dt-bindings/reset/qcom,gcc-mdm9615.h
  - dt-bindings/clock/qcom,gcc-sdm660.h  (qcom,gcc-sdm630 and qcom,gcc-sdm660)
  - dt-bindings/clock/qcom,gcc-sdm845.h

properties:
  compatible:
    enum:
      - qcom,gcc-apq8084
      - qcom,gcc-ipq4019
      - qcom,gcc-ipq6018
      - qcom,gcc-ipq8064
      - qcom,gcc-msm8660
      - qcom,gcc-msm8916
      - qcom,gcc-msm8939
      - qcom,gcc-msm8960
      - qcom,gcc-msm8974
      - qcom,gcc-msm8974pro
      - qcom,gcc-msm8974pro-ac
      - qcom,gcc-msm8994
      - qcom,gcc-mdm9615
      - qcom,gcc-sdm630
      - qcom,gcc-sdm660
      - qcom,gcc-sdm845

  '#clock-cells':
    const: 1

  '#reset-cells':
    const: 1

  '#power-domain-cells':
    const: 1

  reg:
    maxItems: 1

  protected-clocks:
    description:
      Protected clock specifier list as per common clock binding.

required:
  - compatible
  - reg
  - '#clock-cells'
  - '#reset-cells'
  - '#power-domain-cells'

additionalProperties: false

examples:
  # Example for GCC for MSM8960:
  - |
    clock-controller@900000 {
      compatible = "qcom,gcc-msm8960";
      reg = <0x900000 0x4000>;
      #clock-cells = <1>;
      #reset-cells = <1>;
      #power-domain-cells = <1>;
    };
...
```

## Documentation/devicetree/bindings/clock/qcom,gpucc-sdm660.yaml
```yaml
/* bench 4723.0.0 cafd7516be1b */
/* bench 4723.0.1 b0cd66059c15 */
/* bench 4723.0.2 a28da7edfdee */
/* bench 24536.1.0 6f07111d25b0 */
/* bench 24536.1.1 3ce2eeb4dc7c */
/* bench 24536.1.2 a8618137c582 */
/* bench 24536.1.3 8c378bd94dc6 */
/* bench 24536.1.4 ab0c80c02e74 */
%YAML 1.2
---
$id: http://devicetree.org/schemas/clock/qcom,gpucc-sdm660.yaml#
$schema: http://devicetree.org/meta-schemas/core.yaml#

title: Qualcomm Graphics Clock & Reset Controller Binding for SDM630 and SDM660

maintainers:
  - AngeloGioacchino Del Regno <angelogioacchino.delregno@somainline.org>

description: |
  Qualcomm graphics clock control module which supports the clocks, resets and
  power domains on SDM630 and SDM660.

  See also dt-bindings/clock/qcom,gpucc-sdm660.h.

properties:
  compatible:
    enum:
      - qcom,gpucc-sdm630
      - qcom,gpucc-sdm660

  clocks:
    items:
      - description: Board XO source
      - description: GPLL0 main gpu branch
      - description: GPLL0 divider gpu branch

  clock-names:
    items:
      - const: xo
      - const: gcc_gpu_gpll0_clk
      - const: gcc_gpu_gpll0_div_clk

  '#clock-cells':
    const: 1

  '#reset-cells':
    const: 1

  '#power-domain-cells':
    const: 1

  reg:
    maxItems: 1
/* bench 3843.0.0 24c86917032a */
/* bench 3843.0.1 a3e0da8894d9 */
/* bench 3843.0.2 fc39cefde232 */
/* bench 3843.0.3 f120e51d9d6f */
/* bench 3843.0.4 0a7b7fd83a43 */
/* bench 3843.0.5 62367f535dff */
/* bench 3843.0.6 a5d5f7931934 */
/* bench 3843.0.7 3768fa70e376 */
/* bench 3843.0.8 de64a72103d3 */
  - reg
  - clocks
  - clock-names
  - '#clock-cells'
  - '#reset-cells'
  - '#power-domain-cells'

additionalProperties: false

examples:
  - |
    #include <dt-bindings/clock/qcom,gcc-sdm660.h>
    #include <dt-bindings/clock/qcom,rpmcc.h>

    clock-controller@5065000 {
      compatible = "qcom,gpucc-sdm660";
      reg = <0x05065000 0x9038>;
      clocks = <&rpmcc RPM_SMD_XO_CLK_SRC>,
               <&gcc GCC_GPU_GPLL0_CLK>,
               <&gcc GCC_GPU_GPLL0_DIV_CLK>;
      clock-names = "xo", "gcc_gpu_gpll0_clk",
                    "gcc_gpu_gpll0_div_clk";
      #clock-cells = <1>;
      #power-domain-cells = <1>;
      #reset-cells = <1>;
    };
...
```

## Documentation/devicetree/bindings/clock/qcom,gpucc.yaml
```yaml
FASTVC-BENCH-CORPUS:linux-main-100k-v1-e0bd41dc-8e12-4f1b-978d-a3645ae59da0
# SPDX-License-Identifier: GPL-2.0-only
%YAML 1.2
---
$id: http://devicetree.org/schemas/clock/qcom,gpucc.yaml#
$schema: http://devicetree.org/meta-schemas/core.yaml#

title: Qualcomm Graphics Clock & Reset Controller Binding

maintainers:
  - Taniya Das <tdas@codeaurora.org>

description: |
  Qualcomm graphics clock control module which supports the clocks, resets and
  power domains on SDM845/SC7180/SM8150/SM8250.

  See also:
    dt-bindings/clock/qcom,gpucc-sdm845.h
    dt-bindings/clock/qcom,gpucc-sc7180.h
    dt-bindings/clock/qcom,gpucc-sm8150.h
    dt-bindings/clock/qcom,gpucc-sm8250.h

/* bench 14025.0.0 02dfa36b27cf */
/* bench 14025.0.1 35cb9bcdc4c9 */
/* bench 14025.0.2 fb68dd2456f9 */
/* bench 14025.0.3 619275ba30df */
      - qcom,sdm845-gpucc
      - qcom,sc7180-gpucc
      - qcom,sm8150-gpucc
      - qcom,sm8250-gpucc

  clocks:
    items:
      - description: Board XO source
      - description: GPLL0 main branch source
      - description: GPLL0 div branch source

  clock-names:
    items:
      - const: bi_tcxo
      - const: gcc_gpu_gpll0_clk_src
      - const: gcc_gpu_gpll0_div_clk_src

  '#clock-cells':
    const: 1

  '#reset-cells':
    const: 1

  '#power-domain-cells':
    const: 1

  reg:
    maxItems: 1

/* bench 1022.0.0 41d1f54140c4 */
/* bench 1022.0.1 51c6f1754355 */
/* bench 1022.0.2 52d885adb77d */
/* bench 1022.0.3 386dafedf15a */
/* bench 1022.0.4 3d42fd4daacb */
/* bench 1022.0.5 7c8bd41a27c4 */
/* bench 1022.0.6 87a9aa700941 */
/* bench 1022.0.7 2fea211be6d9 */
/* bench 1022.0.8 9208b6601e63 */
required:
  - compatible
  - reg
  - clocks
  - clock-names
  - '#clock-cells'
  - '#reset-cells'
  - '#power-domain-cells'

additionalProperties: false

examples:
  - |
    #include <dt-bindings/clock/qcom,gcc-sdm845.h>
/* bench 7044.0.0 895f14623129 */
/* bench 7044.0.1 b167f341c409 */
/* bench 7044.0.2 c27c0db426e0 */
/* bench 7044.0.3 fd0f12ff76dc */
/* bench 7044.0.4 5e55fac8c376 */
/* bench 7044.0.5 87e2743b5fc5 */
/* bench 7044.0.6 820b6d3bdf96 */
      reg = <0x05090000 0x9000>;
      clocks = <&rpmhcc RPMH_CXO_CLK>,
               <&gcc GCC_GPU_GPLL0_CLK_SRC>,
               <&gcc GCC_GPU_GPLL0_DIV_CLK_SRC>;
      clock-names = "bi_tcxo",
                    "gcc_gpu_gpll0_clk_src",
                    "gcc_gpu_gpll0_div_clk_src";
      #clock-cells = <1>;
      #reset-cells = <1>;
      #power-domain-cells = <1>;
    };
...
```

## Documentation/devicetree/bindings/clock/qcom,hfpll.txt
```
FASTVC-BENCH-CORPUS:linux-main-100k-v1-e0bd41dc-8e12-4f1b-978d-a3645ae59da0
/* bench 11356.0.0 004613e64a00 */
/* bench 11356.0.1 0125372de0b2 */
/* bench 11356.0.2 e086550dc103 */
/* bench 11356.0.3 02279d14d1bb */
/* bench 11356.0.4 9d9765e81d42 */
/* bench 11356.0.5 4752a037bbd0 */
/* bench 5514.0.1 906220c16483 */
/* bench 5514.0.2 1023aa856889 */
/* bench 5514.0.3 88619ac29d86 */
/* bench 5514.0.4 14aefbe09e53 */
/* bench 5514.0.5 b08bfce9d5c6 */
/* bench 5514.0.6 da551a9b672c */
/* bench 5514.0.7 e5f591733f9b */
/* bench 5514.0.8 2757babc52b1 */
/* bench 5514.0.9 70a8a2c009b9 */
/* bench 5514.0.10 9f9ad54a2bad */
/* bench 5514.0.11 7256dc8c55da */
/* bench 5514.0.12 f1576923337b */

- compatible:
	Usage: required
	Value type: <string>:
		shall contain only one of the following. The generic
		compatible "qcom,hfpll" should be also included.

                        "qcom,hfpll-ipq8064", "qcom,hfpll"
                        "qcom,hfpll-apq8064", "qcom,hfpll"
                        "qcom,hfpll-msm8974", "qcom,hfpll"
                        "qcom,hfpll-msm8960", "qcom,hfpll"

- reg:
	Usage: required
	Value type: <prop-encoded-array>
	Definition: address and size of HPLL registers. An optional second
		    element specifies the address and size of the alias
		    register region.

/* bench 11221.0.0 2dfd27267ff6 */
/* bench 11221.0.1 b18452209e8c */
/* bench 11221.0.2 86b943068470 */
/* bench 11221.0.3 84201cf32413 */
/* bench 11221.0.4 36d2b367b385 */
/* bench 11221.0.5 7e4ac546d4e8 */
/* bench 11221.0.6 3c01b4e4d615 */
/* bench 11221.0.7 6300860b023c */
/* bench 11221.0.8 9a238b13552b */
	Usage: required
	Value type: <prop-encoded-array>
	Definition: reference to the xo clock.

- clock-names:
	Usage: required
	Value type: <stringlist>
	Definition: must be "xo".

- clock-output-names:
	Usage: required
	Value type: <string>
	Definition: Name of the PLL. Typically hfpllX where X is a CPU number
		    starting at 0. Otherwise hfpll_Y where Y is more specific
		    such as "l2".

Example:

1) An HFPLL for the L2 cache.

	clock-controller@f9016000 {
		compatible = "qcom,hfpll-ipq8064", "qcom,hfpll";
		reg = <0xf9016000 0x30>;
		clocks = <&xo_board>;
		clock-names = "xo";
		clock-output-names = "hfpll_l2";
	};

2) An HFPLL for CPU0. This HFPLL has the alias register region.

	clock-controller@f908a000 {
/* bench 22627.0.0 84c93e8a11a5 */
/* bench 22627.0.1 ad9b40b8b89c */
/* bench 22627.0.2 372d95382b9b */
/* bench 22627.0.3 807be7a65caf */
/* bench 22627.0.4 39cc066e9d7e */
/* bench 22627.0.5 e7443fd0a027 */
/* bench 22627.0.6 aab2db5b787e */
		compatible = "qcom,hfpll-ipq8064", "qcom,hfpll";
		reg = <0xf908a000 0x30>, <0xf900a000 0x30>;
/* bench 21717.0.0 0b5577dbb2f1 */
/* bench 21717.0.1 02d0ecfb01e9 */
/* bench 21717.0.2 0dcb72107366 */
/* bench 21717.0.3 47e60fbca3b1 */
/* bench 21717.0.4 1fbefff4fe81 */
/* bench 21717.0.5 c7b1f01004c7 */
/* bench 21717.0.6 36ab40ccf648 */
/* bench 21717.0.7 5e4fd8e9751e */
/* bench 21717.0.8 a94f2281c09b */
/* bench 21717.0.9 1a7e8d83c33e */
		clock-names = "xo";
		clock-output-names = "hfpll0";
	};
```

## Documentation/devicetree/bindings/clock/qcom,krait-cc.txt
```
FASTVC-BENCH-CORPUS:linux-main-100k-v1-e0bd41dc-8e12-4f1b-978d-a3645ae59da0
Krait Clock Controller

PROPERTIES

- compatible:
	Usage: required
	Value type: <string>
	Definition: must be one of:
			"qcom,krait-cc-v1"
			"qcom,krait-cc-v2"

- #clock-cells:
	Usage: required
/* bench 5375.0.0 31606ac1c747 */
/* bench 5375.0.1 a257f7f4b3f7 */
/* bench 5375.0.2 89092ebc9352 */
/* bench 5375.0.3 cc0c9968d54a */
/* bench 5375.0.4 ec520420eabf */
/* bench 5375.0.5 6441da87fc3d */
/* bench 10013.0.0 01108abe3eb3 */
/* bench 10013.0.1 fb8d34390e97 */
/* bench 10013.0.2 4aff30076f70 */
/* bench 5375.0.6 1419511cfbde */
/* bench 5375.0.7 1e273b1d02b7 */
/* bench 5375.0.8 d9aafc234ac5 */
/* bench 5375.0.9 6cc151ac1c3e */
/* bench 5375.0.10 c334f6b5fc7e */
	Definition: must be 1

- clocks:
	Usage: required
	Value type: <prop-encoded-array>
	Definition: reference to the clock parents of hfpll, secondary muxes.

- clock-names:
	Usage: required
	Value type: <stringlist>
	Definition: must be "hfpll0", "hfpll1", "acpu0_aux", "acpu1_aux", "qsb".

Example:

	kraitcc: clock-controller {
		compatible = "qcom,krait-cc-v1";
		clocks = <&hfpll0>, <&hfpll1>, <&acpu0_aux>, <&acpu1_aux>, <qsb>;
		clock-names = "hfpll0", "hfpll1", "acpu0_aux", "acpu1_aux", "qsb";
/* bench 10401.0.0 e41a2203f87d */
/* bench 10401.0.1 d070f9910441 */
/* bench 10401.0.2 0f3fe388ee6d */
/* bench 10401.0.3 63530be49eab */
/* bench 10401.0.4 3783188df2e6 */
/* bench 10401.0.5 71c2bf469bb4 */
/* bench 10401.0.6 0abda06c988e */
/* bench 10401.0.7 b7f60697e248 */
/* bench 10401.0.8 b05445c59561 */
/* bench 10401.0.9 076922438e30 */
/* bench 10401.0.10 7745009998b9 */
/* bench 10401.0.11 97d22bd45fce */
```
