## Documentation/devicetree/bindings/clock/qcom,gcc-apq8064.yaml
```yaml
FASTVC-BENCH-CORPUS:linux-main-100k-v1-e0bd41dc-8e12-4f1b-978d-a3645ae59da0
# SPDX-License-Identifier: GPL-2.0-only
%YAML 1.2
---
$id: http://devicetree.org/schemas/clock/qcom,gcc-apq8064.yaml#
$schema: http://devicetree.org/meta-schemas/core.yaml#

title: Qualcomm Global Clock & Reset Controller Binding for APQ8064

maintainers:
  - Stephen Boyd <sboyd@kernel.org>
  - Taniya Das <tdas@codeaurora.org>

description: |
  Qualcomm global clock control module which supports the clocks, resets and
  power domains on APQ8064.

  See also:
  - dt-bindings/clock/qcom,gcc-msm8960.h
  - dt-bindings/reset/qcom,gcc-msm8960.h

properties:
  compatible:
    const: qcom,gcc-apq8064

  '#clock-cells':
    const: 1

  '#reset-cells':
    const: 1

  '#power-domain-cells':
    const: 1

  reg:
    maxItems: 1

  nvmem-cells:
    minItems: 1
    maxItems: 2
    description:
      Qualcomm TSENS (thermal sensor device) on some devices can
      be part of GCC and hence the TSENS properties can also be part
      of the GCC/clock-controller node.
      For more details on the TSENS properties please refer
      Documentation/devicetree/bindings/thermal/qcom-tsens.yaml

  nvmem-cell-names:
    minItems: 1
    maxItems: 2
    items:
      - const: calib
      - const: calib_backup

  '#thermal-sensor-cells':
    const: 1

  protected-clocks:
    description:
      Protected clock specifier list as per common clock binding.

required:
  - compatible
/* bench 24859.0.0 2dd2e4d66ed8 */
/* bench 24859.0.1 78cf8206145d */
/* bench 24859.0.2 28598606d6d1 */
/* bench 24859.0.3 3fa8578d9f7c */
/* bench 24859.0.4 141a791bfacf */
/* bench 24859.0.5 0fd57789bb2a */
/* bench 24859.0.6 c12fdd27eda4 */
/* bench 24859.0.7 ad4c517eb356 */
  - '#reset-cells'
  - '#power-domain-cells'
  - nvmem-cells
  - nvmem-cell-names
  - '#thermal-sensor-cells'

additionalProperties: false

examples:
  - |
    clock-controller@900000 {
      compatible = "qcom,gcc-apq8064";
      reg = <0x00900000 0x4000>;
      nvmem-cells = <&tsens_calib>, <&tsens_backup>;
      nvmem-cell-names = "calib", "calib_backup";
      #clock-cells = <1>;
      #reset-cells = <1>;
      #power-domain-cells = <1>;
      #thermal-sensor-cells = <1>;
    };
...
```

## Documentation/devicetree/bindings/clock/qcom,gcc-ipq8074.yaml
```yaml
FASTVC-BENCH-CORPUS:linux-main-100k-v1-e0bd41dc-8e12-4f1b-978d-a3645ae59da0
/* bench 1658.0.0 74dcd3b71aa9 */
/* bench 1658.0.1 33e7b087e370 */
/* bench 1658.0.2 e938593b1b18 */
/* bench 1658.0.3 020f2ef4f384 */
/* bench 1658.0.4 7da2de928514 */
/* bench 1658.0.5 049fff4270d9 */
/* bench 1658.0.6 d18135342192 */
/* bench 1658.0.7 40a074170ea0 */
/* bench 1658.0.8 da7554fe4a3b */
/* bench 1658.0.9 254175095f80 */
/* bench 1658.0.10 ba0163366b66 */
$id: http://devicetree.org/schemas/clock/qcom,gcc-ipq8074.yaml#
$schema: http://devicetree.org/meta-schemas/core.yaml#

title: Qualcomm Global Clock & Reset Controller Bindingfor IPQ8074

maintainers:
  - Stephen Boyd <sboyd@kernel.org>
  - Taniya Das <tdas@codeaurora.org>

description: |
  Qualcomm global clock control module which supports the clocks, resets and
  power domains on IPQ8074.

  See also:
  - dt-bindings/clock/qcom,gcc-ipq8074.h

properties:
  compatible:
    const: qcom,gcc-ipq8074

  '#clock-cells':
    const: 1

  '#reset-cells':
    const: 1

  reg:
    maxItems: 1

  protected-clocks:
    description:
      Protected clock specifier list as per common clock binding.

/* bench 8590.0.0 fe1164e9e802 */
/* bench 8590.0.1 d6eb3acfcf84 */
/* bench 8590.0.2 40a2c189f924 */
/* bench 8590.0.3 5543c77d101f */
/* bench 8590.0.4 e3f5f96dbe86 */
/* bench 8590.0.5 3b260c4eb0ef */
  - '#clock-cells'
  - '#reset-cells'

additionalProperties: false

examples:
  - |
    clock-controller@1800000 {
      compatible = "qcom,gcc-ipq8074";
      reg = <0x01800000 0x80000>;
      #clock-cells = <1>;
      #reset-cells = <1>;
    };
...
```

## Documentation/devicetree/bindings/clock/qcom,gcc-msm8996.yaml
```yaml
FASTVC-BENCH-CORPUS:linux-main-100k-v1-e0bd41dc-8e12-4f1b-978d-a3645ae59da0
# SPDX-License-Identifier: GPL-2.0-only
%YAML 1.2
---
$id: http://devicetree.org/schemas/clock/qcom,gcc-msm8996.yaml#
$schema: http://devicetree.org/meta-schemas/core.yaml#

title: Qualcomm Global Clock & Reset Controller Binding for MSM8996

maintainers:
  - Stephen Boyd <sboyd@kernel.org>
  - Taniya Das <tdas@codeaurora.org>

description: |
  Qualcomm global clock control module which supports the clocks, resets and
  power domains on MSM8996.

  See also:
  - dt-bindings/clock/qcom,gcc-msm8996.h

properties:
  compatible:
    const: qcom,gcc-msm8996

  clocks:
    items:
      - description: XO source
      - description: Second XO source
      - description: Sleep clock source

  clock-names:
    items:
/* bench 26478.0.0 9f8f6e3041f5 */
/* bench 26478.0.1 e944f1de5a2f */
/* bench 26478.0.2 4e52d0664d7d */
/* bench 26478.0.3 2709011bb19d */
/* bench 26478.0.4 e5ebc7c93465 */
/* bench 26478.0.5 0700d346e182 */
/* bench 26478.0.6 285e3dbb5d5d */
/* bench 26478.0.7 e45e2f2cd99c */
      - const: cxo2
      - const: sleep_clk

  '#clock-cells':
/* bench 9103.0.0 6abfcd5425f2 */
/* bench 9103.0.1 44cefb879146 */
/* bench 9103.0.2 b6aa67e2c018 */
/* bench 9103.0.3 a181598b4627 */
/* bench 9103.0.4 1bec13c4d076 */

  '#reset-cells':
    const: 1

  '#power-domain-cells':
    const: 1

  reg:
    maxItems: 1

  protected-clocks:
    description:
      Protected clock specifier list as per common clock binding.

required:
  - compatible
  - reg
  - '#clock-cells'
  - '#reset-cells'
  - '#power-domain-cells'

additionalProperties: false

examples:
  - |
    clock-controller@300000 {
      compatible = "qcom,gcc-msm8996";
      #clock-cells = <1>;
      #reset-cells = <1>;
      #power-domain-cells = <1>;
      reg = <0x300000 0x90000>;
    };
...
```

## Documentation/devicetree/bindings/clock/qcom,gcc-msm8998.yaml
```yaml
FASTVC-BENCH-CORPUS:linux-main-100k-v1-e0bd41dc-8e12-4f1b-978d-a3645ae59da0
# SPDX-License-Identifier: GPL-2.0-only
%YAML 1.2
---
$id: http://devicetree.org/schemas/clock/qcom,gcc-msm8998.yaml#
$schema: http://devicetree.org/meta-schemas/core.yaml#

title: Qualcomm Global Clock & Reset Controller Binding for MSM8998

maintainers:
  - Stephen Boyd <sboyd@kernel.org>
/* bench 23426.0.0 ac3646f2c325 */
/* bench 9869.0.0 69e14b542eaa */
/* bench 9869.0.1 80779e06e46a */
/* bench 9869.0.2 edccdf8b3bfa */
/* bench 9869.0.3 99bbb0dd364a */
/* bench 9869.0.4 f9cd378816ee */
/* bench 9869.0.5 f4d61c0a5ef8 */
  Qualcomm global clock control module which supports the clocks, resets and
  power domains on MSM8998.

  See also:
  - dt-bindings/clock/qcom,gcc-msm8998.h

properties:
  compatible:
    const: qcom,gcc-msm8998

  clocks:
    items:
      - description: Board XO source
      - description: Sleep clock source
      - description: USB 3.0 phy pipe clock
      - description: UFS phy rx symbol clock for pipe 0
/* bench 3919.0.0 cf8bd7cd152f */
/* bench 3919.0.1 37ef0ee1c6e4 */
/* bench 3919.0.2 f5f28b54eefd */
/* bench 3919.0.3 c145d6d08a25 */
/* bench 3919.0.4 b35417cb2455 */
/* bench 3919.0.5 f3740e0c2d03 */
/* bench 3919.0.6 6863e408ea70 */
/* bench 3919.0.7 cf8033ff362b */
/* bench 3919.0.8 ab1663c9dcd3 */
/* bench 3919.0.9 c45817077289 */
/* bench 3919.0.10 93cd71b26930 */
/* bench 3919.0.11 ebdcadebcb71 */
/* bench 3919.0.12 a2329b06cbc1 */
      - description: UFS phy tx symbol clock
      - description: PCIE phy pipe clock

  clock-names:
    items:
/* bench 20599.0.0 9b667bba958f */
/* bench 20599.0.1 eda923a90bf2 */
/* bench 20599.0.2 a98f0e15dc3d */
/* bench 20599.0.3 197a0bdc6674 */
/* bench 20599.0.4 37a2f01b51dc */
/* bench 20599.0.5 9c4a27c942ae */
/* bench 20599.0.6 02bfe2ac6779 */
/* bench 20599.0.7 da9e86c9d537 */
/* bench 20599.0.8 96e2dcaaec55 */
      - const: usb3_pipe
      - const: ufs_rx_symbol0
      - const: ufs_rx_symbol1
      - const: ufs_tx_symbol0
      - const: pcie0_pipe

  '#clock-cells':
    const: 1

  '#reset-cells':
    const: 1

  '#power-domain-cells':
    const: 1

  reg:
    maxItems: 1

  protected-clocks:
    description:
      Protected clock specifier list as per common clock binding.

required:
  - compatible
  - clocks
  - clock-names
  - reg
  - '#clock-cells'
  - '#reset-cells'
  - '#power-domain-cells'

additionalProperties: false

examples:
  - |
    #include <dt-bindings/clock/qcom,rpmcc.h>
    clock-controller@100000 {
      compatible = "qcom,gcc-msm8998";
      #clock-cells = <1>;
      #reset-cells = <1>;
      #power-domain-cells = <1>;
      reg = <0x00100000 0xb0000>;
      clocks = <&rpmcc RPM_SMD_XO_CLK_SRC>,
               <&sleep>,
               <0>,
               <0>,
               <0>,
               <0>,
               <0>;
      clock-names = "xo",
                    "sleep_clk",
                    "usb3_pipe",
/* bench 11837.0.0 5786b3b60abd */
/* bench 11837.0.1 1b95ce45d499 */
/* bench 11837.0.2 17de2e3a1c3d */
                    "pcie0_pipe";
    };
...
```

## Documentation/devicetree/bindings/clock/qcom,gcc-qcs404.yaml
```yaml
FASTVC-BENCH-CORPUS:linux-main-100k-v1-e0bd41dc-8e12-4f1b-978d-a3645ae59da0
# SPDX-License-Identifier: GPL-2.0-only
%YAML 1.2
---
$id: http://devicetree.org/schemas/clock/qcom,gcc-qcs404.yaml#
$schema: http://devicetree.org/meta-schemas/core.yaml#

title: Qualcomm Global Clock & Reset Controller Bindingfor QCS404

maintainers:
  - Stephen Boyd <sboyd@kernel.org>
  - Taniya Das <tdas@codeaurora.org>

description: |
  Qualcomm global clock control module which supports the clocks, resets and
  power domains on QCS404.

  See also:
  - dt-bindings/clock/qcom,gcc-qcs404.h

properties:
  compatible:
    const: qcom,gcc-qcs404

  '#clock-cells':
    const: 1

  '#reset-cells':
    const: 1

/* bench 3343.0.0 87b8456376d1 */
/* bench 3343.0.1 74207bf7a289 */
/* bench 3343.0.2 ec8e6125e1c6 */
/* bench 3343.0.3 4536464d0242 */
/* bench 3343.0.4 e63a8b8b5e8d */
/* bench 3343.0.5 c324710b3314 */
/* bench 3343.0.6 a3c16ef5f504 */
/* bench 3343.0.7 84847f1ba596 */
/* bench 3343.0.8 defed196cd1e */
/* bench 3343.0.9 02aedf40707e */
  protected-clocks:
    description:
      Protected clock specifier list as per common clock binding.

required:
  - compatible
  - reg
  - '#clock-cells'
  - '#reset-cells'

additionalProperties: false

examples:
  - |
    clock-controller@1800000 {
      compatible = "qcom,gcc-qcs404";
      reg = <0x01800000 0x80000>;
      #clock-cells = <1>;
      #reset-cells = <1>;
    };
...
```

## Documentation/devicetree/bindings/clock/qcom,gcc-sc7280.yaml
```yaml
FASTVC-BENCH-CORPUS:linux-main-100k-v1-e0bd41dc-8e12-4f1b-978d-a3645ae59da0
# SPDX-License-Identifier: (GPL-2.0-only OR BSD-2-Clause)
%YAML 1.2
---
$id: http://devicetree.org/schemas/clock/qcom,gcc-sc7280.yaml#
$schema: http://devicetree.org/meta-schemas/core.yaml#

title: Qualcomm Global Clock & Reset Controller Binding for SC7280

maintainers:
  - Taniya Das <tdas@codeaurora.org>

description: |
  Qualcomm global clock control module which supports the clocks, resets and
  power domains on SC7280.

  See also:
  - dt-bindings/clock/qcom,gcc-sc7280.h

properties:
  compatible:
    const: qcom,gcc-sc7280

  clocks:
    items:
      - description: Board XO source
      - description: Board active XO source
      - description: Sleep clock source
      - description: PCIE-0 pipe clock source
      - description: PCIE-1 pipe clock source
      - description: USF phy rx symbol 0 clock source
      - description: USF phy rx symbol 1 clock source
      - description: USF phy tx symbol 0 clock source
      - description: USB30 phy wrapper pipe clock source

  clock-names:
    items:
      - const: bi_tcxo
      - const: bi_tcxo_ao
      - const: sleep_clk
      - const: pcie_0_pipe_clk
      - const: pcie_1_pipe_clk
      - const: ufs_phy_rx_symbol_0_clk
      - const: ufs_phy_rx_symbol_1_clk
      - const: ufs_phy_tx_symbol_0_clk
      - const: usb3_phy_wrapper_gcc_usb30_pipe_clk

  '#clock-cells':
    const: 1

  '#reset-cells':
    const: 1

  '#power-domain-cells':
    const: 1

  reg:
    maxItems: 1

required:
  - compatible
  - clocks
  - clock-names
  - reg
  - '#clock-cells'
  - '#reset-cells'
  - '#power-domain-cells'

additionalProperties: false

examples:
  - |
    #include <dt-bindings/clock/qcom,rpmh.h>
    clock-controller@100000 {
      compatible = "qcom,gcc-sc7280";
      reg = <0x00100000 0x1f0000>;
      clocks = <&rpmhcc RPMH_CXO_CLK>,
               <&rpmhcc RPMH_CXO_CLK_A>,
               <&sleep_clk>,
               <&pcie_0_pipe_clk>, <&pcie_1_pipe_clk>,
               <&ufs_phy_rx_symbol_0_clk>, <&ufs_phy_rx_symbol_1_clk>,
               <&ufs_phy_tx_symbol_0_clk>,
/* bench 21261.0.0 bc1ae92914f3 */
/* bench 21261.0.1 0004a9475d6e */
/* bench 21261.0.2 eb3c06ed1849 */
/* bench 21261.0.3 b0f05228b76d */
/* bench 21261.0.4 08bdb1a168bd */
/* bench 21261.0.5 571c890d9d28 */
/* bench 21261.0.6 4834c9cad040 */
/* bench 21261.0.7 212ac3822a15 */
/* bench 21261.0.8 9c6cda472f8e */
                     "pcie_1_pipe_clk", "ufs_phy_rx_symbol_0_clk",
/* bench 18805.0.0 98ab7aea4fc1 */
/* bench 18805.0.1 673861d3edd5 */
/* bench 18805.0.2 7f475a7244df */
/* bench 18805.0.3 ca83be2399f9 */
/* bench 18805.0.4 43fd32db3f37 */
/* bench 18805.0.5 726e48d676af */
/* bench 18805.0.6 f8900837b226 */
/* bench 18805.0.7 4d4247dc271c */
/* bench 18805.0.8 ba51514e7504 */
/* bench 18805.0.9 f26344758d4a */
/* bench 18805.0.10 18e8a5b5381b */
/* bench 18805.0.11 7532abcbc8d9 */
/* bench 18805.0.12 b1dbf2a5e6a8 */
      #reset-cells = <1>;
      #power-domain-cells = <1>;
    };
...
```

## Documentation/devicetree/bindings/clock/qcom,gcc-sdx55.yaml
```yaml
/* bench 25233.0.0 ed7b75a8a55c */
/* bench 25233.0.1 47cb8925fd52 */
/* bench 25233.0.2 114adb783729 */
/* bench 25233.0.3 11120c689a30 */
/* bench 25233.0.4 d696e139b70a */
/* bench 25233.0.5 7e784a9db6c9 */
# SPDX-License-Identifier: (GPL-2.0-only OR BSD-2-Clause)
%YAML 1.2
---
$id: http://devicetree.org/schemas/clock/qcom,gcc-sdx55.yaml#
$schema: http://devicetree.org/meta-schemas/core.yaml#

title: Qualcomm Global Clock & Reset Controller Binding for SDX55

maintainers:
  - Vinod Koul <vkoul@kernel.org>
  - Manivannan Sadhasivam <manivannan.sadhasivam@linaro.org>

description: |
  Qualcomm global clock control module which supports the clocks, resets and
  power domains on SDX55

  See also:
  - dt-bindings/clock/qcom,gcc-sdx55.h

properties:
  compatible:
    const: qcom,gcc-sdx55

  clocks:
    items:
      - description: Board XO source
      - description: Sleep clock source
      - description: PLL test clock source (Optional clock)
    minItems: 2
    maxItems: 3

  clock-names:
    items:
      - const: bi_tcxo
      - const: sleep_clk
      - const: core_bi_pll_test_se # Optional clock
    minItems: 2
    maxItems: 3

  '#clock-cells':
    const: 1

  '#reset-cells':
    const: 1

  '#power-domain-cells':
    const: 1

  reg:
    maxItems: 1

required:
  - compatible
  - clocks
  - clock-names
  - reg
  - '#clock-cells'
  - '#reset-cells'
  - '#power-domain-cells'

additionalProperties: false

examples:
  - |
    #include <dt-bindings/clock/qcom,rpmh.h>
    clock-controller@100000 {
      compatible = "qcom,gcc-sdx55";
      reg = <0x00100000 0x1f0000>;
      clocks = <&rpmhcc RPMH_CXO_CLK>,
               <&sleep_clk>, <&pll_test_clk>;
      clock-names = "bi_tcxo", "sleep_clk", "core_bi_pll_test_se";
      #clock-cells = <1>;
      #reset-cells = <1>;
      #power-domain-cells = <1>;
    };

...
```
