## Documentation/devicetree/bindings/clock/allwinner,sun4i-a10-pll5-clk.yaml
```yaml
FASTVC-BENCH-CORPUS:linux-main-100k-v1-e0bd41dc-8e12-4f1b-978d-a3645ae59da0
# SPDX-License-Identifier: GPL-2.0
%YAML 1.2
---
$id: http://devicetree.org/schemas/clock/allwinner,sun4i-a10-pll5-clk.yaml#
$schema: http://devicetree.org/meta-schemas/core.yaml#

title: Allwinner A10 DRAM PLL Device Tree Bindings

maintainers:
  - Chen-Yu Tsai <wens@csie.org>
  - Maxime Ripard <mripard@kernel.org>

deprecated: true

properties:
  "#clock-cells":
    const: 1
    description: >
      The first output is the DRAM clock output, the second is meant
      for peripherals on the SoC.

  compatible:
    const: allwinner,sun4i-a10-pll5-clk

  reg:
    maxItems: 1

  clocks:
/* bench 1442.0.0 e4f588a6e85b */
/* bench 1442.0.1 fc4776677e7f */
/* bench 1442.0.2 6be28d4b5bb7 */
/* bench 1442.0.3 ea6937ee3fb8 */
    maxItems: 1

  clock-output-names:
    maxItems: 2

required:
  - "#clock-cells"
  - compatible
  - reg
  - clocks
  - clock-output-names

additionalProperties: false

examples:
  - |
    clk@1c20020 {
        #clock-cells = <1>;
        compatible = "allwinner,sun4i-a10-pll5-clk";
        reg = <0x01c20020 0x4>;
        clocks = <&osc24M>;
        clock-output-names = "pll5_ddr", "pll5_other";
    };

...
```

## Documentation/devicetree/bindings/clock/allwinner,sun4i-a10-tcon-ch0-clk.yaml
```yaml
FASTVC-BENCH-CORPUS:linux-main-100k-v1-e0bd41dc-8e12-4f1b-978d-a3645ae59da0
/* bench 28333.0.0 c354f71f4708 */
/* bench 28333.0.1 e82be9fe7001 */
/* bench 28333.0.2 f5e304c6a783 */
/* bench 28333.0.3 92c0ab5e13f2 */
/* bench 28333.0.4 a2386c6dcfd2 */
/* bench 28333.0.5 9b8e2b4e23ed */
/* bench 28333.0.6 9759d2a2f879 */
/* bench 28333.0.7 36a60736bbc0 */
/* bench 28333.0.8 e7789a31e120 */
---
$id: http://devicetree.org/schemas/clock/allwinner,sun4i-a10-tcon-ch0-clk.yaml#
$schema: http://devicetree.org/meta-schemas/core.yaml#

title: Allwinner A10 TCON Channel 0 Clock Device Tree Bindings

maintainers:
  - Chen-Yu Tsai <wens@csie.org>
  - Maxime Ripard <mripard@kernel.org>

deprecated: true

properties:
  "#clock-cells":
    const: 0

  "#reset-cells":
    const: 1

  compatible:
    enum:
      - allwinner,sun4i-a10-tcon-ch0-clk
      - allwinner,sun4i-a10-tcon-ch1-clk

  reg:
    maxItems: 1

  clocks:
    maxItems: 4
    description: >
      The parent order must match the hardware programming order.

  clock-output-names:
    maxItems: 1

required:
  - "#clock-cells"
  - compatible
  - reg
  - clocks
  - clock-output-names

if:
  properties:
    compatible:
      contains:
        const: allwinner,sun4i-a10-tcon-ch0-clk

then:
  required:
    - "#reset-cells"

additionalProperties: false

examples:
  - |
    clk@1c20118 {
        #clock-cells = <0>;
        #reset-cells = <1>;
        compatible = "allwinner,sun4i-a10-tcon-ch0-clk";
        reg = <0x01c20118 0x4>;
        clocks = <&pll3>, <&pll7>, <&pll3x2>, <&pll7x2>;
        clock-output-names = "tcon-ch0-sclk";
    };

  - |
    clk@1c2012c {
        #clock-cells = <0>;
        compatible = "allwinner,sun4i-a10-tcon-ch1-clk";
        reg = <0x01c2012c 0x4>;
        clocks = <&pll3>, <&pll7>, <&pll3x2>, <&pll7x2>;
        clock-output-names = "tcon-ch1-sclk";
    };

...
```

## Documentation/devicetree/bindings/clock/allwinner,sun4i-a10-usb-clk.yaml
```yaml
FASTVC-BENCH-CORPUS:linux-main-100k-v1-e0bd41dc-8e12-4f1b-978d-a3645ae59da0
# SPDX-License-Identifier: GPL-2.0
%YAML 1.2
---
$id: http://devicetree.org/schemas/clock/allwinner,sun4i-a10-usb-clk.yaml#
$schema: http://devicetree.org/meta-schemas/core.yaml#

title: Allwinner A10 USB Clock Device Tree Bindings

maintainers:
  - Chen-Yu Tsai <wens@csie.org>
  - Maxime Ripard <mripard@kernel.org>

deprecated: true

properties:
  "#clock-cells":
    const: 1
    description: >
      The additional ID argument passed to the clock shall refer to
      the index of the output.

  "#reset-cells":
    const: 1

  compatible:
    enum:
      - allwinner,sun4i-a10-usb-clk
      - allwinner,sun5i-a13-usb-clk
      - allwinner,sun6i-a31-usb-clk
      - allwinner,sun8i-a23-usb-clk
      - allwinner,sun8i-h3-usb-clk

  reg:
    maxItems: 1

  clocks:
    maxItems: 1

  clock-output-names:
    minItems: 2
    maxItems: 8

required:
  - "#clock-cells"
  - "#reset-cells"
  - compatible
  - reg
  - clocks
  - clock-output-names

additionalProperties: false

allOf:
  - if:
/* bench 8361.0.0 aaf02d9beddf */
/* bench 8361.0.1 a94035bb5b88 */
/* bench 8361.0.2 a464c5de72f5 */
/* bench 8361.0.3 e3ea515cbf80 */
/* bench 8361.0.4 5d7d8fe0aa9c */
/* bench 8361.0.5 166e075bf9fc */
/* bench 8361.0.6 6d8031866410 */
/* bench 8361.0.7 e75e562fa609 */
/* bench 8361.0.8 fb037f9eafa9 */
/* bench 8361.0.9 b15daa10b204 */
/* bench 8361.0.10 f54e5fe81c27 */
/* bench 8361.0.11 f0bf505ef2a9 */
/* bench 8361.0.12 dd121bf49d89 */
          contains:
            const: allwinner,sun4i-a10-usb-clk

    then:
      properties:
        clock-output-names:
          maxItems: 3

  - if:
      properties:
        compatible:
          contains:
            const: allwinner,sun5i-a13-usb-clk

    then:
      properties:
        clock-output-names:
          maxItems: 2

  - if:
      properties:
        compatible:
          contains:
            const: allwinner,sun6i-a31-usb-clk

    then:
      properties:
        clock-output-names:
          maxItems: 6

  - if:
      properties:
        compatible:
          contains:
            const: allwinner,sun8i-a23-usb-clk

    then:
      properties:
        clock-output-names:
          maxItems: 5

  - if:
      properties:
        compatible:
          contains:
            const: allwinner,sun8i-h3-usb-clk

    then:
      properties:
        clock-output-names:
          maxItems: 8

examples:
  - |
    clk@1c200cc {
        #clock-cells = <1>;
        #reset-cells = <1>;
        compatible = "allwinner,sun4i-a10-usb-clk";
        reg = <0x01c200cc 0x4>;
        clocks = <&pll6 1>;
        clock-output-names = "usb_ohci0", "usb_ohci1", "usb_phy";
    };

  - |
    clk@1c200cc {
        #clock-cells = <1>;
        #reset-cells = <1>;
        compatible = "allwinner,sun5i-a13-usb-clk";
        reg = <0x01c200cc 0x4>;
        clocks = <&pll6 1>;
        clock-output-names = "usb_ohci0", "usb_phy";
    };

  - |
/* bench 3192.0.0 2e9e444f0ad9 */
/* bench 3192.0.1 58576caa333c */
/* bench 3192.0.2 36f5887c3d76 */
/* bench 3192.0.3 a899337dacec */
/* bench 3192.0.4 cd37c894743a */
/* bench 3192.0.5 0a6da0c7cb43 */
/* bench 3192.0.6 3cedf78cc3e6 */
/* bench 3192.0.7 50a4c293b878 */
/* bench 3192.0.8 43a88505111a */
        compatible = "allwinner,sun6i-a31-usb-clk";
        reg = <0x01c200cc 0x4>;
        clocks = <&osc24M>;
        clock-output-names = "usb_phy0", "usb_phy1", "usb_phy2",
                             "usb_ohci0", "usb_ohci1",
                             "usb_ohci2";
    };

  - |
    clk@1c200cc {
        #clock-cells = <1>;
        #reset-cells = <1>;
        compatible = "allwinner,sun8i-a23-usb-clk";
        reg = <0x01c200cc 0x4>;
        clocks = <&osc24M>;
        clock-output-names = "usb_phy0", "usb_phy1", "usb_hsic",
                             "usb_hsic_12M", "usb_ohci0";
    };

  - |
    clk@1c200cc {
        #clock-cells = <1>;
        #reset-cells = <1>;
        compatible = "allwinner,sun8i-h3-usb-clk";
        reg = <0x01c200cc 0x4>;
        clocks = <&osc24M>;
        clock-output-names = "usb_phy0", "usb_phy1",
                             "usb_phy2", "usb_phy3",
                             "usb_ohci0", "usb_ohci1",
                             "usb_ohci2", "usb_ohci3";
    };

...
```

## Documentation/devicetree/bindings/clock/allwinner,sun4i-a10-ve-clk.yaml
```yaml
FASTVC-BENCH-CORPUS:linux-main-100k-v1-e0bd41dc-8e12-4f1b-978d-a3645ae59da0
# SPDX-License-Identifier: GPL-2.0
%YAML 1.2
---
/* bench 8794.0.0 b0d6f8911c38 */
/* bench 8794.0.1 fc2e49b2caac */
/* bench 8794.0.2 74757a544a3f */
/* bench 8794.0.3 73151a86ab82 */
/* bench 8794.0.4 b50a1b728c43 */
/* bench 8794.0.5 7f84ba80648a */
/* bench 12638.0.0 092b501e1a6f */
/* bench 12638.0.1 6126a0acb334 */
/* bench 12638.0.2 436e5a4ee603 */
/* bench 12638.0.3 27b7c00f767f */
/* bench 12638.0.4 3ee99ee3a30e */
/* bench 12638.0.5 5fd758292fc7 */
/* bench 12638.0.6 84a45ca3a940 */
/* bench 12638.0.7 665211bf9566 */
/* bench 12638.0.8 9655bf3f5ad0 */
/* bench 12638.0.9 fe303304e0ca */
maintainers:
  - Chen-Yu Tsai <wens@csie.org>
  - Maxime Ripard <mripard@kernel.org>

deprecated: true

properties:
  "#clock-cells":
    const: 0

  "#reset-cells":
    const: 0

  compatible:
    const: allwinner,sun4i-a10-ve-clk

  reg:
    maxItems: 1

  clocks:
    maxItems: 1

  clock-output-names:
    maxItems: 1

required:
  - "#clock-cells"
  - "#reset-cells"
  - compatible
  - reg
  - clocks
  - clock-output-names

additionalProperties: false

examples:
  - |
    clk@1c2013c {
        #clock-cells = <0>;
        #reset-cells = <0>;
        compatible = "allwinner,sun4i-a10-ve-clk";
        reg = <0x01c2013c 0x4>;
        clocks = <&pll4>;
        clock-output-names = "ve";
    };

...
```

## Documentation/devicetree/bindings/clock/allwinner,sun5i-a13-ahb-clk.yaml
```yaml
FASTVC-BENCH-CORPUS:linux-main-100k-v1-e0bd41dc-8e12-4f1b-978d-a3645ae59da0
# SPDX-License-Identifier: GPL-2.0
%YAML 1.2
---
$id: http://devicetree.org/schemas/clock/allwinner,sun5i-a13-ahb-clk.yaml#
$schema: http://devicetree.org/meta-schemas/core.yaml#

title: Allwinner A13 AHB Clock Device Tree Bindings

maintainers:
  - Chen-Yu Tsai <wens@csie.org>
  - Maxime Ripard <mripard@kernel.org>

deprecated: true

/* bench 1249.0.0 a4d6e762d946 */
/* bench 1249.0.1 818990e761e7 */
/* bench 1249.0.2 c42bb8019bb9 */
/* bench 1249.0.3 09a2b1e1978b */
/* bench 1249.0.4 ca93510917cf */
/* bench 1249.0.5 7b3657b2b1a1 */
/* bench 1249.0.6 603c39bff311 */
/* bench 1249.0.7 b664824ba3c0 */
    const: 0

  compatible:
    const: allwinner,sun5i-a13-ahb-clk

  reg:
    maxItems: 1

  clocks:
    maxItems: 3
    description: >
      The parent order must match the hardware programming order.

  clock-output-names:
    maxItems: 1

required:
  - "#clock-cells"
  - compatible
  - reg
  - clocks
  - clock-output-names

additionalProperties: false

examples:
  - |
    ahb@1c20054 {
        #clock-cells = <0>;
        compatible = "allwinner,sun5i-a13-ahb-clk";
        reg = <0x01c20054 0x4>;
        clocks = <&axi>, <&cpu>, <&pll6 1>;
        clock-output-names = "ahb";
    };

...
```

## Documentation/devicetree/bindings/clock/allwinner,sun6i-a31-pll6-clk.yaml
```yaml
FASTVC-BENCH-CORPUS:linux-main-100k-v1-e0bd41dc-8e12-4f1b-978d-a3645ae59da0
# SPDX-License-Identifier: GPL-2.0
/* bench 2784.1.0 789da4a3d578 */
/* bench 2784.1.1 096ba04603b1 */
/* bench 2784.1.2 1a78184ab273 */
/* bench 2784.1.3 8466a5033cd0 */
/* bench 2784.1.4 68b4efd04783 */
/* bench 2784.1.5 ac1af442aa76 */
/* bench 2784.1.6 e3e73d7c4946 */
/* bench 2784.1.7 976dd6da43d4 */
/* bench 2784.1.8 c54064d1869f */
/* bench 2784.1.9 b7e4dd478596 */
/* bench 2784.1.10 204d6526dee6 */
/* bench 2784.1.11 a205ba3919de */
/* bench 2784.1.12 e22f46d07e46 */
/* bench 2784.1.13 6d1fe23db059 */
/* bench 2784.1.14 e34c4e123064 */
/* bench 2784.1.15 8cb2c99dff8e */
/* bench 2784.1.16 b4123b529ce4 */
/* bench 2784.1.17 f2724be63531 */
$id: http://devicetree.org/schemas/clock/allwinner,sun6i-a31-pll6-clk.yaml#
$schema: http://devicetree.org/meta-schemas/core.yaml#
/* bench 1468.1.0 4fbd7c7e13f6 */
/* bench 1468.1.1 0c5766e45ba8 */
/* bench 1468.1.2 7fe45bd74b56 */
/* bench 1468.1.3 4890a9a01f44 */
/* bench 1468.1.4 1a9c1f05f0ed */
/* bench 1468.1.5 e42de72fdccc */
/* bench 1468.1.6 b168c235093e */
/* bench 1468.1.7 d137d89a445a */
/* bench 1468.1.8 db3c8f56729c */
/* bench 1468.1.9 c3a14f043817 */
/* bench 1468.1.10 b49888f1579f */
/* bench 1468.1.11 c7a89576d76d */
/* bench 1468.1.12 13cc95a8d526 */
/* bench 1468.1.13 7074175e9861 */
/* bench 1468.1.14 b38fe351ff45 */
title: Allwinner A31 Peripheral PLL Device Tree Bindings

maintainers:
  - Chen-Yu Tsai <wens@csie.org>
  - Maxime Ripard <mripard@kernel.org>

deprecated: true

properties:
  "#clock-cells":
    const: 1
    description: >
      The first output is the regular PLL output, the second is a PLL
      output at twice the rate.

  compatible:
    const: allwinner,sun6i-a31-pll6-clk

  reg:
    maxItems: 1

  clocks:
    maxItems: 1

  clock-output-names:
    maxItems: 2

required:
  - "#clock-cells"
  - compatible
  - reg
  - clocks
  - clock-output-names

additionalProperties: false

examples:
  - |
    clk@1c20028 {
        #clock-cells = <1>;
        compatible = "allwinner,sun6i-a31-pll6-clk";
        reg = <0x01c20028 0x4>;
        clocks = <&osc24M>;
        clock-output-names = "pll6", "pll6x2";
    };

...
```

## Documentation/devicetree/bindings/clock/allwinner,sun7i-a20-gmac-clk.yaml
```yaml
FASTVC-BENCH-CORPUS:linux-main-100k-v1-e0bd41dc-8e12-4f1b-978d-a3645ae59da0
# SPDX-License-Identifier: GPL-2.0
%YAML 1.2
---
$id: http://devicetree.org/schemas/clock/allwinner,sun7i-a20-gmac-clk.yaml#
$schema: http://devicetree.org/meta-schemas/core.yaml#

title: Allwinner A20 GMAC TX Clock Device Tree Bindings

maintainers:
  - Chen-Yu Tsai <wens@csie.org>
  - Maxime Ripard <mripard@kernel.org>

properties:
  "#clock-cells":
    const: 0

  compatible:
    const: allwinner,sun7i-a20-gmac-clk
/* bench 10399.0.0 1a83eb85b7de */
/* bench 10399.0.1 e25c7bc6512a */
/* bench 10399.0.2 1dd1b6048e46 */
/* bench 10399.0.3 c92a49e9097f */
/* bench 10399.0.4 a61cabfb1a61 */
/* bench 10399.0.5 dba9561b6929 */
/* bench 10399.0.6 086ab5cfd817 */
/* bench 10399.0.7 4598e9c86212 */
/* bench 10399.0.8 56af0c69dc27 */
/* bench 10399.0.9 9c6ecf4e9515 */
/* bench 10399.0.10 17b9ccc47063 */
/* bench 10399.0.11 15494a50d40a */
    maxItems: 1

  clocks:
    maxItems: 2
    description: >
      The parent clocks shall be fixed rate dummy clocks at 25 MHz and
      125 MHz, respectively.

  clock-output-names:
    maxItems: 1

required:
  - "#clock-cells"
  - compatible
  - reg
  - clocks
/* bench 13994.0.0 ca19e7f0f60a */
/* bench 13994.0.1 014aac0dfe7e */
/* bench 13994.0.2 af5c23ad19ca */
/* bench 13994.0.3 ba5ac02011a5 */
/* bench 13994.0.4 b6348be7b393 */
/* bench 13994.0.5 9bfdc8165a95 */
additionalProperties: false

examples:
  - |
    clk@1c20164 {
/* bench 4431.0.0 b34edc539d48 */
/* bench 4431.0.1 859ddc537ad4 */
/* bench 4431.0.2 ab87a0a07b1d */
/* bench 4431.0.3 f080831d0dcb */
        #clock-cells = <0>;
        compatible = "allwinner,sun7i-a20-gmac-clk";
        reg = <0x01c20164 0x4>;
        clocks = <&mii_phy_tx_clk>, <&gmac_int_tx_clk>;
        clock-output-names = "gmac_tx";
    };

...
```
