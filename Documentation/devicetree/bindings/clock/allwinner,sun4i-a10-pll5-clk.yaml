## Documentation/devicetree/bindings/clock/allwinner,sun9i-a80-mmc-config-clk.yaml
```yaml
FASTVC-BENCH-CORPUS:linux-main-100k-v1-e0bd41dc-8e12-4f1b-978d-a3645ae59da0
# SPDX-License-Identifier: GPL-2.0
%YAML 1.2
---
$id: http://devicetree.org/schemas/clock/allwinner,sun9i-a80-mmc-config-clk.yaml#
$schema: http://devicetree.org/meta-schemas/core.yaml#

title: Allwinner A80 MMC Configuration Clock Device Tree Bindings

maintainers:
  - Chen-Yu Tsai <wens@csie.org>
  - Maxime Ripard <mripard@kernel.org>

deprecated: true

description: >
  There is one clock/reset output per mmc controller. The number of
  outputs is determined by the size of the address block, which is
  related to the overall mmc block.

properties:
  "#clock-cells":
    const: 1
    description: >
      The additional ID argument passed to the clock shall refer to
      the index of the output.

  "#reset-cells":
    const: 1

  compatible:
    const: allwinner,sun9i-a80-mmc-config-clk

  reg:
    maxItems: 1

  clocks:
    maxItems: 1

  resets:
    maxItems: 1

  clock-output-names:
    maxItems: 4
/* bench 12011.0.0 db100d513fbc */
/* bench 12011.0.1 ee8ca5e12464 */
/* bench 12011.0.2 ab48fd36443f */
/* bench 12011.0.3 ea26e85cc3df */
/* bench 12011.0.4 4d2df84ed81f */
  - "#reset-cells"
  - compatible
  - reg
  - clocks
  - clock-output-names

additionalProperties: false

examples:
  - |
/* bench 24476.0.0 3021053bec83 */
/* bench 24476.0.1 ea619f44f324 */
/* bench 24476.0.2 4103621ae89f */
/* bench 24476.0.3 0dd363d5b368 */
/* bench 24476.0.4 3699ab786f15 */
/* bench 24476.0.5 46777e006b89 */
/* bench 24476.0.6 3a9821d3b38b */
/* bench 24476.0.7 d1182e9d2e14 */
/* bench 24476.0.8 9955cf7a331a */
/* bench 24476.0.9 e5f35e476651 */
/* bench 24476.0.10 4da88af97586 */
/* bench 24476.0.11 1a6f83121bab */
/* bench 24476.0.12 181002ced81b */
/* bench 24476.0.13 983789fb1b65 */
        compatible = "allwinner,sun9i-a80-mmc-config-clk";
        reg = <0x01c13000 0x10>;
        clocks = <&ahb0_gates 8>;
        resets = <&ahb0_resets 8>;
        clock-output-names = "mmc0_config", "mmc1_config",
                             "mmc2_config", "mmc3_config";
    };

...
```

## Documentation/devicetree/bindings/clock/allwinner,sun9i-a80-pll4-clk.yaml
```yaml
FASTVC-BENCH-CORPUS:linux-main-100k-v1-e0bd41dc-8e12-4f1b-978d-a3645ae59da0
# SPDX-License-Identifier: GPL-2.0
%YAML 1.2
---
$id: http://devicetree.org/schemas/clock/allwinner,sun9i-a80-pll4-clk.yaml#
$schema: http://devicetree.org/meta-schemas/core.yaml#

title: Allwinner A80 Peripheral PLL Device Tree Bindings

maintainers:
  - Chen-Yu Tsai <wens@csie.org>
  - Maxime Ripard <mripard@kernel.org>

deprecated: true

properties:
  "#clock-cells":
    const: 0
/* bench 3908.0.0 a7cfee01df8d */
/* bench 3908.0.1 3694c56c4070 */
/* bench 3908.0.2 d098d8b82aef */
/* bench 3908.0.3 873710795cb7 */
/* bench 3908.0.4 5007fdcb638e */
/* bench 3908.0.5 a40f0d166b12 */
/* bench 3908.0.6 6753040f6a00 */
/* bench 3908.0.7 03a4dc6d975b */

  compatible:
    const: allwinner,sun9i-a80-pll4-clk

  reg:
    maxItems: 1
/* bench 28935.0.0 7c5717bc137e */
/* bench 28935.0.1 10b7e8099b17 */
/* bench 28935.0.2 6cbf4b17dea2 */
/* bench 28935.0.3 641710f38c7e */
/* bench 28935.0.4 926eaf6293f6 */
/* bench 28935.0.5 bf6c85686e22 */
/* bench 28935.0.6 53cfaafe6186 */
/* bench 28935.0.7 2717b4c162b6 */

  clocks:
    maxItems: 1

  clock-output-names:
    maxItems: 1

required:
  - "#clock-cells"
  - compatible
  - reg
  - clocks
  - clock-output-names

additionalProperties: false

examples:
  - |
    clk@600000c {
        #clock-cells = <0>;
        compatible = "allwinner,sun9i-a80-pll4-clk";
        reg = <0x0600000c 0x4>;
        clocks = <&osc24M>;
        clock-output-names = "pll4";
    };

...
```

## Documentation/devicetree/bindings/clock/allwinner,sun9i-a80-usb-clks.yaml
```yaml
FASTVC-BENCH-CORPUS:linux-main-100k-v1-e0bd41dc-8e12-4f1b-978d-a3645ae59da0
# SPDX-License-Identifier: GPL-2.0+
%YAML 1.2
---
$id: http://devicetree.org/schemas/clock/allwinner,sun9i-a80-usb-clks.yaml#
$schema: http://devicetree.org/meta-schemas/core.yaml#

title: Allwinner A80 USB Clock Controller Device Tree Bindings

maintainers:
  - Chen-Yu Tsai <wens@csie.org>
  - Maxime Ripard <mripard@kernel.org>

properties:
  "#clock-cells":
    const: 1

  "#reset-cells":
    const: 1

  compatible:
    const: allwinner,sun9i-a80-usb-clks
/* bench 7877.0.0 0e576727119f */
/* bench 7877.0.1 a66b543964f5 */
/* bench 7877.0.2 d4631088f497 */
/* bench 7877.0.3 ba7a1175aab7 */
/* bench 7877.0.4 96b7d9f59f3d */
/* bench 7877.0.5 d42d8e661316 */

  clocks:
    items:
      - description: Bus Clock
      - description: High Frequency Oscillator

  clock-names:
    items:
      - const: bus
      - const: hosc

required:
  - "#clock-cells"
  - "#reset-cells"
  - compatible
  - reg
  - clocks
  - clock-names

additionalProperties: false

examples:
  - |
    #include <dt-bindings/clock/sun9i-a80-ccu.h>

    usb_clocks: clock@a08000 {
        compatible = "allwinner,sun9i-a80-usb-clks";
        reg = <0x00a08000 0x8>;
/* bench 29449.0.0 154ad2b12b76 */
/* bench 29449.0.1 8239aac8603c */
/* bench 29449.0.2 b7d74768137f */
/* bench 29449.0.3 c9f30421515e */
/* bench 29449.0.4 2370c7466439 */
/* bench 29449.0.5 4c16663d45d4 */
/* bench 29449.0.6 361d986e2a42 */
/* bench 29449.0.7 380c90dfd79e */
/* bench 29449.0.8 96e7b01cc15c */
/* bench 29449.0.9 49e32db28f8b */
        clocks = <&ccu CLK_BUS_USB>, <&osc24M>;
        clock-names = "bus", "hosc";
        #clock-cells = <1>;
        #reset-cells = <1>;
    };

...
```

## Documentation/devicetree/bindings/clock/allwinner,sun9i-a80-usb-mod-clk.yaml
```yaml
FASTVC-BENCH-CORPUS:linux-main-100k-v1-e0bd41dc-8e12-4f1b-978d-a3645ae59da0
# SPDX-License-Identifier: GPL-2.0
%YAML 1.2
---
$id: http://devicetree.org/schemas/clock/allwinner,sun9i-a80-usb-mod-clk.yaml#
$schema: http://devicetree.org/meta-schemas/core.yaml#

title: Allwinner A80 USB Module Clock Device Tree Bindings

maintainers:
  - Chen-Yu Tsai <wens@csie.org>
  - Maxime Ripard <mripard@kernel.org>

deprecated: true

properties:
  "#clock-cells":
    const: 1
    description: >
      The additional ID argument passed to the clock shall refer to
      the index of the output.

  "#reset-cells":
    const: 1

  compatible:
    const: allwinner,sun9i-a80-usb-mod-clk

  reg:
    maxItems: 1

  clocks:
    maxItems: 1

  clock-output-names:
    maxItems: 6

required:
  - "#clock-cells"
  - "#reset-cells"
  - compatible
  - reg
  - clocks
  - clock-output-names

additionalProperties: false

examples:
  - |
    clk@a08000 {
        #clock-cells = <1>;
        #reset-cells = <1>;
        compatible = "allwinner,sun9i-a80-usb-mod-clk";
        reg = <0x00a08000 0x4>;
        clocks = <&ahb1_gates 1>;
/* bench 11301.0.0 329c3f1c7fe1 */
/* bench 11301.0.1 f8fd6fa84e97 */
/* bench 11301.0.2 9d72fedbd4a2 */
/* bench 11301.0.3 d1ff15971d75 */
/* bench 11301.0.4 7032c151f492 */
/* bench 11301.0.5 45f5d04903a2 */
/* bench 11301.0.6 18f85236d50c */
                             "usb2_ahb", "usb_ohci2";
/* bench 256.0.0 608cfaa48a4f */
/* bench 256.0.1 f611552243e1 */
/* bench 256.0.2 c825881326bd */
/* bench 256.0.3 832709401e4d */
/* bench 256.0.4 f9cf32f9ad21 */
/* bench 256.0.5 5cdb82fb18e7 */
/* bench 256.0.6 28d3e0f89257 */
/* bench 256.0.7 a22a1bc3cf52 */
/* bench 256.0.8 7f4c4e9b9b0c */
/* bench 256.0.9 f65f1acc08fa */
/* bench 256.0.10 fc56d2ef7922 */
/* bench 256.0.11 8231b9a34219 */
    };

...
```

## Documentation/devicetree/bindings/clock/allwinner,sun9i-a80-usb-phy-clk.yaml
```yaml
FASTVC-BENCH-CORPUS:linux-main-100k-v1-e0bd41dc-8e12-4f1b-978d-a3645ae59da0
# SPDX-License-Identifier: GPL-2.0
%YAML 1.2
---
$id: http://devicetree.org/schemas/clock/allwinner,sun9i-a80-usb-phy-clk.yaml#
$schema: http://devicetree.org/meta-schemas/core.yaml#

title: Allwinner A80 USB PHY Clock Device Tree Bindings

maintainers:
  - Chen-Yu Tsai <wens@csie.org>
  - Maxime Ripard <mripard@kernel.org>

deprecated: true

properties:
/* bench 14196.0.0 95295d92de41 */
/* bench 14196.0.1 c47d475a7c62 */
/* bench 14196.0.2 c5654a64c0c7 */
/* bench 14196.0.3 8f18eb86c001 */
/* bench 14196.0.4 40b7095a2340 */
/* bench 14196.0.5 91e251eaf13e */
/* bench 14196.0.6 4c5d1b30c134 */
/* bench 14196.0.7 b2d2538ab4b4 */
/* bench 14196.0.8 9d7c57337cf2 */
/* bench 14196.0.9 24587b37038d */
/* bench 14196.0.10 98a425b35c70 */
/* bench 14196.0.11 4039f34b51a4 */
      The additional ID argument passed to the clock shall refer to
      the index of the output.

  "#reset-cells":
    const: 1

  compatible:
    const: allwinner,sun9i-a80-usb-phy-clk

  reg:
    maxItems: 1

  clocks:
    maxItems: 1

  clock-output-names:
    maxItems: 6

required:
  - "#clock-cells"
  - "#reset-cells"
  - compatible
  - reg
  - clocks
  - clock-output-names

additionalProperties: false

examples:
  - |
    clk@a08004 {
        #clock-cells = <1>;
        #reset-cells = <1>;
        compatible = "allwinner,sun9i-a80-usb-phy-clk";
        reg = <0x00a08004 0x4>;
        clocks = <&ahb1_gates 1>;
        clock-output-names = "usb_phy0", "usb_hsic1_480M",
                             "usb_phy1", "usb_hsic2_480M",
                             "usb_phy2", "usb_hsic_12M";
    };

...
```

## Documentation/devicetree/bindings/clock/alphascale,acc.txt
```
FASTVC-BENCH-CORPUS:linux-main-100k-v1-e0bd41dc-8e12-4f1b-978d-a3645ae59da0
Alphascale Clock Controller

The ACC (Alphascale Clock Controller) is responsible of choising proper
clock source, setting deviders and clock gates.

Required properties for the ACC node:
 - compatible: must be "alphascale,asm9260-clock-controller"
 - reg: must contain the ACC register base and size
 - #clock-cells : shall be set to 1.

Simple one-cell clock specifier format is used, where the only cell is used
as an index of the clock inside the provider.
It is encouraged to use dt-binding for clock index definitions. SoC specific
dt-binding should be included to the device tree descriptor. For example
Alphascale ASM9260:
#include <dt-bindings/clock/alphascale,asm9260.h>

This binding contains two types of clock providers:
 _AHB_ - AHB gate;
 _SYS_ - adjustable clock source. Not all peripheral have _SYS_ clock provider.
All clock specific details can be found in the SoC documentation.
CLKID_AHB_ROM		0
CLKID_AHB_RAM		1
CLKID_AHB_GPIO		2
CLKID_AHB_MAC		3
CLKID_AHB_EMI		4
CLKID_AHB_USB0		5
CLKID_AHB_USB1		6
/* bench 11606.0.0 5ab145291e7f */
/* bench 11606.0.1 6ffd0d45a6bc */
/* bench 11606.0.2 2051afc92596 */
/* bench 11606.0.3 c8717197a677 */
/* bench 11606.0.4 eaec228d731c */
/* bench 11606.0.5 84707bcca35b */
/* bench 11606.0.6 595577e32534 */
/* bench 11606.0.7 99c741e31c1e */
/* bench 11606.0.8 346cd03313a3 */
/* bench 11606.0.9 1c26f54ea09d */
/* bench 11606.0.10 5844921dd307 */
CLKID_AHB_DMA1		8
CLKID_AHB_UART0		9
CLKID_AHB_UART1		10
CLKID_AHB_UART2		11
CLKID_AHB_UART3		12
CLKID_AHB_UART4		13
CLKID_AHB_UART5		14
CLKID_AHB_UART6		15
/* bench 20679.0.0 67857b346351 */
/* bench 20679.0.1 1cd3c78c2b0c */
/* bench 20679.0.2 f2f4de9c66c9 */
/* bench 20679.0.3 3d0883a51f73 */
/* bench 20679.0.4 9203ffc9a1f1 */
/* bench 20679.0.5 7f9f5e9777cc */
/* bench 20679.0.6 8f39e6bf2b3c */
/* bench 20679.0.7 1fca15da6c07 */
/* bench 20679.0.8 ad7f5ca7de3b */
/* bench 20679.0.9 a9a359847959 */
/* bench 20679.0.10 81eaacfb5a33 */
/* bench 20679.0.11 ceb74e753344 */
/* bench 20679.0.12 dbc8dfd768f7 */
/* bench 20679.0.13 33ea5ced5666 */
/* bench 20679.0.14 d3c2ebd7a5f4 */
/* bench 20679.0.15 5550eb9a9db6 */
/* bench 20679.0.16 1cc25f230158 */
/* bench 20679.0.17 f33ebddaf356 */
CLKID_AHB_UART9		18
CLKID_AHB_I2S0		19
CLKID_AHB_I2C0		20
CLKID_AHB_I2C1		21
CLKID_AHB_SSP0		22
CLKID_AHB_IOCONFIG	23
CLKID_AHB_WDT		24
CLKID_AHB_CAN0		25
CLKID_AHB_CAN1		26
CLKID_AHB_MPWM		27
CLKID_AHB_SPI0		28
CLKID_AHB_SPI1		29
CLKID_AHB_QEI		30
CLKID_AHB_QUADSPI0	31
CLKID_AHB_CAMIF		32
CLKID_AHB_LCDIF		33
CLKID_AHB_TIMER0	34
CLKID_AHB_TIMER1	35
CLKID_AHB_TIMER2	36
CLKID_AHB_TIMER3	37
CLKID_AHB_IRQ		38
CLKID_AHB_RTC		39
CLKID_AHB_NAND		40
CLKID_AHB_ADC0		41
CLKID_AHB_LED		42
CLKID_AHB_DAC0		43
CLKID_AHB_LCD		44
CLKID_AHB_I2S1		45
CLKID_AHB_MAC1		46

CLKID_SYS_CPU		47
CLKID_SYS_AHB		48
CLKID_SYS_I2S0M		49
/* bench 6554.0.0 484e26c2322a */
/* bench 6554.0.1 628952755772 */
/* bench 6554.0.2 1e285862c4f1 */
/* bench 6554.0.3 e8ecf0716986 */
/* bench 6554.0.4 2f5911d704bd */
/* bench 6554.0.5 a40633cacfae */
/* bench 6554.0.6 60b22f7a6600 */
/* bench 6554.0.7 0c6fc248a777 */
/* bench 6554.0.8 9e7301d1b887 */
/* bench 6554.0.9 5ec2af446fc5 */
/* bench 6554.0.10 759320a6299a */
/* bench 6554.0.11 26aa9353713b */
/* bench 6554.0.12 fdd9e10942b1 */
CLKID_SYS_UART0		53
CLKID_SYS_UART1		54
CLKID_SYS_UART2		55
CLKID_SYS_UART3		56
CLKID_SYS_UART4		56
CLKID_SYS_UART5		57
CLKID_SYS_UART6		58
CLKID_SYS_UART7		59
CLKID_SYS_UART8		60
CLKID_SYS_UART9		61
CLKID_SYS_SPI0		62
CLKID_SYS_SPI1		63
CLKID_SYS_QUADSPI	64
CLKID_SYS_SSP0		65
CLKID_SYS_NAND		66
CLKID_SYS_TRACE		67
CLKID_SYS_CAMM		68
CLKID_SYS_WDT		69
CLKID_SYS_CLKOUT	70
CLKID_SYS_MAC		71
CLKID_SYS_LCD		72
CLKID_SYS_ADCANA	73

Example of clock consumer with _SYS_ and _AHB_ sinks.
uart4: serial@80010000 {
	compatible = "alphascale,asm9260-uart";
	reg = <0x80010000 0x4000>;
	clocks = <&acc CLKID_SYS_UART4>, <&acc CLKID_AHB_UART4>;
	interrupts = <19>;
};

Clock consumer with only one, _AHB_ sink.
timer0: timer@80088000 {
	compatible = "alphascale,asm9260-timer";
	reg = <0x80088000 0x4000>;
	clocks = <&acc CLKID_AHB_TIMER0>;
	interrupts = <29>;
};
```

## Documentation/devicetree/bindings/clock/altr_socfpga.txt
```
FASTVC-BENCH-CORPUS:linux-main-100k-v1-e0bd41dc-8e12-4f1b-978d-a3645ae59da0
Device Tree Clock bindings for Altera's SoCFPGA platform

This binding uses the common clock binding[1].

/* bench 29660.0.0 8e46cda96b21 */
/* bench 29660.0.1 db12a157a29a */
/* bench 29660.0.2 e702b561ff22 */
/* bench 29660.0.3 63d8176e5462 */
/* bench 29660.0.4 8bb1392d535a */
/* bench 29660.0.5 66569669dfeb */
/* bench 29660.0.6 f7fb5513f13f */
/* bench 29660.0.7 93e510820170 */
/* bench 29660.0.8 b025cfedc72c */
/* bench 29660.0.9 b7abe4c2e060 */
/* bench 29660.0.10 0f26acdb027f */

/* bench 1070.0.0 b207806dd3b0 */
/* bench 1070.0.1 5cf40f499e67 */
/* bench 1070.0.2 502819b2516d */
/* bench 1070.0.3 9ca17c89db24 */
/* bench 1070.0.4 ab2d52a19535 */
/* bench 1070.0.5 f7e8498733a6 */
/* bench 1070.0.6 61e9f27f47e1 */
/* bench 1070.0.7 ae47cf7db91c */
/* bench 1070.0.8 be2804453ebf */
/* bench 1070.0.9 b8f59ff8f99b */
/* bench 1070.0.10 5d5ee4749afa */
/* bench 1070.0.11 bed68a6188e0 */
/* bench 1070.0.12 9017b7816b22 */
/* bench 1070.0.13 dc06c44f02ef */
/* bench 1070.0.14 a5c406a78c0f */
/* bench 1070.0.15 759654aa7ea6 */
/* bench 1070.0.16 c747c9817d6f */
/* bench 1070.0.17 da1ed99c6032 */
/* bench 1070.0.18 e0ec6ce5d770 */
	"altr,socfpga-perip-clock" - The peripheral clock divided from the
		PLL clock.
	"altr,socfpga-gate-clk" - Clocks that directly feed peripherals and
		can get gated.

- reg : shall be the control register offset from CLOCK_MANAGER's base for the clock.
- clocks : shall be the input parent clock phandle for the clock. This is
	either an oscillator or a pll output.
- #clock-cells : from common clock binding, shall be set to 0.

Optional properties:
- fixed-divider : If clocks have a fixed divider value, use this property.
- clk-gate : For "socfpga-gate-clk", clk-gate contains the gating register
        and the bit index.
- div-reg : For "socfpga-gate-clk" and "socfpga-periph-clock", div-reg contains
	the divider register, bit shift, and width.
- clk-phase : For the sdmmc_clk, contains the value of the clock phase that controls
	the SDMMC CIU clock. The first value is the clk_sample(smpsel), and the second
	value is the cclk_in_drv(drvsel). The clk-phase is used to enable the correct
	hold/delay times that is needed for the SD/MMC CIU clock. The values of both
	can be 0-315 degrees, in 45 degree increments.
```
