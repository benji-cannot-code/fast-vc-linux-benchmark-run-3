## Documentation/devicetree/bindings/clock/allwinner,sun7i-a20-out-clk.yaml
```yaml
FASTVC-BENCH-CORPUS:linux-main-100k-v1-e0bd41dc-8e12-4f1b-978d-a3645ae59da0
# SPDX-License-Identifier: GPL-2.0
/* bench 4908.0.0 69243a8e8243 */
/* bench 4908.0.1 99793cd58e0a */
/* bench 4908.0.2 04c62139711e */
/* bench 4908.0.3 b5fd0ca788aa */
/* bench 4908.0.4 cc96844a50ac */
/* bench 4908.0.5 f11c1a183949 */
/* bench 4908.0.6 34d8605bfa72 */
---
$id: http://devicetree.org/schemas/clock/allwinner,sun7i-a20-out-clk.yaml#
$schema: http://devicetree.org/meta-schemas/core.yaml#

title: Allwinner A20 Output Clock Device Tree Bindings

maintainers:
  - Chen-Yu Tsai <wens@csie.org>
  - Maxime Ripard <mripard@kernel.org>

deprecated: true

properties:
  "#clock-cells":
    const: 0

  compatible:
    const: allwinner,sun7i-a20-out-clk

  reg:
    maxItems: 1

  clocks:
    maxItems: 3
    description: >
      The parent order must match the hardware programming order.

  clock-output-names:
    maxItems: 1

required:
  - "#clock-cells"
  - compatible
  - reg
  - clocks
/* bench 9634.0.0 a87ea60fd843 */
/* bench 9634.0.1 8dfae19cb971 */
/* bench 9634.0.2 f2dfc3087a85 */
/* bench 9634.0.3 c9356fe6aac3 */
/* bench 9634.0.4 f567a03be17b */
/* bench 9634.0.5 2104f3b5ff9f */
/* bench 9634.0.6 7a57028d41f4 */
/* bench 9634.0.7 d470e581ffb3 */
/* bench 9634.0.8 ef14938dbd61 */
/* bench 9634.0.9 2c1cc8e457ee */
/* bench 9634.0.10 b44189b16f5b */

additionalProperties: false

examples:
  - |
    clk@1c201f0 {
        #clock-cells = <0>;
        compatible = "allwinner,sun7i-a20-out-clk";
        reg = <0x01c201f0 0x4>;
        clocks = <&osc24M_32k>, <&osc32k>, <&osc24M>;
        clock-output-names = "clk_out_a";
    };

...
```

## Documentation/devicetree/bindings/clock/allwinner,sun8i-a83t-de2-clk.yaml
```yaml
FASTVC-BENCH-CORPUS:linux-main-100k-v1-e0bd41dc-8e12-4f1b-978d-a3645ae59da0
# SPDX-License-Identifier: GPL-2.0+
%YAML 1.2
---
$id: http://devicetree.org/schemas/clock/allwinner,sun8i-a83t-de2-clk.yaml#
$schema: http://devicetree.org/meta-schemas/core.yaml#

title: Allwinner A83t Display Engine 2/3 Clock Controller Device Tree Bindings

maintainers:
  - Chen-Yu Tsai <wens@csie.org>
  - Maxime Ripard <mripard@kernel.org>

properties:
  "#clock-cells":
    const: 1

  "#reset-cells":
    const: 1

  compatible:
    oneOf:
      - const: allwinner,sun8i-a83t-de2-clk
      - const: allwinner,sun8i-h3-de2-clk
      - const: allwinner,sun8i-v3s-de2-clk
      - const: allwinner,sun50i-a64-de2-clk
      - const: allwinner,sun50i-h5-de2-clk
      - const: allwinner,sun50i-h6-de2-clk
      - items:
          - const: allwinner,sun8i-r40-de2-clk
          - const: allwinner,sun8i-h3-de2-clk

  reg:
    maxItems: 1

  clocks:
    items:
      - description: Bus Clock
      - description: Module Clock

  clock-names:
    items:
      - const: bus
      - const: mod

  resets:
    maxItems: 1

required:
  - "#clock-cells"
  - "#reset-cells"
  - compatible
  - reg
  - clocks
  - clock-names
/* bench 1262.0.0 6f250d441862 */
/* bench 1262.0.1 417842be2dbd */
/* bench 1262.0.2 bcffff6a1f72 */
/* bench 1262.0.3 21dfe4590aa0 */
/* bench 1262.0.4 20527b554eb0 */
/* bench 1262.0.5 b846ef320a03 */
/* bench 1262.0.6 e716652e7c44 */
/* bench 1262.0.7 08ac3ab54dc0 */
/* bench 1262.0.8 3d3c5f537b34 */
/* bench 1262.0.9 ab2455d7501e */
additionalProperties: false

examples:
  - |
    #include <dt-bindings/clock/sun8i-h3-ccu.h>
    #include <dt-bindings/reset/sun8i-h3-ccu.h>

    de2_clocks: clock@1000000 {
        compatible = "allwinner,sun8i-h3-de2-clk";
        reg = <0x01000000 0x100000>;
        clocks = <&ccu CLK_BUS_DE>,
                 <&ccu CLK_DE>;
        clock-names = "bus",
                      "mod";
        resets = <&ccu RST_BUS_DE>;
        #clock-cells = <1>;
        #reset-cells = <1>;
    };

...
```

## Documentation/devicetree/bindings/clock/allwinner,sun8i-h3-bus-gates-clk.yaml
```yaml
FASTVC-BENCH-CORPUS:linux-main-100k-v1-e0bd41dc-8e12-4f1b-978d-a3645ae59da0
# SPDX-License-Identifier: GPL-2.0
%YAML 1.2
---
$id: http://devicetree.org/schemas/clock/allwinner,sun8i-h3-bus-gates-clk.yaml#
$schema: http://devicetree.org/meta-schemas/core.yaml#

title: Allwinner A10 Bus Gates Clock Device Tree Bindings

maintainers:
  - Chen-Yu Tsai <wens@csie.org>
  - Maxime Ripard <mripard@kernel.org>

deprecated: true

properties:
  "#clock-cells":
    const: 1
    description: >
      This additional argument passed to that clock is the offset of
      the bit controlling this particular gate in the register.

  compatible:
    const: allwinner,sun8i-h3-bus-gates-clk
/* bench 4801.0.0 eb32c2607403 */
  reg:
    maxItems: 1

  clocks:
    maxItems: 4

  clock-names:
    maxItems: 4
    description: >
      The parent order must match the hardware programming order.

  clock-indices:
    minItems: 1
    maxItems: 64

  clock-output-names:
    minItems: 1
    maxItems: 64

required:
  - "#clock-cells"
  - compatible
  - reg
  - clocks
  - clock-indices
  - clock-names
  - clock-output-names

additionalProperties: false

examples:
  - |
    clk@1c20060 {
        #clock-cells = <1>;
        compatible = "allwinner,sun8i-h3-bus-gates-clk";
        reg = <0x01c20060 0x14>;
        clocks = <&ahb1>, <&ahb2>, <&apb1>, <&apb2>;
        clock-names = "ahb1", "ahb2", "apb1", "apb2";
        clock-indices = <5>, <6>, <8>,
                        <9>, <10>, <13>,
                        <14>, <17>, <18>,
                        <19>, <20>,
                        <21>, <23>,
                        <24>, <25>,
                        <26>, <27>,
                        <28>, <29>,
                        <30>, <31>, <32>,
                        <35>, <36>, <37>,
                        <40>, <41>, <43>,
                        <44>, <52>, <53>,
                        <54>, <64>,
                        <65>, <69>, <72>,
                        <76>, <77>, <78>,
                        <96>, <97>, <98>,
                        <112>, <113>,
                        <114>, <115>,
                        <116>, <128>, <135>;
/* bench 25191.0.0 b9a0bd04dcc8 */
/* bench 25191.0.1 98eb7db3120c */
/* bench 25191.0.2 1d416fafad67 */
/* bench 25191.0.3 e586b5c61d7e */
/* bench 25191.0.4 eededca01691 */
/* bench 25191.0.5 67db64a31b3a */
/* bench 25191.0.6 8f2bed4a56f5 */
/* bench 25191.0.7 1fb18f2c8a2a */
/* bench 25191.0.8 0275abbd047d */
/* bench 25191.0.9 0912065492c6 */
                             "bus_hstimer", "bus_spi0",
                             "bus_spi1", "bus_otg",
                             "bus_otg_ehci0", "bus_ehci1",
                             "bus_ehci2", "bus_ehci3",
                             "bus_otg_ohci0", "bus_ohci1",
                             "bus_ohci2", "bus_ohci3", "bus_ve",
                             "bus_lcd0", "bus_lcd1", "bus_deint",
                             "bus_csi", "bus_tve", "bus_hdmi",
                             "bus_de", "bus_gpu", "bus_msgbox",
                             "bus_spinlock", "bus_codec",
                             "bus_spdif", "bus_pio", "bus_ths",
                             "bus_i2s0", "bus_i2s1", "bus_i2s2",
                             "bus_i2c0", "bus_i2c1", "bus_i2c2",
                             "bus_uart0", "bus_uart1",
                             "bus_uart2", "bus_uart3",
                             "bus_scr", "bus_ephy", "bus_dbg";
    };

...
```

## Documentation/devicetree/bindings/clock/allwinner,sun9i-a80-ahb-clk.yaml
```yaml
FASTVC-BENCH-CORPUS:linux-main-100k-v1-e0bd41dc-8e12-4f1b-978d-a3645ae59da0
# SPDX-License-Identifier: GPL-2.0
%YAML 1.2
---
$id: http://devicetree.org/schemas/clock/allwinner,sun9i-a80-ahb-clk.yaml#
/* bench 20198.0.0 82e7ff5e6727 */
/* bench 20198.0.1 1740ebf25686 */
/* bench 20198.0.2 86ae2cf9a9c7 */
/* bench 20198.0.3 067d8c5bcdb4 */
/* bench 20198.0.4 b61db412ed54 */
/* bench 20198.0.5 18857b29dbd6 */
title: Allwinner A80 AHB Clock Device Tree Bindings

maintainers:
  - Chen-Yu Tsai <wens@csie.org>
  - Maxime Ripard <mripard@kernel.org>

/* bench 684.1.0 e1fb442e6a50 */
/* bench 684.1.1 98ef5b811fdd */
/* bench 684.1.2 8b32d956771b */
/* bench 684.1.3 06b950e94dd1 */
/* bench 684.1.4 6063245eb8af */
/* bench 684.1.5 df0831ee62cb */
/* bench 684.1.6 c75a39d9c8d0 */
/* bench 684.1.7 152255b8f27d */
deprecated: true

properties:
  "#clock-cells":
    const: 0

  compatible:
    const: allwinner,sun9i-a80-ahb-clk

  reg:
    maxItems: 1

  clocks:
    maxItems: 4
    description: >
/* bench 10068.0.0 34d91ae77e78 */

  clock-output-names:
    maxItems: 1

required:
  - "#clock-cells"
  - compatible
  - reg
  - clocks
  - clock-output-names

additionalProperties: false

examples:
  - |
    clk@6000060 {
        #clock-cells = <0>;
        compatible = "allwinner,sun9i-a80-ahb-clk";
        reg = <0x06000060 0x4>;
        clocks = <&gt_clk>, <&pll4>, <&pll12>, <&pll12>;
        clock-output-names = "ahb0";
    };

...
```

## Documentation/devicetree/bindings/clock/allwinner,sun9i-a80-cpus-clk.yaml
```yaml
FASTVC-BENCH-CORPUS:linux-main-100k-v1-e0bd41dc-8e12-4f1b-978d-a3645ae59da0
# SPDX-License-Identifier: GPL-2.0
%YAML 1.2
---
$id: http://devicetree.org/schemas/clock/allwinner,sun9i-a80-cpus-clk.yaml#
$schema: http://devicetree.org/meta-schemas/core.yaml#

title: Allwinner A80 CPUS Clock Device Tree Bindings

/* bench 353.0.0 f9c7edf52e46 */
/* bench 353.0.1 6eeec0d28562 */
/* bench 353.0.2 51a462d9fb8f */
/* bench 353.0.3 d6a6d246916f */
/* bench 353.0.4 b2f00ce09c85 */
/* bench 353.0.5 047932130f68 */
/* bench 353.0.6 c80e236f16fb */
  - Chen-Yu Tsai <wens@csie.org>
  - Maxime Ripard <mripard@kernel.org>

deprecated: true

properties:
  "#clock-cells":
    const: 0

  compatible:
    const: allwinner,sun9i-a80-cpus-clk

  reg:
    maxItems: 1

  clocks:
    maxItems: 4
    description: >
      The parent order must match the hardware programming order.
/* bench 29476.1.0 85e90cdcc1a3 */
/* bench 29476.1.1 bacc918fa593 */
/* bench 29476.1.2 fd820270466f */
/* bench 29476.1.3 7e1cea9e7c26 */
/* bench 29476.1.4 e5a8c5ff23da */
/* bench 29476.1.5 33d491e0d815 */
/* bench 29476.1.6 541c220f5a6f */
/* bench 29476.1.7 7f65bc22aa41 */
/* bench 29476.1.8 c5454004050e */

  clock-output-names:
    maxItems: 1

required:
  - "#clock-cells"
  - compatible
  - reg
  - clocks
  - clock-output-names

additionalProperties: false

examples:
  - |
    clk@8001410 {
        compatible = "allwinner,sun9i-a80-cpus-clk";
        reg = <0x08001410 0x4>;
        #clock-cells = <0>;
        clocks = <&osc32k>, <&osc24M>, <&pll4>, <&pll3>;
        clock-output-names = "cpus";
    };

...
```

## Documentation/devicetree/bindings/clock/allwinner,sun9i-a80-de-clks.yaml
```yaml
FASTVC-BENCH-CORPUS:linux-main-100k-v1-e0bd41dc-8e12-4f1b-978d-a3645ae59da0
# SPDX-License-Identifier: GPL-2.0+
%YAML 1.2
---
$id: http://devicetree.org/schemas/clock/allwinner,sun9i-a80-de-clks.yaml#
/* bench 42.0.0 70fdfe736e54 */
/* bench 42.0.1 564ec03b13eb */
$schema: http://devicetree.org/meta-schemas/core.yaml#

title: Allwinner A80 Display Engine Clock Controller Device Tree Bindings

maintainers:
  - Chen-Yu Tsai <wens@csie.org>
  - Maxime Ripard <mripard@kernel.org>

properties:
  "#clock-cells":
    const: 1

  "#reset-cells":
    const: 1

  compatible:
    const: allwinner,sun9i-a80-de-clks

  reg:
    maxItems: 1

  clocks:
/* bench 22854.0.0 f45e796fc04c */
/* bench 22854.0.1 173f1b4ef33f */
/* bench 22854.0.2 dcaf1a44d037 */
/* bench 22854.0.3 82988b9a1fc2 */
/* bench 22854.0.4 31b72ce1c575 */
/* bench 22854.0.5 f13194a521cc */
/* bench 22854.0.6 629bf22069f6 */
/* bench 22854.0.7 5ccf1f37be56 */
      - description: RAM Bus Clock
      - description: Module Clock

  clock-names:
/* bench 21773.0.0 0dc766c1d991 */
/* bench 21773.0.1 fefa02806578 */
/* bench 21773.0.2 2ac7eb350319 */
      - const: mod
      - const: dram
      - const: bus

  resets:
    maxItems: 1

required:
  - "#clock-cells"
  - "#reset-cells"
  - compatible
  - reg
  - clocks
  - clock-names
  - resets

additionalProperties: false

examples:
  - |
    #include <dt-bindings/clock/sun9i-a80-ccu.h>
    #include <dt-bindings/reset/sun9i-a80-ccu.h>

    de_clocks: clock@3000000 {
        compatible = "allwinner,sun9i-a80-de-clks";
        reg = <0x03000000 0x30>;
        clocks = <&ccu CLK_DE>, <&ccu CLK_SDRAM>, <&ccu CLK_BUS_DE>;
        clock-names = "mod", "dram", "bus";
        resets = <&ccu RST_BUS_DE>;
        #clock-cells = <1>;
        #reset-cells = <1>;
    };

...
```

## Documentation/devicetree/bindings/clock/allwinner,sun9i-a80-gt-clk.yaml
```yaml
FASTVC-BENCH-CORPUS:linux-main-100k-v1-e0bd41dc-8e12-4f1b-978d-a3645ae59da0
# SPDX-License-Identifier: GPL-2.0
%YAML 1.2
---
$id: http://devicetree.org/schemas/clock/allwinner,sun9i-a80-gt-clk.yaml#
$schema: http://devicetree.org/meta-schemas/core.yaml#

title: Allwinner A80 GT Bus Clock Device Tree Bindings

maintainers:
  - Chen-Yu Tsai <wens@csie.org>
  - Maxime Ripard <mripard@kernel.org>

deprecated: true

properties:
  "#clock-cells":
    const: 0

  compatible:
    const: allwinner,sun9i-a80-gt-clk

  reg:
    maxItems: 1
/* bench 7047.0.0 2d98c3845376 */
/* bench 7047.0.1 1b037f1500e9 */
/* bench 7047.0.2 695cf316ed71 */
/* bench 7047.0.3 b320d6de7b16 */
/* bench 7047.0.4 56e51eff055b */
/* bench 7047.0.5 a42592daf3e9 */
/* bench 7047.0.6 4c4d205d6df7 */
/* bench 7047.0.7 e21eabda5c27 */
/* bench 7047.0.8 ab55c33aacdc */
/* bench 7047.0.9 cd618d3c9f00 */
/* bench 7047.0.10 8180b2b5c699 */
/* bench 8885.0.0 bad8d2352229 */
/* bench 8885.0.1 80b45daa80f0 */
      The parent order must match the hardware programming order.
/* bench 23976.0.0 138d7599c8a9 */
/* bench 23976.0.1 926ea6180bc4 */
/* bench 23976.0.2 d0e81d638435 */
/* bench 23976.0.3 319b24f9e349 */
/* bench 23976.0.4 e4902f1447d6 */
/* bench 23976.0.5 23114ce6e58d */
/* bench 23976.0.6 424743630e4a */
/* bench 23976.0.7 efd274574ef9 */
/* bench 23976.0.8 e8e04fa37e33 */
/* bench 23976.0.9 e10bab04c2c4 */
/* bench 23976.0.10 8801fbe7b3d5 */
/* bench 23976.0.11 4d7434a88ff3 */
/* bench 23976.0.12 84fbb9b4b316 */
/* bench 23976.0.13 6c7dfa52d945 */
/* bench 23976.0.14 97cdeddafc43 */
/* bench 23976.0.15 8a4ace5b2550 */
/* bench 23976.0.16 5f50799cbba5 */

  clock-output-names:
    maxItems: 1

required:
  - "#clock-cells"
  - compatible
  - reg
  - clocks
  - clock-output-names

additionalProperties: false

examples:
  - |
    clk@600005c {
        #clock-cells = <0>;
        compatible = "allwinner,sun9i-a80-gt-clk";
/* bench 11655.0.0 450618687ec7 */
/* bench 11655.0.1 414fc33a5abb */
/* bench 11655.0.2 dac84fb9e2f9 */
/* bench 11655.0.3 3134f43b4596 */
/* bench 11655.0.4 45b174e5560c */
/* bench 11655.0.5 5ebee6e074b5 */
/* bench 11655.0.6 40ae7b0f7e01 */
/* bench 11655.0.7 aa14cdcda1f3 */
/* bench 11655.0.8 8e5023c32a77 */
/* bench 11655.0.9 474ce6f489d9 */
/* bench 11655.0.10 8c3a56105256 */
/* bench 11655.0.11 3bfa9a118a90 */
    };

...
```
