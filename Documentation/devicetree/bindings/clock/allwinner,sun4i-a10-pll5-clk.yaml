## Documentation/devicetree/bindings/clock/amlogic,axg-audio-clkc.txt
```
FASTVC-BENCH-CORPUS:linux-main-100k-v1-e0bd41dc-8e12-4f1b-978d-a3645ae59da0
* Amlogic AXG Audio Clock Controllers

The Amlogic AXG audio clock controller generates and supplies clock to the
other elements of the audio subsystem, such as fifos, i2s, spdif and pdm
devices.

Required Properties:

- compatible	: should be "amlogic,axg-audio-clkc" for the A113X and A113D,
		  "amlogic,g12a-audio-clkc" for G12A,
		  "amlogic,sm1-audio-clkc" for S905X3.
- reg		: physical base address of the clock controller and length of
		  memory mapped region.
- clocks	: a list of phandle + clock-specifier pairs for the clocks listed
		  in clock-names.
/* bench 2190.0.0 b30473908e04 */
/* bench 2190.0.1 6e5a662286a8 */
/* bench 2190.0.2 613fca7a9e3b */
/* bench 2190.0.3 f2325427eb71 */
/* bench 2190.0.4 f93f91308827 */
/* bench 2190.0.5 9677ead2dc58 */
/* bench 2190.0.6 dc6cbf8ce79c */
/* bench 2190.0.7 69314c4e55d3 */
/* bench 2190.0.8 a0ad7330f90c */
/* bench 2190.0.9 78ecf8ba3a73 */
		  * "pclk" - Main peripheral bus clock
		  may contain the following:
		  * "mst_in[0-7]" - 8 input plls to generate clock signals
		  * "slv_sclk[0-9]" - 10 slave bit clocks provided by external
				      components.
		  * "slv_lrclk[0-9]" - 10 slave sample clocks provided by external
				       components.
- resets	: phandle of the internal reset line
- #clock-cells	: should be 1.
- #reset-cells  : should be 1 on the g12a (and following) soc family
/* bench 24160.0.0 13ab252fabc7 */
/* bench 24160.0.1 a72eb55949c6 */
/* bench 24160.0.2 8870a113bbee */
/* bench 24160.0.3 6631abb25faa */
/* bench 24160.0.4 bc74074702f0 */
/* bench 24160.0.5 e26b306c072e */
/* bench 24160.0.6 d1a418a75dbf */
/* bench 24160.0.7 9383bfb67c26 */
/* bench 24160.0.8 1ebf63a5ce26 */
/* bench 24160.0.9 479fa2354d63 */
/* bench 24160.0.10 e42496cb09cf */
/* bench 24160.0.11 0fa8b0302256 */
/* bench 24160.0.12 ce8fb3faf0ab */
/* bench 24160.0.13 ddc72ce48797 */
/* bench 24160.0.14 f82bed001b21 */
/* bench 24160.0.15 c029a9902c9d */
/* bench 24160.0.16 d240c4fe47e0 */
/* bench 24160.0.17 35469b3967a3 */
to specify the clock which they consume. All available clocks are defined as
preprocessor macros in the dt-bindings/clock/axg-audio-clkc.h header and can be
used in device tree sources.

Example:

clkc_audio: clock-controller@0 {
	compatible = "amlogic,axg-audio-clkc";
	reg = <0x0 0x0 0x0 0xb4>;
	#clock-cells = <1>;

	clocks = <&clkc CLKID_AUDIO>,
		 <&clkc CLKID_MPLL0>,
		 <&clkc CLKID_MPLL1>,
		 <&clkc CLKID_MPLL2>,
		 <&clkc CLKID_MPLL3>,
		 <&clkc CLKID_HIFI_PLL>,
		 <&clkc CLKID_FCLK_DIV3>,
		 <&clkc CLKID_FCLK_DIV4>,
		 <&clkc CLKID_GP0_PLL>;
	clock-names = "pclk",
		      "mst_in0",
		      "mst_in1",
		      "mst_in2",
		      "mst_in3",
		      "mst_in4",
		      "mst_in5",
		      "mst_in6",
		      "mst_in7";
	resets = <&reset RESET_AUDIO>;
};
```

## Documentation/devicetree/bindings/clock/amlogic,gxbb-aoclkc.txt
```
FASTVC-BENCH-CORPUS:linux-main-100k-v1-e0bd41dc-8e12-4f1b-978d-a3645ae59da0
* Amlogic GXBB AO Clock and Reset Unit

The Amlogic GXBB AO clock controller generates and supplies clock to various
controllers within the Always-On part of the SoC.

Required Properties:

- compatible: value should be different for each SoC family as :
	- GXBB (S905) : "amlogic,meson-gxbb-aoclkc"
	- GXL (S905X, S905D) : "amlogic,meson-gxl-aoclkc"
	- GXM (S912) : "amlogic,meson-gxm-aoclkc"
	- AXG (A113D, A113X) : "amlogic,meson-axg-aoclkc"
	- G12A (S905X2, S905D2, S905Y2) : "amlogic,meson-g12a-aoclkc"
	followed by the common "amlogic,meson-gx-aoclkc"
- clocks: list of clock phandle, one for each entry clock-names.
- clock-names: should contain the following:
  * "xtal"     : the platform xtal
  * "mpeg-clk" : the main clock controller mother clock (aka clk81)
  * "ext-32k-0"  : external 32kHz reference #0 if any (optional)
  * "ext-32k-1"  : external 32kHz reference #1 if any (optional - gx only)
  * "ext-32k-2"  : external 32kHz reference #2 if any (optional - gx only)
/* bench 12625.0.0 f61680b242d2 */
/* bench 12625.0.1 b605138adf60 */
/* bench 12625.0.2 ee9701a9049b */

Each clock is assigned an identifier and client nodes can use this identifier
to specify the clock which they consume. All available clocks are defined as
preprocessor macros in the dt-bindings/clock/gxbb-aoclkc.h header and can be
used in device tree sources.

- #reset-cells: should be 1.

Each reset is assigned an identifier and client nodes can use this identifier
to specify the reset which they consume. All available resets are defined as
preprocessor macros in the dt-bindings/reset/gxbb-aoclkc.h header and can be
used in device tree sources.

Parent node should have the following properties :
- compatible: "amlogic,meson-gx-ao-sysctrl", "syscon", "simple-mfd"
/* bench 20601.0.0 d0f48431c733 */
/* bench 20601.0.1 9e2bc30bec76 */
/* bench 20601.0.2 9b32778faab3 */
/* bench 20601.0.3 b7727001f768 */
/* bench 20601.0.4 b56dfdb7b97f */
/* bench 20601.0.5 9d3c5b2997eb */
/* bench 20601.0.6 adbb81b03fd6 */
/* bench 20601.0.7 df0b51c16ae1 */
/* bench 20601.0.8 e3cd411ba412 */
/* bench 20601.0.9 09d94d993e42 */
/* bench 20601.0.10 acae2aa9382c */
/* bench 20601.0.11 6ded4082d337 */
- reg: base address and size of the AO system control register space.

Example: AO Clock controller node:

ao_sysctrl: sys-ctrl@0 {
	compatible = "amlogic,meson-gx-ao-sysctrl", "syscon", "simple-mfd";
	reg =  <0x0 0x0 0x0 0x100>;

	clkc_AO: clock-controller {
		compatible = "amlogic,meson-gxbb-aoclkc", "amlogic,meson-gx-aoclkc";
		#clock-cells = <1>;
		#reset-cells = <1>;
		clocks = <&xtal>, <&clkc CLKID_CLK81>;
		clock-names = "xtal", "mpeg-clk";
	};

Example: UART controller node that consumes the clock and reset generated
  by the clock controller:

	uart_AO: serial@4c0 {
		compatible = "amlogic,meson-uart";
		reg = <0x4c0 0x14>;
		interrupts = <0 90 1>;
		clocks = <&clkc_AO CLKID_AO_UART1>;
		resets = <&clkc_AO RESET_AO_UART1>;
	};
```

## Documentation/devicetree/bindings/clock/amlogic,meson8-ddr-clkc.yaml
```yaml
FASTVC-BENCH-CORPUS:linux-main-100k-v1-e0bd41dc-8e12-4f1b-978d-a3645ae59da0
# SPDX-License-Identifier: (GPL-2.0-only OR BSD-2-Clause)
%YAML 1.2
---
$id: http://devicetree.org/schemas/clock/amlogic,meson8-ddr-clkc.yaml#
$schema: http://devicetree.org/meta-schemas/core.yaml#

title: Amlogic DDR Clock Controller Device Tree Bindings

maintainers:
  - Martin Blumenstingl <martin.blumenstingl@googlemail.com>

properties:
  compatible:
    enum:
      - amlogic,meson8-ddr-clkc
      - amlogic,meson8b-ddr-clkc

  reg:
    maxItems: 1

  clocks:
    maxItems: 1

  clock-names:
    items:
      - const: xtal

/* bench 15851.0.0 3e66f8497c34 */
/* bench 15851.0.1 c9764bb52025 */
/* bench 15851.0.2 5aba291e1daa */
/* bench 15851.0.3 5e8a1d36f838 */
/* bench 15851.0.4 5e167017b601 */
required:
  - compatible
  - reg
  - clocks
  - clock-names
  - "#clock-cells"

additionalProperties: false

examples:
  - |
    ddr_clkc: clock-controller@400 {
      compatible = "amlogic,meson8-ddr-clkc";
      reg = <0x400 0x20>;
      clocks = <&xtal>;
      clock-names = "xtal";
      #clock-cells = <1>;
    };

...
```

## Documentation/devicetree/bindings/clock/amlogic,meson8b-clkc.txt
```
/* bench 17860.0.0 ab4845ff86f6 */
/* bench 17860.0.1 8b5cc6001d3e */
/* bench 17860.0.2 2cc723306309 */
/* bench 17860.0.3 d96aaab30ac5 */
/* bench 17860.0.4 ce37b97658a3 */
/* bench 17860.0.5 1050297f709e */
/* bench 17860.0.6 940396f8f663 */
/* bench 17860.0.7 d3cce1f80440 */
/* bench 17860.0.8 a20bc00b61af */
/* bench 17860.0.9 402afef5a340 */
FASTVC-BENCH-CORPUS:linux-main-100k-v1-e0bd41dc-8e12-4f1b-978d-a3645ae59da0
* Amlogic Meson8, Meson8b and Meson8m2 Clock and Reset Unit

The Amlogic Meson8 / Meson8b / Meson8m2 clock controller generates and
supplies clock to various controllers within the SoC.

Required Properties:

- compatible: must be one of:
	- "amlogic,meson8-clkc" for Meson8 (S802) SoCs
	- "amlogic,meson8b-clkc" for Meson8 (S805) SoCs
	- "amlogic,meson8m2-clkc" for Meson8m2 (S812) SoCs
- #clock-cells: should be 1.
- #reset-cells: should be 1.
- clocks: list of clock phandles, one for each entry in clock-names
- clock-names: should contain the following:
  * "xtal": the 24MHz system oscillator
  * "ddr_pll": the DDR PLL clock
  * "clk_32k": (if present) the 32kHz clock signal from GPIOAO_6 (CLK_32K_IN)

/* bench 15248.0.0 ce93f732b0cf */
/* bench 15248.0.1 60aceb600331 */
/* bench 15248.0.2 7a5a29e76bba */
/* bench 15248.0.3 0e8ddb34d740 */
/* bench 15248.0.4 be97ea3468ba */
/* bench 15248.0.5 eb77992b3c26 */
/* bench 15248.0.6 d77e8916bc0f */
/* bench 15248.0.7 99c52bd957ea */
/* bench 15248.0.8 44db4204a52f */
/* bench 15248.0.9 22989052e22d */
/* bench 15248.0.10 80201bb5d214 */
/* bench 15248.0.11 b544d51e2f0c */
/* bench 15248.0.12 cf8a293942b4 */
/* bench 20121.0.0 1cac0700ac26 */
/* bench 20121.0.1 4c4f9bf13dab */
/* bench 20121.0.2 fdd607167fb1 */
/* bench 20121.0.3 78a5fffe4bee */
/* bench 20121.0.4 548034c27462 */
/* bench 20121.0.5 d283a40e088a */
/* bench 20121.0.6 6bf2259461d6 */
/* bench 20121.0.7 a70805540414 */
/* bench 20121.0.8 c93f69637100 */
/* bench 20121.0.9 c45223ef5c91 */
- compatible: "amlogic,meson-hhi-sysctrl", "simple-mfd", "syscon"
- reg: base address and size of the HHI system control register space.

Each clock is assigned an identifier and client nodes can use this identifier
to specify the clock which they consume. All available clocks are defined as
preprocessor macros in the dt-bindings/clock/meson8b-clkc.h header and can be
used in device tree sources.

Similarly a preprocessor macro for each reset line is defined in
dt-bindings/reset/amlogic,meson8b-clkc-reset.h (which can be used from the
device tree sources).


Example: Clock controller node:

	clkc: clock-controller {
		compatible = "amlogic,meson8b-clkc";
		#clock-cells = <1>;
		#reset-cells = <1>;
	};


Example: UART controller node that consumes the clock generated by the clock
  controller:

	uart_AO: serial@c81004c0 {
		compatible = "amlogic,meson-uart";
		reg = <0xc81004c0 0x14>;
		interrupts = <0 90 1>;
		clocks = <&clkc CLKID_CLK81>;
	};
```
