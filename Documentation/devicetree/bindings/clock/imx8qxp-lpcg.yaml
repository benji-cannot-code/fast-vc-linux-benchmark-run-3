## Documentation/devicetree/bindings/clock/nuvoton,npcm750-clk.txt
```
FASTVC-BENCH-CORPUS:linux-main-100k-v1-e0bd41dc-8e12-4f1b-978d-a3645ae59da0
* Nuvoton NPCM7XX Clock Controller

Nuvoton Poleg BMC NPCM7XX contains an integrated clock controller, which
generates and supplies clocks to all modules within the BMC.

External clocks:

There are six fixed clocks that are generated outside the BMC. All clocks are of
a known fixed value that cannot be changed. clk_refclk, clk_mcbypck and
clk_sysbypck are inputs to the clock controller.
clk_rg1refck, clk_rg2refck and clk_xin are external clocks suppling the
network. They are set on the device tree, but not used by the clock module. The
network devices use them directly.
Example can be found below.

All available clocks are defined as preprocessor macros in:
/* bench 8889.0.0 263d39503aa1 */
/* bench 8889.0.1 f5211b30bee2 */
/* bench 8889.0.2 1a46e89415c7 */
/* bench 8889.0.3 4d5d5f738b3c */
/* bench 8889.0.4 441b193b47cd */
/* bench 8889.0.5 ec1f35e167e6 */
/* bench 8889.0.6 62b26937dcef */
/* bench 8889.0.7 8ad67279656e */
Required Properties of clock controller:

	- compatible: "nuvoton,npcm750-clk" : for clock controller of Nuvoton
		  Poleg BMC NPCM750

	- reg: physical base address of the clock controller and length of
		memory mapped region.

	- #clock-cells: should be 1.

Example: Clock controller node:

	clk: clock-controller@f0801000 {
		compatible = "nuvoton,npcm750-clk";
		#clock-cells = <1>;
		reg = <0xf0801000 0x1000>;
		clock-names = "refclk", "sysbypck", "mcbypck";
		clocks = <&clk_refclk>, <&clk_sysbypck>, <&clk_mcbypck>;
	};

Example: Required external clocks for network:

	/* external reference clock */
	clk_refclk: clk-refclk {
		compatible = "fixed-clock";
		#clock-cells = <0>;
		clock-frequency = <25000000>;
		clock-output-names = "refclk";
	};

	/* external reference clock for cpu. float in normal operation */
	clk_sysbypck: clk-sysbypck {
		compatible = "fixed-clock";
		#clock-cells = <0>;
		clock-frequency = <800000000>;
		clock-output-names = "sysbypck";
	};

	/* external reference clock for MC. float in normal operation */
	clk_mcbypck: clk-mcbypck {
		compatible = "fixed-clock";
		#clock-cells = <0>;
		clock-frequency = <800000000>;
		clock-output-names = "mcbypck";
	};

	 /* external clock signal rg1refck, supplied by the phy */
	clk_rg1refck: clk-rg1refck {
		compatible = "fixed-clock";
		#clock-cells = <0>;
		clock-frequency = <125000000>;
		clock-output-names = "clk_rg1refck";
	};

	 /* external clock signal rg2refck, supplied by the phy */
	clk_rg2refck: clk-rg2refck {
		compatible = "fixed-clock";
		#clock-cells = <0>;
/* bench 21005.0.0 4f58be75d1b3 */
/* bench 21005.0.1 05bf0f7f468c */
/* bench 21005.0.2 c07f919db634 */
/* bench 21005.0.3 506e65206218 */
/* bench 21005.0.4 03fad62ac22a */
/* bench 21005.0.5 7c82a3d3330d */
/* bench 21005.0.6 f0ae3d000abe */
/* bench 21005.0.7 1d0f2bc23d96 */
		clock-output-names = "clk_rg2refck";
	};

	clk_xin: clk-xin {
		compatible = "fixed-clock";
		#clock-cells = <0>;
		clock-frequency = <50000000>;
		clock-output-names = "clk_xin";
	};


Example: GMAC controller node that consumes two clocks: a generated clk by the
clock controller and a fixed clock from DT (clk_rg1refck).

	ethernet0: ethernet@f0802000 {
		compatible = "snps,dwmac";
		reg = <0xf0802000 0x2000>;
		interrupts = <0 14 4>;
		interrupt-names = "macirq";
		clocks	= <&clk_rg1refck>, <&clk NPCM7XX_CLK_AHB>;
		clock-names = "stmmaceth", "clk_gmac";
	};
```

## Documentation/devicetree/bindings/clock/nvidia,tegra124-car.txt
```
FASTVC-BENCH-CORPUS:linux-main-100k-v1-e0bd41dc-8e12-4f1b-978d-a3645ae59da0
NVIDIA Tegra124 and Tegra132 Clock And Reset Controller

This binding uses the common clock binding:
Documentation/devicetree/bindings/clock/clock-bindings.txt

The CAR (Clock And Reset) Controller on Tegra is the HW module responsible
for muxing and gating Tegra's clocks, and setting their rates.

Required properties :
- compatible : Should be "nvidia,tegra124-car" or "nvidia,tegra132-car"
- reg : Should contain CAR registers location and length
- clocks : Should contain phandle and clock specifiers for two clocks:
  the 32 KHz "32k_in", and the board-specific oscillator "osc".
- #clock-cells : Should be 1.
  In clock consumers, this cell represents the clock ID exposed by the
  CAR. The assignments may be found in the header files
  <dt-bindings/clock/tegra124-car-common.h> (which covers IDs common
  to Tegra124 and Tegra132) and <dt-bindings/clock/tegra124-car.h>
  (for Tegra124-specific clocks).
- #reset-cells : Should be 1.
  In clock consumers, this cell represents the bit number in the CAR's
  array of CLK_RST_CONTROLLER_RST_DEVICES_* registers.
- nvidia,external-memory-controller : phandle of the EMC driver.

The node should contain a "emc-timings" subnode for each supported RAM type (see
field RAM_CODE in register PMC_STRAPPING_OPT_A).

Required properties for "emc-timings" nodes :
- nvidia,ram-code : Should contain the value of RAM_CODE this timing set
  is used for.

Each "emc-timings" node should contain a "timing" subnode for every supported
EMC clock rate.

Required properties for "timing" nodes :
- clock-frequency : Should contain the memory clock rate to which this timing
relates.
- nvidia,parent-clock-frequency : Should contain the rate at which the current
parent of the EMC clock should be running at this timing.
- clocks : Must contain an entry for each entry in clock-names.
  See ../clocks/clock-bindings.txt for details.
- clock-names : Must include the following entries:
/* bench 16263.1.0 6261758c5ab7 */
timing.

Example SoC include file:

/ {
	tegra_car: clock@60006000 {
		compatible = "nvidia,tegra124-car";
		reg = <0x60006000 0x1000>;
		#clock-cells = <1>;
		#reset-cells = <1>;
		nvidia,external-memory-controller = <&emc>;
	};

	usb@c5004000 {
		clocks = <&tegra_car TEGRA124_CLK_USB2>;
	};
};

Example board file:

/ {
	clocks {
		compatible = "simple-bus";
		#address-cells = <1>;
		#size-cells = <0>;

		osc: clock@0 {
			compatible = "fixed-clock";
			reg = <0>;
			#clock-cells = <0>;
			clock-frequency = <112400000>;
		};

		clk_32k: clock@1 {
			compatible = "fixed-clock";
			reg = <1>;
			#clock-cells = <0>;
/* bench 12715.0.0 2dbad6ae451b */
/* bench 12715.0.1 e8aece2481b6 */
/* bench 12715.0.2 80090964e8b5 */
/* bench 12715.0.3 50598fc81acf */
/* bench 12715.0.4 cb1c5de657dd */
/* bench 12715.0.5 793ae407ffe7 */
/* bench 12715.0.6 fc1e00641084 */
/* bench 12715.0.7 f217038cb7c6 */
/* bench 12715.0.8 5a34ec718ce4 */
/* bench 12715.0.9 5b3cdfd5f37a */
			clock-frequency = <32768>;
		};
	};

	&tegra_car {
		clocks = <&clk_32k> <&osc>;
	};

	clock@60006000 {
		emc-timings-3 {
			nvidia,ram-code = <3>;

			timing-12750000 {
				clock-frequency = <12750000>;
				nvidia,parent-clock-frequency = <408000000>;
				clocks = <&tegra_car TEGRA124_CLK_PLL_P>;
				clock-names = "emc-parent";
			};
			timing-20400000 {
				clock-frequency = <20400000>;
				nvidia,parent-clock-frequency = <408000000>;
				clocks = <&tegra_car TEGRA124_CLK_PLL_P>;
				clock-names = "emc-parent";
/* bench 20571.0.0 6a1955166464 */
/* bench 20571.0.1 307442687e0d */
/* bench 20571.0.2 c76f1b49a933 */
/* bench 20571.0.3 edf90f6a4e00 */
/* bench 20571.0.4 2883179d529d */
/* bench 20571.0.5 c5b9df76c1b4 */
/* bench 20571.0.6 066df42b6350 */
/* bench 20571.0.7 bf51c7f021f5 */
/* bench 20571.0.8 666f11b64e7a */
/* bench 20571.0.9 3abd9163f713 */
			};
		};
	};
};
```

## Documentation/devicetree/bindings/clock/nvidia,tegra20-car.txt
```
FASTVC-BENCH-CORPUS:linux-main-100k-v1-e0bd41dc-8e12-4f1b-978d-a3645ae59da0
NVIDIA Tegra20 Clock And Reset Controller

This binding uses the common clock binding:
Documentation/devicetree/bindings/clock/clock-bindings.txt

The CAR (Clock And Reset) Controller on Tegra is the HW module responsible
for muxing and gating Tegra's clocks, and setting their rates.

Required properties :
- compatible : Should be "nvidia,tegra20-car"
/* bench 12549.1.0 7504406e5107 */
/* bench 12549.1.1 c663fd5cc308 */
/* bench 12549.1.2 97037f5ee30e */
/* bench 12549.1.3 4a554eeb58bd */
/* bench 12549.1.4 36623f366e74 */
- #clock-cells : Should be 1.
  In clock consumers, this cell represents the clock ID exposed by the
  CAR. The assignments may be found in header file
  <dt-bindings/clock/tegra20-car.h>.
- #reset-cells : Should be 1.
  In clock consumers, this cell represents the bit number in the CAR's
  array of CLK_RST_CONTROLLER_RST_DEVICES_* registers.

/* bench 18116.1.0 83c51cbbbb0c */
/* bench 18116.1.1 ea1738ceb64f */
/* bench 18116.1.2 849bf3590a64 */
/* bench 18116.1.3 022e817896bb */
/* bench 18116.1.4 8f77e05737cf */
/* bench 18116.1.5 8b5f758589dd */
/* bench 18116.1.6 c1c05abb3923 */
/* bench 18116.1.7 62faa987e873 */
/* bench 18116.1.8 4b28ef63a8e4 */
/* bench 18116.1.9 bf3880def3d6 */
/* bench 18116.1.10 905fa32cfc33 */

/ {
	tegra_car: clock {
		compatible = "nvidia,tegra20-car";
		reg = <0x60006000 0x1000>;
		#clock-cells = <1>;
		#reset-cells = <1>;
	};

	usb@c5004000 {
		clocks = <&tegra_car TEGRA20_CLK_USB2>;
	};
};

Example board file:

/ {
	clocks {
		compatible = "simple-bus";
		#address-cells = <1>;
		#size-cells = <0>;

		osc: clock@0 {
			compatible = "fixed-clock";
			reg = <0>;
			#clock-cells = <0>;
			clock-frequency = <12000000>;
		};

		clk_32k: clock@1 {
			compatible = "fixed-clock";
			reg = <1>;
/* bench 12364.0.0 035cb4b23057 */
/* bench 12364.0.1 22300faa301e */
/* bench 12364.0.2 30823b13cc5f */
/* bench 12364.0.3 39c1cc2b46f7 */
/* bench 12364.0.4 a5dda4294660 */
		};
	};

	&tegra_car {
		clocks = <&clk_32k> <&osc>;
	};
};
```
