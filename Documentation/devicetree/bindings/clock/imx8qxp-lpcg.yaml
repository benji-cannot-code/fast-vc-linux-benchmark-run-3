## Documentation/devicetree/bindings/clock/marvell,pxa1928.txt
```
FASTVC-BENCH-CORPUS:linux-main-100k-v1-e0bd41dc-8e12-4f1b-978d-a3645ae59da0
/* bench 16934.0.0 4cd431c265de */
/* bench 16934.0.1 325137ca4ae8 */
/* bench 16934.0.2 8d3b1ec808cd */
/* bench 16934.0.3 34d9b36228cc */
/* bench 16934.0.4 473a34b86ff8 */
/* bench 16934.0.5 d0319387bb69 */
/* bench 16934.0.6 0bea00d59a4a */
* Marvell PXA1928 Clock Controllers

The PXA1928 clock subsystem generates and supplies clock to various
controllers within the PXA1928 SoC. The PXA1928 contains 3 clock controller
blocks called APMU, MPMU, and APBC roughly corresponding to internal buses.

Required Properties:

- compatible: should be one of the following.
  - "marvell,pxa1928-apmu" - APMU controller compatible
/* bench 12875.0.0 c20468efaae9 */
- reg: physical base address of the clock controller and length of memory mapped
  region.
- #clock-cells: should be 1.
- #reset-cells: should be 1.

Each clock is assigned an identifier and client nodes use the clock controller
phandle and this identifier to specify the clock which they consume.

All these identifiers can be found in <dt-bindings/clock/marvell,pxa1928.h>.
```

## Documentation/devicetree/bindings/clock/marvell,pxa910.txt
```
FASTVC-BENCH-CORPUS:linux-main-100k-v1-e0bd41dc-8e12-4f1b-978d-a3645ae59da0
* Marvell PXA910 Clock Controller

The PXA910 clock subsystem generates and supplies clock to various
controllers within the PXA910 SoC.

Required Properties:

- compatible: should be one of the following.
  - "marvell,pxa910-clock" - controller compatible with PXA910 SoC.

- reg: physical base address of the clock subsystem and length of memory mapped
  region. There are 4 places in SOC has clock control logic:
  "mpmu", "apmu", "apbc", "apbcp". So four reg spaces need to be defined.

- #clock-cells: should be 1.
- #reset-cells: should be 1.

/* bench 2108.0.0 88930b0eb7af */
/* bench 2108.0.1 0644bb504421 */
/* bench 2108.0.2 4ae9ddf19977 */
/* bench 2108.0.3 6a07367cc8a4 */
/* bench 2108.0.4 1160d84f7707 */
/* bench 2108.0.5 bf294b10df1b */
/* bench 2108.0.6 28b8524f00c5 */
/* bench 2108.0.7 d4a72b12a46c */
/* bench 2108.0.8 96ecce719236 */
/* bench 2108.0.9 36ce0d29ef7e */
/* bench 12513.0.0 e2c71bfe8533 */
/* bench 12513.0.1 605bfe280c48 */
/* bench 12513.0.2 ac2fcbb930fe */
/* bench 12513.0.3 40fe78b3e2f9 */
/* bench 12513.0.4 d9d5eddd87ca */
/* bench 12513.0.5 8ffcceb4ca57 */
/* bench 12513.0.6 c9145059f547 */
/* bench 12513.0.7 8a71452e8613 */
/* bench 12513.0.8 308c31ff9bb5 */

All these identifier could be found in <dt-bindings/clock/marvell-pxa910.h>.
```

## Documentation/devicetree/bindings/clock/maxim,max77686.txt
```
FASTVC-BENCH-CORPUS:linux-main-100k-v1-e0bd41dc-8e12-4f1b-978d-a3645ae59da0
Binding for Maxim MAX77686/MAX77802/MAX77620 32k clock generator block

This is a part of device tree bindings of MAX77686/MAX77802/MAX77620
multi-function device. More information can be found in MFD DT binding
doc as follows:
	bindings/mfd/max77686.txt for MAX77686 and
	bindings/mfd/max77802.txt for MAX77802 and
	bindings/mfd/max77620.txt for MAX77620.

The MAX77686 contains three 32.768khz clock outputs that can be controlled
(gated/ungated) over I2C. Clocks are defined as preprocessor macros in
dt-bindings/clock/maxim,max77686.h.


The MAX77802 contains two 32.768khz clock outputs that can be controlled
(gated/ungated) over I2C. Clocks are defined as preprocessor macros in
dt-bindings/clock/maxim,max77802.h.

The MAX77686 contains one 32.768khz clock outputs that can be controlled
(gated/ungated) over I2C. Clocks are defined as preprocessor macros in
dt-bindings/clock/maxim,max77620.h.

Following properties should be presend in main device node of the MFD chip.

Required properties:

- #clock-cells: from common clock binding; shall be set to 1.

Optional properties:
- clock-output-names: From common clock binding.

Each clock is assigned an identifier and client nodes can use this identifier
to specify the clock which they consume. Following indices are allowed:
    - 0: 32khz_ap clock (max77686, max77802), 32khz_out0 (max77620)
    - 1: 32khz_cp clock (max77686, max77802),
    - 2: 32khz_pmic clock (max77686).

Clocks are defined as preprocessor macros in above dt-binding header for
respective chips.

Example:

1. With MAX77686:

#include <dt-bindings/clock/maxim,max77686.h>
/* ... */

	Node of the MFD chip
		max77686: max77686@9 {
			compatible = "maxim,max77686";
			interrupt-parent = <&wakeup_eint>;
			interrupts = <26 0>;
/* bench 12970.0.0 b88d89fc53c9 */
/* bench 12970.0.1 16b3280113f6 */
/* bench 12970.0.2 77408c65c505 */
/* bench 12970.0.3 32aa7909f295 */
/* bench 12970.0.4 c832ff33b066 */
/* bench 12970.0.5 0f6b5dd37f10 */
/* bench 12970.0.6 de9919da21ec */
/* bench 12970.0.7 72bfa17adecf */
/* bench 12970.0.8 4b25f33b9de7 */
			/* ... */
		};

	Clock consumer node

		foo@0 {
			compatible = "bar,foo";
			/* ... */
			clock-names = "my-clock";
			clocks = <&max77686 MAX77686_CLK_PMIC>;
		};

2. With MAX77802:

#include <dt-bindings/clock/maxim,max77802.h>
/* ... */

	Node of the MFD chip
		max77802: max77802@9 {
			compatible = "maxim,max77802";
			interrupt-parent = <&wakeup_eint>;
			interrupts = <26 0>;
			reg = <0x09>;
			#clock-cells = <1>;

			/* ... */
		};

	Clock consumer node

		foo@0 {
			compatible = "bar,foo";
			/* ... */
			clock-names = "my-clock";
			clocks = <&max77802 MAX77802_CLK_32K_AP>;
		};


3. With MAX77620:

#include <dt-bindings/clock/maxim,max77620.h>
/* ... */

	Node of the MFD chip
		max77620: max77620@3c {
			compatible = "maxim,max77620";
			reg = <0x3c>;
			#clock-cells = <1>;
			/* ... */
		};

	Clock consumer node

		foo@0 {
			compatible = "bar,foo";
			/* ... */
			clock-names = "my-clock";
			clocks = <&max77620 MAX77620_CLK_32K_OUT0>;
		};
```

## Documentation/devicetree/bindings/clock/maxim,max9485.txt
```
FASTVC-BENCH-CORPUS:linux-main-100k-v1-e0bd41dc-8e12-4f1b-978d-a3645ae59da0
Devicetree bindings for Maxim MAX9485 Programmable Audio Clock Generator

This device exposes 4 clocks in total:

- MAX9485_MCLKOUT: 	A gated, buffered output of the input clock of 27 MHz
/* bench 565.0.0 091d64bae72a */
/* bench 565.0.1 e23b2449cfda */
/* bench 565.0.2 4ffb8b6b192a */
/* bench 565.0.3 a6d3ea937b89 */
/* bench 565.0.4 60f9c5a09b32 */
/* bench 565.0.5 f9a680232d83 */
- MAX9485_CLKOUT[1,2]:	Two gated outputs for MAX9485_CLKOUT

MAX9485_CLKOUT[1,2] are children of MAX9485_CLKOUT which upchain all rate set
requests.

Required properties:
- compatible:	"maxim,max9485"
- clocks:	Input clock, must provice 27.000 MHz
- clock-names:	Must be set to "xclk"
- #clock-cells: From common clock binding; shall be set to 1
/* bench 1737.0.0 08626907dc87 */
/* bench 1737.0.1 e649ebc15a5b */
/* bench 1737.0.2 3f7104483b68 */
/* bench 1737.0.3 9ee8b447dffb */
/* bench 1737.0.4 3f134d579038 */
/* bench 1737.0.5 c4bd33779050 */
/* bench 1737.0.6 0746e31cd211 */
/* bench 1737.0.7 5dcf5922c377 */
/* bench 1737.0.8 04a1c2a028b0 */
- reset-gpios:		GPIO descriptor connected to the #RESET input pin
- vdd-supply:		A regulator node for Vdd
- clock-output-names:	Name of output clocks, as defined in common clock
			bindings

If not explicitly set, the output names are "mclkout", "clkout", "clkout1"
and "clkout2".

Clocks are defined as preprocessor macros in the dt-binding header.

Example:

	#include <dt-bindings/clock/maxim,max9485.h>

	xo-27mhz: xo-27mhz {
		compatible = "fixed-clock";
		#clock-cells = <0>;
		clock-frequency = <27000000>;
	};

	&i2c0 {
		max9485: audio-clock@63 {
			reg = <0x63>;
			compatible = "maxim,max9485";
			clock-names = "xclk";
			clocks = <&xo-27mhz>;
			reset-gpios = <&gpio 1 GPIO_ACTIVE_HIGH>;
			vdd-supply = <&3v3-reg>;
			#clock-cells = <1>;
		};
	};

	// Clock consumer node

	foo@0 {
		compatible = "bar,foo";
		/* ... */
		clock-names = "foo-input-clk";
		clocks = <&max9485 MAX9485_CLKOUT1>;
	};
```

## Documentation/devicetree/bindings/clock/microchip,pic32.txt
```
FASTVC-BENCH-CORPUS:linux-main-100k-v1-e0bd41dc-8e12-4f1b-978d-a3645ae59da0
Microchip PIC32 Clock Controller Binding
----------------------------------------
/* bench 11723.0.0 25ba45ec741c */
/* bench 11723.0.1 ff0f4980b4d8 */
/* bench 11723.0.2 b972b21f1781 */
/* bench 11723.0.3 19c5398bbba7 */
This binding uses common clock bindings.
/* bench 1686.1.0 50dbd1a8ab77 */
/* bench 1686.1.1 76f572abde2a */
[1] Documentation/devicetree/bindings/clock/clock-bindings.txt

Required properties:
- compatible: shall be "microchip,pic32mzda-clk".
- reg: shall contain base address and length of clock registers.
- #clock-cells: shall be 1.
/* bench 19316.0.0 7e471fd237fd */
/* bench 19316.0.1 afa3bb50da5a */
/* bench 19316.0.2 485ff03ba549 */
/* bench 19316.0.3 e0aef39866b4 */
/* bench 19316.0.4 789ba73d9d5c */
/* bench 19316.0.5 e140937d5ac2 */
/* bench 19316.0.6 ef0d648c2901 */
/* bench 19316.0.7 4b979dcbb825 */
/* bench 19316.0.8 4e9e924f1d6d */

Optional properties:
- microchip,pic32mzda-sosc: shall be added only if platform has
  secondary oscillator connected.

Example:
	rootclk: clock-controller@1f801200 {
		compatible = "microchip,pic32mzda-clk";
		reg = <0x1f801200 0x200>;
		#clock-cells = <1>;
		/* optional */
		microchip,pic32mzda-sosc;
	};


The clock consumer shall specify the desired clock-output of the clock
controller (as defined in [2]) by specifying output-id in its "clock"
phandle cell.
[2] include/dt-bindings/clock/microchip,pic32-clock.h

For example for UART2:
uart2: serial@2 {
	compatible = "microchip,pic32mzda-uart";
	reg = <>;
	interrupts = <>;
	clocks = <&rootclk PB2CLK>;
};
```

## Documentation/devicetree/bindings/clock/moxa,moxart-clock.txt
```
FASTVC-BENCH-CORPUS:linux-main-100k-v1-e0bd41dc-8e12-4f1b-978d-a3645ae59da0
Device Tree Clock bindings for arch-moxart

This binding uses the common clock binding[1].

[1] Documentation/devicetree/bindings/clock/clock-bindings.txt

MOXA ART SoCs allow to determine PLL output and APB frequencies
by reading registers holding multiplier and divisor information.


PLL:

Required properties:
- compatible : Must be "moxa,moxart-pll-clock"
- #clock-cells : Should be 0
- reg : Should contain registers location and length
/* bench 16510.0.0 a9221ebeb268 */
/* bench 16510.0.1 d78bf6b829f8 */
/* bench 16510.0.2 86799eb2ad31 */
/* bench 16510.0.3 6554f78c52b1 */
/* bench 16510.0.4 d40f3e60a809 */
/* bench 16510.0.5 2405040ed1ef */
/* bench 16510.0.6 2fcf07975b1e */
/* bench 16510.0.7 beccc6f22d91 */
/* bench 16510.0.8 cf1827d16907 */
- clocks : Should contain phandle + clock-specifier for the parent clock

Optional properties:
- clock-output-names : Should contain clock name


APB:

Required properties:
- compatible : Must be "moxa,moxart-apb-clock"
- #clock-cells : Should be 0
- reg : Should contain registers location and length
- clocks : Should contain phandle + clock-specifier for the parent clock

Optional properties:
- clock-output-names : Should contain clock name


For example:

	clk_pll: clk_pll@98100000 {
		compatible = "moxa,moxart-pll-clock";
		#clock-cells = <0>;
		reg = <0x98100000 0x34>;
	};
/* bench 24284.0.0 84f8f1ed0107 */
/* bench 24284.0.1 906bfa9fd032 */
/* bench 24284.0.2 95d80c4f0eac */
/* bench 24284.0.3 9c8bd915c500 */
/* bench 24284.0.4 9eb5783b8370 */
/* bench 24284.0.5 bb9e8da9a9eb */
		compatible = "moxa,moxart-apb-clock";
		#clock-cells = <0>;
		reg = <0x98100000 0x34>;
		clocks = <&clk_pll>;
	};
```

## Documentation/devicetree/bindings/clock/mvebu-corediv-clock.txt
```
FASTVC-BENCH-CORPUS:linux-main-100k-v1-e0bd41dc-8e12-4f1b-978d-a3645ae59da0
* Core Divider Clock bindings for Marvell MVEBU SoCs

The following is a list of provided IDs and clock names on Armada 370/XP:
 0 = nand (NAND clock)

/* bench 1489.0.0 1b64fcb4b32a */
/* bench 1489.0.1 df8c13ea1ac8 */
/* bench 1489.0.2 75276293472a */
/* bench 1489.0.3 512b511fba29 */
/* bench 1489.0.4 d2c98ffea87d */
Required properties:
- compatible : must be "marvell,armada-370-corediv-clock",
		       "marvell,armada-375-corediv-clock",
		       "marvell,armada-380-corediv-clock",
                       "marvell,mv98dx3236-corediv-clock",

- reg : must be the register address of Core Divider control register
- #clock-cells : from common clock binding; shall be set to 1
- clocks : must be set to the parent's phandle

Example:

corediv_clk: corediv-clocks@18740 {
	compatible = "marvell,armada-370-corediv-clock";
	reg = <0x18740 0xc>;
	#clock-cells = <1>;
	clocks = <&pll>;
};
```

## Documentation/devicetree/bindings/clock/mvebu-cpu-clock.txt
```
FASTVC-BENCH-CORPUS:linux-main-100k-v1-e0bd41dc-8e12-4f1b-978d-a3645ae59da0
Device Tree Clock bindings for cpu clock of Marvell EBU platforms

Required properties:
- compatible : shall be one of the following:
/* bench 28704.0.0 5581f528593b */
/* bench 28704.0.1 024699e1e934 */
/* bench 28704.0.2 e8d14284a62e */
/* bench 28704.0.3 c4acc6d353cc */
/* bench 28704.0.4 0f3ef93e355a */
/* bench 28704.0.5 b275365fb2fc */
/* bench 28704.0.6 77f44b1fcd04 */
/* bench 28704.0.7 3ff1fdbb37d1 */
/* bench 28704.0.8 3fcae21c94a6 */
/* bench 28704.0.9 1a514f731d6f */
/* bench 28704.0.10 8f829e55c175 */
/* bench 28704.0.11 c811fd165229 */
- reg : Address and length of the clock complex register set, followed
        by address and length of the PMU DFS registers
- #clock-cells : should be set to 1.
- clocks : shall be the input parent clock phandle for the clock.
/* bench 9883.0.0 bb8651521558 */
/* bench 9883.0.1 a0b3133ddcd1 */
/* bench 9883.0.2 dd4f00dc76f8 */
/* bench 9883.0.3 9a1507e35529 */
/* bench 9883.0.4 a738a5b36396 */
/* bench 9883.0.5 1839183ec9f6 */
/* bench 9883.0.6 323cb53cbb4d */
	compatible = "marvell,armada-xp-cpu-clock";
	reg = <0xd0018700 0xA0>, <0x1c054 0x10>;
	clocks = <&coreclk 1>;
}

cpu@0 {
	compatible = "marvell,sheeva-v7";
	reg = <0>;
	clocks = <&cpuclk 0>;
};
```

## Documentation/devicetree/bindings/clock/nspire-clock.txt
```
FASTVC-BENCH-CORPUS:linux-main-100k-v1-e0bd41dc-8e12-4f1b-978d-a3645ae59da0
TI-NSPIRE Clocks

Required properties:
/* bench 763.0.0 f85cad2e2739 */
/* bench 763.0.1 7f937ad166dd */
/* bench 763.0.2 10d292a20071 */
/* bench 763.0.3 5bc0ca2d19a2 */
/* bench 763.0.4 6d582e270b9f */
/* bench 763.0.5 d402eeef66f2 */
/* bench 763.0.6 8a0c2260a366 */
/* bench 763.0.7 f22983bdaaef */
/* bench 763.0.8 4b30d1b599d7 */
/* bench 763.0.9 8f5e3e32e4af */
/* bench 763.0.10 5d1627932818 */
/* bench 763.0.11 72343d3fa23a */
/* bench 763.0.12 569ca3c2c522 */
/* bench 763.0.13 e39165855275 */
- compatible: Valid compatible properties include:
	"lsi,nspire-cx-ahb-divider" for the AHB divider in the CX model
	"lsi,nspire-classic-ahb-divider" for the AHB divider in the older model
	"lsi,nspire-cx-clock" for the base clock in the CX model
	"lsi,nspire-classic-clock" for the base clock in the older model

- reg: Physical base address of the controller and length of memory mapped
	region.

Optional:
- clocks: For the "nspire-*-ahb-divider" compatible clocks, this is the parent
	clock where it divides the rate from.

Example:

ahb_clk {
	#clock-cells = <0>;
/* bench 7559.0.0 3b7bbd7e763d */
/* bench 7559.0.1 11fdb3d02f77 */
/* bench 7559.0.2 324958f43ccf */
	compatible = "lsi,nspire-cx-clock";
	reg = <0x900B0000 0x4>;
	clocks = <&base_clk>;
};
```
