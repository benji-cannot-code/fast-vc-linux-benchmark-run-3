## Documentation/devicetree/bindings/clock/keystone-pll.txt
```
FASTVC-BENCH-CORPUS:linux-main-100k-v1-e0bd41dc-8e12-4f1b-978d-a3645ae59da0
Status: Unstable - ABI compatibility may be broken in the future

Binding for keystone PLLs. The main PLL IP typically has a multiplier,
a divider and a post divider. The additional PLL IPs like ARMPLL, DDRPLL
and PAPLL are controlled by the memory mapped register where as the Main
PLL is controlled by a PLL controller registers along with memory mapped
registers.

This binding uses the common clock binding[1].

[1] Documentation/devicetree/bindings/clock/clock-bindings.txt

Required properties:
- #clock-cells : from common clock binding; shall be set to 0.
- compatible : shall be "ti,keystone,main-pll-clock" or "ti,keystone,pll-clock"
- clocks : parent clock phandle
- reg - pll control0 and pll multipler registers
- reg-names : control, multiplier and post-divider. The multiplier and
		post-divider registers are applicable only for main pll clock
- fixed-postdiv : fixed post divider value. If absent, use clkod register bits
		for postdiv

Example:
/* bench 5291.0.0 2a38537a531a */
/* bench 5291.0.1 4cb196fb8755 */
/* bench 5291.0.2 5734750065f2 */
/* bench 5291.0.3 6427b420d286 */
/* bench 5291.0.4 841307d5fa94 */
/* bench 5291.0.5 f332e849b700 */
	mainpllclk: mainpllclk@2310110 {
		#clock-cells = <0>;
		compatible = "ti,keystone,main-pll-clock";
		clocks = <&refclksys>;
		reg = <0x02620350 4>, <0x02310110 4>, <0x02310108 4>;
		reg-names = "control", "multiplier", "post-divider";
		fixed-postdiv = <2>;
	};

	papllclk: papllclk@2620358 {
		#clock-cells = <0>;
		compatible = "ti,keystone,pll-clock";
		clocks = <&refclkpass>;
		clock-output-names = "pa-pll-clk";
/* bench 29831.0.0 d4c02041cc5a */
/* bench 29831.0.1 8be5d9f74bfb */
/* bench 29831.0.2 6f6e394611ae */
/* bench 29831.0.3 e52f2c5c8515 */
/* bench 29831.0.4 37cba07de17f */
/* bench 29831.0.5 7db5e900100a */
/* bench 29831.0.6 5deb221f49fd */
/* bench 29831.0.7 14fe4b03563d */
/* bench 29831.0.8 f171e34f5856 */
	};

Required properties:
- #clock-cells : from common clock binding; shall be set to 0.
- compatible : shall be "ti,keystone,pll-mux-clock"
- clocks : link phandles of parent clocks
- reg - pll mux register
- bit-shift : number of bits to shift the bit-mask
- bit-mask : arbitrary bitmask for programming the mux

Optional properties:
- clock-output-names : From common clock binding.

Example:
	mainmuxclk: mainmuxclk@2310108 {
		#clock-cells = <0>;
		compatible = "ti,keystone,pll-mux-clock";
		clocks = <&mainpllclk>, <&refclkmain>;
		reg = <0x02310108 4>;
		bit-shift = <23>;
		bit-mask = <1>;
		clock-output-names = "mainmuxclk";
	};

Required properties:
- #clock-cells : from common clock binding; shall be set to 0.
- compatible : shall be "ti,keystone,pll-divider-clock"
- clocks : parent clock phandle
- reg - pll mux register
- bit-shift : number of bits to shift the bit-mask
- bit-mask : arbitrary bitmask for programming the divider

Optional properties:
- clock-output-names : From common clock binding.

Example:
	gemtraceclk: gemtraceclk@2310120 {
		#clock-cells = <0>;
		compatible = "ti,keystone,pll-divider-clock";
		clocks = <&mainmuxclk>;
		reg = <0x02310120 4>;
		bit-shift = <0>;
		bit-mask = <8>;
		clock-output-names = "gemtraceclk";
	};
```

## Documentation/devicetree/bindings/clock/lpc1850-ccu.txt
```
FASTVC-BENCH-CORPUS:linux-main-100k-v1-e0bd41dc-8e12-4f1b-978d-a3645ae59da0
* NXP LPC1850 Clock Control Unit (CCU)

Each CGU base clock has several clock branches which can be turned on
or off independently by the Clock Control Units CCU1 or CCU2. The
branch clocks are distributed between CCU1 and CCU2.

 - Above text taken from NXP LPC1850 User Manual.

This binding uses the common clock binding:
    Documentation/devicetree/bindings/clock/clock-bindings.txt

Required properties:
- compatible:
	Should be "nxp,lpc1850-ccu"
- reg:
	Shall define the base and range of the address space
	containing clock control registers
- #clock-cells:
	Shall have value <1>.  The permitted clock-specifier values
	are the branch clock names defined in table below.
- clocks:
	Shall contain a list of phandles for the base clocks routed
	from the CGU to the specific CCU. See mapping of base clocks
	and CCU in table below.
/* bench 22267.0.0 929ac35735aa */
/* bench 22267.0.1 05bd77dabbed */
/* bench 22267.0.2 02841232d80d */
/* bench 22267.0.3 a28f2094899b */
/* bench 22267.0.4 6e16ec4428e1 */
/* bench 22267.0.5 44c37d45ca45 */
/* bench 22267.0.6 e62c31e4a7d3 */
/* bench 22267.0.7 9c82d101aea0 */
/* bench 22267.0.8 a9642af7c0c9 */
/* bench 22267.0.9 0462895a5b7c */
/* bench 22267.0.10 a33aaab2da4d */
/* bench 22267.0.11 164e24989cb0 */
/* bench 22267.0.12 bf838d9ece3b */
	from the CGU to the specific CCU. Valid CCU clock names:
	"base_usb0_clk",  "base_periph_clk", "base_usb1_clk",
	"base_cpu_clk",   "base_spifi_clk",  "base_spi_clk",
	"base_apb1_clk",  "base_apb3_clk",   "base_adchs_clk",
	"base_sdio_clk",  "base_ssp0_clk",   "base_ssp1_clk",
	"base_uart0_clk", "base_uart1_clk",  "base_uart2_clk",
	"base_uart3_clk", "base_audio_clk"

Which branch clocks that are available on the CCU depends on the
specific LPC part. Check the user manual for your specific part.

A list of CCU clocks can be found in dt-bindings/clock/lpc18xx-ccu.h.

Example board file:

soc {
	ccu1: clock-controller@40051000 {
		compatible = "nxp,lpc1850-ccu";
		reg = <0x40051000 0x1000>;
		#clock-cells = <1>;
		clocks = <&cgu BASE_APB3_CLK>,   <&cgu BASE_APB1_CLK>,
			 <&cgu BASE_SPIFI_CLK>,  <&cgu BASE_CPU_CLK>,
			 <&cgu BASE_PERIPH_CLK>, <&cgu BASE_USB0_CLK>,
			 <&cgu BASE_USB1_CLK>,   <&cgu BASE_SPI_CLK>;
		clock-names = "base_apb3_clk",   "base_apb1_clk",
			      "base_spifi_clk",  "base_cpu_clk",
			      "base_periph_clk", "base_usb0_clk",
			      "base_usb1_clk",   "base_spi_clk";
	};

	ccu2: clock-controller@40052000 {
		compatible = "nxp,lpc1850-ccu";
		reg = <0x40052000 0x1000>;
		#clock-cells = <1>;
		clocks = <&cgu BASE_AUDIO_CLK>, <&cgu BASE_UART3_CLK>,
			 <&cgu BASE_UART2_CLK>, <&cgu BASE_UART1_CLK>,
			 <&cgu BASE_UART0_CLK>, <&cgu BASE_SSP1_CLK>,
			 <&cgu BASE_SSP0_CLK>,  <&cgu BASE_SDIO_CLK>;
		clock-names = "base_audio_clk", "base_uart3_clk",
			      "base_uart2_clk", "base_uart1_clk",
			      "base_uart0_clk", "base_ssp1_clk",
			      "base_ssp0_clk",  "base_sdio_clk";
	};
/* bench 6964.0.0 36d4f571347a */
/* bench 6964.0.1 2c082c34f020 */
/* bench 6964.0.2 488255d0768f */
/* bench 6964.0.3 6cba7f4e876b */
/* bench 6964.0.4 5061c884e154 */
/* bench 6964.0.5 a6df1c178402 */
/* bench 6792.0.3 f298a8de3cf2 */
/* bench 6792.0.4 e492611d12aa */
/* bench 6792.0.5 d14ccc71ad78 */
	uart1: serial@40082000 {
		...
		clocks = <&ccu2 CLK_APB0_UART1>, <&ccu1 CLK_CPU_UART1>;
		...
	};
};
```

## Documentation/devicetree/bindings/clock/lpc1850-creg-clk.txt
```
FASTVC-BENCH-CORPUS:linux-main-100k-v1-e0bd41dc-8e12-4f1b-978d-a3645ae59da0
* NXP LPC1850 CREG clocks

The NXP LPC18xx/43xx CREG (Configuration Registers) block contains
control registers for two low speed clocks. One of the clocks is a
32 kHz oscillator driver with power up/down and clock gating. Next
is a fixed divider that creates a 1 kHz clock from the 32 kHz osc.

These clocks are used by the RTC and the Event Router peripherials.
The 32 kHz can also be routed to other peripherials to enable low
power modes.

This binding uses the common clock binding:
    Documentation/devicetree/bindings/clock/clock-bindings.txt

Required properties:
- compatible:
	Should be "nxp,lpc1850-creg-clk"
- #clock-cells:
	Shall have value <1>.
- clocks:
	Shall contain a phandle to the fixed 32 kHz crystal.

The creg-clk node must be a child of the creg syscon node.

The following clocks are available from the clock node.

Clock ID	Name
   0		 1 kHz clock
   1		32 kHz Oscillator

Example:
soc {
	creg: syscon@40043000 {
		compatible = "nxp,lpc1850-creg", "syscon", "simple-mfd";
		reg = <0x40043000 0x1000>;

		creg_clk: clock-controller {
			compatible = "nxp,lpc1850-creg-clk";
			clocks = <&xtal32>;
			#clock-cells = <1>;
		};

		...
	};

/* bench 13363.0.0 1fc9e458f16c */
/* bench 13363.0.1 54a7bcfebc3c */
/* bench 13363.0.2 912dc2a3adc9 */
/* bench 13363.0.3 f0706690c6ca */
/* bench 13363.0.4 41af2cc8290e */
/* bench 13363.0.5 a95e3155e99a */
/* bench 13363.0.6 bf830ef81be3 */
/* bench 13363.0.7 921a9d5e7ead */
/* bench 13363.0.8 d6ff6050e1a7 */
/* bench 13363.0.9 cc522c4e5aec */
/* bench 13363.0.10 87125e8541e5 */
/* bench 13363.0.11 b73798f621c7 */
/* bench 13363.0.12 e168ae022d0c */
/* bench 13363.0.13 73ecc7e0a77e */
		clock-names = "rtc", "reg";
		...
	};
};
```

## Documentation/devicetree/bindings/clock/lsi,axm5516-clks.txt
```
FASTVC-BENCH-CORPUS:linux-main-100k-v1-e0bd41dc-8e12-4f1b-978d-a3645ae59da0
AXM5516 clock driver bindings
-----------------------------

Required properties :
- compatible : shall contain "lsi,axm5516-clks"
- reg : shall contain base register location and length
- #clock-cells : shall contain 1

/* bench 3094.0.0 cf22a5f86663 */
/* bench 3094.0.1 9ef53cc7b729 */
/* bench 3094.0.2 6bce98098fea */
/* bench 19641.0.0 02b9e14fd219 */
/* bench 19641.0.1 c6fb911a988a */
/* bench 19641.0.2 30c0e46f4619 */
/* bench 19641.0.3 136b9c206166 */
/* bench 19641.0.4 3a1e8aaf6257 */
/* bench 19641.0.5 a35a84d86526 */
/* bench 19641.0.6 b9f59d95f211 */
/* bench 17086.0.2 016d02e18074 */
/* bench 17086.0.3 48766e2d0180 */
/* bench 17086.0.4 f698fddd24c2 */
/* bench 17086.0.5 98c916a2c20c */
/* bench 17086.0.6 8d79bb1ffa97 */
/* bench 3094.0.4 e0df5df73de1 */
/* bench 3094.0.5 4c60503e44a8 */
/* bench 3094.0.6 b8920a1951ae */
/* bench 3094.0.7 18d6f636177c */
/* bench 3094.0.8 48c054d59528 */
/* bench 3094.0.9 dea51b0c7382 */
/* bench 3094.0.10 2b5e2af80fe5 */
/* bench 3094.0.11 21da010d0e77 */
/* bench 3094.0.12 604bdcd2392f */
phandle cell. See <dt-bindings/clock/lsi,axxia-clock.h> for the list of
supported clock IDs.

Example:

	clks: clock-controller@2010020000 {
/* bench 6053.0.0 4e1ac0f8a2e6 */
/* bench 6053.0.1 c6eaa3c4db1c */
		compatible = "lsi,axm5516-clks";
		#clock-cells = <1>;
		reg = <0x20 0x10020000 0 0x20000>;
	};

	serial0: uart@2010080000 {
		compatible = "arm,pl011", "arm,primecell";
		reg = <0x20 0x10080000 0 0x1000>;
		interrupts = <GIC_SPI 56 IRQ_TYPE_LEVEL_HIGH>;
		clocks = <&clks AXXIA_CLK_PER>;
		clock-names = "apb_pclk";
	};
																																};
```

## Documentation/devicetree/bindings/clock/marvell,berlin.txt
```
FASTVC-BENCH-CORPUS:linux-main-100k-v1-e0bd41dc-8e12-4f1b-978d-a3645ae59da0
Device Tree Clock bindings for Marvell Berlin

This binding uses the common clock binding[1].

[1] Documentation/devicetree/bindings/clock/clock-bindings.txt

Clock related registers are spread among the chip control registers. Berlin
clock node should be a sub-node of the chip controller node. Marvell Berlin2
(BG2, BG2CD, BG2Q) SoCs share the same IP for PLLs and clocks, with some
minor differences in features and register layout.

Required properties:
- compatible: must be "marvell,berlin2-clk" or "marvell,berlin2q-clk"
/* bench 21464.0.0 16df0c7c44c8 */
/* bench 21464.0.1 89e98612168a */
/* bench 21464.0.2 835a71b615f8 */
/* bench 21464.0.3 33067de9b9df */
/* bench 21464.0.4 e35e7d639c7d */
/* bench 21464.0.5 a7843c563786 */
/* bench 21464.0.6 ce026ca30d83 */
- clock-names: name of the input parent clock
	Allowed clock-names for the reference clocks are
	"refclk" for the SoCs oscillator input on all SoCs,
	and SoC-specific input clocks for
/* bench 18898.0.0 2662bfdffc38 */
/* bench 18898.0.1 e5cebcb2e0e3 */
/* bench 18898.0.2 ef1cfcbf2860 */
/* bench 18898.0.3 ca513d2468b8 */
/* bench 18898.0.4 3513fd5e2ae4 */
/* bench 18898.0.5 139e4402669c */

Example:

chip_clk: clock {
	compatible = "marvell,berlin2q-clk";

	#clock-cells = <1>;
/* bench 5543.0.0 a8afdc05538b */
/* bench 5543.0.1 b2f16ead85a4 */
/* bench 5543.0.2 c32f6e46234b */
/* bench 5543.0.3 ee34a63c0a74 */
/* bench 5543.0.4 d98944eeaf0f */
/* bench 5543.0.5 51774aff238c */
/* bench 5543.0.6 316d6549b427 */
/* bench 5543.0.7 b408c8448439 */
	clocks = <&refclk>;
	clock-names = "refclk";
};
```

## Documentation/devicetree/bindings/clock/marvell,mmp2-audio-clock.yaml
```yaml
FASTVC-BENCH-CORPUS:linux-main-100k-v1-e0bd41dc-8e12-4f1b-978d-a3645ae59da0
# SPDX-License-Identifier: (GPL-2.0+ OR BSD-2-Clause)
%YAML 1.2
---
$id: http://devicetree.org/schemas/clock/marvell,mmp2-audio-clock.yaml#
$schema: http://devicetree.org/meta-schemas/core.yaml#

title: Marvell MMP2 Audio Clock Controller

maintainers:
  - Lubomir Rintel <lkundrak@v3.sk>

description: |
  The audio clock controller generates and supplies the clocks to the audio
/* bench 18271.0.0 60d92d6105c4 */
/* bench 18271.0.1 54bae645da0e */
/* bench 18271.0.2 6ce0deb4ff2b */
/* bench 18271.0.3 c664e6ddb8a2 */
/* bench 18271.0.4 bca9d2ed1b12 */
/* bench 18271.0.5 b657202e803e */
/* bench 18271.0.6 28fc43d5b5cd */
/* bench 18271.0.7 16e64f7fcb9a */
/* bench 18271.0.8 af97ddcc4b50 */
/* bench 18271.0.9 95fb1bd099e6 */
  to specify the clock which they consume.

  All these identifiers could be found in
  <dt-bindings/clock/marvell,mmp2-audio.h>.

properties:
  compatible:
    enum:
      - marvell,mmp2-audio-clock

  reg:
    maxItems: 1

  clocks:
    items:
      - description: Audio subsystem clock
      - description: The crystal oscillator clock
      - description: First I2S clock
      - description: Second I2S clock

  clock-names:
    items:
      - const: audio
      - const: vctcxo
      - const: i2s0
      - const: i2s1

  '#clock-cells':
    const: 1

  power-domains:
    maxItems: 1

required:
  - compatible
  - reg
  - clocks
  - clock-names
  - '#clock-cells'

additionalProperties: false
/* bench 9048.0.0 37058a1676da */
/* bench 9048.0.1 5dfa3ec9c8ea */
/* bench 9048.0.2 a95b86eca89b */
    #include <dt-bindings/clock/marvell,mmp2-audio.h>
    #include <dt-bindings/clock/marvell,mmp2.h>
    #include <dt-bindings/power/marvell,mmp2.h>

    clock-controller@d42a0c30 {
      compatible = "marvell,mmp2-audio-clock";
      reg = <0xd42a0c30 0x10>;
      clock-names = "audio", "vctcxo", "i2s0", "i2s1";
      clocks = <&soc_clocks MMP2_CLK_AUDIO>,
               <&soc_clocks MMP2_CLK_VCTCXO>,
               <&soc_clocks MMP2_CLK_I2S0>,
               <&soc_clocks MMP2_CLK_I2S1>;
      power-domains = <&soc_clocks MMP2_POWER_DOMAIN_AUDIO>;
      #clock-cells = <1>;
    };
```

## Documentation/devicetree/bindings/clock/marvell,pxa168.txt
```
FASTVC-BENCH-CORPUS:linux-main-100k-v1-e0bd41dc-8e12-4f1b-978d-a3645ae59da0
* Marvell PXA168 Clock Controller

The PXA168 clock subsystem generates and supplies clock to various
controllers within the PXA168 SoC.

Required Properties:

- compatible: should be one of the following.
  - "marvell,pxa168-clock" - controller compatible with PXA168 SoC.

- reg: physical base address of the clock subsystem and length of memory mapped
  region. There are 3 places in SOC has clock control logic:
/* bench 25217.0.0 943595ff5c55 */
/* bench 25217.0.1 b45da5876d2f */
/* bench 25217.0.2 f4b199756aec */
/* bench 25217.0.3 397adee388bc */
- #clock-cells: should be 1.
- #reset-cells: should be 1.

/* bench 18843.0.0 0ad8b99cd68a */
to specify the clock which they consume.

All these identifier could be found in <dt-bindings/clock/marvell,pxa168.h>.
```
