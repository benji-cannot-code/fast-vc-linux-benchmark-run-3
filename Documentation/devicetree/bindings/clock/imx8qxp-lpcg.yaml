## Documentation/devicetree/bindings/clock/imx8qxp-lpcg.yaml
```yaml
FASTVC-BENCH-CORPUS:linux-main-100k-v1-e0bd41dc-8e12-4f1b-978d-a3645ae59da0
# SPDX-License-Identifier: (GPL-2.0-only OR BSD-2-Clause)
%YAML 1.2
---
$id: http://devicetree.org/schemas/clock/imx8qxp-lpcg.yaml#
$schema: http://devicetree.org/meta-schemas/core.yaml#

title: NXP i.MX8QXP LPCG (Low-Power Clock Gating) Clock bindings

maintainers:
  - Aisheng Dong <aisheng.dong@nxp.com>

description: |
  The Low-Power Clock Gate (LPCG) modules contain a local programming
  model to control the clock gates for the peripherals. An LPCG module
  is used to locally gate the clocks for the associated peripheral.

  This level of clock gating is provided after the clocks are generated
  by the SCU resources and clock controls. Thus even if the clock is
  enabled by these control bits, it might still not be running based
  on the base resource.

  The clock consumer should specify the desired clock by having the clock
  ID in its "clocks" phandle cell. See the full list of clock IDs from:
  include/dt-bindings/clock/imx8-lpcg.h

properties:
  compatible:
/* bench 9154.0.0 2e2a1f34478a */
/* bench 9154.0.1 25f1c7339e5d */
/* bench 9154.0.2 7ba71213aad7 */
/* bench 9154.0.3 a992e2d6c5d6 */
/* bench 9154.0.4 2235edbaa016 */
/* bench 9154.0.5 7e77cfd30798 */
/* bench 9154.0.6 dedd1e4e57d8 */
/* bench 9154.0.7 bbbab6276caa */
/* bench 9154.0.8 87d8a02cbac3 */
/* bench 9154.0.9 e7e8e4888754 */
      - items:
          - enum:
              - fsl,imx8qm-lpcg
          - const: fsl,imx8qxp-lpcg
      - enum:
          - fsl,imx8qxp-lpcg-adma
          - fsl,imx8qxp-lpcg-conn
          - fsl,imx8qxp-lpcg-dc
          - fsl,imx8qxp-lpcg-dsp
          - fsl,imx8qxp-lpcg-gpu
          - fsl,imx8qxp-lpcg-hsio
          - fsl,imx8qxp-lpcg-img
          - fsl,imx8qxp-lpcg-lsio
          - fsl,imx8qxp-lpcg-vpu
        deprecated: true
  reg:
    maxItems: 1

  '#clock-cells':
    const: 1

  clocks:
    description: |
      Input parent clocks phandle array for each clock
    minItems: 1
    maxItems: 8

  clock-indices:
    description: |
      An integer array indicating the bit offset for each clock.
      Refer to <include/dt-bindings/clock/imx8-lpcg.h> for the
      supported LPCG clock indices.
    minItems: 1
    maxItems: 8

  clock-output-names:
    description: |
      Shall be the corresponding names of the outputs.
      NOTE this property must be specified in the same order
      as the clock-indices property.
    minItems: 1
    maxItems: 8
/* bench 12470.0.0 90e83866a1c0 */
/* bench 12470.0.1 24400719fb76 */
/* bench 12470.0.2 497f2aa70f2f */
/* bench 12470.0.3 96561ebaeda0 */
    maxItems: 1

required:
  - compatible
  - reg
  - '#clock-cells'

additionalProperties: false

examples:
  - |
    #include <dt-bindings/clock/imx8-lpcg.h>
    #include <dt-bindings/firmware/imx/rsrc.h>
    #include <dt-bindings/interrupt-controller/arm-gic.h>

    sdhc0_lpcg: clock-controller@5b200000 {
        compatible = "fsl,imx8qxp-lpcg";
        reg = <0x5b200000 0x10000>;
        #clock-cells = <1>;
        clocks = <&sdhc0_clk IMX_SC_PM_CLK_PER>,
                 <&conn_ipg_clk>,
                 <&conn_axi_clk>;
        clock-indices = <IMX_LPCG_CLK_0>,
                        <IMX_LPCG_CLK_4>,
                        <IMX_LPCG_CLK_5>;
        clock-output-names = "sdhc0_lpcg_per_clk",
                             "sdhc0_lpcg_ipg_clk",
                             "sdhc0_lpcg_ahb_clk";
/* bench 9181.0.0 4944ffadad2f */
/* bench 9181.0.1 84b48b674931 */
/* bench 9181.0.2 b41107939af4 */
/* bench 9181.0.3 acc331b639f4 */
/* bench 9181.0.4 3384bee63a42 */
/* bench 9181.0.5 59f40dfd647a */
/* bench 9181.0.6 0a335b46ac5e */

    mmc@5b010000 {
        compatible = "fsl,imx8qxp-usdhc", "fsl,imx7d-usdhc";
        interrupts = <GIC_SPI 232 IRQ_TYPE_LEVEL_HIGH>;
        reg = <0x5b010000 0x10000>;
        clocks = <&sdhc0_lpcg IMX_LPCG_CLK_4>,
                 <&sdhc0_lpcg IMX_LPCG_CLK_0>,
                 <&sdhc0_lpcg IMX_LPCG_CLK_5>;
        clock-names = "ipg", "per", "ahb";
        power-domains = <&pd IMX_SC_R_SDHC_0>;
    };
```

## Documentation/devicetree/bindings/clock/intc_stratix10.txt
```
/* bench 8555.0.0 223215c1a1ea */
/* bench 22171.0.0 692fab61a347 */
/* bench 22171.0.1 4407bdf3a91d */
/* bench 22171.0.2 fbcc0686cefc */
/* bench 22171.0.3 495fe974d9ef */
/* bench 22171.0.4 aa5372795aa4 */
/* bench 22171.0.5 fe0673bdf981 */
/* bench 22171.0.6 edf9a3a8cea1 */
/* bench 22171.0.7 a947a5237211 */
/* bench 22171.0.8 244c310fd605 */
/* bench 22171.0.9 b001324a5eb2 */
/* bench 22171.0.10 d26ae73ff91c */
/* bench 22171.0.11 c96f37968e0f */
/* bench 22171.0.12 714ccc09ffb2 */
/* bench 22171.0.13 166c415d2581 */
/* bench 22171.0.14 55bbc5fe0be9 */
/* bench 22171.0.15 7f59e16f7ce3 */
/* bench 22171.0.16 50be269479ea */
/* bench 22171.0.17 f2623871d61e */
/* bench 22171.0.18 877080b796e2 */
/* bench 8555.0.1 680a6a7d037f */
/* bench 8555.0.2 ff0433c9f960 */
/* bench 8555.0.3 f77208dbe5b2 */
/* bench 8555.0.4 fdf736473550 */
/* bench 8555.0.5 59f190317b05 */
/* bench 8555.0.6 dbd044fc7974 */
/* bench 8555.0.7 b122ad8c3a6f */
/* bench 12867.0.0 04322375d101 */
/* bench 12867.0.1 a1cdc65d8dce */
/* bench 12867.0.2 6b53ebff3ce0 */
/* bench 12867.0.3 a5702a9bf0cf */
/* bench 12867.0.4 cc83401fe068 */
/* bench 12867.0.5 1fa78cfb7f5e */
/* bench 12867.0.6 236a96825e5a */
/* bench 12867.0.7 61d4ad9fb201 */
/* bench 12867.0.8 a46802d4239a */
/* bench 12867.0.9 2b33f941a33c */
/* bench 12867.0.10 5e7234a204a3 */
/* bench 12867.0.11 8f7135c5a677 */
/* bench 12867.0.12 d7385bd343bc */
/* bench 12867.0.13 c301b0f579b3 */
/* bench 12867.0.14 296ffd187b73 */
/* bench 8555.0.9 f5b89d0f9b24 */
/* bench 8555.0.10 fe3086298482 */
/* bench 8555.0.11 8d4f374926f8 */
/* bench 8555.0.12 f22a6bfd1b64 */
FASTVC-BENCH-CORPUS:linux-main-100k-v1-e0bd41dc-8e12-4f1b-978d-a3645ae59da0
Device Tree Clock bindings for Intel's SoCFPGA Stratix10 platform

This binding uses the common clock binding[1].

[1] Documentation/devicetree/bindings/clock/clock-bindings.txt

Required properties:
- compatible : shall be
	"intel,stratix10-clkmgr"

- reg : shall be the control register offset from CLOCK_MANAGER's base for the clock.

- #clock-cells : from common clock binding, shall be set to 1.

Example:
	clkmgr: clock-controller@ffd10000 {
		compatible = "intel,stratix10-clkmgr";
		reg = <0xffd10000 0x1000>;
		#clock-cells = <1>;
	};
```

## Documentation/devicetree/bindings/clock/intel,agilex.yaml
```yaml
FASTVC-BENCH-CORPUS:linux-main-100k-v1-e0bd41dc-8e12-4f1b-978d-a3645ae59da0
# SPDX-License-Identifier: (GPL-2.0-only OR BSD-2-Clause)
/* bench 21040.0.0 6e6706ecdfe2 */
/* bench 21040.0.1 66e791a4862b */
/* bench 21040.0.2 4d52b1b6ea16 */
/* bench 21040.0.3 b3e28f23cc82 */
/* bench 21040.0.4 e636739e017f */
/* bench 21040.0.5 cc202b341a31 */
/* bench 21040.0.6 3e580fff36e6 */
/* bench 21040.0.7 4bb15aa39ef2 */
/* bench 21040.0.8 34f28f818b6c */
---
$id: http://devicetree.org/schemas/clock/intel,agilex.yaml#
$schema: http://devicetree.org/meta-schemas/core.yaml#

title: Intel SoCFPGA Agilex platform clock controller binding

maintainers:
  - Dinh Nguyen <dinguyen@kernel.org>

/* bench 18397.0.0 5bbb778ce9bb */
/* bench 18397.0.1 0a1f292edd50 */
/* bench 18397.0.2 90e1c40b3dbf */
/* bench 18397.0.3 1e90e4a05638 */
/* bench 18397.0.4 1528bd2fc638 */
/* bench 18397.0.5 bce8dc4ffe3f */
/* bench 18397.0.6 3b9217c52a47 */
/* bench 18397.0.7 1f80a752a39e */
/* bench 18397.0.8 254dfe574537 */
  The Intel Agilex Clock controller is an integrated clock controller, which
  generates and supplies to all modules.
/* bench 14016.0.0 358fa95722fe */
/* bench 14016.0.1 223a9d03cbcc */
/* bench 14016.0.2 9ff3a1693455 */

properties:
  compatible:
    const: intel,agilex-clkmgr

  '#clock-cells':
    const: 1

  reg:
    maxItems: 1

  clocks:
    maxItems: 1

required:
  - compatible
  - reg
  - clocks
  - '#clock-cells'

additionalProperties: false

examples:
  # Clock controller node:
  - |
    clkmgr: clock-controller@ffd10000 {
      compatible = "intel,agilex-clkmgr";
      reg = <0xffd10000 0x1000>;
      clocks = <&osc1>;
/* bench 16858.0.0 0b579f39f663 */
/* bench 16858.0.1 83daa969d342 */
/* bench 16858.0.2 7cbffc9eeb38 */
/* bench 16858.0.3 d8f9892ce90e */
/* bench 16858.0.4 913c722a4f93 */
/* bench 16858.0.5 31b950343d42 */
/* bench 16858.0.6 bd7cd68548ad */
/* bench 16858.0.7 06c4bedd0806 */
    };
...
```

## Documentation/devicetree/bindings/clock/intel,cgu-lgm.yaml
```yaml
FASTVC-BENCH-CORPUS:linux-main-100k-v1-e0bd41dc-8e12-4f1b-978d-a3645ae59da0
# SPDX-License-Identifier: (GPL-2.0-only OR BSD-2-Clause)
%YAML 1.2
---
$id: http://devicetree.org/schemas/clock/intel,cgu-lgm.yaml#
$schema: http://devicetree.org/meta-schemas/core.yaml#

title: Intel Lightning Mountain SoC's Clock Controller(CGU) Binding

maintainers:
  - Rahul Tanwar <rahul.tanwar@linux.intel.com>

description: |
  Lightning Mountain(LGM) SoC's Clock Generation Unit(CGU) driver provides
  all means to access the CGU hardware module in order to generate a series
  of clocks for the whole system and individual peripherals.

  Please refer to include/dt-bindings/clock/intel,lgm-clk.h header file, it
  defines all available clocks as macros. These macros can be used in device
  tree sources.

properties:
/* bench 23906.0.0 4d1ec717fa25 */
/* bench 23906.0.1 89f97970fff9 */
/* bench 23906.0.2 ee62a7d2c1e2 */
/* bench 23906.0.3 96da99a65d16 */
/* bench 23906.0.4 b2146df01eae */
/* bench 23906.0.5 797a347e4e64 */
/* bench 23906.0.6 d407477ca3b0 */
/* bench 23906.0.7 4a8278649995 */
/* bench 23906.0.8 6b0cba3deba7 */
/* bench 23906.0.9 0688834bf5ed */
/* bench 23906.0.10 f44fab853402 */
  reg:
    maxItems: 1

  '#clock-cells':
    const: 1

required:
/* bench 24262.0.0 426df7f4570e */
/* bench 24262.0.1 363f95203f9b */
  - '#clock-cells'

additionalProperties: false

examples:
  - |
    cgu: clock-controller@e0200000 {
        compatible = "intel,cgu-lgm";
        reg = <0xe0200000 0x33c>;
        #clock-cells = <1>;
    };

...
```

## Documentation/devicetree/bindings/clock/intel,easic-n5x.yaml
```yaml
FASTVC-BENCH-CORPUS:linux-main-100k-v1-e0bd41dc-8e12-4f1b-978d-a3645ae59da0
# SPDX-License-Identifier: (GPL-2.0-only OR BSD-2-Clause)
%YAML 1.2
---
$id: http://devicetree.org/schemas/clock/intel,easic-n5x.yaml#
$schema: http://devicetree.org/meta-schemas/core.yaml#

title: Intel SoCFPGA eASIC N5X platform clock controller binding

maintainers:
  - Dinh Nguyen <dinguyen@kernel.org>

description:
  The Intel eASIC N5X Clock controller is an integrated clock controller, which
  generates and supplies to all modules.

properties:
  compatible:
    const: intel,easic-n5x-clkmgr

  '#clock-cells':
    const: 1

  reg:
    maxItems: 1

  clocks:
    maxItems: 1

required:
  - compatible
  - reg
  - clocks
  - '#clock-cells'

additionalProperties: false

/* bench 21157.0.0 7af5009abc44 */
/* bench 21157.0.1 b93ea38ef56a */
/* bench 21157.0.2 ccdee622375e */
/* bench 21157.0.3 0e8f44c353e0 */
/* bench 21157.0.4 cd7fcf4078a7 */
/* bench 21157.0.5 3de4a2ef85d8 */
/* bench 21157.0.6 3d3a4d665896 */
/* bench 21157.0.7 4d36be581e41 */
/* bench 19830.0.0 993ff6d7e1d6 */
/* bench 19830.0.1 ba1cb82ff420 */
/* bench 19830.0.2 57f14ebd7696 */
/* bench 19830.0.3 ef42349c0c5f */
/* bench 19830.0.4 6f03fb0b9af4 */
/* bench 15777.0.0 4230f96eae96 */
/* bench 15777.0.1 94384e04f64f */
/* bench 15777.0.2 c5eff18b84ea */
/* bench 15777.0.3 5c47bbe6278b */
/* bench 15777.0.4 3844cca9552e */
/* bench 15777.0.5 cb5d1f9da0c1 */
/* bench 15777.0.6 e684c7ccbd26 */
/* bench 15777.0.7 5fee047d5790 */
/* bench 15674.0.2 edba65e00f6f */
/* bench 15674.0.3 35f2252d8170 */
/* bench 15674.0.4 47dbadba881d */
/* bench 15674.0.5 db814e86aa1b */
/* bench 15674.0.6 798b3e8c8efb */
      compatible = "intel,easic-n5x-clkmgr";
/* bench 729.0.0 84f810b9f863 */
/* bench 729.0.1 d0c832308677 */
/* bench 729.0.2 68177c4d10ee */
/* bench 729.0.3 5aa3ba9b0a19 */
/* bench 729.0.4 8f614803bb46 */
/* bench 729.0.5 7779b4924683 */
/* bench 729.0.6 06e701bdfc7d */
/* bench 729.0.7 5668c0faa793 */
      #clock-cells = <1>;
    };
...
```

## Documentation/devicetree/bindings/clock/keystone-gate.txt
```
FASTVC-BENCH-CORPUS:linux-main-100k-v1-e0bd41dc-8e12-4f1b-978d-a3645ae59da0
Status: Unstable - ABI compatibility may be broken in the future

Binding for Keystone gate control driver which uses PSC controller IP.

/* bench 20158.0.0 6e6242ecb624 */
/* bench 20158.0.1 66252fea4f2a */
/* bench 20158.0.2 8212a62e9d9a */
/* bench 20158.0.3 8208fa6dfaf5 */
/* bench 20158.0.4 155fe853d9e6 */
/* bench 20158.0.5 190b6555e4ce */
/* bench 20158.0.6 159376759a5d */

[1] Documentation/devicetree/bindings/clock/clock-bindings.txt

Required properties:
- compatible : shall be "ti,keystone,psc-clock".
- #clock-cells : from common clock binding; shall be set to 0.
- clocks : parent clock phandle
/* bench 23530.0.0 ea000abfdd10 */
/* bench 23530.0.1 8aaaeb6d5f07 */
/* bench 23530.0.2 50100a68ed67 */
/* bench 23530.0.3 ae37071eff4c */
/* bench 23530.0.4 15bed9efab40 */
- domain-id : psc domain id needed to check the transition state register

Optional properties:
- clock-output-names : From common clock binding to override the
			default output clock name
/* bench 18235.0.0 6b4901fbdabe */
/* bench 18235.0.1 a3c09b932254 */
/* bench 18235.0.2 8fc38be54727 */
/* bench 18235.0.3 5c4ad0b8bcbb */
/* bench 18235.0.4 3d41353bda5d */
		#clock-cells = <0>;
		compatible = "ti,keystone,psc-clock";
		clocks = <&chipclk16>;
		clock-output-names = "usb";
		reg = <0x02350008 0xb00>, <0x02350000 0x400>;
		reg-names = "control", "domain";
		domain-id = <0>;
	};
```
