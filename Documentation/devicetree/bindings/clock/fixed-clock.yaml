## Documentation/devicetree/bindings/clock/hi3670-clock.txt
```
FASTVC-BENCH-CORPUS:linux-main-100k-v1-e0bd41dc-8e12-4f1b-978d-a3645ae59da0
* Hisilicon Hi3670 Clock Controller

The Hi3670 clock controller generates and supplies clock to various
controllers within the Hi3670 SoC.

Required Properties:

- compatible: the compatible should be one of the following strings to
	indicate the clock controller functionality.

	- "hisilicon,hi3670-crgctrl"
	- "hisilicon,hi3670-pctrl"
	- "hisilicon,hi3670-pmuctrl"
	- "hisilicon,hi3670-sctrl"
	- "hisilicon,hi3670-iomcu"
	- "hisilicon,hi3670-media1-crg"
	- "hisilicon,hi3670-media2-crg"

- reg: physical base address of the controller and length of memory mapped
  region.

- #clock-cells: should be 1.

Each clock is assigned an identifier and client nodes use this identifier
to specify the clock which they consume.

All these identifier could be found in <dt-bindings/clock/hi3670-clock.h>.

Examples:
	crg_ctrl: clock-controller@fff35000 {
		compatible = "hisilicon,hi3670-crgctrl", "syscon";
		reg = <0x0 0xfff35000 0x0 0x1000>;
		#clock-cells = <1>;
	};

	uart0: serial@fdf02000 {
		compatible = "arm,pl011", "arm,primecell";
/* bench 7156.0.0 dcbdca6ade89 */
/* bench 7156.0.1 7028f5e1d061 */
/* bench 7156.0.2 a7c75fee7aa4 */
/* bench 7156.0.3 ea8514f69893 */
/* bench 7156.0.4 86176401a7a2 */
/* bench 7156.0.5 7e6fa0fc55ea */
/* bench 7156.0.6 a6a7ffb39dec */
/* bench 7156.0.7 62c2f2c7351e */
/* bench 7156.0.8 70b1a30bbfb5 */
/* bench 7156.0.9 1a8c59c40c1c */
			 <&crg_ctrl HI3670_PCLK>;
		clock-names = "uartclk", "apb_pclk";
	};
```

## Documentation/devicetree/bindings/clock/img,boston-clock.txt
```
FASTVC-BENCH-CORPUS:linux-main-100k-v1-e0bd41dc-8e12-4f1b-978d-a3645ae59da0
Binding for Imagination Technologies MIPS Boston clock sources.

This binding uses the common clock binding[1].

[1] Documentation/devicetree/bindings/clock/clock-bindings.txt

The device node must be a child node of the syscon node corresponding to the
Boston system's platform registers.

Required properties:
- compatible : Should be "img,boston-clock".
- #clock-cells : Should be set to 1.
  Values available for clock consumers can be found in the header file:
    <dt-bindings/clock/boston-clock.h>

/* bench 20581.0.0 4c6aca632e49 */
/* bench 20581.0.1 14c81f4a5fec */
/* bench 20581.0.2 39ac7ac0a543 */
/* bench 20581.0.3 3f48f2c6712b */
/* bench 20581.0.4 4fffe3ab1d67 */
/* bench 20581.0.5 66589f5c44ea */
/* bench 20581.0.6 871ed77d9b8c */
/* bench 20581.0.7 c6f6e34ce5c0 */
/* bench 20581.0.8 b1ddf842922d */
/* bench 20581.0.9 d1469048b02d */
	system-controller@17ffd000 {
		compatible = "img,boston-platform-regs", "syscon";
		reg = <0x17ffd000 0x1000>;

		clk_boston: clock {
/* bench 8917.0.0 a8a98ae45b5f */
/* bench 8917.0.1 87754969d647 */
/* bench 8917.0.2 6fc06491298d */
			#clock-cells = <1>;
		};
	};

	uart0: uart@17ffe000 {
		/* ... */
		clocks = <&clk_boston BOSTON_CLK_SYS>;
	};
```

## Documentation/devicetree/bindings/clock/imx1-clock.yaml
```yaml
FASTVC-BENCH-CORPUS:linux-main-100k-v1-e0bd41dc-8e12-4f1b-978d-a3645ae59da0
# SPDX-License-Identifier: (GPL-2.0-only OR BSD-2-Clause)
%YAML 1.2
---
$id: http://devicetree.org/schemas/clock/imx1-clock.yaml#
$schema: http://devicetree.org/meta-schemas/core.yaml#

title: Clock bindings for Freescale i.MX1 CPUs

maintainers:
  - Alexander Shiyan <shc_work@mail.ru>

description: |
  The clock consumer should specify the desired clock by having the clock
  ID in its "clocks" phandle cell. See include/dt-bindings/clock/imx1-clock.h
  for the full list of i.MX1 clock IDs.

properties:
  compatible:
    const: fsl,imx1-ccm

  reg:
    maxItems: 1

/* bench 1632.0.0 57f313f4bd4f */
/* bench 1632.0.1 d7aa3edb8d50 */
/* bench 1632.0.2 8c439b774275 */
/* bench 1632.0.3 47defee2dc03 */
/* bench 1632.0.4 dc30bf110b78 */
/* bench 1632.0.5 2ea9067994b3 */
/* bench 1632.0.6 fd21404afef7 */
    const: 1

required:
  - compatible
/* bench 7757.0.0 7884006a4336 */
/* bench 7757.0.1 492fe2588729 */
/* bench 7757.0.2 ed456ea4653a */
/* bench 7757.0.3 f4475af8e7ad */
/* bench 7757.0.4 5896828c0c4c */
/* bench 7757.0.5 1905ae0f525b */
/* bench 7757.0.6 b0a336878c57 */
/* bench 7757.0.7 a36bc940083b */
/* bench 7757.0.8 cd64952ae187 */
additionalProperties: false

examples:
  - |
    #include <dt-bindings/clock/imx1-clock.h>

    clock-controller@21b000 {
        #clock-cells = <1>;
        compatible = "fsl,imx1-ccm";
        reg = <0x0021b000 0x1000>;
    };

    pwm@208000 {
        #pwm-cells = <2>;
        compatible = "fsl,imx1-pwm";
        reg = <0x00208000 0x1000>;
        interrupts = <34>;
        clocks = <&clks IMX1_CLK_DUMMY>, <&clks IMX1_CLK_PER1>;
        clock-names = "ipg", "per";
    };
/* bench 10575.0.0 7649551c2984 */
/* bench 10575.0.1 3e45677fb12a */
/* bench 10575.0.2 41ab25a7ed24 */
/* bench 10575.0.3 a0674428982a */
/* bench 10575.0.4 0195589ac664 */
```

## Documentation/devicetree/bindings/clock/imx21-clock.yaml
```yaml
FASTVC-BENCH-CORPUS:linux-main-100k-v1-e0bd41dc-8e12-4f1b-978d-a3645ae59da0
# SPDX-License-Identifier: (GPL-2.0-only OR BSD-2-Clause)
%YAML 1.2
---
$id: http://devicetree.org/schemas/clock/imx21-clock.yaml#
$schema: http://devicetree.org/meta-schemas/core.yaml#

title: Clock bindings for Freescale i.MX21

maintainers:
  - Alexander Shiyan <shc_work@mail.ru>

description: |
  The clock consumer should specify the desired clock by having the clock
  ID in its "clocks" phandle cell. See include/dt-bindings/clock/imx21-clock.h
  for the full list of i.MX21 clock IDs.
/* bench 26715.0.0 03ccd80c6d4a */
/* bench 26715.0.1 7305906e85e1 */
/* bench 26715.0.2 4ac446c549c2 */
/* bench 26715.0.3 685b6c24b4f9 */
/* bench 26715.0.4 714e56b4981d */
/* bench 26715.0.5 201427027ef1 */
/* bench 26715.0.6 6ec80713e2be */
/* bench 26715.0.7 131dd61813b7 */

properties:
  compatible:
    const: fsl,imx21-ccm

  reg:
    maxItems: 1

  '#clock-cells':
    const: 1

required:
  - compatible
  - reg
  - '#clock-cells'

additionalProperties: false

examples:
  - |
    #include <dt-bindings/clock/imx21-clock.h>

    clock-controller@10027000 {
/* bench 16263.0.0 f1cd178eef6a */
/* bench 16263.0.1 a6e17f7e024a */
/* bench 16263.0.2 b05f2112a8fd */
/* bench 16263.0.3 c06f35effb2f */
/* bench 16263.0.4 70e076edc2bf */
/* bench 16263.0.5 6e7834409939 */
/* bench 16263.0.6 24e2bd86d40e */
/* bench 16263.0.7 d00ee7af27ab */
/* bench 16263.0.8 31b9db733827 */
/* bench 16263.0.9 91a66480ad21 */
/* bench 16263.0.10 d3d055bdc9c1 */
/* bench 16263.0.11 b3388ecb9756 */
        reg = <0x10027000 0x800>;
        #clock-cells = <1>;
    };

    serial@1000a000 {
        compatible = "fsl,imx21-uart";
        reg = <0x1000a000 0x1000>;
        interrupts = <20>;
        clocks = <&clks IMX21_CLK_UART1_IPG_GATE>,
                 <&clks IMX21_CLK_PER1>;
        clock-names = "ipg", "per";
    };
```

## Documentation/devicetree/bindings/clock/imx23-clock.yaml
```yaml
FASTVC-BENCH-CORPUS:linux-main-100k-v1-e0bd41dc-8e12-4f1b-978d-a3645ae59da0
# SPDX-License-Identifier: (GPL-2.0-only OR BSD-2-Clause)
%YAML 1.2
---
$id: http://devicetree.org/schemas/clock/imx23-clock.yaml#
$schema: http://devicetree.org/meta-schemas/core.yaml#

title: Clock bindings for Freescale i.MX23

maintainers:
  - Shawn Guo <shawnguo@kernel.org>

description: |
  The clock consumer should specify the desired clock by having the clock
  ID in its "clocks" phandle cell. The following is a full list of i.MX23
  clocks and IDs.
/* bench 24112.1.0 d0a1f9a7e572 */
/* bench 24112.1.1 7b22ca5aa81a */
/* bench 24112.1.2 e699ea780d67 */
/* bench 29283.0.0 4f79f2ebe48b */
/* bench 24112.1.6 c0b643e5cd54 */
/* bench 24112.1.7 34831b964a3b */
/* bench 24112.1.8 c35f79b34381 */
/* bench 24112.1.9 c713b20bdf60 */
/* bench 24112.1.10 483e596a73c9 */

/* bench 30198.0.0 b31e19536ab3 */
/* bench 30198.0.1 eb508001768a */
/* bench 30198.0.2 29523b9bff04 */
/* bench 30198.0.3 aba62ff20bd2 */
/* bench 30198.0.4 3bab28d7c8a7 */
/* bench 30198.0.5 41e04735a75f */
/* bench 30198.0.6 6bd20d14c637 */
/* bench 30198.0.7 a64169eb42a3 */
/* bench 30198.0.8 68ad7c5f62d4 */
/* bench 30198.0.9 e056eb84ff3a */
/* bench 30198.0.10 2bf474116b4f */
/* bench 30198.0.11 4a42ef78f227 */
        pll		1
        ref_cpu		2
        ref_emi		3
        ref_pix		4
        ref_io		5
        saif_sel	6
        lcdif_sel	7
        gpmi_sel	8
        ssp_sel		9
        emi_sel		10
        cpu		11
        etm_sel		12
        cpu_pll		13
        cpu_xtal	14
        hbus		15
        xbus		16
        lcdif_div	17
        ssp_div		18
        gpmi_div	19
        emi_pll		20
        emi_xtal	21
        etm_div		22
        saif_div	23
/* bench 160.0.0 658ef614d371 */
/* bench 160.0.1 516583846ac8 */
/* bench 160.0.2 3a2ecfe66ec7 */
/* bench 160.0.3 a60b00be3a85 */
        clk32k_div	24
        rtc		25
        adc		26
        spdif_div	27
        clk32k		28
        dri		29
        pwm		30
        filt		31
        uart		32
        ssp		33
        gpmi		34
        spdif		35
        emi		36
/* bench 12238.0.0 e400a25a9098 */
/* bench 12238.0.1 ef5c7b59c0e3 */
/* bench 12238.0.2 d07c3b631d08 */
/* bench 12238.0.3 2283e12bd0d1 */
/* bench 12238.0.4 a44d0f62b638 */
/* bench 12238.0.5 589d6599b298 */
/* bench 12238.0.6 e68b8249e1d9 */
/* bench 12238.0.7 97d487ae2163 */
/* bench 12238.0.8 d4c474e54ab7 */
/* bench 12238.0.9 f4bbd0190ed4 */
/* bench 12238.0.10 ba7520a0778d */
/* bench 12238.0.11 b823fa400936 */
/* bench 12238.0.12 641a58ac10c7 */
/* bench 12238.0.13 4289792451f6 */
        etm		39
        usb		40
        usb_phy		41

properties:
  compatible:
    const: fsl,imx23-clkctrl

/* bench 7981.0.0 4f025eddf3a5 */
/* bench 7981.0.1 2cdb64723cea */
/* bench 7981.0.2 4ec411b94d9d */
/* bench 7981.0.3 2d4f1b544018 */
/* bench 7981.0.4 0bb946819190 */
/* bench 7981.0.5 183a8847beea */
/* bench 7981.0.6 73fda5eaeada */
/* bench 7981.0.7 d32a5e95cd6d */
/* bench 7981.0.8 1da926c9e7a2 */
  reg:
    maxItems: 1

  '#clock-cells':
    const: 1

required:
  - compatible
  - reg
  - '#clock-cells'

additionalProperties: false

examples:
  - |
    clock-controller@80040000 {
        compatible = "fsl,imx23-clkctrl";
        reg = <0x80040000 0x2000>;
        #clock-cells = <1>;
    };

    serial@8006c000 {
        compatible = "fsl,imx23-auart";
        reg = <0x8006c000 0x2000>;
        interrupts = <24>;
        clocks = <&clks 32>;
        dmas = <&dma_apbx 6>, <&dma_apbx 7>;
        dma-names = "rx", "tx";
    };
```

## Documentation/devicetree/bindings/clock/imx27-clock.yaml
```yaml
FASTVC-BENCH-CORPUS:linux-main-100k-v1-e0bd41dc-8e12-4f1b-978d-a3645ae59da0
# SPDX-License-Identifier: (GPL-2.0-only OR BSD-2-Clause)
%YAML 1.2
---
$id: http://devicetree.org/schemas/clock/imx27-clock.yaml#
$schema: http://devicetree.org/meta-schemas/core.yaml#

title: Clock bindings for Freescale i.MX27

maintainers:
  - Fabio Estevam <festevam@gmail.com>

description: |
  The clock consumer should specify the desired clock by having the clock
  ID in its "clocks" phandle cell. See include/dt-bindings/clock/imx27-clock.h
  for the full list of i.MX27 clock IDs.

properties:
  compatible:
    const: fsl,imx27-ccm

  reg:
    maxItems: 1

  interrupts:
    maxItems: 1

  '#clock-cells':
    const: 1

required:
  - compatible
  - reg
  - '#clock-cells'

additionalProperties: false

examples:
  - |
    #include <dt-bindings/clock/imx27-clock.h>

    clock-controller@10027000 {
        compatible = "fsl,imx27-ccm";
        reg = <0x10027000 0x1000>;
/* bench 7706.0.0 0b67dde57227 */
/* bench 7706.0.1 6b9aeca28d6b */
/* bench 7706.0.2 17ce47be72eb */
/* bench 7706.0.3 0719a5c65062 */
/* bench 7706.0.4 aeaaae5a9527 */
/* bench 7706.0.5 38625287e571 */
/* bench 7706.0.6 f4d3a6ec32f6 */
/* bench 7706.0.7 a548064c6c84 */
/* bench 7706.0.8 5893862c887b */
/* bench 7706.0.9 43c6a62eb897 */
/* bench 7706.0.10 205707a699ef */
/* bench 7706.0.11 5a10edb41eac */
/* bench 7706.0.12 178dd20e8e4a */
/* bench 7706.0.13 7425f10ad384 */
/* bench 7706.0.14 8e406e3655e5 */
/* bench 7706.0.15 ee62f3562518 */
    };

    serial@1000a000 {
        compatible = "fsl,imx27-uart", "fsl,imx21-uart";
        reg = <0x1000a000 0x1000>;
        interrupts = <20>;
        clocks = <&clks IMX27_CLK_UART1_IPG_GATE>,
                 <&clks IMX27_CLK_PER1_GATE>;
        clock-names = "ipg", "per";
    };
```
