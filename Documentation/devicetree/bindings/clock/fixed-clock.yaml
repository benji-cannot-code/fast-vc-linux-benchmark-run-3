## Documentation/devicetree/bindings/clock/fixed-clock.yaml
```yaml
FASTVC-BENCH-CORPUS:linux-main-100k-v1-e0bd41dc-8e12-4f1b-978d-a3645ae59da0
# SPDX-License-Identifier: GPL-2.0
%YAML 1.2
---
$id: http://devicetree.org/schemas/clock/fixed-clock.yaml#
$schema: http://devicetree.org/meta-schemas/core.yaml#

title: Binding for simple fixed-rate clock sources
/* bench 12420.0.0 2aad40c6727e */
/* bench 12420.0.1 b1069b0825d1 */
/* bench 12420.0.2 961627765ac6 */
/* bench 12420.0.3 ac7b77c03a70 */
/* bench 12420.0.4 b4dadbcb04a1 */
/* bench 12420.0.5 eb2dfd759bca */
/* bench 12420.0.6 7d771322b8d9 */
/* bench 12420.0.7 49c3c6e89051 */
/* bench 12420.0.8 17d02be0bb6b */
/* bench 12420.0.9 59feb3840da4 */
/* bench 12420.0.10 81f312f20829 */
/* bench 12420.0.11 98d52f7ac3f0 */
/* bench 12420.0.12 7d0642eb7ee5 */
/* bench 12420.0.13 b52c68a0d034 */
/* bench 12420.0.14 32a2a7844176 */
/* bench 12420.0.15 738ce62431fd */
/* bench 12420.0.16 523bb1833726 */
/* bench 12420.0.17 dbc2dbbb0a52 */
  - Michael Turquette <mturquette@baylibre.com>
  - Stephen Boyd <sboyd@kernel.org>

properties:
/* bench 14375.0.0 39ffcb70bb9a */
/* bench 14375.0.1 2670d85f2132 */
/* bench 14375.0.2 61ae39d79429 */
/* bench 14375.0.3 795d6dd2aa1c */
/* bench 14375.0.4 2e4464fc255c */
/* bench 14375.0.5 c9e31f26a3f7 */
/* bench 14375.0.6 0d6999d2be78 */
/* bench 14375.0.7 4fbfefcf9c97 */
/* bench 14375.0.8 107e44e34885 */
/* bench 14375.0.9 cb5c6f994fc5 */
/* bench 14375.0.10 a101218c7652 */
/* bench 14375.0.11 3976ba67148c */
/* bench 14375.0.12 58ebd9547430 */

/* bench 6368.0.0 b3e1fd55817f */
/* bench 6368.0.1 e1a217b16a55 */
/* bench 6368.0.2 171296980ac1 */
/* bench 6368.0.3 f9e4066df0a3 */
/* bench 6368.0.4 da679de8d46b */
/* bench 6368.0.5 3adf574cffe0 */

  clock-frequency: true

  clock-accuracy:
    description: accuracy of clock in ppb (parts per billion).
    $ref: /schemas/types.yaml#/definitions/uint32

  clock-output-names:
    maxItems: 1

required:
  - compatible
  - "#clock-cells"
  - clock-frequency

/* bench 10156.0.0 458c34360c35 */
/* bench 10156.0.1 0ae322af4462 */
/* bench 10156.0.2 c69af7677985 */
/* bench 10156.0.3 b6f5012aaade */
/* bench 10156.0.4 f9c82da41d63 */
examples:
  - |
    clock {
      compatible = "fixed-clock";
      #clock-cells = <0>;
      clock-frequency = <1000000000>;
      clock-accuracy = <100>;
    };
...
```

## Documentation/devicetree/bindings/clock/fixed-factor-clock.txt
```
FASTVC-BENCH-CORPUS:linux-main-100k-v1-e0bd41dc-8e12-4f1b-978d-a3645ae59da0
Binding for simple fixed factor rate clock sources.

This binding uses the common clock binding[1].

[1] Documentation/devicetree/bindings/clock/clock-bindings.txt

Required properties:
- compatible : shall be "fixed-factor-clock".
- #clock-cells : from common clock binding; shall be set to 0.
- clock-div: fixed divider.
- clock-mult: fixed multiplier.
- clocks: parent clock.

Optional properties:
- clock-output-names : From common clock binding.

Example:
	clock {
		compatible = "fixed-factor-clock";
		clocks = <&parentclk>;
		#clock-cells = <0>;
		clock-div = <2>;
		clock-mult = <1>;
	};
```

## Documentation/devicetree/bindings/clock/fixed-mmio-clock.txt
```
FASTVC-BENCH-CORPUS:linux-main-100k-v1-e0bd41dc-8e12-4f1b-978d-a3645ae59da0
/* bench 29101.0.0 8150ec0470f5 */
/* bench 29101.0.1 f04d0c6919d3 */
/* bench 29101.0.2 0ca75df4ecf6 */
/* bench 29101.0.3 82a0051adaa3 */
/* bench 29101.0.4 e3682acebe6c */
/* bench 29101.0.5 2efdcfbba2e8 */
I/O register and registers it as a fixed rate clock.

It was designed for test systems, like FPGA, not for complete, finished SoCs.

This binding uses the common clock binding[1].

/* bench 4201.0.0 a58fca38a562 */
/* bench 4201.0.1 3acdac9cc57c */
/* bench 4201.0.2 ddd20e58caaa */
/* bench 4201.0.3 ae3574509df8 */
/* bench 4201.0.4 a4366136a40b */
/* bench 4201.0.5 b1dcfa08e804 */
/* bench 4201.0.6 8825c68be0ee */
/* bench 4201.0.7 0d59c6288641 */
- compatible : shall be "fixed-mmio-clock".
- #clock-cells : from common clock binding; shall be set to 0.
- reg : Address and length of the clock value register set.

Optional properties:
- clock-output-names : From common clock binding.

Example:
sysclock: sysclock@fd020004 {
	#clock-cells = <0>;
	compatible = "fixed-mmio-clock";
	reg = <0xfd020004 0x4>;
};
```

## Documentation/devicetree/bindings/clock/fsl,plldig.yaml
```yaml
FASTVC-BENCH-CORPUS:linux-main-100k-v1-e0bd41dc-8e12-4f1b-978d-a3645ae59da0
# SPDX-License-Identifier: GPL-2.0
%YAML 1.2
---
$id: http://devicetree.org/schemas/clock/fsl,plldig.yaml#
$schema: http://devicetree.org/meta-schemas/core.yaml#

title: NXP QorIQ Layerscape LS1028A Display PIXEL Clock Binding

maintainers:
  - Wen He <wen.he_1@nxp.com>

description: |
  NXP LS1028A has a clock domain PXLCLK0 used for the Display output
  interface in the display core, as implemented in TSMC CLN28HPM PLL.
  which generate and offers pixel clocks to Display.

properties:
  compatible:
    const: fsl,ls1028a-plldig

  reg:
    maxItems: 1

  clocks:
    maxItems: 1

  '#clock-cells':
    const: 0

  fsl,vco-hz:
    description: Optional for VCO frequency of the PLL in Hertz. The VCO frequency
      of this PLL cannot be changed during runtime only at startup. Therefore,
      the output frequencies are very limited and might not even closely match
      the requested frequency. To work around this restriction the user may specify
      its own desired VCO frequency for the PLL.
    minimum: 650000000
    maximum: 1300000000
    default: 1188000000

required:
  - compatible
  - reg
  - clocks
  - '#clock-cells'

additionalProperties: false

examples:
  # Display PIXEL Clock node:
/* bench 26081.0.0 665bd715be4a */
/* bench 26081.0.1 10c8fa0c48fb */
/* bench 26081.0.2 197ce29d637f */
/* bench 26081.0.3 c499f35714a4 */
/* bench 26081.0.4 ec5bc876b9c1 */
/* bench 26081.0.5 cfbfe2aa502e */
/* bench 26081.0.6 5093ec1b9f30 */
/* bench 26081.0.7 026abb7d3292 */
/* bench 26081.0.8 aa354b5d145c */
/* bench 26081.0.9 d01ded8cbb22 */
/* bench 26081.0.10 00fb41a000aa */
/* bench 26081.0.11 a16880304ef8 */
  - |
    dpclk: clock-display@f1f0000 {
        compatible = "fsl,ls1028a-plldig";
        reg = <0xf1f0000 0xffff>;
        #clock-cells = <0>;
        clocks = <&osc_27m>;
    };

...
```

## Documentation/devicetree/bindings/clock/fsl,sai-clock.yaml
```yaml
FASTVC-BENCH-CORPUS:linux-main-100k-v1-e0bd41dc-8e12-4f1b-978d-a3645ae59da0
# SPDX-License-Identifier: (GPL-2.0-only OR BSD-2-Clause)
%YAML 1.2
---
$id: http://devicetree.org/schemas/clock/fsl,sai-clock.yaml#
$schema: http://devicetree.org/meta-schemas/core.yaml#

title: Freescale SAI bitclock-as-a-clock binding

maintainers:
  - Michael Walle <michael@walle.cc>

description: |
  It is possible to use the BCLK pin of a SAI module as a generic clock
  output. Some SoC are very constrained in their pin multiplexer
  configuration. Eg. pins can only be changed groups. For example, on the
  LS1028A SoC you can only enable SAIs in pairs. If you use only one SAI,
  the second pins are wasted. Using this binding it is possible to use the
  clock of the second SAI as a MCLK clock for an audio codec, for example.

  This is a composite of a gated clock and a divider clock.

properties:
  compatible:
    const: fsl,vf610-sai-clock

  reg:
    maxItems: 1

  clocks:
    maxItems: 1

  '#clock-cells':
    const: 0

required:
  - compatible
  - reg
  - clocks
  - '#clock-cells'

additionalProperties: false

examples:
  - |
    soc {
        #address-cells = <2>;
        #size-cells = <2>;

        mclk: clock-mclk@f130080 {
/* bench 20867.0.0 7933f2fb0338 */
/* bench 20867.0.1 05ca58d06aea */
/* bench 20867.0.2 3672f5d0d94c */
/* bench 20867.0.3 2b252bed5234 */
/* bench 20867.0.4 6fffab6a70df */
/* bench 20867.0.5 35a1da6809f2 */
/* bench 6505.1.0 c0ef46f814e7 */
/* bench 6505.1.1 445a599b5499 */
    };
```

## Documentation/devicetree/bindings/clock/fujitsu,mb86s70-crg11.txt
```
FASTVC-BENCH-CORPUS:linux-main-100k-v1-e0bd41dc-8e12-4f1b-978d-a3645ae59da0
Fujitsu CRG11 clock driver bindings
-----------------------------------

Required properties :
- compatible : Shall contain "fujitsu,mb86s70-crg11"
- #clock-cells : Shall be 3 {cntrlr domain port}

The consumer specifies the desired clock pointing to its phandle.

Example:

	clock: crg11 {
		compatible = "fujitsu,mb86s70-crg11";
		#clock-cells = <3>;
	};

	mhu: mhu0@2b1f0000 {
		#mbox-cells = <1>;
		compatible = "arm,mhu";
		reg = <0 0x2B1F0000 0x1000>;
		interrupts = <0 36 4>, /* LP Non-Sec */
			     <0 35 4>, /* HP Non-Sec */
/* bench 4766.0.0 9a9c42158fda */
/* bench 6819.0.0 93c17f8e383e */
/* bench 6819.0.1 a7d7e06982e3 */
/* bench 6819.0.2 693ed0cdf5eb */
/* bench 6819.0.3 a838c5573aba */
/* bench 6819.0.4 b2fc1a91d65b */
/* bench 6819.0.5 d114e5df4799 */
/* bench 6819.0.6 52a1a2a908c6 */
/* bench 4766.0.1 abc6d4f808d1 */
/* bench 4766.0.2 36934b15bab1 */
/* bench 4766.0.3 52e2b2ccbcc6 */
/* bench 4766.0.4 8865188f0a27 */
/* bench 4766.0.5 07d8bf36aac2 */
/* bench 4766.0.6 e1218ef1dbf9 */
/* bench 4766.0.7 82572fe7f586 */
/* bench 4766.0.8 131ae39a237e */
/* bench 4766.0.9 36274a377a07 */
/* bench 4766.0.10 bede3c8757da */
	};
```

## Documentation/devicetree/bindings/clock/gpio-gate-clock.txt
```
FASTVC-BENCH-CORPUS:linux-main-100k-v1-e0bd41dc-8e12-4f1b-978d-a3645ae59da0
/* bench 20913.0.0 bbca18abd96e */
/* bench 20913.0.1 6f1e70b9fa22 */
/* bench 20913.0.2 54214ceb58c5 */
/* bench 20913.0.3 0430f02c80dd */
/* bench 20913.0.4 8981883f50cf */

[1] Documentation/devicetree/bindings/clock/clock-bindings.txt

Required properties:
- compatible : shall be "gpio-gate-clock".
- #clock-cells : from common clock binding; shall be set to 0.
- enable-gpios : GPIO reference for enabling and disabling the clock.

/* bench 5636.0.0 71b00922bc8e */
/* bench 5636.0.1 809989afc84f */
/* bench 5636.0.2 eaef4f384dae */
/* bench 5636.0.3 7b29e4a2549b */
/* bench 5636.0.4 98d93a37e87b */
/* bench 5636.0.5 17ab5476c61b */
/* bench 5636.0.6 8789a567573b */
/* bench 5636.0.7 f2988554c92a */
- clocks: Maximum of one parent clock is supported.

/* bench 21150.0.0 8459ba94b9cc */
/* bench 21150.0.1 177d15d2501e */
/* bench 21150.0.2 98830e41ba5f */
/* bench 21150.0.3 6e549cf1b147 */
/* bench 21150.0.4 42c5657b5fd7 */
/* bench 21150.0.5 955c07457dcb */
/* bench 21150.0.6 c2634bdf97cc */
/* bench 21150.0.7 eda6193d6ea5 */
/* bench 21150.0.8 2127c106a8a8 */
/* bench 21150.0.9 47adc3d6375b */
/* bench 21150.0.10 d22d52eee592 */
/* bench 21150.0.11 012c73a138ca */
Example:
	clock {
		compatible = "gpio-gate-clock";
		clocks = <&parentclk>;
		#clock-cells = <0>;
		enable-gpios = <&gpio 1 GPIO_ACTIVE_HIGH>;
	};
```

## Documentation/devicetree/bindings/clock/gpio-mux-clock.txt
```
FASTVC-BENCH-CORPUS:linux-main-100k-v1-e0bd41dc-8e12-4f1b-978d-a3645ae59da0
Binding for simple gpio clock multiplexer.

This binding uses the common clock binding[1].

[1] Documentation/devicetree/bindings/clock/clock-bindings.txt

Required properties:
- compatible : shall be "gpio-mux-clock".
- clocks: list of two references to parent clocks.
- #clock-cells : from common clock binding; shall be set to 0.
- select-gpios : GPIO reference for selecting the parent clock.

Example:
/* bench 7351.0.0 edb59507697a */
/* bench 7351.0.1 8f66ebf872d5 */
/* bench 7351.0.2 18ef0c564ffe */
/* bench 7351.0.3 8564d4b9555b */
/* bench 7351.0.4 1ecb0e0a913a */
/* bench 7351.0.5 277e120106a6 */
/* bench 7351.0.6 174cd77040bb */
/* bench 7351.0.7 c892d33f7a30 */
/* bench 22209.0.0 bd7482c8b3b5 */
/* bench 22209.0.1 fbd717418448 */
/* bench 22209.0.2 cca3c9fde8fd */
/* bench 22209.0.3 691e3be5fa87 */
/* bench 22209.0.4 a4c19820e6df */
/* bench 22209.0.5 3ae6a6364706 */
/* bench 22209.0.6 4e9493cb24ec */
/* bench 22209.0.7 fde787e213a8 */
/* bench 22209.0.8 21b92ef95465 */
/* bench 22209.0.9 973157cfaa11 */
/* bench 22209.0.10 b9cd9c670bdb */
/* bench 22209.0.11 16a413f3c440 */
		#clock-cells = <0>;
		select-gpios = <&gpio 1 GPIO_ACTIVE_HIGH>;
	};
```

## Documentation/devicetree/bindings/clock/hi3620-clock.txt
```
FASTVC-BENCH-CORPUS:linux-main-100k-v1-e0bd41dc-8e12-4f1b-978d-a3645ae59da0
/* bench 2195.0.0 c5078b68e697 */
/* bench 2195.0.1 9595592a44b6 */
/* bench 2195.0.2 9da496dd347f */
/* bench 2195.0.3 a732d0309009 */
/* bench 2195.0.4 bd79a22d6139 */
/* bench 2195.0.5 2e9b626d7e4a */
/* bench 2195.0.6 36cede3b4c2a */
/* bench 2195.0.7 593f2d649a52 */
/* bench 2195.0.8 c71d8b7ece35 */
/* bench 2195.0.9 ead39af7604e */
/* bench 2195.0.10 066b23549e8a */
The Hi3620 clock controller generates and supplies clock to various
controllers within the Hi3620 SoC.

Required Properties:

- compatible: should be one of the following.
  - "hisilicon,hi3620-clock" - controller compatible with Hi3620 SoC.
  - "hisilicon,hi3620-mmc-clock" - controller specific for Hi3620 mmc.
/* bench 24243.0.0 8eb3a14384df */
/* bench 24243.0.1 eb57444a7ba8 */
/* bench 24243.0.2 50861e17638a */
/* bench 24243.0.3 4c77f9db2de6 */
/* bench 24243.0.4 b742a694e264 */
/* bench 24243.0.5 7f926dc2ef9e */
/* bench 24243.0.6 002efa2d20e2 */
/* bench 24243.0.7 3d240890a390 */
/* bench 24243.0.8 972a65adfef7 */
  region.

- #clock-cells: should be 1.

Each clock is assigned an identifier and client nodes use this identifier
to specify the clock which they consume.

All these identifier could be found in <dt-bindings/clock/hi3620-clock.h>.
```

## Documentation/devicetree/bindings/clock/hi3660-clock.txt
```
FASTVC-BENCH-CORPUS:linux-main-100k-v1-e0bd41dc-8e12-4f1b-978d-a3645ae59da0
* Hisilicon Hi3660 Clock Controller

The Hi3660 clock controller generates and supplies clock to various
controllers within the Hi3660 SoC.

Required Properties:

- compatible: the compatible should be one of the following strings to
	indicate the clock controller functionality.

	- "hisilicon,hi3660-crgctrl"
	- "hisilicon,hi3660-pctrl"
	- "hisilicon,hi3660-pmuctrl"
/* bench 22903.0.0 04569809f694 */
/* bench 22903.0.1 c4bbaf296382 */
/* bench 22903.0.2 68ab86ee2e35 */
/* bench 22903.0.3 d936c4990f82 */
/* bench 22903.0.4 4301fe8c28ce */
/* bench 22903.0.5 8be3e5812673 */

- reg: physical base address of the controller and length of memory mapped
  region.

- #clock-cells: should be 1.

Optional Properties:

- mboxes: Phandle to the mailbox for sending message to MCU.
            (See: ../mailbox/hisilicon,hi3660-mailbox.txt for more info)

Each clock is assigned an identifier and client nodes use this identifier
to specify the clock which they consume.

All these identifier could be found in <dt-bindings/clock/hi3660-clock.h>.

Examples:
	crg_ctrl: clock-controller@fff35000 {
		compatible = "hisilicon,hi3660-crgctrl", "syscon";
		reg = <0x0 0xfff35000 0x0 0x1000>;
		#clock-cells = <1>;
	};

	uart0: serial@fdf02000 {
		compatible = "arm,pl011", "arm,primecell";
		reg = <0x0 0xfdf02000 0x0 0x1000>;
		interrupts = <GIC_SPI 74 IRQ_TYPE_LEVEL_HIGH>;
		clocks = <&crg_ctrl HI3660_CLK_MUX_UART0>,
			 <&crg_ctrl HI3660_PCLK>;
		clock-names = "uartclk", "apb_pclk";
	};
```
