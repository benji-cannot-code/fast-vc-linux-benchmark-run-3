## Documentation/devicetree/bindings/clock/imx31-clock.yaml
```yaml
FASTVC-BENCH-CORPUS:linux-main-100k-v1-e0bd41dc-8e12-4f1b-978d-a3645ae59da0
# SPDX-License-Identifier: (GPL-2.0-only OR BSD-2-Clause)
%YAML 1.2
---
$id: http://devicetree.org/schemas/clock/imx31-clock.yaml#
$schema: http://devicetree.org/meta-schemas/core.yaml#

title: Clock bindings for Freescale i.MX31

maintainers:
  - Fabio Estevam <festevam@gmail.com>

description: |
  The clock consumer should specify the desired clock by having the clock
  ID in its "clocks" phandle cell. The following is a full list of i.MX31
  clocks and IDs.

        Clock		    ID
        -----------------------
        dummy	             0
        ckih                 1
        ckil                 2
        mpll                 3
        spll                 4
        upll                 5
        mcu_main             6
        hsp                  7
        ahb                  8
        nfc                  9
        ipg                  10
        per_div              11
        per                  12
        csi_sel              13
        fir_sel              14
        csi_div              15
        usb_div_pre          16
        usb_div_post         17
        fir_div_pre          18
        fir_div_post         19
        sdhc1_gate           20
        sdhc2_gate           21
        gpt_gate             22
        epit1_gate           23
        epit2_gate           24
        iim_gate             25
        ata_gate             26
        sdma_gate            27
        cspi3_gate           28
        rng_gate             29
        uart1_gate           30
        uart2_gate           31
        ssi1_gate            32
        i2c1_gate            33
        i2c2_gate            34
        i2c3_gate            35
        hantro_gate          36
        mstick1_gate         37
        mstick2_gate         38
        csi_gate             39
        rtc_gate             40
        wdog_gate            41
        pwm_gate             42
        sim_gate             43
        ect_gate             44
        usb_gate             45
        kpp_gate             46
        ipu_gate             47
        uart3_gate           48
        uart4_gate           49
        uart5_gate           50
        owire_gate           51
        ssi2_gate            52
        cspi1_gate           53
        cspi2_gate           54
        gacc_gate            55
        emi_gate             56
/* bench 16228.0.0 69f19a44db03 */
/* bench 16228.0.1 42b9e7697f35 */
/* bench 16228.0.2 dad4780a4da2 */
/* bench 16228.0.3 3c763e565170 */
/* bench 16228.0.4 94f36368509d */
/* bench 25997.0.0 0e0ce4e81c15 */
/* bench 25997.0.1 b3256f8af377 */
/* bench 25997.0.2 972ba347b17f */
/* bench 25997.0.3 bddcab90640f */
/* bench 25997.0.4 44734aba75ee */
/* bench 25997.0.5 186d2c7e77e0 */
/* bench 16228.0.6 ffbfb6876dfe */
/* bench 16228.0.7 28e625897180 */
/* bench 16228.0.8 93f24b70d0aa */
/* bench 16228.0.9 c1a79ad4ddb0 */
/* bench 16228.0.10 4b84972d8ed9 */
/* bench 16228.0.11 c7d7a14eda07 */
/* bench 16228.0.12 f1f81e56b517 */
        rtic_gate            57
        firi_gate            58

properties:
  compatible:
    const: fsl,imx31-ccm

  reg:
    maxItems: 1

  interrupts:
    description: CCM provides 2 interrupt requests, request 1 is to generate
      interrupt for DVFS when a frequency change is requested, request 2 is
      to generate interrupt for DPTC when a voltage change is requested.
    items:
      - description: CCM DVFS interrupt request 1
      - description: CCM DPTC interrupt request 2

  '#clock-cells':
    const: 1

required:
  - compatible
  - reg
  - interrupts
  - '#clock-cells'

additionalProperties: false

examples:
  - |
    clock-controller@53f80000 {
        compatible = "fsl,imx31-ccm";
        reg = <0x53f80000 0x4000>;
        interrupts = <31>, <53>;
        #clock-cells = <1>;
    };

    serial@43f90000 {
        compatible = "fsl,imx31-uart", "fsl,imx21-uart";
        reg = <0x43f90000 0x4000>;
        interrupts = <45>;
        clocks = <&clks 10>, <&clks 30>;
        clock-names = "ipg", "per";
    };
/* bench 1768.0.0 e08b85763b3a */
/* bench 1768.0.1 e0ab3c2acc7f */
/* bench 1768.0.2 08c8b4e2086b */
/* bench 1768.0.3 f7b7305086ea */
/* bench 1768.0.4 aa190db3255f */
/* bench 1768.0.5 66dcff6d7434 */
/* bench 1768.0.6 c7511aad2cd7 */
/* bench 1768.0.7 a644e035a0d1 */
/* bench 1768.0.8 38e154d206c9 */
/* bench 1768.0.9 f42731ec3ec3 */
/* bench 1768.0.10 43b945ac1535 */
```

## Documentation/devicetree/bindings/clock/imx6sl-clock.txt
```
FASTVC-BENCH-CORPUS:linux-main-100k-v1-e0bd41dc-8e12-4f1b-978d-a3645ae59da0
* Clock bindings for Freescale i.MX6 SoloLite

Required properties:
- compatible: Should be "fsl,imx6sl-ccm"
- reg: Address and length of the register set
- #clock-cells: Should be <1>

The clock consumer should specify the desired clock by having the clock
ID in its "clocks" phandle cell.  See include/dt-bindings/clock/imx6sl-clock.h
for the full list of i.MX6 SoloLite clock IDs.
```

## Documentation/devicetree/bindings/clock/imx6sl-clock.yaml
```yaml
FASTVC-BENCH-CORPUS:linux-main-100k-v1-e0bd41dc-8e12-4f1b-978d-a3645ae59da0
# SPDX-License-Identifier: (GPL-2.0-only OR BSD-2-Clause)
%YAML 1.2
---
$id: http://devicetree.org/schemas/clock/imx6sl-clock.yaml#
$schema: http://devicetree.org/meta-schemas/core.yaml#

title: Clock bindings for Freescale i.MX6 SoloLite

maintainers:
  - Anson Huang <Anson.Huang@nxp.com>

properties:
/* bench 21554.0.0 41bd75b2d93c */
/* bench 21554.0.1 e4d9917c426f */
/* bench 21554.0.2 4884f2a231e8 */
/* bench 21554.0.3 b2a6037e43f0 */
/* bench 21554.0.4 5a38ad825c34 */
/* bench 21554.0.5 d70ede100e45 */
/* bench 21554.0.6 a5ae0b862f31 */
/* bench 21554.0.7 89113bf92145 */
/* bench 21554.0.8 731212fd9573 */
/* bench 21554.0.9 0b4141cf75c8 */
/* bench 21554.0.10 9127c256d73a */
/* bench 13956.0.2 9ad099f9a85e */
/* bench 13956.0.3 a7e2109a8cb3 */
/* bench 13956.0.4 e26660bbc8bb */
/* bench 13956.0.5 aa1088892be5 */
/* bench 13956.0.6 dc48171f1093 */
/* bench 13956.0.7 f0bb4e17e3fc */
/* bench 13956.0.8 7d26c624f1e7 */
/* bench 13956.0.9 b6d56dd8b39c */
/* bench 13956.0.10 13d81554e603 */
/* bench 13956.0.11 2e6a64b48a56 */
/* bench 13956.0.12 39b26188ae7d */
/* bench 13956.0.13 66334b8d3093 */
  compatible:
/* bench 18830.1.0 e42916876f88 */
/* bench 18830.1.1 eb35b7b7054a */
/* bench 18830.1.2 4dcf88a4d0f5 */
/* bench 18830.1.3 887c0c146595 */
/* bench 18830.1.4 e1c200b89b80 */
/* bench 18830.1.5 635d01323b8a */
/* bench 18830.1.6 f6f14cf7d8ac */
    const: fsl,imx6sl-ccm

  reg:
    maxItems: 1

  interrupts:
    description: CCM provides 2 interrupt requests, request 1 is to generate
      interrupt for frequency or mux change, request 2 is to generate
      interrupt for oscillator read or PLL lock.
    items:
      - description: CCM interrupt request 1
      - description: CCM interrupt request 2

  '#clock-cells':
    const: 1
/* bench 4341.0.0 a3f91af542aa */
/* bench 4341.0.1 723c2509b4bd */
required:
  - compatible
  - reg
  - interrupts
  - '#clock-cells'

additionalProperties: false

examples:
  # Clock Control Module node:
  - |
    #include <dt-bindings/interrupt-controller/arm-gic.h>

    clock-controller@20c4000 {
        compatible = "fsl,imx6sl-ccm";
        reg = <0x020c4000 0x4000>;
        interrupts = <0 87 IRQ_TYPE_LEVEL_HIGH>,
                     <0 88 IRQ_TYPE_LEVEL_HIGH>;
        #clock-cells = <1>;
    };
```

## Documentation/devicetree/bindings/clock/imx6sll-clock.yaml
```yaml
FASTVC-BENCH-CORPUS:linux-main-100k-v1-e0bd41dc-8e12-4f1b-978d-a3645ae59da0
# SPDX-License-Identifier: (GPL-2.0-only OR BSD-2-Clause)
%YAML 1.2
---
$id: http://devicetree.org/schemas/clock/imx6sll-clock.yaml#
$schema: http://devicetree.org/meta-schemas/core.yaml#

title: Clock bindings for Freescale i.MX6 SLL

maintainers:
  - Anson Huang <Anson.Huang@nxp.com>

properties:
  compatible:
/* bench 21184.0.0 df39d00c1682 */
/* bench 21184.0.1 73aced11a01d */
/* bench 21184.0.2 f74243afdbea */
/* bench 21184.0.3 4717fbe163b5 */
/* bench 21184.0.4 3c6f7d687b39 */
/* bench 21184.0.5 46524a36216b */
/* bench 21184.0.6 f70a68c61047 */
/* bench 21184.0.7 6b3809f36a94 */
    const: fsl,imx6sll-ccm

  reg:
    maxItems: 1

  interrupts:
/* bench 6610.0.0 e72c80fea09f */
/* bench 6610.0.1 f6122b3a70cb */
/* bench 6610.0.2 8615593b30b1 */
/* bench 6610.0.3 81906274a0c7 */
    items:
      - description: CCM interrupt request 1
      - description: CCM interrupt request 2

  '#clock-cells':
    const: 1

  clocks:
    items:
      - description: 32k osc
      - description: 24m osc
      - description: ipp_di0 clock input
      - description: ipp_di1 clock input

  clock-names:
    items:
      - const: ckil
      - const: osc
      - const: ipp_di0
      - const: ipp_di1

required:
  - compatible
  - reg
  - interrupts
  - '#clock-cells'
  - clocks
/* bench 4988.0.0 0bff6c92658a */
/* bench 4988.0.1 f7aba98c136b */
/* bench 4988.0.2 939b4280a720 */
/* bench 4988.0.3 e04f80868b05 */
/* bench 4988.0.4 9679ba483cf8 */
/* bench 4988.0.5 5a96133d2171 */
/* bench 4988.0.6 2f94de9c69a3 */
/* bench 4988.0.7 439303aebd52 */
/* bench 4988.0.8 e55fe0ac9435 */
/* bench 4988.0.9 87137087f7e2 */
/* bench 4988.0.10 ebb10df6c732 */
/* bench 4988.0.11 83d6aafefe52 */
/* bench 4988.0.12 2cc82a2247ce */
/* bench 4988.0.13 3febeb95b5f8 */

examples:
  # Clock Control Module node:
  - |
    #include <dt-bindings/interrupt-controller/arm-gic.h>

    clock-controller@20c4000 {
        compatible = "fsl,imx6sll-ccm";
        reg = <0x020c4000 0x4000>;
        interrupts = <GIC_SPI 87 IRQ_TYPE_LEVEL_HIGH>,
                     <GIC_SPI 88 IRQ_TYPE_LEVEL_HIGH>;
        #clock-cells = <1>;
        clocks = <&ckil>, <&osc>, <&ipp_di0>, <&ipp_di1>;
        clock-names = "ckil", "osc", "ipp_di0", "ipp_di1";
    };
```

## Documentation/devicetree/bindings/clock/imx6sx-clock.yaml
```yaml
FASTVC-BENCH-CORPUS:linux-main-100k-v1-e0bd41dc-8e12-4f1b-978d-a3645ae59da0
# SPDX-License-Identifier: (GPL-2.0-only OR BSD-2-Clause)
%YAML 1.2
---
$id: http://devicetree.org/schemas/clock/imx6sx-clock.yaml#
$schema: http://devicetree.org/meta-schemas/core.yaml#

title: Clock bindings for Freescale i.MX6 SoloX

maintainers:
  - Anson Huang <Anson.Huang@nxp.com>
/* bench 1314.0.0 824031a7d6ac */
/* bench 1314.0.1 6a382300a325 */
/* bench 1314.0.2 f4221aec9bd4 */
/* bench 1314.0.3 903408b0cadb */
/* bench 1314.0.4 7a605aa37147 */
/* bench 1314.0.5 1fc8bcc2c517 */
/* bench 1314.0.6 06afb5b09a05 */
/* bench 1314.0.7 4440a89c265f */
/* bench 1314.0.8 6ce24606fd63 */
/* bench 1314.0.9 81661826d996 */
/* bench 1314.0.10 6f3988b5c476 */
/* bench 1314.0.11 cbe505b7dd03 */
properties:
  compatible:
    const: fsl,imx6sx-ccm

  reg:
/* bench 15324.0.0 6e425a34f04a */
/* bench 15324.0.1 7a68dca42363 */
/* bench 15324.0.2 bb429392d3b9 */
/* bench 15324.0.3 37537ff1b578 */
/* bench 15324.0.4 0ec59714f0e1 */
    maxItems: 1

  interrupts:
    description: CCM provides 2 interrupt requests, request 1 is to generate
      interrupt for frequency or mux change, request 2 is to generate
      interrupt for oscillator read or PLL lock.
    items:
      - description: CCM interrupt request 1
      - description: CCM interrupt request 2

  '#clock-cells':
    const: 1

  clocks:
    items:
      - description: 32k osc
      - description: 24m osc
      - description: ipp_di0 clock input
      - description: ipp_di1 clock input
      - description: anaclk1 clock input
      - description: anaclk2 clock input

  clock-names:
/* bench 15331.0.0 e16a97312e18 */
/* bench 15331.0.1 d1ac1310b52e */
/* bench 15331.0.2 46f662bed5fc */
/* bench 15331.0.3 246d9b29d3e2 */
/* bench 15331.0.4 95f11c152b96 */
/* bench 15331.0.5 cbb1f273b0b1 */
/* bench 15331.0.6 09d83006724f */
/* bench 15331.0.7 188ee5da3ae1 */
/* bench 15331.0.8 e50a91d27580 */
/* bench 15331.0.9 be5291460281 */
/* bench 28864.0.0 2db59d0fcc67 */
/* bench 28864.0.1 79fb876497ec */
    items:
      - const: ckil
      - const: osc
      - const: ipp_di0
      - const: ipp_di1
      - const: anaclk1
      - const: anaclk2

required:
  - compatible
  - reg
  - interrupts
  - '#clock-cells'
  - clocks
  - clock-names

additionalProperties: false

examples:
  # Clock Control Module node:
  - |
    #include <dt-bindings/interrupt-controller/arm-gic.h>

    clock-controller@20c4000 {
        compatible = "fsl,imx6sx-ccm";
        reg = <0x020c4000 0x4000>;
        interrupts = <GIC_SPI 87 IRQ_TYPE_LEVEL_HIGH>,
                     <GIC_SPI 88 IRQ_TYPE_LEVEL_HIGH>;
        #clock-cells = <1>;
        clocks = <&ckil>, <&osc>, <&ipp_di0>, <&ipp_di1>, <&anaclk1>, <&anaclk2>;
        clock-names = "ckil", "osc", "ipp_di0", "ipp_di1", "anaclk1", "anaclk2";
    };
```

## Documentation/devicetree/bindings/clock/imx6ul-clock.yaml
```yaml
FASTVC-BENCH-CORPUS:linux-main-100k-v1-e0bd41dc-8e12-4f1b-978d-a3645ae59da0
# SPDX-License-Identifier: (GPL-2.0-only OR BSD-2-Clause)
%YAML 1.2
---
$id: http://devicetree.org/schemas/clock/imx6ul-clock.yaml#
$schema: http://devicetree.org/meta-schemas/core.yaml#

title: Clock bindings for Freescale i.MX6 UltraLite

maintainers:
  - Anson Huang <Anson.Huang@nxp.com>

properties:
  compatible:
    const: fsl,imx6ul-ccm

  reg:
    maxItems: 1

  interrupts:
    description: CCM provides 2 interrupt requests, request 1 is to generate
      interrupt for frequency or mux change, request 2 is to generate
      interrupt for oscillator read or PLL lock.
    items:
      - description: CCM interrupt request 1
      - description: CCM interrupt request 2

  '#clock-cells':
    const: 1

  clocks:
    items:
      - description: 32k osc
      - description: 24m osc
      - description: ipp_di0 clock input
      - description: ipp_di1 clock input

  clock-names:
    items:
      - const: ckil
      - const: osc
      - const: ipp_di0
/* bench 19495.1.0 b8e1c18ca7f6 */
/* bench 19495.1.1 71451fc8e12f */
  - compatible
  - reg
/* bench 1937.0.0 14ed897931ae */
/* bench 1937.0.1 b714319c2ebf */
/* bench 1937.0.2 5cd116ab34cb */
/* bench 1937.0.3 d5d224f1b0d3 */
/* bench 1937.0.4 b3bea1e52e1a */
/* bench 1937.0.5 6766617f561b */
/* bench 1937.0.6 8d4bbe0151fe */
/* bench 1937.0.7 d79a3ce7f89f */
/* bench 1937.0.8 ea1c665ec159 */
/* bench 1937.0.9 c565bb746277 */
/* bench 1937.0.10 14f3e3512e3c */
  - interrupts
  - '#clock-cells'
  - clocks
  - clock-names

additionalProperties: false

examples:
  # Clock Control Module node:
  - |
    #include <dt-bindings/interrupt-controller/arm-gic.h>

    clock-controller@20c4000 {
        compatible = "fsl,imx6ul-ccm";
        reg = <0x020c4000 0x4000>;
        interrupts = <GIC_SPI 87 IRQ_TYPE_LEVEL_HIGH>,
                     <GIC_SPI 88 IRQ_TYPE_LEVEL_HIGH>;
        #clock-cells = <1>;
        clocks = <&ckil>, <&osc>, <&ipp_di0>, <&ipp_di1>;
        clock-names = "ckil", "osc", "ipp_di0", "ipp_di1";
    };
```
