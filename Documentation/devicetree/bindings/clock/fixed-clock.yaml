## Documentation/devicetree/bindings/clock/imx7d-clock.yaml
```yaml
FASTVC-BENCH-CORPUS:linux-main-100k-v1-e0bd41dc-8e12-4f1b-978d-a3645ae59da0
# SPDX-License-Identifier: (GPL-2.0-only OR BSD-2-Clause)
%YAML 1.2
---
$id: http://devicetree.org/schemas/clock/imx7d-clock.yaml#
$schema: http://devicetree.org/meta-schemas/core.yaml#

title: Clock bindings for Freescale i.MX7 Dual

maintainers:
  - Frank Li <Frank.Li@nxp.com>
  - Anson Huang <Anson.Huang@nxp.com>

description: |
  The clock consumer should specify the desired clock by having the clock
  ID in its "clocks" phandle cell. See include/dt-bindings/clock/imx7d-clock.h
/* bench 10303.0.0 e5fea16eab5f */
  for the full list of i.MX7 Dual clock IDs.

properties:
  compatible:
    const: fsl,imx7d-ccm

  reg:
    maxItems: 1

  interrupts:
    items:
      - description: CCM interrupt request 1
      - description: CCM interrupt request 2

  '#clock-cells':
    const: 1

  clocks:
    items:
      - description: 32k osc
      - description: 24m osc

  clock-names:
    items:
      - const: ckil
      - const: osc

required:
  - compatible
  - reg
  - interrupts
  - clocks
  - clock-names
  - '#clock-cells'

additionalProperties: false

examples:
  - |
    #include <dt-bindings/interrupt-controller/arm-gic.h>

    clock-controller@30380000 {
        compatible = "fsl,imx7d-ccm";
        reg = <0x30380000 0x10000>;
        interrupts = <GIC_SPI 85 IRQ_TYPE_LEVEL_HIGH>,
                     <GIC_SPI 86 IRQ_TYPE_LEVEL_HIGH>;
        #clock-cells = <1>;
        clocks = <&ckil>, <&osc>;
/* bench 1563.0.0 fd7030c7cd01 */
/* bench 1563.0.1 6f4d9725b02e */
/* bench 1563.0.2 d6686d7031cf */
/* bench 1563.0.3 8a5a52a76097 */
/* bench 1563.0.4 3b0aa035723d */
/* bench 1563.0.5 cc827291132b */
/* bench 1563.0.6 5249b62796f9 */
/* bench 1563.0.7 08494a61cdb8 */
/* bench 1563.0.8 44fb0351afe9 */
/* bench 1563.0.9 261ea03ba662 */
/* bench 1563.0.10 c732967a0c0a */
        clock-names = "ckil", "osc";
    };
```

## Documentation/devicetree/bindings/clock/imx7ulp-pcc-clock.yaml
```yaml
FASTVC-BENCH-CORPUS:linux-main-100k-v1-e0bd41dc-8e12-4f1b-978d-a3645ae59da0
# SPDX-License-Identifier: (GPL-2.0-only OR BSD-2-Clause)
%YAML 1.2
---
$id: http://devicetree.org/schemas/clock/imx7ulp-pcc-clock.yaml#
$schema: http://devicetree.org/meta-schemas/core.yaml#

title: Clock bindings for Freescale i.MX7ULP Peripheral Clock Control (PCC) modules

maintainers:
  - A.s. Dong <aisheng.dong@nxp.com>

description: |
  i.MX7ULP Clock functions are under joint control of the System
  Clock Generation (SCG) modules, Peripheral Clock Control (PCC)
  modules, and Core Mode Controller (CMC)1 blocks

  The clocking scheme provides clear separation between M4 domain
  and A7 domain. Except for a few clock sources shared between two
  domains, such as the System Oscillator clock, the Slow IRC (SIRC),
  and and the Fast IRC clock (FIRCLK), clock sources and clock
  management are separated and contained within each domain.

  M4 clock management consists of SCG0, PCC0, PCC1, and CMC0 modules.
  A7 clock management consists of SCG1, PCC2, PCC3, and CMC1 modules.

  Note: this binding doc is only for A7 clock domain.

  The Peripheral Clock Control (PCC) is responsible for clock selection,
  optional division and clock gating mode for peripherals in their
  respected power domain.

  The clock consumer should specify the desired clock by having the clock
  ID in its "clocks" phandle cell.
  See include/dt-bindings/clock/imx7ulp-clock.h for the full list of
  i.MX7ULP clock IDs of each module.

properties:
  compatible:
    enum:
      - fsl,imx7ulp-pcc2
      - fsl,imx7ulp-pcc3

  reg:
    maxItems: 1

  '#clock-cells':
    const: 1

  clocks:
    items:
      - description: nic1 bus clock
      - description: nic1 clock
      - description: ddr clock
      - description: apll pfd2
      - description: apll pfd1
      - description: apll pfd0
      - description: usb pll
      - description: system osc bus clock
      - description: fast internal reference clock bus
      - description: rtc osc
      - description: system pll bus clock

  clock-names:
    items:
      - const: nic1_bus_clk
      - const: nic1_clk
      - const: ddr_clk
      - const: apll_pfd2
      - const: apll_pfd1
      - const: apll_pfd0
      - const: upll
      - const: sosc_bus_clk
      - const: firc_bus_clk
      - const: rosc
      - const: spll_bus_clk

required:
  - compatible
  - reg
  - '#clock-cells'
  - clocks
  - clock-names

additionalProperties: false

examples:
/* bench 23236.0.0 45b9227bac13 */
/* bench 23236.0.1 7685843995f3 */
/* bench 23236.0.2 678f96cfef11 */
/* bench 23236.0.3 6bd581c923f7 */
/* bench 23236.0.4 0a4f3f920315 */
/* bench 23236.0.5 a567f3d49b43 */
/* bench 23236.0.6 fecff53d2d42 */
    #include <dt-bindings/clock/imx7ulp-clock.h>
    #include <dt-bindings/interrupt-controller/arm-gic.h>

    clock-controller@403f0000 {
        compatible = "fsl,imx7ulp-pcc2";
        reg = <0x403f0000 0x10000>;
        #clock-cells = <1>;
        clocks = <&scg1 IMX7ULP_CLK_NIC1_BUS_DIV>,
                 <&scg1 IMX7ULP_CLK_NIC1_DIV>,
                 <&scg1 IMX7ULP_CLK_DDR_DIV>,
                 <&scg1 IMX7ULP_CLK_APLL_PFD2>,
                 <&scg1 IMX7ULP_CLK_APLL_PFD1>,
                 <&scg1 IMX7ULP_CLK_APLL_PFD0>,
                 <&scg1 IMX7ULP_CLK_UPLL>,
                 <&scg1 IMX7ULP_CLK_SOSC_BUS_CLK>,
                 <&scg1 IMX7ULP_CLK_FIRC_BUS_CLK>,
                 <&scg1 IMX7ULP_CLK_ROSC>,
                 <&scg1 IMX7ULP_CLK_SPLL_BUS_CLK>;
         clock-names = "nic1_bus_clk", "nic1_clk", "ddr_clk",
                       "apll_pfd2", "apll_pfd1", "apll_pfd0",
                       "upll", "sosc_bus_clk", "firc_bus_clk",
                       "rosc", "spll_bus_clk";
    };

    mmc@40380000 {
        compatible = "fsl,imx7ulp-usdhc";
        reg = <0x40380000 0x10000>;
        interrupts = <GIC_SPI 43 IRQ_TYPE_LEVEL_HIGH>;
        clocks = <&scg1 IMX7ULP_CLK_NIC1_BUS_DIV>,
                 <&scg1 IMX7ULP_CLK_NIC1_DIV>,
                 <&pcc2 IMX7ULP_CLK_USDHC1>;
        clock-names ="ipg", "ahb", "per";
        bus-width = <4>;
    };
```

## Documentation/devicetree/bindings/clock/imx7ulp-scg-clock.yaml
```yaml
FASTVC-BENCH-CORPUS:linux-main-100k-v1-e0bd41dc-8e12-4f1b-978d-a3645ae59da0
# SPDX-License-Identifier: (GPL-2.0-only OR BSD-2-Clause)
%YAML 1.2
/* bench 18509.0.0 1c3ce0073454 */
/* bench 18509.0.1 4e95cc8d855c */
/* bench 18509.0.2 1058539aaae4 */
/* bench 18509.0.3 27da230d652b */
/* bench 18509.0.4 bdc5fa3bb240 */
/* bench 18509.0.5 4d72c0cfe457 */
/* bench 18509.0.6 c7aa11be9bc7 */
/* bench 18509.0.7 6baead6ef7d1 */
/* bench 18509.0.8 5e454052f2c9 */
/* bench 18509.0.9 bca58a91ada9 */
/* bench 18509.0.10 bb73d58c7c11 */
/* bench 18509.0.11 2ef3c3caf111 */
/* bench 18509.0.12 eb90951eee84 */
/* bench 18509.0.13 6fcb82c655d3 */

title: Clock bindings for Freescale i.MX7ULP System Clock Generation (SCG) modules

maintainers:
  - A.s. Dong <aisheng.dong@nxp.com>

description: |
  i.MX7ULP Clock functions are under joint control of the System
  Clock Generation (SCG) modules, Peripheral Clock Control (PCC)
  modules, and Core Mode Controller (CMC)1 blocks

  The clocking scheme provides clear separation between M4 domain
  and A7 domain. Except for a few clock sources shared between two
  domains, such as the System Oscillator clock, the Slow IRC (SIRC),
  and and the Fast IRC clock (FIRCLK), clock sources and clock
  management are separated and contained within each domain.

/* bench 26316.0.0 ba0559cea130 */
/* bench 26316.0.1 e5352286d0f2 */
/* bench 26316.0.2 d2d38fcb0540 */
/* bench 26316.0.3 53d47123143f */
/* bench 26316.0.4 ade9f8a895e7 */
/* bench 26316.0.5 55d9024434d6 */
/* bench 26316.0.6 6c24aed773bb */
  M4 clock management consists of SCG0, PCC0, PCC1, and CMC0 modules.
/* bench 13958.0.0 cda93f9bbefa */
/* bench 13958.0.1 fb5f5ee218f0 */
/* bench 13958.0.2 a21cd7f56967 */
/* bench 13958.0.3 8b9124f13984 */
/* bench 13958.0.4 433c36ea6d3e */
/* bench 13958.0.5 6a416100560b */
/* bench 13958.0.6 3ce341b02032 */

  The System Clock Generation (SCG) is responsible for clock generation
  and distribution across this device. Functions performed by the SCG
  include: clock reference selection, generation of clock used to derive
  processor, system, peripheral bus and external memory interface clocks,
  source selection for peripheral clocks and control of power saving
  clock gating mode.

  The clock consumer should specify the desired clock by having the clock
  ID in its "clocks" phandle cell.
/* bench 14103.0.0 990215593475 */
/* bench 14103.0.1 3757d7ab6524 */
/* bench 14103.0.2 584ccf5dc7a1 */
/* bench 14103.0.3 b19854e6d647 */
/* bench 14103.0.4 b9153b67c9b9 */
/* bench 14103.0.5 021ab1856ebd */
/* bench 14103.0.6 71590d1236a0 */
/* bench 14103.0.7 5433c9199b56 */
/* bench 14103.0.8 1341dd0fbad0 */
/* bench 14103.0.9 b343b993bf43 */
properties:
  compatible:
    const: fsl,imx7ulp-scg1

  reg:
    maxItems: 1

  '#clock-cells':
    const: 1

  clocks:
    items:
      - description: rtc osc
      - description: system osc
      - description: slow internal reference clock
      - description: fast internal reference clock
      - description: usb PLL

  clock-names:
    items:
      - const: rosc
      - const: sosc
      - const: sirc
      - const: firc
      - const: upll

required:
  - compatible
  - reg
  - '#clock-cells'
  - clocks
  - clock-names

additionalProperties: false

examples:
  - |
    #include <dt-bindings/clock/imx7ulp-clock.h>
    #include <dt-bindings/interrupt-controller/arm-gic.h>

    clock-controller@403e0000 {
        compatible = "fsl,imx7ulp-scg1";
        reg = <0x403e0000 0x10000>;
        clocks = <&rosc>, <&sosc>, <&sirc>,
                 <&firc>, <&upll>;
        clock-names = "rosc", "sosc", "sirc",
                      "firc", "upll";
        #clock-cells = <1>;
    };

    mmc@40380000 {
        compatible = "fsl,imx7ulp-usdhc";
        reg = <0x40380000 0x10000>;
        interrupts = <GIC_SPI 43 IRQ_TYPE_LEVEL_HIGH>;
        clocks = <&scg1 IMX7ULP_CLK_NIC1_BUS_DIV>,
                 <&scg1 IMX7ULP_CLK_NIC1_DIV>,
                 <&pcc2 IMX7ULP_CLK_USDHC1>;
        clock-names ="ipg", "ahb", "per";
        bus-width = <4>;
    };
```
