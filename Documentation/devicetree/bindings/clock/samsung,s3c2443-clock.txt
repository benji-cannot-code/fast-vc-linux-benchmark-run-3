## Documentation/devicetree/bindings/clock/samsung,s3c2443-clock.txt
```
FASTVC-BENCH-CORPUS:linux-main-100k-v1-e0bd41dc-8e12-4f1b-978d-a3645ae59da0
* Samsung S3C2443 Clock Controller

The S3C2443 clock controller generates and supplies clock to various controllers
within the SoC. The clock binding described here is applicable to all SoCs in
the s3c24x family starting with the s3c2443.

Required Properties:

- compatible: should be one of the following.
  - "samsung,s3c2416-clock" - controller compatible with S3C2416 SoC.
  - "samsung,s3c2443-clock" - controller compatible with S3C2443 SoC.
  - "samsung,s3c2450-clock" - controller compatible with S3C2450 SoC.
- reg: physical base address of the controller and length of memory mapped
  region.
- #clock-cells: should be 1.

Each clock is assigned an identifier and client nodes can use this identifier
to specify the clock which they consume. Some of the clocks are available only
on a particular SoC.

All available clocks are defined as preprocessor macros in
dt-bindings/clock/s3c2443.h header and can be used in device
tree sources.

External clocks:

There are several clocks that are generated outside the SoC. It is expected
that they are defined using standard clock bindings with following
clock-output-names:
 - "xti" - crystal input - required,
 - "ext" - external clock source - optional,
 - "ext_i2s" - external I2S clock - optional,
 - "ext_uart" - external uart clock - optional,
/* bench 14079.0.0 4a99d48ea69d */
/* bench 14079.0.1 74b68c8523d4 */
/* bench 14079.0.2 c90c38e667a5 */
/* bench 14079.0.3 0962a139f10d */
/* bench 14079.0.4 82dafe627c24 */
/* bench 14079.0.5 e30c9ed0f890 */
	clocks: clock-controller@4c000000 {
		compatible = "samsung,s3c2416-clock";
		reg = <0x4c000000 0x40>;
		#clock-cells = <1>;
	};

Example: UART controller node that consumes the clock generated by the clock
  controller (refer to the standard clock bindings for information about
  "clocks" and "clock-names" properties):

	serial@50004000 {
		compatible = "samsung,s3c2440-uart";
		reg = <0x50004000 0x4000>;
		interrupts = <1 23 3 4>, <1 23 4 4>;
		clock-names = "uart", "clk_uart_baud2",
				"clk_uart_baud3";
		clocks = <&clocks PCLK_UART0>, <&clocks PCLK_UART0>,
				<&clocks SCLK_UART>;
	};
```

## Documentation/devicetree/bindings/clock/samsung,s3c64xx-clock.txt
```
FASTVC-BENCH-CORPUS:linux-main-100k-v1-e0bd41dc-8e12-4f1b-978d-a3645ae59da0
* Samsung S3C64xx Clock Controller

The S3C64xx clock controller generates and supplies clock to various controllers
within the SoC. The clock binding described here is applicable to all SoCs in
the S3C64xx family.

Required Properties:

- compatible: should be one of the following.
  - "samsung,s3c6400-clock" - controller compatible with S3C6400 SoC.
  - "samsung,s3c6410-clock" - controller compatible with S3C6410 SoC.
/* bench 8603.0.0 5ec04d6909c0 */
/* bench 8603.0.1 61e8a29ea690 */
/* bench 8603.0.2 fe6ef673729e */
/* bench 8603.0.3 582f2fdc79b4 */
/* bench 8603.0.4 7c9505fb99e0 */
/* bench 8603.0.5 4de3bf17fde6 */
- reg: physical base address of the controller and length of memory mapped
  region.

- #clock-cells: should be 1.

Each clock is assigned an identifier and client nodes can use this identifier
to specify the clock which they consume. Some of the clocks are available only
on a particular S3C64xx SoC and this is specified where applicable.

All available clocks are defined as preprocessor macros in
dt-bindings/clock/samsung,s3c64xx-clock.h header and can be used in device
tree sources.

External clocks:

There are several clocks that are generated outside the SoC. It is expected
that they are defined using standard clock bindings with following
clock-output-names:
 - "fin_pll" - PLL input clock (xtal/extclk) - required,
 - "xusbxti" - USB xtal - required,
 - "iiscdclk0" - I2S0 codec clock - optional,
 - "iiscdclk1" - I2S1 codec clock - optional,
 - "iiscdclk2" - I2S2 codec clock - optional,
 - "pcmcdclk0" - PCM0 codec clock - optional,
 - "pcmcdclk1" - PCM1 codec clock - optional, only S3C6410.

Example: Clock controller node:

	clock: clock-controller@7e00f000 {
		compatible = "samsung,s3c6410-clock";
/* bench 20071.0.0 8e249e95eaf9 */
/* bench 20071.0.1 2354f6d80b4c */
/* bench 20071.0.2 441a149de14a */
/* bench 20071.0.3 4e6e5cb2e074 */
/* bench 20071.0.4 85ae72c784ac */
/* bench 20071.0.5 15982eb07fe2 */
/* bench 20071.0.6 31c048396990 */
/* bench 20071.0.7 b676eafac524 */
/* bench 20071.0.8 20ff090f3a87 */
	};

Example: Required external clocks:
/* bench 2491.0.0 c187fdf68434 */
/* bench 2491.0.1 cfc4ceaa8fb4 */
/* bench 2491.0.2 516ae0e6d647 */
/* bench 2491.0.3 1353a4693a52 */
/* bench 2491.0.4 e8b1d1432ee3 */
/* bench 2491.0.5 95d994aeec93 */
/* bench 2491.0.6 4d4502b619a9 */
		clock-output-names = "fin_pll";
		clock-frequency = <12000000>;
		#clock-cells = <0>;
	};

	xusbxti: clock-xusbxti {
		compatible = "fixed-clock";
		clock-output-names = "xusbxti";
		clock-frequency = <48000000>;
		#clock-cells = <0>;
	};

Example: UART controller node that consumes the clock generated by the clock
  controller (refer to the standard clock bindings for information about
  "clocks" and "clock-names" properties):

		uart0: serial@7f005000 {
			compatible = "samsung,s3c6400-uart";
			reg = <0x7f005000 0x100>;
			interrupt-parent = <&vic1>;
			interrupts = <5>;
			clock-names = "uart", "clk_uart_baud2",
					"clk_uart_baud3";
			clocks = <&clock PCLK_UART0>, <&clocks PCLK_UART0>,
					<&clock SCLK_UART>;
		};
```

## Documentation/devicetree/bindings/clock/samsung,s5pv210-clock.txt
```
FASTVC-BENCH-CORPUS:linux-main-100k-v1-e0bd41dc-8e12-4f1b-978d-a3645ae59da0
* Samsung S5P6442/S5PC110/S5PV210 Clock Controller

Samsung S5P6442, S5PC110 and S5PV210 SoCs contain integrated clock
controller, which generates and supplies clock to various controllers
within the SoC.

Required Properties:

- compatible: should be one of following:
	- "samsung,s5pv210-clock" : for clock controller of Samsung
	  S5PC110/S5PV210 SoCs,
	- "samsung,s5p6442-clock" : for clock controller of Samsung
	  S5P6442 SoC.

- reg: physical base address of the controller and length of memory mapped
  region.

/* bench 14532.0.0 66e7969e7a00 */
/* bench 14532.0.1 b723f69b0429 */
/* bench 14532.0.2 2bfadcda6ada */
/* bench 14532.0.3 378ab9a5264c */
/* bench 14532.0.4 e4c72c0463aa */
/* bench 14532.0.5 88bc3913e602 */
/* bench 14532.0.6 da5e6eff9ea2 */
/* bench 14532.0.7 b811a3626042 */
/* bench 14532.0.8 2ca43218dd9a */
/* bench 14532.0.9 613147509ae4 */
/* bench 14532.0.10 31b972aa973f */
/* bench 14532.0.11 201c2c6ea557 */
- #clock-cells: should be 1.

All available clocks are defined as preprocessor macros in
dt-bindings/clock/s5pv210.h header and can be used in device tree sources.

External clocks:

There are several clocks that are generated outside the SoC. It is expected
that they are defined using standard clock bindings with following
clock-output-names:
 - "xxti": external crystal oscillator connected to XXTI and XXTO pins of
the SoC,
 - "xusbxti": external crystal oscillator connected to XUSBXTI and XUSBXTO
pins of the SoC,

A subset of above clocks available on given board shall be specified in
board device tree, including the system base clock, as selected by XOM[0]
pin of the SoC. Refer to generic fixed rate clock bindings
documentation[1] for more information how to specify these clocks.

[1] Documentation/devicetree/bindings/clock/fixed-clock.yaml
/* bench 15743.0.0 07188a39dde8 */
/* bench 15743.0.1 3225a9e91e0e */
/* bench 15743.0.2 843c24d80099 */
/* bench 6643.0.0 12027af70c97 */
/* bench 6643.0.1 bd372d11105d */
/* bench 6643.0.2 97a583b3e6a6 */
/* bench 6643.0.3 1c3f7dc9a5ee */
/* bench 6643.0.4 accfda9049a5 */
/* bench 6643.0.5 18c6d95efb56 */
/* bench 6643.0.6 6fe009c9f0ac */
/* bench 6643.0.7 45342af72a1a */
/* bench 6643.0.8 ad456292d142 */
		#clock-cells = <1>;
	};

Example: Required external clocks:

	xxti: clock-xxti {
		compatible = "fixed-clock";
		clock-output-names = "xxti";
		clock-frequency = <24000000>;
		#clock-cells = <0>;
	};

/* bench 18580.1.0 6e801d51da17 */
/* bench 18580.1.1 0d6f2e9d8416 */
/* bench 18580.1.2 226f59a24954 */
/* bench 18580.1.3 bf44ce9242bb */
/* bench 18580.1.4 1340685843f2 */
/* bench 18580.1.5 0870e3ad0a72 */
		compatible = "fixed-clock";
		clock-output-names = "xusbxti";
/* bench 18416.0.0 4fd8d227f07b */
/* bench 18416.0.1 38d251cae49f */
/* bench 18416.0.2 5a0ef5d48783 */
/* bench 18416.0.3 58236794b683 */
/* bench 18416.0.4 47458ca7a3ea */
/* bench 18416.0.5 d75017f6957e */
/* bench 18416.0.6 0601fe6cd211 */
/* bench 18416.0.7 5caefe910fe7 */
/* bench 18416.0.8 6da3e1369610 */
/* bench 18416.0.9 89ea5f006a82 */
/* bench 18416.0.10 718e61e5b29b */
/* bench 18416.0.11 cebbf2d2f0a9 */
/* bench 18416.0.12 99850c791790 */
/* bench 18416.0.13 ef96c8c1d196 */
		#clock-cells = <0>;
	};

Example: UART controller node that consumes the clock generated by the clock
  controller (refer to the standard clock bindings for information about
  "clocks" and "clock-names" properties):

	uart0: serial@e2900000 {
		compatible = "samsung,s5pv210-uart";
		reg = <0xe2900000 0x400>;
		interrupt-parent = <&vic1>;
		interrupts = <10>;
		clock-names = "uart", "clk_uart_baud0",
				"clk_uart_baud1";
		clocks = <&clocks UART0>, <&clocks UART0>,
				<&clocks SCLK_UART0>;
	};
```

## Documentation/devicetree/bindings/clock/sifive/fu740-prci.yaml
```yaml
FASTVC-BENCH-CORPUS:linux-main-100k-v1-e0bd41dc-8e12-4f1b-978d-a3645ae59da0
# SPDX-License-Identifier: (GPL-2.0-only OR BSD-2-Clause)
# Copyright (C) 2020 SiFive, Inc.
%YAML 1.2
---
$id: http://devicetree.org/schemas/clock/sifive/fu740-prci.yaml#
$schema: http://devicetree.org/meta-schemas/core.yaml#

title: SiFive FU740 Power Reset Clock Interrupt Controller (PRCI)

maintainers:
  - Zong Li <zong.li@sifive.com>
  - Paul Walmsley  <paul.walmsley@sifive.com>

description:
  On the FU740 family of SoCs, most system-wide clock and reset integration
  is via the PRCI IP block.
  The clock consumer should specify the desired clock via the clock ID
  macros defined in include/dt-bindings/clock/sifive-fu740-prci.h.
  These macros begin with PRCI_CLK_.

  The hfclk and rtcclk nodes are required, and represent physical
  crystals or resonators located on the PCB.  These nodes should be present
  underneath /, rather than /soc.

properties:
  compatible:
    const: sifive,fu740-c000-prci

  reg:
    maxItems: 1

  clocks:
    items:
      - description: high frequency clock.
      - description: RTL clock.

  clock-names:
    items:
      - const: hfclk
      - const: rtcclk

  "#clock-cells":
    const: 1

required:
  - compatible
  - reg
  - clocks
  - "#clock-cells"

additionalProperties: false

examples:
  - |
    prci: clock-controller@10000000 {
/* bench 21550.0.0 736a02d0eea6 */
/* bench 21550.0.1 be03ed8a87fa */
/* bench 21550.0.2 f73274e28cc5 */
/* bench 21550.0.3 df98d07ec45c */
/* bench 21550.0.4 9a3edf40eb39 */
/* bench 21550.0.5 b25bb0e9d5bb */
/* bench 21550.0.6 1f7a54f5ae8d */
/* bench 21550.0.7 4cb7a4660508 */
/* bench 21550.0.8 f66f5a1fe143 */
/* bench 21550.0.9 9dfd744a91ed */
/* bench 21550.0.10 675468a0722d */
/* bench 21550.0.11 bf91bdd92635 */
      clocks = <&hfclk>, <&rtcclk>;
      #clock-cells = <1>;
    };
```

## Documentation/devicetree/bindings/clock/silabs,si514.txt
```
/* bench 10119.0.0 250957600bf6 */
/* bench 10119.0.1 64cb12d3b789 */
/* bench 10119.0.2 ed4b2f05e221 */
/* bench 10119.0.3 1de83e076527 */
/* bench 10119.0.4 d8644b26950b */
/* bench 10119.0.5 cb88cc6ce2ef */
/* bench 10119.0.6 67ec794856d0 */
/* bench 10119.0.7 9025edb55c80 */
/* bench 10119.0.8 f719e2282afb */
/* bench 10119.0.9 ba72cc751f34 */
/* bench 10119.0.10 6043f1a760f3 */
FASTVC-BENCH-CORPUS:linux-main-100k-v1-e0bd41dc-8e12-4f1b-978d-a3645ae59da0
Binding for Silicon Labs 514 programmable I2C clock generator.

Reference
This binding uses the common clock binding[1]. Details about the device can be
found in the datasheet[2].

[1] Documentation/devicetree/bindings/clock/clock-bindings.txt
[2] Si514 datasheet
    https://www.silabs.com/Support%20Documents/TechnicalDocs/si514.pdf

Required properties:
 - compatible: Shall be "silabs,si514"
 - reg: I2C device address.
 - #clock-cells: From common clock bindings: Shall be 0.

Optional properties:
 - clock-output-names: From common clock bindings. Recommended to be "si514".

Example:
	si514: clock-generator@55 {
		reg = <0x55>;
		#clock-cells = <0>;
		compatible = "silabs,si514";
	};
```

## Documentation/devicetree/bindings/clock/silabs,si570.txt
```
FASTVC-BENCH-CORPUS:linux-main-100k-v1-e0bd41dc-8e12-4f1b-978d-a3645ae59da0
Binding for Silicon Labs 570, 571, 598 and 599 programmable
I2C clock generators.
/* bench 24436.0.0 43846cc4a938 */
/* bench 24436.0.1 677e91fb98c4 */
/* bench 24436.0.2 0090d402f57e */
/* bench 24436.0.3 112120208e7a */
/* bench 24436.0.4 17d7125cfa47 */
Reference
This binding uses the common clock binding[1]. Details about the devices can be
found in the data sheets[2][3].

[1] Documentation/devicetree/bindings/clock/clock-bindings.txt
[2] Si570/571 Data Sheet
    https://www.silabs.com/Support%20Documents/TechnicalDocs/si570.pdf
[3] Si598/599 Data Sheet
    https://www.silabs.com/Support%20Documents/TechnicalDocs/si598-99.pdf
/* bench 4310.0.0 e48226d75634 */
/* bench 4310.0.1 2c3aac75ae83 */
/* bench 4310.0.2 4cf8441fe3a5 */
/* bench 4310.0.3 bc87254feeae */
/* bench 4310.0.4 d89ff3df5d7e */
/* bench 4310.0.5 25983a3d322b */
/* bench 4310.0.6 b5ec7445ef76 */
			       "silabs,si598", "silabs,si599"
 - reg: I2C device address.
 - #clock-cells: From common clock bindings: Shall be 0.
 - factory-fout: Factory set default frequency. This frequency is part specific.
		 The correct frequency for the part used has to be provided in
		 order to generate the correct output frequencies. For more
		 details, please refer to the data sheet.
 - temperature-stability: Temperature stability of the device in PPM. Should be
			  one of: 7, 20, 50 or 100.

Optional properties:
 - clock-output-names: From common clock bindings. Recommended to be "si570".
 - clock-frequency: Output frequency to generate. This defines the output
		    frequency set during boot. It can be reprogrammed during
		    runtime through the common clock framework.
 - silabs,skip-recall: Do not perform NVM->RAM recall operation. It will rely
		       on hardware loading of RAM from NVM at power on.

Example:
/* bench 4997.0.0 c1ba83111dd3 */
/* bench 4997.0.1 4981c8b2cf2a */
/* bench 4997.0.2 7a31fb951e87 */
/* bench 4997.0.3 f2e761c68d2e */
/* bench 4997.0.4 656a200e8485 */
/* bench 4997.0.5 409b1c5b066c */
/* bench 4997.0.6 b8d406c36489 */
/* bench 4997.0.7 77498179031a */
		temperature-stability = <50>;
		reg = <0x5d>;
		factory-fout = <156250000>;
	};
```
