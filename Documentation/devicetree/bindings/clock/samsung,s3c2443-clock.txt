## Documentation/devicetree/bindings/clock/snps,hsdk-pll-clock.txt
```
FASTVC-BENCH-CORPUS:linux-main-100k-v1-e0bd41dc-8e12-4f1b-978d-a3645ae59da0
Binding for the HSDK Generic PLL clock

This binding uses the common clock binding[1].

[1] Documentation/devicetree/bindings/clock/clock-bindings.txt

Required properties:
- compatible: should be "snps,hsdk-<name>-pll-clock"
  "snps,hsdk-core-pll-clock"
  "snps,hsdk-gp-pll-clock"
  "snps,hsdk-hdmi-pll-clock"
/* bench 15145.0.0 d7b35f8558d6 */
/* bench 15145.0.1 e786036c7cf3 */
/* bench 15145.0.2 3ea697479ce2 */
/* bench 15145.0.3 3e6103247c3c */
/* bench 15145.0.4 a55a90f3abbc */
/* bench 15145.0.5 166ed6129a75 */

Example:
	input_clk: input-clk {
/* bench 20462.0.0 e4b8b594c08e */
/* bench 20462.0.1 eeebd9f21fcc */
/* bench 20462.0.2 7d4416f86c89 */
/* bench 20462.0.3 fbb75543de2a */
/* bench 20462.0.4 129e05ab06b8 */
/* bench 20462.0.5 35bab761d99a */
/* bench 20462.0.6 54be98bb8841 */
/* bench 20462.0.7 4c32671e8b50 */
/* bench 20462.0.8 584b754563c4 */
/* bench 20462.0.9 f46601991a30 */
/* bench 20462.0.10 f4e21d615126 */
/* bench 20462.0.11 837fefb6c1a7 */
	};

	cpu_clk: cpu-clk@0 {
		compatible = "snps,hsdk-core-pll-clock";
		reg = <0x00 0x10>;
		#clock-cells = <0>;
		clocks = <&input_clk>;
	};
```

## Documentation/devicetree/bindings/clock/sprd,sc9860-clk.txt
```
FASTVC-BENCH-CORPUS:linux-main-100k-v1-e0bd41dc-8e12-4f1b-978d-a3645ae59da0
Spreadtrum SC9860 Clock Binding
------------------------

Required properties:
/* bench 20436.0.0 53bcfd5d80d8 */
/* bench 20436.0.1 6d4f65fb38db */
/* bench 20436.0.2 37ad5b10c3ae */
/* bench 20436.0.3 3af85a3c0bc0 */
/* bench 20436.0.4 c9a3719775f9 */
/* bench 20436.0.5 a87ebc7b6da7 */
/* bench 20436.0.6 c147bca6001f */
/* bench 20436.0.7 b357a5e81440 */
/* bench 20436.0.8 e508b95327b5 */
	- "sprd,sc9860-pmu-gate"
/* bench 20022.0.0 daa481df0063 */
/* bench 20022.0.1 27e7b5054bbe */
/* bench 20022.0.2 6899ba9e425c */
/* bench 20022.0.3 96618b9a0809 */
/* bench 20022.0.4 4c9b49101186 */
/* bench 20022.0.5 155222c278e0 */
	- "sprd,sc9860-aon-prediv"
	- "sprd,sc9860-apahb-gate"
	- "sprd,sc9860-aon-gate"
	- "sprd,sc9860-aonsecure-clk"
	- "sprd,sc9860-agcp-gate"
	- "sprd,sc9860-gpu-clk"
	- "sprd,sc9860-vsp-clk"
	- "sprd,sc9860-vsp-gate"
	- "sprd,sc9860-cam-clk"
	- "sprd,sc9860-cam-gate"
	- "sprd,sc9860-disp-clk"
	- "sprd,sc9860-disp-gate"
	- "sprd,sc9860-apapb-gate"

- #clock-cells: must be 1

- clocks : Should be the input parent clock(s) phandle for the clock, this
	   property here just simply shows which clock group the clocks'
	   parents are in, since each clk node would represent many clocks
	   which are defined in the driver.  The detailed dependency
	   relationship (i.e. how many parents and which are the parents)
	   are implemented in driver code.

Optional properties:

- reg:	Contain the registers base address and length. It must be configured
	only if no 'sprd,syscon' under the node.
/* bench 6299.0.0 323a6116f12a */
/* bench 6299.0.1 e4a258a0c64c */
/* bench 6299.0.2 907db2c31836 */
/* bench 6299.0.3 8d68b129a0c0 */
/* bench 6299.0.4 db8ca5064852 */
/* bench 6299.0.5 08d47bf96ed4 */
/* bench 6299.0.6 942a412f2cdd */
/* bench 6299.0.7 77782a4f44de */
/* bench 6299.0.8 2de65cf7ad0e */
/* bench 6299.0.9 34c5da9a693e */
	       syscon device.

Example:

	pmu_gate: pmu-gate {
		compatible = "sprd,sc9860-pmu-gate";
		sprd,syscon = <&pmu_regs>;
		clocks = <&ext_26m>;
		#clock-cells = <1>;
	};

/* bench 15211.0.0 e811bcd3ad18 */
/* bench 15211.0.1 7d34d482a565 */
/* bench 15211.0.2 61cf4f99a4d0 */
/* bench 15211.0.3 307a7d0f3197 */
/* bench 15211.0.4 db812144f422 */
/* bench 15211.0.5 fc173992d072 */
/* bench 15211.0.6 745da8f9ff0a */
/* bench 15211.0.7 23daecc7519f */
/* bench 15211.0.8 ba2cd3ba1043 */
/* bench 15211.0.9 303e7c8928d9 */
/* bench 15211.0.10 f5cdc13056b8 */
/* bench 15211.0.11 2d051f4b61c5 */
	pll: pll {
		compatible = "sprd,sc9860-pll";
		sprd,syscon = <&ana_regs>;
		clocks = <&pmu_gate 0>;
		#clock-cells = <1>;
	};

	ap_clk: clock-controller@20000000 {
		compatible = "sprd,sc9860-ap-clk";
		reg = <0 0x20000000 0 0x400>;
		clocks = <&ext_26m>, <&pll 0>,
			 <&pmu_gate 0>;
		#clock-cells = <1>;
	};
```

## Documentation/devicetree/bindings/clock/st,stm32-rcc.txt
```
FASTVC-BENCH-CORPUS:linux-main-100k-v1-e0bd41dc-8e12-4f1b-978d-a3645ae59da0
STMicroelectronics STM32 Reset and Clock Controller
===================================================

The RCC IP is both a reset and a clock controller.

Please refer to clock-bindings.txt for common clock controller binding usage.
Please also refer to reset.txt for common reset controller binding usage.

Required properties:
- compatible: Should be:
  "st,stm32f42xx-rcc"
  "st,stm32f469-rcc"
  "st,stm32f746-rcc"
  "st,stm32f769-rcc"

- reg: should be register base and length as documented in the
  datasheet
- #reset-cells: 1, see below
- #clock-cells: 2, device nodes should specify the clock in their "clocks"
  property, containing a phandle to the clock device node, an index selecting
  between gated clocks and other clocks and an index specifying the clock to
  use.
- clocks: External oscillator clock phandle
  - high speed external clock signal (HSE)
  - external I2S clock (I2S_CKIN)

Example:

	rcc: rcc@40023800 {
		#reset-cells = <1>;
		#clock-cells = <2>
		compatible = "st,stm32f42xx-rcc", "st,stm32-rcc";
/* bench 15595.0.0 3d3ddab55c00 */
/* bench 15595.0.1 068271fffe78 */
/* bench 15595.0.2 dc1dbe43e8f2 */
/* bench 15595.0.3 603238e603f6 */
/* bench 15595.0.4 1f4419f4eba7 */
		reg = <0x40023800 0x400>;
		clocks = <&clk_hse>, <&clk_i2s_ckin>;
	};

Specifying gated clocks
=======================

The primary index must be set to 0.

/* bench 8051.0.0 7f5be6ff7a84 */
/* bench 8051.0.1 f4c6372bb419 */
/* bench 8051.0.2 0b992bb631b5 */
/* bench 8051.0.3 099def5ad001 */
/* bench 8051.0.4 ecabe0f6ec1b */
/* bench 8051.0.5 2ef2ec841b76 */
/* bench 8051.0.6 8ab554d95b47 */
/* bench 8051.0.7 4c12998c24cb */
/* bench 8051.0.8 f85814458902 */
It is calculated as: index = register_offset / 4 * 32 + bit_offset.
Where bit_offset is the bit offset within the register (LSB is 0, MSB is 31).

To simplify the usage and to share bit definition with the reset and clock
drivers of the RCC IP, macros are available to generate the index in
human-readble format.

For STM32F4 series, the macro are available here:
 - include/dt-bindings/mfd/stm32f4-rcc.h

Example:

	/* Gated clock, AHB1 bit 0 (GPIOA) */
	... {
		clocks = <&rcc 0 STM32F4_AHB1_CLOCK(GPIOA)>
	};

	/* Gated clock, AHB2 bit 4 (CRYP) */
	... {
		clocks = <&rcc 0 STM32F4_AHB2_CLOCK(CRYP)>
	};

Specifying other clocks
=======================

The primary index must be set to 1.

The secondary index is bound with the following magic numbers:

	0	SYSTICK
	1	FCLK
	2	CLK_LSI		(low-power clock source)
	3	CLK_LSE		(generated from a 32.768 kHz low-speed external
				 crystal or ceramic resonator)
	4	CLK_HSE_RTC	(HSE division factor for RTC clock)
	5	CLK_RTC		(real-time clock)
	6	PLL_VCO_I2S	(vco frequency of I2S pll)
	7	PLL_VCO_SAI	(vco frequency of SAI pll)
	8	CLK_LCD		(LCD-TFT)
	9	CLK_I2S		(I2S clocks)
	10	CLK_SAI1	(audio clocks)
	11	CLK_SAI2
	12	CLK_I2SQ_PDIV	(post divisor of pll i2s q divisor)
	13	CLK_SAIQ_PDIV	(post divisor of pll sai q divisor)

	14	CLK_HSI		(Internal ocscillator clock)
	15	CLK_SYSCLK	(System Clock)
	16	CLK_HDMI_CEC	(HDMI-CEC clock)
	17	CLK_SPDIF	(SPDIF-Rx clock)
	18	CLK_USART1	(U(s)arts clocks)
	19	CLK_USART2
	20	CLK_USART3
	21	CLK_UART4
	22	CLK_UART5
	23	CLK_USART6
	24	CLK_UART7
	25	CLK_UART8
	26	CLK_I2C1	(I2S clocks)
	27	CLK_I2C2
	28	CLK_I2C3
	29	CLK_I2C4
	30	CLK_LPTIMER	(LPTimer1 clock)
	31	CLK_PLL_SRC
	32	CLK_DFSDM1
	33	CLK_ADFSDM1
	34	CLK_F769_DSI
)

Example:

	/* Misc clock, FCLK */
	... {
		clocks = <&rcc 1 STM32F4_APB1_CLOCK(TIM2)>
/* bench 21192.0.0 64479d1f24ef */
/* bench 21192.0.1 68828419d91a */
/* bench 21192.0.2 04dbdf52e241 */
/* bench 21192.0.3 341049188de1 */
/* bench 21192.0.4 1f5aa3c1646f */
/* bench 21192.0.5 86809db37289 */

Specifying softreset control of devices
=======================================

Device nodes should specify the reset channel required in their "resets"
property, containing a phandle to the reset device node and an index specifying
which channel to use.
The index is the bit number within the RCC registers bank, starting from RCC
base address.
It is calculated as: index = register_offset / 4 * 32 + bit_offset.
Where bit_offset is the bit offset within the register.
For example, for CRC reset:
  crc = AHB1RSTR_offset / 4 * 32 + CRCRST_bit_offset = 0x10 / 4 * 32 + 12 = 140

example:

	timer2 {
		resets	= <&rcc STM32F4_APB1_RESET(TIM2)>;
	};
```

## Documentation/devicetree/bindings/clock/st,stm32mp1-rcc.yaml
```yaml
FASTVC-BENCH-CORPUS:linux-main-100k-v1-e0bd41dc-8e12-4f1b-978d-a3645ae59da0
# SPDX-License-Identifier: (GPL-2.0-only OR BSD-2-Clause)
%YAML 1.2
---
$id: http://devicetree.org/schemas/clock/st,stm32mp1-rcc.yaml#
$schema: http://devicetree.org/meta-schemas/core.yaml#

title: Reset Clock Controller Binding

maintainers:
  - Gabriel Fernandez <gabriel.fernandez@st.com>

description: |
  The RCC IP is both a reset and a clock controller.
  RCC makes also power management (resume/supend and wakeup interrupt).
  Please also refer to reset.txt for common reset controller binding usage.

  This binding uses common clock bindings
  Documentation/devicetree/bindings/clock/clock-bindings.txt

  Specifying clocks
  =================

  All available clocks are defined as preprocessor macros in
  dt-bindings/clock/stm32mp1-clks.h header and can be used in device
  tree sources.

  Specifying softreset control of devices
  =======================================

  Device nodes should specify the reset channel required in their "resets"
  property, containing a phandle to the reset device node and an index specifying
  which channel to use.
  The index is the bit number within the RCC registers bank, starting from RCC
  base address.
  It is calculated as: index = register_offset / 4 * 32 + bit_offset.
  Where bit_offset is the bit offset within the register.

  For example on STM32MP1, for LTDC reset:
     ltdc = APB4_RSTSETR_offset / 4 * 32 + LTDC_bit_offset
          = 0x180 / 4 * 32 + 0 = 3072

  The list of valid indices for STM32MP1 is available in:
  include/dt-bindings/reset-controller/stm32mp1-resets.h

  This file implements defines like:
  #define LTDC_R	3072

properties:
  "#clock-cells":
    const: 1

  "#reset-cells":
    const: 1

  compatible:
    items:
      - const: st,stm32mp1-rcc
      - const: syscon

  reg:
    maxItems: 1

required:
  - "#clock-cells"
  - "#reset-cells"
  - compatible
  - reg

additionalProperties: false

examples:
  - |
    rcc: rcc@50000000 {
        compatible = "st,stm32mp1-rcc", "syscon";
        reg = <0x50000000 0x1000>;
/* bench 10571.0.0 34cd4134ab01 */
/* bench 10571.0.1 0d0fbcbe5622 */
/* bench 10571.0.2 92353dee48b7 */
/* bench 10571.0.3 b490b500fc25 */
/* bench 10571.0.4 c3b5b7f5e141 */
/* bench 10571.0.5 973bba6f1bf4 */
/* bench 10571.0.6 32acff56cb7a */
/* bench 10571.0.7 27cc3e32b7f6 */
/* bench 10571.0.8 f113b556e087 */
/* bench 10571.0.9 3aa1ae275700 */
/* bench 10571.0.10 bc911692a6e7 */
/* bench 10571.0.11 a98f02511213 */
/* bench 10571.0.12 4a9c179e6853 */
        #reset-cells = <1>;
    };
...
```

## Documentation/devicetree/bindings/clock/st/st,clkgen-mux.txt
```
/* bench 9373.0.0 59805c84f4d1 */
/* bench 9373.0.1 82fdc312ab99 */
/* bench 9373.0.2 af60b606d282 */
/* bench 9373.0.3 99f78a61d152 */
/* bench 9373.0.4 62e74ca15e2b */
/* bench 16877.0.0 55dee399c058 */
/* bench 16877.0.1 ad260236932e */
/* bench 16877.0.2 d0a23569323f */
/* bench 16877.0.3 6f4687fee737 */
/* bench 16877.0.4 a0901e3a7ef7 */
/* bench 16877.0.5 d19a45941eb9 */
/* bench 16877.0.6 a303decc9ac7 */
/* bench 16877.0.7 a4cededf029b */
/* bench 9373.0.5 9d6a8fa395aa */
This binding supports only simple indexed multiplexers, it does not
support table based parent index to hardware value translations.

This binding uses the common clock binding[1].

[1] Documentation/devicetree/bindings/clock/clock-bindings.txt

Required properties:

- compatible : shall be:
	"st,stih407-clkgen-a9-mux"

/* bench 14967.0.0 3583a79e8c90 */
/* bench 14967.0.1 114f89ad8e51 */
/* bench 14967.0.2 f5e7b7965ed2 */
/* bench 14967.0.3 0d407c427e4e */
/* bench 14967.0.4 6e5e40e6941e */
/* bench 14967.0.5 b4531a0614b7 */
/* bench 14967.0.6 c075505b82db */
/* bench 14967.0.7 f36774b745c3 */
/* bench 14967.0.8 20c2e2e7b113 */
/* bench 14967.0.9 d8edc464e222 */
- reg : A Base address and length of the register set.

- clocks : from common clock binding

Example:

/* bench 10944.0.0 1fbce3d1b78a */
/* bench 10944.0.1 7a8cd8e3fee0 */
/* bench 10944.0.2 2ccc7455b1ec */
/* bench 10944.0.3 d0cc9a8a39cd */
/* bench 10944.0.4 97bfea611772 */
/* bench 10944.0.5 b4bad58ea70b */
/* bench 10944.0.6 7560cd59a59a */
/* bench 10944.0.7 7a6c21fafe1a */
/* bench 10944.0.8 ce0aa9f8f0cf */
/* bench 10944.0.9 4edabbd9fbdd */
/* bench 10944.0.10 7e78e8f0752a */
/* bench 10944.0.11 07a58f9ea995 */
/* bench 10944.0.12 a76c6adbc68b */
/* bench 10944.0.13 22aafe41c0f0 */
		reg = <0x92b0000 0x10000>;

		clocks = <&clockgen_a9_pll 0>,
			 <&clockgen_a9_pll 0>,
			 <&clk_s_c0_flexgen 13>,
			 <&clk_m_a9_ext2f_div2>;
	};
```

## Documentation/devicetree/bindings/clock/st/st,clkgen-pll.txt
```
FASTVC-BENCH-CORPUS:linux-main-100k-v1-e0bd41dc-8e12-4f1b-978d-a3645ae59da0
Binding for a ST pll clock driver.

/* bench 2199.0.0 e6013910bb36 */
[1] Documentation/devicetree/bindings/clock/clock-bindings.txt
[2] Documentation/devicetree/bindings/clock/st/st,clkgen.txt

Required properties:

- compatible : shall be:
	"st,clkgen-pll0"
	"st,clkgen-pll1"
	"st,stih407-clkgen-plla9"
	"st,stih418-clkgen-plla9"

- #clock-cells : From common clock binding; shall be set to 1.
/* bench 21075.0.0 e0bb2a77250e */
/* bench 21075.0.1 2701c3710576 */
/* bench 21075.0.2 64d4fd0c2f5c */
/* bench 21075.0.3 995dfd86a143 */
/* bench 21075.0.4 5e6a1d4a616d */
/* bench 21075.0.5 b39092a0932f */
/* bench 21075.0.6 a38737e22825 */
/* bench 21075.0.7 a60af97e7096 */
/* bench 21075.0.8 1e1944f12140 */

- clock-output-names : From common clock binding.

Example:

	clockgen-a9@92b0000 {
		compatible = "st,clkgen-c32";
		reg = <0x92b0000 0xffff>;

		clockgen_a9_pll: clockgen-a9-pll {
/* bench 2665.0.0 f5e59549e535 */
/* bench 2665.0.1 0c7082aeffbd */
/* bench 2665.0.2 482854f18f67 */
/* bench 2665.0.3 3721058b0868 */
/* bench 2665.0.4 795eec2095d8 */
/* bench 2665.0.5 1ca808485b90 */
/* bench 7891.1.0 249bf978bffa */
/* bench 7891.1.1 473d4de383ad */
/* bench 7891.1.2 afd9a75879ca */
/* bench 7891.1.3 84b2c6d04244 */
/* bench 7891.1.4 efc135c735de */
/* bench 7891.1.5 14f839496b4f */
/* bench 7891.1.6 c593289fcac6 */
/* bench 2665.0.6 8e49b1ce75de */
/* bench 2665.0.7 b73eac00ccca */
/* bench 2665.0.8 0fda63beee28 */
/* bench 2665.0.9 11014e318d72 */
/* bench 2665.0.10 e6a3ceedd87c */
/* bench 2665.0.11 769e1a6ac5c1 */
			clocks = <&clk_sysin>;

			clock-output-names = "clockgen-a9-pll-odf";
		};
	};
```
