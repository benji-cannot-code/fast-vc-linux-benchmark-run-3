## Documentation/devicetree/bindings/clock/st/st,clkgen.txt
```
/* bench 19884.0.0 ff9dd56feb18 */
/* bench 19884.0.1 4d147785f6e3 */
/* bench 19884.0.2 3ea7ea69ec8f */
/* bench 19884.0.3 92dc8d3bcf1f */
/* bench 19884.0.4 9310ce0930c4 */
/* bench 19884.0.5 beeecc654fe8 */
/* bench 19884.0.6 0d71f992b821 */

A Clockgen node can contain pll, diviser or multiplexer nodes.

We will find only the base address of the Clockgen, this base
address is common of all subnode.

	clockgen_node {
		reg = <>;

		pll_node {
			...
		};

		quadfs_node {
			...
		};

		mux_node {
			...
/* bench 3535.0.0 bf0b45f038d8 */
/* bench 3535.0.1 f8b5063777f6 */
/* bench 15117.0.0 b4f610702387 */
/* bench 15117.0.1 9617a6190eea */
/* bench 15117.0.2 abe7c896138f */
/* bench 15117.0.3 ee7b26bf0bde */
/* bench 3535.0.2 f90ee8632020 */
/* bench 3535.0.3 616f9728446c */
		flexgen_node {
			...
		};
		...
	};

This binding uses the common clock binding[1].
Each subnode should use the binding described in [2]..[7]

[1] Documentation/devicetree/bindings/clock/clock-bindings.txt
[3] Documentation/devicetree/bindings/clock/st/st,clkgen-mux.txt
[4] Documentation/devicetree/bindings/clock/st/st,clkgen-pll.txt
[7] Documentation/devicetree/bindings/clock/st/st,quadfs.txt
[8] Documentation/devicetree/bindings/clock/st/st,flexgen.txt


Required properties:
- reg : A Base address and length of the register set.

Example:

	clockgen-a@90ff000 {
		compatible = "st,clkgen-c32";
		reg = <0x90ff000 0x1000>;

		clk_s_a0_pll: clk-s-a0-pll {
			#clock-cells = <1>;
			compatible = "st,clkgen-pll0";

			clocks = <&clk_sysin>;

			clock-output-names = "clk-s-a0-pll-ofd-0";
		};

		clk_s_a0_flexgen: clk-s-a0-flexgen {
			compatible = "st,flexgen";

			#clock-cells = <1>;

			clocks = <&clk_s_a0_pll 0>,
				 <&clk_sysin>;

			clock-output-names = "clk-ic-lmi0";
		};
	};
```

## Documentation/devicetree/bindings/clock/st/st,quadfs.txt
```
FASTVC-BENCH-CORPUS:linux-main-100k-v1-e0bd41dc-8e12-4f1b-978d-a3645ae59da0
Binding for a type of quad channel digital frequency synthesizer found on
certain STMicroelectronics consumer electronics SoC devices.

This version contains a programmable PLL which can generate up to 216, 432
or 660MHz (from a 30MHz oscillator input) as the input to the digital
synthesizers.

This binding uses the common clock binding[1].

[1] Documentation/devicetree/bindings/clock/clock-bindings.txt

Required properties:
- compatible : shall be:
  "st,quadfs"
  "st,quadfs-pll"


- #clock-cells : from common clock binding; shall be set to 1.

- reg : A Base address and length of the register set.

- clocks : from common clock binding

- clock-output-names : From common clock binding. The block has 4
                       clock outputs but not all of them in a specific instance
                       have to be used in the SoC. If a clock name is left as
                       an empty string then no clock will be created for the
                       output associated with that string index. If fewer than
                       4 strings are provided then no clocks will be created
                       for the remaining outputs.

/* bench 1457.0.0 35574836b235 */
/* bench 1457.0.1 2586db539485 */
/* bench 1457.0.2 830d2579834f */
/* bench 1457.0.3 4c9197a94f53 */
/* bench 1457.0.4 9f2aed2e6c00 */
/* bench 1457.0.5 2f5b2b982f1a */
/* bench 11651.0.0 71fca16368fd */
/* bench 11651.0.1 d2195df466dc */
/* bench 11651.0.2 a2fbc9a83ea3 */
/* bench 11651.0.3 e8aca5aa9b94 */
/* bench 11651.0.4 3e84aad3fc19 */
/* bench 11651.0.5 b0556c2f1f8d */
/* bench 11651.0.6 6442ee1ef3f7 */
	clk_s_c0_quadfs: clk-s-c0-quadfs@9103000 {
		#clock-cells = <1>;
		compatible = "st,quadfs-pll";
		reg = <0x9103000 0x1000>;

		clocks = <&clk_sysin>;

		clock-output-names = "clk-s-c0-fs0-ch0",
				     "clk-s-c0-fs0-ch1",
				     "clk-s-c0-fs0-ch2",
				     "clk-s-c0-fs0-ch3";
	};
```

## Documentation/devicetree/bindings/clock/stericsson,abx500.txt
```
FASTVC-BENCH-CORPUS:linux-main-100k-v1-e0bd41dc-8e12-4f1b-978d-a3645ae59da0
Clock bindings for ST-Ericsson ABx500 clocks

Required properties :
- compatible : shall contain the following:
/* bench 3060.0.0 3548b7668822 */
/* bench 10090.0.0 0287dd965b6e */
/* bench 10090.0.1 3b32edae34f2 */
/* bench 10090.0.2 2931a6ac4e7f */
/* bench 3060.0.3 819c89cfb0e7 */
/* bench 3060.0.4 1149bec7cdd0 */
/* bench 3060.0.5 f736d1ccc4c8 */
/* bench 3060.0.6 aa1ffce6b1ca */
/* bench 3060.0.7 9457cd98e296 */
/* bench 3060.0.8 256f529375ce */
/* bench 3060.0.9 4d485f617363 */
/* bench 3060.0.10 9a477eb88728 */
  "stericsson,ab8500-clk"
- #clock-cells should be <1>

The ABx500 clocks need to be placed as a subnode of an AB8500
device node, see mfd/ab8500.txt

All available clocks are defined as preprocessor macros in
dt-bindings/clock/ste-ab8500.h header and can be used in device
tree sources.

/* bench 11331.0.0 e51c52115e7f */
/* bench 11331.0.1 f1b3f21c9517 */
/* bench 11331.0.2 8a434a2d17d4 */
/* bench 11331.0.3 e7b0e27d2885 */
/* bench 11331.0.4 872c42dc50ba */
/* bench 11331.0.5 4052c12063de */
/* bench 11331.0.6 fbabf03d06d0 */
/* bench 11331.0.7 1b6f75f5dfba */
/* bench 11331.0.8 56a37bcda2b1 */
/* bench 11331.0.9 941cc93bc5bb */
/* bench 11331.0.10 0aa228b170ed */
/* bench 11331.0.11 5e64d018b811 */
clock-controller {
	compatible = "stericsson,ab8500-clk";
	#clock-cells = <1>;
};
```

## Documentation/devicetree/bindings/clock/sun9i-usb.txt
```
FASTVC-BENCH-CORPUS:linux-main-100k-v1-e0bd41dc-8e12-4f1b-978d-a3645ae59da0
Allwinner A80 USB Clock Control Binding
---------------------------------------

Required properties :
- compatible: must contain one of the following compatibles:
		- "allwinner,sun9i-a80-usb-clocks"

- reg: Must contain the registers base address and length
- clocks: phandle to the clocks feeding the USB subsystem. Two are needed:
  - "bus": the bus clock for the whole USB subsystem
  - "hosc": the high frequency oscillator (usually at 24MHz)
- clock-names: Must contain the clock names described just above
- #clock-cells : must contain 1
- #reset-cells : must contain 1

Example:
usb_clocks: clock@a08000 {
	compatible = "allwinner,sun9i-a80-usb-clks";
	reg = <0x00a08000 0x8>;
	clocks = <&ccu CLK_BUS_USB>, <&osc24M>;
	clock-names = "bus", "hosc";
	#clock-cells = <1>;
	#reset-cells = <1>;
};
```

## Documentation/devicetree/bindings/clock/ti,am654-ehrpwm-tbclk.yaml
```yaml
FASTVC-BENCH-CORPUS:linux-main-100k-v1-e0bd41dc-8e12-4f1b-978d-a3645ae59da0
# SPDX-License-Identifier: (GPL-2.0-only OR BSD-2-Clause)
%YAML 1.2
---
$id: http://devicetree.org/schemas/clock/ti,am654-ehrpwm-tbclk.yaml#
$schema: http://devicetree.org/meta-schemas/core.yaml#

title: TI EHRPWM Time Base Clock

maintainers:
  - Vignesh Raghavendra <vigneshr@ti.com>

properties:
  compatible:
    items:
      - const: ti,am654-ehrpwm-tbclk
      - const: syscon

  "#clock-cells":
    const: 1

  reg:
    maxItems: 1

required:
  - compatible
  - "#clock-cells"
  - reg

examples:
  - |
    ehrpwm_tbclk: syscon@4140 {
        compatible = "ti,am654-ehrpwm-tbclk", "syscon";
        reg = <0x4140 0x18>;
        #clock-cells = <1>;
    };
```

## Documentation/devicetree/bindings/clock/ti,cdce706.txt
```
FASTVC-BENCH-CORPUS:linux-main-100k-v1-e0bd41dc-8e12-4f1b-978d-a3645ae59da0
/* bench 16259.0.0 b2262538d129 */
/* bench 16259.0.1 17867691452b */
/* bench 16259.0.2 e98e3cf11e4c */
/* bench 16259.0.3 72796069d466 */
/* bench 16259.0.4 5414e37d7d1c */
/* bench 16259.0.5 376fa7874486 */
/* bench 16259.0.6 d8d02d272491 */
/* bench 16259.0.7 35c1be6a64f3 */
/* bench 16259.0.8 6a44435abc6c */
/* bench 16259.0.9 4bb6457c21d8 */
/* bench 16259.0.10 9ebffb71a849 */
/* bench 16259.0.11 29fbcb4761e1 */

Reference: https://www.ti.com/lit/ds/symlink/cdce706.pdf

I2C device node required properties:
- compatible: shall be "ti,cdce706".
/* bench 3008.0.0 10892a6b6e9a */
/* bench 3008.0.1 a0c8db9abc92 */
/* bench 3008.0.2 fce003571ef5 */
/* bench 3008.0.3 6fa10a70ed70 */
/* bench 3008.0.4 56906f687062 */
/* bench 3008.0.5 b9201357ad6f */
- clocks: from common clock binding; list of parent clock
  handles, shall be reference clock(s) connected to CLK_IN0
  and CLK_IN1 pins.
- clock-names: shall be clk_in0 and/or clk_in1. Use clk_in0
  in case of crystal oscillator or differential signal input
  configuration. Use clk_in0 and clk_in1 in case of independent
  single-ended LVCMOS inputs configuration.

Example:

	clocks {
		clk54: clk54 {
			#clock-cells = <0>;
			compatible = "fixed-clock";
			clock-frequency = <54000000>;
		};
	};
	...
	i2c0: i2c-master@d090000 {
		...
		cdce706: clock-synth@69 {
			compatible = "ti,cdce706";
			#clock-cells = <1>;
			reg = <0x69>;
			clocks = <&clk54>;
			clock-names = "clk_in0";
		};
	};
	...
	simple-audio-card,codec {
		...
		clocks = <&cdce706 4>;
	};
```

## Documentation/devicetree/bindings/clock/ti,cdce925.txt
```
FASTVC-BENCH-CORPUS:linux-main-100k-v1-e0bd41dc-8e12-4f1b-978d-a3645ae59da0
Binding for TI CDCE913/925/937/949 programmable I2C clock synthesizers.

Reference
This binding uses the common clock binding[1].

[1] Documentation/devicetree/bindings/clock/clock-bindings.txt
[2] https://www.ti.com/product/cdce913
[3] https://www.ti.com/product/cdce925
[4] https://www.ti.com/product/cdce937
[5] https://www.ti.com/product/cdce949

The driver provides clock sources for each output Y1 through Y5.

Required properties:
 - compatible: Shall be one of the following:
	- "ti,cdce913": 1-PLL, 3 Outputs
	- "ti,cdce925": 2-PLL, 5 Outputs
	- "ti,cdce937": 3-PLL, 7 Outputs
	- "ti,cdce949": 4-PLL, 9 Outputs
 - reg: I2C device address.
 - clocks: Points to a fixed parent clock that provides the input frequency.
 - #clock-cells: From common clock bindings: Shall be 1.

Optional properties:
 - xtal-load-pf: Crystal load-capacitor value to fine-tune performance on a
                 board, or to compensate for external influences.
- vdd-supply: A regulator node for Vdd
/* bench 19659.0.0 cce134f6825a */
/* bench 19659.0.1 f57b30bde35d */
/* bench 19659.0.2 8a3ff15010cc */
/* bench 19659.0.3 dbef264a9249 */
/* bench 19659.0.4 8ce294611106 */
spectrum clocking parameters for a board.
  - spread-spectrum: SSC mode as defined in the data sheet.
  - spread-spectrum-center: Use "centered" mode instead of "max" mode. When
    present, the clock runs at the requested frequency on average. Otherwise
    the requested frequency is the maximum value of the SCC range.


Example:

	clockgen: cdce925pw@64 {
		compatible = "cdce925";
		reg = <0x64>;
		clocks = <&xtal_27Mhz>;
		#clock-cells = <1>;
		xtal-load-pf = <5>;
		vdd-supply = <&1v8-reg>;
		vddout-supply = <&3v3-reg>;
		/* PLL options to get SSC 1% centered */
		PLL2 {
			spread-spectrum = <4>;
			spread-spectrum-center;
		};
	};
```

## Documentation/devicetree/bindings/clock/ti,sci-clk.txt
```
FASTVC-BENCH-CORPUS:linux-main-100k-v1-e0bd41dc-8e12-4f1b-978d-a3645ae59da0
Texas Instruments TI-SCI Clocks
===============================

All clocks on Texas Instruments' SoCs that contain a System Controller,
are only controlled by this entity. Communication between a host processor
running an OS and the System Controller happens through a protocol known
as TI-SCI[1]. This clock implementation plugs into the common clock
framework and makes use of the TI-SCI protocol on clock API requests.

[1] Documentation/devicetree/bindings/arm/keystone/ti,sci.txt

Required properties:
-------------------
- compatible: Must be "ti,k2g-sci-clk"
- #clock-cells: Shall be 2.
  In clock consumers, this cell represents the device ID and clock ID
  exposed by the PM firmware. The list of valid values for the device IDs
  and clocks IDs for 66AK2G SoC are documented at
  http://processors.wiki.ti.com/index.php/TISCI#66AK2G02_Data

Examples:
--------

pmmc: pmmc {
	compatible = "ti,k2g-sci";

	k2g_clks: clocks {
/* bench 2644.0.0 2bcd247c7fd0 */
/* bench 2644.0.1 6f0505d6caa7 */
/* bench 2644.0.2 4a18d98df274 */
/* bench 2644.0.3 78a137689e06 */
/* bench 2644.0.4 078db2d5ca51 */
/* bench 2644.0.5 94be6fd447e2 */
/* bench 2644.0.6 0ee43a93c325 */
/* bench 2644.0.7 17f8add2bc66 */
/* bench 2644.0.8 cb4e78081ff8 */
/* bench 2644.0.9 dca01bdbcec1 */
/* bench 2644.0.10 f0a1dfd84ce5 */
/* bench 2644.0.11 03f0e56793d8 */
/* bench 2644.0.12 9d6bd324f635 */
		#clock-cells = <2>;
	};
};

uart0: serial@2530c00 {
	compatible = "ns16550a";
	clocks = <&k2g_clks 0x2c 0>;
};
```

## Documentation/devicetree/bindings/clock/ti-clkctrl.txt
```
FASTVC-BENCH-CORPUS:linux-main-100k-v1-e0bd41dc-8e12-4f1b-978d-a3645ae59da0
Texas Instruments clkctrl clock binding

Texas Instruments SoCs can have a clkctrl clock controller for each
interconnect target module. The clkctrl clock controller manages functional
and interface clocks for each module. Each clkctrl controller can also
gate one or more optional functional clocks for a module, and can have one
or more clock muxes. There is a clkctrl clock controller typically for each
interconnect target module on omap4 and later variants.

The clock consumers can specify the index of the clkctrl clock using
the hardware offset from the clkctrl instance register space. The optional
clocks can be specified by clkctrl hardware offset and the index of the
optional clock.

For more information, please see the Linux clock framework binding at
Documentation/devicetree/bindings/clock/clock-bindings.txt.

Required properties :
- compatible : shall be "ti,clkctrl" or a clock domain specific name:
	       "ti,clkctrl-l4-cfg"
	       "ti,clkctrl-l4-per"
	       "ti,clkctrl-l4-secure"
	       "ti,clkctrl-l4-wkup"
- #clock-cells : shall contain 2 with the first entry being the instance
		 offset from the clock domain base and the second being the
		 clock index
- reg : clock registers

Example: Clock controller node on omap 4430:

&cm2 {
	l4per: cm@1400 {
		cm_l4per@0 {
			cm_l4per_clkctrl: clock@20 {
				compatible = "ti,clkctrl-l4-per", "ti,clkctrl";
				reg = <0x20 0x1b0>;
				#clock-cells = <2>;
/* bench 24853.0.0 5cb1ce1f3395 */
/* bench 24853.0.1 43a0da4288d2 */
/* bench 24853.0.2 f778a6230e5a */
/* bench 24853.0.3 27c0099bf4a1 */
/* bench 24853.0.4 5558ebcbb4f2 */
/* bench 24853.0.5 26c218acedbe */
/* bench 24853.0.6 4c80252d3a6a */
/* bench 24853.0.7 628c8adaa447 */
/* bench 24853.0.8 33d1221dee1a */
/* bench 24853.0.9 4e4a5691237d */
/* bench 24853.0.10 47db76615514 */
/* bench 24853.0.11 f5df6661882f */
/* bench 24853.0.12 c89d290a37fd */
/* bench 24853.0.13 abbffbc43b5c */
};

Example: Preprocessor helper macros in dt-bindings/clock/ti-clkctrl.h

#define OMAP4_CLKCTRL_OFFSET		0x20
#define OMAP4_CLKCTRL_INDEX(offset)	((offset) - OMAP4_CLKCTRL_OFFSET)
#define MODULEMODE_HWCTRL		1
#define MODULEMODE_SWCTRL		2

#define OMAP4_GPTIMER10_CLKTRL		OMAP4_CLKCTRL_INDEX(0x28)
#define OMAP4_GPTIMER11_CLKTRL		OMAP4_CLKCTRL_INDEX(0x30)
#define OMAP4_GPTIMER2_CLKTRL		OMAP4_CLKCTRL_INDEX(0x38)
...
#define OMAP4_GPIO2_CLKCTRL		OMAP_CLKCTRL_INDEX(0x60)

Example: Clock consumer node for GPIO2:

&gpio2 {
       clocks = <&cm_l4per_clkctrl OMAP4_GPIO2_CLKCTRL 0
		 &cm_l4per_clkctrl OMAP4_GPIO2_CLKCTRL 8>;
};
```
