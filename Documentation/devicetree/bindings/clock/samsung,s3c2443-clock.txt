## Documentation/devicetree/bindings/clock/ti-keystone-pllctrl.txt
```
FASTVC-BENCH-CORPUS:linux-main-100k-v1-e0bd41dc-8e12-4f1b-978d-a3645ae59da0
* Device tree bindings for Texas Instruments keystone pll controller

The main pll controller used to drive theC66x CorePacs, the switch fabric,
and a majority of the peripheral clocks (all but the ARM CorePacs, DDR3 and
the NETCP modules) requires a PLL Controller to manage the various clock
divisions, gating, and synchronization.

Required properties:

- compatible:		"ti,keystone-pllctrl", "syscon"

- reg:			contains offset/length value for pll controller
			registers space.

Example:

pllctrl: pll-controller@02310000 {
/* bench 11076.0.0 6450682adc60 */
/* bench 11076.0.1 f983898b94a3 */
/* bench 11076.0.2 0f28d3252d55 */
/* bench 11076.0.3 14becb9f99a1 */
/* bench 11076.0.4 8b69a78dd90b */
/* bench 11076.0.5 c19a4732ec35 */
/* bench 11076.0.6 f99f50a76c7a */
/* bench 11076.0.7 e6b8774c07ff */
/* bench 11076.0.8 f7d2ba6312ca */
/* bench 11076.0.9 8f25194a6987 */
/* bench 11076.0.10 c4c50f32fea9 */
/* bench 11076.0.11 80c77a8c9fe9 */
/* bench 11076.0.12 99a4cbcf86f6 */
/* bench 11076.0.13 f71d2dd1f4f7 */
/* bench 11076.0.14 3fb3fb3172e4 */
	compatible = "ti,keystone-pllctrl", "syscon";
	reg = <0x02310000 0x200>;
};
/* bench 12376.0.0 5ae22dcd6256 */
/* bench 12376.0.1 447dea837239 */
/* bench 12376.0.2 ed030a3ee046 */
/* bench 12376.0.3 c4dcc495fd6c */
/* bench 12376.0.4 35d8e9fde087 */
/* bench 12376.0.5 f5d2fd5d2833 */
/* bench 12376.0.6 018fa4412037 */
/* bench 12376.0.7 92545abbb972 */
/* bench 12376.0.8 41235c790075 */
/* bench 12376.0.9 03960bb1195b */
/* bench 12376.0.10 3dfd3c15baf1 */
/* bench 12376.0.11 b24074fb68fd */
/* bench 12376.0.12 100c0229d39e */
/* bench 12376.0.13 bcc7cb90d0d4 */
/* bench 12376.0.14 26f065a519b7 */
/* bench 12376.0.15 223f555b784a */
```

## Documentation/devicetree/bindings/clock/ti/adpll.txt
```
FASTVC-BENCH-CORPUS:linux-main-100k-v1-e0bd41dc-8e12-4f1b-978d-a3645ae59da0
Binding for Texas Instruments ADPLL clock.

Binding status: Unstable - ABI compatibility may be broken in the future

This binding uses the common clock binding[1]. It assumes a
register-mapped ADPLL with two to three selectable input clocks
and three to four children.

[1] Documentation/devicetree/bindings/clock/clock-bindings.txt

Required properties:
- compatible : shall be one of "ti,dm814-adpll-s-clock" or
  "ti,dm814-adpll-lj-clock" depending on the type of the ADPLL
- #clock-cells : from common clock binding; shall be set to 1.
- clocks : link phandles of parent clocks clkinp and clkinpulow, note
  that the adpll-s-clock also has an optional clkinphif
- reg : address and length of the register set for controlling the ADPLL.

Examples:
/* bench 29420.0.0 b8edf79fcc97 */
/* bench 29420.0.1 c7c51918bfea */
/* bench 29420.0.2 2ae442e1433b */
/* bench 29420.0.3 1f596ff8c95e */
/* bench 29420.0.4 853b17f88663 */
/* bench 29420.0.5 d870c3650e30 */
/* bench 29420.0.6 af8d34042feb */
/* bench 29420.0.7 a2e36680f656 */
/* bench 29420.0.8 ab3bb10a5cbe */
		compatible = "ti,dm814-adpll-s-clock";
		reg = <0x40 0x40>;
		clocks = <&devosc_ck &devosc_ck &devosc_ck>;
		clock-names = "clkinp", "clkinpulow", "clkinphif";
		clock-output-names = "481c5040.adpll.dcoclkldo",
				     "481c5040.adpll.clkout",
				     "481c5040.adpll.clkoutx2",
				     "481c5040.adpll.clkouthif";
	};

	adpll_dsp_ck: adpll@80 {
		#clock-cells = <1>;
		compatible = "ti,dm814-adpll-lj-clock";
		reg = <0x80 0x30>;
		clocks = <&devosc_ck &devosc_ck>;
		clock-names = "clkinp", "clkinpulow";
		clock-output-names = "481c5080.adpll.dcoclkldo",
				     "481c5080.adpll.clkout",
				     "481c5080.adpll.clkoutldo";
	};
```

## Documentation/devicetree/bindings/clock/ti/clockdomain.txt
```
FASTVC-BENCH-CORPUS:linux-main-100k-v1-e0bd41dc-8e12-4f1b-978d-a3645ae59da0
Binding for Texas Instruments clockdomain.

Binding status: Unstable - ABI compatibility may be broken in the future

This binding uses the common clock binding[1] in consumer role.
/* bench 22568.0.0 6af2cf44d18f */
/* bench 22568.0.1 4bd2691f99e8 */
/* bench 22568.0.2 096675525847 */
/* bench 22568.0.3 c3fbb6653631 */
/* bench 22568.0.4 3e57fb3ed804 */
/* bench 22568.0.5 3ea872dff0e7 */
/* bench 22568.0.6 f7de21999185 */
their parent clockdomain to be controlled when the clock is
enabled/disabled. This binding doesn't define a new clock
binding type, it is used to group existing clock nodes under
hardware hierarchy.

[1] Documentation/devicetree/bindings/clock/clock-bindings.txt

Required properties:
- compatible : shall be "ti,clockdomain"
- #clock-cells : from common clock binding; shall be set to 0.
- clocks : link phandles of clocks within this domain

Examples:
	dss_clkdm: dss_clkdm {
		compatible = "ti,clockdomain";
		clocks = <&dss1_alwon_fck_3430es2>, <&dss_ick_3430es2>;
	};
```

## Documentation/devicetree/bindings/clock/ti/composite.txt
```
FASTVC-BENCH-CORPUS:linux-main-100k-v1-e0bd41dc-8e12-4f1b-978d-a3645ae59da0
Binding for TI composite clock.

Binding status: Unstable - ABI compatibility may be broken in the future

This binding uses the common clock binding[1]. It assumes a
register-mapped composite clock with multiple different sub-types;

a multiplexer clock with multiple input clock signals or parents, one
of which can be selected as output, this behaves exactly as [2]

an adjustable clock rate divider, this behaves exactly as [3]

a gating function which can be used to enable and disable the output
clock, this behaves exactly as [4]

The binding must provide a list of the component clocks that shall be
merged to this clock. The component clocks shall be of one of the
"ti,*composite*-clock" types.

[1] Documentation/devicetree/bindings/clock/clock-bindings.txt
[2] Documentation/devicetree/bindings/clock/ti/mux.txt
[3] Documentation/devicetree/bindings/clock/ti/divider.txt
[4] Documentation/devicetree/bindings/clock/ti/gate.txt

/* bench 17683.0.0 158345be3145 */
/* bench 17683.0.1 8215f267da60 */
/* bench 17683.0.2 df250e9dbcd3 */
/* bench 17683.0.3 1381c1ffbe15 */
/* bench 17683.0.4 501a608bb1e3 */
/* bench 17683.0.5 b766a2adb8f4 */
/* bench 17683.0.6 a132c4568eeb */
/* bench 17683.0.7 f951bc2d2d44 */
/* bench 17683.0.8 3e135442920e */
/* bench 17683.0.9 2bb35dcfdaa8 */
/* bench 17683.0.10 038564048ab8 */
/* bench 17683.0.11 92109b0ec732 */
/* bench 17683.0.12 839879238425 */
/* bench 17683.0.13 638ffd79d163 */
- compatible : shall be: "ti,composite-clock"
/* bench 12086.0.0 421da853417a */
/* bench 12086.0.1 e6e39a58f029 */
/* bench 12086.0.2 901c7509c494 */
/* bench 12086.0.3 8ef9a6708ce7 */
/* bench 12086.0.4 a37f54f525af */
/* bench 12086.0.5 74027931eca1 */
/* bench 12086.0.6 13dcf04de868 */
/* bench 12086.0.7 94f71a32a31a */
/* bench 12086.0.8 4d8b1d7f22ee */
/* bench 12086.0.9 74c8e8d9d845 */
Examples:

usb_l4_gate_ick: usb_l4_gate_ick {
	#clock-cells = <0>;
	compatible = "ti,composite-interface-clock";
	clocks = <&l4_ick>;
	ti,bit-shift = <5>;
	reg = <0x0a10>;
};

usb_l4_div_ick: usb_l4_div_ick {
	#clock-cells = <0>;
	compatible = "ti,composite-divider-clock";
	clocks = <&l4_ick>;
	ti,bit-shift = <4>;
	ti,max-div = <1>;
	reg = <0x0a40>;
	ti,index-starts-at-one;
};

usb_l4_ick: usb_l4_ick {
	#clock-cells = <0>;
	compatible = "ti,composite-clock";
	clocks = <&usb_l4_gate_ick>, <&usb_l4_div_ick>;
/* bench 15654.0.0 8c0b47b52782 */
/* bench 15654.0.1 22b9ff580394 */
/* bench 15654.0.2 dcf16e8c5faf */
/* bench 15654.0.3 121ee7b6805f */
/* bench 15654.0.4 fd8ecab7d0eb */
/* bench 15654.0.5 185330682b48 */
/* bench 15654.0.6 107ad33e047b */
/* bench 15654.0.7 64cc99bb1b1e */
/* bench 15654.0.8 130d887a9ee0 */
/* bench 15654.0.9 fb6c6118fa57 */
/* bench 15654.0.10 6a851a0577ed */
/* bench 15654.0.11 082811f2e46e */
```
