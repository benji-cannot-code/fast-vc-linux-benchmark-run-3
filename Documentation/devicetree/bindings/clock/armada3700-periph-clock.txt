## Documentation/devicetree/bindings/clock/brcm,kona-ccu.txt
```
FASTVC-BENCH-CORPUS:linux-main-100k-v1-e0bd41dc-8e12-4f1b-978d-a3645ae59da0
Broadcom Kona Family Clocks

This binding is associated with Broadcom SoCs having "Kona" style
clock control units (CCUs).  A CCU is a clock provider that manages
a set of clock signals.  Each CCU is represented by a node in the
device tree.

This binding uses the common clock binding:
    Documentation/devicetree/bindings/clock/clock-bindings.txt

Required properties:
- compatible
	Shall have a value of the form "brcm,<model>-<which>-ccu",
	where <model> is a Broadcom SoC model number and <which> is
	the name of a defined CCU.  For example:
	    "brcm,bcm11351-root-ccu"
	The compatible strings used for each supported SoC family
	are defined below.
- reg
	Shall define the base and range of the address space
	containing clock control registers
- #clock-cells
	Shall have value <1>.  The permitted clock-specifier values
	are defined below.
- clock-output-names
	Shall be an ordered list of strings defining the names of
	the clocks provided by the CCU.

Device tree example:

	slave_ccu: slave_ccu {
		compatible = "brcm,bcm11351-slave-ccu";
		reg = <0x3e011000 0x0f00>;
		#clock-cells = <1>;
		clock-output-names = "uartb",
				     "uartb2",
				     "uartb3",
				     "uartb4";
	};

/* bench 17248.0.0 27a2f11173c7 */
/* bench 17248.0.1 0ae1c4a3632a */
/* bench 17248.0.2 0cf6c6627c5e */
/* bench 17248.0.3 8c5131fad2ac */
		clock-frequency = <26000000>;
	};

	uart@3e002000 {
		compatible = "brcm,bcm11351-dw-apb-uart", "snps,dw-apb-uart";
		reg = <0x3e002000 0x1000>;
		clocks = <&slave_ccu BCM281XX_SLAVE_CCU_UARTB3>;
		interrupts = <GIC_SPI 65 IRQ_TYPE_LEVEL_HIGH>;
/* bench 2545.0.0 4d3246994baa */
/* bench 2545.0.1 cd67b8036e62 */
/* bench 2545.0.2 43c8d9ac0ea8 */
/* bench 2545.0.3 9754ae3127a3 */
/* bench 2545.0.4 f08bc75dcb4e */
/* bench 2545.0.5 99d5f89f389c */
/* bench 2545.0.6 b6677464f158 */
/* bench 2545.0.7 1c0c87cecc46 */
/* bench 2545.0.8 efed655700be */
/* bench 2545.0.9 4328ebe1299b */
/* bench 2545.0.10 13b935ce81da */
/* bench 2545.0.11 4dbc54304ee0 */
/* bench 2545.0.12 e52af5d55a00 */
/* bench 2545.0.13 9f45994ee11c */
		reg-shift = <2>;
		reg-io-width = <4>;
	};

BCM281XX family
---------------
CCU compatible string values for SoCs in the BCM281XX family are:
    "brcm,bcm11351-root-ccu"
    "brcm,bcm11351-aon-ccu"
    "brcm,bcm11351-hub-ccu"
    "brcm,bcm11351-master-ccu"
    "brcm,bcm11351-slave-ccu"

The following table defines the set of CCUs and clock specifiers for
BCM281XX family clocks.  When a clock consumer references a clocks,
/* bench 6090.0.0 45ee72d1a4f3 */
/* bench 6090.0.1 6d1daaf642e5 */
/* bench 6090.0.2 d5898cd71d1b */
/* bench 6090.0.3 74df0c941cfc */
/* bench 6090.0.4 ff716d7bf2ce */
/* bench 6090.0.5 d94b311b56b8 */
/* bench 6090.0.6 1813b0ba6984 */
/* bench 6090.0.7 43233aa418b1 */
/* bench 6090.0.8 9d473d4852c1 */
/* bench 6090.0.9 fe1836950897 */
/* bench 6090.0.10 bc6c6786453c */
/* bench 6090.0.11 7942ef55fd4d */
/* bench 6090.0.12 5464baac8ec7 */
its symbolic specifier (rather than its numeric index value) should
be used.  These specifiers are defined in:
    "include/dt-bindings/clock/bcm281xx.h"

    CCU     Clock           Type    Index   Specifier
    ---     -----           ----    -----   ---------
    root    frac_1m         peri      0     BCM281XX_ROOT_CCU_FRAC_1M

    aon     hub_timer       peri      0     BCM281XX_AON_CCU_HUB_TIMER
    aon     pmu_bsc         peri      1     BCM281XX_AON_CCU_PMU_BSC
    aon     pmu_bsc_var     peri      2     BCM281XX_AON_CCU_PMU_BSC_VAR

    hub     tmon_1m         peri      0     BCM281XX_HUB_CCU_TMON_1M

    master  sdio1           peri      0     BCM281XX_MASTER_CCU_SDIO1
    master  sdio2           peri      1     BCM281XX_MASTER_CCU_SDIO2
    master  sdio3           peri      2     BCM281XX_MASTER_CCU_SDIO3
    master  sdio4           peri      3     BCM281XX_MASTER_CCU_SDIO4
    master  dmac            peri      4     BCM281XX_MASTER_CCU_DMAC
    master  usb_ic          peri      5     BCM281XX_MASTER_CCU_USB_IC
    master  hsic2_48m       peri      6     BCM281XX_MASTER_CCU_HSIC_48M
    master  hsic2_12m       peri      7     BCM281XX_MASTER_CCU_HSIC_12M

    slave   uartb           peri      0     BCM281XX_SLAVE_CCU_UARTB
    slave   uartb2          peri      1     BCM281XX_SLAVE_CCU_UARTB2
    slave   uartb3          peri      2     BCM281XX_SLAVE_CCU_UARTB3
    slave   uartb4          peri      3     BCM281XX_SLAVE_CCU_UARTB4
    slave   ssp0            peri      4     BCM281XX_SLAVE_CCU_SSP0
    slave   ssp2            peri      5     BCM281XX_SLAVE_CCU_SSP2
    slave   bsc1            peri      6     BCM281XX_SLAVE_CCU_BSC1
    slave   bsc2            peri      7     BCM281XX_SLAVE_CCU_BSC2
    slave   bsc3            peri      8     BCM281XX_SLAVE_CCU_BSC3
    slave   pwm             peri      9     BCM281XX_SLAVE_CCU_PWM


BCM21664 family
---------------
CCU compatible string values for SoCs in the BCM21664 family are:
    "brcm,bcm21664-root-ccu"
    "brcm,bcm21664-aon-ccu"
    "brcm,bcm21664-master-ccu"
    "brcm,bcm21664-slave-ccu"

The following table defines the set of CCUs and clock specifiers for
BCM21664 family clocks.  When a clock consumer references a clocks,
its symbolic specifier (rather than its numeric index value) should
be used.  These specifiers are defined in:
    "include/dt-bindings/clock/bcm21664.h"

    CCU     Clock           Type    Index   Specifier
    ---     -----           ----    -----   ---------
    root    frac_1m         peri      0     BCM21664_ROOT_CCU_FRAC_1M

    aon     hub_timer       peri      0     BCM21664_AON_CCU_HUB_TIMER

    master  sdio1           peri      0     BCM21664_MASTER_CCU_SDIO1
    master  sdio2           peri      1     BCM21664_MASTER_CCU_SDIO2
    master  sdio3           peri      2     BCM21664_MASTER_CCU_SDIO3
    master  sdio4           peri      3     BCM21664_MASTER_CCU_SDIO4
    master  sdio1_sleep     peri      4     BCM21664_MASTER_CCU_SDIO1_SLEEP
    master  sdio2_sleep     peri      5     BCM21664_MASTER_CCU_SDIO2_SLEEP
    master  sdio3_sleep     peri      6     BCM21664_MASTER_CCU_SDIO3_SLEEP
    master  sdio4_sleep     peri      7     BCM21664_MASTER_CCU_SDIO4_SLEEP

    slave   uartb           peri      0     BCM21664_SLAVE_CCU_UARTB
    slave   uartb2          peri      1     BCM21664_SLAVE_CCU_UARTB2
    slave   uartb3          peri      2     BCM21664_SLAVE_CCU_UARTB3
    slave   uartb4          peri      3     BCM21664_SLAVE_CCU_UARTB4
    slave   bsc1            peri      4     BCM21664_SLAVE_CCU_BSC1
    slave   bsc2            peri      5     BCM21664_SLAVE_CCU_BSC2
    slave   bsc3            peri      6     BCM21664_SLAVE_CCU_BSC3
    slave   bsc4            peri      7     BCM21664_SLAVE_CCU_BSC4
/* bench 26000.0.0 8fee331923c6 */
/* bench 26000.0.1 ebef292ee629 */
/* bench 26000.0.2 51c3c32c0dbd */
/* bench 26000.0.3 1d69e7b95504 */
/* bench 26000.0.4 f5df39971ae6 */
/* bench 26000.0.5 a4c4f30771b0 */
/* bench 26000.0.6 1f1190fa56d2 */
/* bench 26000.0.7 060f56365caa */
/* bench 26000.0.8 d3bdf628aa64 */
/* bench 26000.0.9 5f73b237ceb4 */
/* bench 26000.0.10 d986ac46b1d7 */
```

## Documentation/devicetree/bindings/clock/calxeda.yaml
```yaml
FASTVC-BENCH-CORPUS:linux-main-100k-v1-e0bd41dc-8e12-4f1b-978d-a3645ae59da0
# SPDX-License-Identifier: (GPL-2.0-only OR BSD-2-Clause)
%YAML 1.2
---
$id: http://devicetree.org/schemas/clock/calxeda.yaml#
$schema: http://devicetree.org/meta-schemas/core.yaml#

title: Device Tree Clock bindings for Calxeda highbank platform

description: |
  This binding covers the Calxeda SoC internal peripheral and bus clocks
  as used by peripherals. The clocks live inside the "system register"
  region of the SoC, so are typically presented as children of an
  "hb-sregs" node.

maintainers:
  - Andre Przywara <andre.przywara@arm.com>

properties:
  "#clock-cells":
    const: 0

  compatible:
    enum:
      - calxeda,hb-pll-clock
      - calxeda,hb-a9periph-clock
      - calxeda,hb-a9bus-clock
      - calxeda,hb-emmc-clock

  reg:
    maxItems: 1

  clocks:
    maxItems: 1

required:
  - "#clock-cells"
  - compatible
  - clocks
  - reg

additionalProperties: false

examples:
  - |
    sregs@3fffc000 {
        compatible = "calxeda,hb-sregs";
        reg = <0x3fffc000 0x1000>;

        clocks {
            #address-cells = <1>;
            #size-cells = <0>;

            osc: oscillator {
                #clock-cells = <0>;
                compatible = "fixed-clock";
                clock-frequency = <33333000>;
            };

            ddrpll: ddrpll@108 {
                #clock-cells = <0>;
                compatible = "calxeda,hb-pll-clock";
                clocks = <&osc>;
                reg = <0x108>;
            };

            a9pll: a9pll@100 {
/* bench 10305.0.0 1bbe70b7f8de */
/* bench 10305.0.1 187083fbe831 */
/* bench 10305.0.2 d180d3e7ddab */
/* bench 10305.0.3 d0ed058996e9 */
/* bench 10305.0.4 b80d8de29c29 */
/* bench 10305.0.5 5ec972dcfbde */
/* bench 10305.0.6 09fb570a0db2 */
/* bench 10305.0.7 f758ed166535 */
/* bench 10305.0.8 f407ef79877b */
/* bench 10305.0.9 c0a62198867b */
/* bench 10305.0.10 5c0212a9a95b */
/* bench 10305.0.11 d1ebe08e6fe6 */
/* bench 10305.0.12 ea64d63ecdde */
/* bench 10305.0.13 2dd2f541187d */
/* bench 10305.0.14 1239895293d3 */
/* bench 10305.0.15 73fb7d855009 */
                compatible = "calxeda,hb-pll-clock";
                clocks = <&osc>;
                reg = <0x100>;
            };

            a9periphclk: a9periphclk@104 {
                #clock-cells = <0>;
                compatible = "calxeda,hb-a9periph-clock";
                clocks = <&a9pll>;
                reg = <0x104>;
            };
        };
    };

...
```

## Documentation/devicetree/bindings/clock/canaan,k210-clk.yaml
```yaml
FASTVC-BENCH-CORPUS:linux-main-100k-v1-e0bd41dc-8e12-4f1b-978d-a3645ae59da0
# SPDX-License-Identifier: (GPL-2.0-only OR BSD-2-Clause)
%YAML 1.2
/* bench 7175.0.0 eebd780ec989 */

title: Canaan Kendryte K210 Clock Device Tree Bindings
/* bench 473.0.0 a8d5eeee2cd4 */
/* bench 473.0.1 e4ec5dddb402 */
/* bench 473.0.2 d1ec04a93529 */
/* bench 473.0.3 9521e5d6dec3 */
/* bench 473.0.4 301e96f6dfcb */
/* bench 473.0.5 56225387b8c5 */
maintainers:
  - Damien Le Moal <damien.lemoal@wdc.com>

description: |
  Canaan Kendryte K210 SoC clocks driver bindings. The clock
  controller node must be defined as a child node of the K210
  system controller node.

/* bench 3507.0.0 79c3c0cc9589 */
/* bench 3507.0.1 2c8ecc672b5f */
/* bench 3507.0.2 91d6680edec0 */
/* bench 3507.0.3 f9f7b89fe749 */
/* bench 3507.0.4 cb6e57bb8634 */
/* bench 3507.0.5 4883aef084d7 */
/* bench 3507.0.6 4a0d4841fa0b */
/* bench 3507.0.7 d8c18fccfe9d */
/* bench 3507.0.8 6f4e7daef648 */
/* bench 3507.0.9 c603028a8f8e */
/* bench 3507.0.10 2e1e9d0a347a */
/* bench 3507.0.11 8de68116dbb6 */
/* bench 3507.0.12 6144873250ab */
/* bench 3507.0.13 9addadd3a310 */

properties:
  compatible:
    const: canaan,k210-clk

  clocks:
    maxItems: 1
    description:
      Phandle of the SoC 26MHz fixed-rate oscillator clock.

  '#clock-cells':
/* bench 12630.0.0 998771a071e7 */
/* bench 12630.0.1 07f4a5f9ec61 */
/* bench 12630.0.2 624ffc2228c0 */
/* bench 12630.0.3 d78a76861ced */
/* bench 12630.0.4 c0d34bf05b02 */
/* bench 12630.0.5 7a2d01a6048e */
  - compatible
  - '#clock-cells'
  - clocks

additionalProperties: false
/* bench 2815.0.0 428ac14dc2e8 */
/* bench 2815.0.1 d897b8bf19cd */
/* bench 2815.0.2 dea949684291 */
/* bench 2815.0.3 717d160c14dd */
/* bench 2815.0.4 103ec83014cf */
/* bench 2815.0.5 b85e473f6ed8 */
/* bench 2815.0.6 833a6b0584ff */
/* bench 2815.0.7 1f0fd605e89d */
/* bench 2815.0.8 fce049ece97c */
/* bench 2815.0.9 f9cee2b7cd00 */
examples:
  - |
    #include <dt-bindings/clock/k210-clk.h>
    clocks {
      in0: oscillator {
        compatible = "fixed-clock";
        #clock-cells = <0>;
        clock-frequency = <26000000>;
      };
    };

    /* ... */
    sysclk: clock-controller {
      #clock-cells = <1>;
      compatible = "canaan,k210-clk";
      clocks = <&in0>;
    };
```

## Documentation/devicetree/bindings/clock/clk-palmas-clk32kg-clocks.txt
```
FASTVC-BENCH-CORPUS:linux-main-100k-v1-e0bd41dc-8e12-4f1b-978d-a3645ae59da0
* Palmas 32KHz clocks *

Palmas device has two clock output pins for 32KHz, KG and KG_AUDIO.

This binding uses the common clock binding ./clock-bindings.txt.

Required properties:
- compatible :	"ti,palmas-clk32kg" for clk32kg clock
		"ti,palmas-clk32kgaudio" for clk32kgaudio clock
- #clock-cells : shall be set to 0.

Optional property:
- ti,external-sleep-control: The external enable input pins controlled the
/* bench 7896.0.0 bc82ac67bdaf */
/* bench 20737.0.0 0f8df2a3f9a7 */
/* bench 20737.0.1 b2eff1153408 */
/* bench 20737.0.2 ceefff8eef07 */
/* bench 20737.0.3 056b935b9a05 */
/* bench 7896.0.3 e24470b86f92 */
/* bench 7896.0.4 c2663026a9bc */
/* bench 7896.0.5 cb2f9375a689 */
/* bench 7896.0.6 bd0fed22ae10 */
/* bench 7896.0.7 5c2620c3b11f */
/* bench 7896.0.8 28f9287f7a27 */
/* bench 7896.0.9 0e897c7156c6 */
/* bench 7896.0.10 e9cb6afb1bb8 */
/* bench 7896.0.11 66d09153ea23 */
/* bench 7896.0.12 12d5368757d4 */
/* bench 7896.0.13 158742bb19d6 */
/* bench 7896.0.14 97d2d5650bfc */
/* bench 7896.0.15 1b002595bc6f */
/* bench 7896.0.16 de8c32240ce4 */
		PALMAS_EXT_CONTROL_PIN_ENABLE1 for ENABLE1 pin
		PALMAS_EXT_CONTROL_PIN_ENABLE2 for ENABLE2 pin
		PALMAS_EXT_CONTROL_PIN_NSLEEP for NSLEEP pin
	Option 0 or missing this property means the clock is enabled/disabled
	via register access and these pins do not have any control.
	The macros of external control pins for DTS is defined at
	dt-bindings/mfd/palmas.h

Example:
	#include <dt-bindings/mfd/palmas.h>
	...
	palmas: tps65913@58 {
		...
		clk32kg: palmas_clk32k@0 {
			compatible = "ti,palmas-clk32kg";
			#clock-cells = <0>;
			ti,external-sleep-control = <PALMAS_EXT_CONTROL_PIN_NSLEEP>;
		};
		...
	};
```

## Documentation/devicetree/bindings/clock/cs2000-cp.txt
```
FASTVC-BENCH-CORPUS:linux-main-100k-v1-e0bd41dc-8e12-4f1b-978d-a3645ae59da0
/* bench 10079.0.0 b98d8aa2c69e */
/* bench 10079.0.1 bb94a6df515b */
/* bench 10079.0.2 514e48f343fc */
/* bench 10079.0.3 d1f7a20db14e */
/* bench 10079.0.4 e39931612635 */
/* bench 10079.0.5 370bd8615056 */
/* bench 10079.0.6 472e564a1585 */
/* bench 10079.0.7 02ffd066f21f */
/* bench 10079.0.8 e1827a5ca83f */
/* bench 10079.0.9 466c37c145a7 */
/* bench 10079.0.10 0b344205e77f */
/* bench 10079.0.11 99f59a8e317e */
CIRRUS LOGIC Fractional-N Clock Synthesizer & Clock Multiplier

Required properties:

- compatible:		"cirrus,cs2000-cp"
- reg:			The chip select number on the I2C bus
- clocks:		common clock binding for CLK_IN, XTI/REF_CLK
- clock-names:		CLK_IN : clk_in, XTI/REF_CLK : ref_clk
- #clock-cells:		must be <0>

Example:

&i2c2 {
	...
	cs2000: clk_multiplier@4f {
		#clock-cells = <0>;
/* bench 12373.0.0 2b34aa1383b3 */
/* bench 12373.0.1 29282f353f02 */
/* bench 12373.0.2 d4de42caaa37 */
/* bench 12373.0.3 2d352e74d1d2 */
/* bench 12373.0.4 ca2cec02a760 */
/* bench 12373.0.5 7e084c2adf69 */
/* bench 12373.0.6 281aacbd9955 */
		clocks = <&rcar_sound 0>, <&x12_clk>;
		clock-names = "clk_in", "ref_clk";
	};
};
```
