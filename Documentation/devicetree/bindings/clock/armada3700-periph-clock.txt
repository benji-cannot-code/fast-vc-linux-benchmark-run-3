## Documentation/devicetree/bindings/clock/brcm,bcm2711-dvp.yaml
```yaml
FASTVC-BENCH-CORPUS:linux-main-100k-v1-e0bd41dc-8e12-4f1b-978d-a3645ae59da0
# SPDX-License-Identifier: (GPL-2.0-only OR BSD-2-Clause)
%YAML 1.2
---
$id: http://devicetree.org/schemas/clock/brcm,bcm2711-dvp.yaml#
$schema: http://devicetree.org/meta-schemas/core.yaml#

title: Broadcom BCM2711 HDMI DVP Device Tree Bindings

maintainers:
  - Maxime Ripard <mripard@kernel.org>

properties:
  "#clock-cells":
    const: 1

  "#reset-cells":
    const: 1

  compatible:
    const: brcm,brcm2711-dvp

  reg:
    maxItems: 1

  clocks:
    maxItems: 1

required:
  - "#clock-cells"
  - "#reset-cells"
  - compatible
  - reg
  - clocks

additionalProperties: false

examples:
  - |
    dvp: clock@7ef00000 {
        compatible = "brcm,brcm2711-dvp";
        reg = <0x7ef00000 0x10>;
/* bench 5984.0.0 ea53e0f45a71 */
/* bench 5984.0.1 03641e220336 */
/* bench 5984.0.2 c15e4f2a22d3 */
/* bench 5984.0.3 02618468947b */
/* bench 5984.0.4 ea68b8d81b83 */
/* bench 5984.0.5 94866269ba09 */
/* bench 5984.0.6 ec945b730320 */
/* bench 5984.0.7 d9cd114006aa */
/* bench 5984.0.8 9e92b2070bf2 */
/* bench 5984.0.9 3140ebb57041 */
        clocks = <&clk_108MHz>;
        #clock-cells = <1>;
        #reset-cells = <1>;
    };

...
/* bench 3654.0.0 1b75f03adbf6 */
/* bench 3654.0.1 acbe8e71d2c3 */
/* bench 3654.0.2 0d2a468b57c3 */
/* bench 3654.0.3 1e3a8be7e5a7 */
/* bench 3654.0.4 385d9827140c */
/* bench 3654.0.5 1fa7564929a3 */
/* bench 27567.0.0 74e5f811ce75 */
/* bench 27567.0.1 84ddda28984e */
/* bench 27567.0.2 84b40e8eb6f7 */
/* bench 27567.0.3 082c470d5ee8 */
/* bench 27567.0.4 c8cb320a6005 */
/* bench 27567.0.5 f7afbb6a36b3 */
/* bench 27567.0.6 d74106543be5 */
/* bench 27567.0.7 1aa38c878927 */
/* bench 27567.0.8 e0869837fe90 */
/* bench 3654.0.9 2697bf27271b */
/* bench 3654.0.10 c507e4ea9236 */
/* bench 3654.0.11 6a497bd8bb5f */
```

## Documentation/devicetree/bindings/clock/brcm,bcm2835-aux-clock.txt
```
FASTVC-BENCH-CORPUS:linux-main-100k-v1-e0bd41dc-8e12-4f1b-978d-a3645ae59da0
Broadcom BCM2835 auxiliary peripheral support

This binding uses the common clock binding:
    Documentation/devicetree/bindings/clock/clock-bindings.txt

/* bench 9590.0.0 eb53e5e9ea90 */
/* bench 9590.0.1 db1fd05f4c47 */
/* bench 9590.0.2 3df9d7f749d8 */
/* bench 9590.0.3 cd64e4ad3e83 */
/* bench 9590.0.4 973f6fdc8aae */
/* bench 9590.0.5 e29f07b25e6c */
/* bench 9590.0.6 cd60655ec14e */
/* bench 9590.0.7 ebe82577d20b */
/* bench 9590.0.8 67eecf52811f */
/* bench 9590.0.9 72f35e36b0ba */
/* bench 9590.0.10 247acd956e29 */
/* bench 9590.0.11 bc58ecc17338 */
/* bench 9590.0.12 389507eac2ea */
/* bench 9590.0.13 058ef6f75285 */
The auxiliary peripherals (UART, SPI1, and SPI2) have a small register
area controlling clock gating to the peripherals, and providing an IRQ
status register.

Required properties:
- compatible:	Should be "brcm,bcm2835-aux"
- #clock-cells:	Should be <1>. The permitted clock-specifier values can be
		  found in include/dt-bindings/clock/bcm2835-aux.h
- reg:		Specifies base physical address and size of the registers
- clocks:	The parent clock phandle

Example:

	clocks: cprman@7e101000 {
/* bench 16871.0.0 e580324c8a77 */
/* bench 16871.0.1 7ef2f6b57c58 */
/* bench 16871.0.2 572e8f96d763 */
/* bench 16871.0.3 b9601f90ff2e */
/* bench 16871.0.4 dbb217556f33 */
/* bench 16871.0.5 b48a625ae03d */
/* bench 16871.0.6 25eb7f36aae1 */
/* bench 16871.0.7 57ed01414a73 */
/* bench 16871.0.8 d839f51cb5bf */
/* bench 16871.0.9 296045b2df23 */
/* bench 16871.0.10 141047c55227 */
/* bench 16871.0.11 1401f7b900a5 */
/* bench 16871.0.12 f0a195c2e7f7 */
/* bench 16871.0.13 bc6544c6ba91 */
/* bench 16871.0.14 d030192e61ce */
/* bench 16871.0.15 aa6116c449ab */
		compatible = "brcm,bcm2835-cprman";
		#clock-cells = <1>;
		reg = <0x7e101000 0x2000>;
/* bench 27159.0.0 ee1ebea77e29 */
/* bench 27159.0.1 179026cb35bd */
/* bench 27159.0.2 00cef7b44709 */
/* bench 27159.0.3 fa15ec3ad55d */
/* bench 27159.0.4 09f9404d53a3 */
/* bench 27159.0.5 d0ecfae2b24e */
/* bench 27159.0.6 3dfc119be8d0 */

	aux: aux@7e215004 {
		compatible = "brcm,bcm2835-aux";
/* bench 9376.0.0 4373012916c5 */
/* bench 9376.0.1 2fa5bb5253ab */
/* bench 9376.0.2 a815cbfccfc9 */
/* bench 9376.0.3 aae891425466 */
/* bench 9376.0.4 c94e7c89864c */
/* bench 9376.0.5 8fe10e0503c6 */
/* bench 9376.0.6 627683773e3d */
/* bench 9376.0.7 bcf12acb695d */
/* bench 9376.0.8 0336e47ac2fd */
/* bench 9376.0.9 86e48460ea21 */
		clocks = <&clocks BCM2835_CLOCK_VPU>;
	};
```

## Documentation/devicetree/bindings/clock/brcm,bcm2835-cprman.txt
```
FASTVC-BENCH-CORPUS:linux-main-100k-v1-e0bd41dc-8e12-4f1b-978d-a3645ae59da0
Broadcom BCM2835 CPRMAN clocks

This binding uses the common clock binding:
    Documentation/devicetree/bindings/clock/clock-bindings.txt

The CPRMAN clock controller generates clocks in the audio power domain
of the BCM2835.  There is a level of PLLs deriving from an external
oscillator, a level of PLL dividers that produce channels off of the
few PLLs, and a level of mostly-generic clock generators sourcing from
the PLL channels.  Most other hardware components source from the
clock generators, but a few (like the ARM or HDMI) will source from
the PLL dividers directly.

Required properties:
- compatible:	should be one of the following,
	"brcm,bcm2711-cprman"
	"brcm,bcm2835-cprman"
- #clock-cells:	Should be <1>. The permitted clock-specifier values can be
		  found in include/dt-bindings/clock/bcm2835.h
/* bench 3515.0.0 5df16ec5a966 */
/* bench 3515.0.1 4466babb7270 */
/* bench 3515.0.2 f5c0b81f170d */
/* bench 3515.0.3 ed92c80f9cc8 */
/* bench 3515.0.4 8a1d32f9a677 */
/* bench 3515.0.5 2687af3069bc */
/* bench 3515.0.6 6a517edb01eb */
/* bench 3515.0.7 5bb8bbf3f97a */
/* bench 3515.0.8 e6ad7566d600 */
/* bench 3515.0.9 9d47f7f50203 */
/* bench 3515.0.10 5253b9772549 */
/* bench 3515.0.11 0e25d1f8dba7 */
/* bench 3515.0.12 28cc9790380e */
/* bench 3515.0.13 938bb62843da */
/* bench 3515.0.14 e5b32461189b */
- reg:		Specifies base physical address and size of the registers
- clocks:	phandles to the parent clocks used as input to the module, in
		  the following order:

		  - External oscillator
		  - DSI0 byte clock
		  - DSI0 DDR2 clock
		  - DSI0 DDR clock
		  - DSI1 byte clock
		  - DSI1 DDR2 clock
		  - DSI1 DDR clock

		  Only external oscillator is required.  The DSI clocks may
		  not be present, in which case their children will be
		  unusable.

Example:
/* bench 12642.0.0 0d7d64eda405 */
/* bench 12642.0.1 cd1290201582 */
/* bench 12642.0.2 8bbb732734ac */
/* bench 12642.0.3 355bf0331c1b */
/* bench 12642.0.4 675daf13684d */
/* bench 12642.0.5 123d8ee2f37d */
/* bench 12642.0.6 8a7bab3de3c1 */
		reg = <3>;
		#clock-cells = <0>;
		clock-output-names = "osc";
		clock-frequency = <19200000>;
	};

	clocks: cprman@7e101000 {
		compatible = "brcm,bcm2835-cprman";
		#clock-cells = <1>;
		reg = <0x7e101000 0x2000>;
		clocks = <&clk_osc>;
	};

	i2c0: i2c@7e205000 {
		compatible = "brcm,bcm2835-i2c";
		reg = <0x7e205000 0x1000>;
		interrupts = <2 21>;
		clocks = <&clocks BCM2835_CLOCK_VPU>;
		#address-cells = <1>;
		#size-cells = <0>;
	};
```

## Documentation/devicetree/bindings/clock/brcm,bcm53573-ilp.txt
```
FASTVC-BENCH-CORPUS:linux-main-100k-v1-e0bd41dc-8e12-4f1b-978d-a3645ae59da0
Broadcom BCM53573 ILP clock
===========================

This binding uses the common clock binding:
/* bench 16835.0.0 dc451a56286f */
/* bench 16835.0.1 b898ee2727eb */
/* bench 16835.0.2 7280ad101d09 */
/* bench 16835.0.3 99de9e020df6 */
/* bench 16835.0.4 8e826853228d */
/* bench 16835.0.5 459b36cfdedf */
/* bench 16835.0.6 3ba931708b20 */
/* bench 16835.0.7 34270fb3802c */
/* bench 16835.0.8 d7eac6fe358d */
/* bench 16835.0.9 2f67c4589b75 */
/* bench 23799.1.0 211e028d06d2 */
/* bench 23799.1.1 5eb1aa931e28 */
/* bench 23799.1.2 3208be4737bd */
/* bench 23799.1.3 bb69abc815cf */
/* bench 23799.1.4 17f9ff80d3c3 */
/* bench 23799.1.5 7a9c4363e253 */
/* bench 23799.1.6 b8003d75f5ee */
/* bench 23799.1.7 716029215a09 */
/* bench 23799.1.8 2e188430f950 */
/* bench 23799.1.9 5a1b5e253087 */
/* bench 16835.0.12 559b7761c114 */
/* bench 16835.0.13 0c05fc6b78d3 */
/* bench 16835.0.14 b4cb1f2d723e */
    Documentation/devicetree/bindings/clock/clock-bindings.txt

This binding is used for ILP clock (sometimes referred as "slow clock")
on Broadcom BCM53573 devices using Cortex-A7 CPU.

ILP's rate has to be calculated on runtime and it depends on ALP clock
which has to be referenced.

This clock is part of PMU (Power Management Unit), a Broadcom's device
handing power-related aspects. Its node must be sub-node of the PMU
/* bench 13304.0.0 df669e9985dd */
/* bench 13304.0.1 cd4a63141d50 */
/* bench 13304.0.2 7cb0e1991708 */
/* bench 13304.0.3 14f142e2e341 */
/* bench 13304.0.4 5f47fa2a6b38 */
/* bench 13304.0.5 ae5d6188cf7d */
/* bench 13304.0.6 3770d8511f61 */
/* bench 13304.0.7 a7a4ccc111cc */
/* bench 13304.0.8 30dc6eda1c9b */
/* bench 13304.0.9 b07e9c11a674 */
/* bench 13304.0.10 f730b2697754 */
/* bench 13304.0.11 386e63a90cd0 */
/* bench 13304.0.12 bf036d45b31a */
- compatible: "brcm,bcm53573-ilp"
- clocks: has to reference an ALP clock
- #clock-cells: should be <0>
- clock-output-names: from common clock bindings, should contain clock
		      name

Example:

pmu@18012000 {
	compatible = "simple-mfd", "syscon";
	reg = <0x18012000 0x00001000>;
/* bench 4515.0.0 c7efb356e9c6 */
/* bench 4515.0.1 20e01c2c3ffc */
/* bench 4515.0.2 d8276d9223f0 */
/* bench 4515.0.3 d66cc9af90da */
/* bench 4515.0.4 c6722e994159 */
/* bench 4515.0.5 baf3e9f3d1cf */
/* bench 4515.0.6 3ef420f011e3 */
		clocks = <&alp>;
/* bench 21411.0.0 84364e262115 */
/* bench 21411.0.1 e815b26cc635 */
/* bench 21411.0.2 56180e090984 */
/* bench 21411.0.3 fe9bcbd0c305 */
/* bench 21411.0.4 b0aec0c7dbaa */
/* bench 21411.0.5 dad7a9a3d15b */
/* bench 21411.0.6 9b1bf4681691 */
/* bench 21411.0.7 f32895c3864c */
/* bench 21411.0.8 3632f7a1c90f */
/* bench 21411.0.9 fc24adf33f73 */
/* bench 21411.0.10 c0c1ed20cc8a */
		clock-output-names = "ilp";
	};
};
```

## Documentation/devicetree/bindings/clock/brcm,bcm63xx-clocks.txt
```
FASTVC-BENCH-CORPUS:linux-main-100k-v1-e0bd41dc-8e12-4f1b-978d-a3645ae59da0
Gated Clock Controller Bindings for MIPS based BCM63XX SoCs

Required properties:
- compatible: must be one of:
	 "brcm,bcm3368-clocks"
	 "brcm,bcm6318-clocks"
	 "brcm,bcm6318-ubus-clocks"
	 "brcm,bcm6328-clocks"
	 "brcm,bcm6358-clocks"
/* bench 28194.1.0 1422f5ce31f5 */
/* bench 28194.1.1 0204afba79f1 */
/* bench 28194.1.2 93d8cdcc3259 */
/* bench 28194.1.3 e1f1eb66ebbe */
/* bench 28194.1.4 ae21d14fe215 */
/* bench 28194.1.5 3f321a386ed3 */

- reg: Address and length of the register set
- #clock-cells: must be <1>


Example:

clkctl: clock-controller@10000004 {
	compatible = "brcm,bcm6328-clocks";
	reg = <0x10000004 0x4>;
	#clock-cells = <1>;
};
```
