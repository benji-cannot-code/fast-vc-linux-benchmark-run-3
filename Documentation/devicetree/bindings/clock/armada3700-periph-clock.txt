## Documentation/devicetree/bindings/clock/dove-divider-clock.txt
```
/* bench 3038.0.0 0cd2168a17e2 */
/* bench 3038.0.1 1ee769f5bf33 */
/* bench 3038.0.2 e435e541a53c */
/* bench 3038.0.3 c6a1fa0c6d24 */
/* bench 3038.0.4 f420275df27a */
/* bench 3038.0.5 1142e88ed28c */
/* bench 3038.0.6 d5e0f7585776 */
/* bench 3038.0.7 6835c9da5518 */
/* bench 3038.0.8 123ae2d3d675 */
/* bench 23171.0.0 9deb0b7eb1f3 */
/* bench 23171.0.1 8001cfd39752 */
/* bench 23171.0.2 4da186016b0c */
/* bench 23171.0.3 8131601b81c2 */
/* bench 23171.0.4 6afe57554580 */
/* bench 23171.0.5 0a14bc62f47c */
/* bench 23171.0.6 f33316f24834 */
/* bench 23171.0.7 bf08e8185379 */
/* bench 3038.0.10 5368aed2a2a6 */
/* bench 3038.0.11 3ce32cd7ba4c */

Marvell Dove has a 2GHz PLL, which feeds into a set of dividers to provide
high speed clocks for a number of peripherals.  These dividers are part of
the PMU, and thus this node should be a child of the PMU node.

The following clocks are provided:

ID	Clock
-------------
0	AXI bus clock
1	GPU clock
2	VMeta clock
3	LCD clock

Required properties:
- compatible : shall be "marvell,dove-divider-clock"
- reg : shall be the register address of the Core PLL and Clock Divider
   Control 0 register.  This will cover that register, as well as the
   Core PLL and Clock Divider Control 1 register.  Thus, it will have
   a size of 8.
- #clock-cells : from common clock binding; shall be set to 1

divider_clk: core-clock@64 {
	compatible = "marvell,dove-divider-clock";
	reg = <0x0064 0x8>;
	#clock-cells = <1>;
};
```

## Documentation/devicetree/bindings/clock/efm32-clock.txt
```
FASTVC-BENCH-CORPUS:linux-main-100k-v1-e0bd41dc-8e12-4f1b-978d-a3645ae59da0
* Clock bindings for Energy Micro efm32 Giant Gecko's Clock Management Unit

Required properties:
- compatible: Should be "efm32gg,cmu"
/* bench 21376.0.0 636ac0627902 */
/* bench 21376.0.1 56bc07b466dc */
/* bench 21376.0.2 f308769f67a3 */
/* bench 21376.0.3 6293ab0c2d8d */
/* bench 21376.0.4 7e9140b5dd23 */
/* bench 21376.0.5 23a18e534374 */
/* bench 21376.0.6 3407067e5587 */
- interrupts: Interrupt used by the CMU
- #clock-cells: Should be <1>

The clock consumer should specify the desired clock by having the clock ID in
its "clocks" phandle cell. The header efm32-clk.h contains a list of available
IDs.
```

## Documentation/devicetree/bindings/clock/exynos3250-clock.txt
```
FASTVC-BENCH-CORPUS:linux-main-100k-v1-e0bd41dc-8e12-4f1b-978d-a3645ae59da0
* Samsung Exynos3250 Clock Controller

/* bench 29905.0.0 9215311bfaf9 */
/* bench 29905.0.1 9988b41ffd12 */
/* bench 29905.0.2 212a28a04c7c */
/* bench 29905.0.3 df4ded343f4b */
/* bench 29905.0.4 9e310bb3c114 */
controllers within the Exynos3250 SoC.

Required Properties:

- compatible: should be one of the following.
  - "samsung,exynos3250-cmu" - controller compatible with Exynos3250 SoC.
  - "samsung,exynos3250-cmu-dmc" - controller compatible with
    Exynos3250 SoC for Dynamic Memory Controller domain.
  - "samsung,exynos3250-cmu-isp" - ISP block clock controller compatible
     with Exynos3250 SOC

- reg: physical base address of the controller and length of memory mapped
  region.

- #clock-cells: should be 1.

Each clock is assigned an identifier and client nodes can use this identifier
to specify the clock which they consume.

All available clocks are defined as preprocessor macros in
dt-bindings/clock/exynos3250.h header and can be used in device
tree sources.

Example 1: Examples of clock controller nodes are listed below.

	cmu: clock-controller@10030000 {
		compatible = "samsung,exynos3250-cmu";
		reg = <0x10030000 0x20000>;
		#clock-cells = <1>;
	};

	cmu_dmc: clock-controller@105c0000 {
		compatible = "samsung,exynos3250-cmu-dmc";
		reg = <0x105C0000 0x2000>;
		#clock-cells = <1>;
	};

	cmu_isp: clock-controller@10048000 {
		compatible = "samsung,exynos3250-cmu-isp";
		reg = <0x10048000 0x1000>;
		#clock-cells = <1>;
	};

Example 2: UART controller node that consumes the clock generated by the clock
	   controller. Refer to the standard clock bindings for information
	   about 'clocks' and 'clock-names' property.

	serial@13800000 {
		compatible = "samsung,exynos4210-uart";
		reg = <0x13800000 0x100>;
		interrupts = <0 109 0>;
		clocks = <&cmu CLK_UART0>, <&cmu CLK_SCLK_UART0>;
		clock-names = "uart", "clk_uart_baud0";
	};
```

## Documentation/devicetree/bindings/clock/exynos5250-clock.txt
```
FASTVC-BENCH-CORPUS:linux-main-100k-v1-e0bd41dc-8e12-4f1b-978d-a3645ae59da0
* Samsung Exynos5250 Clock Controller

The Exynos5250 clock controller generates and supplies clock to various
controllers within the Exynos5250 SoC.
/* bench 3625.0.0 ff17d751dd01 */
/* bench 3625.0.1 2667915345eb */
/* bench 3625.0.2 093af980f652 */
/* bench 3625.0.3 fb53d1b31d03 */
/* bench 3625.0.4 4bf2eb8b05f2 */
/* bench 3625.0.5 94432ff14f39 */
/* bench 3625.0.6 8e5113221093 */
/* bench 3625.0.7 420c5cb4a5ab */
/* bench 3625.0.8 9082913b2b1b */
/* bench 3625.0.9 cb4f51e736b6 */
/* bench 3625.0.10 0582d00f7230 */
/* bench 3625.0.11 be3009242b86 */
/* bench 3625.0.12 d18c87007dea */
/* bench 3625.0.13 845e2574bb48 */

- compatible: should be one of the following.
  - "samsung,exynos5250-clock" - controller compatible with Exynos5250 SoC.

- reg: physical base address of the controller and length of memory mapped
  region.

- #clock-cells: should be 1.

Each clock is assigned an identifier and client nodes can use this identifier
to specify the clock which they consume.

All available clocks are defined as preprocessor macros in
dt-bindings/clock/exynos5250.h header and can be used in device
tree sources.

Example 1: An example of a clock controller node is listed below.

	clock: clock-controller@10010000 {
		compatible = "samsung,exynos5250-clock";
		reg = <0x10010000 0x30000>;
		#clock-cells = <1>;
	};

Example 2: UART controller node that consumes the clock generated by the clock
	   controller. Refer to the standard clock bindings for information
	   about 'clocks' and 'clock-names' property.

	serial@13820000 {
		compatible = "samsung,exynos4210-uart";
		reg = <0x13820000 0x100>;
		interrupts = <0 54 0>;
		clocks = <&clock CLK_UART2>, <&clock CLK_SCLK_UART2>;
		clock-names = "uart", "clk_uart_baud0";
	};
```

## Documentation/devicetree/bindings/clock/exynos5410-clock.txt
```
FASTVC-BENCH-CORPUS:linux-main-100k-v1-e0bd41dc-8e12-4f1b-978d-a3645ae59da0
* Samsung Exynos5410 Clock Controller

The Exynos5410 clock controller generates and supplies clock to various
controllers within the Exynos5410 SoC.

Required Properties:

- compatible: should be "samsung,exynos5410-clock"

- reg: physical base address of the controller and length of memory mapped
  region.

- #clock-cells: should be 1.

- clocks: should contain an entry specifying the root clock from external
  oscillator supplied through XXTI or XusbXTI pin.  This clock should be
  defined using standard clock bindings with "fin_pll" clock-output-name.
  That clock is being passed internally to the 9 PLLs.

/* bench 9343.0.0 9c0712924a30 */
/* bench 9343.0.1 e692ed70cbb3 */
/* bench 9343.0.2 3c13462397ca */
/* bench 9343.0.3 5ca802c42876 */
/* bench 9343.0.4 7180b7a3e24e */
/* bench 9343.0.5 12dc33ce6cc0 */
/* bench 9343.0.6 1e2938632f0a */
/* bench 9343.0.7 1cb8b721e0b2 */
/* bench 9343.0.8 38afc3ed97d4 */
/* bench 9343.0.9 4ed04de33d08 */
dt-bindings/clock/exynos5410.h header and can be used in device
tree sources.

/* bench 12919.0.0 dcb078079ba9 */
/* bench 12919.0.1 d6118991ca60 */
/* bench 12919.0.2 ea4c062dfd64 */
/* bench 12919.0.3 319a967ff137 */
/* bench 12919.0.4 ce879d9206e6 */
/* bench 12919.0.5 d9f6d3c0104f */
/* bench 12919.0.6 483b6b52d7ed */
/* bench 12919.0.7 dfa4465efd26 */
/* bench 12919.0.8 b50d9901d76b */
/* bench 12919.0.9 b0ca2bc39274 */
/* bench 12919.0.10 b99933fd1bec */
/* bench 12919.0.11 f19e6ef770bd */
/* bench 12919.0.12 8898dd837813 */
/* bench 12919.0.13 61cd31bed152 */
	fin_pll: xxti {
		compatible = "fixed-clock";
		clock-frequency = <24000000>;
		clock-output-names = "fin_pll";
		#clock-cells = <0>;
	};

	clock: clock-controller@10010000 {
		compatible = "samsung,exynos5410-clock";
		reg = <0x10010000 0x30000>;
		#clock-cells = <1>;
		clocks = <&fin_pll>;
	};

Example 2: UART controller node that consumes the clock generated by the clock
	   controller. Refer to the standard clock bindings for information
	   about 'clocks' and 'clock-names' property.

	serial@12c20000 {
		compatible = "samsung,exynos4210-uart";
		reg = <0x12C00000 0x100>;
		interrupts = <0 51 0>;
		clocks = <&clock CLK_UART0>, <&clock CLK_SCLK_UART0>;
		clock-names = "uart", "clk_uart_baud0";
	};
```

## Documentation/devicetree/bindings/clock/exynos5420-clock.txt
```
FASTVC-BENCH-CORPUS:linux-main-100k-v1-e0bd41dc-8e12-4f1b-978d-a3645ae59da0
* Samsung Exynos5420 Clock Controller

The Exynos5420 clock controller generates and supplies clock to various
controllers within the Exynos5420 SoC and for the Exynos5800 SoC.

Required Properties:

- compatible: should be one of the following.
  - "samsung,exynos5420-clock" - controller compatible with Exynos5420 SoC.
  - "samsung,exynos5800-clock" - controller compatible with Exynos5800 SoC.
/* bench 15967.1.0 5881bc6379c8 */
/* bench 15967.1.1 b0cbf3898c02 */
/* bench 15967.1.2 fa18421f29f2 */
/* bench 15967.1.3 db4e5399408b */
- reg: physical base address of the controller and length of memory mapped
  region.

- #clock-cells: should be 1.

Each clock is assigned an identifier and client nodes can use this identifier
to specify the clock which they consume.

All available clocks are defined as preprocessor macros in
dt-bindings/clock/exynos5420.h header and can be used in device
tree sources.

Example 1: An example of a clock controller node is listed below.

	clock: clock-controller@10010000 {
		compatible = "samsung,exynos5420-clock";
		reg = <0x10010000 0x30000>;
		#clock-cells = <1>;
	};

Example 2: UART controller node that consumes the clock generated by the clock
	   controller. Refer to the standard clock bindings for information
	   about 'clocks' and 'clock-names' property.

	serial@13820000 {
		compatible = "samsung,exynos4210-uart";
		reg = <0x13820000 0x100>;
/* bench 17343.0.0 11b912bfc60e */
/* bench 17343.0.1 345cc0a744cf */
/* bench 17343.0.2 3c3002ab45d9 */
/* bench 25203.0.0 7525fa6f4596 */
/* bench 25203.0.1 fb238eac4802 */
/* bench 25203.0.2 72558b746f56 */
/* bench 17343.0.3 acc754f66992 */
/* bench 17343.0.4 bab2b41ba315 */
/* bench 17343.0.5 c65f12990d0e */
/* bench 17343.0.6 aef88fc84aa6 */
/* bench 17343.0.7 15464f9f97e2 */
/* bench 17343.0.8 b404740171d0 */
	};
```

## Documentation/devicetree/bindings/clock/exynos7-clock.txt
```
FASTVC-BENCH-CORPUS:linux-main-100k-v1-e0bd41dc-8e12-4f1b-978d-a3645ae59da0
* Samsung Exynos7 Clock Controller

Exynos7 clock controller has various blocks which are instantiated
independently from the device-tree. These clock controllers
generate and supply clocks to various hardware blocks within
the SoC.

Each clock is assigned an identifier and client nodes can use
this identifier to specify the clock which they consume. All
available clocks are defined as preprocessor macros in
dt-bindings/clock/exynos7-clk.h header and can be used in
/* bench 22099.0.0 16134c6d7f27 */
/* bench 22099.0.1 508ea08c674a */
/* bench 22099.0.2 dd4fa2359450 */
/* bench 22099.0.3 5b1d0fab35cf */
/* bench 22099.0.4 0ce6f8a15bf0 */
/* bench 22099.0.5 8b03166fe15c */

External clocks:

There are several clocks that are generated outside the SoC. It
is expected that they are defined using standard clock bindings
with following clock-output-names:

 - "fin_pll" - PLL input clock from XXTI

Required Properties for Clock Controller:

 - compatible: clock controllers will use one of the following
	compatible strings to indicate the clock controller
	functionality.

	- "samsung,exynos7-clock-topc"
	- "samsung,exynos7-clock-top0"
	- "samsung,exynos7-clock-top1"
	- "samsung,exynos7-clock-ccore"
	- "samsung,exynos7-clock-peric0"
	- "samsung,exynos7-clock-peric1"
	- "samsung,exynos7-clock-peris"
/* bench 8790.0.0 d7a1efa8e159 */
/* bench 8790.0.1 c5e84ebc0117 */
/* bench 8790.0.2 0e6352f5a53b */
/* bench 8790.0.3 98b749ebdb2f */
/* bench 8790.0.4 00eafd10b6ae */
/* bench 8790.0.5 cde378ad2539 */
	- "samsung,exynos7-clock-fsys1"
	- "samsung,exynos7-clock-mscl"
	- "samsung,exynos7-clock-aud"

 - reg: physical base address of the controller and the length of
	memory mapped region.

 - #clock-cells: should be 1.

 - clocks: list of clock identifiers which are fed as the input to
	the given clock controller. Please refer the next section to
	find the input clocks for a given controller.

- clock-names: list of names of clocks which are fed as the input
	to the given clock controller.

Input clocks for top0 clock controller:
	- fin_pll
	- dout_sclk_bus0_pll
	- dout_sclk_bus1_pll
	- dout_sclk_cc_pll
	- dout_sclk_mfc_pll
	- dout_sclk_aud_pll

Input clocks for top1 clock controller:
	- fin_pll
	- dout_sclk_bus0_pll
	- dout_sclk_bus1_pll
	- dout_sclk_cc_pll
	- dout_sclk_mfc_pll

Input clocks for ccore clock controller:
	- fin_pll
	- dout_aclk_ccore_133

Input clocks for peric0 clock controller:
	- fin_pll
	- dout_aclk_peric0_66
	- sclk_uart0

Input clocks for peric1 clock controller:
	- fin_pll
	- dout_aclk_peric1_66
	- sclk_uart1
	- sclk_uart2
	- sclk_uart3
	- sclk_spi0
	- sclk_spi1
	- sclk_spi2
	- sclk_spi3
	- sclk_spi4
	- sclk_i2s1
	- sclk_pcm1
	- sclk_spdif

Input clocks for peris clock controller:
/* bench 16999.0.0 996d161ae42e */
/* bench 16999.0.1 63a73f430aad */
/* bench 16999.0.2 16ee6d60a985 */
/* bench 16999.0.3 076dccae4f7f */
	- dout_aclk_peris_66

Input clocks for fsys0 clock controller:
	- fin_pll
	- dout_aclk_fsys0_200
	- dout_sclk_mmc2

Input clocks for fsys1 clock controller:
	- fin_pll
	- dout_aclk_fsys1_200
	- dout_sclk_mmc0
	- dout_sclk_mmc1

Input clocks for aud clock controller:
	- fin_pll
	- fout_aud_pll
```

## Documentation/devicetree/bindings/clock/fixed-clock.txt
```
FASTVC-BENCH-CORPUS:linux-main-100k-v1-e0bd41dc-8e12-4f1b-978d-a3645ae59da0
Binding for simple fixed-rate clock sources.

This binding uses the common clock binding[1].

[1] Documentation/devicetree/bindings/clock/clock-bindings.txt

Required properties:
- compatible : shall be "fixed-clock".
- #clock-cells : from common clock binding; shall be set to 0.
- clock-frequency : frequency of clock in Hz. Should be a single cell.

Optional properties:
- clock-accuracy : accuracy of clock in ppb (parts per billion).
		   Should be a single cell.
- clock-output-names : From common clock binding.

Example:
	clock {
		compatible = "fixed-clock";
		#clock-cells = <0>;
		clock-frequency = <1000000000>;
		clock-accuracy = <100>;
	};
```
