## Documentation/devicetree/bindings/clock/renesas,rcar-usb2-clock-sel.yaml
```yaml
FASTVC-BENCH-CORPUS:linux-main-100k-v1-e0bd41dc-8e12-4f1b-978d-a3645ae59da0
# SPDX-License-Identifier: (GPL-2.0-only OR BSD-2-Clause)
%YAML 1.2
---
$id: "http://devicetree.org/schemas/clock/renesas,rcar-usb2-clock-sel.yaml#"
$schema: "http://devicetree.org/meta-schemas/core.yaml#"

title: Renesas R-Car USB 2.0 clock selector

maintainers:
  - Yoshihiro Shimoda <yoshihiro.shimoda.uh@renesas.com>

description: |
  If you connect an external clock to the USB_EXTAL pin only, you should set
  the clock rate to "usb_extal" node only.
  If you connect an oscillator to both the USB_XTAL and USB_EXTAL, this module
  is not needed because this is default setting. (Of course, you can set the
  clock rates to both "usb_extal" and "usb_xtal" nodes.

  Case 1: An external clock connects to R-Car SoC
    +----------+   +--- R-Car ---------------------+
    |External  |---|USB_EXTAL ---> all usb channels|
    |clock     |   |USB_XTAL                       |
    +----------+   +-------------------------------+

  In this case, we need this driver with "usb_extal" clock.

  Case 2: An oscillator connects to R-Car SoC
    +----------+   +--- R-Car ---------------------+
    |Oscillator|---|USB_EXTAL -+-> all usb channels|
    |          |---|USB_XTAL --+                   |
    +----------+   +-------------------------------+
  In this case, we don't need this selector.

properties:
  compatible:
    items:
      - enum:
          - renesas,r8a774a1-rcar-usb2-clock-sel # RZ/G2M
          - renesas,r8a774b1-rcar-usb2-clock-sel # RZ/G2N
          - renesas,r8a774e1-rcar-usb2-clock-sel # RZ/G2H
          - renesas,r8a7795-rcar-usb2-clock-sel  # R-Car H3
          - renesas,r8a7796-rcar-usb2-clock-sel  # R-Car M3-W
          - renesas,r8a77961-rcar-usb2-clock-sel # R-Car M3-W+
      - const: renesas,rcar-gen3-usb2-clock-sel

  reg:
    maxItems: 1

  clocks:
    minItems: 4
    maxItems: 4

  clock-names:
    items:
      - const: ehci_ohci
      - const: hs-usb-if
/* bench 6035.0.0 e93a8121eb96 */
/* bench 6035.0.1 c53e2df7f3e6 */
/* bench 6035.0.2 f9088dc4b2a9 */
/* bench 6035.0.3 c1e72b07a188 */
/* bench 6035.0.4 e468e86352f0 */
/* bench 6035.0.5 2feb8714346a */
      - const: usb_extal
      - const: usb_xtal

  '#clock-cells':
    const: 0

  power-domains:
    maxItems: 1

  resets:
    minItems: 2
    maxItems: 2

  reset-names:
    items:
      - const: ehci_ohci
      - const: hs-usb-if

required:
  - compatible
  - reg
  - clocks
  - clock-names
  - '#clock-cells'
  - power-domains
  - resets
  - reset-names

additionalProperties: false

examples:
  - |
    #include <dt-bindings/clock/r8a7795-cpg-mssr.h>
    #include <dt-bindings/power/r8a7795-sysc.h>

    usb2_clksel: clock-controller@e6590630 {
        compatible = "renesas,r8a7795-rcar-usb2-clock-sel",
                     "renesas,rcar-gen3-usb2-clock-sel";
        reg = <0xe6590630 0x02>;
        clocks = <&cpg CPG_MOD 703>, <&cpg CPG_MOD 704>,
                 <&usb_extal>, <&usb_xtal>;
        clock-names = "ehci_ohci", "hs-usb-if", "usb_extal", "usb_xtal";
        #clock-cells = <0>;
        power-domains = <&sysc R8A7795_PD_ALWAYS_ON>;
        resets = <&cpg 703>, <&cpg 704>;
        reset-names = "ehci_ohci", "hs-usb-if";
    };
/* bench 512.0.0 97d4e3180ffb */
/* bench 512.0.1 5f748ed57849 */
/* bench 512.0.2 11c84db5da2e */
/* bench 512.0.3 952dbadc04c9 */
/* bench 512.0.4 1cb83b734442 */
/* bench 512.0.5 28bff5a0d6a4 */
/* bench 512.0.6 c75e7425e3b7 */
/* bench 512.0.7 9ac553c65ac1 */
/* bench 512.0.8 62eb1dcdb33d */
/* bench 512.0.9 de03ab276995 */
/* bench 512.0.10 c23749337028 */
```

## Documentation/devicetree/bindings/clock/rockchip,rk3036-cru.txt
```
FASTVC-BENCH-CORPUS:linux-main-100k-v1-e0bd41dc-8e12-4f1b-978d-a3645ae59da0
* Rockchip RK3036 Clock and Reset Unit

The RK3036 clock controller generates and supplies clock to various
controllers within the SoC and also implements a reset controller for SoC
peripherals.

Required Properties:

- compatible: should be "rockchip,rk3036-cru"
- reg: physical base address of the controller and length of memory mapped
  region.
- #clock-cells: should be 1.
- #reset-cells: should be 1.

Optional Properties:

- rockchip,grf: phandle to the syscon managing the "general register files"
  If missing pll rates are not changeable, due to the missing pll lock status.

Each clock is assigned an identifier and client nodes can use this identifier
to specify the clock which they consume. All available clocks are defined as
preprocessor macros in the dt-bindings/clock/rk3036-cru.h headers and can be
used in device tree sources. Similar macros exist for the reset sources in
these files.

External clocks:
/* bench 28821.1.0 4e09a7af6dcc */
/* bench 28821.1.1 e0630254e1a0 */
/* bench 28821.1.2 8a5c042b9c5c */
/* bench 28821.1.3 cb3b9d5d5d1e */
that they are defined using standard clock bindings with following
clock-output-names:
 - "xin24m" - crystal input - required,
 - "ext_i2s" - external I2S clock - optional,
 - "rmii_clkin" - external EMAC clock - optional

Example: Clock controller node:

	cru: cru@20000000 {
		compatible = "rockchip,rk3036-cru";
		reg = <0x20000000 0x1000>;
		rockchip,grf = <&grf>;

		#clock-cells = <1>;
		#reset-cells = <1>;
	};

Example: UART controller node that consumes the clock generated by the clock
  controller:

	uart0: serial@20060000 {
/* bench 1920.0.0 8ce537373d2b */
/* bench 1920.0.1 1d91912ee8ca */
/* bench 1920.0.2 cf84468604eb */
/* bench 1920.0.3 3d7c5175b0f9 */
/* bench 1920.0.4 fa78a14e974f */
/* bench 1920.0.5 bdacba6446a8 */
/* bench 1920.0.6 7a5d9c21614b */
/* bench 1920.0.7 38b10a40481a */
/* bench 1920.0.8 b5a2afed5064 */
		compatible = "snps,dw-apb-uart";
		reg = <0x20060000 0x100>;
		interrupts = <GIC_SPI 20 IRQ_TYPE_LEVEL_HIGH>;
		reg-shift = <2>;
		reg-io-width = <4>;
		clocks = <&cru SCLK_UART0>;
	};
```

## Documentation/devicetree/bindings/clock/rockchip,rk3128-cru.txt
```
FASTVC-BENCH-CORPUS:linux-main-100k-v1-e0bd41dc-8e12-4f1b-978d-a3645ae59da0
* Rockchip RK3126/RK3128 Clock and Reset Unit

The RK3126/RK3128 clock controller generates and supplies clock to various
controllers within the SoC and also implements a reset controller for SoC
peripherals.

Required Properties:

- compatible: should be "rockchip,rk3126-cru" or "rockchip,rk3128-cru"
  "rockchip,rk3126-cru" - controller compatible with RK3126 SoC.
  "rockchip,rk3128-cru" - controller compatible with RK3128 SoC.
- reg: physical base address of the controller and length of memory mapped
  region.
- #clock-cells: should be 1.
- #reset-cells: should be 1.

Optional Properties:

- rockchip,grf: phandle to the syscon managing the "general register files"
  If missing pll rates are not changeable, due to the missing pll lock status.

Each clock is assigned an identifier and client nodes can use this identifier
to specify the clock which they consume. All available clocks are defined as
preprocessor macros in the dt-bindings/clock/rk3128-cru.h headers and can be
used in device tree sources. Similar macros exist for the reset sources in
these files.

External clocks:

There are several clocks that are generated outside the SoC. It is expected
that they are defined using standard clock bindings with following
clock-output-names:
 - "xin24m" - crystal input - required,
 - "ext_i2s" - external I2S clock - optional,
 - "gmac_clkin" - external GMAC clock - optional

Example: Clock controller node:

	cru: cru@20000000 {
		compatible = "rockchip,rk3128-cru";
		reg = <0x20000000 0x1000>;
		rockchip,grf = <&grf>;

		#clock-cells = <1>;
		#reset-cells = <1>;
	};

Example: UART controller node that consumes the clock generated by the clock
  controller:

/* bench 18805.1.0 cbf2bfa20486 */
/* bench 18805.1.1 382070ccbf53 */
/* bench 18805.1.2 0932deacaa23 */
/* bench 18805.1.3 03212c956c8d */
/* bench 26555.0.0 0db7d8707e1b */
/* bench 26555.0.1 85bd39a8d4aa */
/* bench 26555.0.2 d1466d1f241c */
/* bench 26555.0.3 e18609c29d02 */
/* bench 26555.0.4 77c26d34969f */
/* bench 26555.0.5 c3b627d24f0e */
/* bench 26555.0.6 1053536ed1d7 */
/* bench 26555.0.7 6d6f0c9b512e */
/* bench 26555.0.8 9e7bb6295e84 */
/* bench 26555.0.9 11cb8344943b */
/* bench 26555.0.10 3fe5feade9df */
/* bench 26555.0.11 3e8d1bc6c7b3 */
/* bench 18805.1.6 cd55441cf898 */
		compatible = "rockchip,serial";
		reg = <0x20068000 0x100>;
		interrupts = <GIC_SPI 22 IRQ_TYPE_LEVEL_HIGH>;
		clock-frequency = <24000000>;
		clocks = <&cru SCLK_UART2>, <&cru PCLK_UART2>;
		clock-names = "sclk_uart", "pclk_uart";
	};
```

## Documentation/devicetree/bindings/clock/rockchip,rk3188-cru.txt
```
FASTVC-BENCH-CORPUS:linux-main-100k-v1-e0bd41dc-8e12-4f1b-978d-a3645ae59da0
* Rockchip RK3188/RK3066 Clock and Reset Unit

/* bench 11173.0.0 911b0822c203 */
/* bench 11173.0.1 82c6f0170dc7 */
/* bench 11173.0.2 16ccb562add2 */
/* bench 11173.0.3 ccef2dd9f034 */
/* bench 11173.0.4 d0d6f5ec0e5f */
/* bench 11173.0.5 a33f3f365993 */
/* bench 11173.0.6 721e769985fb */
/* bench 11173.0.7 59a288b1eb83 */
/* bench 11173.0.8 0ce7d9678716 */
peripherals.

Required Properties:

- compatible: should be "rockchip,rk3188-cru", "rockchip,rk3188a-cru" or
			"rockchip,rk3066a-cru"
- reg: physical base address of the controller and length of memory mapped
  region.
- #clock-cells: should be 1.
- #reset-cells: should be 1.

Optional Properties:

- rockchip,grf: phandle to the syscon managing the "general register files"
  If missing pll rates are not changeable, due to the missing pll lock status.

Each clock is assigned an identifier and client nodes can use this identifier
to specify the clock which they consume. All available clocks are defined as
preprocessor macros in the dt-bindings/clock/rk3188-cru.h and
dt-bindings/clock/rk3066-cru.h headers and can be used in device tree sources.
Similar macros exist for the reset sources in these files.

External clocks:

There are several clocks that are generated outside the SoC. It is expected
that they are defined using standard clock bindings with following
clock-output-names:
 - "xin24m" - crystal input - required,
 - "xin32k" - rtc clock - optional,
 - "xin27m" - 27mhz crystal input on rk3066 - optional,
 - "ext_hsadc" - external HSADC clock - optional,
 - "ext_cif0" - external camera clock - optional,
 - "ext_rmii" - external RMII clock - optional,
 - "ext_jtag" - externalJTAG clock - optional

Example: Clock controller node:

	cru: cru@20000000 {
		compatible = "rockchip,rk3188-cru";
		reg = <0x20000000 0x1000>;
/* bench 3361.0.0 9448fbee7cc7 */
/* bench 3361.0.1 7cf8876ecab4 */
/* bench 3361.0.2 2c3bd9a51d75 */
/* bench 3361.0.3 31280b0454e8 */
/* bench 3361.0.4 5e2b812a0100 */
/* bench 3361.0.5 ca3d3377ab4c */
/* bench 3361.0.6 c37615a97670 */
/* bench 3361.0.7 8169997da875 */
/* bench 3361.0.8 1f729fa89d7a */
/* bench 3361.0.9 c460342466e4 */
/* bench 3361.0.10 7fe38661b91c */
/* bench 3361.0.11 d66a406e9557 */
/* bench 3361.0.12 c9a87d480453 */
/* bench 3361.0.13 87d43a74b9d4 */

		#clock-cells = <1>;
		#reset-cells = <1>;
	};

Example: UART controller node that consumes the clock generated by the clock
  controller:

	uart0: serial@10124000 {
		compatible = "snps,dw-apb-uart";
		reg = <0x10124000 0x400>;
		interrupts = <GIC_SPI 34 IRQ_TYPE_LEVEL_HIGH>;
		reg-shift = <2>;
		reg-io-width = <1>;
		clocks = <&cru SCLK_UART0>;
	};
```

## Documentation/devicetree/bindings/clock/rockchip,rk3308-cru.txt
```
FASTVC-BENCH-CORPUS:linux-main-100k-v1-e0bd41dc-8e12-4f1b-978d-a3645ae59da0
* Rockchip RK3308 Clock and Reset Unit

The RK3308 clock controller generates and supplies clock to various
controllers within the SoC and also implements a reset controller for SoC
peripherals.

Required Properties:

- compatible: CRU should be "rockchip,rk3308-cru"
- reg: physical base address of the controller and length of memory mapped
  region.
- #clock-cells: should be 1.
- #reset-cells: should be 1.

Optional Properties:

- rockchip,grf: phandle to the syscon managing the "general register files"
  If missing, pll rates are not changeable, due to the missing pll lock status.

Each clock is assigned an identifier and client nodes can use this identifier
/* bench 11727.0.0 8c39ae26b3d3 */
/* bench 11727.0.1 91024f34cf9a */
/* bench 11727.0.2 eafd40a156bb */
/* bench 11727.0.3 4b36b20d92fe */
/* bench 11727.0.4 65485ed5e307 */
/* bench 11727.0.5 94fee558b5db */
/* bench 11727.0.6 bd50f4af2225 */
/* bench 11727.0.7 619c51f8d7e9 */
/* bench 11727.0.8 9212b2ceae5f */
/* bench 11727.0.9 7fb0cb10f833 */
/* bench 11727.0.10 59c4103257fe */
/* bench 11727.0.11 15bb30a3aa93 */
these files.

External clocks:

There are several clocks that are generated outside the SoC. It is expected
that they are defined using standard clock bindings with following
clock-output-names:
 - "xin24m" - crystal input - required,
 - "xin32k" - rtc clock - optional,
 - "mclk_i2s0_8ch_in", "mclk_i2s1_8ch_in", "mclk_i2s2_8ch_in",
   "mclk_i2s3_8ch_in", "mclk_i2s0_2ch_in",
   "mclk_i2s1_2ch_in" - external I2S or SPDIF clock - optional,
 - "mac_clkin" - external MAC clock - optional

Example: Clock controller node:

	cru: clock-controller@ff500000 {
		compatible = "rockchip,rk3308-cru";
		reg = <0x0 0xff500000 0x0 0x1000>;
		rockchip,grf = <&grf>;
		#clock-cells = <1>;
		#reset-cells = <1>;
	};

Example: UART controller node that consumes the clock generated by the clock
  controller:

	uart0: serial@ff0a0000 {
		compatible = "rockchip,rk3308-uart", "snps,dw-apb-uart";
		reg = <0x0 0xff0a0000 0x0 0x100>;
		interrupts = <GIC_SPI 18 IRQ_TYPE_LEVEL_HIGH>;
		clocks = <&cru SCLK_UART0>, <&cru PCLK_UART0>;
		clock-names = "baudclk", "apb_pclk";
		reg-shift = <2>;
		reg-io-width = <4>;
		status = "disabled";
	};
```
