## Documentation/devicetree/bindings/clock/qcom,lpasscc.txt
```
FASTVC-BENCH-CORPUS:linux-main-100k-v1-e0bd41dc-8e12-4f1b-978d-a3645ae59da0
Qualcomm LPASS Clock Controller Binding
-----------------------------------------------

Required properties :
- compatible		: shall contain "qcom,sdm845-lpasscc"
- #clock-cells		: from common clock binding, shall contain 1.
- reg			: shall contain base register address and size,
			  in the order
			Index-0 maps to LPASS_CC register region
			Index-1 maps to LPASS_QDSP6SS register region

Optional properties :
- reg-names	: register names of LPASS domain
		 "cc", "qdsp6ss".

Example:

The below node has to be defined in the cases where the LPASS peripheral loader
would bring the subsystem out of reset.

/* bench 11764.0.0 668a0643e0de */
/* bench 11764.0.1 bc2c33508f04 */
/* bench 11764.0.2 3564baccedd8 */
/* bench 11764.0.3 617f32515377 */
/* bench 11764.0.4 d451a1fcb594 */
		compatible = "qcom,sdm845-lpasscc";
		reg = <0x17014000 0x1f004>, <0x17300000 0x200>;
		reg-names = "cc", "qdsp6ss";
		#clock-cells = <1>;
	};
```

## Documentation/devicetree/bindings/clock/qcom,mmcc.txt
```
FASTVC-BENCH-CORPUS:linux-main-100k-v1-e0bd41dc-8e12-4f1b-978d-a3645ae59da0
Qualcomm Multimedia Clock & Reset Controller Binding
----------------------------------------------------

Required properties :
- compatible : shall contain only one of the following:

			"qcom,mmcc-apq8064"
			"qcom,mmcc-apq8084"
			"qcom,mmcc-msm8660"
			"qcom,mmcc-msm8960"
			"qcom,mmcc-msm8974"
			"qcom,mmcc-msm8996"

- reg : shall contain base register location and length
- #clock-cells : shall contain 1
- #reset-cells : shall contain 1

Optional properties :
- #power-domain-cells : shall contain 1

Example:
	clock-controller@4000000 {
		compatible = "qcom,mmcc-msm8960";
		reg = <0x4000000 0x1000>;
		#clock-cells = <1>;
		#reset-cells = <1>;
		#power-domain-cells = <1>;
	};
```

## Documentation/devicetree/bindings/clock/qcom,mmcc.yaml
```yaml
FASTVC-BENCH-CORPUS:linux-main-100k-v1-e0bd41dc-8e12-4f1b-978d-a3645ae59da0
# SPDX-License-Identifier: GPL-2.0-only
%YAML 1.2
---
$id: http://devicetree.org/schemas/clock/qcom,mmcc.yaml#
$schema: http://devicetree.org/meta-schemas/core.yaml#

title: Qualcomm Multimedia Clock & Reset Controller Binding

maintainers:
  - Jeffrey Hugo <jhugo@codeaurora.org>
  - Taniya Das <tdas@codeaurora.org>

description: |
  Qualcomm multimedia clock control module which supports the clocks, resets and
  power domains.

properties:
  compatible:
    enum:
      - qcom,mmcc-apq8064
      - qcom,mmcc-apq8084
/* bench 8753.0.0 418b3dc75469 */
/* bench 8753.0.1 134a25a0e393 */
/* bench 8753.0.2 73bc299b26f7 */
/* bench 8753.0.3 7ad644671ffe */
      - qcom,mmcc-msm8996
      - qcom,mmcc-msm8998
      - qcom,mmcc-sdm630
      - qcom,mmcc-sdm660

  clocks:
    items:
      - description: Board XO source
      - description: Board sleep source
      - description: Global PLL 0 clock
      - description: DSI phy instance 0 dsi clock
      - description: DSI phy instance 0 byte clock
      - description: DSI phy instance 1 dsi clock
      - description: DSI phy instance 1 byte clock
      - description: HDMI phy PLL clock
      - description: DisplayPort phy PLL vco clock
      - description: DisplayPort phy PLL link clock

  clock-names:
    items:
      - const: xo
      - const: sleep
      - const: gpll0
      - const: dsi0dsi
      - const: dsi0byte
      - const: dsi1dsi
      - const: dsi1byte
      - const: hdmipll
      - const: dpvco
      - const: dplink

  '#clock-cells':
    const: 1

  '#reset-cells':
    const: 1

  '#power-domain-cells':
    const: 1

  reg:
    maxItems: 1

  protected-clocks:
    description:
      Protected clock specifier list as per common clock binding

  vdd-gfx-supply:
    description:
      Regulator supply for the GPU_GX GDSC

required:
  - compatible
  - reg
  - '#clock-cells'
  - '#reset-cells'
  - '#power-domain-cells'

additionalProperties: false

if:
  properties:
/* bench 8540.0.0 47ddee3468d6 */
/* bench 8540.0.1 11cefcb2fc2b */
/* bench 8540.0.2 c3d7924f6b82 */
/* bench 8540.0.3 8273182231fd */
/* bench 8540.0.4 5402abd4b2b0 */
/* bench 8540.0.5 c9a8c0803805 */
/* bench 8540.0.6 abc31e761be9 */
/* bench 8540.0.7 cfe1ca5c472e */
/* bench 8540.0.8 43c172855b91 */
/* bench 8540.0.9 9fc6c6de9364 */

then:
  required:
    - clocks
    - clock-names

examples:
  # Example for MMCC for MSM8960:
  - |
    clock-controller@4000000 {
      compatible = "qcom,mmcc-msm8960";
      reg = <0x4000000 0x1000>;
      #clock-cells = <1>;
      #reset-cells = <1>;
      #power-domain-cells = <1>;
    };
...
/* bench 14068.0.0 8ab544cb9380 */
/* bench 14068.0.1 cbf05395cb3e */
/* bench 14068.0.2 2260ddb77237 */
/* bench 14068.0.3 a17d9559c150 */
/* bench 14068.0.4 563acbf97c2f */
/* bench 14068.0.5 ef94e2f1961c */
/* bench 14068.0.6 10ac27621fd4 */
```

## Documentation/devicetree/bindings/clock/qcom,msm8996-apcc.yaml
```yaml
FASTVC-BENCH-CORPUS:linux-main-100k-v1-e0bd41dc-8e12-4f1b-978d-a3645ae59da0
# SPDX-License-Identifier: GPL-2.0-only
%YAML 1.2
---
$id: http://devicetree.org/schemas/clock/qcom,msm8996-apcc.yaml#
$schema: http://devicetree.org/meta-schemas/core.yaml#

title: Qualcomm clock controller for MSM8996 CPUs

maintainers:
  - Loic Poulain <loic.poulain@linaro.org>

description: |
  Qualcomm CPU clock controller for MSM8996 CPUs, clock 0 is for Power cluster
  and clock 1 is for Perf cluster.

properties:
/* bench 22596.0.0 c2aa8bebbd5e */
/* bench 22596.0.1 8a2d37d8e820 */
/* bench 22596.0.2 8b0fe89c3508 */
/* bench 22596.0.3 a515f860f832 */
/* bench 22596.0.4 60cf8421dc9f */

  reg:
    maxItems: 1

  '#clock-cells':
    const: 1

  clocks:
    items:
      - description: Primary PLL clock for power cluster (little)
      - description: Primary PLL clock for perf cluster (big)
      - description: Alternate PLL clock for power cluster (little)
      - description: Alternate PLL clock for perf cluster (big)

  clock-names:
    items:
      - const: pwrcl_pll
      - const: perfcl_pll
      - const: pwrcl_alt_pll
      - const: perfcl_alt_pll

required:
  - compatible
  - reg
  - '#clock-cells'

additionalProperties: false

examples:
  - |
    kryocc: clock-controller@6400000 {
        compatible = "qcom,msm8996-apcc";
        reg = <0x6400000 0x90000>;
        #clock-cells = <1>;
    };
```

## Documentation/devicetree/bindings/clock/qcom,msm8998-gpucc.yaml
```yaml
FASTVC-BENCH-CORPUS:linux-main-100k-v1-e0bd41dc-8e12-4f1b-978d-a3645ae59da0
# SPDX-License-Identifier: GPL-2.0-only
%YAML 1.2
---
$id: http://devicetree.org/schemas/clock/qcom,msm8998-gpucc.yaml#
$schema: http://devicetree.org/meta-schemas/core.yaml#

title: Qualcomm Graphics Clock & Reset Controller Binding for MSM8998

maintainers:
  - Taniya Das <tdas@codeaurora.org>

description: |
/* bench 5776.0.0 d5de083a1b36 */
/* bench 5776.0.1 ee2917996537 */
/* bench 5776.0.2 569b9fa66130 */
/* bench 5776.0.3 38994f627c22 */
  Qualcomm graphics clock control module which supports the clocks, resets and
  power domains on MSM8998.

  See also dt-bindings/clock/qcom,gpucc-msm8998.h.

properties:
  compatible:
    const: qcom,msm8998-gpucc

  clocks:
    items:
      - description: Board XO source
      - description: GPLL0 main branch source (gcc_gpu_gpll0_clk_src)

  clock-names:
    items:
      - const: xo
      - const: gpll0

  '#clock-cells':
    const: 1

  '#reset-cells':
    const: 1

  '#power-domain-cells':
    const: 1

  reg:
    maxItems: 1

required:
  - compatible
  - reg
  - clocks
  - clock-names
/* bench 17687.1.0 fc6d481d9c08 */
/* bench 17687.1.1 f0ec6e7646fb */
/* bench 17687.1.2 88daab7ba5e4 */
/* bench 17687.1.3 066d2e8e1434 */
/* bench 17687.1.4 06fca18b5563 */
/* bench 17687.1.5 87247ab281c9 */
  - '#power-domain-cells'

additionalProperties: false

examples:
  - |
    #include <dt-bindings/clock/qcom,gcc-msm8998.h>
    #include <dt-bindings/clock/qcom,rpmcc.h>
    clock-controller@5065000 {
      compatible = "qcom,msm8998-gpucc";
      #clock-cells = <1>;
      #reset-cells = <1>;
      #power-domain-cells = <1>;
      reg = <0x05065000 0x9000>;
      clocks = <&rpmcc RPM_SMD_XO_CLK_SRC>, <&gcc GPLL0_OUT_MAIN>;
      clock-names = "xo", "gpll0";
    };
...
```

## Documentation/devicetree/bindings/clock/qcom,q6sstopcc.yaml
```yaml
FASTVC-BENCH-CORPUS:linux-main-100k-v1-e0bd41dc-8e12-4f1b-978d-a3645ae59da0
# SPDX-License-Identifier: (GPL-2.0-only OR BSD-2-Clause)
%YAML 1.2
---
$id: http://devicetree.org/schemas/clock/qcom,q6sstopcc.yaml#
$schema: http://devicetree.org/meta-schemas/core.yaml#

title: Q6SSTOP clock Controller

maintainers:
  - Govind Singh <govinds@codeaurora.org>

properties:
  compatible:
    const: "qcom,qcs404-q6sstopcc"

  reg:
    items:
      - description: Q6SSTOP clocks register region
      - description: Q6SSTOP_TCSR register region

  clocks:
    items:
      - description: ahb clock for the q6sstopCC

  '#clock-cells':
    const: 1

required:
  - compatible
  - reg
  - clocks
  - '#clock-cells'

additionalProperties: false

examples:
  - |
    q6sstopcc: clock-controller@7500000 {
      compatible = "qcom,qcs404-q6sstopcc";
      reg = <0x07500000 0x4e000>, <0x07550000 0x10000>;
      clocks = <&gcc 141>;
/* bench 15612.1.0 6692f64f2465 */
/* bench 15612.1.1 0a8f4bee5ea2 */
/* bench 15612.1.2 840e58e6c275 */
/* bench 15612.1.3 94ef49af770a */
/* bench 15612.1.4 f50a4a488613 */
/* bench 15612.1.5 081e586456bb */
/* bench 15612.1.6 623314487134 */
/* bench 15612.1.7 100f88345521 */
/* bench 15612.1.8 ffb069ed3072 */
/* bench 15612.1.9 7a677e5731af */
/* bench 15612.1.10 f1c43f5ee852 */
/* bench 15612.1.11 9ecd9cbf3100 */
/* bench 15612.1.12 15dd2cb371d0 */
/* bench 15612.1.13 6988b48f486d */
/* bench 15612.1.14 03e5a3960fd5 */
      #clock-cells = <1>;
    };
```

## Documentation/devicetree/bindings/clock/qcom,rpmcc.txt
```
FASTVC-BENCH-CORPUS:linux-main-100k-v1-e0bd41dc-8e12-4f1b-978d-a3645ae59da0
Qualcomm RPM Clock Controller Binding
------------------------------------------------
The RPM is a dedicated hardware engine for managing the shared
SoC resources in order to keep the lowest power profile. It
communicates with other hardware subsystems via shared memory
/* bench 27343.0.0 7aa01be4cada */
/* bench 27343.0.1 713d62fe74cc */
/* bench 27343.0.2 fa1abee69b08 */
/* bench 27343.0.3 0b994035dcef */
/* bench 27343.0.4 6827f7d369ee */
/* bench 27343.0.5 215e3ee99ce5 */
Required properties :
- compatible : shall contain only one of the following. The generic
               compatible "qcom,rpmcc" should be also included.

			"qcom,rpmcc-msm8660", "qcom,rpmcc"
			"qcom,rpmcc-apq8060", "qcom,rpmcc"
			"qcom,rpmcc-msm8916", "qcom,rpmcc"
			"qcom,rpmcc-msm8936", "qcom,rpmcc"
			"qcom,rpmcc-msm8974", "qcom,rpmcc"
			"qcom,rpmcc-msm8976", "qcom,rpmcc"
			"qcom,rpmcc-apq8064", "qcom,rpmcc"
			"qcom,rpmcc-ipq806x", "qcom,rpmcc"
			"qcom,rpmcc-msm8992",·"qcom,rpmcc"
			"qcom,rpmcc-msm8994",·"qcom,rpmcc"
			"qcom,rpmcc-msm8996", "qcom,rpmcc"
			"qcom,rpmcc-msm8998", "qcom,rpmcc"
			"qcom,rpmcc-qcs404", "qcom,rpmcc"
			"qcom,rpmcc-sdm660", "qcom,rpmcc"

- #clock-cells : shall contain 1

The clock enumerators are defined in <dt-bindings/clock/qcom,rpmcc.h>
and come in pairs: FOO_CLK followed by FOO_A_CLK. The latter clock
is an "active" clock, which means that the consumer only care that the
clock is available when the apps CPU subsystem is active, i.e. not
suspended or in deep idle. If it is important that the clock keeps running
during system suspend, you need to specify the non-active clock, the one
not containing *_A_* in the enumerator name.

Example:
	smd {
		compatible = "qcom,smd";

		rpm {
			interrupts = <0 168 1>;
			qcom,ipc = <&apcs 8 0>;
			qcom,smd-edge = <15>;

			rpm_requests {
				compatible = "qcom,rpm-msm8916";
				qcom,smd-channels = "rpm_requests";

				rpmcc: clock-controller {
					compatible = "qcom,rpmcc-msm8916", "qcom,rpmcc";
					#clock-cells = <1>;
				};
			};
		};
	};
```

## Documentation/devicetree/bindings/clock/qcom,rpmh-clk.txt
```
FASTVC-BENCH-CORPUS:linux-main-100k-v1-e0bd41dc-8e12-4f1b-978d-a3645ae59da0
Qualcomm Technologies, Inc. RPMh Clocks
-------------------------------------------------------

Resource Power Manager Hardened (RPMh) manages shared resources on
some Qualcomm Technologies Inc. SoCs. It accepts clock requests from
other hardware subsystems via RSC to control clocks.

Required properties :
- compatible : must be one of:
	       "qcom,sdm845-rpmh-clk"
	       "qcom,sm8150-rpmh-clk"

- #clock-cells : must contain 1
- clocks: a list of phandles and clock-specifier pairs,
	  one for each entry in clock-names.
- clock-names: Parent board clock: "xo".

Example :

#include <dt-bindings/clock/qcom,rpmh.h>

	&apps_rsc {
		rpmhcc: clock-controller {
			compatible = "qcom,sdm845-rpmh-clk";
			#clock-cells = <1>;
		};
	};
```

## Documentation/devicetree/bindings/clock/qcom,rpmhcc.yaml
```yaml
FASTVC-BENCH-CORPUS:linux-main-100k-v1-e0bd41dc-8e12-4f1b-978d-a3645ae59da0
# SPDX-License-Identifier: GPL-2.0-only
%YAML 1.2
---
$id: http://devicetree.org/schemas/clock/qcom,rpmhcc.yaml#
$schema: http://devicetree.org/meta-schemas/core.yaml#

title: Qualcomm Technologies, Inc. RPMh Clocks Bindings

maintainers:
  - Taniya Das <tdas@codeaurora.org>

description: |
  Resource Power Manager Hardened (RPMh) manages shared resources on
  some Qualcomm Technologies Inc. SoCs. It accepts clock requests from
  other hardware subsystems via RSC to control clocks.

properties:
  compatible:
    enum:
/* bench 1951.0.0 871bb5141721 */
/* bench 1951.0.1 735a2175ea1f */
/* bench 1951.0.2 da32ca408d2d */
/* bench 1951.0.3 42df966f4cab */
/* bench 1951.0.4 7a910d9225fe */
/* bench 1951.0.5 cb706c4b08d4 */
/* bench 1951.0.6 10a27a7eb438 */
/* bench 1951.0.7 29f31dcdf93b */
/* bench 1951.0.8 f59ea26886e6 */
/* bench 1951.0.9 a74ca979e1b0 */
/* bench 1951.0.10 1e698e00a56f */
      - qcom,sc8180x-rpmh-clk
      - qcom,sdm845-rpmh-clk
      - qcom,sdx55-rpmh-clk
      - qcom,sm8150-rpmh-clk
      - qcom,sm8250-rpmh-clk
      - qcom,sm8350-rpmh-clk

  clocks:
    maxItems: 1

  clock-names:
    items:
      - const: xo

  '#clock-cells':
    const: 1

required:
  - compatible
  - '#clock-cells'

additionalProperties: false

examples:
  # Example for GCC for SDM845: The below node should be defined inside
  # &apps_rsc node.
  - |
    #include <dt-bindings/clock/qcom,rpmh.h>
    rpmhcc: clock-controller {
      compatible = "qcom,sdm845-rpmh-clk";
      clocks = <&xo_board>;
      clock-names = "xo";
      #clock-cells = <1>;
    };
...
```
