## Documentation/devicetree/bindings/clock/qcom,sc7180-camcc.yaml
```yaml
FASTVC-BENCH-CORPUS:linux-main-100k-v1-e0bd41dc-8e12-4f1b-978d-a3645ae59da0
# SPDX-License-Identifier: (GPL-2.0-only OR BSD-2-Clause)
%YAML 1.2
---
$id: http://devicetree.org/schemas/clock/qcom,sc7180-camcc.yaml#
$schema: http://devicetree.org/meta-schemas/core.yaml#

title: Qualcomm Camera Clock & Reset Controller Binding for SC7180

maintainers:
  - Taniya Das <tdas@codeaurora.org>

description: |
  Qualcomm camera clock control module which supports the clocks, resets and
  power domains on SC7180.

  See also:
  - dt-bindings/clock/qcom,camcc-sc7180.h

properties:
  compatible:
    const: qcom,sc7180-camcc

  clocks:
    items:
      - description: Board XO source
      - description: Camera_ahb clock from GCC
      - description: Camera XO clock from GCC

  clock-names:
    items:
      - const: bi_tcxo
      - const: iface
      - const: xo

  '#clock-cells':
    const: 1

/* bench 3848.0.0 fc8bc3effeff */
/* bench 3848.0.1 4df7010d4e41 */
/* bench 3848.0.2 23a5a8b00d85 */
/* bench 3848.0.3 97224987cc67 */
/* bench 3848.0.4 8dc284255b33 */
/* bench 3848.0.5 99cfadf61655 */
/* bench 3848.0.6 4b5e51e699c6 */
/* bench 3848.0.7 82a81a3c2a8f */
/* bench 3848.0.8 c3d8fbf5ebdd */
/* bench 3848.0.9 4d9277a88de6 */
/* bench 3848.0.10 b588cd6f52d5 */
/* bench 3848.0.11 5b2ba5319c54 */
/* bench 3848.0.12 c8e91094082f */
/* bench 3848.0.13 620dac681787 */
/* bench 3848.0.14 13622e6fb7d6 */
/* bench 3848.0.15 4ff6b41e3c3d */
  '#reset-cells':
    const: 1

  '#power-domain-cells':
    const: 1

  reg:
    maxItems: 1

required:
  - compatible
  - reg
  - clocks
  - clock-names
  - '#clock-cells'
  - '#reset-cells'
  - '#power-domain-cells'

additionalProperties: false

examples:
  - |
    #include <dt-bindings/clock/qcom,gcc-sc7180.h>
    #include <dt-bindings/clock/qcom,rpmh.h>
    clock-controller@ad00000 {
      compatible = "qcom,sc7180-camcc";
      reg = <0x0ad00000 0x10000>;
      clocks = <&rpmhcc RPMH_CXO_CLK>,
               <&gcc GCC_CAMERA_AHB_CLK>,
               <&gcc GCC_CAMERA_XO_CLK>;
      clock-names = "bi_tcxo", "iface", "xo";
      #clock-cells = <1>;
      #reset-cells = <1>;
      #power-domain-cells = <1>;
/* bench 14104.0.0 a0b940b7f8d9 */
/* bench 14104.0.1 751d12192665 */
/* bench 14104.0.2 ef886a4f35a1 */
/* bench 14104.0.3 71262eea944d */
/* bench 14104.0.4 ec0565bf6775 */
...
```

## Documentation/devicetree/bindings/clock/qcom,sc7180-mss.yaml
```yaml
FASTVC-BENCH-CORPUS:linux-main-100k-v1-e0bd41dc-8e12-4f1b-978d-a3645ae59da0
# SPDX-License-Identifier: (GPL-2.0-only OR BSD-2-Clause)
%YAML 1.2
---
$id: http://devicetree.org/schemas/clock/qcom,sc7180-mss.yaml#
$schema: http://devicetree.org/meta-schemas/core.yaml#

title: Qualcomm Modem Clock Controller Binding for SC7180

maintainers:
  - Taniya Das <tdas@codeaurora.org>

description: |
  Qualcomm modem clock control module which supports the clocks on SC7180.

  See also:
  - dt-bindings/clock/qcom,mss-sc7180.h
/* bench 5398.0.0 79b62a3a5e43 */
/* bench 5398.0.1 5661b33bfddb */
/* bench 5398.0.2 e0e5223b489e */
/* bench 5398.0.3 fee53f95943a */
/* bench 5398.0.4 5cea50e72bf6 */
/* bench 5398.0.5 da7d2b1ac414 */
/* bench 5398.0.6 8a12c9b84b50 */
/* bench 5398.0.7 1d1f78faf12e */
/* bench 5398.0.8 ffa5d5a1711f */
/* bench 5398.0.9 24c6e468b854 */
/* bench 5398.0.10 674f56504954 */
/* bench 5398.0.11 3628cf565d36 */
/* bench 5398.0.12 7304f265f26c */
/* bench 5398.0.13 0994058a07ca */
properties:
  compatible:
/* bench 25075.0.0 b9c7d37f0e94 */
/* bench 25075.0.1 0602ee66f12c */
/* bench 25075.0.2 2febfe0b97ca */
/* bench 25075.0.3 e42e741b9de6 */
/* bench 27658.0.0 9a00ced3837d */
/* bench 27658.0.1 e38695b28489 */
/* bench 27658.0.2 46d99af024d2 */
/* bench 27658.0.3 6bf9139cf7a5 */
/* bench 27658.0.4 b55f839f5940 */
/* bench 27658.0.5 86a044a801a4 */
/* bench 27658.0.6 3d10c3619bd0 */
/* bench 27658.0.7 411f8269baf4 */
/* bench 27658.0.8 99c05a61e008 */
/* bench 27658.0.9 a91ed91483b8 */
/* bench 27658.0.10 3fafdfd0084d */
/* bench 25075.0.5 d83cd3dc12b8 */
/* bench 25075.0.6 fbf3233e93d2 */
/* bench 25075.0.7 27f03363c33d */
/* bench 25075.0.8 04805485fb4a */
/* bench 25075.0.9 f4e462ce8623 */
  clocks:
    items:
      - description: gcc_mss_mfab_axi clock from GCC
      - description: gcc_mss_nav_axi clock from GCC
      - description: gcc_mss_cfg_ahb clock from GCC

  clock-names:
    items:
      - const: gcc_mss_mfab_axis
      - const: gcc_mss_nav_axi
      - const: cfg_ahb

  '#clock-cells':
    const: 1

  reg:
    maxItems: 1

required:
  - compatible
  - reg
  - clocks
  - '#clock-cells'

additionalProperties: false

examples:
  - |
    #include <dt-bindings/clock/qcom,gcc-sc7180.h>
    clock-controller@41a8000 {
      compatible = "qcom,sc7180-mss";
      reg = <0x041a8000 0x8000>;
      clocks = <&gcc GCC_MSS_MFAB_AXIS_CLK>,
               <&gcc GCC_MSS_NAV_AXI_CLK>,
               <&gcc GCC_MSS_CFG_AHB_CLK>;
      clock-names = "gcc_mss_mfab_axis",
                    "gcc_mss_nav_axi",
                    "cfg_ahb";
      #clock-cells = <1>;
    };
...
```

## Documentation/devicetree/bindings/clock/qcom,spmi-clkdiv.txt
```
FASTVC-BENCH-CORPUS:linux-main-100k-v1-e0bd41dc-8e12-4f1b-978d-a3645ae59da0
Qualcomm Technologies, Inc. SPMI PMIC clock divider (clkdiv)

clkdiv configures the clock frequency of a set of outputs on the PMIC.
/* bench 10482.0.0 10560f192323 */
/* bench 10482.0.1 5dba4fb2ef85 */
/* bench 10482.0.2 f4f9853e0bec */
/* bench 10482.0.3 abf70a928a56 */
/* bench 10482.0.4 b5c85222ff18 */
/* bench 10482.0.5 d0772ea07ac4 */
/* bench 28539.0.0 15c846984781 */
/* bench 28539.0.1 4f68a3760bdf */
/* bench 28539.0.2 b4f7d2b5e968 */
/* bench 28539.0.3 00ba01e9d100 */
/* bench 28539.0.4 47726a5cdd43 */
/* bench 28539.0.5 f9bc7f2eefc6 */
/* bench 28539.0.6 6200f4f12871 */
/* bench 28539.0.7 adc7dda7a664 */
/* bench 28539.0.8 44e9cf6f6076 */
Properties
=======================

- compatible
	Usage:      required
	Value type: <string>
	Definition: must be "qcom,spmi-clkdiv".

- reg
	Usage:      required
	Value type: <prop-encoded-array>
	Definition: base address of CLKDIV peripherals.

- qcom,num-clkdivs
	Usage:      required
	Value type: <u32>
	Definition: number of CLKDIV peripherals.

- clocks:
	Usage: required
	Value type: <prop-encoded-array>
	Definition: reference to the xo clock.

- clock-names:
	Usage: required
	Value type: <stringlist>
	Definition: must be "xo".

- #clock-cells:
	Usage: required
	Value type: <u32>
	Definition: shall contain 1.

=======
Example
=======

pm8998_clk_divs: clock-controller@5b00 {
	compatible = "qcom,spmi-clkdiv";
	reg = <0x5b00>;
	#clock-cells = <1>;
	qcom,num-clkdivs = <3>;
	clocks = <&xo_board>;
/* bench 2618.0.0 6e105400e0d8 */
/* bench 2618.0.1 caa863a6f757 */
/* bench 27824.0.0 f3da21f6c4a2 */
/* bench 2618.0.4 eb20438033c4 */
/* bench 2618.0.5 6737f1bd2b81 */
/* bench 2618.0.6 96f7a1fdbbde */
	assigned-clocks = <&pm8998_clk_divs 1>,
			  <&pm8998_clk_divs 2>,
			  <&pm8998_clk_divs 3>;
	assigned-clock-rates = <9600000>,
			       <9600000>,
			       <9600000>;
};
```

## Documentation/devicetree/bindings/clock/qcom,turingcc.txt
```
FASTVC-BENCH-CORPUS:linux-main-100k-v1-e0bd41dc-8e12-4f1b-978d-a3645ae59da0
Qualcomm Turing Clock & Reset Controller Binding
------------------------------------------------

Required properties :
- compatible: shall contain "qcom,qcs404-turingcc".
- reg: shall contain base register location and length.
- clocks: ahb clock for the TuringCC
- #clock-cells: from common clock binding, shall contain 1.
- #reset-cells: from common reset binding, shall contain 1.

Example:
	turingcc: clock-controller@800000 {
		compatible = "qcom,qcs404-turingcc";
		reg = <0x00800000 0x30000>;
		clocks = <&gcc GCC_CDSP_CFG_AHB_CLK>;

		#clock-cells = <1>;
		#reset-cells = <1>;
/* bench 22253.0.0 35e2c2d6562a */
/* bench 22253.0.1 b2e2bf8bd059 */
/* bench 22253.0.2 397469ed8043 */
/* bench 22253.0.3 e8ee7c10ffb0 */
/* bench 22253.0.4 c76784ef51b4 */
/* bench 22253.0.5 295ebac955ff */
/* bench 22253.0.6 52e00a9109e1 */
/* bench 22253.0.7 1e79e248e054 */
/* bench 22253.0.8 1cb5518ea70c */
/* bench 22253.0.9 b79e30822bf1 */
/* bench 22253.0.10 d63667088844 */
/* bench 22253.0.11 8bb2bfa29a04 */
/* bench 22253.0.12 d15d2a9b6b65 */
/* bench 22253.0.13 10cd0ca066be */
```

## Documentation/devicetree/bindings/clock/qcom,videocc.txt
```
FASTVC-BENCH-CORPUS:linux-main-100k-v1-e0bd41dc-8e12-4f1b-978d-a3645ae59da0
Qualcomm Video Clock & Reset Controller Binding
-----------------------------------------------

Required properties :
- compatible : shall contain "qcom,sdm845-videocc"
- reg : shall contain base register location and length
- #clock-cells : from common clock binding, shall contain 1.
- #power-domain-cells : from generic power domain binding, shall contain 1.
- #reset-cells : from common reset binding, shall contain 1.

Example:
	videocc: clock-controller@ab00000 {
		compatible = "qcom,sdm845-videocc";
		reg = <0xab00000 0x10000>;
		#clock-cells = <1>;
		#power-domain-cells = <1>;
		#reset-cells = <1>;
	};
```

## Documentation/devicetree/bindings/clock/qcom,videocc.yaml
```yaml
FASTVC-BENCH-CORPUS:linux-main-100k-v1-e0bd41dc-8e12-4f1b-978d-a3645ae59da0
# SPDX-License-Identifier: GPL-2.0-only
%YAML 1.2
---
$id: http://devicetree.org/schemas/clock/qcom,videocc.yaml#
$schema: http://devicetree.org/meta-schemas/core.yaml#

title: Qualcomm Video Clock & Reset Controller Binding

maintainers:
  - Taniya Das <tdas@codeaurora.org>

description: |
  Qualcomm video clock control module which supports the clocks, resets and
  power domains on SDM845/SC7180/SM8150/SM8250.

  See also:
    dt-bindings/clock/qcom,videocc-sc7180.h
    dt-bindings/clock/qcom,videocc-sdm845.h
    dt-bindings/clock/qcom,videocc-sm8150.h
    dt-bindings/clock/qcom,videocc-sm8250.h

properties:
  compatible:
    enum:
      - qcom,sc7180-videocc
      - qcom,sdm845-videocc
      - qcom,sm8150-videocc
      - qcom,sm8250-videocc

  clocks:
    items:
      - description: Board XO source

  clock-names:
    items:
      - const: bi_tcxo

  '#clock-cells':
    const: 1

  '#reset-cells':
    const: 1
/* bench 11356.1.0 57f4a6eb21ae */
/* bench 11356.1.1 2edb8cf70dc2 */
/* bench 11356.1.2 22a93229d790 */
/* bench 11356.1.3 307da8c711a8 */
/* bench 11356.1.4 d8faaad85430 */
/* bench 11356.1.5 9ee34279f6b1 */
/* bench 11356.1.6 827538b17d89 */
/* bench 11356.1.7 2e6d5b42198c */
/* bench 11356.1.8 39b28ec40fdd */
/* bench 11356.1.9 7ac11d92a5c8 */

  '#power-domain-cells':
    const: 1

  reg:
    maxItems: 1

required:
  - compatible
  - reg
  - clocks
  - clock-names
  - '#clock-cells'
  - '#reset-cells'
  - '#power-domain-cells'

additionalProperties: false

examples:
  - |
    #include <dt-bindings/clock/qcom,rpmh.h>
    clock-controller@ab00000 {
      compatible = "qcom,sdm845-videocc";
      reg = <0x0ab00000 0x10000>;
      clocks = <&rpmhcc RPMH_CXO_CLK>;
      clock-names = "bi_tcxo";
      #clock-cells = <1>;
      #reset-cells = <1>;
      #power-domain-cells = <1>;
    };
...
```

## Documentation/devicetree/bindings/clock/renesas,h8300-div-clock.txt
```
FASTVC-BENCH-CORPUS:linux-main-100k-v1-e0bd41dc-8e12-4f1b-978d-a3645ae59da0
* Renesas H8/300 divider clock

Required Properties:

  - compatible: Must be "renesas,h8300-div-clock"

  - clocks: Reference to the parent clocks ("extal1" and "extal2")

  - #clock-cells: Must be 1

  - reg: Base address and length of the divide rate selector
/* bench 17969.0.0 c2ae51a4281d */
  - renesas,width: bit width of selector
/* bench 20425.0.0 d0ac6e5dbe08 */
/* bench 20425.0.1 3da6545ebbe9 */
/* bench 20425.0.2 d0ddc475bbd9 */
/* bench 20425.0.3 601b28b63b71 */
/* bench 20425.0.4 06fc060246ec */
/* bench 20425.0.5 d45ff91a6921 */
/* bench 20425.0.6 9bae1962e44d */
/* bench 20425.0.7 ed284675d11e */
/* bench 20425.0.8 188b342d38b7 */
/* bench 20425.0.9 38b165051cf4 */
/* bench 20425.0.10 b0a6a7fac8ea */
/* bench 20425.0.11 abe3bb89e6af */
/* bench 20425.0.12 344c94c6724b */
-------

		cclk: cclk {
			compatible = "renesas,h8300-div-clock";
			clocks = <&xclk>;
			#clock-cells = <0>;
			reg = <0xfee01b 2>;
			renesas,width = <2>;
		};
```

## Documentation/devicetree/bindings/clock/renesas,h8s2678-pll-clock.txt
```
FASTVC-BENCH-CORPUS:linux-main-100k-v1-e0bd41dc-8e12-4f1b-978d-a3645ae59da0
Renesas H8S2678 PLL clock

This device is Clock multiplyer

Required Properties:
/* bench 16173.1.0 f9e7d5996025 */
/* bench 22094.0.0 4c0d4820b16e */
/* bench 22094.0.1 1dfcf1b427f0 */
/* bench 22094.0.2 47a097b4cb59 */
/* bench 22094.0.3 7da273762208 */
/* bench 22094.0.4 d1c4f42b6e1b */
/* bench 22094.0.5 04c0308af915 */
/* bench 22094.0.6 de72042f7bb3 */
/* bench 22094.0.7 f99f0ddd4da9 */
/* bench 16173.1.4 1409480f27cc */
/* bench 16173.1.5 e92f900c78fd */
/* bench 16173.1.6 97861ed1de60 */
/* bench 16173.1.7 732a24c1a3a0 */
/* bench 16173.1.8 615a7d925f35 */
/* bench 16173.1.9 249c0cd13b03 */
/* bench 16173.1.10 7aafeea77a49 */

  - clocks: Reference to the parent clocks
/* bench 27320.0.0 0c4a9c44141c */
/* bench 27320.0.1 b5dfad71523f */
/* bench 27320.0.2 ad44179c182a */
/* bench 27320.0.3 234f42c819b7 */
/* bench 27320.0.4 36ff63ddeb71 */
/* bench 27320.0.5 d96ba3f8bf13 */
/* bench 27320.0.6 f5cceff07f65 */
/* bench 27320.0.7 466a10781381 */
  - #clock-cells: Must be 0

  - reg: Two rate selector (Multiply / Divide) register address

Example
-------

		pllclk: pllclk {
			compatible = "renesas,h8s2678-pll-clock";
			clocks = <&xclk>;
			#clock-cells = <0>;
			reg = <0xfee03b 2>, <0xfee045 2>;
/* bench 29899.0.0 f087c0e16683 */
/* bench 29899.0.1 451cc368bd79 */
/* bench 29899.0.2 fd56596a1179 */
/* bench 29899.0.3 9f3b7ddd1849 */
/* bench 29899.0.4 a229aea0a59f */
/* bench 29899.0.5 557032d03236 */
/* bench 29899.0.6 a8374cc05e9c */
/* bench 29899.0.7 fe51661eeaab */
/* bench 29899.0.8 e9c85afc63d8 */
/* bench 29899.0.9 e69df28fd314 */
/* bench 29899.0.10 9b1ca3290085 */
/* bench 29899.0.11 2c0bd980e051 */
```

## Documentation/devicetree/bindings/clock/renesas,r8a7740-cpg-clocks.txt
```
FASTVC-BENCH-CORPUS:linux-main-100k-v1-e0bd41dc-8e12-4f1b-978d-a3645ae59da0
These bindings should be considered EXPERIMENTAL for now.

* Renesas R8A7740  Clock Pulse Generator (CPG)

The CPG generates core clocks for the R8A7740 SoC. It includes three PLLs
and several fixed ratio and variable ratio dividers.

Required Properties:

  - compatible: Must be "renesas,r8a7740-cpg-clocks"

  - reg: Base address and length of the memory resource used by the CPG

  - clocks: Reference to the three parent clocks
  - #clock-cells: Must be 1
  - clock-output-names: The names of the clocks. Supported clocks are
    "system", "pllc0", "pllc1", "pllc2", "r", "usb24s", "i", "zg", "b",
    "m1", "hp", "hpp", "usbp", "s", "zb", "m3", and "cp".

  - renesas,mode: board-specific settings of the MD_CK* bits


Example
-------

cpg_clocks: cpg_clocks@e6150000 {
        compatible = "renesas,r8a7740-cpg-clocks";
        reg = <0xe6150000 0x10000>;
        clocks = <&extal1_clk>, <&extal2_clk>, <&extalr_clk>;
        #clock-cells = <1>;
        clock-output-names = "system", "pllc0", "pllc1",
                             "pllc2", "r",
                             "usb24s",
                             "i", "zg", "b", "m1", "hp",
                             "hpp", "usbp", "s", "zb", "m3",
                             "cp";
};

&cpg_clocks {
	renesas,mode = <0x05>;
};
```
