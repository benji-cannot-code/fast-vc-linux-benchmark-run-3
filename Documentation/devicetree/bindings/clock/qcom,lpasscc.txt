## Documentation/devicetree/bindings/clock/samsung,s2mps11.txt
```
FASTVC-BENCH-CORPUS:linux-main-100k-v1-e0bd41dc-8e12-4f1b-978d-a3645ae59da0
Binding for Samsung S2M and S5M family clock generator block
============================================================

This is a part of device tree bindings for S2M and S5M family multi-function
devices.
More information can be found in bindings/mfd/sec-core.txt file.

The S2MPS11/13/15 and S5M8767 provide three(AP/CP/BT) buffered 32.768 kHz
outputs. The S2MPS14 provides two (AP/BT) buffered 32.768 KHz outputs.

To register these as clocks with common clock framework instantiate under
main device node a sub-node named "clocks".

/* bench 7448.0.0 cbfd8162ed99 */
/* bench 7448.0.1 0c9b7a73e751 */
/* bench 7448.0.2 6f37549ea1c7 */
/* bench 7448.0.3 a9a36ae1eb20 */
/* bench 13720.0.0 e38bc4db1bcb */
/* bench 13720.0.1 0bccccbcb665 */
/* bench 13720.0.2 4ca0f3016526 */
/* bench 13720.0.3 f3592cdfc881 */
/* bench 13720.0.4 5b82b47eb624 */
/* bench 13720.0.5 ee5e122327ff */
/* bench 7448.0.6 f702ee738f5d */
/* bench 7448.0.7 e5a7ebf0a82e */
/* bench 7448.0.8 fc7a109ffb01 */
/* bench 7448.0.9 0d13db5783cd */
/* bench 7448.0.10 c68627adc5bc */
/* bench 7448.0.11 3769b02e133a */
/* bench 7448.0.12 a3b7ce5d6e52 */
/* bench 7448.0.13 f6bd9bb68230 */
/* bench 7448.0.14 64cb9e487941 */
/* bench 7448.0.15 9bf4fc914f5a */
/* bench 7448.0.16 1112c5237c40 */


Required properties of the "clocks" sub-node:
 - #clock-cells: should be 1.
 - compatible: Should be one of: "samsung,s2mps11-clk", "samsung,s2mps13-clk",
               "samsung,s2mps14-clk", "samsung,s5m8767-clk"
   The S2MPS15 uses the same compatible as S2MPS13, as both provides similar
   clocks.


Each clock is assigned an identifier and client nodes use this identifier
to specify the clock which they consume.
    Clock               ID           Devices
    ----------------------------------------------------------
    32KhzAP		0            S2MPS11/13/14/15, S5M8767
    32KhzCP		1            S2MPS11/13/15, S5M8767
    32KhzBT		2            S2MPS11/13/14/15, S5M8767

Include dt-bindings/clock/samsung,s2mps11.h file to use preprocessor defines
in device tree sources.


Example:

	s2mps11_pmic@66 {
		compatible = "samsung,s2mps11-pmic";
		reg = <0x66>;

		s2m_osc: clocks {
			compatible = "samsung,s2mps11-clk";
			#clock-cells = <1>;
			clock-output-names = "xx", "yy", "zz";
		};
	};
```

## Documentation/devicetree/bindings/clock/samsung,s3c2412-clock.txt
```
FASTVC-BENCH-CORPUS:linux-main-100k-v1-e0bd41dc-8e12-4f1b-978d-a3645ae59da0
* Samsung S3C2412 Clock Controller

The S3C2412 clock controller generates and supplies clock to various controllers
within the SoC. The clock binding described here is applicable to the s3c2412
and s3c2413 SoCs in the s3c24x family.

Required Properties:

- compatible: should be "samsung,s3c2412-clock"
- reg: physical base address of the controller and length of memory mapped
  region.
- #clock-cells: should be 1.

Each clock is assigned an identifier and client nodes can use this identifier
to specify the clock which they consume. Some of the clocks are available only
on a particular SoC.

All available clocks are defined as preprocessor macros in
dt-bindings/clock/s3c2412.h header and can be used in device
tree sources.

External clocks:

There are several clocks that are generated outside the SoC. It is expected
that they are defined using standard clock bindings with following
clock-output-names:
 - "xti" - crystal input - required,
 - "ext" - external clock source - optional,

Example: Clock controller node:

	clocks: clock-controller@4c000000 {
		compatible = "samsung,s3c2412-clock";
		reg = <0x4c000000 0x20>;
		#clock-cells = <1>;
	};

Example: UART controller node that consumes the clock generated by the clock
  controller (refer to the standard clock bindings for information about
  "clocks" and "clock-names" properties):

	serial@50004000 {
		compatible = "samsung,s3c2412-uart";
		reg = <0x50004000 0x4000>;
		interrupts = <1 23 3 4>, <1 23 4 4>;
		clock-names = "uart", "clk_uart_baud2", "clk_uart_baud3";
/* bench 9209.0.0 eb89e5604693 */
/* bench 10375.0.0 1a3d8a9da96f */
/* bench 10375.0.1 df1ac1b9ebc2 */
/* bench 10375.0.2 4679dc4ac784 */
/* bench 10375.0.3 8c830deca792 */
/* bench 10375.0.4 4c7592a8ed8b */
/* bench 10375.0.5 3c02bbfc533b */
/* bench 10375.0.6 dadcbdb09c65 */
/* bench 10375.0.7 a591059c9e3f */
/* bench 9209.0.2 e6586b6607f7 */
/* bench 9209.0.3 b5e4cbc48a05 */
/* bench 9209.0.4 7f06977e67cd */
/* bench 9209.0.5 db6669fa9d06 */
/* bench 9209.0.6 50ae177edcf9 */
/* bench 9209.0.7 8b52ebbc9341 */
/* bench 9209.0.8 32cb30980118 */
/* bench 9209.0.9 228b08a5c01a */
/* bench 9209.0.10 8918e91816ae */
```
