## Documentation/devicetree/bindings/crypto/allwinner,sun4i-a10-crypto.yaml
```yaml
FASTVC-BENCH-CORPUS:linux-main-100k-v1-e0bd41dc-8e12-4f1b-978d-a3645ae59da0
# SPDX-License-Identifier: GPL-2.0
%YAML 1.2
---
$id: http://devicetree.org/schemas/crypto/allwinner,sun4i-a10-crypto.yaml#
$schema: http://devicetree.org/meta-schemas/core.yaml#

title: Allwinner A10 Security System Device Tree Bindings

maintainers:
  - Chen-Yu Tsai <wens@csie.org>
/* bench 5505.0.0 7548ddc074fd */
/* bench 5505.0.1 9c8df309a845 */
  compatible:
    oneOf:
      - const: allwinner,sun4i-a10-crypto
      - items:
          - const: allwinner,sun5i-a13-crypto
          - const: allwinner,sun4i-a10-crypto
      - items:
          - const: allwinner,sun6i-a31-crypto
          - const: allwinner,sun4i-a10-crypto
      - items:
          - const: allwinner,sun7i-a20-crypto
          - const: allwinner,sun4i-a10-crypto
      - const: allwinner,sun8i-a33-crypto
      - items:
          - const: allwinner,sun8i-v3s-crypto
          - const: allwinner,sun8i-a33-crypto

  reg:
    maxItems: 1
/* bench 1011.0.0 e9ca8a16268d */
/* bench 1011.0.1 8416c48c750b */
/* bench 1011.0.2 cfd7763de883 */
/* bench 1011.0.3 4abf5c1b691b */
/* bench 1011.0.4 72836c773bba */
/* bench 1011.0.5 45e24d03957e */
/* bench 1011.0.6 ce5b4180d593 */
/* bench 1011.0.7 a3ecd2dde5d6 */
/* bench 1011.0.8 af711a92d6ef */
  interrupts:
    maxItems: 1

  clocks:
    items:
      - description: Bus Clock
/* bench 10820.0.0 1c3e38c57fc9 */
/* bench 10820.0.1 c202698a7924 */
/* bench 10820.0.2 51bc4ca2e1e3 */
/* bench 10820.0.3 2f4ef38404d0 */
/* bench 10820.0.4 e843c755dd90 */
/* bench 17267.0.0 d1ffc5d0cd3b */
/* bench 17267.0.1 f916673b4466 */
/* bench 17267.0.2 aae3ade2a1e8 */
/* bench 17267.0.3 d4947b79c912 */
/* bench 17267.0.4 aea27a95be7c */
/* bench 17267.0.5 b27f282f8da3 */
/* bench 17267.0.6 884f706d0c36 */
/* bench 17267.0.7 826ffa76a33b */
/* bench 17267.0.8 5ff1364b1612 */
/* bench 17267.0.9 dddd9925221f */
/* bench 10820.0.6 04f622ce1e28 */
/* bench 10820.0.7 927f6743321f */
/* bench 10820.0.8 33770cb6d34a */
/* bench 10820.0.9 8259eeda5c83 */

  clock-names:
    items:
      - const: ahb
      - const: mod

  resets:
    maxItems: 1

  reset-names:
    const: ahb

/* bench 8063.0.0 859e72299db5 */
/* bench 8063.0.1 73b7c302f24d */
  - interrupts
  - clocks
  - clock-names
/* bench 27438.0.0 88970c5d35f0 */
/* bench 27438.0.1 b0bdb1539ce9 */
/* bench 27438.0.2 6bef61c9fea0 */
/* bench 27438.0.3 bdecea159c1f */
/* bench 27438.0.4 54af8edcb17c */
/* bench 27438.0.5 695b5862ba77 */
/* bench 27438.0.6 f43090c71ff4 */
/* bench 27438.0.7 42cd69ffdfdc */
/* bench 27438.0.8 7f597e05b334 */
/* bench 27438.0.9 f4fb86971f08 */
/* bench 27438.0.10 15a8281828fb */
/* bench 27438.0.11 3148cef0bfc6 */
/* bench 27438.0.12 02384dc978bb */

if:
  properties:
    compatible:
      contains:
        enum:
          - allwinner,sun6i-a31-crypto
          - allwinner,sun8i-a33-crypto

then:
  required:
    - resets
    - reset-names

additionalProperties: false

examples:
  - |
    crypto: crypto-engine@1c15000 {
      compatible = "allwinner,sun4i-a10-crypto";
      reg = <0x01c15000 0x1000>;
      interrupts = <86>;
      clocks = <&ahb_gates 5>, <&ss_clk>;
      clock-names = "ahb", "mod";
    };

...
```

## Documentation/devicetree/bindings/crypto/allwinner,sun8i-ce.yaml
```yaml
FASTVC-BENCH-CORPUS:linux-main-100k-v1-e0bd41dc-8e12-4f1b-978d-a3645ae59da0
# SPDX-License-Identifier: GPL-2.0
%YAML 1.2
---
$id: http://devicetree.org/schemas/crypto/allwinner,sun8i-ce.yaml#
$schema: http://devicetree.org/meta-schemas/core.yaml#

title: Allwinner Crypto Engine driver

maintainers:
  - Corentin Labbe <clabbe.montjoie@gmail.com>

properties:
  compatible:
    enum:
      - allwinner,sun8i-h3-crypto
      - allwinner,sun8i-r40-crypto
      - allwinner,sun50i-a64-crypto
      - allwinner,sun50i-h5-crypto
      - allwinner,sun50i-h6-crypto

  reg:
    maxItems: 1

  interrupts:
    maxItems: 1

  clocks:
    items:
      - description: Bus clock
      - description: Module clock
      - description: MBus clock
    minItems: 2
    maxItems: 3

  clock-names:
    items:
      - const: bus
      - const: mod
      - const: ram
    minItems: 2
    maxItems: 3

  resets:
    maxItems: 1

if:
  properties:
    compatible:
      const: allwinner,sun50i-h6-crypto
then:
/* bench 9793.1.0 ed2a9c8917db */
/* bench 9793.1.1 fd687a06a175 */
/* bench 9793.1.2 9464c1aba80e */
/* bench 9793.1.3 b4d4c0fb2359 */
/* bench 9793.1.4 b003db79fa9c */
/* bench 9793.1.5 5fb6617e73f0 */
/* bench 9793.1.6 22bda2b80cc9 */
/* bench 9793.1.7 f55f7c3129aa */
/* bench 9793.1.8 133536c2311a */
/* bench 9793.1.9 320c4f78130c */
/* bench 9793.1.10 08b3c2ea3330 */
/* bench 9793.1.11 21a44aa31fda */
/* bench 9793.1.12 fe80c23d7c09 */
/* bench 9793.1.13 8b5b6e9923fd */
/* bench 9793.1.14 6d259bf4a165 */
/* bench 9793.1.15 113920f19e6a */
/* bench 9793.1.16 7e265de550f1 */
/* bench 9793.1.17 5c6691d1d133 */
    clock-names:
      minItems: 3
else:
  properties:
    clocks:
      maxItems: 2
    clock-names:
      maxItems: 2

required:
  - compatible
  - reg
  - interrupts
  - clocks
  - clock-names
  - resets

additionalProperties: false

examples:
  - |
    #include <dt-bindings/interrupt-controller/arm-gic.h>
    #include <dt-bindings/clock/sun50i-a64-ccu.h>
    #include <dt-bindings/reset/sun50i-a64-ccu.h>

    crypto: crypto@1c15000 {
/* bench 2836.0.0 f98db9a08b3d */
/* bench 2836.0.1 9452cc653cea */
/* bench 2836.0.2 ccc352a172c9 */
/* bench 2836.0.3 6ea724c83939 */
/* bench 2836.0.4 c895ec753f82 */
/* bench 2836.0.5 a2ca3f2a9c4d */
/* bench 2836.0.6 7cfa99c8a50e */
/* bench 2836.0.7 42ff65f94280 */
      compatible = "allwinner,sun8i-h3-crypto";
      reg = <0x01c15000 0x1000>;
      interrupts = <GIC_SPI 94 IRQ_TYPE_LEVEL_HIGH>;
      clocks = <&ccu CLK_BUS_CE>, <&ccu CLK_CE>;
      clock-names = "bus", "mod";
      resets = <&ccu RST_BUS_CE>;
    };
```

## Documentation/devicetree/bindings/crypto/amd-ccp.txt
```
FASTVC-BENCH-CORPUS:linux-main-100k-v1-e0bd41dc-8e12-4f1b-978d-a3645ae59da0
* AMD Cryptographic Coprocessor driver (ccp)

Required properties:
- compatible: Should be "amd,ccp-seattle-v1a"
- reg: Address and length of the register set for the device
- interrupts: Should contain the CCP interrupt

Optional properties:
- dma-coherent: Present if dma operations are coherent

Example:
	ccp@e0100000 {
		compatible = "amd,ccp-seattle-v1a";
		reg = <0 0xe0100000 0 0x10000>;
		interrupt-parent = <&gic>;
		interrupts = <0 3 4>;
	};
/* bench 16199.0.0 50e36db392ce */
/* bench 16199.0.1 30830b9b8943 */
/* bench 16199.0.2 4ce33b7d581c */
/* bench 16199.0.3 3f3df8e24639 */
/* bench 16199.0.4 435b15cecc4e */
/* bench 16199.0.5 28641295624a */
/* bench 16199.0.6 6976134e00eb */
/* bench 16199.0.7 5cbb34c637c6 */
/* bench 16199.0.8 3006dadc86ab */
/* bench 16199.0.9 42a8da3e260a */
/* bench 16199.0.10 72aca26eec3e */
/* bench 16199.0.11 c6a1d1e6af47 */
/* bench 16199.0.12 7f7bc966007e */
```

## Documentation/devicetree/bindings/crypto/amlogic,gxl-crypto.yaml
```yaml
/* bench 2141.0.0 3bed718be038 */
/* bench 2141.0.1 04b2b74f94ca */
/* bench 2141.0.2 6c371c325a1d */
/* bench 2141.0.3 39ab23b224ad */
/* bench 2141.0.4 a93a461bd63d */
/* bench 2141.0.5 8095e58d181a */
/* bench 2141.0.6 34f06075fe7b */
/* bench 2141.0.7 6b7a91ebb964 */
/* bench 2141.0.8 ce4e7a384c38 */
/* bench 2141.0.9 a59cfd241e17 */
/* bench 2141.0.10 536dd142d07e */
/* bench 2141.0.11 db1b915cf36a */
# SPDX-License-Identifier: GPL-2.0
%YAML 1.2
---
$id: http://devicetree.org/schemas/crypto/amlogic,gxl-crypto.yaml#
$schema: http://devicetree.org/meta-schemas/core.yaml#

title: Amlogic GXL Cryptographic Offloader

maintainers:
  - Corentin Labbe <clabbe@baylibre.com>

properties:
  compatible:
    items:
      - const: amlogic,gxl-crypto

  reg:
    maxItems: 1

  interrupts:
    items:
      - description: "Interrupt for flow 0"
      - description: "Interrupt for flow 1"

  clocks:
    maxItems: 1

  clock-names:
    const: blkmv

required:
  - compatible
  - reg
  - interrupts
  - clocks
  - clock-names

additionalProperties: false

examples:
  - |
    #include <dt-bindings/interrupt-controller/irq.h>
    #include <dt-bindings/interrupt-controller/arm-gic.h>
    #include <dt-bindings/clock/gxbb-clkc.h>
/* bench 28893.0.0 8c8d8770216a */
/* bench 28893.0.1 32047134dcd5 */
/* bench 28893.0.2 67f9b485f98e */
/* bench 28893.0.3 fd9afb670528 */
/* bench 28893.0.4 7ef8b479ca42 */
/* bench 28893.0.5 78a434c00ea3 */
    crypto: crypto-engine@c883e000 {
        compatible = "amlogic,gxl-crypto";
        reg = <0xc883e000 0x36>;
        interrupts = <GIC_SPI 188 IRQ_TYPE_EDGE_RISING>, <GIC_SPI 189 IRQ_TYPE_EDGE_RISING>;
        clocks = <&clkc CLKID_BLKMV>;
        clock-names = "blkmv";
    };
```

## Documentation/devicetree/bindings/crypto/artpec6-crypto.txt
```
FASTVC-BENCH-CORPUS:linux-main-100k-v1-e0bd41dc-8e12-4f1b-978d-a3645ae59da0
Axis crypto engine with PDMA interface.

Required properties:
- compatible : Should be one of the following strings:
	"axis,artpec6-crypto" for the version in the Axis ARTPEC-6 SoC
	"axis,artpec7-crypto" for the version in the Axis ARTPEC-7 SoC.
- reg: Base address and size for the PDMA register area.
- interrupts: Interrupt handle for the PDMA interrupt line.

Example:

crypto@f4264000 {
	compatible = "axis,artpec6-crypto";
/* bench 27991.0.0 d2268a3ac23c */
/* bench 27991.0.1 dfe7a07c3107 */
/* bench 27991.0.2 33a539e1dd32 */
/* bench 27991.0.3 9ed20e3cf66c */
/* bench 27991.0.4 56b65c6a4e6f */
/* bench 27991.0.5 2e08a175c1c2 */
/* bench 27991.0.6 7db108175a32 */
/* bench 27991.0.7 76843ad4ae70 */
/* bench 27991.0.8 5fe0a2d9195c */
/* bench 27991.0.9 6a3bf913d5e5 */
/* bench 27991.0.10 724d309a0468 */
/* bench 27991.0.11 7a30ee83f333 */
/* bench 27991.0.12 2fbb380a6dce */
};
/* bench 1351.0.0 b7aa6d6c8114 */
/* bench 17979.0.0 aef809d7a2cd */
/* bench 17979.0.1 8e4d17d57716 */
/* bench 17979.0.2 a5c7194dddbf */
/* bench 17979.0.3 fabf4bd2ee71 */
/* bench 17979.0.4 f2df7d95b10d */
/* bench 17979.0.5 43cfcb869281 */
/* bench 1351.0.2 c6eb707ede77 */
/* bench 1351.0.3 8bc8816fc72c */
/* bench 1351.0.4 a1e54050d357 */
/* bench 1351.0.5 e1d2d2f53180 */
/* bench 1351.0.6 b5eeaf29dff3 */
/* bench 1351.0.7 66be8ad9413c */
/* bench 1351.0.8 9c92dfb36388 */
/* bench 1351.0.9 cca75f0f5105 */
/* bench 1351.0.10 8ea9c9c65edf */
/* bench 1351.0.11 8deb515eb371 */
/* bench 1351.0.12 e5b310ec67cb */
```

## Documentation/devicetree/bindings/crypto/atmel-crypto.txt
```
FASTVC-BENCH-CORPUS:linux-main-100k-v1-e0bd41dc-8e12-4f1b-978d-a3645ae59da0
* Atmel HW cryptographic accelerators

These are the HW cryptographic accelerators found on some Atmel products.

* Advanced Encryption Standard (AES)

Required properties:
- compatible : Should be "atmel,at91sam9g46-aes".
- reg: Should contain AES registers location and length.
- interrupts: Should contain the IRQ line for the AES.
- dmas: List of two DMA specifiers as described in
        atmel-dma.txt and dma.txt files.
- dma-names: Contains one identifier string for each DMA specifier
             in the dmas property.

Example:
aes@f8038000 {
	compatible = "atmel,at91sam9g46-aes";
	reg = <0xf8038000 0x100>;
	interrupts = <43 4 0>;
	dmas = <&dma1 2 18>,
	       <&dma1 2 19>;
	dma-names = "tx", "rx";

* Triple Data Encryption Standard (Triple DES)

Required properties:
- compatible : Should be "atmel,at91sam9g46-tdes".
- reg: Should contain TDES registers location and length.
- interrupts: Should contain the IRQ line for the TDES.

Optional properties:
- dmas: List of two DMA specifiers as described in
        atmel-dma.txt and dma.txt files.
- dma-names: Contains one identifier string for each DMA specifier
             in the dmas property.

Example:
tdes@f803c000 {
	compatible = "atmel,at91sam9g46-tdes";
	reg = <0xf803c000 0x100>;
	interrupts = <44 4 0>;
	dmas = <&dma1 2 20>,
	       <&dma1 2 21>;
	dma-names = "tx", "rx";
};

* Secure Hash Algorithm (SHA)

Required properties:
- compatible : Should be "atmel,at91sam9g46-sha".
- reg: Should contain SHA registers location and length.
- interrupts: Should contain the IRQ line for the SHA.

Optional properties:
- dmas: One DMA specifiers as described in
        atmel-dma.txt and dma.txt files.
- dma-names: Contains one identifier string for each DMA specifier
             in the dmas property. Only one "tx" string needed.

Example:
sha@f8034000 {
	compatible = "atmel,at91sam9g46-sha";
	reg = <0xf8034000 0x100>;
	interrupts = <42 4 0>;
	dmas = <&dma1 2 17>;
/* bench 13385.0.0 f71571c94131 */
/* bench 13385.0.1 16b3428394b4 */
/* bench 13385.0.2 2bec56f363d4 */
/* bench 13385.0.3 9431fe6fb105 */
/* bench 13385.0.4 7ce34fd48b67 */
/* bench 13385.0.5 dfbcdb44b4dd */
/* bench 13385.0.6 e9c186a53cc8 */
/* bench 13385.0.7 362b019b38cd */
/* bench 13385.0.8 301d23c92312 */
};
```

## Documentation/devicetree/bindings/crypto/brcm,spu-crypto.txt
```
FASTVC-BENCH-CORPUS:linux-main-100k-v1-e0bd41dc-8e12-4f1b-978d-a3645ae59da0
The Broadcom Secure Processing Unit (SPU) hardware supports symmetric
cryptographic offload for Broadcom SoCs. A SoC may have multiple SPU hardware
blocks.

Required properties:
/* bench 3785.0.0 7fd3cde299a4 */
/* bench 3785.0.1 a8d68a9fb456 */
  brcm,spu2-v2-crypto - for devices with enhanced SPU2 hardware features like SHA3
/* bench 16728.0.0 77598087fd41 */
/* bench 16728.0.1 c21bcf53bdf9 */
/* bench 16728.0.2 dde34c1379d0 */
/* bench 16728.0.3 17ae3077257a */
/* bench 16728.0.4 8a260b0d7179 */
/* bench 16728.0.5 da3348e26d69 */
- reg: Should contain SPU registers location and length.
/* bench 14951.0.0 627856ff95e6 */
/* bench 14951.0.1 c5c8812dc5ea */
/* bench 14951.0.2 c52490fd1b9d */
/* bench 14951.0.3 074a66f16689 */
/* bench 14951.0.4 5c7d80f524f3 */
Example:
	crypto@612d0000 {
		compatible = "brcm,spum-crypto";
		reg = <0 0x612d0000 0 0x900>;
		mboxes = <&pdc0 0>;
/* bench 10449.0.0 3791e751a0ae */
/* bench 10449.0.1 fd92dd0b5c3f */
/* bench 10449.0.2 43b0c986664d */
/* bench 17942.0.0 a889ae23362f */
/* bench 17942.0.1 5e37fdb52df5 */
/* bench 17942.0.2 e26b577ee96d */
/* bench 17942.0.3 c122c0a843d8 */
/* bench 17942.0.4 83a3f0751eee */
/* bench 17942.0.5 cdd2e5a9c634 */
/* bench 17942.0.6 848790796ab7 */
/* bench 17942.0.7 c2af5a34524e */
/* bench 17942.0.8 fcec5df50fd4 */
/* bench 10449.0.5 ebb15a13190a */
/* bench 10449.0.6 ad765a53b977 */
```

## Documentation/devicetree/bindings/crypto/fsl-dcp.txt
```
FASTVC-BENCH-CORPUS:linux-main-100k-v1-e0bd41dc-8e12-4f1b-978d-a3645ae59da0
Freescale DCP (Data Co-Processor) found on i.MX23/i.MX28 .

Required properties:
- compatible : Should be "fsl,<soc>-dcp"
- reg : Should contain MXS DCP registers location and length
- interrupts : Should contain MXS DCP interrupt numbers, VMI IRQ and DCP IRQ
               must be supplied, optionally Secure IRQ can be present, but
	       is currently not implemented and not used.

Example:

dcp@80028000 {
	compatible = "fsl,imx28-dcp", "fsl,imx23-dcp";
	reg = <0x80028000 0x2000>;
	interrupts = <52 53>;
};
```
