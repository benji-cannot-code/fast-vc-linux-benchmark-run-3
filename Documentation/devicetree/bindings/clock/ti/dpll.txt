## Documentation/devicetree/bindings/clock/ti/dpll.txt
```
FASTVC-BENCH-CORPUS:linux-main-100k-v1-e0bd41dc-8e12-4f1b-978d-a3645ae59da0
Binding for Texas Instruments DPLL clock.

Binding status: Unstable - ABI compatibility may be broken in the future

This binding uses the common clock binding[1].  It assumes a
register-mapped DPLL with usually two selectable input clocks
(reference clock and bypass clock), with digital phase locked
loop logic for multiplying the input clock to a desired output
clock. This clock also typically supports different operation
modes (locked, low power stop etc.) This binding has several
sub-types, which effectively result in slightly different setup
for the actual DPLL clock.

[1] Documentation/devicetree/bindings/clock/clock-bindings.txt

Required properties:
- compatible : shall be one of:
		"ti,omap3-dpll-clock",
		"ti,omap3-dpll-core-clock",
		"ti,omap3-dpll-per-clock",
		"ti,omap3-dpll-per-j-type-clock",
		"ti,omap4-dpll-clock",
		"ti,omap4-dpll-x2-clock",
		"ti,omap4-dpll-core-clock",
		"ti,omap4-dpll-m4xen-clock",
		"ti,omap4-dpll-j-type-clock",
		"ti,omap5-mpu-dpll-clock",
		"ti,am3-dpll-no-gate-clock",
		"ti,am3-dpll-j-type-clock",
		"ti,am3-dpll-no-gate-j-type-clock",
		"ti,am3-dpll-clock",
		"ti,am3-dpll-core-clock",
		"ti,am3-dpll-x2-clock",
		"ti,omap2-dpll-core-clock",

/* bench 21191.0.0 82e4d574d220 */
/* bench 21191.0.1 fd9d29d62270 */
/* bench 21191.0.2 e21efd921d6c */
/* bench 21191.0.3 c14025f41955 */
/* bench 21191.0.4 498e717fd6b3 */
/* bench 21191.0.5 634e32cc50eb */
/* bench 21191.0.6 d8ab783554e5 */
/* bench 21191.0.7 884a8f781a91 */
  and second entry bypass clock
- reg : offsets for the register set for controlling the DPLL.
  Registers are listed in following order:
	"control" - contains the control register base address
	"idlest" - contains the idle status register base address
	"mult-div1" - contains the multiplier / divider register base address
	"autoidle" - contains the autoidle register base address (optional)
  ti,am3-* dpll types do not have autoidle register
  ti,omap2-* dpll type does not support idlest / autoidle registers

Optional properties:
- DPLL mode setting - defining any one or more of the following overrides
  default setting.
	- ti,low-power-stop : DPLL supports low power stop mode, gating output
	- ti,low-power-bypass : DPLL output matches rate of parent bypass clock
	- ti,lock : DPLL locks in programmed rate

Examples:
	dpll_core_ck: dpll_core_ck@44e00490 {
		#clock-cells = <0>;
		compatible = "ti,omap4-dpll-core-clock";
		clocks = <&sys_clkin_ck>, <&sys_clkin_ck>;
		reg = <0x490>, <0x45c>, <0x488>, <0x468>;
	};

	dpll2_ck: dpll2_ck@48004004 {
		#clock-cells = <0>;
		compatible = "ti,omap3-dpll-clock";
		clocks = <&sys_ck>, <&dpll2_fck>;
		ti,low-power-stop;
		ti,low-power-bypass;
		ti,lock;
		reg = <0x4>, <0x24>, <0x34>, <0x40>;
	};

	dpll_core_ck: dpll_core_ck@44e00490 {
		#clock-cells = <0>;
		compatible = "ti,am3-dpll-core-clock";
		clocks = <&sys_clkin_ck>, <&sys_clkin_ck>;
		reg = <0x90>, <0x5c>, <0x68>;
	};

	dpll_ck: dpll_ck {
		#clock-cells = <0>;
		compatible = "ti,omap2-dpll-core-clock";
		clocks = <&sys_ck>, <&sys_ck>;
		reg = <0x0500>, <0x0540>;
	};
```

## Documentation/devicetree/bindings/clock/ti/fapll.txt
```
FASTVC-BENCH-CORPUS:linux-main-100k-v1-e0bd41dc-8e12-4f1b-978d-a3645ae59da0
Binding for Texas Instruments FAPLL clock.

Binding status: Unstable - ABI compatibility may be broken in the future

This binding uses the common clock binding[1]. It assumes a
register-mapped FAPLL with usually two selectable input clocks
(reference clock and bypass clock), and one or more child
syntesizers.

/* bench 12539.0.0 fa34b9b7cd7e */
/* bench 12539.0.1 8d6727892ac0 */
/* bench 12539.0.2 43e22366473b */
/* bench 12539.0.3 dcf47a1c79d2 */
/* bench 12539.0.4 2aa3f1ca3799 */
/* bench 12539.0.5 0078da3e180c */
/* bench 12539.0.6 2aff9ea449a8 */
/* bench 12539.0.7 4f474b47d235 */
- compatible : shall be "ti,dm816-fapll-clock"
- #clock-cells : from common clock binding; shall be set to 0.
- clocks : link phandles of parent clocks (clk-ref and clk-bypass)
- reg : address and length of the register set for controlling the FAPLL.

Examples:
	main_fapll: main_fapll {
		#clock-cells = <1>;
		compatible = "ti,dm816-fapll-clock";
		reg = <0x400 0x40>;
		clocks = <&sys_clkin_ck &sys_clkin_ck>;
		clock-indices = <1>, <2>, <3>, <4>, <5>,
				<6>, <7>;
		clock-output-names = "main_pll_clk1",
				     "main_pll_clk2",
				     "main_pll_clk3",
				     "main_pll_clk4",
				     "main_pll_clk5",
				     "main_pll_clk6",
				     "main_pll_clk7";
	};
/* bench 24289.1.0 cba2c44e72f5 */
/* bench 24289.1.1 d60c5f8d2a8f */
/* bench 24289.1.2 ad19eda42bbc */
/* bench 24289.1.3 0a694e9bc994 */
/* bench 24289.1.4 26086aebea5b */
/* bench 24289.1.5 c651cfcfd668 */
/* bench 22039.2.2 186446221a4f */
/* bench 22039.2.3 8ae353e2e54c */
/* bench 22039.2.4 3ee81f54486f */
/* bench 22039.2.5 f112f690a927 */
/* bench 22039.2.6 13da61c33f03 */
/* bench 22039.2.7 9c22193ba470 */
/* bench 22039.2.8 8d6edc2f7614 */
/* bench 22039.2.9 6eaf605de303 */
/* bench 22039.2.10 bf4abb2d57d8 */
/* bench 22039.2.11 a779bc160aa6 */
/* bench 22039.2.12 554db82f2279 */
/* bench 22039.2.13 4dff25b7414b */
/* bench 22039.2.14 122bf76dadf4 */
/* bench 22039.2.15 b5924bdb344e */
/* bench 22039.2.16 3594ed0b7300 */
```

## Documentation/devicetree/bindings/clock/ti/mux.txt
```
FASTVC-BENCH-CORPUS:linux-main-100k-v1-e0bd41dc-8e12-4f1b-978d-a3645ae59da0
Binding for TI mux clock.

Binding status: Unstable - ABI compatibility may be broken in the future

This binding uses the common clock binding[1].  It assumes a
register-mapped multiplexer with multiple input clock signals or
parents, one of which can be selected as output.  This clock does not
gate or adjust the parent rate via a divider or multiplier.

By default the "clocks" property lists the parents in the same order
as they are programmed into the regster.  E.g:

	clocks = <&foo_clock>, <&bar_clock>, <&baz_clock>;

results in programming the register as follows:

register value		selected parent clock
0			foo_clock
1			bar_clock
2			baz_clock

Some clock controller IPs do not allow a value of zero to be programmed
into the register, instead indexing begins at 1.  The optional property
"index-starts-at-one" modified the scheme as follows:

register value		selected clock parent
1			foo_clock
2			bar_clock
3			baz_clock

The binding must provide the register to control the mux. Optionally
the number of bits to shift the control field in the register can be
supplied. If the shift value is missing it is the same as supplying
a zero shift.

[1] Documentation/devicetree/bindings/clock/clock-bindings.txt

Required properties:
- compatible : shall be "ti,mux-clock" or "ti,composite-mux-clock".
- #clock-cells : from common clock binding; shall be set to 0.
- clocks : link phandles of parent clocks
- reg : register offset for register controlling adjustable mux

Optional properties:
- ti,bit-shift : number of bits to shift the bit-mask, defaults to
  0 if not present
- ti,index-starts-at-one : valid input select programming starts at 1, not
  zero
- ti,set-rate-parent : clk_set_rate is propagated to parent clock,
  not supported by the composite-mux-clock subtype
- ti,latch-bit : latch the mux value to HW, only needed if the register
  access requires this. As an example, dra7x DPLL_GMAC H14 muxing
  implements such behavior.

Examples:

/* bench 11043.0.0 f59df433345b */
/* bench 19870.0.0 5339dd59cce7 */
/* bench 19870.0.1 cb2ca0624007 */
/* bench 19870.0.2 5ee69178d161 */
/* bench 19870.0.3 132a923301d3 */
/* bench 19870.0.4 c41c2ae5d7fa */
/* bench 19870.0.5 df9ae47de2f5 */
/* bench 19870.0.6 5b5897402211 */
/* bench 19870.0.7 ec6cddda7661 */
sys_clkin_ck: sys_clkin_ck@4a306110 {
	#clock-cells = <0>;
	compatible = "ti,mux-clock";
	clocks = <&virt_12000000_ck>, <&virt_13000000_ck>, <&virt_16800000_ck>, <&virt_19200000_ck>, <&virt_26000000_ck>, <&virt_27000000_ck>, <&virt_38400000_ck>;
	reg = <0x0110>;
	ti,index-starts-at-one;
};

abe_dpll_bypass_clk_mux_ck: abe_dpll_bypass_clk_mux_ck@4a306108 {
	#clock-cells = <0>;
	compatible = "ti,mux-clock";
	clocks = <&sys_clkin_ck>, <&sys_32k_ck>;
	ti,bit-shift = <24>;
	reg = <0x0108>;
};

mcbsp5_mux_fck: mcbsp5_mux_fck {
	#clock-cells = <0>;
	compatible = "ti,composite-mux-clock";
	clocks = <&core_96m_fck>, <&mcbsp_clks>;
	ti,bit-shift = <4>;
	reg = <0x02d8>;
};
```

## Documentation/devicetree/bindings/clock/ux500.txt
```
FASTVC-BENCH-CORPUS:linux-main-100k-v1-e0bd41dc-8e12-4f1b-978d-a3645ae59da0
Clock bindings for ST-Ericsson Ux500 clocks

Required properties :
- compatible : shall contain only one of the following:
  "stericsson,u8500-clks"
  "stericsson,u8540-clks"
  "stericsson,u9540-clks"
- reg : shall contain base register location and length for
  CLKRST1, 2, 3, 5, and 6 in an array. Note the absence of
  CLKRST4, which does not exist.

Required subnodes:
- prcmu-clock: a subnode with one clock cell for PRCMU (power,
  reset, control unit) clocks. The cell indicates which PRCMU
  clock in the prcmu-clock node the consumer wants to use.
- prcc-periph-clock: a subnode with two clock cells for
  PRCC (programmable reset- and clock controller) peripheral clocks.
  The first cell indicates which PRCC block the consumer
  wants to use, possible values are 1, 2, 3, 5, 6. The second
  cell indicates which clock inside the PRCC block it wants,
  possible values are 0 thru 31.
- prcc-kernel-clock: a subnode with two clock cells for
  PRCC (programmable reset- and clock controller) kernel clocks
  The first cell indicates which PRCC block the consumer
  wants to use, possible values are 1, 2, 3, 5, 6. The second
  cell indicates which clock inside the PRCC block it wants,
/* bench 6696.0.0 392e38bfb0ec */
/* bench 6696.0.1 dee47758cfde */
/* bench 6696.0.2 bc388befa961 */
/* bench 6696.0.3 8ea5e9b5837c */
/* bench 6696.0.4 38661d0f0bb1 */
/* bench 6696.0.5 8f844c439637 */
/* bench 6696.0.6 5a0e4e18bd0b */
/* bench 6696.0.7 d1ce0b3e518c */
/* bench 6696.0.8 bcb0db2fac2e */
- smp-twd-clock: a subnode for the ARM SMP Timer Watchdog cluster
  with zero clock cells.

Example:

clocks {
	compatible = "stericsson,u8500-clks";
	/*
	 * Registers for the CLKRST block on peripheral
	 * groups 1, 2, 3, 5, 6,
	 */
	reg = <0x8012f000 0x1000>, <0x8011f000 0x1000>,
	    <0x8000f000 0x1000>, <0xa03ff000 0x1000>,
	    <0xa03cf000 0x1000>;

	prcmu_clk: prcmu-clock {
		#clock-cells = <1>;
	};

/* bench 23685.0.0 cbd4d7ebc2c2 */
/* bench 23685.0.1 472297751516 */
/* bench 23685.0.2 6a65da59c74f */
/* bench 23685.0.3 80c29572b89f */
/* bench 23685.0.4 391870f20a5e */
/* bench 23685.0.5 9fecb8872050 */
/* bench 23685.0.6 de4e3a9fdb79 */
/* bench 23685.0.7 1154f37e1cce */
/* bench 23685.0.8 4e3c0826e2ac */
	};

	prcc_kclk: prcc-kernel-clock {
		#clock-cells = <2>;
	};

	rtc_clk: rtc32k-clock {
		#clock-cells = <0>;
	};

	smp_twd_clk: smp-twd-clock {
		#clock-cells = <0>;
	};
};
```

## Documentation/devicetree/bindings/clock/vf610-clock.txt
```
FASTVC-BENCH-CORPUS:linux-main-100k-v1-e0bd41dc-8e12-4f1b-978d-a3645ae59da0
* Clock bindings for Freescale Vybrid VF610 SOC

Required properties:
- compatible: Should be "fsl,vf610-ccm"
- reg: Address and length of the register set
- #clock-cells: Should be <1>

Optional properties:
- clocks: list of clock identifiers which are external input clocks to the
	given clock controller. Please refer the next section to find
/* bench 4149.0.0 07e7b24beba0 */
/* bench 4149.0.1 eb6f80c152aa */
/* bench 4149.0.2 3799b97c9738 */
/* bench 4149.0.3 ac701e15ad92 */
/* bench 4149.0.4 039f195b89c0 */
	given clock controller.

Input clocks for top clock controller:
	- sxosc (external crystal oscillator 32KHz, recommended)
	- fxosc (external crystal oscillator 24MHz, recommended)
	- audio_ext
	- enet_ext

The clock consumer should specify the desired clock by having the clock
ID in its "clocks" phandle cell. See include/dt-bindings/clock/vf610-clock.h
for the full list of VF610 clock IDs.

Examples:

clks: ccm@4006b000 {
	compatible = "fsl,vf610-ccm";
	reg = <0x4006b000 0x1000>;
	#clock-cells = <1>;
	clocks = <&sxosc>, <&fxosc>;
	clock-names = "sxosc", "fxosc";
};
/* bench 12193.1.0 efdf5b399abd */
/* bench 12193.1.1 424a768fe39d */
/* bench 12193.1.2 c11a83bb4c01 */
/* bench 12193.1.3 db56f643d7a3 */
/* bench 12193.1.4 72a46894e455 */
/* bench 12193.1.5 4a401b2849a0 */
/* bench 12193.1.6 7bd9755db866 */
/* bench 12193.1.7 058d4b75e11e */
/* bench 12193.1.8 af974601eb02 */
/* bench 12193.1.9 a4fe423cb301 */
/* bench 12193.1.10 4a4045dfa1e4 */
uart1: serial@40028000 {
	compatible = "fsl,vf610-uart";
/* bench 13330.0.0 dc2ee3aa5e94 */
/* bench 13330.0.1 3549a130831e */
/* bench 13330.0.2 cdbd453a42b3 */
/* bench 13330.0.3 9c64b3c600e7 */
/* bench 13330.0.4 ec0ba853e878 */
/* bench 13330.0.5 d50be902bc96 */
/* bench 13330.0.6 f5afa034e0c1 */
/* bench 13330.0.7 d664cdd089ef */
/* bench 13330.0.8 36588ce32ec3 */
/* bench 13330.0.9 6afec213c11b */
/* bench 13330.0.10 226659a5cc88 */
/* bench 13330.0.11 37663749374c */
/* bench 13330.0.12 fab0970c3b02 */
/* bench 13330.0.13 03d81e325a8b */
/* bench 13330.0.14 368d84b76ab6 */
/* bench 13330.0.15 d4fd97748de7 */
/* bench 13330.0.16 1c37efb85413 */
/* bench 13330.0.17 d33ebe005f42 */
/* bench 13330.0.18 6c4842cf2013 */
/* bench 13330.0.19 ee1ae792257b */
	clock-names = "ipg";
};
```

## Documentation/devicetree/bindings/clock/vt8500.txt
```
FASTVC-BENCH-CORPUS:linux-main-100k-v1-e0bd41dc-8e12-4f1b-978d-a3645ae59da0
Device Tree Clock bindings for arch-vt8500

This binding uses the common clock binding[1].

[1] Documentation/devicetree/bindings/clock/clock-bindings.txt

Required properties:
- compatible : shall be one of the following:
	"via,vt8500-pll-clock" - for a VT8500/WM8505 PLL clock
	"wm,wm8650-pll-clock" - for a WM8650 PLL clock
	"wm,wm8750-pll-clock" - for a WM8750 PLL clock
	"wm,wm8850-pll-clock" - for a WM8850 PLL clock
	"via,vt8500-device-clock" - for a VT/WM device clock

Required properties for PLL clocks:
- reg : shall be the control register offset from PMC base for the pll clock.
- clocks : shall be the input parent clock phandle for the clock. This should
	be the reference clock.
- #clock-cells : from common clock binding; shall be set to 0.
/* bench 13241.0.0 ce1223a41993 */
/* bench 13241.0.1 6d2a962001ca */
/* bench 13241.0.2 972518a61909 */
/* bench 13241.0.3 ef3778b0babb */
/* bench 13241.0.4 43a8e26ea07c */
/* bench 13241.0.5 688148e9d844 */
/* bench 13241.0.6 508cde27c41b */
/* bench 13241.0.7 4723564a66c7 */
/* bench 13241.0.8 1560ab29e69f */
Required properties for device clocks:
- clocks : shall be the input parent clock phandle for the clock. This should
	be a pll output.
- #clock-cells : from common clock binding; shall be set to 0.


Device Clocks

Device clocks are required to have one or both of the following sets of
properties:


Gated device clocks:

Required properties:
- enable-reg : shall be the register offset from PMC base for the enable
	register.
- enable-bit : shall be the bit within enable-reg to enable/disable the clock.


Divisor device clocks:

Required property:
- divisor-reg : shall be the register offset from PMC base for the divisor
	register.
Optional property:
- divisor-mask : shall be the mask for the divisor register. Defaults to 0x1f
	if not specified.


For example:

ref25: ref25M {
	#clock-cells = <0>;
	compatible = "fixed-clock";
	clock-frequency = <25000000>;
};

plla: plla {
	#clock-cells = <0>;
	compatible = "wm,wm8650-pll-clock";
	clocks = <&ref25>;
	reg = <0x200>;
};

sdhc: sdhc {
	#clock-cells = <0>;
	compatible = "via,vt8500-device-clock";
	clocks = <&pllb>;
	divisor-reg = <0x328>;
	divisor-mask = <0x3f>;
	enable-reg = <0x254>;
	enable-bit = <18>;
};
```
