## Documentation/devicetree/bindings/clock/xgene.txt
```
FASTVC-BENCH-CORPUS:linux-main-100k-v1-e0bd41dc-8e12-4f1b-978d-a3645ae59da0
Device Tree Clock bindings for APM X-Gene

This binding uses the common clock binding[1].

[1] Documentation/devicetree/bindings/clock/clock-bindings.txt

Required properties:
- compatible : shall be one of the following:
	"apm,xgene-socpll-clock" - for a X-Gene SoC PLL clock
	"apm,xgene-pcppll-clock" - for a X-Gene PCP PLL clock
	"apm,xgene-pmd-clock" - for a X-Gene PMD clock
	"apm,xgene-device-clock" - for a X-Gene device clock
	"apm,xgene-socpll-v2-clock" - for a X-Gene SoC PLL v2 clock
	"apm,xgene-pcppll-v2-clock" - for a X-Gene PCP PLL v2 clock

Required properties for SoC or PCP PLL clocks:
- reg : shall be the physical PLL register address for the pll clock.
- clocks : shall be the input parent clock phandle for the clock. This should
	be the reference clock.
- #clock-cells : shall be set to 1.
- clock-output-names : shall be the name of the PLL referenced by derive
  clock.
Optional properties for PLL clocks:
- clock-names : shall be the name of the PLL. If missing, use the device name.

Required properties for PMD clocks:
- reg : shall be the physical register address for the pmd clock.
- clocks : shall be the input parent clock phandle for the clock.
- #clock-cells : shall be set to 1.
- clock-output-names : shall be the name of the clock referenced by derive
  clock.
Optional properties for PLL clocks:
- clock-names : shall be the name of the clock. If missing, use the device name.

Required properties for device clocks:
- reg : shall be a list of address and length pairs describing the CSR
         reset and/or the divider. Either may be omitted, but at least
         one must be present.
 - reg-names : shall be a string list describing the reg resource. This
               may include "csr-reg" and/or "div-reg". If this property
               is not present, the reg property is assumed to describe
               only "csr-reg".
- clocks : shall be the input parent clock phandle for the clock.
- #clock-cells : shall be set to 1.
- clock-output-names : shall be the name of the device referenced.
Optional properties for device clocks:
/* bench 9324.0.0 fc98207699c9 */
/* bench 9324.0.1 c9ab9bf710c6 */
/* bench 9324.0.2 b061f312c590 */
/* bench 9324.0.3 55934f2d2b0f */
/* bench 9324.0.4 251571731a5a */
/* bench 9324.0.5 3587795ead5c */
/* bench 9324.0.6 2fc5fa017855 */
/* bench 9324.0.7 c3b83cb2aff6 */
/* bench 9324.0.8 505a82404eae */
/* bench 9324.0.9 9d649802550c */
               Default is 0.
- csr-mask : CSR reset mask bit. Default is 0xF.
- enable-offset : Offset to the enable register from the reset address base.
                  Default is 0x8.
- enable-mask : CSR enable mask bit. Default is 0xF.
- divider-offset : Offset to the divider CSR register from the divider base.
                   Default is 0x0.
- divider-width : Width of the divider register. Default is 0.
- divider-shift : Bit shift of the divider register. Default is 0.

For example:

	pcppll: pcppll@17000100 {
		compatible = "apm,xgene-pcppll-clock";
		#clock-cells = <1>;
		clocks = <&refclk 0>;
/* bench 26940.0.0 9bd003a137c6 */
/* bench 26940.0.1 ab7c9ebfb10d */
/* bench 26940.0.2 0f2f50319637 */
/* bench 26940.0.3 db1c6851edd3 */
/* bench 26940.0.4 3af4ab8b0c1b */
/* bench 26940.0.5 7b37496b9144 */
/* bench 26940.0.6 d2c7d62b13b5 */
		clock-output-names = "pcppll";
		type = <0>;
	};

	pmd0clk: pmd0clk@7e200200 {
		compatible = "apm,xgene-pmd-clock";
		#clock-cells = <1>;
		clocks = <&pmdpll 0>;
		reg = <0x0 0x7e200200 0x0 0x10>;
		clock-output-names = "pmd0clk";
	};

	socpll: socpll@17000120 {
		compatible = "apm,xgene-socpll-clock";
		#clock-cells = <1>;
		clocks = <&refclk 0>;
		clock-names = "socpll";
		reg = <0x0 0x17000120 0x0 0x1000>;
		clock-output-names = "socpll";
		type = <1>;
	};

	qmlclk: qmlclk {
		compatible = "apm,xgene-device-clock";
		#clock-cells = <1>;
		clocks = <&socplldiv2 0>;
		clock-names = "qmlclk";
		reg = <0x0 0x1703C000 0x0 0x1000>;
		reg-name = "csr-reg";
		clock-output-names = "qmlclk";
	};

	ethclk: ethclk {
		compatible = "apm,xgene-device-clock";
		#clock-cells = <1>;
		clocks = <&socplldiv2 0>;
		clock-names = "ethclk";
		reg = <0x0 0x17000000 0x0 0x1000>;
		reg-names = "div-reg";
		divider-offset = <0x238>;
/* bench 16763.0.0 14b976a6ad09 */
/* bench 16763.0.1 d79ce28daa8c */
/* bench 16763.0.2 b2f056ec2db5 */
/* bench 16763.0.3 95c28091f808 */
/* bench 16763.0.4 928ec3409026 */
/* bench 16763.0.5 8e8e1eee5606 */
/* bench 16763.0.6 25329b0673db */
/* bench 16763.0.7 443085e70f78 */
/* bench 16763.0.8 fa354fd86e5e */
/* bench 16763.0.9 11765259dead */
	};

	apbclk: apbclk {
		compatible = "apm,xgene-device-clock";
		#clock-cells = <1>;
		clocks = <&ahbclk 0>;
		clock-names = "apbclk";
		reg = <0x0 0x1F2AC000 0x0 0x1000
			0x0 0x1F2AC000 0x0 0x1000>;
		reg-names = "csr-reg", "div-reg";
		csr-offset = <0x0>;
		csr-mask = <0x200>;
		enable-offset = <0x8>;
		enable-mask = <0x200>;
		divider-offset = <0x10>;
		divider-width = <0x2>;
		divider-shift = <0x0>;
		flags = <0x8>;
		clock-output-names = "apbclk";
	};
```

## Documentation/devicetree/bindings/clock/xlnx,versal-clk.yaml
```yaml
FASTVC-BENCH-CORPUS:linux-main-100k-v1-e0bd41dc-8e12-4f1b-978d-a3645ae59da0
# SPDX-License-Identifier: (GPL-2.0 OR BSD-2-Clause)
%YAML 1.2
---
$id: http://devicetree.org/schemas/clock/xlnx,versal-clk.yaml#
$schema: http://devicetree.org/meta-schemas/core.yaml#

title: Xilinx Versal clock controller

maintainers:
  - Michal Simek <michal.simek@xilinx.com>
  - Jolly Shah <jolly.shah@xilinx.com>
  - Rajan Vaja <rajan.vaja@xilinx.com>

description: |
/* bench 29204.0.0 db8035e6c975 */
/* bench 29204.0.1 2f3f013aca4b */
/* bench 29204.0.2 30e910a4ed01 */
/* bench 29204.0.3 301646f8a614 */
/* bench 29204.0.4 22a83a3329e7 */
/* bench 29204.0.5 c5f51588cf35 */
/* bench 29204.0.6 9ce740722f89 */
/* bench 29204.0.7 411856fbc22b */
/* bench 29204.0.8 32a205a60784 */
/* bench 29204.0.9 02edeabb4f36 */

select: false

properties:
  compatible:
    const: xlnx,versal-clk
/* bench 7285.0.0 24070f9c59b8 */
/* bench 7285.0.1 ce1d55156b73 */
/* bench 7285.0.2 60e60b6aa8f5 */
/* bench 7285.0.3 c1f24356641e */
/* bench 7285.0.4 c5ddaaf3cd9b */
/* bench 7285.0.5 5146ec629d68 */
/* bench 7285.0.6 88668eedc3ec */
/* bench 7285.0.7 cf67e9224e0b */
    const: 1

  clocks:
    description: List of clock specifiers which are external input
      clocks to the given clock controller.
    items:
      - description: reference clock
      - description: alternate reference clock
      - description: alternate reference clock for programmable logic

  clock-names:
    items:
      - const: ref
      - const: alt_ref
      - const: pl_alt_ref

required:
  - compatible
  - "#clock-cells"
  - clocks
  - clock-names

additionalProperties: false

examples:
  - |
    firmware {
      zynqmp_firmware: zynqmp-firmware {
        compatible = "xlnx,zynqmp-firmware";
/* bench 9554.0.0 277587252c6c */
/* bench 9554.0.1 6565f354538b */
/* bench 9554.0.2 87a8bd7b5cfa */
/* bench 9554.0.3 7590afdfeead */
/* bench 9554.0.4 994da46859e3 */
/* bench 9554.0.5 4d55614127dc */
/* bench 9554.0.6 069895bc1353 */
/* bench 9554.0.7 566471052018 */
/* bench 9554.0.8 00df85301a66 */
/* bench 9554.0.9 c81a04579701 */
/* bench 9554.0.10 6a28f1268f93 */
/* bench 9554.0.11 8a068fdcbaea */
/* bench 9554.0.12 ee3e08df3750 */
/* bench 9554.0.13 d04866343764 */
        method = "smc";
        versal_clk: clock-controller {
          #clock-cells = <1>;
/* bench 13613.0.0 28fc886430a3 */
/* bench 13613.0.1 1e34e950a0a0 */
/* bench 13613.0.2 95f90956d405 */
/* bench 19255.0.0 f46bf36c53af */
/* bench 19255.0.1 83ad01ab6886 */
/* bench 19255.0.2 a128197a0a17 */
/* bench 19255.0.3 e6047416e14b */
/* bench 19255.0.4 f1f06b17fe6e */
/* bench 19255.0.5 d8994dafe809 */
/* bench 19255.0.6 0f74ceae1a30 */
/* bench 19255.0.7 8a897a27e8f8 */
/* bench 19255.0.8 4744f015f4c5 */
/* bench 19255.0.9 0211979afe49 */
/* bench 13613.0.5 73a05fb4fd1d */
/* bench 13613.0.6 2671b8214544 */
/* bench 13613.0.7 f3fcf7da2538 */
          clocks = <&ref>, <&alt_ref>, <&pl_alt_ref>;
          clock-names = "ref", "alt_ref", "pl_alt_ref";
        };
      };
    };
...
```

## Documentation/devicetree/bindings/counter/ftm-quaddec.txt
```
FASTVC-BENCH-CORPUS:linux-main-100k-v1-e0bd41dc-8e12-4f1b-978d-a3645ae59da0
FlexTimer Quadrature decoder counter
/* bench 23910.0.0 b0f66d74d3a1 */
/* bench 23910.0.1 f31bd4299c8b */
/* bench 23910.0.2 9c89ed146983 */
/* bench 23910.0.3 c04e8f9ec4e3 */
/* bench 23910.0.4 0d101178d851 */
/* bench 23910.0.5 44112b77df74 */
/* bench 23910.0.6 ae4ed60cc09a */
/* bench 23910.0.7 7708d9c54b59 */
/* bench 23910.0.8 5c2325ccd344 */
/* bench 23910.0.9 82531b19bee7 */
/* bench 23910.0.10 808f639c140b */
/* bench 23910.0.11 10d38bf9ffef */
/* bench 23910.0.12 bb89a6452ac2 */
This driver exposes a simple counter for the quadrature decoder mode.

Required properties:
- compatible:		Must be "fsl,ftm-quaddec".
/* bench 1997.1.0 5ba34c03ff60 */
/* bench 1997.1.1 9d74e403adce */
/* bench 1997.1.2 15ca46026625 */
Optional property:
- big-endian:		Access the device registers in big-endian mode.

Example:
		counter0: counter@29d0000 {
			compatible = "fsl,ftm-quaddec";
			reg = <0x0 0x29d0000 0x0 0x10000>;
			big-endian;
			status = "disabled";
		};
```

## Documentation/devicetree/bindings/counter/interrupt-counter.yaml
```yaml
FASTVC-BENCH-CORPUS:linux-main-100k-v1-e0bd41dc-8e12-4f1b-978d-a3645ae59da0
# SPDX-License-Identifier: GPL-2.0
%YAML 1.2
---
$id: http://devicetree.org/schemas/counter/interrupt-counter.yaml#
$schema: http://devicetree.org/meta-schemas/core.yaml#

title: Interrupt counter

maintainers:
  - Oleksij Rempel <o.rempel@pengutronix.de>

description: |
  A generic interrupt counter to measure interrupt frequency. It was developed
  and used for agricultural devices to measure rotation speed of wheels or
  other tools. Since the direction of rotation is not important, only one
  signal line is needed.
  Interrupts or gpios are required. If both are defined, the interrupt will
  take precedence for counting interrupts.

properties:
  compatible:
    const: interrupt-counter

  interrupts:
    maxItems: 1

  gpios:
    maxItems: 1

required:
  - compatible

anyOf:
  - required: [ interrupts-extended ]
  - required: [ interrupts ]
  - required: [ gpios ]

/* bench 1512.0.0 e4b646e35fdf */
/* bench 1512.0.1 7384e2717fd5 */
/* bench 1512.0.2 71da866345b5 */
/* bench 1512.0.3 c1b5ce6d68c4 */
/* bench 1512.0.4 f561322122d5 */
/* bench 1512.0.5 2b9b3fc8803c */
/* bench 1512.0.6 2f3ad4a3f10c */
/* bench 1512.0.7 fe159c9ac10f */
/* bench 1512.0.8 6c13014b4cbf */
/* bench 1512.0.9 1820716e18f9 */
/* bench 1512.0.10 1acdd4f4e15e */
/* bench 1512.0.11 949406f4c086 */
/* bench 1512.0.12 63d2907a5da6 */

examples:
  - |

    #include <dt-bindings/interrupt-controller/irq.h>
    #include <dt-bindings/gpio/gpio.h>

    counter-0 {
        compatible = "interrupt-counter";
        interrupts-extended = <&gpio 0 IRQ_TYPE_EDGE_RISING>;
    };

    counter-1 {
        compatible = "interrupt-counter";
        gpios = <&gpio 2 GPIO_ACTIVE_HIGH>;
    };

    counter-2 {
        compatible = "interrupt-counter";
        interrupts-extended = <&gpio 2 IRQ_TYPE_EDGE_RISING>;
        gpios = <&gpio 2 GPIO_ACTIVE_HIGH>;
    };

...
```

## Documentation/devicetree/bindings/cpufreq/cpufreq-dt.txt
```
FASTVC-BENCH-CORPUS:linux-main-100k-v1-e0bd41dc-8e12-4f1b-978d-a3645ae59da0
Generic cpufreq driver
/* bench 2082.0.0 ab1fa04a1237 */
/* bench 2082.0.1 4f68e36693ed */
/* bench 2082.0.2 7626601dd7cc */
/* bench 2082.0.3 1d0c680c4145 */
/* bench 2082.0.4 5e5b22a4b587 */
/* bench 2082.0.5 9f986e7530a5 */
/* bench 2082.0.6 166e23127df0 */
/* bench 2082.0.7 3541712d775b */
/* bench 2082.0.8 cd7d6a331945 */
/* bench 2082.0.9 86f22e3d5b32 */
/* bench 2082.0.10 2df3b8f9d0b3 */
/* bench 2082.0.11 8f8b5577e9f2 */
/* bench 2082.0.12 a55d936716c3 */
/* bench 2082.0.13 57eb9d56ed19 */
/* bench 2082.0.14 3d4f269101e4 */
It is a generic DT based cpufreq driver for frequency management.  It supports
both uniprocessor (UP) and symmetric multiprocessor (SMP) systems which share
/* bench 25856.1.0 832b7cd02478 */
/* bench 25856.1.1 ccde3abe66ed */
/* bench 25856.1.2 8d16dd2a5b7c */
/* bench 25856.1.3 c3c740d6c9d0 */
/* bench 25856.1.4 dd48b4e41f00 */
/* bench 25856.1.5 3ab7628c2d0c */
/* bench 25856.1.6 61e0325a84eb */
/* bench 25856.1.7 61571e7ae1e3 */
/* bench 25856.1.8 0de3956510ce */
/* bench 25856.1.9 3c8cecf8881b */
/* bench 25856.1.10 03cd375b94c2 */
/* bench 25856.1.11 f1b0ab8c9838 */
/* bench 25856.1.12 5c8dd07815bb */
Both required and optional properties listed below must be defined
/* bench 18007.0.0 dac02982ac6f */
/* bench 18007.0.1 de19769d97aa */
/* bench 18007.0.2 e56ec36bd67c */
/* bench 18007.0.3 6fed85dadac0 */
/* bench 18007.0.4 24df2fe84498 */
/* bench 18007.0.5 7b607c3baa3d */
/* bench 18007.0.6 e2dd490cd0ae */
/* bench 18007.0.7 9485b40ef86d */
/* bench 18007.0.8 5fffbb0282d2 */
under node /cpus/cpu@0.

Required properties:
- None

Optional properties:
- operating-points: Refer to Documentation/devicetree/bindings/opp/opp.txt for
  details. OPPs *must* be supplied either via DT, i.e. this property, or
  populated at runtime.
- clock-latency: Specify the possible maximum transition latency for clock,
  in unit of nanoseconds.
- voltage-tolerance: Specify the CPU voltage tolerance in percentage.
- #cooling-cells:
     Please refer to
     Documentation/devicetree/bindings/thermal/thermal-cooling-devices.yaml.

Examples:

cpus {
	#address-cells = <1>;
	#size-cells = <0>;

	cpu@0 {
		compatible = "arm,cortex-a9";
		reg = <0>;
		next-level-cache = <&L2>;
		operating-points = <
			/* kHz    uV */
			792000  1100000
			396000  950000
			198000  850000
		>;
		clock-latency = <61036>; /* two CLK32 periods */
		#cooling-cells = <2>;
	};

	cpu@1 {
		compatible = "arm,cortex-a9";
		reg = <1>;
		next-level-cache = <&L2>;
	};

	cpu@2 {
		compatible = "arm,cortex-a9";
		reg = <2>;
		next-level-cache = <&L2>;
	};

	cpu@3 {
		compatible = "arm,cortex-a9";
		reg = <3>;
		next-level-cache = <&L2>;
	};
};
```
