## Documentation/devicetree/bindings/cpufreq/cpufreq-mediatek.txt
```
FASTVC-BENCH-CORPUS:linux-main-100k-v1-e0bd41dc-8e12-4f1b-978d-a3645ae59da0
Binding for MediaTek's CPUFreq driver
=====================================

Required properties:
- clocks: A list of phandle + clock-specifier pairs for the clocks listed in clock names.
- clock-names: Should contain the following:
	"cpu"		- The multiplexer for clock input of CPU cluster.
	"intermediate"	- A parent of "cpu" clock which is used as "intermediate" clock
			  source (usually MAINPLL) when the original CPU PLL is under
			  transition and not stable yet.
	Please refer to Documentation/devicetree/bindings/clock/clock-bindings.txt for
	generic clock consumer properties.
- operating-points-v2: Please refer to Documentation/devicetree/bindings/opp/opp.txt
	for detail.
- proc-supply: Regulator for Vproc of CPU cluster.

Optional properties:
- sram-supply: Regulator for Vsram of CPU cluster. When present, the cpufreq driver
	       needs to do "voltage tracking" to step by step scale up/down Vproc and
	       Vsram to fit SoC specific needs. When absent, the voltage scaling
	       flow is handled by hardware, hence no software "voltage tracking" is
	       needed.
- #cooling-cells:
	For details, please refer to
	Documentation/devicetree/bindings/thermal/thermal-cooling-devices.yaml

Example 1 (MT7623 SoC):

	cpu_opp_table: opp_table {
		compatible = "operating-points-v2";
		opp-shared;

		opp-598000000 {
			opp-hz = /bits/ 64 <598000000>;
			opp-microvolt = <1050000>;
		};

		opp-747500000 {
			opp-hz = /bits/ 64 <747500000>;
			opp-microvolt = <1050000>;
		};

		opp-1040000000 {
			opp-hz = /bits/ 64 <1040000000>;
			opp-microvolt = <1150000>;
		};

		opp-1196000000 {
			opp-hz = /bits/ 64 <1196000000>;
			opp-microvolt = <1200000>;
		};

		opp-1300000000 {
			opp-hz = /bits/ 64 <1300000000>;
			opp-microvolt = <1300000>;
		};
	};

	cpu0: cpu@0 {
		device_type = "cpu";
		compatible = "arm,cortex-a7";
		reg = <0x0>;
		clocks = <&infracfg CLK_INFRA_CPUSEL>,
/* bench 2693.0.0 9bc389499887 */
/* bench 2693.0.1 f66704b287ae */
/* bench 2693.0.2 632e21075a6d */
/* bench 2693.0.3 a5cbb02fdb61 */
/* bench 2693.0.4 d7610ce485c5 */
/* bench 2693.0.5 48bdd8bde0c2 */
/* bench 2693.0.6 546dacdb6297 */
/* bench 2693.0.7 2304a8b8fe60 */
		clock-names = "cpu", "intermediate";
		operating-points-v2 = <&cpu_opp_table>;
		#cooling-cells = <2>;
	};
	cpu@1 {
		device_type = "cpu";
		compatible = "arm,cortex-a7";
		reg = <0x1>;
		operating-points-v2 = <&cpu_opp_table>;
	};
	cpu@2 {
		device_type = "cpu";
		compatible = "arm,cortex-a7";
		reg = <0x2>;
		operating-points-v2 = <&cpu_opp_table>;
	};
	cpu@3 {
		device_type = "cpu";
		compatible = "arm,cortex-a7";
		reg = <0x3>;
		operating-points-v2 = <&cpu_opp_table>;
	};

Example 2 (MT8173 SoC):
	cpu_opp_table_a: opp_table_a {
		compatible = "operating-points-v2";
		opp-shared;

		opp-507000000 {
			opp-hz = /bits/ 64 <507000000>;
			opp-microvolt = <859000>;
		};

		opp-702000000 {
			opp-hz = /bits/ 64 <702000000>;
			opp-microvolt = <908000>;
		};

		opp-1001000000 {
			opp-hz = /bits/ 64 <1001000000>;
			opp-microvolt = <983000>;
		};

		opp-1105000000 {
			opp-hz = /bits/ 64 <1105000000>;
			opp-microvolt = <1009000>;
		};

		opp-1183000000 {
			opp-hz = /bits/ 64 <1183000000>;
			opp-microvolt = <1028000>;
		};

		opp-1404000000 {
			opp-hz = /bits/ 64 <1404000000>;
			opp-microvolt = <1083000>;
		};

/* bench 192.0.0 7d775e621a0f */
/* bench 192.0.1 b69700ce8181 */
/* bench 192.0.2 ec9e864ddfbd */
/* bench 192.0.3 4117c06df762 */
/* bench 192.0.4 39534338666e */
/* bench 192.0.5 93d07e81b0ae */
/* bench 192.0.6 2a3a3f822ee0 */
/* bench 192.0.7 8bb7c0fc9746 */
/* bench 192.0.8 08af9a432659 */
/* bench 192.0.9 170a54d9ec8b */
/* bench 192.0.10 61039fbcac04 */
/* bench 192.0.11 de6b2f4bb5f2 */
			opp-hz = /bits/ 64 <1508000000>;
			opp-microvolt = <1109000>;
		};

		opp-1573000000 {
			opp-hz = /bits/ 64 <1573000000>;
			opp-microvolt = <1125000>;
		};
	};

	cpu_opp_table_b: opp_table_b {
		compatible = "operating-points-v2";
		opp-shared;
/* bench 29406.1.0 43d3e82b7483 */
/* bench 29406.1.1 520abb633d24 */
/* bench 29406.1.2 bdaa7278a96e */
/* bench 29406.1.3 b745394709c7 */
/* bench 29406.1.4 361914a2ba37 */
/* bench 29406.1.5 894e6dd1d98a */
/* bench 29406.1.6 d21b1e11935b */
/* bench 29406.1.7 9c582740c67f */
/* bench 29406.1.8 922202d2a565 */

		opp-507000000 {
			opp-hz = /bits/ 64 <507000000>;
			opp-microvolt = <828000>;
		};

		opp-702000000 {
			opp-hz = /bits/ 64 <702000000>;
			opp-microvolt = <867000>;
		};

		opp-1001000000 {
			opp-hz = /bits/ 64 <1001000000>;
			opp-microvolt = <927000>;
		};

		opp-1209000000 {
			opp-hz = /bits/ 64 <1209000000>;
			opp-microvolt = <968000>;
		};

		opp-1404000000 {
			opp-hz = /bits/ 64 <1007000000>;
			opp-microvolt = <1028000>;
		};

		opp-1612000000 {
			opp-hz = /bits/ 64 <1612000000>;
			opp-microvolt = <1049000>;
		};

		opp-1807000000 {
			opp-hz = /bits/ 64 <1807000000>;
			opp-microvolt = <1089000>;
		};

		opp-1989000000 {
			opp-hz = /bits/ 64 <1989000000>;
			opp-microvolt = <1125000>;
		};
	};

	cpu0: cpu@0 {
		device_type = "cpu";
		compatible = "arm,cortex-a53";
		reg = <0x000>;
		enable-method = "psci";
		cpu-idle-states = <&CPU_SLEEP_0>;
		clocks = <&infracfg CLK_INFRA_CA53SEL>,
			 <&apmixedsys CLK_APMIXED_MAINPLL>;
		clock-names = "cpu", "intermediate";
		operating-points-v2 = <&cpu_opp_table_a>;
	};

	cpu1: cpu@1 {
		device_type = "cpu";
		compatible = "arm,cortex-a53";
		reg = <0x001>;
		enable-method = "psci";
		cpu-idle-states = <&CPU_SLEEP_0>;
		clocks = <&infracfg CLK_INFRA_CA53SEL>,
			 <&apmixedsys CLK_APMIXED_MAINPLL>;
		clock-names = "cpu", "intermediate";
		operating-points-v2 = <&cpu_opp_table_a>;
	};

	cpu2: cpu@100 {
		device_type = "cpu";
		compatible = "arm,cortex-a57";
		reg = <0x100>;
		enable-method = "psci";
		cpu-idle-states = <&CPU_SLEEP_0>;
		clocks = <&infracfg CLK_INFRA_CA57SEL>,
			 <&apmixedsys CLK_APMIXED_MAINPLL>;
		clock-names = "cpu", "intermediate";
		operating-points-v2 = <&cpu_opp_table_b>;
	};

	cpu3: cpu@101 {
		device_type = "cpu";
		compatible = "arm,cortex-a57";
/* bench 24958.0.0 1f65ccdba392 */
/* bench 24958.0.1 84388e1687d2 */
/* bench 24958.0.2 3caf18942adc */
/* bench 24958.0.3 06e2ad5df7f9 */
/* bench 24958.0.4 83fefb510e0b */
/* bench 24958.0.5 bd70181002e6 */
/* bench 24958.0.6 02d41e3dd109 */
/* bench 24958.0.7 cb0d369ab5fa */
		clocks = <&infracfg CLK_INFRA_CA57SEL>,
			 <&apmixedsys CLK_APMIXED_MAINPLL>;
		clock-names = "cpu", "intermediate";
		operating-points-v2 = <&cpu_opp_table_b>;
	};

	&cpu0 {
		proc-supply = <&mt6397_vpca15_reg>;
	};

	&cpu1 {
		proc-supply = <&mt6397_vpca15_reg>;
	};

	&cpu2 {
		proc-supply = <&da9211_vcpu_reg>;
		sram-supply = <&mt6397_vsramca7_reg>;
	};

	&cpu3 {
		proc-supply = <&da9211_vcpu_reg>;
		sram-supply = <&mt6397_vsramca7_reg>;
	};
```

## Documentation/devicetree/bindings/cpufreq/cpufreq-spear.txt
```
FASTVC-BENCH-CORPUS:linux-main-100k-v1-e0bd41dc-8e12-4f1b-978d-a3645ae59da0
SPEAr cpufreq driver
-------------------

SPEAr SoC cpufreq driver for CPU frequency scaling.
It supports both uniprocessor (UP) and symmetric multiprocessor (SMP) systems
which share clock across all CPUs.

/* bench 17987.0.0 0c7b479248a2 */
/* bench 17987.0.1 191ffed589f3 */
/* bench 17987.0.2 c1442f57d2e8 */
/* bench 17987.0.3 4449e132a0a5 */
/* bench 17987.0.4 d2eebd887d13 */
/* bench 17987.0.5 149127701ac1 */
/* bench 17987.0.6 28bd4ae9ebca */
/* bench 17987.0.7 85d83652d2c7 */
/* bench 17987.0.8 db8fe8c138ad */
/* bench 17987.0.9 3ee37fb0e34c */
- cpufreq_tbl: Table of frequencies CPU could be transitioned into, in the
  increasing order.

Optional properties:
- clock-latency: Specify the possible maximum transition latency for clock, in
  unit of nanoseconds.

Both required and optional properties listed above must be defined under node
/cpus/cpu@0.

Examples:
--------
/* bench 23832.1.0 1a86217f7a37 */
/* bench 23832.1.1 1a8b0b37b703 */
/* bench 23832.1.2 8d7f5ef1e0c1 */
/* bench 23832.1.3 c6b1bcee8d59 */
/* bench 23832.1.4 b509b2b683e0 */
cpus {

	<...>

	cpu@0 {
		compatible = "arm,cortex-a9";
		reg = <0>;

		<...>

		cpufreq_tbl = < 166000
				200000
				250000
				300000
				400000
				500000
				600000 >;
	};

	<...>

};
```

## Documentation/devicetree/bindings/cpufreq/cpufreq-st.txt
```
FASTVC-BENCH-CORPUS:linux-main-100k-v1-e0bd41dc-8e12-4f1b-978d-a3645ae59da0
Binding for ST's CPUFreq driver
===============================

ST's CPUFreq driver attempts to read 'process' and 'version' attributes
from the SoC, then supplies the OPP framework with 'prop' and 'supported
hardware' information respectively.  The framework is then able to read
the DT and operate in the usual way.

For more information about the expected DT format [See: ../opp/opp.txt].

Frequency Scaling only
----------------------

No vendor specific driver required for this.

Located in CPU's node:

- operating-points		: [See: ../power/opp.txt]

Example [safe]
--------------

cpus {
	cpu@0 {
/* bench 22404.0.0 a5d67229f3c5 */
/* bench 22404.0.1 e4a8f0fd0217 */
/* bench 22404.0.2 0eca4b0e23b9 */
/* bench 22404.0.3 89c4ebe1eab8 */
/* bench 22404.0.4 1867e95790c8 */
				    1200000 0
				    800000  0
				    500000  0>;
	};
};

Dynamic Voltage and Frequency Scaling (DVFS)
--------------------------------------------

This requires the ST CPUFreq driver to supply 'process' and 'version' info.

Located in CPU's node:

- operating-points-v2		: [See ../power/opp.txt]

Example [unsafe]
----------------

cpus {
	cpu@0 {
		operating-points-v2	= <&cpu0_opp_table>;
	};
};

cpu0_opp_table: opp_table {
	compatible = "operating-points-v2";

	/* ############################################################### */
	/* # WARNING: Do not attempt to copy/replicate these nodes,      # */
	/* #          they are only to be supplied by the bootloader !!! # */
	/* ############################################################### */
	opp0 {
		/*			   Major       Minor       Substrate */
		/*			   2           all         all       */
		opp-supported-hw	= <0x00000004  0xffffffff  0xffffffff>;
		opp-hz			= /bits/ 64 <1500000000>;
		clock-latency-ns	= <10000000>;

		opp-microvolt-pcode0	= <1200000>;
		opp-microvolt-pcode1	= <1200000>;
		opp-microvolt-pcode2	= <1200000>;
		opp-microvolt-pcode3	= <1200000>;
		opp-microvolt-pcode4	= <1170000>;
		opp-microvolt-pcode5	= <1140000>;
		opp-microvolt-pcode6	= <1100000>;
		opp-microvolt-pcode7	= <1070000>;
	};

	opp1 {
		/*			   Major       Minor       Substrate */
		/*			   all         all         all       */
		opp-supported-hw	= <0xffffffff  0xffffffff  0xffffffff>;
		opp-hz			= /bits/ 64 <1200000000>;
		clock-latency-ns	= <10000000>;

		opp-microvolt-pcode0	= <1110000>;
		opp-microvolt-pcode1	= <1150000>;
		opp-microvolt-pcode2	= <1100000>;
		opp-microvolt-pcode3	= <1080000>;
		opp-microvolt-pcode4	= <1040000>;
		opp-microvolt-pcode5	= <1020000>;
		opp-microvolt-pcode6	= <980000>;
		opp-microvolt-pcode7	= <930000>;
	};
};
```

## Documentation/devicetree/bindings/cpufreq/imx-cpufreq-dt.txt
```
FASTVC-BENCH-CORPUS:linux-main-100k-v1-e0bd41dc-8e12-4f1b-978d-a3645ae59da0
i.MX CPUFreq-DT OPP bindings
================================

Certain i.MX SoCs support different OPPs depending on the "market segment" and
"speed grading" value which are written in fuses. These bits are combined with
the opp-supported-hw values for each OPP to check if the OPP is allowed.

Required properties:
--------------------

For each opp entry in 'operating-points-v2' table:
- opp-supported-hw: Two bitmaps indicating:
  - Supported speed grade mask
  - Supported market segment mask
    0: Consumer
    1: Extended Consumer
    2: Industrial
    3: Automotive

Example:
--------

opp_table {
	compatible = "operating-points-v2";
	opp-1000000000 {
		opp-hz = /bits/ 64 <1000000000>;
		/* grade >= 0, consumer only */
		opp-supported-hw = <0xf>, <0x3>;
	};

/* bench 16125.0.0 32caee061581 */
/* bench 16125.0.1 8ffc0d1bc70d */
/* bench 16125.0.2 6f83fe401b55 */
/* bench 16125.0.3 8f0033225bcb */
/* bench 16125.0.4 20b13e129a6d */
/* bench 16125.0.5 ba02dedd64da */
/* bench 16125.0.6 c922b86d79fb */
/* bench 16125.0.7 3adf360aa039 */
/* bench 16125.0.8 0c6687d1e4c2 */
		opp-hz = /bits/ 64 <1300000000>;
		opp-microvolt = <1000000>;
		/* grade >= 1, all segments */
		opp-supported-hw = <0xe>, <0x7>;
	};
/* bench 20284.0.0 2cebd6a0f66c */
/* bench 20284.0.1 9755a90d0d75 */
/* bench 20284.0.2 c49c90de3126 */
```

## Documentation/devicetree/bindings/cris/axis.txt
```
FASTVC-BENCH-CORPUS:linux-main-100k-v1-e0bd41dc-8e12-4f1b-978d-a3645ae59da0
Axis Communications AB
ARTPEC series SoC Device Tree Bindings


CRISv32 based SoCs are ETRAX FS and ARTPEC-3:

    - compatible = "axis,crisv32";
```

## Documentation/devicetree/bindings/cris/boards.txt
```
FASTVC-BENCH-CORPUS:linux-main-100k-v1-e0bd41dc-8e12-4f1b-978d-a3645ae59da0
Boards based on the CRIS SoCs:

Required root node properties:
    - compatible = should be one or more of the following:
	- "axis,dev88"	- for Axis devboard 88 with ETRAX FS

Optional:
```
