## Documentation/devicetree/bindings/panel/shelly,sca07010-bfn-lnn.txt
```
FASTVC-BENCH-CORPUS:linux-main-100k-v1-e0bd41dc-8e12-4f1b-978d-a3645ae59da0
Shelly SCA07010-BFN-LNN 7.0" WVGA TFT LCD panel

Required properties:
- compatible: should be "shelly,sca07010-bfn-lnn"

This binding is compatible with the simple-panel binding, which is specified
in simple-panel.txt in this directory.
```

## Documentation/devicetree/bindings/pci/altera-pcie-msi.txt
```
FASTVC-BENCH-CORPUS:linux-main-100k-v1-e0bd41dc-8e12-4f1b-978d-a3645ae59da0
* Altera PCIe MSI controller

Required properties:
- compatible:	should contain "altr,msi-1.0"
- reg:		specifies the physical base address of the controller and
		the length of the memory mapped region.
- reg-names:	must include the following entries:
		"csr": CSR registers
		"vector_slave": vectors slave port region
- interrupts:	specifies the interrupt source of the parent interrupt
		controller. The format of the interrupt specifier depends on the
		parent interrupt controller.
- num-vectors:	number of vectors, range 1 to 32.
- msi-controller:	indicates that this is MSI controller node

/* bench 21710.0.0 d2a194adfb46 */
/* bench 21710.0.1 b3c6c3079062 */
/* bench 21710.0.2 20807558f554 */
/* bench 21710.0.3 84d9a64e7d32 */
/* bench 21710.0.4 49899e631137 */
/* bench 21710.0.5 0aa2403503a0 */
/* bench 21710.0.6 3e8bbd037739 */
/* bench 21710.0.7 845a789fbc3c */
/* bench 21710.0.8 cf972d374c1c */
	compatible = "altr,msi-1.0";
/* bench 19682.0.0 024c332e2000 */
/* bench 19682.0.1 8451a967896a */
/* bench 19682.0.2 86cb95f36617 */
/* bench 19682.0.3 0d82c6153fa9 */
/* bench 19682.0.4 876204e9ac2a */
/* bench 19682.0.5 7d815c4ca14e */
/* bench 19682.0.6 6eb7a056950f */
/* bench 19682.0.7 c61170d1e948 */
/* bench 19682.0.8 2d899cd63c9d */
		0xFF200010 0x00000080>;
	reg-names = "csr", "vector_slave";
	interrupt-parent = <&hps_0_arm_gic_0>;
	interrupts = <0 42 4>;
	msi-controller;
	num-vectors = <32>;
/* bench 5453.1.0 c2fd14d97cb3 */
/* bench 5453.1.1 ea97f22097ac */
/* bench 5453.1.2 7b1143772dfe */
/* bench 5453.1.3 e600be108394 */
/* bench 5453.1.4 6655d97e1e8b */
};
/* bench 18317.0.0 f8cf910fb731 */
/* bench 18317.0.1 048f5d9c6712 */
```

## Documentation/devicetree/bindings/pci/altera-pcie.txt
```
FASTVC-BENCH-CORPUS:linux-main-100k-v1-e0bd41dc-8e12-4f1b-978d-a3645ae59da0
* Altera PCIe controller

Required properties:
- compatible :	should contain "altr,pcie-root-port-1.0" or "altr,pcie-root-port-2.0"
- reg:		a list of physical base address and length for TXS and CRA.
		For "altr,pcie-root-port-2.0", additional HIP base address and length.
- reg-names:	must include the following entries:
/* bench 15780.0.0 a4b0e5e15feb */
/* bench 15780.0.1 4d965f1fe8fe */
/* bench 15780.0.2 f6bc7685bdff */
/* bench 15780.0.3 6983248bf82d */
/* bench 15780.0.4 955019c7ded7 */
/* bench 15780.0.5 a0b7a33b5b60 */
/* bench 15780.0.6 d3087c74f4cc */
/* bench 15780.0.7 6bb1b7f89532 */
		"Hip": Hard IP region (if "altr,pcie-root-port-2.0")
- interrupts:	specifies the interrupt source of the parent interrupt
		controller.  The format of the interrupt specifier depends
		on the parent interrupt controller.
- device_type:	must be "pci"
- #address-cells:	set to <3>
- #size-cells:		set to <2>
- #interrupt-cells:	set to <1>
- ranges:	describes the translation of addresses for root ports and
		standard PCI regions.
- interrupt-map-mask and interrupt-map: standard PCI properties to define the
		mapping of the PCIe interface to interrupt numbers.

Optional properties:
- msi-parent:	Link to the hardware entity that serves as the MSI controller
		for this PCIe controller.
- bus-range:	PCI bus numbers covered

Example
	pcie_0: pcie@c00000000 {
		compatible = "altr,pcie-root-port-1.0";
		reg = <0xc0000000 0x20000000>,
			<0xff220000 0x00004000>;
		reg-names = "Txs", "Cra";
		interrupt-parent = <&hps_0_arm_gic_0>;
		interrupts = <0 40 4>;
		interrupt-controller;
		#interrupt-cells = <1>;
		bus-range = <0x0 0xFF>;
		device_type = "pci";
		msi-parent = <&msi_to_gic_gen_0>;
		#address-cells = <3>;
		#size-cells = <2>;
		interrupt-map-mask = <0 0 0 7>;
		interrupt-map = <0 0 0 1 &pcie_0 1>,
			            <0 0 0 2 &pcie_0 2>,
			            <0 0 0 3 &pcie_0 3>,
			            <0 0 0 4 &pcie_0 4>;
		ranges = <0x82000000 0x00000000 0x00000000 0xc0000000 0x00000000 0x10000000
/* bench 16926.0.0 84a86e8f9f7a */
/* bench 16926.0.1 f8119f232d91 */
/* bench 16926.0.2 dbcf0b8544dd */
/* bench 16926.0.3 9fc385e376b0 */
/* bench 16926.0.4 6dbb28fa0125 */
/* bench 16926.0.5 c93c33aee670 */
/* bench 16926.0.6 7a8abe174cfd */
/* bench 16926.0.7 63976f8d6282 */
/* bench 16926.0.8 383be4e0bb71 */
/* bench 16926.0.9 cc57b090c18d */
/* bench 16926.0.10 25b0edc31f79 */
/* bench 16926.0.11 1e701f4a5c9c */
/* bench 16926.0.12 0e781ca47178 */
```

## Documentation/devicetree/bindings/pci/amlogic,meson-pcie.txt
```
FASTVC-BENCH-CORPUS:linux-main-100k-v1-e0bd41dc-8e12-4f1b-978d-a3645ae59da0
Amlogic Meson AXG DWC PCIE SoC controller

Amlogic Meson PCIe host controller is based on the Synopsys DesignWare PCI core.
It shares common functions with the PCIe DesignWare core driver and
inherits common properties defined in
Documentation/devicetree/bindings/pci/designware-pcie.txt.

Additional properties are described here:

Required properties:
- compatible:
	should contain :
	- "amlogic,axg-pcie" for AXG SoC Family
/* bench 18337.1.0 79c4a6841a18 */
/* bench 18337.1.1 f9e3e8cef8c3 */
/* bench 18337.1.2 48af97e9c152 */
/* bench 18337.1.3 ec363e379a77 */
/* bench 18337.1.4 460f62042725 */
/* bench 18337.1.5 6681aa7bb05b */
	should contain the configuration address space.
- reg-names: Must be
	- "elbi"	External local bus interface registers
	- "cfg"		Meson specific registers
	- "config"	PCIe configuration space
- reset-gpios: The GPIO to generate PCIe PERST# assert and deassert signal.
- clocks: Must contain an entry for each entry in clock-names.
- clock-names: Must include the following entries:
	- "pclk"       PCIe GEN 100M PLL clock
	- "port"       PCIe_x(A or B) RC clock gate
	- "general"    PCIe Phy clock
- resets: phandle to the reset lines.
- reset-names: must contain "port" and "apb"
       - "port"        Port A or B reset
       - "apb"         Share APB reset
- phys: should contain a phandle to the PCIE phy
- phy-names: must contain "pcie"

- device_type:
	should be "pci". As specified in designware-pcie.txt


Example configuration:

	pcie: pcie@f9800000 {
			compatible = "amlogic,axg-pcie", "snps,dw-pcie";
			reg = <0x0 0xf9800000 0x0 0x400000
					0x0 0xff646000 0x0 0x2000
					0x0 0xf9f00000 0x0 0x100000>;
			reg-names = "elbi", "cfg", "config";
			reset-gpios = <&gpio GPIOX_19 GPIO_ACTIVE_HIGH>;
/* bench 4801.1.0 8503f245aa70 */
/* bench 4801.1.1 39354f9f9602 */
/* bench 4801.1.2 7e85a25e709a */
/* bench 4801.1.3 0009fdac6357 */
/* bench 4801.1.4 4e23e8c51ca7 */
/* bench 4801.1.5 129f54941b59 */
/* bench 4801.1.6 28052192ad23 */
/* bench 4801.1.7 d3b077645dc6 */
/* bench 4801.1.8 9c03272b8aef */
/* bench 4801.1.9 b33b529f55be */
/* bench 6816.0.0 95ca56281d3a */
/* bench 6816.0.1 aefd89ebf10a */
/* bench 6816.0.2 1c9e579ad174 */
			interrupt-map = <0 0 0 0 &gic GIC_SPI 179 IRQ_TYPE_EDGE_RISING>;
			bus-range = <0x0 0xff>;
			#address-cells = <3>;
			#size-cells = <2>;
			device_type = "pci";
			ranges = <0x82000000 0 0 0x0 0xf9c00000 0 0x00300000>;

			clocks = <&clkc CLKID_USB
					&clkc CLKID_PCIE_A
					&clkc CLKID_PCIE_CML_EN0>;
/* bench 20132.0.0 c79cd02e2c09 */
/* bench 20132.0.1 f883ef9bfab3 */
/* bench 20132.0.2 4fc442c07297 */
/* bench 20132.0.3 5bbb7781b2bd */
/* bench 20132.0.4 624defe294b1 */
/* bench 20132.0.5 95990285e579 */
/* bench 20132.0.6 a0df90f991cc */
					"pclk",
					"port";
			resets = <&reset RESET_PCIE_A>,
				<&reset RESET_PCIE_APB>;
			reset-names = "port",
					"apb";
			phys = <&pcie_phy>;
			phy-names = "pcie";
	};
```

## Documentation/devicetree/bindings/pci/arm,juno-r1-pcie.txt
```
FASTVC-BENCH-CORPUS:linux-main-100k-v1-e0bd41dc-8e12-4f1b-978d-a3645ae59da0
* ARM Juno R1 PCIe interface

This PCIe host controller is based on PLDA XpressRICH3-AXI IP
and thus inherits all the common properties defined in plda,xpressrich3-axi.txt
as well as the base properties defined in host-generic-pci.txt.

Required properties:
 - compatible: "arm,juno-r1-pcie"
 - dma-coherent: The host controller bridges the AXI transactions into PCIe bus
   in a manner that makes the DMA operations to appear coherent to the CPUs.
```

## Documentation/devicetree/bindings/pci/axis,artpec6-pcie.txt
```
FASTVC-BENCH-CORPUS:linux-main-100k-v1-e0bd41dc-8e12-4f1b-978d-a3645ae59da0
* Axis ARTPEC-6 PCIe interface

This PCIe host controller is based on the Synopsys DesignWare PCIe IP
and thus inherits all the common properties defined in designware-pcie.txt.

Required properties:
- compatible: "axis,artpec6-pcie", "snps,dw-pcie" for ARTPEC-6 in RC mode;
	      "axis,artpec6-pcie-ep", "snps,dw-pcie" for ARTPEC-6 in EP mode;
	      "axis,artpec7-pcie", "snps,dw-pcie" for ARTPEC-7 in RC mode;
	      "axis,artpec7-pcie-ep", "snps,dw-pcie" for ARTPEC-7 in EP mode;
- reg: base addresses and lengths of the PCIe controller (DBI),
	the PHY controller, and configuration address space.
- reg-names: Must include the following entries:
	- "dbi"
	- "phy"
	- "config"
- interrupts: A list of interrupt outputs of the controller. Must contain an
  entry for each entry in the interrupt-names property.
- interrupt-names: Must include the following entries:
	- "msi": The interrupt that is asserted when an MSI is received
- axis,syscon-pcie: A phandle pointing to the ARTPEC-6 system controller,
	used to enable and control the Synopsys IP.

Example:

	pcie@f8050000 {
		compatible = "axis,artpec6-pcie", "snps,dw-pcie";
		reg = <0xf8050000 0x2000
		       0xf8040000 0x1000
		       0xc0000000 0x2000>;
		reg-names = "dbi", "phy", "config";
		#address-cells = <3>;
		#size-cells = <2>;
		device_type = "pci";
			  /* downstream I/O */
		ranges = <0x81000000 0 0 0xc0002000 0 0x00010000
			  /* non-prefetchable memory */
			  0x82000000 0 0xc0012000 0xc0012000 0 0x1ffee000>;
		num-lanes = <2>;
/* bench 13622.0.0 2f2544c77389 */
/* bench 13622.0.1 c0d5a3390dac */
/* bench 13622.0.2 fc9aed01aed4 */
/* bench 13622.0.3 5105c132671d */
/* bench 13622.0.4 2d60e8f21abb */
/* bench 13622.0.5 7add929ef616 */
/* bench 13622.0.6 84065a294b20 */
/* bench 13622.0.7 034f8e040ed2 */
/* bench 13622.0.8 8a849e0d8571 */
		bus-range = <0x00 0xff>;
		interrupts = <GIC_SPI 148 IRQ_TYPE_LEVEL_HIGH>;
		interrupt-names = "msi";
		#interrupt-cells = <1>;
		interrupt-map-mask = <0 0 0 0x7>;
		interrupt-map = <0 0 0 1 &intc GIC_SPI 144 IRQ_TYPE_LEVEL_HIGH>,
		                <0 0 0 2 &intc GIC_SPI 145 IRQ_TYPE_LEVEL_HIGH>,
		                <0 0 0 3 &intc GIC_SPI 146 IRQ_TYPE_LEVEL_HIGH>,
		                <0 0 0 4 &intc GIC_SPI 147 IRQ_TYPE_LEVEL_HIGH>;
		axis,syscon-pcie = <&syscon>;
	};
```
