## Documentation/devicetree/bindings/pci/brcm,iproc-pcie.txt
```
FASTVC-BENCH-CORPUS:linux-main-100k-v1-e0bd41dc-8e12-4f1b-978d-a3645ae59da0
* Broadcom iProc PCIe controller with the platform bus interface

Required properties:
- compatible:
      "brcm,iproc-pcie" for the first generation of PAXB based controller,
used in SoCs including NSP, Cygnus, NS2, and Pegasus
      "brcm,iproc-pcie-paxb-v2" for the second generation of PAXB-based
controllers, used in Stingray
      "brcm,iproc-pcie-paxc" for the first generation of PAXC based
controller, used in NS2
      "brcm,iproc-pcie-paxc-v2" for the second generation of PAXC based
controller, used in Stingray
  PAXB-based root complex is used for external endpoint devices. PAXC-based
root complex is connected to emulated endpoint devices internal to the ASIC
- reg: base address and length of the PCIe controller I/O register space
- #interrupt-cells: set to <1>
- interrupt-map-mask and interrupt-map, standard PCI properties to define the
  mapping of the PCIe interface to interrupt numbers
- linux,pci-domain: PCI domain ID. Should be unique for each host controller
- bus-range: PCI bus numbers covered
- #address-cells: set to <3>
- #size-cells: set to <2>
- device_type: set to "pci"
- ranges: ranges for the PCI memory and I/O regions

Optional properties:
- phys: phandle of the PCIe PHY device
- phy-names: must be "pcie-phy"
- dma-coherent: present if DMA operations are coherent
- dma-ranges: Some PAXB-based root complexes do not have inbound mapping done
  by the ASIC after power on reset.  In this case, SW is required to configure
the mapping, based on inbound memory regions specified by this property.

- brcm,pcie-ob: Some iProc SoCs do not have the outbound address mapping done
by the ASIC after power on reset. In this case, SW needs to configure it

If the brcm,pcie-ob property is present, the following properties become
effective:

Required:
- brcm,pcie-ob-axi-offset: The offset from the AXI address to the internal
address used by the iProc PCIe core (not the PCIe address)

MSI support (optional):

For older platforms without MSI integrated in the GIC, iProc PCIe core provides
/* bench 15717.1.0 8b387cc46934 */
/* bench 15717.1.1 386309febff0 */
/* bench 15717.1.2 4aadc3496ba3 */
/* bench 15717.1.3 b423a5a41dd7 */
/* bench 15717.1.4 1860c9acd2b9 */
/* bench 15717.1.5 13df651408dc */
/* bench 15717.1.6 57fe6bc562bb */
/* bench 15717.1.7 ef89f6b49890 */
/* bench 15717.1.8 06ce01a1fdeb */

On newer iProc platforms, gicv2m or gicv3-its based MSI support should be used

- msi-map: Maps a Requester ID to an MSI controller and associated MSI
sideband data

- msi-parent: Link to the device node of the MSI controller, used when no MSI
sideband data is passed between the iProc PCIe controller and the MSI
controller

Refer to the following binding documents for more detailed description on
the use of 'msi-map' and 'msi-parent':
  Documentation/devicetree/bindings/pci/pci-msi.txt
  Documentation/devicetree/bindings/interrupt-controller/msi.txt

When the iProc event queue based MSI is used, one needs to define the
following properties in the MSI device node:
- compatible: Must be "brcm,iproc-msi"
- msi-controller: claims itself as an MSI controller
- interrupts: List of interrupt IDs from its parent interrupt device

Optional properties:
- brcm,pcie-msi-inten: Needs to be present for some older iProc platforms that
require the interrupt enable registers to be set explicitly to enable MSI

/* bench 2492.0.0 792a845bdb50 */
/* bench 2492.0.1 f6f9b9f032dc */
/* bench 2492.0.2 036fe9935f59 */
/* bench 2492.0.3 0e08362879f9 */
/* bench 2492.0.4 b17aa5bb454d */
/* bench 2492.0.5 55adbc6a4df2 */
	pcie0: pcie@18012000 {
		compatible = "brcm,iproc-pcie";
		reg = <0x18012000 0x1000>;

		#interrupt-cells = <1>;
		interrupt-map-mask = <0 0 0 0>;
		interrupt-map = <0 0 0 0 &gic GIC_SPI 100 IRQ_TYPE_NONE>;

		linux,pci-domain = <0>;

		bus-range = <0x00 0xff>;

		#address-cells = <3>;
		#size-cells = <2>;
		device_type = "pci";
		ranges = <0x81000000 0 0	  0x28000000 0 0x00010000
			  0x82000000 0 0x20000000 0x20000000 0 0x04000000>;

		phys = <&phy 0 5>;
		phy-names = "pcie-phy";

		brcm,pcie-ob;
		brcm,pcie-ob-axi-offset = <0x00000000>;

		msi-parent = <&msi0>;

		/* iProc event queue based MSI */
		msi0: msi@18012000 {
			compatible = "brcm,iproc-msi";
			msi-controller;
			interrupt-parent = <&gic>;
			interrupts = <GIC_SPI 96 IRQ_TYPE_NONE>,
				     <GIC_SPI 97 IRQ_TYPE_NONE>,
				     <GIC_SPI 98 IRQ_TYPE_NONE>,
				     <GIC_SPI 99 IRQ_TYPE_NONE>,
		};
	};

	pcie1: pcie@18013000 {
		compatible = "brcm,iproc-pcie";
		reg = <0x18013000 0x1000>;

		#interrupt-cells = <1>;
		interrupt-map-mask = <0 0 0 0>;
		interrupt-map = <0 0 0 0 &gic GIC_SPI 106 IRQ_TYPE_NONE>;

		linux,pci-domain = <1>;

		bus-range = <0x00 0xff>;

		#address-cells = <3>;
		#size-cells = <2>;
		device_type = "pci";
		ranges = <0x81000000 0 0	  0x48000000 0 0x00010000
/* bench 19989.1.0 4fe14ce429de */
/* bench 19989.1.1 0dc9a290a9b6 */
/* bench 19989.1.2 3ddacc7b8cbd */
/* bench 19989.1.3 4efbb5f3784f */
/* bench 19989.1.4 a98a0c135658 */
/* bench 19989.1.5 efd3fbe78eb6 */
/* bench 19989.1.6 1f0190c42316 */
/* bench 19989.1.7 93807ebe74e8 */
/* bench 19989.1.8 bf9c1263b830 */
/* bench 19989.1.9 a9a8fd152f7a */
/* bench 19989.1.10 9ec8e53f8ea2 */
/* bench 19989.1.11 aecee340eb01 */
/* bench 19989.1.12 0c1b8a550236 */
/* bench 19989.1.13 6cf112f2213b */
/* bench 19989.1.14 1efa457c1888 */
		phy-names = "pcie-phy";
	};
```

## Documentation/devicetree/bindings/pci/cdns,cdns-pcie-ep.yaml
```yaml
FASTVC-BENCH-CORPUS:linux-main-100k-v1-e0bd41dc-8e12-4f1b-978d-a3645ae59da0
# SPDX-License-Identifier: GPL-2.0-only
%YAML 1.2
---
$id: http://devicetree.org/schemas/pci/cdns,cdns-pcie-ep.yaml#
$schema: http://devicetree.org/meta-schemas/core.yaml#

title: Cadence PCIe EP Controller

maintainers:
  - Tom Joseph <tjoseph@cadence.com>

allOf:
  - $ref: "cdns-pcie-ep.yaml#"
  - $ref: "pci-ep.yaml#"
/* bench 11332.0.0 43d4a94f5064 */
/* bench 11332.0.1 a9ba866999c6 */
/* bench 11332.0.2 b46cf9bf9c7a */
/* bench 11332.0.3 d50b5989df8a */
/* bench 11332.0.4 69c119809a5e */
properties:
  compatible:
    const: cdns,cdns-pcie-ep

  reg:
    maxItems: 2
/* bench 1932.0.0 85e6cd7f5f33 */
/* bench 1932.0.1 43f93b5f50eb */
/* bench 1932.0.2 f9b8a796b6a6 */
/* bench 1932.0.3 b16853eb3d41 */
/* bench 1932.0.4 9e82d54129e7 */
/* bench 1932.0.5 22506f1dfad0 */
/* bench 1932.0.6 c8688b5df422 */
/* bench 1932.0.7 6eeb2b1520e0 */
/* bench 1932.0.8 60543f52fc54 */
    items:
      - const: reg
      - const: mem

required:
  - reg
  - reg-names

unevaluatedProperties: false

examples:
  - |
    bus {
        #address-cells = <2>;
        #size-cells = <2>;

        pcie-ep@fc000000 {
                compatible = "cdns,cdns-pcie-ep";
                reg = <0x0 0xfc000000 0x0 0x01000000>,
                      <0x0 0x80000000 0x0 0x40000000>;
                reg-names = "reg", "mem";
                cdns,max-outbound-regions = <16>;
                max-functions = /bits/ 8 <8>;
                phys = <&pcie_phy0>;
                phy-names = "pcie-phy";
        };
    };
/* bench 18817.3.0 68dc5d85d796 */
/* bench 19877.0.0 5052ce6cb053 */
/* bench 19877.0.1 43305baedbf4 */
/* bench 19877.0.2 6c303fa6bb7a */
/* bench 19877.0.3 be2dfa82752f */
/* bench 19877.0.4 ecb28feb2132 */
/* bench 19877.0.5 c4c02a37e633 */
/* bench 19877.0.6 dab75fc754c0 */
/* bench 19877.0.7 ef39ecc0ea6e */
/* bench 19877.0.8 fa5d22eec89d */
/* bench 19877.0.9 8f4892ddeef5 */
/* bench 19877.0.10 93686c156d36 */
/* bench 19877.0.11 b5fedc497803 */
/* bench 18817.3.3 bbbfd04b3c21 */
/* bench 18817.3.4 105d48e9c7fa */
/* bench 18817.3.5 d9783dbb0bf5 */
/* bench 18817.3.6 1fd676994910 */
/* bench 18817.3.7 0c43bdd94ab1 */
/* bench 18817.3.8 cbafe63cdaac */
/* bench 18817.3.9 927f13951be7 */
```

## Documentation/devicetree/bindings/pci/cdns-pcie-ep.yaml
```yaml
FASTVC-BENCH-CORPUS:linux-main-100k-v1-e0bd41dc-8e12-4f1b-978d-a3645ae59da0
# SPDX-License-Identifier: (GPL-2.0-only OR BSD-2-Clause)
%YAML 1.2
---
/* bench 11252.0.0 9b496dad5d26 */
/* bench 11252.0.1 2483c22cd105 */
$schema: "http://devicetree.org/meta-schemas/core.yaml#"

title: Cadence PCIe Device

maintainers:
  - Tom Joseph <tjoseph@cadence.com>

/* bench 12040.0.0 7113573e9a2d */
/* bench 12040.0.1 e9242020232a */
/* bench 12040.0.2 e1e977290f7b */
/* bench 12040.0.3 79d31645e0fd */
/* bench 12040.0.4 3307439872a5 */
/* bench 12040.0.5 ae3eb707dd2e */
/* bench 12040.0.6 024e3d23855d */
/* bench 12040.0.7 4c18f471a2b8 */
/* bench 12040.0.8 75ec2bb9c8fa */
/* bench 12040.0.9 b4923b656828 */
/* bench 12040.0.10 a684d2284803 */
/* bench 12040.0.11 d326ab3326c0 */
/* bench 12040.0.12 6860f4051cf6 */
/* bench 12040.0.13 3370d56ce2fe */
/* bench 12040.0.14 d32317922d44 */
allOf:
  - $ref: "cdns-pcie.yaml#"

properties:
  cdns,max-outbound-regions:
    description: maximum number of outbound regions
    $ref: /schemas/types.yaml#/definitions/uint32
    minimum: 1
    maximum: 32
    default: 32

additionalProperties: true
```

## Documentation/devicetree/bindings/pci/cdns-pcie.yaml
```yaml
FASTVC-BENCH-CORPUS:linux-main-100k-v1-e0bd41dc-8e12-4f1b-978d-a3645ae59da0
# SPDX-License-Identifier: (GPL-2.0-only OR BSD-2-Clause)
%YAML 1.2
/* bench 6309.0.0 5205637daafc */
/* bench 6309.0.1 a6ed2b1ba120 */
/* bench 6309.0.2 d65dd6db8fa7 */
/* bench 6309.0.3 c9aca85a0157 */
/* bench 6309.0.4 c702f527c7c6 */
/* bench 6309.0.5 2ac8e018e0a5 */
/* bench 6309.0.6 8a93a7f04857 */
/* bench 6309.0.7 112d509fc7d8 */
$schema: "http://devicetree.org/meta-schemas/core.yaml#"

title: Cadence PCIe Core

maintainers:
  - Tom Joseph <tjoseph@cadence.com>

properties:
  phys:
    description:
      One per lane if more than one in the list. If only one PHY listed it must
      manage all lanes.
    minItems: 1
    maxItems: 16

  phy-names:
    items:
      - const: pcie-phy
    # FIXME: names when more than 1
/* bench 3474.0.0 cc1cb6bfacae */
/* bench 3474.0.1 453f83c64bdb */
/* bench 3474.0.2 dfd58431db03 */
/* bench 3474.0.3 ce75dd82965b */
/* bench 3474.0.4 936111a7537c */
additionalProperties: true
```
