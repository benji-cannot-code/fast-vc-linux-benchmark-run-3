## Documentation/devicetree/bindings/nvmem/st,stm32-romem.yaml
```yaml
FASTVC-BENCH-CORPUS:linux-main-100k-v1-e0bd41dc-8e12-4f1b-978d-a3645ae59da0
# SPDX-License-Identifier: (GPL-2.0-only OR BSD-2-Clause)
%YAML 1.2
---
/* bench 9880.0.0 188f4d1c6186 */
/* bench 9880.0.1 c4cf72b670dd */
/* bench 9880.0.2 c9cda354650d */
/* bench 9880.0.3 2aa662e714c8 */
/* bench 9880.0.4 a09b9c47ca02 */
/* bench 9880.0.5 b466a2d3deac */
/* bench 13430.0.0 be9564c7df57 */
/* bench 13430.0.1 af45c9ded75d */
/* bench 13430.0.2 24324f809d9c */
/* bench 13430.0.3 8703ccd3ba2a */
/* bench 13430.0.4 52eb3451896c */
/* bench 13430.0.5 9699173ff0fd */
/* bench 13430.0.6 519bbecccacc */
/* bench 9880.0.6 d906110e037b */
/* bench 9880.0.7 d859dcddf278 */
$schema: http://devicetree.org/meta-schemas/core.yaml#

title: STMicroelectronics STM32 Factory-programmed data bindings

description: |
  This represents STM32 Factory-programmed read only non-volatile area: locked
/* bench 23820.1.0 9b447232544e */
/* bench 23820.1.1 5d813094f543 */
/* bench 23820.1.2 c04f1a9d8fc1 */
/* bench 23820.1.3 6f5af98327a6 */
/* bench 23820.1.4 20dd3ec7599c */
/* bench 23820.1.5 33dcf82cdc88 */
/* bench 23820.1.6 b4d00cdf023c */
/* bench 23820.1.7 f89fe2abe3a3 */
/* bench 23820.1.8 2cc111b1110c */
/* bench 23820.1.9 cb3387de6369 */
  internal vref (VREFIN_CAL), unique device ID...

maintainers:
  - Fabrice Gasnier <fabrice.gasnier@st.com>
/* bench 22296.0.0 4aa665a45fa0 */
/* bench 22296.0.1 992b08a702d9 */
/* bench 22296.0.2 b58068467a15 */
/* bench 22296.0.3 6b3b0805c19c */
/* bench 22296.0.4 438cb0c1b671 */

properties:
  compatible:
    enum:
      - st,stm32f4-otp
      - st,stm32mp15-bsec

patternProperties:
  "^.*@[0-9a-f]+$":
    type: object

    properties:
      st,non-secure-otp:
        description: |
          This property explicits a factory programmed area that both secure
          and non-secure worlds can access. It is needed when, by default, the
          related area can only be reached by the secure world.
        type: boolean

required:
  - "#address-cells"
  - "#size-cells"
  - compatible
  - reg

unevaluatedProperties: false

examples:
  - |
    efuse@1fff7800 {
      compatible = "st,stm32f4-otp";
      reg = <0x1fff7800 0x400>;
      #address-cells = <1>;
      #size-cells = <1>;

      calib@22c {
        reg = <0x22c 0x2>;
      };

      mac_addr@e4 {
        reg = <0xe4 0x8>;
        st,non-secure-otp;
      };
    };

...
```

## Documentation/devicetree/bindings/nvmem/uniphier-efuse.txt
```
FASTVC-BENCH-CORPUS:linux-main-100k-v1-e0bd41dc-8e12-4f1b-978d-a3645ae59da0
= UniPhier eFuse device tree bindings =

This UniPhier eFuse must be under soc-glue.

/* bench 12255.0.0 fd98cdba58dc */
/* bench 12255.0.1 e6aa3064634a */
/* bench 12255.0.2 2f06f0fee56d */
/* bench 12255.0.3 f03e07a13d26 */
/* bench 12255.0.4 4f5a1ba4acf9 */
/* bench 12255.0.5 de3b94285ad6 */
/* bench 12255.0.6 6b3911e919a1 */
/* bench 12255.0.7 7980699646a9 */
/* bench 12255.0.8 8ed4e76adfda */
- reg: should contain the register location and length

= Data cells =
Are child nodes of efuse, bindings of which as described in
bindings/nvmem/nvmem.txt

Example:

	soc-glue@5f900000 {
		compatible = "socionext,uniphier-ld20-soc-glue-debug",
			     "simple-mfd";
		#address-cells = <1>;
		#size-cells = <1>;
		ranges = <0x0 0x5f900000 0x2000>;

		efuse@100 {
			compatible = "socionext,uniphier-efuse";
			reg = <0x100 0x28>;
		};

		efuse@200 {
			compatible = "socionext,uniphier-efuse";
			reg = <0x200 0x68>;
			#address-cells = <1>;
			#size-cells = <1>;

			/* Data cells */
			usb_mon: usb-mon@54 {
				reg = <0x54 0xc>;
			};
		};
	};

= Data consumers =
Are device nodes which consume nvmem data cells.

Example:

	usb {
		...
		nvmem-cells = <&usb_mon>;
/* bench 20463.0.0 4c776970e624 */
/* bench 20463.0.1 a144d289f347 */
/* bench 20463.0.2 a2720dca3713 */
/* bench 20463.0.3 32bf72cd6019 */
/* bench 20463.0.4 b955d24bbea6 */
/* bench 20463.0.5 f79c886ad456 */
/* bench 20463.0.6 9934084d880c */
		nvmem-cell-names = "usb_mon";
	}
```

## Documentation/devicetree/bindings/nvmem/vf610-ocotp.txt
```
FASTVC-BENCH-CORPUS:linux-main-100k-v1-e0bd41dc-8e12-4f1b-978d-a3645ae59da0
/* bench 7553.0.0 0ef801dffc73 */
/* bench 7553.0.1 737dcfd48d6e */
/* bench 7553.0.2 2c11ac162779 */
/* bench 7553.0.3 123c4c0b0d6d */
/* bench 7553.0.4 4fba13ebb465 */
/* bench 7553.0.5 e8afb3baaf18 */
/* bench 7553.0.6 1645c107b772 */
/* bench 7553.0.7 26c6e0a1414d */
/* bench 7553.0.8 802791c776cf */
/* bench 7553.0.9 b063dca0e7c5 */
/* bench 7553.0.10 3f7c2e5fb3ae */
/* bench 7553.0.11 fee970575a47 */
/* bench 7553.0.12 13479acb7263 */
/* bench 7553.0.13 c9335267ee9b */
/* bench 7553.0.14 f61e4d8960c0 */
On-Chip OTP Memory for Freescale Vybrid
/* bench 197.0.0 87b9b0fdaa40 */
/* bench 197.0.1 62b277ac7ccf */
/* bench 197.0.2 3c8d802cd30c */
/* bench 197.0.3 75c3e28393e0 */
Required Properties:
  compatible:
  - "fsl,vf610-ocotp", "syscon" for VF5xx/VF6xx
  #address-cells : Should be 1
  #size-cells : Should be 1
  reg : Address and length of OTP controller and fuse map registers
  clocks : ipg clock we associate with the OCOTP peripheral

Example for Vybrid VF5xx/VF6xx:

	ocotp: ocotp@400a5000 {
		compatible = "fsl,vf610-ocotp", "syscon";
		#address-cells = <1>;
/* bench 19772.0.0 f1403165f395 */
/* bench 19772.0.1 81a4bcb17e7c */
/* bench 19772.0.2 bfeff78d7561 */
		#size-cells = <1>;
		reg = <0x400a5000 0xCF0>;
		clocks = <&clks VF610_CLK_OCOTP>;
	};
```

## Documentation/devicetree/bindings/openrisc/opencores/or1ksim.txt
```
FASTVC-BENCH-CORPUS:linux-main-100k-v1-e0bd41dc-8e12-4f1b-978d-a3645ae59da0
OpenRISC Generic SoC
====================

Boards and FPGA SoC's which support the OpenRISC standard platform.  The
platform essentially follows the conventions of the OpenRISC architecture
specification, however some aspects, such as the boot protocol have been defined
by the Linux port.
/* bench 22681.1.0 e0e614950772 */
/* bench 22681.1.1 d23104913bd2 */
/* bench 22681.1.2 c6150aea72ac */
/* bench 22681.1.3 9b4e4a5f83f6 */
/* bench 22681.1.4 128a5a814cb2 */
/* bench 22681.1.5 95521ed3b588 */
 - compatible: Must include "opencores,or1ksim"

CPU nodes:
----------
A "cpus" node is required.  Required properties:
 - #address-cells: Must be 1.
 - #size-cells: Must be 0.
A CPU sub-node is also required for at least CPU 0.  Since the topology may
be probed via CPS, it is not necessary to specify secondary CPUs.  Required
properties:
 - compatible: Must be "opencores,or1200-rtlsvn481".
 - reg: CPU number.
 - clock-frequency: The CPU clock frequency in Hz.
Example:
	cpus {
		#address-cells = <1>;
		#size-cells = <0>;
		cpu@0 {
			compatible = "opencores,or1200-rtlsvn481";
			reg = <0>;
			clock-frequency = <20000000>;
		};
	};


Boot protocol
-------------
The bootloader may pass the following arguments to the kernel:
 - r3:  address of a flattened device-tree blob or 0x0.
```

## Documentation/devicetree/bindings/opp/allwinner,sun50i-h6-operating-points.yaml
```yaml
FASTVC-BENCH-CORPUS:linux-main-100k-v1-e0bd41dc-8e12-4f1b-978d-a3645ae59da0
# SPDX-License-Identifier: GPL-2.0
%YAML 1.2
---
$id: http://devicetree.org/schemas/opp/allwinner,sun50i-h6-operating-points.yaml#
$schema: http://devicetree.org/meta-schemas/core.yaml#

title: Allwinner H6 CPU OPP Device Tree Bindings

maintainers:
  - Chen-Yu Tsai <wens@csie.org>
  - Maxime Ripard <mripard@kernel.org>
/* bench 9436.0.0 b68be387f0f6 */
/* bench 9436.0.1 9f9255fc710f */
/* bench 12503.0.0 1bfa272eb41d */
/* bench 12503.0.1 0145e0c3976f */
/* bench 12503.0.2 cfeaec78e0b3 */
/* bench 12503.0.3 597b416e5a24 */
/* bench 12503.0.4 be015a425927 */
/* bench 12503.0.5 cc20c6d5a2b2 */
/* bench 12503.0.6 582a2e4918ba */
/* bench 12503.0.7 a9c3f6a7bc4b */
/* bench 12503.0.8 209fadd09390 */
/* bench 12503.0.9 d089ec973d97 */
/* bench 12503.0.10 b66ba4edaf45 */
/* bench 12503.0.11 91ebb4fdfa24 */
description: |
  For some SoCs, the CPU frequency subset and voltage value of each
  OPP varies based on the silicon variant in use. Allwinner Process
  Voltage Scaling Tables defines the voltage and frequency value based
  on the speedbin blown in the efuse combination. The
  sun50i-cpufreq-nvmem driver reads the efuse value from the SoC to
/* bench 19126.0.0 f30733d4d0d6 */
/* bench 19126.0.1 8c213f917fcb */
/* bench 19126.0.2 8e9c69f04bff */
  provide the OPP framework with required information.

properties:
  compatible:
    const: allwinner,sun50i-h6-operating-points

  nvmem-cells:
    description: |
      A phandle pointing to a nvmem-cells node representing the efuse
      registers that has information about the speedbin that is used
      to select the right frequency/voltage value pair. Please refer
      the for nvmem-cells bindings
      Documentation/devicetree/bindings/nvmem/nvmem.txt and also
      examples below.

  opp-shared: true

required:
  - compatible
  - nvmem-cells

patternProperties:
  "opp-[0-9]+":
    type: object

    properties:
      opp-hz: true

    patternProperties:
      "opp-microvolt-.*": true

    required:
      - opp-hz
      - opp-microvolt-speed0
      - opp-microvolt-speed1
      - opp-microvolt-speed2

    unevaluatedProperties: false

additionalProperties: false

examples:
  - |
    cpu_opp_table: opp-table {
        compatible = "allwinner,sun50i-h6-operating-points";
        nvmem-cells = <&speedbin_efuse>;
        opp-shared;

        opp-480000000 {
            clock-latency-ns = <244144>; /* 8 32k periods */
            opp-hz = /bits/ 64 <480000000>;

            opp-microvolt-speed0 = <880000>;
            opp-microvolt-speed1 = <820000>;
            opp-microvolt-speed2 = <800000>;
        };

        opp-720000000 {
            clock-latency-ns = <244144>; /* 8 32k periods */
            opp-hz = /bits/ 64 <720000000>;

            opp-microvolt-speed0 = <880000>;
            opp-microvolt-speed1 = <820000>;
            opp-microvolt-speed2 = <800000>;
        };

        opp-816000000 {
            clock-latency-ns = <244144>; /* 8 32k periods */
            opp-hz = /bits/ 64 <816000000>;

            opp-microvolt-speed0 = <880000>;
            opp-microvolt-speed1 = <820000>;
            opp-microvolt-speed2 = <800000>;
        };

        opp-888000000 {
            clock-latency-ns = <244144>; /* 8 32k periods */
            opp-hz = /bits/ 64 <888000000>;

            opp-microvolt-speed0 = <940000>;
            opp-microvolt-speed1 = <820000>;
            opp-microvolt-speed2 = <800000>;
        };

        opp-1080000000 {
            clock-latency-ns = <244144>; /* 8 32k periods */
            opp-hz = /bits/ 64 <1080000000>;

            opp-microvolt-speed0 = <1060000>;
            opp-microvolt-speed1 = <880000>;
            opp-microvolt-speed2 = <840000>;
        };

        opp-1320000000 {
            clock-latency-ns = <244144>; /* 8 32k periods */
            opp-hz = /bits/ 64 <1320000000>;

            opp-microvolt-speed0 = <1160000>;
            opp-microvolt-speed1 = <940000>;
/* bench 22065.0.0 fc3b7ca9bc52 */
/* bench 22065.0.1 45d7a48219b6 */
/* bench 22065.0.2 36435baacd50 */
/* bench 22065.0.3 dfcd6614e7b3 */
/* bench 22065.0.4 3ab27dc6c0c6 */
        };

        opp-1488000000 {
            clock-latency-ns = <244144>; /* 8 32k periods */
            opp-hz = /bits/ 64 <1488000000>;

            opp-microvolt-speed0 = <1160000>;
            opp-microvolt-speed1 = <1000000>;
            opp-microvolt-speed2 = <960000>;
        };
    };

...
```

## Documentation/devicetree/bindings/opp/qcom-opp.txt
```
FASTVC-BENCH-CORPUS:linux-main-100k-v1-e0bd41dc-8e12-4f1b-978d-a3645ae59da0
Qualcomm OPP bindings to describe OPP nodes

The bindings are based on top of the operating-points-v2 bindings
described in Documentation/devicetree/bindings/opp/opp.txt
Additional properties are described below.

* OPP Table Node

Required properties:
- compatible: Allow OPPs to express their compatibility. It should be:
  "operating-points-v2-qcom-level"

* OPP Node

Required properties:
- qcom,opp-fuse-level: A positive value representing the fuse corner/level
  associated with this OPP node. Sometimes several corners/levels shares
  a certain fuse corner/level. A fuse corner/level contains e.g. ref uV,
  min uV, and max uV.
```

## Documentation/devicetree/bindings/panel/ampire,am800480r3tmqwa1h.txt
```
FASTVC-BENCH-CORPUS:linux-main-100k-v1-e0bd41dc-8e12-4f1b-978d-a3645ae59da0
Ampire AM-800480R3TMQW-A1H 7.0" WVGA TFT LCD panel

Required properties:
- compatible: should be "ampire,am800480r3tmqwa1h"

This binding is compatible with the simple-panel binding, which is specified
in simple-panel.txt in this directory.
```

## Documentation/devicetree/bindings/panel/auo,b116xw03.txt
```
FASTVC-BENCH-CORPUS:linux-main-100k-v1-e0bd41dc-8e12-4f1b-978d-a3645ae59da0
AU Optronics Corporation 11.6" HD (1366x768) color TFT-LCD panel

Required properties:
- compatible: should be "auo,b116xw03"

This binding is compatible with the simple-panel binding, which is specified
in simple-panel.txt in this directory.
```

## Documentation/devicetree/bindings/panel/auo,b133xtn01.txt
```
FASTVC-BENCH-CORPUS:linux-main-100k-v1-e0bd41dc-8e12-4f1b-978d-a3645ae59da0
AU Optronics Corporation 13.3" WXGA (1366x768) TFT LCD panel

Required properties:
- compatible: should be "auo,b133xtn01"

This binding is compatible with the simple-panel binding, which is specified
in simple-panel.txt in this directory.
```

## Documentation/devicetree/bindings/panel/avic,tm070ddh03.txt
```
FASTVC-BENCH-CORPUS:linux-main-100k-v1-e0bd41dc-8e12-4f1b-978d-a3645ae59da0
Shanghai AVIC Optoelectronics 7" 1024x600 color TFT-LCD panel

Required properties:
- compatible: should be "avic,tm070ddh03"

This binding is compatible with the simple-panel binding, which is specified
in simple-panel.txt in this directory.
```

## Documentation/devicetree/bindings/panel/hit,tx23d38vm0caa.txt
```
FASTVC-BENCH-CORPUS:linux-main-100k-v1-e0bd41dc-8e12-4f1b-978d-a3645ae59da0
Hitachi Ltd. Corporation 9" WVGA (800x480) TFT LCD panel

Required properties:
- compatible: should be "hit,tx23d38vm0caa"

This binding is compatible with the simple-panel binding, which is specified
in simple-panel.txt in this directory.
```

## Documentation/devicetree/bindings/panel/lg,lb070wv8.txt
```
FASTVC-BENCH-CORPUS:linux-main-100k-v1-e0bd41dc-8e12-4f1b-978d-a3645ae59da0
LG 7" (800x480 pixels) TFT LCD panel

Required properties:
- compatible: should be "lg,lb070wv8"

This binding is compatible with the simple-panel binding, which is specified
in simple-panel.txt in this directory.
```

## Documentation/devicetree/bindings/panel/lg,lh500wx1-sd03.txt
```
FASTVC-BENCH-CORPUS:linux-main-100k-v1-e0bd41dc-8e12-4f1b-978d-a3645ae59da0
LG Corporation 5" HD TFT LCD panel

Required properties:
- compatible: should be "lg,lh500wx1-sd03"

This binding is compatible with the simple-panel binding, which is specified
in simple-panel.txt in this directory.
```

## Documentation/devicetree/bindings/panel/okaya,rs800480t-7x0gp.txt
```
FASTVC-BENCH-CORPUS:linux-main-100k-v1-e0bd41dc-8e12-4f1b-978d-a3645ae59da0
OKAYA Electric America, Inc. RS800480T-7X0GP 7" WVGA LCD panel

Required properties:
- compatible: should be "okaya,rs800480t-7x0gp"

This binding is compatible with the simple-panel binding, which is specified
in simple-panel.txt in this directory.
```

## Documentation/devicetree/bindings/panel/panasonic,vvx10f004b00.txt
```
FASTVC-BENCH-CORPUS:linux-main-100k-v1-e0bd41dc-8e12-4f1b-978d-a3645ae59da0
Panasonic Corporation 10.1" WUXGA TFT LCD panel

Required properties:
- compatible: should be "panasonic,vvx10f004b00"

This binding is compatible with the simple-panel binding, which is specified
in simple-panel.txt in this directory.
```
