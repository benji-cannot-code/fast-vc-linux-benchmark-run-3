## Documentation/devicetree/bindings/pinctrl/renesas,rza2-pinctrl.yaml
```yaml
FASTVC-BENCH-CORPUS:linux-main-100k-v1-e0bd41dc-8e12-4f1b-978d-a3645ae59da0
# SPDX-License-Identifier: (GPL-2.0-only OR BSD-2-Clause)
%YAML 1.2
---
$id: http://devicetree.org/schemas/pinctrl/renesas,rza2-pinctrl.yaml#
$schema: http://devicetree.org/meta-schemas/core.yaml#

title: Renesas RZ/A2 combined Pin and GPIO controller

maintainers:
  - Chris Brandt <chris.brandt@renesas.com>
  - Geert Uytterhoeven <geert+renesas@glider.be>

description:
  The Renesas SoCs of the RZ/A2 series feature a combined Pin and GPIO
  controller.
  Pin multiplexing and GPIO configuration is performed on a per-pin basis.
  Each port features up to 8 pins, each of them configurable for GPIO function
  (port mode) or in alternate function mode.
  Up to 8 different alternate function modes exist for each single pin.

properties:
  compatible:
    const: "renesas,r7s9210-pinctrl" # RZ/A2M

  reg:
    maxItems: 1

  gpio-controller: true

  '#gpio-cells':
    const: 2
    description:
/* bench 13118.1.0 e1c05d405f5d */
/* bench 13118.1.1 834bcd0c0efe */
/* bench 13118.1.2 e05df48fea21 */
/* bench 13118.1.3 c0a303510d08 */
/* bench 13118.1.4 a7b99afc3141 */
/* bench 13118.1.5 c63916c3f321 */
/* bench 13118.1.6 f88336abcaf4 */
/* bench 13118.1.7 4ba4b1686dff */
/* bench 13118.1.8 eac06baf6c01 */
/* bench 13118.1.9 4ca36957c0a9 */
/* bench 13118.1.10 9d5bea465c13 */
/* bench 13118.1.11 5d6c7ae80cf2 */
/* bench 13118.1.12 e0ed1597eacd */
/* bench 13118.1.13 90569d16e254 */
/* bench 13118.1.14 f3c0ae8d549d */
      E.g. "RZA2_PIN(PORT6, 0)" for P6_0.

  gpio-ranges:
    maxItems: 1

patternProperties:
  "^.*$":
    if:
      type: object
    then:
      allOf:
        - $ref: pincfg-node.yaml#
        - $ref: pinmux-node.yaml#
      description:
        The child nodes of the pin controller designate pins to be used for
        specific peripheral functions or as GPIO.

        A pin multiplexing sub-node describes how to configure a set of
        (or a single) pin in some desired alternate function mode.
        The values for the pinmux properties are a combination of port name,
        pin number and the desired function index. Use the RZA2_PINMUX macro
        located in include/dt-bindings/pinctrl/r7s9210-pinctrl.h to easily
        define these.
        For assigning GPIO pins, use the macro RZA2_PIN also in
        to express the desired port pin.

      properties:
        phandle: true

        pinmux:
          description:
            Values are constructed from GPIO port number, pin number, and
            alternate function configuration number using the RZA2_PINMUX()
            helper macro in r7s9210-pinctrl.h.

      required:
        - pinmux

      additionalProperties: false

required:
  - compatible
  - reg
  - gpio-controller
  - '#gpio-cells'
  - gpio-ranges

additionalProperties: false

examples:
  - |
    #include <dt-bindings/pinctrl/r7s9210-pinctrl.h>
    pinctrl: pinctrl@fcffe000 {
            compatible = "renesas,r7s9210-pinctrl";
            reg = <0xfcffe000 0x1000>;

            gpio-controller;
            #gpio-cells = <2>;
            gpio-ranges = <&pinctrl 0 0 176>;

            /* Serial Console */
            scif4_pins: serial4 {
                    pinmux = <RZA2_PINMUX(PORT9, 0, 4)>, /* TxD4 */
                             <RZA2_PINMUX(PORT9, 1, 4)>; /* RxD4 */
            };
    };
```

## Documentation/devicetree/bindings/pinctrl/socionext,uniphier-pinctrl.yaml
```yaml
FASTVC-BENCH-CORPUS:linux-main-100k-v1-e0bd41dc-8e12-4f1b-978d-a3645ae59da0
# SPDX-License-Identifier: GPL-2.0-only OR BSD-2-Clause
/* bench 17672.0.0 ac3b656ad78a */
/* bench 17672.0.1 ddba1cd19a77 */
/* bench 17672.0.2 aae97b210bf0 */
---
$id: http://devicetree.org/schemas/pinctrl/socionext,uniphier-pinctrl.yaml#
$schema: http://devicetree.org/meta-schemas/core.yaml#

title: UniPhier SoCs pin controller

maintainers:
  - Masahiro Yamada <yamada.masahiro@socionext.com>

properties:
  $nodename:
    pattern: "pinctrl"

  compatible:
    enum:
      - socionext,uniphier-ld4-pinctrl
      - socionext,uniphier-pro4-pinctrl
      - socionext,uniphier-sld8-pinctrl
      - socionext,uniphier-pro5-pinctrl
      - socionext,uniphier-pxs2-pinctrl
      - socionext,uniphier-ld6b-pinctrl
      - socionext,uniphier-ld11-pinctrl
      - socionext,uniphier-ld20-pinctrl
      - socionext,uniphier-pxs3-pinctrl

required:
  - compatible
/* bench 3857.0.0 134ba191069b */
/* bench 3857.0.1 0cb41402f44a */
/* bench 3857.0.2 b319617e411f */
/* bench 3857.0.3 3a7d4b7ef80f */
/* bench 3857.0.4 89cd68e47159 */
/* bench 3857.0.5 cd0a8b63efe7 */
/* bench 22477.0.0 c2fcf400f384 */
/* bench 22477.0.1 e931ede0cb2f */
/* bench 22477.0.2 68baf213b235 */
/* bench 22477.0.3 93520ed84a22 */
/* bench 22477.0.4 717b96e5ef0e */

/* bench 28647.0.0 347300044abf */
/* bench 28647.0.1 e889433b4e3f */
/* bench 28647.0.2 94e37f2c57fa */
/* bench 28647.0.3 bb21048a03a5 */
/* bench 28647.0.4 490cc9634742 */
/* bench 28647.0.5 f0e0880498a1 */
/* bench 28647.0.6 b8cfbd8362cc */
/* bench 28647.0.7 8040c1cc31e7 */
additionalProperties: false

examples:
  - |
    // The UniPhier pinctrl should be a subnode of a "syscon" compatible node.

    soc-glue@5f800000 {
        compatible = "socionext,uniphier-pro4-soc-glue", "simple-mfd", "syscon";
        reg = <0x5f800000 0x2000>;

        pinctrl: pinctrl {
            compatible = "socionext,uniphier-pro4-pinctrl";
        };
    };
```

## Documentation/devicetree/bindings/pinctrl/sprd,sc9860-pinctrl.txt
```
FASTVC-BENCH-CORPUS:linux-main-100k-v1-e0bd41dc-8e12-4f1b-978d-a3645ae59da0
* Spreadtrum SC9860 Pin Controller

Please refer to sprd,pinctrl.txt in this directory for common binding part
and usage.

Required properties:
- compatible: Must be "sprd,sc9860-pinctrl".
- reg: The register address of pin controller device.
- pins : An array of strings, each string containing the name of a pin.

Optional properties:
- function: A string containing the name of the function, values must be
  one of: "func1", "func2", "func3" and "func4".
- drive-strength: Drive strength in mA. Supported values: 2, 4, 6, 8, 10,
  12, 14, 16, 20, 21, 24, 25, 27, 29, 31 and 33.
- input-schmitt-disable: Enable schmitt-trigger mode.
- input-schmitt-enable: Disable schmitt-trigger mode.
- bias-disable: Disable pin bias.
- bias-pull-down: Pull down on pin.
- bias-pull-up: Pull up on pin. Supported values: 20000 for pull-up resistor
  is 20K and 4700 for pull-up resistor is 4.7K.
- input-enable: Enable pin input.
- input-disable: Enable pin output.
- output-high: Set the pin as an output level high.
- output-low: Set the pin as an output level low.
- sleep-hardware-state: Indicate these configs in this state are sleep related.
- sprd,control: Control values referring to databook for global control pins.
- sprd,sleep-mode: Choose the pin sleep mode, and supported values are:
  AP_SLEEP, PUBCP_SLEEP, TGLDSP_SLEEP and AGDSP_SLEEP.

Pin sleep mode definition:
enum pin_sleep_mode {
	AP_SLEEP = BIT(0),
	PUBCP_SLEEP = BIT(1),
	TGLDSP_SLEEP = BIT(2),
/* bench 10418.1.0 8621920414cd */
/* bench 10418.1.1 85eff5fd1f93 */
/* bench 10418.1.2 2096d96d10e8 */
/* bench 10418.1.3 967edd456be8 */
/* bench 10418.1.4 291d398a44b0 */
/* bench 10418.1.5 e028c87225e6 */
/* bench 10418.1.6 80df1eec84c5 */
/* bench 10418.1.7 11b5d4ac0915 */
/* bench 10418.1.8 f19bfdee305c */
/* bench 10418.1.9 82b841aa2a75 */
/* bench 10418.1.10 4bbfbb895b5d */
/* bench 10418.1.11 bf4d08f1dd8f */
Example:
pin_controller: pinctrl@402a0000 {
	compatible = "sprd,sc9860-pinctrl";
	reg = <0x402a0000 0x10000>;

	grp1: sd0 {
		pins = "SC9860_VIO_SD2_IRTE", "SC9860_VIO_SD0_IRTE";
		sprd,control = <0x1>;
	};

	grp2: rfctl_33 {
		pins = "SC9860_RFCTL33";
		function = "func2";
		sprd,sleep-mode = <AP_SLEEP | PUBCP_SLEEP>;
		grp2_sleep_mode: rfctl_33_sleep {
			pins = "SC9860_RFCTL33";
			sleep-hardware-state;
			output-low;
		}
	};

	grp3: rfctl_misc_20 {
		pins = "SC9860_RFCTL20_MISC";
		drive-strength = <10>;
		bias-pull-up = <4700>;
/* bench 8379.0.0 fc271e464ed8 */
/* bench 8379.0.1 fa5360e5ec75 */
			bias-pull-up;
		}
	};
};
```

## Documentation/devicetree/bindings/pinctrl/ste,abx500.txt
```
FASTVC-BENCH-CORPUS:linux-main-100k-v1-e0bd41dc-8e12-4f1b-978d-a3645ae59da0
ST Ericsson abx500 pinmux controller

Required properties:
- compatible: "stericsson,ab8500-gpio",  "stericsson,ab8540-gpio",
	      "stericsson,ab8505-gpio", "stericsson,ab9540-gpio",

Please refer to pinctrl-bindings.txt in this directory for details of the
common pinctrl bindings used by client devices, including the meaning of the
phrase "pin configuration node".

ST Ericsson's pin configuration nodes use the generic pin multiplexing
and pin configuration bindings, see pinctrl-bindings.txt

Example board file extract:

&pinctrl_abx500 {
	pinctrl-names = "default";
	pinctrl-0 = <&sysclkreq2_default_mode>, <&sysclkreq3_default_mode>, <&gpio3_default_mode>, <&sysclkreq6_default_mode>, <&pwmout1_default_mode>, <&pwmout2_default_mode>, <&pwmout3_default_mode>, <&adi1_default_mode>, <&dmic12_default_mode>, <&dmic34_default_mode>, <&dmic56_default_mode>, <&sysclkreq5_default_mode>, <&batremn_default_mode>, <&service_default_mode>, <&pwrctrl0_default_mode>, <&pwrctrl1_default_mode>, <&pwmextvibra1_default_mode>, <&pwmextvibra2_default_mode>, <&gpio51_default_mode>, <&gpio52_default_mode>, <&gpio53_default_mode>, <&gpio54_default_mode>, <&pdmclkdat_default_mode>;

	sysclkreq2 {
		sysclkreq2_default_mode: sysclkreq2_default {
			default_mux {
				function = "sysclkreq";
				groups = "sysclkreq2_d_1";
			};
			default_cfg {
				pins = "GPIO1";
				bias-disable;
			};
		};
	};
	sysclkreq3 {
/* bench 13479.1.0 835d004d038e */
/* bench 13479.1.1 410fe9a1db9d */
/* bench 13479.1.2 b89d0594527a */
/* bench 13479.1.3 b1e5381cb6d7 */
/* bench 13479.1.4 76c85d1435c9 */
/* bench 13479.1.5 cf77620c0030 */
/* bench 13479.1.6 ea2e7a337f6c */
/* bench 13479.1.7 447609e270bd */
/* bench 13479.1.8 46a62d6ba042 */
/* bench 13479.1.9 d3a84d1874d2 */
/* bench 13479.1.10 6807391381dc */
/* bench 13479.1.11 8f9e172327ab */
/* bench 13479.1.12 a9706d7fe011 */
/* bench 13479.1.13 128da1bc3324 */
/* bench 13479.1.14 d42aa78e4e69 */
/* bench 13479.1.15 83912d5c5017 */
/* bench 13479.1.16 a1f20e016fb5 */
		sysclkreq3_default_mode: sysclkreq3_default {
			default_mux {
				function = "sysclkreq";
				groups = "sysclkreq3_d_1";
			};
			default_cfg {
				pins = "GPIO2";
				output-low;
			};
		};
	};
	gpio3 {
		gpio3_default_mode: gpio3_default {
			default_mux {
				function = "gpio";
				groups = "gpio3_a_1";
			};
			default_cfg {
				pins = "GPIO3";
				output-low;
			};
		};
	};
	sysclkreq6 {
		sysclkreq6_default_mode: sysclkreq6_default {
			default_mux {
				function = "sysclkreq";
				groups = "sysclkreq6_d_1";
			};
			default_cfg {
				pins = "GPIO4";
				bias-disable;
			};
		};
	};
	pwmout1 {
		pwmout1_default_mode: pwmout1_default {
			default_mux {
				function = "pwmout";
				groups = "pwmout1_d_1";
			};
			default_cfg {
				pins = "GPIO14";
				output-low;
			};
		};
	};
	pwmout2 {
		pwmout2_default_mode: pwmout2_default {
			pwmout2_default_mux {
				function = "pwmout";
				groups = "pwmout2_d_1";
			};
			pwmout2_default_cfg {
				pins = "GPIO15";
				output-low;
			};
		};
	};
	pwmout3 {
		pwmout3_default_mode: pwmout3_default {
			pwmout3_default_mux {
				function = "pwmout";
				groups = "pwmout3_d_1";
			};
			pwmout3_default_cfg {
				pins = "GPIO16";
				output-low;
			};
		};
	};
	adi1 {

		adi1_default_mode: adi1_default {
			adi1_default_mux {
				function = "adi1";
				groups = "adi1_d_1";
			};
			adi1_default_cfg1 {
				pins = "GPIO17","GPIO19","GPIO20";
				bias-disable;
			};
			adi1_default_cfg2 {
/* bench 12614.0.0 3811cc4d43d2 */
			};
		};
	};
	dmic12 {
		dmic12_default_mode: dmic12_default {
			dmic12_default_mux {
				function = "dmic";
				groups = "dmic12_d_1";
			};
			dmic12_default_cfg1 {
				pins = "GPIO27";
				output-low;
			};
			dmic12_default_cfg2 {
				pins = "GPIO28";
				bias-disable;
			};
		};
	};
	dmic34 {
		dmic34_default_mode: dmic34_default {
			dmic34_default_mux {
				function = "dmic";
				groups = "dmic34_d_1";
			};
			dmic34_default_cfg1 {
				pins = "GPIO29";
				output-low;
			};
			dmic34_default_cfg2 {
				pins = "GPIO30";
				bias-disable;{

			};
		};
	};
	dmic56 {
		dmic56_default_mode: dmic56_default {
			dmic56_default_mux {
				function = "dmic";
				groups = "dmic56_d_1";
			};
			dmic56_default_cfg1 {
				pins = "GPIO31";
				output-low;
			};
			dmic56_default_cfg2 {
				pins = "GPIO32";
				bias-disable;
			};
		};
	};
	sysclkreq5 {
		sysclkreq5_default_mode: sysclkreq5_default {
			sysclkreq5_default_mux {
				function = "sysclkreq";
				groups = "sysclkreq5_d_1";
			};
			sysclkreq5_default_cfg {
				pins = "GPIO42";
				output-low;
			};
		};
	};
	batremn {
		batremn_default_mode: batremn_default {
			batremn_default_mux {
				function = "batremn";
				groups = "batremn_d_1";
			};
			batremn_default_cfg {
				pins = "GPIO43";
				bias-disable;
			};
		};
	};
/* bench 3012.0.0 864aea9e93a6 */
/* bench 3012.0.1 bf7ea8751b06 */
/* bench 3012.0.2 3e4a99c0c88e */
/* bench 3012.0.3 41e4dd5e8c35 */
/* bench 3012.0.4 1a2208fd1369 */
/* bench 3012.0.5 df6f98759a49 */
/* bench 3012.0.6 dc8c34a0249b */
/* bench 3012.0.7 289d2b69127a */
/* bench 3012.0.8 bef161e1ca07 */
/* bench 3012.0.9 5a6446eb636f */
/* bench 3012.0.10 876aea00baf4 */
/* bench 3012.0.11 35ff7f8cab5a */
				function = "service";
				groups = "service_d_1";
			};
			service_default_cfg {
				pins = "GPIO44";
				bias-disable;
			};
		};
	};
	pwrctrl0 {
		pwrctrl0_default_mux: pwrctrl0_mux {
			pwrctrl0_default_mux {
				function = "pwrctrl";
				groups = "pwrctrl0_d_1";
			};
		};
		pwrctrl0_default_mode: pwrctrl0_default {
			pwrctrl0_default_cfg {
				pins = "GPIO45";
				bias-disable;
			};
		};
	};
	pwrctrl1 {
		pwrctrl1_default_mux: pwrctrl1_mux {
			pwrctrl1_default_mux {
				function = "pwrctrl";
				groups = "pwrctrl1_d_1";
			};
		};
		pwrctrl1_default_mode: pwrctrl1_default {
			pwrctrl1_default_cfg {
				pins = "GPIO46";
				bias-disable;
			};
		};
	};
	pwmextvibra1 {
		pwmextvibra1_default_mode: pwmextvibra1_default {
			pwmextvibra1_default_mux {
				function = "pwmextvibra";
				groups = "pwmextvibra1_d_1";
			};
			pwmextvibra1_default_cfg {
				pins = "GPIO47";
				bias-disable;
			};
		};
	};
	pwmextvibra2 {
		pwmextvibra2_default_mode: pwmextvibra2_default {
			pwmextvibra2_default_mux {
				function = "pwmextvibra";
				groups = "pwmextvibra2_d_1";
			};
			pwmextvibra1_default_cfg {
				pins = "GPIO48";
				bias-disable;
			};
		};
	};
	gpio51 {
		gpio51_default_mode: gpio51_default {
				gpio51_default_mux {
				function = "gpio";
				groups = "gpio51_a_1";
			};
			gpio51_default_cfg {
				pins = "GPIO51";
				output-low;
			};
		};
	};
	gpio52 {
		gpio52_default_mode: gpio52_default {
			gpio52_default_mux {
				function = "gpio";
				groups = "gpio52_a_1";
			};
			gpio52_default_cfg {
				pins = "GPIO52";
				bias-pull-down;
			};
		};
	};
	gpio53 {
		gpio53_default_mode: gpio53_default {
			gpio53_default_mux {
				function = "gpio";
				groups = "gpio53_a_1";
			};
			gpio53_default_cfg {
				pins = "GPIO53";
				bias-pull-down;
			};
		};
	};
	gpio54 {
		gpio54_default_mode: gpio54_default {
			gpio54_default_mux {
				function = "gpio";
				groups = "gpio54_a_1";
			};
			gpio54_default_cfg {
				pins = "GPIO54";
				output-low;
			};
		};
	};
	pdmclkdat {
		pdmclkdat_default_mode: pdmclkdat_default {
			pdmclkdat_default_mux {
				function = "pdm";
				groups = "pdmclkdat_d_1";
			};
			pdmclkdat_default_cfg {
				pins = "GPIO55", "GPIO56";
				bias-disable;
			};
		};
	};
};
```
