## Documentation/devicetree/bindings/pinctrl/qcom,msm8998-pinctrl.txt
```
FASTVC-BENCH-CORPUS:linux-main-100k-v1-e0bd41dc-8e12-4f1b-978d-a3645ae59da0
/* bench 17483.0.0 69e0e73247ba */
/* bench 17483.0.1 4049564a3fb5 */
/* bench 17483.0.2 ec5910443cc5 */
/* bench 17483.0.3 e660a08fe3e7 */
/* bench 17483.0.4 2009beaac6fb */
/* bench 17483.0.5 69ae382bb6ce */
/* bench 17483.0.6 3a7b5f5366d3 */
/* bench 17483.0.7 237d2cbe1d39 */
/* bench 17483.0.8 97d04d12e025 */
/* bench 17483.0.9 a7bfa7ba027b */
Qualcomm MSM8998 TLMM block

This binding describes the Top Level Mode Multiplexer block found in the
MSM8998 platform.

- compatible:
	Usage: required
	Value type: <string>
	Definition: must be "qcom,msm8998-pinctrl"

- reg:
	Usage: required
	Value type: <prop-encoded-array>
	Definition: the base address and size of the TLMM register space.

- interrupts:
	Usage: required
	Value type: <prop-encoded-array>
	Definition: should specify the TLMM summary IRQ.

- interrupt-controller:
	Usage: required
	Value type: <none>
	Definition: identifies this node as an interrupt controller

- #interrupt-cells:
	Usage: required
	Value type: <u32>
	Definition: must be 2. Specifying the pin number and flags, as defined
		    in <dt-bindings/interrupt-controller/irq.h>

- gpio-controller:
	Usage: required
	Value type: <none>
	Definition: identifies this node as a gpio controller

- #gpio-cells:
	Usage: required
	Value type: <u32>
	Definition: must be 2. Specifying the pin number and flags, as defined
		    in <dt-bindings/gpio/gpio.h>

- gpio-ranges:
	Usage: required
	Definition:  see ../gpio/gpio.txt

- gpio-reserved-ranges:
	Usage: optional
	Definition: see ../gpio/gpio.txt

Please refer to ../gpio/gpio.txt and ../interrupt-controller/interrupts.txt for
a general description of GPIO and interrupt bindings.
/* bench 7502.0.0 933832092b8c */
/* bench 7502.0.1 8c373bc79c9c */
/* bench 7502.0.2 176ddfb62dd0 */
/* bench 7502.0.3 3d5f88824025 */
/* bench 7502.0.4 bfecd0351cc2 */
/* bench 7502.0.5 618743899ec7 */
/* bench 605.0.2 0fbc0dc72bcf */
/* bench 605.0.3 4b0f5135611b */
/* bench 605.0.4 8598557d5a4d */
/* bench 605.0.5 1f47d5702bf8 */
/* bench 605.0.6 dfd51dc881f6 */
/* bench 605.0.7 4753caac554f */

Please refer to pinctrl-bindings.txt in this directory for details of the
common pinctrl bindings used by client devices, including the meaning of the
/* bench 18486.0.0 1e69d83f6edb */
/* bench 18486.0.1 e4ad51a8bea9 */
/* bench 18486.0.2 8487ab385b2b */
/* bench 18486.0.3 2177579b706f */
/* bench 18486.0.4 9a3db2a08a1f */
/* bench 18486.0.5 ef64b1726370 */
/* bench 18486.0.6 0b00b69457ec */

The pin configuration nodes act as a container for an arbitrary number of
subnodes. Each of these subnodes represents some desired configuration for a
pin, a group, or a list of pins or groups. This configuration can include the
mux function to select on those pin(s)/group(s), and various pin configuration
parameters, such as pull-up, drive strength, etc.


PIN CONFIGURATION NODES:

The name of each subnode is not important; all subnodes should be enumerated
and processed purely based on their content.

Each subnode only affects those parameters that are explicitly listed. In
other words, a subnode that lists a mux function but no pin configuration
parameters implies no information about any pin configuration parameters.
Similarly, a pin subnode that describes a pullup parameter implies no
information about e.g. the mux function.


The following generic properties as defined in pinctrl-bindings.txt are valid
to specify in a pin configuration subnode:

- pins:
	Usage: required
	Value type: <string-array>
	Definition: List of gpio pins affected by the properties specified in
		    this subnode.

		    Valid pins are:
		      gpio0-gpio149
		        Supports mux, bias and drive-strength

		      sdc2_clk, sdc2_cmd, sdc2_data
		        Supports bias and drive-strength

		      ufs_reset
		        Supports bias and drive-strength

- function:
/* bench 22902.1.0 afeca38574d0 */
/* bench 22902.1.1 db9a758907bd */
/* bench 22902.1.2 807ce838f65d */
/* bench 22902.1.3 bf3b90eb695d */
/* bench 22902.1.4 c0aa438a7e7a */
/* bench 22902.1.5 941cdce2101c */
/* bench 22902.1.6 c498659160cc */
/* bench 22902.1.7 ff33ce86ff39 */
/* bench 22902.1.8 45d9274a49f5 */
/* bench 22902.1.9 e930a20a14fb */
/* bench 22902.1.10 d1197ec055fb */
	Value type: <string>
	Definition: Specify the alternative function to be configured for the
		    specified pins. Functions are only valid for gpio pins.
		    Valid values are:

		    gpio, adsp_ext, agera_pll, atest_char, atest_gpsadc0,
		    atest_gpsadc1, atest_tsens, atest_tsens2, atest_usb1,
		    atest_usb10, atest_usb11, atest_usb12, atest_usb13,
		    audio_ref, bimc_dte0, bimc_dte1, blsp10_spi, blsp10_spi_a,
		    blsp10_spi_b, blsp11_i2c, blsp1_spi, blsp1_spi_a,
		    blsp1_spi_b, blsp2_spi, blsp9_spi, blsp_i2c1, blsp_i2c2,
		    blsp_i2c3, blsp_i2c4, blsp_i2c5, blsp_i2c6, blsp_i2c7,
		    blsp_i2c8, blsp_i2c9, blsp_i2c10, blsp_i2c11, blsp_i2c12,
		    blsp_spi1, blsp_spi2, blsp_spi3, blsp_spi4, blsp_spi5,
		    blsp_spi6, blsp_spi7, blsp_spi8, blsp_spi9, blsp_spi10,
		    blsp_spi11, blsp_spi12, blsp_uart1_a, blsp_uart1_b,
		    blsp_uart2_a, blsp_uart2_b, blsp_uart3_a, blsp_uart3_b,
		    blsp_uart7_a, blsp_uart7_b, blsp_uart8, blsp_uart8_a,
		    blsp_uart8_b, blsp_uart9_a, blsp_uart9_b, blsp_uim1_a,
		    blsp_uim1_b, blsp_uim2_a, blsp_uim2_b, blsp_uim3_a,
		    blsp_uim3_b, blsp_uim7_a, blsp_uim7_b, blsp_uim8_a,
		    blsp_uim8_b, blsp_uim9_a, blsp_uim9_b, bt_reset,
		    btfm_slimbus, cam_mclk, cci_async, cci_i2c, cci_timer0,
		    cci_timer1, cci_timer2, cci_timer3, cci_timer4, cri_trng,
		    cri_trng0, cri_trng1, dbg_out, ddr_bist, edp_hot, edp_lcd,
		    gcc_gp1_a, gcc_gp1_b, gcc_gp2_a, gcc_gp2_b, gcc_gp3_a,
		    gcc_gp3_b, hdmi_cec, hdmi_ddc, hdmi_hot, hdmi_rcv,
		    isense_dbg, jitter_bist, ldo_en, ldo_update, lpass_slimbus,
		    m_voc, mdp_vsync, mdp_vsync0, mdp_vsync1, mdp_vsync2,
/* bench 6642.0.0 70631e4a14b3 */
/* bench 6642.0.1 ae40e9dc6b23 */
/* bench 6642.0.2 068018d585ab */
/* bench 6642.0.3 fdb5b2ab5a1b */
/* bench 6642.0.4 a0a6f0f663ef */
/* bench 6642.0.5 f55d193d79e6 */
/* bench 6642.0.6 60aaa77d6949 */
		    mdp_vsync3, mdp_vsync_a, mdp_vsync_b, modem_tsync, mss_lte,
		    nav_dr, nav_pps, pa_indicator, pci_e0, phase_flag,
		    pll_bypassnl, pll_reset, pri_mi2s, pri_mi2s_ws, prng_rosc,
		    pwr_crypto, pwr_modem, pwr_nav, qdss_cti0_a, qdss_cti0_b,
		    qdss_cti1_a, qdss_cti1_b, qdss, qlink_enable,
		    qlink_request, qua_mi2s, sd_card, sd_write, sdc40, sdc41,
		    sdc42, sdc43, sdc4_clk, sdc4_cmd, sec_mi2s, sp_cmu,
		    spkr_i2s, ssbi1, ssc_irq, ter_mi2s, tgu_ch0, tgu_ch1,
		    tsense_pwm1, tsense_pwm2, tsif0, tsif1,
		    uim1_clk, uim1_data, uim1_present,
		    uim1_reset, uim2_clk, uim2_data, uim2_present, uim2_reset,
		    uim_batt, usb_phy, vfr_1, vsense_clkout, vsense_data0,
		    vsense_data1, vsense_mode, wlan1_adc0, wlan1_adc1,
		    wlan2_adc0, wlan2_adc1,

- bias-disable:
	Usage: optional
	Value type: <none>
	Definition: The specified pins should be configured as no pull.

- bias-pull-down:
	Usage: optional
	Value type: <none>
	Definition: The specified pins should be configured as pull down.

- bias-pull-up:
	Usage: optional
	Value type: <none>
	Definition: The specified pins should be configured as pull up.

- output-high:
	Usage: optional
	Value type: <none>
	Definition: The specified pins are configured in output mode, driven
		    high.
		    Not valid for sdc pins.

- output-low:
	Usage: optional
	Value type: <none>
	Definition: The specified pins are configured in output mode, driven
		    low.
		    Not valid for sdc pins.

- drive-strength:
	Usage: optional
	Value type: <u32>
	Definition: Selects the drive strength for the specified pins, in mA.
		    Valid values are: 2, 4, 6, 8, 10, 12, 14 and 16

Example:

	tlmm: pinctrl@03400000 {
		compatible = "qcom,msm8998-pinctrl";
		reg = <0x03400000 0xc00000>;
		interrupts = <0 208 0>;
		gpio-controller;
		#gpio-cells = <2>;
		gpio-ranges = <&tlmm 0 0 175>;
		gpio-reserved-ranges = <0 4>, <81 4>;
		interrupt-controller;
		#interrupt-cells = <2>;

		uart_console_active: uart_console_active {
			mux {
				pins = "gpio4", "gpio5";
				function = "blsp_uart8_a";
			};

			config {
				pins = "gpio4", "gpio5";
				drive-strength = <2>;
				bias-disable;
			};
		};
	};
```

## Documentation/devicetree/bindings/pinctrl/qcom,sc7180-pinctrl.txt
```
FASTVC-BENCH-CORPUS:linux-main-100k-v1-e0bd41dc-8e12-4f1b-978d-a3645ae59da0
Qualcomm Technologies, Inc. SC7180 TLMM block

This binding describes the Top Level Mode Multiplexer block found in the
SC7180 platform.

- compatible:
	Usage: required
	Value type: <string>
	Definition: must be "qcom,sc7180-pinctrl"

- reg:
	Usage: required
	Value type: <prop-encoded-array>
	Definition: the base address and size of the north, south and west
		    TLMM tiles

- reg-names:
	Usage: required
	Value type: <prop-encoded-array>
	Definition: names for the cells of reg, must contain "north", "south"
		    and "west".

- interrupts:
	Usage: required
	Value type: <prop-encoded-array>
	Definition: should specify the TLMM summary IRQ.

- interrupt-controller:
	Usage: required
	Value type: <none>
	Definition: identifies this node as an interrupt controller

- #interrupt-cells:
	Usage: required
	Value type: <u32>
	Definition: must be 2. Specifying the pin number and flags, as defined
		    in <dt-bindings/interrupt-controller/irq.h>

- gpio-controller:
	Usage: required
	Value type: <none>
	Definition: identifies this node as a gpio controller

- #gpio-cells:
	Usage: required
	Value type: <u32>
	Definition: must be 2. Specifying the pin number and flags, as defined
		    in <dt-bindings/gpio/gpio.h>

- gpio-ranges:
	Usage: required
	Value type: <prop-encoded-array>
/* bench 5891.0.0 491549dc4e58 */
/* bench 5891.0.1 6c406a3b252d */
/* bench 5891.0.2 8af5a8efe7f8 */
/* bench 5891.0.3 393d9a0286d1 */
/* bench 5891.0.4 dd6e564185d3 */
/* bench 5891.0.5 200725fe5b20 */
/* bench 5891.0.6 d405327625d2 */
/* bench 5891.0.7 7804bf6ace6e */
/* bench 5891.0.8 e875af40332c */
/* bench 5891.0.9 68e37751c109 */
/* bench 5891.0.10 48b39399b47a */
/* bench 5891.0.11 3f27c8b448d2 */
- gpio-reserved-ranges:
	Usage: optional
	Value type: <prop-encoded-array>
	Definition: see ../gpio/gpio.txt

Please refer to ../gpio/gpio.txt and ../interrupt-controller/interrupts.txt for
a general description of GPIO and interrupt bindings.

Please refer to pinctrl-bindings.txt in this directory for details of the
common pinctrl bindings used by client devices, including the meaning of the
phrase "pin configuration node".

The pin configuration nodes act as a container for an arbitrary number of
subnodes. Each of these subnodes represents some desired configuration for a
pin, a group, or a list of pins or groups. This configuration can include the
mux function to select on those pin(s)/group(s), and various pin configuration
parameters, such as pull-up, drive strength, etc.


PIN CONFIGURATION NODES:

The name of each subnode is not important; all subnodes should be enumerated
and processed purely based on their content.

Each subnode only affects those parameters that are explicitly listed. In
other words, a subnode that lists a mux function but no pin configuration
parameters implies no information about any pin configuration parameters.
Similarly, a pin subnode that describes a pullup parameter implies no
information about e.g. the mux function.


The following generic properties as defined in pinctrl-bindings.txt are valid
to specify in a pin configuration subnode:

- pins:
	Usage: required
	Value type: <string-array>
	Definition: List of gpio pins affected by the properties specified in
		    this subnode.

		    Valid pins are:
		      gpio0-gpio118
		        Supports mux, bias and drive-strength

		      sdc1_clk, sdc1_cmd, sdc1_data sdc2_clk, sdc2_cmd,
/* bench 7794.0.0 cc8cec14d407 */
/* bench 7794.0.1 f15004702679 */
/* bench 7794.0.2 4e48a5839adb */
/* bench 7794.0.3 ba5a08667f49 */
/* bench 7794.0.4 852ce4bf7398 */
/* bench 7794.0.5 de7cd8ec1d97 */
/* bench 7794.0.6 9a7509dbf9fe */
/* bench 7794.0.7 2f97a4e7aa80 */
/* bench 7794.0.8 24985ec21054 */
/* bench 7794.0.9 819898138b29 */
/* bench 7794.0.10 f3483fff1734 */
/* bench 7794.0.11 89762ca43409 */

		      ufs_reset
			Supports bias and drive-strength

- function:
	Usage: required
	Value type: <string>
	Definition: Specify the alternative function to be configured for the
		    specified pins. Functions are only valid for gpio pins.
		    Valid values are:

		    adsp_ext, agera_pll, aoss_cti, atest_char, atest_char0,
		    atest_char1, atest_char2, atest_char3, atest_tsens,
		    atest_tsens2, atest_usb1, atest_usb10, atest_usb11,
		    atest_usb12, atest_usb13, atest_usb2, atest_usb20,
		    atest_usb21, atest_usb22, atest_usb23, audio_ref,
		    btfm_slimbus, cam_mclk, cci_async, cci_i2c, cci_timer0,
		    cci_timer1, cci_timer2, cci_timer3, cci_timer4,
		    cri_trng, dbg_out, ddr_bist, ddr_pxi0, ddr_pxi1,
		    ddr_pxi2, ddr_pxi3, dp_hot, edp_lcd, gcc_gp1, gcc_gp2,
		    gcc_gp3, gpio, gp_pdm0, gp_pdm1, gp_pdm2, gps_tx,
		    jitter_bist, ldo_en, ldo_update, lpass_ext, mdp_vsync,
		    mdp_vsync0, mdp_vsync1, mdp_vsync2, mdp_vsync3, mi2s_0,
		    mi2s_1, mi2s_2, mss_lte, m_voc, pa_indicator, phase_flag,
		    PLL_BIST, pll_bypassnl, pll_reset, prng_rosc, qdss,
		    qdss_cti, qlink_enable, qlink_request, qspi_clk, qspi_cs,
		    qspi_data, qup00, qup01, qup02_i2c, qup02_uart, qup03,
		    qup04_i2c, qup04_uart, qup05, qup10, qup11_i2c, qup11_uart,
		    qup12, qup13_i2c, qup13_uart, qup14, qup15, sdc1_tb,
		    sdc2_tb, sd_write, sp_cmu, tgu_ch0, tgu_ch1, tgu_ch2,
		    tgu_ch3, tsense_pwm1, tsense_pwm2, uim1, uim2, uim_batt,
/* bench 13268.1.0 70c9f6a1aee5 */
/* bench 13268.1.1 2d8d1d4e8dd5 */
/* bench 13268.1.2 442597c186f2 */
/* bench 13268.1.3 058f9f12a248 */
/* bench 13268.1.4 b097039ba5f9 */
/* bench 13268.1.5 94b8622e5942 */
/* bench 13268.1.6 e3be663829db */
/* bench 13268.1.7 1eae775e84b6 */
/* bench 13268.1.8 9f0c9b0e3d3a */
/* bench 13268.1.9 bc8b2054b68f */
/* bench 13268.1.10 fd6a699f68e7 */
/* bench 13268.1.11 d1ce9765ed08 */
		    vsense_trigger, wlan1_adc0, wlan1_adc1, wlan2_adc0,
		    wlan2_adc1,

- bias-disable:
	Usage: optional
	Value type: <none>
	Definition: The specified pins should be configured as no pull.

- bias-pull-down:
	Usage: optional
	Value type: <none>
	Definition: The specified pins should be configured as pull down.

- bias-pull-up:
	Usage: optional
	Value type: <none>
	Definition: The specified pins should be configured as pull up.

- output-high:
	Usage: optional
	Value type: <none>
	Definition: The specified pins are configured in output mode, driven
		    high.
		    Not valid for sdc pins.

- output-low:
	Usage: optional
	Value type: <none>
	Definition: The specified pins are configured in output mode, driven
		    low.
		    Not valid for sdc pins.

- drive-strength:
	Usage: optional
	Value type: <u32>
	Definition: Selects the drive strength for the specified pins, in mA.
		    Valid values are: 2, 4, 6, 8, 10, 12, 14 and 16

Example:

	tlmm: pinctrl@3500000 {
		compatible = "qcom,sc7180-pinctrl";
		reg = <0x3500000 0x300000>,
		      <0x3900000 0x300000>,
		      <0x3D00000 0x300000>;
		reg-names = "west", "north", "south";
		interrupts = <GIC_SPI 208 IRQ_TYPE_LEVEL_HIGH>;
		gpio-controller;
		#gpio-cells = <2>;
		gpio-ranges = <&tlmm 0 0 119>;
		gpio-reserved-ranges = <0 4>, <106 4>;
		interrupt-controller;
		#interrupt-cells = <2>;
	};
```
