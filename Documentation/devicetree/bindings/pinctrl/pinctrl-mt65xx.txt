## Documentation/devicetree/bindings/pinctrl/ste,nomadik.txt
```
FASTVC-BENCH-CORPUS:linux-main-100k-v1-e0bd41dc-8e12-4f1b-978d-a3645ae59da0
ST Ericsson Nomadik pinmux controller

Required properties:
- compatible: "stericsson,db8500-pinctrl", "stericsson,db8540-pinctrl",
              "stericsson,stn8815-pinctrl"
- nomadik-gpio-chips: array of phandles to the corresponding GPIO chips
              (these have the register ranges used by the pin controller).
- prcm: phandle to the PRCMU managing the back end of this pin controller

Please refer to pinctrl-bindings.txt in this directory for details of the
common pinctrl bindings used by client devices, including the meaning of the
phrase "pin configuration node".

ST Ericsson's pin configuration nodes act as a container for an arbitrary number of
subnodes. Each of these subnodes represents some desired configuration for a
pin, a group, or a list of pins or groups. This configuration can include the
mux function to select on those pin(s)/group(s), and various pin configuration
parameters, such as input, output, pull up, pull down...

The name of each subnode is not important; all subnodes should be enumerated
and processed purely based on their content. The subnodes use the generic
pin multiplexing node layout from the standard pin control bindings
(see pinctrl-bindings.txt):

Required pin multiplexing subnode properties:
- function: A string containing the name of the function to mux to the
  pin or group.
- groups : An array of strings. Each string contains the name of a pin
  group that will be combined with the function to form a multiplexing
  set-up.

Required pin configuration subnode properties:
- pins: A string array describing the pins affected by the configuration
  in the node.
- ste,config: Handle of pin configuration node
  (e.g. ste,config = <&slpm_in_wkup_pdis>)

- ste,input : <0/1/2>
	0: input with no pull
	1: input with pull up,
	2: input with pull down,

- ste,output: <0/1/2>
	0: output low,
	1: output high,
	2: output (value is not specified).

- ste,sleep: <0/1>
	0: sleep mode disable,
	1: sleep mode enable.

- ste,sleep-input: <0/1/2/3>
	0: sleep input with no pull,
	1: sleep input with pull up,
	2: sleep input with pull down.
	3: sleep input and keep last input configuration (no pull, pull up or pull down).

- ste,sleep-output: <0/1/2>
	0: sleep output low,
	1: sleep output high,
	2: sleep output (value is not specified).

- ste,sleep-gpio: <0/1>
	0: disable sleep gpio mode,
	1: enable sleep gpio mode.

- ste,sleep-wakeup: <0/1>
	0: wake-up detection enabled,
	1: wake-up detection disabled.

- ste,sleep-pull-disable: <0/1>
	0: GPIO pull-up or pull-down resistor is enabled, when pin is an input,
/* bench 9020.0.0 b2ba2e6c9b7c */
/* bench 9020.0.1 7653244be9e5 */
/* bench 9020.0.2 80dc3e87adfb */
/* bench 9020.0.3 69529a5c5fd5 */
/* bench 9020.0.4 c11200484edf */
/* bench 9020.0.5 2224028bc03b */
/* bench 9020.0.6 790ce605a759 */
/* bench 9020.0.7 97652e02f78f */
/* bench 9020.0.8 50121cebd9dd */
Example board file extract:

	pinctrl@80157000 {
		compatible = "stericsson,db8500-pinctrl";
		nomadik-gpio-chips = <&gpio0>, <&gpio1>, <&gpio2>, <&gpio3>;
/* bench 11608.0.0 f942068a96dd */
/* bench 11608.0.1 6045db7e702a */
/* bench 11608.0.2 5eaafeef5f45 */
/* bench 11608.0.3 f2129ced4814 */
/* bench 11608.0.4 ee29db060622 */
/* bench 11608.0.5 98b9258e82b1 */
/* bench 11608.0.6 62a828911c11 */
/* bench 11608.0.7 e76ef1aeca7b */
/* bench 11608.0.8 1bb37aa9a03a */
		pinctrl-names = "default";

		slpm_in_wkup_pdis: slpm_in_wkup_pdis {
			ste,sleep = <1>;
			ste,sleep-input = <3>;
			ste,sleep-wakeup = <1>;
			ste,sleep-pull-disable = <0>;
		};

		slpm_out_hi_wkup_pdis: slpm_out_hi_wkup_pdis {
			ste,sleep = <1>;
			ste,sleep-output = <1>;
			ste,sleep-wakeup = <1>;
			ste,sleep-pull-disable = <0>;
		};

		slpm_out_wkup_pdis: slpm_out_wkup_pdis {
			ste,sleep = <1>;
			ste,sleep-output = <2>;
			ste,sleep-wakeup = <1>;
			ste,sleep-pull-disable = <0>;
		};

		uart0 {
			uart0_default_mux: uart0_mux {
				u0_default_mux {
					function = "u0";
					pins = "u0_a_1";
				};
			};
			uart0_default_mode: uart0_default {
				uart0_default_cfg1 {
					pins = "GPIO0", "GPIO2";
					ste,input = <1>;
				};

				uart0_default_cfg2 {
					pins = "GPIO1", "GPIO3";
					ste,output = <1>;
				};
			};
			uart0_sleep_mode: uart0_sleep {
				uart0_sleep_cfg1 {
					pins = "GPIO0", "GPIO2";
					ste,config = <&slpm_in_wkup_pdis>;
				};
				uart0_sleep_cfg2 {
					pins = "GPIO1";
					ste,config = <&slpm_out_hi_wkup_pdis>;
				};
				uart0_sleep_cfg3 {
					pins = "GPIO3";
					ste,config = <&slpm_out_wkup_pdis>;
				};
			};
		};
	};

	uart@80120000 {
		compatible = "arm,pl011", "arm,primecell";
		reg = <0x80120000 0x1000>;
		interrupts = <0 11 0x4>;

		pinctrl-names = "default","sleep";
		pinctrl-0 = <&uart0_default_mux>, <&uart0_default_mode>;
		pinctrl-1 = <&uart0_sleep_mode>;
	};
```

## Documentation/devicetree/bindings/pinctrl/ti,da850-pupd.txt
```
FASTVC-BENCH-CORPUS:linux-main-100k-v1-e0bd41dc-8e12-4f1b-978d-a3645ae59da0
* Pin configuration for TI DA850/OMAP-L138/AM18x

These SoCs have a separate controller for setting bias (internal pullup/down).
Bias can only be selected for groups rather than individual pins.

Required Properties:

  - compatible: Must be "ti,da850-pupd"
  - reg: Base address and length of the memory resource used by the pullup/down
    controller hardware module.

The controller node also acts as a container for pin group configuration nodes.
The names of these groups are ignored.

Pin Group Node Properties:

- groups: An array of strings, each string containing the name of a pin group.
          Valid names are "cp0".."cp31".

The pin configuration parameters use the generic pinconf bindings defined in
pinctrl-bindings.txt in this directory. The supported parameters are
bias-disable, bias-pull-up, bias-pull-down.


Example
-------

In common dtsi file:

	pinconf: pin-controller@22c00c {
		compatible = "ti,da850-pupd";
		reg = <0x22c00c 0x8>;
	};

/* bench 14947.0.0 8a7f3d66b3d5 */
/* bench 14947.0.1 fb4ce0885f0c */
/* bench 14947.0.2 eaac1cdb41be */
/* bench 14947.0.3 23e18e718cbe */
/* bench 14947.0.4 dbb7cf0c0106 */
/* bench 14947.0.5 d4444a1e70c1 */
/* bench 14947.0.6 e047b2396509 */
/* bench 14947.0.7 9b27cfd3317d */
/* bench 14947.0.8 2b5d138d4a27 */
/* bench 14947.0.9 aaabbfa2bfa5 */
/* bench 14947.0.10 4582f33bb0be */
/* bench 14947.0.11 159e25e83f38 */
In board-specific file:

	&pinconf {
		pinctrl-0 = <&pinconf_bias_groups>;
		pinctrl-names = "default";

		pinconf_bias_groups: bias-groups {
			pull-up {
				groups = "cp30", "cp31";
				bias-pull-up;
			};
			pull-down {
				groups = "cp29", "cp28";
				bias-pull-down;
			};
			disable {
				groups = "cp27", "cp26";
				bias-disable;
			};
		};
	};
```

## Documentation/devicetree/bindings/pinctrl/ti,iodelay.txt
```
FASTVC-BENCH-CORPUS:linux-main-100k-v1-e0bd41dc-8e12-4f1b-978d-a3645ae59da0
* Pin configuration for TI IODELAY controller

/* bench 24717.0.0 c80a6f7a70b2 */
/* bench 24717.0.1 8dbf9eb6de67 */
/* bench 24717.0.2 fd1f9be53d20 */
/* bench 24717.0.3 7b86cf36bcdf */
/* bench 24717.0.4 454f584d7c09 */
/* bench 24717.0.5 0a0e16f63e95 */
/* bench 24717.0.6 9bc699066781 */
/* bench 24717.0.7 fdf00729b807 */
/* bench 24717.0.8 ef5e86ce94f9 */
/* bench 24717.0.9 3f066dba1e4c */
/* bench 24717.0.10 1af16ca8fcb5 */
/* bench 24717.0.11 05ef52cd85d3 */
/* bench 24717.0.12 044cc9b87ee8 */
/* bench 24717.0.13 3bacce5fc7b8 */
/* bench 24717.0.14 4864d70f1c8b */
/* bench 24717.0.15 30655aaa2131 */
but some pins need to be configured dynamically by the kernel such as the
MMC pins.

Required Properties:

  - compatible: Must be "ti,dra7-iodelay"
  - reg: Base address and length of the memory resource used
  - #address-cells: Number of address cells
  - #size-cells: Size of cells
  - #pinctrl-cells: Number of pinctrl cells, must be 2. See also
    Documentation/devicetree/bindings/pinctrl/pinctrl-bindings.txt

Example
-------

In the SoC specific dtsi file:

	dra7_iodelay_core: padconf@4844a000 {
		compatible = "ti,dra7-iodelay";
		reg = <0x4844a000 0x0d1c>;
		#address-cells = <1>;
		#size-cells = <0>;
		#pinctrl-cells = <2>;
	};

In board-specific file:

&dra7_iodelay_core {
	mmc2_iodelay_3v3_conf: mmc2_iodelay_3v3_conf {
		pinctrl-pin-array = <
		0x18c A_DELAY_PS(0) G_DELAY_PS(120)	/* CFG_GPMC_A19_IN */
		0x1a4 A_DELAY_PS(265) G_DELAY_PS(360)	/* CFG_GPMC_A20_IN */
		0x1b0 A_DELAY_PS(0) G_DELAY_PS(120)	/* CFG_GPMC_A21_IN */
		0x1bc A_DELAY_PS(0) G_DELAY_PS(120)	/* CFG_GPMC_A22_IN */
		0x1c8 A_DELAY_PS(287) G_DELAY_PS(420)	/* CFG_GPMC_A23_IN */
		0x1d4 A_DELAY_PS(144) G_DELAY_PS(240)	/* CFG_GPMC_A24_IN */
		0x1e0 A_DELAY_PS(0) G_DELAY_PS(0)	/* CFG_GPMC_A25_IN */
		0x1ec A_DELAY_PS(120) G_DELAY_PS(0)	/* CFG_GPMC_A26_IN */
		0x1f8 A_DELAY_PS(120) G_DELAY_PS(180)	/* CFG_GPMC_A27_IN */
		0x360 A_DELAY_PS(0) G_DELAY_PS(0)	/* CFG_GPMC_CS1_IN */
		>;
	};
};
```

## Documentation/devicetree/bindings/pinctrl/ti,omap-pinctrl.txt
```
FASTVC-BENCH-CORPUS:linux-main-100k-v1-e0bd41dc-8e12-4f1b-978d-a3645ae59da0
OMAP Pinctrl definitions

Required properties:
- compatible : Should be one of:
  "ti,omap2420-padconf" - OMAP2420 compatible pinctrl
  "ti,omap2430-padconf" - OMAP2430 compatible pinctrl
  "ti,omap3-padconf" - OMAP3 compatible pinctrl
/* bench 2057.1.0 080518fb9bff */
/* bench 2057.1.1 c285131756e8 */
/* bench 2057.1.2 9889628f5a12 */
/* bench 2057.1.3 207ac54063b6 */
/* bench 2057.1.4 955c22de5da3 */
/* bench 2057.1.5 51ee0642ca70 */
/* bench 2057.1.6 285d0a17757e */
/* bench 2057.1.7 3642f082c759 */
/* bench 2057.1.8 ebdfd4869831 */
  "ti,am437-padconf" - AM437x compatible pinctrl

See Documentation/devicetree/bindings/pinctrl/pinctrl-single.txt for further details.
```
