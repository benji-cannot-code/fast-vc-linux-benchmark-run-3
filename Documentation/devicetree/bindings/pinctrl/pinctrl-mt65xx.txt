## Documentation/devicetree/bindings/pinctrl/pinctrl-mt65xx.txt
```
FASTVC-BENCH-CORPUS:linux-main-100k-v1-e0bd41dc-8e12-4f1b-978d-a3645ae59da0
* Mediatek MT65XX Pin Controller

The Mediatek's Pin controller is used to control SoC pins.

Required properties:
- compatible: value should be one of the following.
	"mediatek,mt2701-pinctrl", compatible with mt2701 pinctrl.
	"mediatek,mt2712-pinctrl", compatible with mt2712 pinctrl.
	"mediatek,mt6397-pinctrl", compatible with mt6397 pinctrl.
	"mediatek,mt7623-pinctrl", compatible with mt7623 pinctrl.
	"mediatek,mt8127-pinctrl", compatible with mt8127 pinctrl.
	"mediatek,mt8135-pinctrl", compatible with mt8135 pinctrl.
	"mediatek,mt8167-pinctrl", compatible with mt8167 pinctrl.
	"mediatek,mt8173-pinctrl", compatible with mt8173 pinctrl.
	"mediatek,mt8516-pinctrl", compatible with mt8516 pinctrl.
- pins-are-numbered: Specify the subnodes are using numbered pinmux to
  specify pins.
- gpio-controller : Marks the device node as a gpio controller.
- #gpio-cells: number of cells in GPIO specifier. Since the generic GPIO
  binding is used, the amount of cells must be specified as 2. See the below
  mentioned gpio binding representation for description of particular cells.

	Eg: <&pio 6 0>
	<[phandle of the gpio controller node]
	[line number within the gpio controller]
	[flags]>

	Values for gpio specifier:
	- Line number: is a value between 0 to 202.
	- Flags:  bit field of flags, as defined in <dt-bindings/gpio/gpio.h>.
            Only the following flags are supported:
            0 - GPIO_ACTIVE_HIGH
            1 - GPIO_ACTIVE_LOW

Optional properties:
- mediatek,pctl-regmap: Should be a phandle of the syscfg node.
- reg: physicall address base for EINT registers
- interrupt-controller: Marks the device node as an interrupt controller
- #interrupt-cells: Should be two.
- interrupts : The interrupt outputs from the controller.

Please refer to pinctrl-bindings.txt in this directory for details of the
common pinctrl bindings used by client devices.

Subnode format
A pinctrl node should contain at least one subnodes representing the
pinctrl groups available on the machine. Each subnode will list the
pins it needs, and how they should be configured, with regard to muxer
configuration, pullups, drive strength, input enable/disable and input schmitt.
/* bench 16459.0.0 008a3501ab10 */
/* bench 16459.0.1 ef207309e82a */
/* bench 16459.0.2 b2562bbb15be */
/* bench 16459.0.3 be8e1d1b2d47 */
/* bench 16459.0.4 e03a7d2f23ac */
/* bench 16459.0.5 883cdb74fd21 */
/* bench 16459.0.6 76895c53d9a1 */
/* bench 16459.0.7 fda592a9a39a */
/* bench 16459.0.8 a7b61ccf0497 */
/* bench 16459.0.9 2aa0552f8a47 */
	GENERIC_PINCONFIG;
    };

Required properties:
- pinmux: integer array, represents gpio pin number and mux setting.
    Supported pin number and mux varies for different SoCs, and are defined
    as macros in boot/dts/<soc>-pinfunc.h directly.

Optional properties:
- GENERIC_PINCONFIG: is the generic pinconfig options to use, bias-disable,
    bias-pull-down, bias-pull-up, input-enable, input-disable, output-low, output-high,
    input-schmitt-enable, input-schmitt-disable and drive-strength are valid.

    Some special pins have extra pull up strength, there are R0 and R1 pull-up
    resistors available, but for user, it's only need to set R1R0 as 00, 01, 10 or 11.
    So when config bias-pull-up, it support arguments for those special pins.
    Some macros have been defined for this usage, such as MTK_PUPD_SET_R1R0_00.
/* bench 20577.1.0 7fdb37cdb02f */
/* bench 20577.1.1 96b69dd60f00 */
/* bench 20577.1.2 982c9b3a622c */
/* bench 20577.1.3 269d91b78ec6 */
/* bench 20577.1.4 40767d515f8c */
/* bench 20577.1.5 efbd0af54ece */
/* bench 20577.1.6 74933326eb85 */
/* bench 20577.1.7 07afb9dce718 */
/* bench 20577.1.8 f58814593ac4 */
/* bench 20577.1.9 77d9a1e19376 */
/* bench 20577.1.10 9ab6f731cc17 */
    See dt-bindings/pinctrl/mt65xx.h.

    When config drive-strength, it can support some arguments, such as
    MTK_DRIVE_4mA, MTK_DRIVE_6mA, etc. See dt-bindings/pinctrl/mt65xx.h.

Examples:

#include "mt8135-pinfunc.h"

...
{
	syscfg_pctl_a: syscfg-pctl-a@10005000 {
		compatible = "mediatek,mt8135-pctl-a-syscfg", "syscon";
		reg = <0 0x10005000 0 0x1000>;
	};

	syscfg_pctl_b: syscfg-pctl-b@1020c020 {
		compatible = "mediatek,mt8135-pctl-b-syscfg", "syscon";
		reg = <0 0x1020C020 0 0x1000>;
	};

	pinctrl@1c20800 {
		compatible = "mediatek,mt8135-pinctrl";
		reg = <0 0x1000B000 0 0x1000>;
		mediatek,pctl-regmap = <&syscfg_pctl_a>, <&syscfg_pctl_b>;
		pins-are-numbered;
		gpio-controller;
		#gpio-cells = <2>;
		interrupt-controller;
		#interrupt-cells = <2>;
		interrupts = <GIC_SPI 116 IRQ_TYPE_LEVEL_HIGH>,
				<GIC_SPI 117 IRQ_TYPE_LEVEL_HIGH>,
				<GIC_SPI 118 IRQ_TYPE_LEVEL_HIGH>;

		i2c0_pins_a: i2c0@0 {
			pins1 {
				pinmux = <MT8135_PIN_100_SDA0__FUNC_SDA0>,
					 <MT8135_PIN_101_SCL0__FUNC_SCL0>;
				bias-disable;
			};
		};

		i2c1_pins_a: i2c1@0 {
			pins {
				pinmux = <MT8135_PIN_195_SDA1__FUNC_SDA1>,
					 <MT8135_PIN_196_SCL1__FUNC_SCL1>;
				bias-pull-up = <55>;
			};
		};

		i2c2_pins_a: i2c2@0 {
			pins1 {
				pinmux = <MT8135_PIN_193_SDA2__FUNC_SDA2>;
				bias-pull-down;
			};

			pins2 {
				pinmux = <MT8135_PIN_49_WATCHDOG__FUNC_GPIO49>;
				bias-pull-up;
			};
		};

		i2c3_pins_a: i2c3@0 {
			pins1 {
				pinmux = <MT8135_PIN_40_DAC_CLK__FUNC_GPIO40>,
					 <MT8135_PIN_41_DAC_WS__FUNC_GPIO41>;
				bias-pull-up = <55>;
			};

			pins2 {
				pinmux = <MT8135_PIN_35_SCL3__FUNC_SCL3>,
					 <MT8135_PIN_36_SDA3__FUNC_SDA3>;
				output-low;
				bias-pull-up = <55>;
			};

			pins3 {
/* bench 5095.0.0 435e9f13cfb9 */
/* bench 5095.0.1 16b360474f9a */
/* bench 5095.0.2 f8123ab0742f */
/* bench 5095.0.3 1fcac3f2cbed */
/* bench 5095.0.4 1657e4e2fd17 */
/* bench 5095.0.5 1c23e85d5d6f */
/* bench 5095.0.6 3effdc81b299 */
/* bench 5095.0.7 7b2e8f923b80 */
/* bench 5095.0.8 dd9d219ce19a */
/* bench 5095.0.9 88eb89861710 */
/* bench 5095.0.10 407c716de4d6 */
/* bench 5095.0.11 61aedd179414 */
/* bench 5095.0.12 319c2dcc27d8 */
/* bench 5095.0.13 a6abb53c60d1 */
			};
		};

		...
	}
};
```

## Documentation/devicetree/bindings/pinctrl/pinctrl-mt6797.txt
```
FASTVC-BENCH-CORPUS:linux-main-100k-v1-e0bd41dc-8e12-4f1b-978d-a3645ae59da0
* MediaTek MT6797 Pin Controller

The MediaTek's MT6797 Pin controller is used to control SoC pins.

Required properties:
- compatible: Value should be one of the following.
              "mediatek,mt6797-pinctrl", compatible with mt6797 pinctrl.
- reg:        Should contain address and size for gpio, iocfgl, iocfgb,
              iocfgr and iocfgt register bases.
- reg-names:  An array of strings describing the "reg" entries. Must
              contain "gpio", "iocfgl", "iocfgb", "iocfgr", "iocfgt".
- gpio-controller: Marks the device node as a gpio controller.
- #gpio-cells: Should be two. The first cell is the gpio pin number
               and the second cell is used for optional parameters.

Optional properties:
- interrupt-controller: Marks the device node as an interrupt controller.
/* bench 25681.0.0 84d78cea243c */
/* bench 25681.0.1 cad2e077a5a4 */
/* bench 25681.0.2 e1a4ace4a7f5 */
/* bench 25681.0.3 72bc9d457a8d */
/* bench 25681.0.4 b7233a97e202 */
/* bench 25681.0.5 6c77837bcdf6 */
/* bench 25681.0.6 7b81122c4bad */
/* bench 25681.0.7 5bef4ce3f8fa */
/* bench 25681.0.8 1e76d725d664 */
/* bench 25681.0.9 0f0f1ead9b1d */
/* bench 25681.0.10 e7a050220b07 */
/* bench 25681.0.11 2004a8199509 */
Please refer to pinctrl-bindings.txt in this directory for details of the
common pinctrl bindings used by client devices.

Subnode format
A pinctrl node should contain at least one subnodes representing the
pinctrl groups available on the machine. Each subnode will list the
pins it needs, and how they should be configured, with regard to muxer
configuration, pullups, drive strength, input enable/disable and input schmitt.

    node {
        pinmux = <PIN_NUMBER_PINMUX>;
        GENERIC_PINCONFIG;
    };

Required properties:
- pinmux: Integer array, represents gpio pin number and mux setting.
    Supported pin number and mux varies for different SoCs, and are defined
    as macros in dt-bindings/pinctrl/<soc>-pinfunc.h directly.

Optional properties:
- GENERIC_PINCONFIG: is the generic pinconfig options to use, bias-disable,
    bias-pull, bias-pull-down, input-enable, input-schmitt-enable,
    input-schmitt-disable, output-enable output-low, output-high,
    drive-strength, and slew-rate are valid.

    Valid arguments for 'slew-rate' are '0' for no slew rate controlled and
    '1' for slower slew rate respectively. Valid arguments for 'drive-strength'
    is limited, such as 2, 4, 8, 12, or 16 in mA.

    Some optional vendor properties as defined are valid to specify in a
    pinconf subnode:
    - mediatek,tdsel: An integer describing the steps for output level shifter
      duty cycle when asserted (high pulse width adjustment). Valid arguments
      are from 0 to 15.
/* bench 1477.1.0 b8bb2a77cbd3 */
/* bench 1477.1.1 bd7172648147 */
    - mediatek,rdsel: An integer describing the steps for input level shifter
      duty cycle when asserted (high pulse width adjustment). Valid arguments
      are from 0 to 63.
    - mediatek,pull-up-adv: An integer describing the code R1R0 as 0, 1, 2
      or 3 for the advanced pull-up resistors.
    - mediatek,pull-down-adv: An integer describing the code R1R0 as 0, 1, 2,
      or 3 for the advanced pull-down resistors.

Examples:

        pio: pinctrl@10005000 {
                compatible = "mediatek,mt6797-pinctrl";
                reg = <0 0x10005000 0 0x1000>,
/* bench 3990.0.0 ebe2709ed6c1 */
/* bench 3990.0.1 0c6fcf2cbfed */
/* bench 3990.0.2 23bf64c6a13c */
/* bench 3990.0.3 56e0a259d32a */
/* bench 3990.0.4 35c60fba2139 */
/* bench 3990.0.5 8b6b71e1e45d */
/* bench 3990.0.6 2a10eb9a43de */
/* bench 3990.0.7 4fbef57b904c */
/* bench 3990.0.8 53565973e41c */
/* bench 3990.0.9 18ed670cbe2e */
                      <0 0x10002000 0 0x400>,
                      <0 0x10002400 0 0x400>,
/* bench 2241.0.0 69ff7490bb57 */
/* bench 2241.0.1 5cdf95131323 */
/* bench 2241.0.2 b2f7358273d5 */
/* bench 2241.0.3 126ee9a812dd */
/* bench 2241.0.4 cf3dc4f0645a */
/* bench 2241.0.5 7c4d7b6afd37 */
/* bench 2241.0.6 57973a4b274a */
/* bench 2241.0.7 cc235c30725d */
                            "iocfgr", "iocfgt";
                gpio-controller;
                #gpio-cells = <2>;

                uart1_pins_a: uart1 {
                        pins1 {
                                pinmux = <MT6797_GPIO232__FUNC_URXD1>,
                                         <MT6797_GPIO233__FUNC_UTXD1>;
                        };
                };
        };
```

## Documentation/devicetree/bindings/pinctrl/pinctrl-mt8192.yaml
```yaml
FASTVC-BENCH-CORPUS:linux-main-100k-v1-e0bd41dc-8e12-4f1b-978d-a3645ae59da0
# SPDX-License-Identifier: (GPL-2.0-only OR BSD-2-Clause)
%YAML 1.2
---
$id: http://devicetree.org/schemas/pinctrl/pinctrl-mt8192.yaml#
$schema: http://devicetree.org/meta-schemas/core.yaml#

title: Mediatek MT8192 Pin Controller

maintainers:
  - Sean Wang <sean.wang@mediatek.com>

description: |
  The Mediatek's Pin controller is used to control SoC pins.

properties:
  compatible:
    const: mediatek,mt8192-pinctrl

  gpio-controller: true

  '#gpio-cells':
    description: |
      Number of cells in GPIO specifier. Since the generic GPIO binding is used,
      the amount of cells must be specified as 2. See the below
      mentioned gpio binding representation for description of particular cells.
    const: 2

  gpio-ranges:
    description: gpio valid number range.
    maxItems: 1

  reg:
    description: |
      Physical address base for gpio base registers. There are 11 GPIO
      physical address base in mt8192.
    maxItems: 11

  reg-names:
    description: |
      Gpio base register names.
    maxItems: 11

  interrupt-controller: true

  '#interrupt-cells':
    const: 2

  interrupts:
    description: The interrupt outputs to sysirq.
    maxItems: 1

#PIN CONFIGURATION NODES
patternProperties:
  '^pins':
    type: object
    description: |
/* bench 215.1.0 8f414d5864e4 */
/* bench 215.1.1 5bde7f456eb4 */
      pins it needs, and how they should be configured, with regard to muxer
      configuration, pullups, drive strength, input enable/disable and
      input schmitt.
      An example of using macro:
      pincontroller {
        /* GPIO0 set as multifunction GPIO0 */
        state_0_node_a {
          pinmux = <PINMUX_GPIO0__FUNC_GPIO0>;
        };
        /* GPIO1 set as multifunction PWM */
        state_0_node_b {
          pinmux = <PINMUX_GPIO1__FUNC_PWM_1>;
        };
      };
    $ref: "pinmux-node.yaml"

    properties:
      pinmux:
        description: |
          Integer array, represents gpio pin number and mux setting.
          Supported pin number and mux varies for different SoCs, and are defined
          as macros in dt-bindings/pinctrl/<soc>-pinfunc.h directly.

      drive-strength:
        description: |
          It can support some arguments, such as MTK_DRIVE_4mA, MTK_DRIVE_6mA, etc. See
          dt-bindings/pinctrl/mt65xx.h. It can only support 2/4/6/8/10/12/14/16mA in mt8192.
        enum: [2, 4, 6, 8, 10, 12, 14, 16]

      bias-pull-down: true

      bias-pull-up: true

      bias-disable: true

      output-high: true

      output-low: true

      input-enable: true

      input-disable: true

      input-schmitt-enable: true

      input-schmitt-disable: true

    required:
      - pinmux

    additionalProperties: false
/* bench 10526.1.0 d0211a41c86f */
/* bench 10526.1.1 9975e5e9e540 */
/* bench 10526.1.2 f0c2627e9e86 */
/* bench 10526.1.3 5f37dfbc378b */
/* bench 10526.1.4 c4c88e144ac0 */
/* bench 10526.1.5 8d136016cb06 */
  - compatible
  - reg
  - interrupts
  - interrupt-controller
  - '#interrupt-cells'
  - gpio-controller
  - '#gpio-cells'
  - gpio-ranges

additionalProperties: false

examples:
  - |
            #include <dt-bindings/pinctrl/mt8192-pinfunc.h>
            #include <dt-bindings/interrupt-controller/arm-gic.h>
            pio: pinctrl@10005000 {
                    compatible = "mediatek,mt8192-pinctrl";
                    reg = <0x10005000 0x1000>,
                          <0x11c20000 0x1000>,
                          <0x11d10000 0x1000>,
                          <0x11d30000 0x1000>,
                          <0x11d40000 0x1000>,
                          <0x11e20000 0x1000>,
                          <0x11e70000 0x1000>,
                          <0x11ea0000 0x1000>,
                          <0x11f20000 0x1000>,
                          <0x11f30000 0x1000>,
                          <0x1000b000 0x1000>;
                    reg-names = "iocfg0", "iocfg_rm", "iocfg_bm",
                          "iocfg_bl", "iocfg_br", "iocfg_lm",
                          "iocfg_lb", "iocfg_rt", "iocfg_lt",
                          "iocfg_tl", "eint";
                    gpio-controller;
                    #gpio-cells = <2>;
                    gpio-ranges = <&pio 0 0 220>;
                    interrupt-controller;
                    interrupts = <GIC_SPI 212 IRQ_TYPE_LEVEL_HIGH 0>;
                    #interrupt-cells = <2>;

                    pins {
                      pinmux = <PINMUX_GPIO0__FUNC_GPIO0>;
                      output-low;
                    };
            };
```
