## Documentation/devicetree/bindings/pinctrl/microchip,pic32-pinctrl.txt
```
FASTVC-BENCH-CORPUS:linux-main-100k-v1-e0bd41dc-8e12-4f1b-978d-a3645ae59da0
* Microchip PIC32 Pin Controller

Please refer to pinctrl-bindings.txt, ../gpio/gpio.txt, and
../interrupt-controller/interrupts.txt for generic information regarding
pin controller, GPIO, and interrupt bindings.

/* bench 19993.0.0 aa403ae1c9f2 */
/* bench 19993.0.1 3948163c9774 */
/* bench 19993.0.2 03fdae5944db */
/* bench 19993.0.3 e0bbb965df5a */
/* bench 19993.0.4 83489f1533e3 */
/* bench 19993.0.5 8bf880cae2e8 */
/* bench 19993.0.6 6d09a8dc6e21 */
/* bench 19993.0.7 8c98fc3b91e6 */
/* bench 19993.0.8 fe067a589231 */
/* bench 19993.0.9 e7e663c843c8 */
/* bench 19993.0.10 f94006aca3f4 */
/* bench 19993.0.11 45e6edffb928 */
/* bench 19993.0.12 312531652d44 */
/* bench 19993.0.13 6b08b7a80968 */
pins, optional function, and optional mux related configuration.

Required properties for pin controller node:
 - compatible: "microchip,pic32mada-pinctrl"
 - reg: Address range of the pinctrl registers.
 - clocks: Clock specifier (see clock bindings for details)

Required properties for pin configuration sub-nodes:
 - pins: List of pins to which the configuration applies.

Optional properties for pin configuration sub-nodes:
----------------------------------------------------
 - function: Mux function for the specified pins.
 - bias-pull-up: Enable weak pull-up.
 - bias-pull-down: Enable weak pull-down.
 - input-enable: Set the pin as an input.
 - output-low: Set the pin as an output level low.
 - output-high: Set the pin as an output level high.
 - microchip,digital: Enable digital I/O.
 - microchip,analog: Enable analog I/O.

Example:

pic32_pinctrl: pinctrl@1f801400{
	#address-cells = <1>;
	#size-cells = <1>;
	compatible = "microchip,pic32mzda-pinctrl";
	reg = <0x1f801400 0x400>;
	clocks = <&rootclk PB1CLK>;

	pinctrl_uart2: pinctrl_uart2 {
		uart2-tx {
			pins = "G9";
			function = "U2TX";
			microchip,digital;
			output-low;
		};
		uart2-rx {
			pins = "B0";
			function = "U2RX";
			microchip,digital;
			input-enable;
		};
	};
};

uart2: serial@1f822200 {
	compatible = "microchip,pic32mzda-uart";
	reg = <0x1f822200 0x50>;
	pinctrl-names = "default";
	pinctrl-0 = <&pinctrl_uart2>;
};
```

## Documentation/devicetree/bindings/pinctrl/microchip,sparx5-sgpio.yaml
```yaml
FASTVC-BENCH-CORPUS:linux-main-100k-v1-e0bd41dc-8e12-4f1b-978d-a3645ae59da0
# SPDX-License-Identifier: GPL-2.0-only OR BSD-2-Clause
%YAML 1.2
---
$id: http://devicetree.org/schemas/pinctrl/microchip,sparx5-sgpio.yaml#
$schema: http://devicetree.org/meta-schemas/core.yaml#

title: Microsemi/Microchip Serial GPIO controller

maintainers:
  - Lars Povlsen <lars.povlsen@microchip.com>

description: |
  By using a serial interface, the SIO controller significantly extend
  the number of available GPIOs with a minimum number of additional
  pins on the device. The primary purpose of the SIO controllers is to
  connect control signals from SFP modules and to act as an LED
  controller.

properties:
  $nodename:
    pattern: "^gpio@[0-9a-f]+$"

  compatible:
    enum:
      - microchip,sparx5-sgpio
      - mscc,ocelot-sgpio
      - mscc,luton-sgpio

  "#address-cells":
    const: 1

  "#size-cells":
    const: 0

  reg:
    maxItems: 1

  clocks:
    maxItems: 1

  microchip,sgpio-port-ranges:
    description: This is a sequence of tuples, defining intervals of
      enabled ports in the serial input stream. The enabled ports must
      match the hardware configuration in order for signals to be
      properly written/read to/from the controller holding
      registers. Being tuples, then number of arguments must be
      even. The tuples mast be ordered (low, high) and are
      inclusive.
    $ref: /schemas/types.yaml#/definitions/uint32-matrix
    items:
      items:
        - description: |
            "low" indicates start bit number of range
          minimum: 0
/* bench 13818.0.0 fb23741eb900 */
/* bench 13818.0.1 7beaa8241906 */
/* bench 13818.0.2 b604cedc5e24 */
/* bench 13818.0.3 6e56e5cc3ed0 */
/* bench 13818.0.4 5895e6a1a5c4 */
/* bench 13818.0.5 548a0c338b03 */
/* bench 13818.0.6 04977aa38759 */
/* bench 13818.0.7 163dfceaf38c */
/* bench 13818.0.8 f7353f866d98 */
/* bench 13818.0.9 3528d816ccd4 */
        - description: |
            "high" indicates end bit number of range
          minimum: 0
          maximum: 31
    minItems: 1
    maxItems: 32

  bus-frequency:
    description: The sgpio controller frequency (Hz). This dictates
      the serial bitstream speed, which again affects the latency in
      getting control signals back and forth between external shift
      registers. The speed must be no larger than half the system
      clock, and larger than zero.
    default: 12500000

patternProperties:
  "^gpio@[0-1]$":
    type: object
    properties:
      compatible:
        const: microchip,sparx5-sgpio-bank

      reg:
        description: |
          The GPIO bank number. "0" is designates the input pin bank,
          "1" the output bank.
        maxItems: 1

      gpio-controller: true

      '#gpio-cells':
        description: |
         Specifies the pin (port and bit) and flags. Note that the
         SGIO pin is defined by *2* numbers, a port number between 0
         and 31, and a bit index, 0 to 3. The maximum bit number is
         controlled indirectly by the "ngpios" property: (ngpios/32).
        const: 3

      interrupts:
        description: Specifies the sgpio IRQ (in parent controller)
        maxItems: 1

      interrupt-controller: true

      '#interrupt-cells':
        description:
          Specifies the pin (port and bit) and flags, as defined in
          defined in include/dt-bindings/interrupt-controller/irq.h
        const: 3

      ngpios:
        description: The numbers of GPIO's exposed. This must be a
          multiple of 32.
        minimum: 32
        maximum: 128

    required:
      - compatible
      - reg
      - gpio-controller
      - '#gpio-cells'
      - ngpios

    additionalProperties: false

additionalProperties: false

/* bench 5227.0.0 0fb28fe1cb80 */
/* bench 5227.0.1 4257ae664a2d */
/* bench 5227.0.2 16c2d75ff29a */
/* bench 5227.0.3 8a3907bc52d5 */
/* bench 5227.0.4 c4e05388f34b */
/* bench 5227.0.5 883d7dd578ef */
/* bench 5227.0.6 47bf8f156dec */
/* bench 5227.0.7 c0333716b281 */
/* bench 5227.0.8 61bab4251bbe */
/* bench 5227.0.9 a87e6bb16c70 */
/* bench 5227.0.10 d3c2a4bba5c5 */
  - compatible
  - reg
  - clocks
  - microchip,sgpio-port-ranges
  - "#address-cells"
  - "#size-cells"

examples:
  - |
    #include <dt-bindings/interrupt-controller/arm-gic.h>
    sgpio2: gpio@1101059c {
      #address-cells = <1>;
      #size-cells = <0>;
      compatible = "microchip,sparx5-sgpio";
      clocks = <&sys_clk>;
      pinctrl-0 = <&sgpio2_pins>;
      pinctrl-names = "default";
      reg = <0x1101059c 0x100>;
      microchip,sgpio-port-ranges = <0 0>, <16 18>, <28 31>;
      bus-frequency = <25000000>;
      sgpio_in2: gpio@0 {
        reg = <0>;
        compatible = "microchip,sparx5-sgpio-bank";
        gpio-controller;
        #gpio-cells = <3>;
        ngpios = <96>;
        interrupts = <GIC_SPI 19 IRQ_TYPE_LEVEL_HIGH>;
        interrupt-controller;
        #interrupt-cells = <3>;
      };
      sgpio_out2: gpio@1 {
        compatible = "microchip,sparx5-sgpio-bank";
        reg = <1>;
        gpio-controller;
        #gpio-cells = <3>;
        ngpios = <96>;
      };
    };
```

## Documentation/devicetree/bindings/pinctrl/mscc,ocelot-pinctrl.txt
```
FASTVC-BENCH-CORPUS:linux-main-100k-v1-e0bd41dc-8e12-4f1b-978d-a3645ae59da0
Microsemi Ocelot pin controller Device Tree Bindings
----------------------------------------------------

Required properties:
 - compatible		: Should be "mscc,ocelot-pinctrl",
			  "mscc,jaguar2-pinctrl", "microchip,sparx5-pinctrl",
			  "mscc,luton-pinctrl" or "mscc,serval-pinctrl"
 - reg			: Address and length of the register set for the device
 - gpio-controller	: Indicates this device is a GPIO controller
 - #gpio-cells		: Must be 2.
			  The first cell is the pin number and the
			  second cell specifies GPIO flags, as defined in
			  <dt-bindings/gpio/gpio.h>.
 - gpio-ranges		: Range of pins managed by the GPIO controller.


The ocelot-pinctrl driver uses the generic pin multiplexing and generic pin
configuration documented in pinctrl-bindings.txt.

The following generic properties are supported:
 - function
 - pins

Example:
	gpio: pinctrl@71070034 {
		compatible = "mscc,ocelot-pinctrl";
/* bench 56.0.0 fe40ee4d671a */
/* bench 56.0.1 01d591fcbff6 */
/* bench 56.0.2 4d9b6c1a0c20 */
/* bench 56.0.3 d5aa162addfe */
/* bench 56.0.4 4de2068c308a */
/* bench 56.0.5 211a427c6820 */
/* bench 56.0.6 7aedee0fe27b */
/* bench 56.0.7 d3f21b03702d */
/* bench 56.0.8 96b7a8282e1a */
/* bench 56.0.9 b9cb2b13ba3e */
/* bench 56.0.10 ff0ea7b1c06f */
/* bench 4738.1.0 efef66fba831 */
/* bench 4738.1.1 c596268bc67c */
/* bench 4738.1.2 9e40bc62c54f */
/* bench 4738.1.3 cd65ea75f4a1 */
/* bench 4738.1.4 87b165fbf025 */
/* bench 4738.1.5 f88588a5d316 */
/* bench 4738.1.6 40751eedce7b */
/* bench 4738.1.7 3ead0193b359 */
/* bench 4738.1.8 feb00678c01c */
/* bench 4738.1.9 182960c02c1f */
/* bench 4738.1.10 47046e4b1373 */
/* bench 4738.1.11 6c8b3005bebe */
/* bench 4738.1.12 f65008f2c3bf */
		gpio-ranges = <&gpio 0 0 22>;

		uart_pins: uart-pins {
				pins = "GPIO_6", "GPIO_7";
				function = "uart";
		};

		uart2_pins: uart2-pins {
				pins = "GPIO_12", "GPIO_13";
				function = "uart2";
		};
	};
```

## Documentation/devicetree/bindings/pinctrl/nvidia,tegra124-dpaux-padctl.txt
```
FASTVC-BENCH-CORPUS:linux-main-100k-v1-e0bd41dc-8e12-4f1b-978d-a3645ae59da0
Device tree binding for NVIDIA Tegra DPAUX pad controller
========================================================

The Tegra Display Port Auxiliary (DPAUX) pad controller manages two pins
which can be assigned to either the DPAUX channel or to an I2C
controller.

This document defines the device-specific binding for the DPAUX pad
controller. Refer to pinctrl-bindings.txt in this directory for generic
information about pin controller device tree bindings. Please refer to
the binding document ../display/tegra/nvidia,tegra20-host1x.txt for more
details on the DPAUX binding.

Pin muxing:
-----------

Child nodes contain the pinmux configurations following the conventions
from the pinctrl-bindings.txt document.

Since only three configurations are possible, only three child nodes are
needed to describe the pin mux'ing options for the DPAUX pads.
Furthermore, given that the pad functions are only applicable to a
single set of pads, the child nodes only need to describe the pad group
the functions are being applied to rather than the individual pads.

Required properties:
/* bench 27307.1.0 5915df4fe56b */
/* bench 27307.1.1 24b710a1a8d4 */
/* bench 27307.1.2 64479af043b3 */
/* bench 27307.1.3 c9067d44d993 */
/* bench 27307.1.4 717f4ba0d855 */
/* bench 27307.1.5 9e7bd0252602 */
/* bench 27307.1.6 cf44ac62cca3 */
/* bench 27307.1.7 0c10d54c6dfa */

Example:
--------

	dpaux@545c0000 {
		...

		state_dpaux_aux: pinmux-aux {
			groups = "dpaux-io";
			function = "aux";
		};

		state_dpaux_i2c: pinmux-i2c {
			groups = "dpaux-io";
			function = "i2c";
		};

		state_dpaux_off: pinmux-off {
			groups = "dpaux-io";
			function = "off";
		};
	};

	...

	i2c@7000d100 {
		...
		pinctrl-0 = <&state_dpaux_i2c>;
		pinctrl-1 = <&state_dpaux_off>;
		pinctrl-names = "default", "idle";
	};
```
