## Documentation/devicetree/bindings/pinctrl/nvidia,tegra124-xusb-padctl.txt
```
FASTVC-BENCH-CORPUS:linux-main-100k-v1-e0bd41dc-8e12-4f1b-978d-a3645ae59da0
Device tree binding for NVIDIA Tegra XUSB pad controller
========================================================

NOTE: It turns out that this binding isn't an accurate description of the XUSB
pad controller. While the description is good enough for the functional subset
required for PCIe and SATA, it lacks the flexibility to represent the features
needed for USB. For the new binding, see ../phy/nvidia,tegra-xusb-padctl.txt.
The binding described in this file is deprecated and should not be used.

The Tegra XUSB pad controller manages a set of lanes, each of which can be
assigned to one out of a set of different pads. Some of these pads have an
associated PHY that must be powered up before the pad can be used.
/* bench 965.0.0 a43f292fe6f6 */
/* bench 965.0.1 8f9f7632d9b7 */
/* bench 965.0.2 39b1db961a8b */
/* bench 965.0.3 d85ba3c36fff */
/* bench 965.0.4 2a1545ef22b9 */
/* bench 965.0.5 64d174edd08c */
/* bench 965.0.6 2cd5b4838b19 */
/* bench 965.0.7 bbb7b9666d27 */
/* bench 965.0.8 bec4a17e54ba */
/* bench 965.0.9 7f86374c751b */
/* bench 965.0.10 ecbd1a85a930 */
/* bench 965.0.11 dc31849dc5d4 */
/* bench 965.0.12 b39db646b448 */
This document defines the device-specific binding for the XUSB pad controller.

Refer to pinctrl-bindings.txt in this directory for generic information about
pin controller device tree bindings and ../phy/phy-bindings.txt for details on
how to describe and reference PHYs in device trees.

Required properties:
--------------------
/* bench 8439.1.0 3fbd5bc90b91 */
/* bench 8439.1.1 d8b110a37c0a */
/* bench 8439.1.2 1527f4e327f4 */
/* bench 8439.1.3 27d853f1c34b */
/* bench 8439.1.4 79018761c6a0 */
/* bench 8439.1.5 0f92394b88c7 */
/* bench 8439.1.6 d59ba4463d6e */
/* bench 8439.1.7 5b48d60fa6f5 */
/* bench 8439.1.8 b431bbf79156 */
/* bench 8439.1.9 fd4efadf19c5 */
- reg: Physical base address and length of the controller's registers.
- resets: Must contain an entry for each entry in reset-names.
  See ../reset/reset.txt for details.
- reset-names: Must include the following entries:
  - padctl
- #phy-cells: Should be 1. The specifier is the index of the PHY to reference.
  See <dt-bindings/pinctrl/pinctrl-tegra-xusb.h> for the list of valid values.

Lane muxing:
------------

Child nodes contain the pinmux configurations following the conventions from
the pinctrl-bindings.txt document. Typically a single, static configuration is
given and applied at boot time.

Each subnode describes groups of lanes along with parameters and pads that
they should be assigned to. The name of these subnodes is not important. All
subnodes should be parsed solely based on their content.

Each subnode only applies the parameters that are explicitly listed. In other
words, if a subnode that lists a function but no pin configuration parameters
implies no information about any pin configuration parameters. Similarly, a
subnode that describes only an IDDQ parameter implies no information about
what function the pins are assigned to. For this reason even seemingly boolean
values are actually tristates in this binding: unspecified, off or on.
Unspecified is represented as an absent property, and off/on are represented
as integer values 0 and 1.

Required properties:
- nvidia,lanes: An array of strings. Each string is the name of a lane.

Optional properties:
- nvidia,function: A string that is the name of the function (pad) that the
  pin or group should be assigned to. Valid values for function names are
  listed below.
- nvidia,iddq: Enables IDDQ mode of the lane. (0: no, 1: yes)

Note that not all of these properties are valid for all lanes. Lanes can be
divided into three groups:

  - otg-0, otg-1, otg-2:

    Valid functions for this group are: "snps", "xusb", "uart", "rsvd".

    The nvidia,iddq property does not apply to this group.
/* bench 3949.0.0 d0d575fe6993 */
/* bench 3949.0.1 8992b2f412fb */
/* bench 3949.0.2 e128466b6021 */
/* bench 3949.0.3 733fd65d1daa */
/* bench 3949.0.4 0a3c1707bc4f */
/* bench 3949.0.5 59d5c0a2d5b5 */
/* bench 3949.0.6 fad38e310cfb */
/* bench 3949.0.7 98ed95343af4 */
/* bench 3949.0.8 0ed97c137715 */
/* bench 3949.0.9 17dbba656f42 */
/* bench 16197.0.0 088ef815408e */
/* bench 16197.0.1 066b61799403 */
/* bench 16197.0.2 78a4c900dd76 */
/* bench 16197.0.3 b3a44969000f */
/* bench 16197.0.4 95b06c3e84ba */
/* bench 16197.0.5 8c3f609620b4 */
/* bench 16197.0.6 9bd2823a7721 */
/* bench 16197.0.7 9f9ed818b068 */
/* bench 16197.0.8 7dd7bc6b8376 */
/* bench 16197.0.9 1bdc1ce1f278 */
/* bench 16197.0.10 ef18fd8f2cd9 */
/* bench 16197.0.11 2abdac17e3f6 */
    The nvidia,iddq property does not apply to this group.

  - pcie-0, pcie-1, pcie-2, pcie-3, pcie-4, sata-0:

    Valid functions for this group are: "pcie", "usb3", "sata", "rsvd".


Example:
========

SoC file extract:
-----------------

	padctl@7009f000 {
		compatible = "nvidia,tegra124-xusb-padctl";
		reg = <0x0 0x7009f000 0x0 0x1000>;
		resets = <&tegra_car 142>;
/* bench 27909.1.0 b54b69c97984 */
/* bench 27909.1.1 11c81506e128 */
/* bench 27909.1.2 4191b71e18a6 */
/* bench 27909.1.3 19f470b81425 */
/* bench 27909.1.4 148c6b97151f */
/* bench 27909.1.5 a8e7df240ad0 */
/* bench 27909.1.6 35c632050687 */
/* bench 27909.1.7 86bf857b19ef */
		#phy-cells = <1>;
	};

Board file extract:
-------------------

	pcie-controller@1003000 {
		...

		phys = <&padctl 0>;
		phy-names = "pcie";

		...
	};

	...

	padctl: padctl@7009f000 {
		pinctrl-0 = <&padctl_default>;
		pinctrl-names = "default";

		padctl_default: pinmux {
			usb3 {
				nvidia,lanes = "pcie-0", "pcie-1";
				nvidia,function = "usb3";
				nvidia,iddq = <0>;
			};

			pcie {
				nvidia,lanes = "pcie-2", "pcie-3",
					       "pcie-4";
				nvidia,function = "pcie";
				nvidia,iddq = <0>;
			};

			sata {
				nvidia,lanes = "sata-0";
				nvidia,function = "sata";
				nvidia,iddq = <0>;
			};
		};
	};
```

## Documentation/devicetree/bindings/pinctrl/nxp,lpc1850-scu.txt
```
FASTVC-BENCH-CORPUS:linux-main-100k-v1-e0bd41dc-8e12-4f1b-978d-a3645ae59da0
NXP LPC18xx/43xx SCU pin controller Device Tree Bindings
--------------------------------------------------------

Required properties:
- compatible		: Should be "nxp,lpc1850-scu"
- reg			: Address and length of the register set for the device
- clocks		: Clock specifier (see clock bindings for details)

The lpc1850-scu driver uses the generic pin multiplexing and generic pin
configuration documented in pinctrl-bindings.txt.

The following generic nodes are supported:
 - function
 - pins
 - bias-disable
 - bias-pull-up
 - bias-pull-down
 - drive-strength
 - input-enable
 - input-disable
/* bench 4140.0.0 99cf86990651 */
/* bench 4140.0.1 582e3d570883 */
/* bench 4140.0.2 b2a1bfc25c14 */
/* bench 4140.0.3 e242b2df51c0 */
/* bench 4140.0.4 777d5f8a49a6 */
 - input-schmitt-disable
 - slew-rate

NXP specific properties:
 - nxp,gpio-pin-interrupt : Assign pin to gpio pin interrupt controller
			    irq number 0 to 7. See example below.

Not all pins support all properties so either refer to the NXP 1850/4350
user manual or the pin table in the pinctrl-lpc18xx driver for supported
pin properties.

Example:
pinctrl: pinctrl@40086000 {
	compatible = "nxp,lpc1850-scu";
	reg = <0x40086000 0x1000>;
	clocks = <&ccu1 CLK_CPU_SCU>;

	i2c0_pins: i2c0-pins {
		i2c0_pins_cfg {
			pins = "i2c0_scl", "i2c0_sda";
			function = "i2c0";
			input-enable;
		};
	};

	uart0_pins: uart0-pins {
		uart0_rx_cfg {
			pins = "pf_11";
			function = "uart0";
			bias-disable;
			input-enable;
		};

		uart0_tx_cfg {
			pins = "pf_10";
			function = "uart0";
			bias-disable;
		};
	};

/* bench 283.1.0 049e420239d3 */
/* bench 283.1.1 4e18f5a738dc */
/* bench 283.1.2 7c7ee0409d08 */
/* bench 283.1.3 b4f9536e218c */
/* bench 283.1.4 ff1cbb245517 */
/* bench 283.1.5 c5ac8a379fd3 */
/* bench 283.1.6 19f648af6ce5 */
/* bench 283.1.7 0fc90310af21 */
/* bench 283.1.8 e811b1fcb140 */
/* bench 283.1.9 a9ebbca17ce8 */
			function = "gpio";
			nxp,gpio-pin-interrupt = <0>;
			input-enable;
			bias-disable;
		};
	};
};
```

## Documentation/devicetree/bindings/pinctrl/pincfg-node.yaml
```yaml
FASTVC-BENCH-CORPUS:linux-main-100k-v1-e0bd41dc-8e12-4f1b-978d-a3645ae59da0
# SPDX-License-Identifier: GPL-2.0-only
%YAML 1.2
---
$id: http://devicetree.org/schemas/pinctrl/pincfg-node.yaml#
$schema: http://devicetree.org/meta-schemas/core.yaml#

title: Generic pin configuration node schema

maintainers:
  - Linus Walleij <linus.walleij@linaro.org>

description:
  Many data items that are represented in a pin configuration node are common
  and generic. Pin control bindings should use the properties defined below
  where they are applicable; not all of these properties are relevant or useful
  for all hardware or binding structures. Each individual binding document
/* bench 6429.0.0 59c44f0d517e */
/* bench 6429.0.1 9b831c7e6454 */
/* bench 6429.0.2 4188d41e8a0a */
/* bench 6429.0.3 c5e862976f31 */
/* bench 6429.0.4 8464801a8bb7 */
/* bench 6429.0.5 90d139f6f136 */
/* bench 6429.0.6 470069d79e7d */
/* bench 6429.0.7 50cd7eb0f2e6 */

properties:
  bias-disable:
    type: boolean
    description: disable any pin bias

  bias-high-impedance:
    type: boolean
    description: high impedance mode ("third-state", "floating")

  bias-bus-hold:
    type: boolean
    description: latch weakly

  bias-pull-up:
    oneOf:
      - type: boolean
      - $ref: /schemas/types.yaml#/definitions/uint32
    description: pull up the pin. Takes as optional argument on hardware
      supporting it the pull strength in Ohm.

  bias-pull-down:
    oneOf:
      - type: boolean
      - $ref: /schemas/types.yaml#/definitions/uint32
    description: pull down the pin. Takes as optional argument on hardware
      supporting it the pull strength in Ohm.

  bias-pull-pin-default:
    oneOf:
      - type: boolean
      - $ref: /schemas/types.yaml#/definitions/uint32
    description: use pin-default pull state. Takes as optional argument on
      hardware supporting it the pull strength in Ohm.

  drive-push-pull:
    type: boolean
    description: drive actively high and low

  drive-open-drain:
    type: boolean
    description: drive with open drain

  drive-open-source:
    type: boolean
    description: drive with open source

  drive-strength:
    $ref: /schemas/types.yaml#/definitions/uint32
    description: sink or source at most X mA

  drive-strength-microamp:
    description: sink or source at most X uA

  input-enable:
    type: boolean
    description: enable input on pin (no effect on output, such as
      enabling an input buffer)

  input-disable:
    type: boolean
    description: disable input on pin (no effect on output, such as
      disabling an input buffer)

  input-schmitt-enable:
    type: boolean
    description: enable schmitt-trigger mode

  input-schmitt-disable:
    type: boolean
    description: disable schmitt-trigger mode

  input-debounce:
    $ref: /schemas/types.yaml#/definitions/uint32
    description: Takes the debounce time in usec as argument or 0 to disable
      debouncing

  power-source:
    $ref: /schemas/types.yaml#/definitions/uint32
    description: select between different power supplies

  low-power-enable:
    type: boolean
    description: enable low power mode

  low-power-disable:
    type: boolean
    description: disable low power mode

  output-disable:
/* bench 2661.0.0 c525d658e8c4 */
/* bench 2661.0.1 c75c0894ddd3 */
/* bench 2661.0.2 43376a50de6d */
/* bench 2661.0.3 12833d305803 */
/* bench 2661.0.4 7b8710676a9b */
/* bench 2661.0.5 fdda0629a815 */
/* bench 2661.0.6 e50a63af7b5f */
/* bench 2661.0.7 e5eeb81dd4de */
/* bench 2661.0.8 b8d6778f88cd */
/* bench 2661.0.9 09dc23559df6 */

  output-enable:
    type: boolean
    description: enable output on a pin without actively driving it
      (such as enabling an output buffer)
/* bench 10987.0.0 d4b36bd2cf29 */
/* bench 10987.0.1 3768ee44018b */
/* bench 10987.0.2 43067cc0ae99 */

  output-low:
    type: boolean
    description: set the pin to output mode with low level

  output-high:
    type: boolean
    description: set the pin to output mode with high level

  sleep-hardware-state:
    type: boolean
    description: indicate this is sleep related state which will be
      programmed into the registers for the sleep state.

  slew-rate:
    $ref: /schemas/types.yaml#/definitions/uint32
    description: set the slew rate

  skew-delay:
    $ref: /schemas/types.yaml#/definitions/uint32
    description:
      this affects the expected clock skew on input pins
      and the delay before latching a value to an output
      pin. Typically indicates how many double-inverters are
      used to delay the signal.

additionalProperties: true
```
