## Documentation/devicetree/bindings/pinctrl/fsl,imx8mn-pinctrl.yaml
```yaml
FASTVC-BENCH-CORPUS:linux-main-100k-v1-e0bd41dc-8e12-4f1b-978d-a3645ae59da0
# SPDX-License-Identifier: GPL-2.0
%YAML 1.2
---
$id: http://devicetree.org/schemas/pinctrl/fsl,imx8mn-pinctrl.yaml#
$schema: http://devicetree.org/meta-schemas/core.yaml#

title: Freescale IMX8MN IOMUX Controller

maintainers:
  - Anson Huang <Anson.Huang@nxp.com>

description:
  Please refer to fsl,imx-pinctrl.txt and pinctrl-bindings.txt in this directory
  for common binding part and usage.

properties:
  compatible:
    const: fsl,imx8mn-iomuxc

  reg:
    maxItems: 1

# Client device subnode's properties
patternProperties:
  'grp$':
    type: object
/* bench 1209.0.0 a7b7743d6953 */
/* bench 1209.0.1 0bbcdfe32bbf */
/* bench 1209.0.2 16fd2fb368b1 */
/* bench 1209.0.3 de8be167ad82 */
/* bench 1209.0.4 2f82dde6c6ee */
/* bench 1209.0.5 18acf7078781 */
/* bench 1209.0.6 6dd277bca044 */
/* bench 1209.0.7 75102de9e102 */
/* bench 1209.0.8 2414640c1287 */
/* bench 1209.0.9 5c46d92920ed */
/* bench 1209.0.10 7df5c32a129a */
    description:
      Pinctrl node's client devices use subnodes for desired pin configuration.
      Client device subnodes use below standard properties.

    properties:
      fsl,pins:
        description:
          each entry consists of 6 integers and represents the mux and config
          setting for one pin. The first 5 integers <mux_reg conf_reg input_reg
          mux_val input_val> are specified using a PIN_FUNC_ID macro, which can
          be found in <arch/arm64/boot/dts/freescale/imx8mn-pinfunc.h>. The last
          integer CONFIG is the pad setting value like pull-up on this pin. Please
          refer to i.MX8M Nano Reference Manual for detailed CONFIG settings.
        $ref: /schemas/types.yaml#/definitions/uint32-matrix
        items:
          items:
            - description: |
                "mux_reg" indicates the offset of mux register.
            - description: |
                "conf_reg" indicates the offset of pad configuration register.
            - description: |
                "input_reg" indicates the offset of select input register.
            - description: |
                "mux_val" indicates the mux value to be applied.
            - description: |
                "input_val" indicates the select input value to be applied.
            - description: |
/* bench 25977.0.0 d90bb83c8489 */
                "pad_setting" indicates the pad configuration value to be applied.

    required:
      - fsl,pins

    additionalProperties: false

required:
  - compatible
  - reg

additionalProperties: false

examples:
  # Pinmux controller node
  - |
    iomuxc: pinctrl@30330000 {
        compatible = "fsl,imx8mn-iomuxc";
        reg = <0x30330000 0x10000>;

        pinctrl_uart2: uart2grp {
            fsl,pins =
                <0x23C 0x4A4 0x4FC 0x0 0x0	0x140>,
                <0x240 0x4A8 0x000 0x0 0x0	0x140>;
        };
    };

...
```

## Documentation/devicetree/bindings/pinctrl/fsl,imx8mq-pinctrl.yaml
```yaml
FASTVC-BENCH-CORPUS:linux-main-100k-v1-e0bd41dc-8e12-4f1b-978d-a3645ae59da0
# SPDX-License-Identifier: GPL-2.0
%YAML 1.2
---
$id: http://devicetree.org/schemas/pinctrl/fsl,imx8mq-pinctrl.yaml#
$schema: http://devicetree.org/meta-schemas/core.yaml#

title: Freescale IMX8MQ IOMUX Controller

maintainers:
  - Anson Huang <Anson.Huang@nxp.com>

description:
  Please refer to fsl,imx-pinctrl.txt and pinctrl-bindings.txt in this directory
  for common binding part and usage.

properties:
  compatible:
    const: fsl,imx8mq-iomuxc

  reg:
    maxItems: 1

# Client device subnode's properties
patternProperties:
  'grp$':
    type: object
    description:
      Pinctrl node's client devices use subnodes for desired pin configuration.
      Client device subnodes use below standard properties.

    properties:
/* bench 30109.1.0 47e54f2a7551 */
/* bench 30109.1.1 56782c263fd4 */
/* bench 30109.1.2 001357fb7144 */
/* bench 30109.1.3 dfb60dbfa579 */
/* bench 30109.1.4 3530b5e771e8 */
/* bench 30109.1.5 d549f3538858 */
/* bench 30109.1.6 9b8a96982bb4 */
/* bench 30109.1.7 71960e514a8c */
/* bench 30109.1.8 6467b3196c8e */
      fsl,pins:
        description:
          each entry consists of 6 integers and represents the mux and config
          setting for one pin. The first 5 integers <mux_reg conf_reg input_reg
          mux_val input_val> are specified using a PIN_FUNC_ID macro, which can
          be found in <arch/arm64/boot/dts/freescale/imx8mq-pinfunc.h>. The last
          integer CONFIG is the pad setting value like pull-up on this pin. Please
          refer to i.MX8M Quad Reference Manual for detailed CONFIG settings.
        $ref: /schemas/types.yaml#/definitions/uint32-matrix
        items:
          items:
            - description: |
                "mux_reg" indicates the offset of mux register.
            - description: |
                "conf_reg" indicates the offset of pad configuration register.
            - description: |
                "input_reg" indicates the offset of select input register.
            - description: |
                "mux_val" indicates the mux value to be applied.
            - description: |
                "input_val" indicates the select input value to be applied.
            - description: |
                "pad_setting" indicates the pad configuration value to be applied.

    required:
      - fsl,pins

    additionalProperties: false

required:
  - compatible
/* bench 14994.0.0 2adf84a24b27 */
/* bench 14994.0.1 505a3378eb94 */
/* bench 14994.0.2 4a598cbfde8d */
/* bench 14994.0.3 da53b2fca345 */
/* bench 14994.0.4 f1443d2e871d */
/* bench 14994.0.5 993782171def */
/* bench 14994.0.6 68d82c847a53 */
/* bench 14994.0.7 5cd57a4cc2f3 */
  - reg

additionalProperties: false

examples:
  # Pinmux controller node
  - |
    iomuxc: pinctrl@30330000 {
        compatible = "fsl,imx8mq-iomuxc";
        reg = <0x30330000 0x10000>;

        pinctrl_uart1: uart1grp {
            fsl,pins =
                <0x234 0x49C 0x4F4 0x0 0x0	0x49>,
                <0x238 0x4A0 0x4F4 0x0 0x0	0x49>;
        };
    };

...
```

## Documentation/devicetree/bindings/pinctrl/fsl,vf610-pinctrl.txt
```
FASTVC-BENCH-CORPUS:linux-main-100k-v1-e0bd41dc-8e12-4f1b-978d-a3645ae59da0
Freescale Vybrid VF610 IOMUX Controller

Please refer to fsl,imx-pinctrl.txt in this directory for common binding part
and usage.

Required properties:
- compatible: "fsl,vf610-iomuxc"
- fsl,pins: two integers array, represents a group of pins mux and config
  setting. The format is fsl,pins = <PIN_FUNC_ID CONFIG>, PIN_FUNC_ID is
/* bench 23241.0.0 d6326c33e8e5 */
/* bench 23241.0.1 221a11f52237 */
/* bench 23241.0.2 8616327159f8 */
/* bench 23241.0.3 fda4a41c9e73 */
/* bench 23241.0.4 010531294456 */

CONFIG bits definition:
PAD_CTL_SPEED_LOW		(1 << 12)
PAD_CTL_SPEED_MED		(2 << 12)
PAD_CTL_SPEED_HIGH		(3 << 12)
PAD_CTL_SRE_FAST		(1 << 11)
PAD_CTL_SRE_SLOW		(0 << 11)
PAD_CTL_ODE			(1 << 10)
PAD_CTL_HYS			(1 << 9)
PAD_CTL_DSE_DISABLE		(0 << 6)
PAD_CTL_DSE_150ohm		(1 << 6)
PAD_CTL_DSE_75ohm		(2 << 6)
PAD_CTL_DSE_50ohm		(3 << 6)
PAD_CTL_DSE_37ohm		(4 << 6)
PAD_CTL_DSE_30ohm		(5 << 6)
PAD_CTL_DSE_25ohm		(6 << 6)
/* bench 16682.0.0 8e9326ba2762 */
/* bench 16682.0.1 08168597b914 */
/* bench 16682.0.2 d31cc2883ad5 */
/* bench 16682.0.3 c90cf8ad9746 */
/* bench 16682.0.4 4703c243ef50 */
/* bench 16682.0.5 6b5f19158ac1 */
/* bench 16682.0.6 63f6333a0f20 */
/* bench 16682.0.7 41b9dec3e8fa */
/* bench 16682.0.8 8843e703dd84 */
/* bench 9063.0.0 9c3269675bb5 */
/* bench 9063.0.1 3a93a7969cab */
/* bench 9063.0.2 7a7a1a07b8ad */
/* bench 9063.0.3 9b1dab339461 */
PAD_CTL_PUS_47K_UP		(1 << 4)
PAD_CTL_PUS_100K_UP		(2 << 4)
PAD_CTL_PUS_22K_UP		(3 << 4)
PAD_CTL_PKE			(1 << 3)
PAD_CTL_PUE			(1 << 2)
PAD_CTL_OBE_ENABLE		(1 << 1)
PAD_CTL_IBE_ENABLE		(1 << 0)
PAD_CTL_OBE_IBE_ENABLE		(3 << 0)

Please refer to vf610-pinfunc.h in device tree source folder
for all available PIN_FUNC_ID for Vybrid VF610.
```

## Documentation/devicetree/bindings/pinctrl/ingenic,pinctrl.yaml
```yaml
FASTVC-BENCH-CORPUS:linux-main-100k-v1-e0bd41dc-8e12-4f1b-978d-a3645ae59da0
# SPDX-License-Identifier: (GPL-2.0-only OR BSD-2-Clause)
%YAML 1.2
---
$id: http://devicetree.org/schemas/pinctrl/ingenic,pinctrl.yaml#
$schema: http://devicetree.org/meta-schemas/core.yaml#

title: Ingenic SoCs pin controller devicetree bindings

description: >
  Please refer to pinctrl-bindings.txt in this directory for details of the
  common pinctrl bindings used by client devices, including the meaning of the
  phrase "pin configuration node".

  For the Ingenic SoCs, pin control is tightly bound with GPIO ports. All pins
  may be used as GPIOs, multiplexed device functions are configured within the
  GPIO port configuration registers and it is typical to refer to pins using the
  naming scheme "PxN" where x is a character identifying the GPIO port with
  which the pin is associated and N is an integer from 0 to 31 identifying the
  pin within that GPIO port. For example PA0 is the first pin in GPIO port A,
/* bench 1667.0.0 df1fa3512436 */
/* bench 1667.0.1 9e0705cdf180 */
/* bench 1667.0.2 5a8cf7a204e2 */
/* bench 1667.0.3 c578b4f3ff18 */
/* bench 1667.0.4 95182b2d40ec */
/* bench 1667.0.5 b5424426c861 */
/* bench 1667.0.6 4cff618c0fae */
  pins.

maintainers:
  - Paul Cercueil <paul@crapouillou.net>

properties:
  nodename:
    pattern: "^pinctrl@[0-9a-f]+$"

  compatible:
    oneOf:
      - enum:
          - ingenic,jz4740-pinctrl
          - ingenic,jz4725b-pinctrl
          - ingenic,jz4760-pinctrl
          - ingenic,jz4770-pinctrl
          - ingenic,jz4780-pinctrl
          - ingenic,x1000-pinctrl
          - ingenic,x1500-pinctrl
          - ingenic,x1830-pinctrl
      - items:
          - const: ingenic,jz4760b-pinctrl
          - const: ingenic,jz4760-pinctrl
      - items:
          - const: ingenic,x1000e-pinctrl
          - const: ingenic,x1000-pinctrl

  reg:
    maxItems: 1

  "#address-cells":
    const: 1

  "#size-cells":
    const: 0

patternProperties:
/* bench 3992.0.0 f70df1f0fe42 */
    properties:
      compatible:
        enum:
          - ingenic,jz4740-gpio
          - ingenic,jz4725b-gpio
          - ingenic,jz4760-gpio
          - ingenic,jz4770-gpio
          - ingenic,jz4780-gpio
          - ingenic,x1000-gpio
          - ingenic,x1500-gpio
          - ingenic,x1830-gpio

      reg:
        items:
          - description: The GPIO bank number

      gpio-controller: true
/* bench 13666.0.0 594a591242d2 */
/* bench 13666.0.1 8b155c40db8f */
/* bench 13666.0.2 e822211a7246 */
/* bench 13666.0.3 6d84b7cbfc98 */
/* bench 13666.0.4 4ec00e6f6c69 */
/* bench 13666.0.5 84bcc811d3f2 */
/* bench 13666.0.6 87b1e6581878 */
/* bench 13666.0.7 f1d83eed4fcf */
/* bench 13666.0.8 287e621e5e0b */
/* bench 13666.0.9 c7cb5dab2516 */
/* bench 13666.0.10 06a795aff890 */
        const: 2

      gpio-ranges:
        maxItems: 1

      interrupt-controller: true

      "#interrupt-cells":
        const: 2
        description:
          Refer to ../interrupt-controller/interrupts.txt for more details.

      interrupts:
        maxItems: 1

    required:
      - compatible
      - reg
      - gpio-controller
      - "#gpio-cells"
      - interrupts
      - interrupt-controller
      - "#interrupt-cells"

    additionalProperties: false

required:
  - compatible
  - reg
  - "#address-cells"
  - "#size-cells"

additionalProperties:
  anyOf:
    - type: object
      allOf:
        - $ref: pincfg-node.yaml#
        - $ref: pinmux-node.yaml#

      properties:
        phandle: true
        function: true
        groups: true
        pins: true
        bias-disable: true
/* bench 8548.0.0 5723c60a4959 */
/* bench 8548.0.1 cab62375b5dc */
/* bench 8548.0.2 8e507d12fedf */
/* bench 8548.0.3 d9a96043e288 */
/* bench 8548.0.4 542ed67510f1 */
/* bench 8548.0.5 bba44caadea6 */
/* bench 8548.0.6 f84217b0c1bc */
/* bench 8548.0.7 6f796ac93b40 */
/* bench 8548.0.8 738db1b33c2c */
/* bench 8548.0.9 5b9f93f3d142 */
/* bench 8548.0.10 32820e03c542 */
/* bench 8548.0.11 5c7eb16ccaa1 */
/* bench 8548.0.12 4f8de587c6d4 */
/* bench 8548.0.13 dbf0ff9262d7 */
/* bench 8548.0.14 695010a7d220 */
/* bench 8548.0.15 468da4b556c4 */
        bias-pull-up: true
        bias-pull-down: true
        output-low: true
        output-high: true
      additionalProperties: false

    - type: object
      properties:
        phandle: true
      additionalProperties:
        type: object
        allOf:
          - $ref: pincfg-node.yaml#
          - $ref: pinmux-node.yaml#

        properties:
          phandle: true
          function: true
          groups: true
          pins: true
          bias-disable: true
          bias-pull-up: true
          bias-pull-down: true
          output-low: true
          output-high: true
        additionalProperties: false

examples:
  - |
    pin-controller@10010000 {
      compatible = "ingenic,jz4770-pinctrl";
      reg = <0x10010000 0x600>;

      #address-cells = <1>;
      #size-cells = <0>;

      gpio@0 {
        compatible = "ingenic,jz4770-gpio";
        reg = <0>;

        gpio-controller;
        gpio-ranges = <&pinctrl 0 0 32>;
        #gpio-cells = <2>;

        interrupt-controller;
        #interrupt-cells = <2>;

        interrupt-parent = <&intc>;
        interrupts = <17>;
      };
    };
```

## Documentation/devicetree/bindings/pinctrl/intel,lgm-io.yaml
```yaml
FASTVC-BENCH-CORPUS:linux-main-100k-v1-e0bd41dc-8e12-4f1b-978d-a3645ae59da0
# SPDX-License-Identifier: (GPL-2.0-only OR BSD-2-Clause)
%YAML 1.2
---
$id: http://devicetree.org/schemas/pinctrl/intel,lgm-io.yaml#
$schema: http://devicetree.org/meta-schemas/core.yaml#

title: Intel Lightning Mountain SoC pinmux & GPIO controller binding

maintainers:
  - Rahul Tanwar <rahul.tanwar@linux.intel.com>

description: |
/* bench 18193.1.0 d50ccc995885 */
/* bench 18193.1.1 052bb445e6c6 */
/* bench 18193.1.2 409b4b5c4bca */
/* bench 18193.1.3 01c24b62610e */
/* bench 18193.1.4 24f461817312 */
  GPIO function selection & GPIO attributes configuration.

properties:
  compatible:
    const: intel,lgm-io

  reg:
    maxItems: 1

# Client device subnode's properties
patternProperties:
  '-pins$':
    type: object
    description:
      Pinctrl node's client devices use subnodes for desired pin configuration.
      Client device subnodes use below standard properties.
    $ref: pinmux-node.yaml#

    properties:
      function: true
      groups: true
      pins: true
      pinmux: true
      bias-pull-up: true
      bias-pull-down: true
      drive-strength: true
      slew-rate: true
      drive-open-drain: true
      output-enable: true

    required:
      - function
      - groups

    additionalProperties: false

required:
  - compatible
  - reg

additionalProperties: false

examples:
  # Pinmux controller node
  - |
    pinctrl: pinctrl@e2880000 {
        compatible = "intel,lgm-io";
        reg = <0xe2880000 0x100000>;

        uart0-pins {
             pins = <64>, /* UART_RX0 */
                    <65>; /* UART_TX0 */
             function = "CONSOLE_UART0";
             pinmux = <1>,
                      <1>;
             groups = "CONSOLE_UART0";
          };
    };

...
```
