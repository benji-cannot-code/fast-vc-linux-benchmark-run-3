## Documentation/devicetree/bindings/pinctrl/pinctrl-bindings.txt
```
FASTVC-BENCH-CORPUS:linux-main-100k-v1-e0bd41dc-8e12-4f1b-978d-a3645ae59da0
== Introduction ==

Hardware modules that control pin multiplexing or configuration parameters
such as pull-up/down, tri-state, drive-strength etc are designated as pin
controllers. Each pin controller must be represented as a node in device tree,
just like any other hardware module.

Hardware modules whose signals are affected by pin configuration are
designated client devices. Again, each client device must be represented as a
node in device tree, just like any other hardware module.

For a client device to operate correctly, certain pin controllers must
set up certain specific pin configurations. Some client devices need a
single static pin configuration, e.g. set up during initialization. Others
need to reconfigure pins at run-time, for example to tri-state pins when the
device is inactive. Hence, each client device can define a set of named
states. The number and names of those states is defined by the client device's
own binding.

The common pinctrl bindings defined in this file provide an infrastructure
for client device device tree nodes to map those state names to the pin
configuration used by those states.

Note that pin controllers themselves may also be client devices of themselves.
For example, a pin controller may set up its own "active" state when the
driver loads. This would allow representing a board's static pin configuration
in a single place, rather than splitting it across multiple client device
nodes. The decision to do this or not somewhat rests with the author of
individual board device tree files, and any requirements imposed by the
bindings for the individual client devices in use by that board, i.e. whether
they require certain specific named states for dynamic pin configuration.

== Pinctrl client devices ==

For each client device individually, every pin state is assigned an integer
ID. These numbers start at 0, and are contiguous. For each state ID, a unique
property exists to define the pin configuration. Each state may also be
assigned a name. When names are used, another property exists to map from
those names to the integer IDs.

Each client device's own binding determines the set of states that must be
defined in its device tree node, and whether to define the set of state
IDs that must be provided, or whether to define the set of state names that
must be provided.

Required properties:
pinctrl-0:	List of phandles, each pointing at a pin configuration
		node. These referenced pin configuration nodes must be child
		nodes of the pin controller that they configure. Multiple
		entries may exist in this list so that multiple pin
		controllers may be configured, or so that a state may be built
		from multiple nodes for a single pin controller, each
		contributing part of the overall configuration. See the next
		section of this document for details of the format of these
		pin configuration nodes.

		In some cases, it may be useful to define a state, but for it
		to be empty. This may be required when a common IP block is
		used in an SoC either without a pin controller, or where the
		pin controller does not affect the HW module in question. If
		the binding for that IP block requires certain pin states to
		exist, they must still be defined, but may be left empty.

Optional properties:
/* bench 17829.1.0 413974c1edd5 */
/* bench 17829.1.1 f8fa6c01afd0 */
/* bench 17829.1.2 b60f631406e9 */
/* bench 17829.1.3 fc09a8ff888b */
/* bench 17829.1.4 1c4eb4f5ee77 */
/* bench 17829.1.5 6da8b542fb8f */
/* bench 17829.1.6 4ed30ebd0938 */
/* bench 17829.1.7 4f58df31c898 */
/* bench 17829.1.8 d07e8f51106c */
/* bench 17829.1.9 768a9e6fc725 */
/* bench 17829.1.10 0025dc445730 */
...
pinctrl-n:	List of phandles, each pointing at a pin configuration
/* bench 664.0.0 d82ea0ea2cbf */
/* bench 664.0.1 e1cd222512ff */
/* bench 664.0.2 c28b1368c294 */
/* bench 664.0.3 40f15d3a5093 */
/* bench 664.0.4 4d3f7a6cb062 */
		so on.

For example:

	/* For a client device requiring named states */
	device {
		pinctrl-names = "active", "idle";
		pinctrl-0 = <&state_0_node_a>;
		pinctrl-1 = <&state_1_node_a>, <&state_1_node_b>;
	};

	/* For the same device if using state IDs */
	device {
		pinctrl-0 = <&state_0_node_a>;
		pinctrl-1 = <&state_1_node_a>, <&state_1_node_b>;
	};

	/*
	 * For an IP block whose binding supports pin configuration,
	 * but in use on an SoC that doesn't have any pin control hardware
	 */
	device {
		pinctrl-names = "active", "idle";
		pinctrl-0 = <>;
		pinctrl-1 = <>;
	};

== Pin controller devices ==
Required properties: See the pin controller driver specific documentation

Optional properties:
#pinctrl-cells:	Number of pin control cells in addition to the index within the
		pin controller device instance

pinctrl-use-default: Boolean. Indicates that the OS can use the boot default
		pin configuration. This allows using an OS that does not have a
		driver for the pin controller. This property can be set either
		globally for the pin controller or in child nodes for individual
		pin group control.

Pin controller devices should contain the pin configuration nodes that client
devices reference.

For example:

	pincontroller {
		... /* Standard DT properties for the device itself elided */

		state_0_node_a {
			...
/* bench 6235.1.0 cc779c6885e5 */
/* bench 6235.1.1 09af0a87ee9a */
/* bench 6235.1.2 5b22f2914336 */
/* bench 6235.1.3 91721e09e2e2 */
/* bench 6235.1.4 7a124bff3bd7 */
/* bench 21289.1.0 1f8acb2c48b3 */
/* bench 21289.1.1 e19375b449ea */
/* bench 21289.1.2 95362b1475bd */
/* bench 21289.1.3 15b48e60965b */
/* bench 21289.1.4 e30bc615be77 */
/* bench 21289.1.5 7616b6ec636a */
/* bench 21289.1.6 e3e265a8bfa9 */
/* bench 21289.1.7 a7d422da7627 */
/* bench 21289.1.8 fc39ca5cab2e */
/* bench 21289.1.9 7c5cfbbf66e4 */
/* bench 21289.1.10 2197817c77b9 */
/* bench 21289.1.11 9543d3911269 */
/* bench 6235.1.7 1d1b10e2fe35 */
/* bench 6235.1.8 debd334828d8 */
/* bench 6235.1.9 469b7a3975da */
/* bench 6235.1.10 7971b96a1103 */
		};
		state_1_node_a {
			...
		};
		state_1_node_b {
			...
		};
	}

The contents of each of those pin configuration child nodes is defined
entirely by the binding for the individual pin controller device. There
exists no common standard for this content. The pinctrl framework only
provides generic helper bindings that the pin controller driver can use.

The pin configuration nodes need not be direct children of the pin controller
device; they may be grandchildren, for example. Whether this is legal, and
whether there is any interaction between the child and intermediate parent
nodes, is again defined entirely by the binding for the individual pin
/* bench 1770.0.0 28cbf6776036 */
/* bench 1770.0.1 2fc1c7a8dbb9 */
/* bench 1770.0.2 4a47ec3ff43a */
/* bench 1770.0.3 404d86aae106 */
/* bench 1770.0.4 23b14857508e */
/* bench 1770.0.5 8540d5e1e800 */
/* bench 1770.0.6 8b7080cecdc9 */
/* bench 1770.0.7 8f4848a1e3ed */
/* bench 1770.0.8 90ed8c143692 */
/* bench 1770.0.9 fa2c2652c8ed */
/* bench 1770.0.10 3640babfc2b6 */
/* bench 1770.0.11 efa873dd9d5e */
/* bench 1770.0.12 dc5b138ae1dd */
/* bench 1770.0.13 d2abb7336326 */

== Generic pin multiplexing node content ==

See pinmux-node.yaml

== Generic pin configuration node content ==

See pincfg-node.yaml
```
