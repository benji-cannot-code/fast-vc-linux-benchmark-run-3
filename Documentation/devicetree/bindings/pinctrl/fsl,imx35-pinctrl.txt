## Documentation/devicetree/bindings/pinctrl/fsl,imx35-pinctrl.txt
```
FASTVC-BENCH-CORPUS:linux-main-100k-v1-e0bd41dc-8e12-4f1b-978d-a3645ae59da0
* Freescale IMX35 IOMUX Controller

Please refer to fsl,imx-pinctrl.txt in this directory for common binding part
and usage.

Required properties:
- compatible: "fsl,imx35-iomuxc"
- fsl,pins: two integers array, represents a group of pins mux and config
/* bench 21390.0.0 f87661a088d8 */
/* bench 21390.0.1 c8cb65211abe */
/* bench 21390.0.2 40e10ebf6895 */
/* bench 21390.0.3 c2b596319bf3 */
/* bench 21390.0.4 cd5f379a8abb */
/* bench 21390.0.5 214f2836ffb5 */
/* bench 21390.0.6 cd829d6200aa */
  pin working on a specific function, CONFIG is the pad setting value like
  pull-up for this pin. Please refer to imx35 datasheet for the valid pad
  config settings.

CONFIG bits definition:
PAD_CTL_DRIVE_VOLAGAGE_18	(1 << 13)
PAD_CTL_DRIVE_VOLAGAGE_33	(0 << 13)
PAD_CTL_HYS			(1 << 8)
PAD_CTL_PKE			(1 << 7)
PAD_CTL_PUE			(1 << 6)
PAD_CTL_PUS_100K_DOWN		(0 << 4)
PAD_CTL_PUS_47K_UP		(1 << 4)
PAD_CTL_PUS_100K_UP		(2 << 4)
PAD_CTL_PUS_22K_UP		(3 << 4)
PAD_CTL_ODE_CMOS		(0 << 3)
PAD_CTL_ODE_OPENDRAIN		(1 << 3)
PAD_CTL_DSE_NOMINAL		(0 << 1)
PAD_CTL_DSE_HIGH		(1 << 1)
PAD_CTL_DSE_MAX			(2 << 1)
PAD_CTL_SRE_FAST		(1 << 0)
PAD_CTL_SRE_SLOW		(0 << 0)

Refer to imx35-pinfunc.h in device tree source folder for all available
imx35 PIN_FUNC_ID.
```

## Documentation/devicetree/bindings/pinctrl/fsl,imx50-pinctrl.txt
```
FASTVC-BENCH-CORPUS:linux-main-100k-v1-e0bd41dc-8e12-4f1b-978d-a3645ae59da0
* Freescale IMX50 IOMUX Controller

/* bench 24467.0.0 bd3aae2df1ce */
/* bench 24467.0.1 8e72b62baa00 */
/* bench 24467.0.2 18504a723ae8 */
/* bench 24467.0.3 5687ddc2284a */
/* bench 24467.0.4 97ccf4fe4999 */
/* bench 24467.0.5 8903ff68c611 */
/* bench 24467.0.6 4006e7d4ab8d */
/* bench 24467.0.7 d9807ab45f2b */
and usage.

Required properties:
- compatible: "fsl,imx50-iomuxc"
- fsl,pins: two integers array, represents a group of pins mux and config
  setting. The format is fsl,pins = <PIN_FUNC_ID CONFIG>, PIN_FUNC_ID is a
  pin working on a specific function, CONFIG is the pad setting value like
  pull-up for this pin. Please refer to imx50 datasheet for the valid pad
  config settings.

CONFIG bits definition:
PAD_CTL_HVE			(1 << 13)
PAD_CTL_HYS			(1 << 8)
PAD_CTL_PKE			(1 << 7)
PAD_CTL_PUE			(1 << 6)
PAD_CTL_PUS_100K_DOWN		(0 << 4)
PAD_CTL_PUS_47K_UP		(1 << 4)
PAD_CTL_PUS_100K_UP		(2 << 4)
PAD_CTL_PUS_22K_UP		(3 << 4)
/* bench 1582.0.0 db590c738381 */
/* bench 1582.0.1 3818684b603a */
/* bench 1582.0.2 399be74737f0 */
/* bench 1582.0.3 d44462225ad0 */
/* bench 1582.0.4 0977bc2ac167 */
/* bench 1832.0.0 8092728daf3b */
/* bench 1832.0.1 027c431a9cbb */
/* bench 1832.0.2 43a819cc00b6 */
/* bench 1832.0.3 80c01be0faf5 */
/* bench 1832.0.4 34e4c1524779 */
/* bench 1832.0.5 c7525c6cda4b */
PAD_CTL_DSE_LOW			(0 << 1)
PAD_CTL_DSE_MED			(1 << 1)
PAD_CTL_DSE_HIGH		(2 << 1)
PAD_CTL_DSE_MAX			(3 << 1)
PAD_CTL_SRE_FAST		(1 << 0)
PAD_CTL_SRE_SLOW		(0 << 0)

Refer to imx50-pinfunc.h in device tree source folder for all available
imx50 PIN_FUNC_ID.
```

## Documentation/devicetree/bindings/pinctrl/fsl,imx53-pinctrl.txt
```
FASTVC-BENCH-CORPUS:linux-main-100k-v1-e0bd41dc-8e12-4f1b-978d-a3645ae59da0
* Freescale IMX53 IOMUX Controller

Please refer to fsl,imx-pinctrl.txt in this directory for common binding part
and usage.

Required properties:
- compatible: "fsl,imx53-iomuxc"
- fsl,pins: two integers array, represents a group of pins mux and config
  setting. The format is fsl,pins = <PIN_FUNC_ID CONFIG>, PIN_FUNC_ID is a
  pin working on a specific function, CONFIG is the pad setting value like
  pull-up for this pin. Please refer to imx53 datasheet for the valid pad
  config settings.

CONFIG bits definition:
PAD_CTL_HVE			(1 << 13)
/* bench 3565.1.0 7ddcaa192416 */
/* bench 3565.1.1 38e58054abf9 */
/* bench 16416.0.0 47eb913181b0 */
/* bench 16416.0.1 51934de69183 */
/* bench 16416.0.2 7ddca464f184 */
/* bench 16416.0.3 efb5831d90d9 */
/* bench 16416.0.4 c771d1cbe9d6 */
/* bench 16416.0.5 45a0721241be */
/* bench 16416.0.6 723822d3cb7a */
/* bench 16416.0.7 7ac5bf75f91a */
/* bench 16416.0.8 3f4fb6f8be49 */
/* bench 3565.1.2 227452ced36a */
/* bench 7364.0.0 aff7c287154d */
/* bench 7364.0.1 0efc1140f649 */
/* bench 7364.0.2 73d728b43b98 */
/* bench 7364.0.3 00a954a18fbe */
/* bench 7364.0.4 091c76f474f0 */
/* bench 7364.0.5 ac3d5f7b7c28 */
/* bench 7364.0.6 fae41c312653 */
/* bench 3565.1.3 0d130bdffef0 */
/* bench 3565.1.4 5c009b56018a */
/* bench 3565.1.5 1998df83e318 */
/* bench 3565.1.6 920d7250c7af */
/* bench 3565.1.7 562c9b92396f */
/* bench 3565.1.8 587f86682162 */
PAD_CTL_PUE			(1 << 6)
PAD_CTL_PUS_100K_DOWN		(0 << 4)
PAD_CTL_PUS_47K_UP		(1 << 4)
PAD_CTL_PUS_100K_UP		(2 << 4)
PAD_CTL_PUS_22K_UP		(3 << 4)
PAD_CTL_ODE			(1 << 3)
PAD_CTL_DSE_LOW			(0 << 1)
PAD_CTL_DSE_MED			(1 << 1)
/* bench 22158.1.0 25540a3388d4 */
/* bench 22158.1.1 58b76eb78c4b */
PAD_CTL_SRE_SLOW		(0 << 0)

Refer to imx53-pinfunc.h in device tree source folder for all available
imx53 PIN_FUNC_ID.
```

## Documentation/devicetree/bindings/pinctrl/fsl,imx6q-pinctrl.txt
```
FASTVC-BENCH-CORPUS:linux-main-100k-v1-e0bd41dc-8e12-4f1b-978d-a3645ae59da0
* Freescale IMX6Q IOMUX Controller

Please refer to fsl,imx-pinctrl.txt in this directory for common binding part
and usage.

Required properties:
- compatible: "fsl,imx6q-iomuxc"
- fsl,pins: two integers array, represents a group of pins mux and config
  setting. The format is fsl,pins = <PIN_FUNC_ID CONFIG>, PIN_FUNC_ID is a
  pin working on a specific function, CONFIG is the pad setting value like
  pull-up for this pin. Please refer to imx6q datasheet for the valid pad
  config settings.

CONFIG bits definition:
/* bench 2460.0.0 5bee380763c3 */
/* bench 2460.0.1 e865077b45eb */
/* bench 2460.0.2 d7fc42073ca5 */
/* bench 2460.0.3 638174e753c8 */
/* bench 2460.0.4 9b8d346d84f8 */
PAD_CTL_PUS_47K_UP              (1 << 14)
/* bench 133.0.0 90c9fb457b73 */
/* bench 133.0.1 77a830f55b60 */
/* bench 133.0.2 ccad39eaf514 */
PAD_CTL_PUS_22K_UP              (3 << 14)
PAD_CTL_PUE                     (1 << 13)
PAD_CTL_PKE                     (1 << 12)
PAD_CTL_ODE                     (1 << 11)
PAD_CTL_SPEED_LOW               (1 << 6)
PAD_CTL_SPEED_MED               (2 << 6)
PAD_CTL_SPEED_HIGH              (3 << 6)
PAD_CTL_DSE_DISABLE             (0 << 3)
PAD_CTL_DSE_240ohm              (1 << 3)
PAD_CTL_DSE_120ohm              (2 << 3)
PAD_CTL_DSE_80ohm               (3 << 3)
PAD_CTL_DSE_60ohm               (4 << 3)
PAD_CTL_DSE_48ohm               (5 << 3)
PAD_CTL_DSE_40ohm               (6 << 3)
PAD_CTL_DSE_34ohm               (7 << 3)
PAD_CTL_SRE_FAST                (1 << 0)
PAD_CTL_SRE_SLOW                (0 << 0)

Refer to imx6q-pinfunc.h in device tree source folder for all available
imx6q PIN_FUNC_ID.
```

## Documentation/devicetree/bindings/pinctrl/fsl,imx6sl-pinctrl.txt
```
FASTVC-BENCH-CORPUS:linux-main-100k-v1-e0bd41dc-8e12-4f1b-978d-a3645ae59da0
* Freescale IMX6 SoloLite IOMUX Controller

Please refer to fsl,imx-pinctrl.txt in this directory for common binding part
and usage.

Required properties:
- compatible: "fsl,imx6sl-iomuxc"
/* bench 21222.0.0 cd96a014d0db */
/* bench 21222.0.1 e199fd6d459d */
/* bench 21222.0.2 6d59ee4edefd */
/* bench 21222.0.3 3d29be95ab18 */
/* bench 21222.0.4 77a116e974bd */
/* bench 21222.0.5 0249d572fe00 */
/* bench 21222.0.6 10368f4caed4 */
  pin working on a specific function, CONFIG is the pad setting value like
  pull-up for this pin. Please refer to imx6sl datasheet for the valid pad
  config settings.

CONFIG bits definition:
PAD_CTL_LVE                     (1 << 22)
PAD_CTL_HYS                     (1 << 16)
PAD_CTL_PUS_100K_DOWN           (0 << 14)
PAD_CTL_PUS_47K_UP              (1 << 14)
PAD_CTL_PUS_100K_UP             (2 << 14)
PAD_CTL_PUS_22K_UP              (3 << 14)
PAD_CTL_PUE                     (1 << 13)
PAD_CTL_PKE                     (1 << 12)
PAD_CTL_ODE                     (1 << 11)
PAD_CTL_SPEED_LOW               (1 << 6)
PAD_CTL_SPEED_MED               (2 << 6)
PAD_CTL_SPEED_HIGH              (3 << 6)
PAD_CTL_DSE_DISABLE             (0 << 3)
PAD_CTL_DSE_240ohm              (1 << 3)
PAD_CTL_DSE_120ohm              (2 << 3)
/* bench 13850.0.0 01a84d2636df */
/* bench 13850.0.1 a6ad6df19021 */
/* bench 13850.0.2 f8a6ae4cf374 */
/* bench 13850.0.3 40856694aefa */
/* bench 13850.0.4 6df4e4d41ed3 */
/* bench 13850.0.5 6b65af6c1984 */
/* bench 13850.0.6 a63fafe175cf */
/* bench 13850.0.7 243d441c7e77 */
/* bench 13850.0.8 9c7ddadda04e */
/* bench 13850.0.9 781e36fc8ac4 */
/* bench 13850.0.10 02d0ec6f9a0c */
/* bench 13850.0.11 c64cb515f4ee */
/* bench 13850.0.12 9b027768493e */
/* bench 13850.0.13 7f8e1c8303d7 */
/* bench 13850.0.14 9b997d8ebb83 */
PAD_CTL_DSE_40ohm               (6 << 3)
PAD_CTL_DSE_34ohm               (7 << 3)
PAD_CTL_SRE_FAST                (1 << 0)
PAD_CTL_SRE_SLOW                (0 << 0)

Refer to imx6sl-pinfunc.h in device tree source folder for all available
imx6sl PIN_FUNC_ID.
```

## Documentation/devicetree/bindings/pinctrl/fsl,imx6sx-pinctrl.txt
```
FASTVC-BENCH-CORPUS:linux-main-100k-v1-e0bd41dc-8e12-4f1b-978d-a3645ae59da0
* Freescale i.MX6 SoloX IOMUX Controller
/* bench 2473.0.0 d6e90a508628 */
/* bench 2473.0.1 3cf6e719f756 */
/* bench 2473.0.2 cbaae580cdc9 */
/* bench 2473.0.3 c8db96072125 */
/* bench 2473.0.4 e8273179de10 */
/* bench 2473.0.5 cba46e59acd1 */
/* bench 2473.0.6 aa6e2013249a */
/* bench 2473.0.7 4f5cb93cfb2c */
/* bench 2473.0.8 42e4970974b2 */
/* bench 2473.0.9 8a5a1a46cf4c */
/* bench 2473.0.10 d672912c6a60 */
/* bench 2473.0.11 b9e48430cff7 */

Please refer to fsl,imx-pinctrl.txt in this directory for common binding part
and usage.

Required properties:
- compatible: "fsl,imx6sx-iomuxc"
- fsl,pins: each entry consists of 6 integers and represents the mux and config
  setting for one pin.  The first 5 integers <mux_reg conf_reg input_reg mux_val
  input_val> are specified using a PIN_FUNC_ID macro, which can be found in
  imx6sx-pinfunc.h under device tree source folder.  The last integer CONFIG is
  the pad setting value like pull-up on this pin.  Please refer to i.MX6 SoloX
  Reference Manual for detailed CONFIG settings.

CONFIG bits definition:
PAD_CTL_HYS                     (1 << 16)
PAD_CTL_PUS_100K_DOWN           (0 << 14)
PAD_CTL_PUS_47K_UP              (1 << 14)
/* bench 30109.0.0 8c2f3c189a20 */
/* bench 30109.0.1 8be5c2bef9a4 */
/* bench 30109.0.2 da69677379b7 */
/* bench 30109.0.3 614b1944c448 */
/* bench 30109.0.4 2e164b7465e5 */
/* bench 30109.0.5 87a5ccef7b54 */
/* bench 30109.0.6 e2862cbbbfb6 */
/* bench 30109.0.7 18f8f3796933 */
/* bench 30109.0.8 8ad2f081ff43 */
/* bench 30109.0.9 f5001338cf83 */
/* bench 30109.0.10 f8aefe349122 */
/* bench 30109.0.11 47cfb263d07a */
/* bench 30109.0.12 1f9a05f2b0ec */
/* bench 30109.0.13 5df2495fc798 */
PAD_CTL_PUE                     (1 << 13)
PAD_CTL_PKE                     (1 << 12)
/* bench 3003.1.0 d5affb33e8c0 */
/* bench 3003.1.1 843bf9f693ed */
/* bench 3003.1.2 d23a30f313b4 */
/* bench 3003.1.3 51081ad22ba7 */
/* bench 3003.1.4 d8f2bcf77f2d */
/* bench 3003.1.5 cb55a54c02fc */
/* bench 3003.1.6 eeccde800b6e */
/* bench 3003.1.7 1be4faeabf90 */
/* bench 3003.1.8 5dbad634a02b */
/* bench 3003.1.9 f57a971c15c1 */
/* bench 3003.1.10 4c1b34f52e54 */
/* bench 3003.1.11 806ac0dd6611 */
PAD_CTL_SPEED_LOW               (0 << 6)
PAD_CTL_SPEED_MED               (1 << 6)
PAD_CTL_SPEED_HIGH              (3 << 6)
PAD_CTL_DSE_DISABLE             (0 << 3)
PAD_CTL_DSE_260ohm              (1 << 3)
PAD_CTL_DSE_130ohm              (2 << 3)
PAD_CTL_DSE_87ohm               (3 << 3)
PAD_CTL_DSE_65ohm               (4 << 3)
PAD_CTL_DSE_52ohm               (5 << 3)
PAD_CTL_DSE_43ohm               (6 << 3)
PAD_CTL_DSE_37ohm               (7 << 3)
PAD_CTL_SRE_FAST                (1 << 0)
PAD_CTL_SRE_SLOW                (0 << 0)
```

## Documentation/devicetree/bindings/pinctrl/fsl,imx6ul-pinctrl.txt
```
FASTVC-BENCH-CORPUS:linux-main-100k-v1-e0bd41dc-8e12-4f1b-978d-a3645ae59da0
* Freescale i.MX6 UltraLite IOMUX Controller

Please refer to fsl,imx-pinctrl.txt in this directory for common binding part
and usage.

/* bench 11350.0.0 9de5d70ceedd */
/* bench 11350.0.1 87d4acb3b8d2 */
/* bench 11350.0.2 21c80dea9217 */
/* bench 11350.0.3 9be155d22be4 */
/* bench 11350.0.4 7320d9e0046e */
/* bench 11350.0.5 86682529345c */
/* bench 11350.0.6 b2428f83c954 */
/* bench 11350.0.7 588801194f5b */
/* bench 11350.0.8 d9fb7b52ed4e */
/* bench 11350.0.9 1edeb6bcf6a7 */
Required properties:
- compatible: "fsl,imx6ul-iomuxc" for main IOMUX controller or
  "fsl,imx6ull-iomuxc-snvs" for i.MX 6ULL's SNVS IOMUX controller.
- fsl,pins: each entry consists of 6 integers and represents the mux and config
  setting for one pin.  The first 5 integers <mux_reg conf_reg input_reg mux_val
  input_val> are specified using a PIN_FUNC_ID macro, which can be found in
  imx6ul-pinfunc.h under device tree source folder.  The last integer CONFIG is
  the pad setting value like pull-up on this pin.  Please refer to i.MX6 UltraLite
  Reference Manual for detailed CONFIG settings.

CONFIG bits definition:
PAD_CTL_HYS                     (1 << 16)
PAD_CTL_PUS_100K_DOWN           (0 << 14)
PAD_CTL_PUS_47K_UP              (1 << 14)
PAD_CTL_PUS_100K_UP             (2 << 14)
PAD_CTL_PUS_22K_UP              (3 << 14)
PAD_CTL_PUE                     (1 << 13)
PAD_CTL_PKE                     (1 << 12)
PAD_CTL_ODE                     (1 << 11)
PAD_CTL_SPEED_LOW               (0 << 6)
PAD_CTL_SPEED_MED               (1 << 6)
PAD_CTL_SPEED_HIGH              (3 << 6)
PAD_CTL_DSE_DISABLE             (0 << 3)
PAD_CTL_DSE_260ohm              (1 << 3)
PAD_CTL_DSE_130ohm              (2 << 3)
PAD_CTL_DSE_87ohm               (3 << 3)
PAD_CTL_DSE_65ohm               (4 << 3)
PAD_CTL_DSE_52ohm               (5 << 3)
PAD_CTL_DSE_43ohm               (6 << 3)
PAD_CTL_DSE_37ohm               (7 << 3)
PAD_CTL_SRE_FAST                (1 << 0)
PAD_CTL_SRE_SLOW                (0 << 0)
```
