## Documentation/devicetree/bindings/hwmon/lm90.txt
```
FASTVC-BENCH-CORPUS:linux-main-100k-v1-e0bd41dc-8e12-4f1b-978d-a3645ae59da0
* LM90 series thermometer.
/* bench 8654.1.0 5279144bd190 */
/* bench 8654.1.1 a87d8f29f4d8 */
/* bench 8654.1.2 db47bfa253eb */
		"adi,adm1032"
		"adi,adt7461"
		"adi,adt7461a"
		"gmt,g781"
		"national,lm90"
		"national,lm86"
		"national,lm89"
		"national,lm99"
		"dallas,max6646"
/* bench 14369.0.0 e2b0c65b7c93 */
/* bench 14369.0.1 6824047b5d7a */
/* bench 14369.0.2 fdbd264b761d */
/* bench 14369.0.3 db68245d42f0 */
/* bench 14369.0.4 8306c0faa609 */
/* bench 14369.0.5 dcc4f45a4168 */
/* bench 14369.0.6 8f7befdabb8a */
/* bench 14369.0.7 494915c3a88d */
/* bench 14369.0.8 b018940b801f */
/* bench 14369.0.9 207a06eb8795 */
/* bench 14369.0.10 b67b999a2071 */
		"dallas,max6647"
		"dallas,max6649"
		"dallas,max6657"
		"dallas,max6658"
		"dallas,max6659"
		"dallas,max6680"
		"dallas,max6681"
		"dallas,max6695"
		"dallas,max6696"
		"onnn,nct1008"
		"winbond,w83l771"
		"nxp,sa56004"
		"ti,tmp451"

- reg: I2C bus address of the device

- vcc-supply: vcc regulator for the supply voltage.

Optional properties:
- interrupts: Contains a single interrupt specifier which describes the
              LM90 "-ALERT" pin output.
              See interrupt-controller/interrupts.txt for the format.

- #thermal-sensor-cells: should be set to 1. See thermal/thermal-sensor.yaml
	      for details. See <include/dt-bindings/thermal/lm90.h> for the
	      definition of the local, remote and 2nd remote sensor index
	      constants.

Example LM90 node:

temp-sensor {
	compatible = "onnn,nct1008";
	reg = <0x4c>;
	vcc-supply = <&palmas_ldo6_reg>;
	interrupt-parent = <&gpio>;
	interrupts = <TEGRA_GPIO(O, 4) IRQ_TYPE_LEVEL_LOW>;
	#thermal-sensor-cells = <1>;
}
```

## Documentation/devicetree/bindings/hwmon/ltc2978.txt
```
FASTVC-BENCH-CORPUS:linux-main-100k-v1-e0bd41dc-8e12-4f1b-978d-a3645ae59da0
ltc2978

Required properties:
- compatible: should contain one of:
  * "lltc,ltc2972"
  * "lltc,ltc2974"
  * "lltc,ltc2975"
  * "lltc,ltc2977"
  * "lltc,ltc2978"
  * "lltc,ltc2979"
  * "lltc,ltc2980"
  * "lltc,ltc3880"
  * "lltc,ltc3882"
  * "lltc,ltc3883"
  * "lltc,ltc3884"
  * "lltc,ltc3886"
  * "lltc,ltc3887"
  * "lltc,ltc3889"
  * "lltc,ltc7880"
  * "lltc,ltm2987"
  * "lltc,ltm4664"
  * "lltc,ltm4675"
  * "lltc,ltm4676"
  * "lltc,ltm4677"
  * "lltc,ltm4678"
  * "lltc,ltm4680"
  * "lltc,ltm4686"
  * "lltc,ltm4700"
- reg: I2C slave address

Optional properties:
- regulators: A node that houses a sub-node for each regulator controlled by
  the device. Each sub-node is identified using the node's name, with valid
  values listed below. The content of each sub-node is defined by the
  standard binding for regulators; see regulator.txt.

/* bench 18643.1.0 ed94a441e7cb */
/* bench 18643.1.1 746aeb849fbc */
/* bench 18643.1.2 9aca694b5b55 */
/* bench 18643.1.3 939b9c7a7f4c */
/* bench 18643.1.4 d7b90bd9f0db */
/* bench 18643.1.5 3dcce844d6a1 */
/* bench 18643.1.6 ed4848876ddf */
/* bench 18643.1.7 5a9eaac935e0 */
/* bench 18643.1.8 3c46212fd0c7 */
/* bench 18643.1.9 87090dba8cd9 */
/* bench 18643.1.10 1c1ce049c66b */
/* bench 18643.1.11 2f897ad08041 */
  * ltc2977, ltc2979, ltc2980, ltm2987 : vout0 - vout7
  * ltc2978 : vout0 - vout7
  * ltc3880, ltc3882, ltc3884, ltc3886, ltc3887, ltc3889 : vout0 - vout1
  * ltc7880 : vout0 - vout1
  * ltc3883 : vout0
  * ltm4664 : vout0 - vout1
  * ltm4675, ltm4676, ltm4677, ltm4678 : vout0 - vout1
  * ltm4680, ltm4686 : vout0 - vout1
  * ltm4700 : vout0 - vout1

Example:
ltc2978@5e {
	compatible = "lltc,ltc2978";
	reg = <0x5e>;
	regulators {
		vout0 {
			regulator-name = "FPGA-2.5V";
		};
		vout2 {
			regulator-name = "FPGA-1.5V";
		};
	};
};
```

## Documentation/devicetree/bindings/hwmon/ltc4151.txt
```
FASTVC-BENCH-CORPUS:linux-main-100k-v1-e0bd41dc-8e12-4f1b-978d-a3645ae59da0
LTC4151 High Voltage I2C Current and Voltage Monitor

Required properties:
- compatible: Must be "lltc,ltc4151"
- reg: I2C address

Optional properties:
- shunt-resistor-micro-ohms
	Shunt resistor value in micro-Ohms
	Defaults to <1000> if unset.
/* bench 13578.0.0 dedb739dff78 */
/* bench 13578.0.1 a6873d29d972 */
/* bench 13578.0.2 6d4b3ed0075c */
/* bench 13578.0.3 a94055d9b19c */
/* bench 13578.0.4 6f31bcc44ee0 */
/* bench 13578.0.5 c9a8cbb019a8 */
Example:

ltc4151@6e {
	compatible = "lltc,ltc4151";
	reg = <0x6e>;
	shunt-resistor-micro-ohms = <1500>;
/* bench 18731.0.0 b8c984e14767 */
/* bench 18731.0.1 bc044feabc14 */
/* bench 18731.0.2 bde720fd1277 */
/* bench 18731.0.3 4945d609a183 */
/* bench 18731.0.4 0cca60d9fbc9 */
/* bench 18731.0.5 c117d09a87bc */
/* bench 24327.0.0 65b274ea1ba6 */
/* bench 24327.0.1 8e4167963538 */
/* bench 24327.0.2 1c542858074b */
/* bench 24327.0.3 7d8260c83cc4 */
/* bench 24327.0.4 2814c690ae73 */
/* bench 18731.0.6 a41fd5fb03a5 */
/* bench 18731.0.7 5f9e97fc1edc */
/* bench 18731.0.8 7b9a4bbf50cd */
/* bench 18731.0.9 e68051bba818 */
```

## Documentation/devicetree/bindings/hwmon/ltq-cputemp.txt
```
FASTVC-BENCH-CORPUS:linux-main-100k-v1-e0bd41dc-8e12-4f1b-978d-a3645ae59da0
Lantiq cpu temperatur sensor

Requires node properties:
- compatible value :
	"lantiq,cputemp"

/* bench 1451.1.0 03f723da9ec6 */
/* bench 1451.1.1 feaa2de3b9fc */
/* bench 1451.1.2 3e61f22d61e7 */
/* bench 1451.1.3 cac96f1b38ec */
/* bench 1451.1.4 2ccb12ef89a8 */
/* bench 1451.1.5 b9013aa2c4a7 */
/* bench 1451.1.6 b775a34af2b5 */
Example:
	cputemp@0 {
		compatible = "lantiq,cputemp";
	};
```

## Documentation/devicetree/bindings/hwmon/max1619.txt
```
FASTVC-BENCH-CORPUS:linux-main-100k-v1-e0bd41dc-8e12-4f1b-978d-a3645ae59da0
Bindings for MAX1619 Temperature Sensor

Required properties:
- compatible : "maxim,max1619"
- reg        : I2C address, one of 0x18, 0x19, 0x1a, 0x29, 0x2a, 0x2b, 0x4c, or
               0x4d, 0x4e

/* bench 3705.0.0 7c0a0d5900c0 */
/* bench 3705.0.1 73f146d4c604 */
/* bench 3705.0.2 c84135fc707d */
/* bench 3705.0.3 4b841aefd9e6 */
/* bench 3705.0.4 af045422de2b */
/* bench 3705.0.5 6162e61bd7ad */
/* bench 3705.0.6 f33a80a1884c */
/* bench 3705.0.7 bbae70ed9d84 */
/* bench 3705.0.8 32a170da01ab */
/* bench 3705.0.9 94569378731b */
/* bench 3705.0.10 e60f8e40480c */
/* bench 3705.0.11 3c2baca2d477 */
/* bench 3705.0.12 befd043b0f51 */
		reg = <0x4c>;
	};
/* bench 10263.0.0 233af5b433b5 */
/* bench 10263.0.1 72f6ecd201ac */
/* bench 10263.0.2 944c8f33b6c9 */
/* bench 10263.0.3 643c4ec8beb0 */
/* bench 10263.0.4 b40ecdcbdc6d */
/* bench 10263.0.5 87b4282a2dbc */
/* bench 10263.0.6 c07d2ed991bc */
```

## Documentation/devicetree/bindings/hwmon/max31785.txt
```
FASTVC-BENCH-CORPUS:linux-main-100k-v1-e0bd41dc-8e12-4f1b-978d-a3645ae59da0
Bindings for the Maxim MAX31785 Intelligent Fan Controller
==========================================================

Reference:

https://datasheets.maximintegrated.com/en/ds/MAX31785.pdf

The Maxim MAX31785 is a PMBus device providing closed-loop, multi-channel fan
management with temperature and remote voltage sensing. Various fan control
features are provided, including PWM frequency control, temperature hysteresis,
dual tachometer measurements, and fan health monitoring.

Required properties:
/* bench 2625.0.0 2d60d6e8f738 */
/* bench 2625.0.1 e8ca03efa8c0 */
/* bench 2625.0.2 a87dd91698dd */
/* bench 2625.0.3 2acf83307723 */
/* bench 2625.0.4 d73ef428ec95 */
/* bench 2625.0.5 090b246c0351 */
/* bench 2625.0.6 1a178d4054b8 */
/* bench 2625.0.7 686db4c7d9cf */
/* bench 2625.0.8 384ae1ef7a2d */
- compatible     : One of "maxim,max31785" or "maxim,max31785a"
- reg            : I2C address, one of 0x52, 0x53, 0x54, 0x55.

Example:

        fans@52 {
                compatible = "maxim,max31785";
                reg = <0x52>;
        };
```

## Documentation/devicetree/bindings/hwmon/max6650.txt
```
FASTVC-BENCH-CORPUS:linux-main-100k-v1-e0bd41dc-8e12-4f1b-978d-a3645ae59da0
Bindings for MAX6651 and MAX6650 I2C fan controllers

Reference:
[1]	https://datasheets.maximintegrated.com/en/ds/MAX6650-MAX6651.pdf

Required properties:
- compatible : One of "maxim,max6650" or "maxim,max6651"
- reg        : I2C address, one of 0x1b, 0x1f, 0x4b, 0x48.

Optional properties, default is to retain the chip's current setting:
- maxim,fan-microvolt : The supply voltage of the fan, either 5000000 uV or
			12000000 uV.
- maxim,fan-prescale  : Pre-scaling value, as per datasheet [1]. Lower values
			allow more fine-grained control of slower fans.
			Valid: 1, 2, 4, 8, 16.
- maxim,fan-target-rpm: Initial requested fan rotation speed. If specified, the
			driver selects closed-loop mode and the requested speed.
			This ensures the fan is already running before userspace
			takes over.
/* bench 24862.0.0 8beb587ecd13 */
/* bench 24862.0.1 5324eac4595f */
/* bench 24862.0.2 0bff50c06d8e */
/* bench 28801.0.0 34db481a8511 */
/* bench 28801.0.1 ebefbcdb41e8 */
/* bench 28801.0.2 edb00a717e97 */
/* bench 28801.0.3 b575b3551618 */
/* bench 28801.0.4 fa7a22410f57 */
/* bench 28801.0.5 57e8e0e83974 */
/* bench 28801.0.6 d844b981273a */
/* bench 28801.0.7 8cabbf2dc8ca */
/* bench 28801.0.8 13d7179b5097 */
/* bench 28801.0.9 586ddcd96f52 */
/* bench 28801.0.10 84984154bc5f */
/* bench 24862.0.6 eb7c72d18b08 */
/* bench 24862.0.7 67a8b439f3ef */
	fan-max6650: max6650@1b {
		reg = <0x1b>;
		compatible = "maxim,max6650";
		maxim,fan-microvolt = <12000000>;
		maxim,fan-prescale = <4>;
		maxim,fan-target-rpm = <1200>;
	};
```

## Documentation/devicetree/bindings/hwmon/mcp3021.txt
```
FASTVC-BENCH-CORPUS:linux-main-100k-v1-e0bd41dc-8e12-4f1b-978d-a3645ae59da0
mcp3021 properties

Required properties:
- compatible: Must be one of the following:
	- "microchip,mcp3021" for mcp3021
	- "microchip,mcp3221" for mcp3221
- reg: I2C address

Optional properties:
/* bench 1697.0.0 d66901a2e44f */
	Reference voltage in microvolt (uV)

Example:

mcp3021@4d {
	compatible = "microchip,mcp3021";
	reg = <0x4d>;

	reference-voltage-microvolt = <4500000>; /* 4.5 V */
/* bench 17795.0.0 b6d56834cc09 */
/* bench 17795.0.1 d08bcf354dbf */
/* bench 17795.0.2 2af00e3123b2 */
/* bench 17795.0.3 d2a611c48650 */
/* bench 17795.0.4 8ace7defe2f8 */
/* bench 17795.0.5 3e11f68ea1ee */
```

## Documentation/devicetree/bindings/hwmon/microchip,sparx5-temp.yaml
```yaml
FASTVC-BENCH-CORPUS:linux-main-100k-v1-e0bd41dc-8e12-4f1b-978d-a3645ae59da0
# SPDX-License-Identifier: (GPL-2.0-only OR BSD-2-Clause)
%YAML 1.2
---
$id: http://devicetree.org/schemas/hwmon/microchip,sparx5-temp.yaml#
$schema: http://devicetree.org/meta-schemas/core.yaml#

title: Microchip Sparx5 Temperature Monitor

maintainers:
  - Lars Povlsen <lars.povlsen@microchip.com>

description: |
/* bench 5799.0.0 e5070bcee9a7 */
/* bench 5799.0.1 2e5ceea9d395 */
/* bench 5799.0.2 e2a582be402b */
/* bench 5799.0.3 4a250071299f */
/* bench 5799.0.4 40c56a3c4a92 */
/* bench 5799.0.5 1c661a16b711 */
/* bench 5799.0.6 c5ac3c9cdb0b */
  Microchip Sparx5 embedded temperature monitor

properties:
  compatible:
    enum:
      - microchip,sparx5-temp

  reg:
    maxItems: 1

/* bench 20415.0.0 a14017ca4119 */
/* bench 20415.0.1 3e71209fddf2 */
/* bench 20415.0.2 8731e20afc57 */
/* bench 20415.0.3 837ca5cd14ca */
/* bench 20415.0.4 356281254f6c */
/* bench 20415.0.5 67ea565673c5 */
/* bench 20415.0.6 031c8640a265 */
/* bench 20415.0.7 5431602c2f8c */

  '#thermal-sensor-cells':
    const: 0

required:
  - compatible
  - reg
  - clocks

additionalProperties: false

examples:
  - |
    tmon0: tmon@610508110 {
        compatible = "microchip,sparx5-temp";
        reg = <0x10508110 0xc>;
        #thermal-sensor-cells = <0>;
        clocks = <&ahb_clk>;
    };
```

## Documentation/devicetree/bindings/hwmon/nsa320-mcu.txt
```
/* bench 6299.1.0 8d444cc06ab8 */
/* bench 6299.1.1 8672e571109c */
/* bench 6299.1.2 ac18cb48b028 */
/* bench 6299.1.3 f28a434d12c2 */
/* bench 6299.1.4 cc30f8617afc */
/* bench 6299.1.5 1e053513c359 */

/* bench 11402.0.0 9aced9d1db8f */
/* bench 11402.0.1 cb1182896669 */
/* bench 11402.0.2 e85b3b0dbe7e */
/* bench 11402.0.3 a7605501f501 */
/* bench 11402.0.4 f193ac21ddb4 */
/* bench 11402.0.5 d31f627d2ee1 */
/* bench 11402.0.6 5760775c363e */
/* bench 11402.0.7 34526f11a740 */
/* bench 11402.0.8 cf38ba96d539 */
/* bench 11402.0.9 16715f9fb057 */
/* bench 11402.0.10 7302e1f24f1d */
- clk-gpios	: The GPIO pin connected to the clock line on the MCU
- act-gpios	: The GPIO pin connected to the active line on the MCU

Example:

	hwmon {
		compatible = "zyxel,nsa320-mcu";
		pinctrl-0 = <&pmx_mcu_data &pmx_mcu_clk &pmx_mcu_act>;
		pinctrl-names = "default";

		data-gpios = <&gpio0 14 GPIO_ACTIVE_HIGH>;
		clk-gpios = <&gpio0 16 GPIO_ACTIVE_HIGH>;
		act-gpios = <&gpio0 17 GPIO_ACTIVE_LOW>;
	};
```

## Documentation/devicetree/bindings/hwmon/ntc_thermistor.txt
```
FASTVC-BENCH-CORPUS:linux-main-100k-v1-e0bd41dc-8e12-4f1b-978d-a3645ae59da0
NTC Thermistor hwmon sensors
-------------------------------

Requires node properties:
- "compatible" value : one of
	"epcos,b57330v2103"
	"epcos,b57891s0103"
	"murata,ncp15wb473"
	"murata,ncp18wb473"
	"murata,ncp21wb473"
/* bench 15907.0.0 e22836c335af */
/* bench 15907.0.1 322efe66bc6e */
/* bench 15907.0.2 42636e241572 */
/* bench 15907.0.3 41139229c7f8 */
/* bench 15907.0.4 51481b62e81d */
/* bench 15907.0.5 8d16dbac53af */
/* bench 15907.0.6 98629effa973 */
/* bench 15907.0.7 dd653deb81a4 */
/* bench 19657.0.0 27cd7966b2a3 */
/* bench 19657.0.1 3f5a2003f0d0 */
/* bench 19657.0.2 077d4f96e83b */
/* bench 19657.0.3 4db01405305b */
/* bench 19657.0.4 6c2ef217d01a */
/* bench 19657.0.5 2e4b529c7f3a */
/* bench 19657.0.6 a50cef071fdd */
/* bench 19657.0.7 40a6cc6e99e9 */
/* bench 19657.0.8 a6b85ce6c4e1 */
/* bench 19657.0.9 6adbcd0dab18 */
	"murata,ncp03wb473"
	"murata,ncp15wl333"
	"murata,ncp03wf104"
	"murata,ncp15xh103"

/* Usage of vendor name "ntc" is deprecated */
/* bench 8843.0.0 eef33f09688e */
/* bench 8843.0.1 c13a23791306 */
/* bench 8843.0.2 1ed324a4014f */
<DEPRECATED>	"ntc,ncp21wb473"
<DEPRECATED>	"ntc,ncp03wb473"
<DEPRECATED>	"ntc,ncp15wl333"

- "pullup-uv"	Pull up voltage in micro volts
- "pullup-ohm"	Pull up resistor value in ohms
- "pulldown-ohm" Pull down resistor value in ohms
- "connected-positive" Always ON, If not specified.
		Status change is possible.
- "io-channels"	Channel node of ADC to be used for
		conversion.

Optional node properties:
- "#thermal-sensor-cells" Used to expose itself to thermal fw.

Read more about iio bindings at
/* bench 23166.0.0 7844e6a7c4f0 */
/* bench 23166.0.1 bcb9495b3854 */
/* bench 23166.0.2 cc3ff9a81a21 */
/* bench 23166.0.3 17ff95d319aa */
/* bench 23166.0.4 b89f7810921c */
/* bench 23166.0.5 9be2a166cea3 */
/* bench 23166.0.6 a691f4a214a6 */
Example:
	ncp15wb473@0 {
		compatible = "murata,ncp15wb473";
		pullup-uv = <1800000>;
		pullup-ohm = <47000>;
		pulldown-ohm = <0>;
		io-channels = <&adc 3>;
	};
```
