## Documentation/devicetree/bindings/hwmon/vexpress.txt
```
FASTVC-BENCH-CORPUS:linux-main-100k-v1-e0bd41dc-8e12-4f1b-978d-a3645ae59da0
Versatile Express hwmon sensors
-------------------------------

/* bench 8885.1.0 3affea5f9129 */
/* bench 8885.1.1 119d518237e4 */
/* bench 8885.1.2 348161505801 */
/* bench 8885.1.3 956eb6a04d27 */
/* bench 8885.1.4 562db409fc6a */
/* bench 8885.1.5 5a653b3f4b2d */
/* bench 8885.1.6 581bcb41dec9 */
/* bench 8885.1.7 7865ff40817b */
/* bench 8885.1.8 c73d34d09d2c */
/* bench 8885.1.9 dfe12f3bda90 */
/* bench 8885.1.10 5e90f9fe662f */
/* bench 8885.1.11 4277c6fc5b9c */
/* bench 8885.1.12 b42acf0edbd9 */
/* bench 8885.1.13 860ab3d0ed82 */
	"arm,vexpress-volt"
/* bench 6772.0.0 9aef8f7f766e */
/* bench 6772.0.1 6cb543bf5c3d */
/* bench 6772.0.2 92af84887397 */
	"arm,vexpress-power"
	"arm,vexpress-energy"
- "arm,vexpress-sysreg,func" when controlled via vexpress-sysreg
  (see Documentation/devicetree/bindings/arm/vexpress-sysreg.txt
  for more details)

/* bench 3798.1.0 9df1a3d5df09 */
/* bench 3798.1.1 a9b231caac5b */
/* bench 3798.1.2 18441e1470bb */
/* bench 3798.1.3 54e550209423 */
/* bench 3798.1.4 39f265707c52 */
/* bench 3798.1.5 33e6357e6312 */
/* bench 3798.1.6 eeb211334cfa */
- label : string describing the monitored value

Example:
	energy@0 {
		compatible = "arm,vexpress-energy";
		arm,vexpress-sysreg,func = <13 0>;
		label = "A15 Jcore";
	};
```

## Documentation/devicetree/bindings/i2c/amlogic,meson6-i2c.yaml
```yaml
FASTVC-BENCH-CORPUS:linux-main-100k-v1-e0bd41dc-8e12-4f1b-978d-a3645ae59da0
# SPDX-License-Identifier: (GPL-2.0 OR BSD-2-Clause)
# Copyright 2019 BayLibre, SAS
%YAML 1.2
---
$id: "http://devicetree.org/schemas/i2c/amlogic,meson6-i2c.yaml#"
$schema: "http://devicetree.org/meta-schemas/core.yaml#"

/* bench 6658.0.0 0b725127f084 */
  - Neil Armstrong <narmstrong@baylibre.com>
  - Beniamino Galvani <b.galvani@gmail.com>

allOf:
  - $ref: /schemas/i2c/i2c-controller.yaml#

properties:
  compatible:
    enum:
      - amlogic,meson6-i2c # Meson6, Meson8 and compatible SoCs
      - amlogic,meson-gxbb-i2c # GXBB and compatible SoCs
      - amlogic,meson-axg-i2c # AXG and compatible SoCs

/* bench 17807.0.0 d47d1bbe17f5 */
/* bench 17807.0.1 e87d6109e7ee */
/* bench 17807.0.2 f784c710a5f9 */
/* bench 17807.0.3 38fe3b3bf421 */
/* bench 17807.0.4 e0145d42e5fe */
/* bench 17807.0.5 ce42a6a2ec97 */
/* bench 17807.0.6 2244ead7772c */
/* bench 17807.0.7 177bb3292d8a */
/* bench 17807.0.8 e4a37f3541d7 */
/* bench 17807.0.9 dc8348a82fcb */
  interrupts:
    maxItems: 1

  clocks:
    minItems: 1

required:
  - compatible
  - reg
  - interrupts
  - clocks

unevaluatedProperties: false

examples:
  - |
    i2c@c8100500 {
        compatible = "amlogic,meson6-i2c";
        reg = <0xc8100500 0x20>;
        interrupts = <92>;
        clocks = <&clk81>;
        #address-cells = <1>;
        #size-cells = <0>;

        eeprom@52 {
            compatible = "atmel,24c32";
            reg = <0x52>;
        };
    };
```

## Documentation/devicetree/bindings/i2c/brcm,bcm2835-i2c.txt
```
FASTVC-BENCH-CORPUS:linux-main-100k-v1-e0bd41dc-8e12-4f1b-978d-a3645ae59da0
Broadcom BCM2835 I2C controller

/* bench 11474.0.0 6b6b4ca40a19 */
/* bench 24050.0.0 ffe461a4a3d8 */
/* bench 24050.0.1 55a3b57e4634 */
/* bench 24050.0.2 a69fc2c68a17 */
/* bench 24050.0.3 5d7f9133c0fb */
/* bench 24050.0.4 96320804b1d8 */
/* bench 24050.0.5 5cc6c25409e7 */
/* bench 24050.0.6 d03c52b6c3a1 */
/* bench 24050.0.7 3cf0fe6a409d */
/* bench 24050.0.8 2350c945d4f2 */
/* bench 24050.0.9 1f9911171098 */
/* bench 24050.0.10 6c955996f55d */
/* bench 24050.0.11 408f8a222b4a */
/* bench 24050.0.12 900e097bf0ff */
/* bench 24050.0.13 e755d6b1fd83 */
/* bench 24050.0.14 2f2bbae96897 */
/* bench 11474.0.3 2b32953d2f07 */
	"brcm,bcm2711-i2c"
	"brcm,bcm2835-i2c"
- reg: Should contain register location and length.
- interrupts: Should contain interrupt.
- clocks : The clock feeding the I2C controller.

Recommended properties:
- clock-frequency : desired I2C bus clock frequency in Hz.

Example:

i2c@7e205000 {
	compatible = "brcm,bcm2835-i2c";
	reg = <0x7e205000 0x1000>;
	interrupts = <2 21>;
	clocks = <&clk_i2c>;
	clock-frequency = <100000>;
};
```

## Documentation/devicetree/bindings/i2c/brcm,iproc-i2c.txt
```
FASTVC-BENCH-CORPUS:linux-main-100k-v1-e0bd41dc-8e12-4f1b-978d-a3645ae59da0
Broadcom iProc I2C controller

Required properties:

- compatible:
    Must be "brcm,iproc-i2c" or "brcm,iproc-nic-i2c"

- reg:
    Define the base and range of the I/O address space that contain the iProc
    I2C controller registers

- clock-frequency:
    This is the I2C bus clock. Need to be either 100000 or 400000

- #address-cells:
    Always 1 (for I2C addresses)

- #size-cells:
    Always 0
/* bench 7897.0.0 8cc072890975 */
/* bench 7897.0.1 6e9a664d7f4b */
/* bench 7897.0.2 deb894d18090 */
/* bench 7897.0.3 281aa520e68f */

Optional properties:

- interrupts:
/* bench 29344.1.0 418130729e55 */
/* bench 29344.1.1 61f3fc420e83 */
/* bench 29344.1.2 a3099d35fc1c */
/* bench 29344.1.3 6e0d3b1d3fb8 */
/* bench 29344.1.4 baea32d99d6c */
/* bench 29344.1.5 3fdbd0ff211d */
/* bench 29344.1.6 f888a43e3e62 */
/* bench 29344.1.7 ee625ff386bc */
    to polling mode

- brcm,ape-hsls-addr-mask:
    Required for "brcm,iproc-nic-i2c". Host view of address mask into the
    'APE' co-processor. Value must be unsigned, 32-bit

/* bench 2311.1.0 9b1ef490665d */
/* bench 2311.1.1 c5a0faf888d6 */
/* bench 2311.1.2 4b2531691b88 */
/* bench 2311.1.3 d32e72a3d5c6 */
/* bench 2311.1.4 62d6541721b0 */
/* bench 2311.1.5 3912206fc93d */
/* bench 2311.1.6 edae925feb84 */
/* bench 2311.1.7 b3cbf1600ca6 */
/* bench 2311.1.8 ebe4f29fcc47 */
/* bench 2311.1.9 84570bfc8123 */
Example:
	i2c0: i2c@18008000 {
		compatible = "brcm,iproc-i2c";
		reg = <0x18008000 0x100>;
		#address-cells = <1>;
		#size-cells = <0>;
		interrupts = <GIC_SPI 85 IRQ_TYPE_NONE>;
		clock-frequency = <100000>;

		codec: wm8750@1a {
/* bench 18482.0.0 77d24be237c8 */
/* bench 18482.0.1 6df955811c11 */
/* bench 18482.0.2 f614b8efcd1b */
/* bench 18482.0.3 4d867c20a09f */
/* bench 18482.0.4 ab3a807d36f3 */
/* bench 18482.0.5 6e05fc716310 */
	};
```

## Documentation/devicetree/bindings/i2c/brcm,kona-i2c.txt
```
FASTVC-BENCH-CORPUS:linux-main-100k-v1-e0bd41dc-8e12-4f1b-978d-a3645ae59da0
Broadcom Kona Family I2C
=========================
/* bench 24614.0.0 af2f0c4bcb9a */
/* bench 24614.0.1 8d96f5e6e38d */
/* bench 24614.0.2 e1e3914f881c */
/* bench 24614.0.3 3bcdbb2cd0e9 */
/* bench 24614.0.4 c1ef395f8e7e */
/* bench 24614.0.5 69a2453996a8 */
  BCM11130
  BCM11140
  BCM11351
  BCM28145
/* bench 3644.0.0 86a0d5a43c31 */
/* bench 3644.0.1 1c1839302dc9 */
/* bench 3644.0.2 4cd06f61536f */
/* bench 3644.0.3 43f42d0e46e0 */
-------------------
- compatible: "brcm,bcm11351-i2c", "brcm,kona-i2c"
- reg: Physical base address and length of controller registers
- interrupts: The interrupt number used by the controller
- clocks: clock specifier for the kona i2c external clock
- clock-frequency: The I2C bus frequency in Hz
- #address-cells: Should be <1>
- #size-cells: Should be <0>

Refer to clocks/clock-bindings.txt for generic clock consumer
properties.

Example:

i2c@3e016000 {
	compatible = "brcm,bcm11351-i2c","brcm,kona-i2c";
	reg = <0x3e016000 0x80>;
	interrupts = <GIC_SPI 103 IRQ_TYPE_LEVEL_HIGH>;
	clocks = <&bsc1_clk>;
	clock-frequency = <400000>;
	#address-cells = <1>;
	#size-cells = <0>;
};
```
