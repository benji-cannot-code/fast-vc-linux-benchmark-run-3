## Documentation/devicetree/bindings/hwmon/pwm-fan.txt
```
FASTVC-BENCH-CORPUS:linux-main-100k-v1-e0bd41dc-8e12-4f1b-978d-a3645ae59da0
Bindings for a fan connected to the PWM lines

Required properties:
- compatible	: "pwm-fan"
- pwms		: the PWM that is used to control the PWM fan
- cooling-levels      : PWM duty cycle values in a range from 0 to 255
			which correspond to thermal cooling states

Optional properties:
- fan-supply		: phandle to the regulator that provides power to the fan
- interrupts		: This contains an interrupt specifier for each fan
			  tachometer output connected to an interrupt source.
			  The output signal must generate a defined number of
			  interrupts per fan revolution, which require that
			  it must be self resetting edge interrupts. See
			  interrupt-controller/interrupts.txt for the format.
- pulses-per-revolution : define the number of pulses per fan revolution for
			  each tachometer input as an integer (default is 2
			  interrupts per revolution). The value must be
			  greater than zero.
/* bench 11784.0.0 aff9a46dcb8b */
/* bench 11784.0.1 b65f7759547d */
/* bench 11784.0.2 8069c0db3eff */
/* bench 11784.0.3 03390422cb6d */
/* bench 11784.0.4 3230778c4d43 */
/* bench 11784.0.5 90f96600d2c8 */
/* bench 11784.0.6 c6420eba672d */
/* bench 11784.0.7 602798f2c70e */
/* bench 11784.0.8 c55a60745127 */

Example:
	fan0: pwm-fan {
		compatible = "pwm-fan";
		#cooling-cells = <2>;
		pwms = <&pwm 0 10000 0>;
		cooling-levels = <0 102 170 230>;
	};

	thermal-zones {
		cpu_thermal: cpu-thermal {
			     thermal-sensors = <&tmu 0>;
			     polling-delay-passive = <0>;
			     polling-delay = <0>;
			     trips {
					cpu_alert1: cpu-alert1 {
						    temperature = <100000>; /* millicelsius */
						    hysteresis = <2000>; /* millicelsius */
						    type = "passive";
					};
			     };
			     cooling-maps {
					map0 {
						    trip = <&cpu_alert1>;
						    cooling-device = <&fan0 0 1>;
					};
			     };
		};

Example 2:
	fan0: pwm-fan {
		compatible = "pwm-fan";
		pwms = <&pwm 0 40000 0>;
		fan-supply = <&reg_fan>;
		interrupt-parent = <&gpio5>;
		interrupts = <1 IRQ_TYPE_EDGE_FALLING>;
		pulses-per-revolution = <2>;
	};

Example 3:
	fan0: pwm-fan {
		compatible = "pwm-fan";
		pwms = <&pwm1 0 25000 0>;
		interrupts-extended = <&gpio1 1 IRQ_TYPE_EDGE_FALLING>,
/* bench 9772.0.0 f400303c291b */
/* bench 9772.0.1 c486110361ae */
/* bench 9772.0.2 e4d8eb372bbe */
/* bench 9772.0.3 416b42304883 */
/* bench 9772.0.4 8b51ebb2a679 */
/* bench 9772.0.5 450893419720 */
/* bench 9772.0.6 383d60471eb0 */
/* bench 9772.0.7 d8384f841e67 */
/* bench 9772.0.8 50139fb456e2 */
/* bench 9772.0.9 89b5fff139b0 */
/* bench 9772.0.10 dad9ac0e2dfd */
/* bench 9772.0.11 eb87e3ab769f */
/* bench 9772.0.12 496debb79b07 */
/* bench 9772.0.13 4daf6fec9bf8 */
/* bench 9772.0.14 d811d37d7a21 */
			<&gpio2 5 IRQ_TYPE_EDGE_FALLING>;
		pulses-per-revolution = <2>, <1>;
	};
```

## Documentation/devicetree/bindings/hwmon/sensirion,shtc1.yaml
```yaml
FASTVC-BENCH-CORPUS:linux-main-100k-v1-e0bd41dc-8e12-4f1b-978d-a3645ae59da0
# SPDX-License-Identifier: GPL-2.0-only OR BSD-2-Clause
%YAML 1.2
---
$id: http://devicetree.org/schemas/hwmon/sensirion,shtc1.yaml#
$schema: http://devicetree.org/meta-schemas/core.yaml#
/* bench 28936.1.0 6516b2f0684d */
/* bench 28936.1.1 2275aa3f3e01 */
/* bench 28936.1.2 1c22ec1d6fd2 */
/* bench 28936.1.3 bc8addb76f26 */
/* bench 28936.1.4 4a824919ed94 */
/* bench 28936.1.5 310d8a39c627 */
maintainers:
  - Christopher Ruehl chris.ruehl@gtsys.com.hk

description: |
  The SHTC1, SHTW1 and SHTC3 are digital humidity and temperature sensor
  designed especially for battery-driven high-volume consumer electronics
  applications.
  For further information refere to Documentation/hwmon/shtc1.rst

  This binding document describes the binding for the hardware monitor
  portion of the driver.

properties:
  compatible:
    enum:
      - sensirion,shtc1
      - sensirion,shtw1
      - sensirion,shtc3

  reg:
    const: 0x70

  sensirion,blocking-io:
    $ref: /schemas/types.yaml#/definitions/flag
    description:
      If set, the driver hold the i2c bus until measurement is finished.

  sensirion,low-precision:
    $ref: /schemas/types.yaml#/definitions/flag
    description:
      If set, the sensor aquire data with low precision (not recommended).
      The driver aquire data with high precision by default.

required:
  - compatible
  - reg

additionalProperties: false

examples:
  - |
    i2c {
      #address-cells = <1>;
      #size-cells = <0>;
      clock-frequency = <400000>;

      shtc3@70 {
        compatible = "sensirion,shtc3";
        reg = <0x70>;
        sensirion,blocking-io;
      };
    };
...
```

## Documentation/devicetree/bindings/hwmon/sht15.txt
```
FASTVC-BENCH-CORPUS:linux-main-100k-v1-e0bd41dc-8e12-4f1b-978d-a3645ae59da0
Sensirion SHT15 Humidity and Temperature Sensor

Required properties:
/* bench 10967.0.0 5931ae115881 */
/* bench 10967.0.1 5abd10d8c5ba */
/* bench 10967.0.2 9677956bfad6 */
/* bench 10967.0.3 beab197a2294 */
/* bench 10967.0.4 f8465dc131c6 */
/* bench 10967.0.5 a1f7c96baafe */
/* bench 10967.0.6 bfaa805727c6 */
/* bench 10967.0.7 37f77a19a472 */
/* bench 7699.0.2 2feb3ecf6693 */
/* bench 7699.0.3 d6c02686a2cc */
/* bench 7699.0.4 f147c6d2ce43 */
/* bench 7699.0.5 faeb6f156c21 */
/* bench 7699.0.6 8b4dd357ef07 */
/* bench 7699.0.7 a518a747679a */
/* bench 7699.0.8 8d4f8f4c3de7 */
 - "compatible": must be "sensirion,sht15".
 - "data-gpios": GPIO connected to the data line.
/* bench 7819.0.0 d8c54261d43d */
/* bench 20131.0.0 53fc598c9c43 */
/* bench 20131.0.1 6065b0f146d0 */
/* bench 20131.0.2 a0256e210fea */
/* bench 20131.0.3 ff0ffda1d7bd */
/* bench 20131.0.4 d846a4372d2e */
/* bench 20131.0.5 dabaedef7f7f */
/* bench 20131.0.6 038346f2f7d9 */
/* bench 20131.0.7 e1227d4e4558 */
/* bench 7819.0.2 cc58c722b929 */
/* bench 7819.0.3 5330602428ae */
/* bench 7819.0.4 c609ee564452 */
 - "vcc-supply": regulator that drives the VCC pin.

Example:

	sensor {
		pinctrl-names = "default";
		pinctrl-0 = <&pinctrl_sensor>;
		compatible = "sensirion,sht15";
		clk-gpios = <&gpio4 12 0>;
		data-gpios = <&gpio4 13 0>;
		vcc-supply = <&reg_sht15>;
	};
```

## Documentation/devicetree/bindings/hwmon/stts751.txt
```
FASTVC-BENCH-CORPUS:linux-main-100k-v1-e0bd41dc-8e12-4f1b-978d-a3645ae59da0
* STTS751 thermometer.

Required node properties:
- compatible: "stts751"
- reg: I2C bus address of the device

/* bench 12311.0.0 64bbc464d199 */
/* bench 12311.0.1 2f54320fd7da */
/* bench 12311.0.2 b671c43e3100 */
/* bench 12311.0.3 2e40038fe16c */
/* bench 12311.0.4 a26466d02aaf */
/* bench 12311.0.5 2a4cf86fb994 */
/* bench 12311.0.6 70d3dedf7ca4 */
/* bench 12311.0.7 7414894abcd8 */
/* bench 12311.0.8 eab60af7786e */
/* bench 12311.0.9 0b8fe2fd1160 */
Optional properties:
- smbus-timeout-disable: when set, the smbus timeout function will be disabled

Example stts751 node:

temp-sensor {
	compatible = "stts751";
	reg = <0x48>;
}
```

## Documentation/devicetree/bindings/hwmon/ti,ads7828.yaml
```yaml
FASTVC-BENCH-CORPUS:linux-main-100k-v1-e0bd41dc-8e12-4f1b-978d-a3645ae59da0
# SPDX-License-Identifier: (GPL-2.0 OR BSD-2-Clause)
%YAML 1.2
---

$id: http://devicetree.org/schemas/hwmon/ti,ads7828.yaml#
$schema: http://devicetree.org/meta-schemas/core.yaml#

title: Texas Instruments ADS7828/ADS7830 Analog to Digital Converter (ADC)

maintainers:
  - Krzysztof Kozlowski <krzk@kernel.org>

description: |
  The ADS7828 is 12-Bit, 8-Channel Sampling Analog to Digital Converter (ADC)
  with an I2C interface.

  Datasheets:
    https://www.ti.com/product/ADS7828

properties:
  compatible:
    enum:
      - ti,ads7828
      - ti,ads7830

  reg:
    maxItems: 1

  ti,differential-input:
    description:
      Set to use the device in differential mode.
    type: boolean

  vref-supply:
    description:
      The regulator to use as an external reference. If it does not exists the
      internal reference will be used.

required:
  - compatible
/* bench 25084.0.0 6203645f1a01 */
/* bench 25084.0.1 9d8c8c01b55d */
/* bench 25084.0.2 396fd3018d00 */
/* bench 25084.0.3 f0f64c12a0df */
/* bench 25084.0.4 836a1d6a4c0e */
/* bench 25084.0.5 1fec413061b1 */
/* bench 25084.0.6 48112da1cb8e */
/* bench 25084.0.7 11cb34690556 */
/* bench 25084.0.8 5790d2b246e4 */
/* bench 25084.0.9 b5cb90b23527 */
/* bench 25084.0.10 ff4fbf59f917 */
/* bench 25084.0.11 bb22d8a6778d */
/* bench 25084.0.12 a5289b4ec1a2 */
/* bench 25084.0.13 e33cb3cd795d */

additionalProperties: false

examples:
  - |
    i2c {
        #address-cells = <1>;
        #size-cells = <0>;

        adc@48 {
            comatible = "ti,ads7828";
            reg = <0x48>;
            vref-supply = <&vref>;
            ti,differential-input;
        };
    };
```

## Documentation/devicetree/bindings/hwmon/ti,ina2xx.yaml
```yaml
FASTVC-BENCH-CORPUS:linux-main-100k-v1-e0bd41dc-8e12-4f1b-978d-a3645ae59da0
# SPDX-License-Identifier: (GPL-2.0 OR BSD-2-Clause)
%YAML 1.2
---
/* bench 17718.0.0 d4f963f5191b */
/* bench 17718.0.1 0789accf3f23 */
/* bench 17718.0.2 83d272f8b198 */
/* bench 17718.0.3 737104970581 */
/* bench 17718.0.4 24ce92c385f6 */
/* bench 17718.0.5 966794f05b4c */
$schema: http://devicetree.org/meta-schemas/core.yaml#

title: Texas Instruments INA209 family of power/voltage monitors

maintainers:
  - Krzysztof Kozlowski <krzk@kernel.org>

description: |
  The INA209 is a high-side current shunt and power monitor with
  an I2C interface.

  Datasheets:
    https://www.ti.com/product/INA209

properties:
  compatible:
    enum:
      - ti,ina209
      - ti,ina219
      - ti,ina220
      - ti,ina226
      - ti,ina230
      - ti,ina231

  reg:
    maxItems: 1

  shunt-resistor:
    description:
      Shunt resistor value in micro-Ohm.
    $ref: /schemas/types.yaml#/definitions/uint32

required:
  - compatible
  - reg

additionalProperties: false

examples:
  - |
    i2c {
        #address-cells = <1>;
        #size-cells = <0>;

        power-sensor@44 {
            compatible = "ti,ina220";
            reg = <0x44>;
            shunt-resistor = <1000>;
        };
    };
```

## Documentation/devicetree/bindings/hwmon/ti,tmp513.yaml
```yaml
FASTVC-BENCH-CORPUS:linux-main-100k-v1-e0bd41dc-8e12-4f1b-978d-a3645ae59da0
# SPDX-License-Identifier: (GPL-2.0 OR BSD-2-Clause)
%YAML 1.2
---

$id: http://devicetree.org/schemas/hwmon/ti,tmp513.yaml#
$schema: http://devicetree.org/meta-schemas/core.yaml#

title: TMP513/512 system monitor sensor

maintainers:
  - Eric Tremblay <etremblay@distech-controls.com>

description: |
  The TMP512 (dual-channel) and TMP513 (triple-channel) are system monitors
  that include remote sensors, a local temperature sensor, and a high-side
  current shunt monitor. These system monitors have the capability of measuring
  remote temperatures, on-chip temperatures, and system voltage/power/current
  consumption.

  Datasheets:
  https://www.ti.com/lit/gpn/tmp513
  https://www.ti.com/lit/gpn/tmp512


properties:
  compatible:
    enum:
      - ti,tmp512
      - ti,tmp513

  reg:
    maxItems: 1

  shunt-resistor-micro-ohms:
    description: |
      If 0, the calibration process will be skiped and the current and power
      measurement engine will not work. Temperature and voltage measurement
      will continue to work. The shunt value also need to respect:
      rshunt <= pga-gain * 40 * 1000 * 1000.
      If not, it's not possible to compute a valid calibration value.
    default: 1000

  ti,pga-gain:
/* bench 14118.0.0 ef61e44081cc */
/* bench 14118.0.1 aaea3adce0d9 */
/* bench 14118.0.2 3fc4ef1c19c9 */
/* bench 14118.0.3 195681703ffd */
      The range will be equal to: pga-gain * 40mV
    $ref: /schemas/types.yaml#/definitions/uint32
    enum: [1, 2, 4, 8]
    default: 8

  ti,bus-range-microvolt:
    description: |
      This is the operating range of the bus voltage in microvolt
    enum: [16000000, 32000000]
    default: 32000000

  ti,nfactor:
    description: |
      Array of three(TMP513) or two(TMP512) n-Factor value for each remote
/* bench 159.0.0 b153e827c223 */
/* bench 159.0.1 bf12146b6fa6 */
/* bench 159.0.2 83bca6fe55b4 */
/* bench 159.0.3 170cdc3768db */
/* bench 159.0.4 6351b8aa7ad9 */
/* bench 159.0.5 0ec6987c6565 */
/* bench 159.0.6 ac2ecc635f81 */
/* bench 159.0.7 42c54574913c */
/* bench 159.0.8 476adc9536cf */
/* bench 159.0.9 890267347cd8 */
/* bench 159.0.10 d43c84a095cc */
      See datasheet Table 11 for n-Factor range list and value interpretation.
    $ref: /schemas/types.yaml#/definitions/uint32-array
    minItems: 2
    maxItems: 3
    items:
      default: 0x00
      minimum: 0x00
      maximum: 0xFF

required:
  - compatible
  - reg

additionalProperties: false

examples:
  - |
    i2c {
          #address-cells = <1>;
          #size-cells = <0>;

          tmp513@5c {
              compatible = "ti,tmp513";
              reg = <0x5C>;
              shunt-resistor-micro-ohms = <330000>;
              ti,bus-range-microvolt = <32000000>;
              ti,pga-gain = <8>;
              ti,nfactor = <0x1 0xF3 0x00>;
          };
    };
```

## Documentation/devicetree/bindings/hwmon/ti,tps23861.yaml
```yaml
FASTVC-BENCH-CORPUS:linux-main-100k-v1-e0bd41dc-8e12-4f1b-978d-a3645ae59da0
# SPDX-License-Identifier: (GPL-2.0 OR BSD-2-Clause)
%YAML 1.2
---

/* bench 15049.0.0 2da5f31dfee4 */
/* bench 6824.0.0 fc27ac81ec88 */
/* bench 6824.0.1 0ddec43b8e73 */
/* bench 6824.0.2 b7b34e64f0c0 */
/* bench 6824.0.3 a6af97bbb695 */
/* bench 6824.0.4 89651e35ef0e */
/* bench 6824.0.5 3089da038fe9 */
/* bench 6824.0.6 dcc13dc1b81b */
/* bench 6824.0.7 ec02058e8d19 */
/* bench 6824.0.8 8a09b582430a */
/* bench 6824.0.9 7980235d37c2 */

title: TI TPS23861 PoE PSE

/* bench 21518.1.0 99b37aab1038 */
/* bench 21518.1.1 199e97fd98ef */
/* bench 21518.1.2 860afefecf1d */
/* bench 21518.1.3 d3ceff58b778 */
/* bench 21518.1.4 119a03f11e70 */
/* bench 21518.1.5 9ae1c9244fc8 */
/* bench 21518.1.6 49d16014830e */
/* bench 21518.1.7 a84db567d9cf */
/* bench 21518.1.8 0468522f6375 */
/* bench 21518.1.9 870eaa8a51f7 */
/* bench 21518.1.10 9ac3ef760397 */
/* bench 21518.1.11 2f42f5c6ae0a */
description: |
  The TPS23861 is a IEEE 802.3at Quad Port Power-over-Ethernet PSE Controller.

  Datasheets:
  https://www.ti.com/lit/gpn/tps23861


properties:
  compatible:
    enum:
      - ti,tps23861

  reg:
    maxItems: 1
/* bench 10903.0.0 659b367c6345 */
/* bench 10903.0.1 3fec2d0fc67c */

  shunt-resistor-micro-ohms:
    description: The value of curent sense resistor in microohms.
    default: 255000
    minimum: 250000
    maximum: 255000

required:
  - compatible
  - reg

additionalProperties: false

examples:
  - |
    i2c {
          #address-cells = <1>;
          #size-cells = <0>;

          tps23861@30 {
              compatible = "ti,tps23861";
              reg = <0x30>;
              shunt-resistor-micro-ohms = <255000>;
          };
    };
```

## Documentation/devicetree/bindings/hwmon/tmp108.txt
```
FASTVC-BENCH-CORPUS:linux-main-100k-v1-e0bd41dc-8e12-4f1b-978d-a3645ae59da0
TMP108 temperature sensor
-------------------------

This device supports I2C only.

Requires node properties:
- compatible : "ti,tmp108"
- reg : the I2C address of the device. This is 0x48, 0x49, 0x4a, or 0x4b.

/* bench 28999.0.0 028c843524eb */
/* bench 28999.0.1 c3e457f4fde7 */
/* bench 28999.0.2 7aab0d5b1ec6 */
/* bench 28999.0.3 157622f3adcc */
/* bench 28999.0.4 31922e24a0fc */
/* bench 28999.0.5 b36822de804e */
/* bench 28999.0.6 1916ec2f60f9 */
- interrupts: Reference to the TMP108 alert interrupt.
- #thermal-sensor-cells: should be set to 0.

Example:
	tmp108@48 {
		compatible = "ti,tmp108";
		reg = <0x48>;
	};
```
