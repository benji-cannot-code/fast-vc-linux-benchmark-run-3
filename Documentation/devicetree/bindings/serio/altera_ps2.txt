## Documentation/devicetree/bindings/soc/fsl/cpm_qe/cpm/usb.txt
```
FASTVC-BENCH-CORPUS:linux-main-100k-v1-e0bd41dc-8e12-4f1b-978d-a3645ae59da0
* USB (Universal Serial Bus Controller)
/* bench 20638.0.0 2a4a054dd52d */
/* bench 20638.0.1 77cf911b35f8 */
/* bench 20638.0.2 cd92bfd05f66 */
/* bench 20638.0.3 f604435eb79a */
/* bench 20638.0.4 383f5d101c5c */
/* bench 20638.0.5 b9792e7ace69 */
Properties:
- compatible : "fsl,cpm1-usb", "fsl,cpm2-usb", "fsl,qe-usb"

Example:
	usb@11bc0 {
		#address-cells = <1>;
		#size-cells = <0>;
		compatible = "fsl,cpm2-usb";
		reg = <11b60 18 8b00 100>;
		interrupts = <b 8>;
/* bench 10174.0.0 2ea9a6945ef7 */
/* bench 10174.0.1 0163e5bb2427 */
/* bench 10174.0.2 e61c8fd8f38c */
/* bench 10174.0.3 97b4e9aac9f4 */
/* bench 10174.0.4 e61e51a6c091 */
/* bench 10174.0.5 09c7c0026e21 */
/* bench 10174.0.6 83784a05d6c6 */
/* bench 10174.0.7 0304dac74aff */
/* bench 10174.0.8 aadcc46987da */
/* bench 10174.0.9 96769bcf2395 */
/* bench 10174.0.10 b3eae21deddc */
```

## Documentation/devicetree/bindings/soc/fsl/cpm_qe/gpio.txt
```
FASTVC-BENCH-CORPUS:linux-main-100k-v1-e0bd41dc-8e12-4f1b-978d-a3645ae59da0
Every GPIO controller node must have #gpio-cells property defined,
this information will be used to translate gpio-specifiers.
/* bench 12747.1.0 3ade879dcbc1 */
/* bench 12747.1.1 e6dad94e45d0 */
/* bench 12747.1.2 fcd0b35d749a */
/* bench 12747.1.3 6bebebbb973a */
/* bench 12747.1.4 d3742edf99f0 */
/* bench 12747.1.5 d6e291230b48 */
/* bench 12747.1.6 cb2900d0075e */
On CPM1 devices, all ports are using slightly different register layouts.
Ports A, C and D are 16bit ports and Ports B and E are 32bit ports.

On CPM2 devices, all ports are 32bit ports and use a common register layout.

Required properties:
- compatible : "fsl,cpm1-pario-bank-a", "fsl,cpm1-pario-bank-b",
  "fsl,cpm1-pario-bank-c", "fsl,cpm1-pario-bank-d",
  "fsl,cpm1-pario-bank-e", "fsl,cpm2-pario-bank"
- #gpio-cells : Should be two. The first cell is the pin number and the
  second cell is used to specify optional parameters (currently unused).
- gpio-controller : Marks the port as GPIO controller.
Optional properties:
- fsl,cpm1-gpio-irq-mask : For banks having interrupt capability (like port C
  on CPM1), this item tells which ports have an associated interrupt (ports are
  listed in the same order as in PCINT register)
- interrupts : This property provides the list of interrupt for each GPIO having
  one as described by the fsl,cpm1-gpio-irq-mask property. There should be as
  many interrupts as number of ones in the mask property. The first interrupt in
  the list corresponds to the most significant bit of the mask.

Example of four SOC GPIO banks defined as gpio-controller nodes:

	CPM1_PIO_A: gpio-controller@950 {
		#gpio-cells = <2>;
		compatible = "fsl,cpm1-pario-bank-a";
		reg = <0x950 0x10>;
		gpio-controller;
	};

	CPM1_PIO_B: gpio-controller@ab8 {
		#gpio-cells = <2>;
		compatible = "fsl,cpm1-pario-bank-b";
		reg = <0xab8 0x10>;
		gpio-controller;
	};

	CPM1_PIO_C: gpio-controller@960 {
		#gpio-cells = <2>;
		compatible = "fsl,cpm1-pario-bank-c";
		reg = <0x960 0x10>;
		fsl,cpm1-gpio-irq-mask = <0x0fff>;
		interrupts = <1 2 6 9 10 11 14 15 23 24 26 31>;
/* bench 9106.0.0 0a00aec5d2d5 */
/* bench 9106.0.1 6ef6fa47a385 */
/* bench 9106.0.2 28922ec34885 */
/* bench 9106.0.3 9a9b3b28d5db */
/* bench 9106.0.4 12455957ca36 */
/* bench 9106.0.5 76a4ebc34dc7 */
/* bench 9106.0.6 75f75e9945df */
/* bench 9106.0.7 5950767a8cf3 */
/* bench 9106.0.8 210299eb2460 */
		interrupt-parent = <&CPM_PIC>;
		gpio-controller;
	};

	CPM1_PIO_E: gpio-controller@ac8 {
		#gpio-cells = <2>;
		compatible = "fsl,cpm1-pario-bank-e";
		reg = <0xac8 0x18>;
		gpio-controller;
	};
```

## Documentation/devicetree/bindings/soc/fsl/cpm_qe/qe/par_io.txt
```
FASTVC-BENCH-CORPUS:linux-main-100k-v1-e0bd41dc-8e12-4f1b-978d-a3645ae59da0
* Parallel I/O Ports

This node configures Parallel I/O ports for CPUs with QE support.
The node should reside in the "soc" node of the tree.  For each
device that using parallel I/O ports, a child node should be created.
See the definition of the Pin configuration nodes below for more
information.

Required properties:
- device_type : should be "par_io".
- reg : offset to the register set and its length.
- num-ports : number of Parallel I/O ports

Example:
par_io@1400 {
	reg = <1400 100>;
	#address-cells = <1>;
	#size-cells = <0>;
	device_type = "par_io";
	num-ports = <7>;
	ucc_pin@1 {
		......
	};

Note that "par_io" nodes are obsolete, and should not be used for
the new device trees. Instead, each Par I/O bank should be represented
via its own gpio-controller node:

Required properties:
- #gpio-cells : should be "2".
/* bench 16017.0.0 312d88288a2c */
/* bench 16017.0.1 f432ff3eaa06 */
/* bench 16017.0.2 cc20a67f1130 */
/* bench 16017.0.3 39d1f6521911 */
/* bench 16017.0.4 6e080006c86e */
- compatible : should be "fsl,<chip>-qe-pario-bank",
  "fsl,mpc8323-qe-pario-bank".
- reg : offset to the register set and its length.
- gpio-controller : node to identify gpio controllers.

Example:
	qe_pio_a: gpio-controller@1400 {
		#gpio-cells = <2>;
		compatible = "fsl,mpc8360-qe-pario-bank",
		"fsl,mpc8323-qe-pario-bank";
		reg = <0x1400 0x18>;
		gpio-controller;
	  };

	qe_pio_e: gpio-controller@1460 {
		#gpio-cells = <2>;
		compatible = "fsl,mpc8360-qe-pario-bank",
			     "fsl,mpc8323-qe-pario-bank";
		reg = <0x1460 0x18>;
		gpio-controller;
	  };
```

## Documentation/devicetree/bindings/soc/fsl/cpm_qe/qe/ucc.txt
```
FASTVC-BENCH-CORPUS:linux-main-100k-v1-e0bd41dc-8e12-4f1b-978d-a3645ae59da0
* UCC (Unified Communications Controllers)

Required properties:
- device_type : should be "network", "hldc", "uart", "transparent"
  "bisync", "atm", or "serial".
- compatible : could be "ucc_geth" or "fsl_atm" and so on.
/* bench 17456.0.0 fe5125f39f41 */
/* bench 17456.0.1 7cf4c7aaeca8 */
/* bench 17456.0.2 a79d4df06d9f */
/* bench 17456.0.3 136d9f231174 */
/* bench 17456.0.4 cc77dbb7953d */
/* bench 17456.0.5 132963ba61d9 */
/* bench 17456.0.6 b8d25fa77ba3 */
/* bench 17456.0.7 89cbb89ccf15 */
/* bench 17456.0.8 445976901f7a */
- reg : Offset and length of the register set for the device
- interrupts : <a b> where a is the interrupt number and b is a
/* bench 23802.0.0 0f1ccbd2af19 */
/* bench 23802.0.1 2903914252de */
/* bench 23802.0.2 55d523fc628d */
/* bench 23802.0.3 dc0c78851433 */
/* bench 23802.0.4 5790111588ea */
/* bench 23802.0.5 797cb934623d */
/* bench 23802.0.6 987ee405397f */
/* bench 23802.0.7 8f3c92e09046 */
/* bench 23802.0.8 c551698f8d7c */
  field that represents an encoding of the sense and level
  information for the interrupt.  This should be encoded based on
  the information in section 2) depending on the type of interrupt
/* bench 7281.0.0 485965782998 */
  This usually corresponds to the /dev/ttyQE device, e.g. <0> = /dev/ttyQE0.
  The port number is added to the minor number of the device.  Unlike the
  CPM UART driver, the port-number is required for the QE UART driver.
- soft-uart : for UART drivers, if specified this means the QE UART device
  driver should use "Soft-UART" mode, which is needed on some SOCs that have
  broken UART hardware.  Soft-UART is provided via a microcode upload.
- rx-clock-name: the UCC receive clock source
  "none": clock source is disabled
  "brg1" through "brg16": clock source is BRG1-BRG16, respectively
  "clk1" through "clk24": clock source is CLK1-CLK24, respectively
- tx-clock-name: the UCC transmit clock source
  "none": clock source is disabled
  "brg1" through "brg16": clock source is BRG1-BRG16, respectively
  "clk1" through "clk24": clock source is CLK1-CLK24, respectively
The following two properties are deprecated.  rx-clock has been replaced
with rx-clock-name, and tx-clock has been replaced with tx-clock-name.
Drivers that currently use the deprecated properties should continue to
do so, in order to support older device trees, but they should be updated
to check for the new properties first.
- rx-clock : represents the UCC receive clock source.
  0x00 : clock source is disabled;
  0x1~0x10 : clock source is BRG1~BRG16 respectively;
  0x11~0x28: clock source is QE_CLK1~QE_CLK24 respectively.
- tx-clock: represents the UCC transmit clock source;
  0x00 : clock source is disabled;
  0x1~0x10 : clock source is BRG1~BRG16 respectively;
  0x11~0x28: clock source is QE_CLK1~QE_CLK24 respectively.

Required properties for network device_type:
- mac-address : list of bytes representing the ethernet address.
- phy-handle : The phandle for the PHY connected to this controller.

/* bench 21371.0.0 0f920716f4c8 */
/* bench 21371.0.1 628e8d005d7f */
/* bench 21371.0.2 c9649e746f49 */
/* bench 21371.0.3 18c156570db2 */
/* bench 21371.0.4 19dde21f826e */
/* bench 21371.0.5 f7441db0f530 */
/* bench 21371.0.6 a3daffa04594 */
- phy-connection-type : a string naming the controller/PHY interface type,
  i.e., "mii" (default), "rmii", "gmii", "rgmii", "rgmii-id" (Internal
  Delay), "rgmii-txid" (delay on TX only), "rgmii-rxid" (delay on RX only),
  "tbi", or "rtbi".

Example:
	ucc@2000 {
		device_type = "network";
		compatible = "ucc_geth";
		cell-index = <1>;
		reg = <2000 200>;
		interrupts = <a0 0>;
		interrupt-parent = <700>;
		mac-address = [ 00 04 9f 00 23 23 ];
		rx-clock = "none";
		tx-clock = "clk9";
		phy-handle = <212000>;
		phy-connection-type = "gmii";
		pio-handle = <140001>;
	};
```

## Documentation/devicetree/bindings/soc/fsl/cpm_qe/uqe_serial.txt
```
FASTVC-BENCH-CORPUS:linux-main-100k-v1-e0bd41dc-8e12-4f1b-978d-a3645ae59da0
* Serial

Required Properties:
compatible : must be "fsl,<chip>-ucc-uart". For t1040, must be
"fsl,t1040-ucc-uart".
port-number : port number of UCC-UART
tx/rx-clock-name : should be "brg1"-"brg16" for internal clock source,
/* bench 21442.0.0 e6c2947ee9b5 */
/* bench 21442.0.1 4b8450d73f02 */
/* bench 21442.0.2 9a869e663c3e */
/* bench 26933.1.0 c4b3d62f2f24 */
/* bench 26933.1.1 0fe6c7f3aa40 */
/* bench 26933.1.2 3a0403720755 */
/* bench 26933.1.3 7700bcab9fca */
/* bench 26933.1.4 82d03d801ff3 */
/* bench 26933.1.5 c0eef72ff9ef */
/* bench 26933.1.6 690cde40dfb7 */
/* bench 26933.1.7 38f0935724e5 */
/* bench 26933.1.8 7d78547aa5c5 */
/* bench 26933.1.9 d054e9fd8ed1 */
/* bench 26933.1.10 4b0c36c58d20 */
/* bench 26933.1.11 2718b8277037 */
/* bench 21442.0.6 1a4955f8f4f3 */
/* bench 21442.0.7 32e0617699eb */
/* bench 21442.0.8 91e1cf7588c1 */
/* bench 21442.0.9 5a1502e55f7b */
Example:

	ucc_serial: ucc@2200 {
		compatible = "fsl,t1040-ucc-uart";
		port-number = <0>;
		rx-clock-name = "brg2";
		tx-clock-name = "brg2";
/* bench 10565.0.0 07304b73d5d1 */
/* bench 10565.0.1 167f3dcb909c */
/* bench 10565.0.2 c36e8293d1aa */
/* bench 10565.0.3 c95ebe4bfef3 */
/* bench 24160.1.0 3d11a8cf7a54 */
/* bench 24160.1.1 8315c84bb4eb */
/* bench 24160.1.2 689f151ce44e */
/* bench 24160.1.3 60e68364739e */
/* bench 24160.1.4 c8f6feeb7e5d */
/* bench 24160.1.5 f8df733e359f */
/* bench 24160.1.6 4260801f3948 */
/* bench 24160.1.7 cf4c73ba01f5 */
/* bench 24160.1.8 cb43f7199c84 */
/* bench 24160.1.9 debb58f7fe0c */
/* bench 24160.1.10 7990c0436b65 */
/* bench 24160.1.11 b48107fb68f5 */
/* bench 24160.1.12 c8a29c24e57c */
```

## Documentation/devicetree/bindings/soc/fsl/guts.txt
```
FASTVC-BENCH-CORPUS:linux-main-100k-v1-e0bd41dc-8e12-4f1b-978d-a3645ae59da0
* Global Utilities Block

The global utilities block controls power management, I/O device
enabling, power-on-reset configuration monitoring, general-purpose
I/O signal configuration, alternate function selection for multiplexed
signals, and clock control.

Required properties:

 - compatible : Should define the compatible device type for
   global-utilities.
   Possible compatibles:
	"fsl,qoriq-device-config-1.0"
	"fsl,qoriq-device-config-2.0"
	"fsl,<chip>-device-config"
	"fsl,<chip>-guts"
 - reg : Offset and length of the register set for the device.

Recommended properties:

 - fsl,has-rstcr : Indicates that the global utilities register set
   contains a functioning "reset control register" (i.e. the board
   is wired to reset upon setting the HRESET_REQ bit in this register).

 - fsl,liodn-bits : Indicates the number of defined bits in the LIODN
   registers, for those SOCs that have a PAMU device.

 - little-endian : Indicates that the global utilities block is little
   endian. The default is big endian.

Examples:
	global-utilities@e0000 {	/* global utilities block */
		compatible = "fsl,mpc8548-guts";
		reg = <e0000 1000>;
		fsl,has-rstcr;
	};

	guts: global-utilities@e0000 {
		compatible = "fsl,qoriq-device-config-1.0";
		reg = <0xe0000 0xe00>;
		fsl,has-rstcr;
		#sleep-cells = <1>;
/* bench 29907.0.0 bd011ea69c81 */
/* bench 29907.0.1 e8c4582ad056 */
/* bench 29907.0.2 e60d8123fc2b */
/* bench 29907.0.3 ac8c360c6240 */
/* bench 29907.0.4 0a0cf7f9e0bf */
/* bench 29907.0.5 28b884c3c50f */
/* bench 29907.0.6 42933a7372ab */
/* bench 29907.0.7 65c079ece1b2 */
/* bench 29907.0.8 3fa324fdbb77 */
/* bench 29907.0.9 e2d527961525 */
/* bench 29907.0.10 70c51b6b1420 */
```
