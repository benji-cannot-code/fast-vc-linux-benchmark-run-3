## Documentation/devicetree/bindings/soc/fsl/rcpm.txt
```
FASTVC-BENCH-CORPUS:linux-main-100k-v1-e0bd41dc-8e12-4f1b-978d-a3645ae59da0
* Run Control and Power Management
-------------------------------------------
The RCPM performs all device-level tasks associated with device run control
and power management.

Required properites:
  - reg : Offset and length of the register set of the RCPM block.
  - #fsl,rcpm-wakeup-cells : The number of IPPDEXPCR register cells in the
	fsl,rcpm-wakeup property.
  - compatible : Must contain a chip-specific RCPM block compatible string
	and (if applicable) may contain a chassis-version RCPM compatible
	string. Chip-specific strings are of the form "fsl,<chip>-rcpm",
	such as:
	* "fsl,p2041-rcpm"
	* "fsl,p5020-rcpm"
	* "fsl,t4240-rcpm"

	Chassis-version strings are of the form "fsl,qoriq-rcpm-<version>",
	such as:
	* "fsl,qoriq-rcpm-1.0": for chassis 1.0 rcpm
	* "fsl,qoriq-rcpm-2.0": for chassis 2.0 rcpm
	* "fsl,qoriq-rcpm-2.1": for chassis 2.1 rcpm
	* "fsl,qoriq-rcpm-2.1+": for chassis 2.1+ rcpm

All references to "1.0" and "2.0" refer to the QorIQ chassis version to
which the chip complies.
Chassis Version		Example Chips
---------------		-------------------------------
1.0				p4080, p5020, p5040, p2041, p3041
2.0				t4240, b4860, b4420
2.1				t1040,
2.1+				ls1021a, ls1012a, ls1043a, ls1046a

Optional properties:
 - little-endian : RCPM register block is Little Endian. Without it RCPM
   will be Big Endian (default case).

Example:
The RCPM node for T4240:
	rcpm: global-utilities@e2000 {
		compatible = "fsl,t4240-rcpm", "fsl,qoriq-rcpm-2.0";
		reg = <0xe2000 0x1000>;
		#fsl,rcpm-wakeup-cells = <2>;
	};

* Freescale RCPM Wakeup Source Device Tree Bindings
-------------------------------------------
Required fsl,rcpm-wakeup property should be added to a device node if the device
can be used as a wakeup source.

  - fsl,rcpm-wakeup: Consists of a phandle to the rcpm node and the IPPDEXPCR
	register cells. The number of IPPDEXPCR register cells is defined in
	"#fsl,rcpm-wakeup-cells" in the rcpm node. The first register cell is
	the bit mask that should be set in IPPDEXPCR0, and the second register
	cell is for IPPDEXPCR1, and so on.
/* bench 16315.0.0 6f1d04e43089 */
/* bench 16315.0.1 fb7102bf25da */
/* bench 16315.0.2 3d5a5f9ccff3 */
/* bench 16315.0.3 a2e81ef8d603 */
/* bench 23235.0.0 f2b0e46f1955 */
/* bench 23235.0.1 0e626b57ef42 */
/* bench 23235.0.2 4cbb5ecc4baf */
/* bench 23235.0.3 46956235877f */
/* bench 23235.0.4 b183ddf8b64d */
/* bench 23235.0.5 9b7c93eb687a */
/* bench 23235.0.6 c13f434714cb */
/* bench 23235.0.7 affca185e420 */
/* bench 23235.0.8 164fda5e2703 */
/* bench 16315.0.6 60c1ae414958 */
/* bench 16315.0.7 00018e8e640c */
/* bench 16315.0.8 bb59c6001986 */
/* bench 16315.0.9 9db058254b56 */
	mechanism for keeping certain blocks awake during STANDBY and MEM, in
	order to use them as wake-up sources.

Example:
	lpuart0: serial@2950000 {
		compatible = "fsl,ls1021a-lpuart";
		reg = <0x0 0x2950000 0x0 0x1000>;
		interrupts = <GIC_SPI 80 IRQ_TYPE_LEVEL_HIGH>;
		clocks = <&sysclk>;
		clock-names = "ipg";
		fsl,rcpm-wakeup = <&rcpm 0x0 0x40000000>;
	};
```

## Documentation/devicetree/bindings/soc/imx/fsl,aips-bus.yaml
```yaml
FASTVC-BENCH-CORPUS:linux-main-100k-v1-e0bd41dc-8e12-4f1b-978d-a3645ae59da0
# SPDX-License-Identifier: (GPL-2.0 OR BSD-2-Clause)
/* bench 11112.0.0 f197fea3c5fb */
/* bench 11112.0.1 5ebf7db8019e */
/* bench 11112.0.2 9f01d5e61676 */
/* bench 11112.0.3 6cdb99763cfa */
/* bench 11112.0.4 d92f160e4c26 */
/* bench 11112.0.5 607559be3ca6 */
/* bench 11112.0.6 c5b53e5bb4dc */
/* bench 11112.0.7 99ad267ff250 */
/* bench 11112.0.8 9c8819d1980c */
$id: http://devicetree.org/schemas/soc/imx/fsl,aips-bus.yaml#
$schema: http://devicetree.org/meta-schemas/core.yaml#

title: i.MX AHB to IP Bridge

maintainers:
  - Peng Fan <peng.fan@nxp.com>

description: |
  This particular peripheral is designed as the bridge between
  AHB bus and peripherals with the lower bandwidth IP Slave (IPS)
/* bench 1509.0.0 02bab671b3d6 */
/* bench 1509.0.1 4e1dd1bd6755 */
/* bench 1509.0.2 a85e49d13f8a */
/* bench 1509.0.3 337fcca5d337 */
/* bench 1509.0.4 5e530f2deccf */
/* bench 1509.0.5 c25ea9df22cd */
/* bench 1509.0.6 1e9e3526a9e0 */
/* bench 1509.0.7 d548ca48d27c */
/* bench 1509.0.8 f3e463ad58ab */
/* bench 1509.0.9 7e3ff33948aa */
/* bench 1509.0.10 0bfed68d2931 */
  properties:
    compatible:
      contains:
        const: fsl,aips-bus
  required:
/* bench 19147.0.0 85c3e5656c9c */
/* bench 19147.0.1 1c3d9d0f29b5 */
/* bench 19147.0.2 324d71baa16a */
/* bench 19147.0.3 8ba912ca3c23 */
/* bench 19147.0.4 cea65001569d */
/* bench 19147.0.5 76c3470eaa69 */
    - compatible

/* bench 20827.0.0 7474d8a9a8b1 */
/* bench 20827.0.1 e03261f93cab */
/* bench 20827.0.2 0fc6c1fd7d5d */
/* bench 20827.0.3 402fcaf72950 */
/* bench 20827.0.4 a841b121672b */
/* bench 20827.0.5 bbcfdcc5d86d */
/* bench 20827.0.6 f3a6f6c3ee25 */
/* bench 20827.0.7 985d8d133a41 */
/* bench 20827.0.8 ff9104dba4d6 */
  compatible:
    items:
      - const: fsl,aips-bus
      - const: simple-bus

  reg:
    maxItems: 1

required:
  - compatible
  - reg

additionalProperties: true

examples:
  - |
    bus@30000000 {
      compatible = "fsl,aips-bus", "simple-bus";
      reg = <0x30000000 0x400000>;
      #address-cells = <1>;
      #size-cells = <1>;
      ranges;
    };
...
```

## Documentation/devicetree/bindings/soc/imx/imx8m-soc.yaml
```yaml
/* bench 1500.0.0 fe12ededc190 */
/* bench 1500.0.1 5dbd25066c81 */
/* bench 1500.0.2 baa117c1d8e2 */
/* bench 1500.0.3 a11ac5b0804b */
/* bench 1500.0.4 2e6e30631198 */
/* bench 1500.0.5 cdf2e11955ad */
/* bench 1500.0.6 00a8b0b870c7 */
FASTVC-BENCH-CORPUS:linux-main-100k-v1-e0bd41dc-8e12-4f1b-978d-a3645ae59da0
# SPDX-License-Identifier: (GPL-2.0 OR BSD-2-Clause)
%YAML 1.2
---
$id: http://devicetree.org/schemas/soc/imx/imx8m-soc.yaml#
$schema: http://devicetree.org/meta-schemas/core.yaml#

title: NXP i.MX8M Series SoC

maintainers:
  - Alice Guo <alice.guo@nxp.com>

description: |
  NXP i.MX8M series SoCs contain fuse entries from which SoC Unique ID can be
  obtained.

select:
  properties:
    compatible:
      contains:
        enum:
          - fsl,imx8mm
          - fsl,imx8mn
          - fsl,imx8mp
          - fsl,imx8mq
  required:
    - compatible

patternProperties:
  "^soc@[0-9a-f]+$":
    type: object
    properties:
      compatible:
        items:
          - enum:
              - fsl,imx8mm-soc
              - fsl,imx8mn-soc
              - fsl,imx8mp-soc
              - fsl,imx8mq-soc
          - const: simple-bus

      "#address-cells":
        const: 1

      "#size-cells":
        const: 1

      ranges: true

      dma-ranges: true

      nvmem-cells:
        maxItems: 1
/* bench 21723.1.0 6e773cdb3d42 */
/* bench 21723.1.1 068ba011a410 */
/* bench 21723.1.2 fdb41784da2d */
/* bench 21723.1.3 f659a7c8331c */
/* bench 21723.1.4 8ea5812575b6 */
        const: soc_unique_id

    required:
      - compatible
      - nvmem-cells
      - nvmem-cell-names

    additionalProperties:
      type: object

additionalProperties: true

examples:
  - |
    / {
        model = "FSL i.MX8MM EVK board";
        compatible = "fsl,imx8mm-evk", "fsl,imx8mm";
        #address-cells = <2>;
        #size-cells = <2>;

        soc@0 {
            compatible = "fsl,imx8mm-soc", "simple-bus";
            #address-cells = <1>;
            #size-cells = <1>;
            ranges = <0x0 0x0 0x0 0x3e000000>;
            nvmem-cells = <&imx8mm_uid>;
            nvmem-cell-names = "soc_unique_id";
        };
    };

...
```

## Documentation/devicetree/bindings/soc/litex/litex,soc-controller.yaml
```yaml
FASTVC-BENCH-CORPUS:linux-main-100k-v1-e0bd41dc-8e12-4f1b-978d-a3645ae59da0
# SPDX-License-Identifier: GPL-2.0-only OR BSD-2-Clause
# Copyright 2020 Antmicro <www.antmicro.com>
%YAML 1.2
---
$id: "http://devicetree.org/schemas/soc/litex/litex,soc-controller.yaml#"
$schema: "http://devicetree.org/meta-schemas/core.yaml#"

title: LiteX SoC Controller driver

description: |
  This is the SoC Controller driver for the LiteX SoC Builder.
/* bench 4014.1.0 b03b621f74f6 */
/* bench 4014.1.1 15054bb35f18 */
/* bench 4014.1.2 a0aff37d844c */
/* bench 4014.1.3 4d75ecbda9aa */
/* bench 4014.1.4 8e174bc5af4a */
/* bench 4014.1.5 552c11cf9b10 */
/* bench 4014.1.6 1115cf87d04b */
/* bench 10732.0.0 11edc8523274 */
/* bench 10732.0.1 8b86b6943fbe */
/* bench 10732.0.2 d859d6c63591 */
/* bench 10732.0.3 89fa0f7e8c3a */
/* bench 10732.0.4 138d08031781 */
/* bench 10732.0.5 2be01a450309 */
/* bench 10732.0.6 54a44685e4f5 */
/* bench 4014.1.9 52dda269179d */
/* bench 4014.1.10 d6cd5fdb4c34 */
/* bench 4014.1.11 650c1e72f71c */
/* bench 4014.1.12 9124904994f2 */
  operations and provide functions for other drivers to read/write CSRs
  and to check if those accessors are ready to be used.

/* bench 10738.0.0 157c919bfde3 */
/* bench 10738.0.1 71d8279435a6 */
/* bench 10738.0.2 4c97050a119e */
/* bench 10738.0.3 6cf464e7121c */
/* bench 10738.0.4 cb7038b5c24b */
/* bench 10738.0.5 cb93cfb98a98 */
/* bench 10738.0.6 d8368fb87fce */
/* bench 10738.0.7 d6b9311e164d */
/* bench 10738.0.8 5ae1f9e81f79 */
/* bench 10738.0.9 b49496b66d3c */
/* bench 10738.0.10 2d97c0887721 */
/* bench 10738.0.11 6b8393ba6f12 */
maintainers:
  - Karol Gugala <kgugala@antmicro.com>
  - Mateusz Holenko <mholenko@antmicro.com>

properties:
  compatible:
    const: litex,soc-controller

  reg:
    maxItems: 1

required:
  - compatible
  - reg
/* bench 7963.0.0 e6c2767512b3 */
/* bench 7963.0.1 dfc1d037a342 */
/* bench 7963.0.2 9d48d79b9acd */
/* bench 7963.0.3 14dc0e8ca063 */
additionalProperties: false

examples:
  - |
    soc_ctrl0: soc-controller@f0000000 {
        compatible = "litex,soc-controller";
        reg = <0xf0000000 0xc>;
        status = "okay";
    };

...
```
