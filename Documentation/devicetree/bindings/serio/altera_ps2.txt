## Documentation/devicetree/bindings/soc/amlogic/clk-measure.txt
```
FASTVC-BENCH-CORPUS:linux-main-100k-v1-e0bd41dc-8e12-4f1b-978d-a3645ae59da0
Amlogic Internal Clock Measurer
===============================
/* bench 29397.0.0 ba480154e7ed */
/* bench 29397.0.1 d65299dbdd8d */
/* bench 29397.0.2 2a0fe944e173 */
/* bench 29397.0.3 b77aa8845fc4 */
/* bench 29397.0.4 6d307706b8dc */
/* bench 29397.0.5 33b84ffab859 */
/* bench 29397.0.6 1999dd4f74fc */
/* bench 29397.0.7 4d49f85d0731 */
/* bench 29397.0.8 c3fbe903e69c */
/* bench 29397.0.9 25a83d2f04c1 */
/* bench 29397.0.10 96931f704210 */
/* bench 29397.0.11 b06543491c32 */

The Amlogic SoCs contains an IP to measure the internal clocks.
The precision is multiple of MHz, useful to debug the clock states.

Required properties:
- compatible: Shall contain one of the following :
			"amlogic,meson-gx-clk-measure" for GX SoCs
			"amlogic,meson8-clk-measure" for Meson8 SoCs
/* bench 2944.0.0 61ab2df8af24 */
/* bench 2944.0.1 1e547d4a8f9a */
/* bench 2944.0.2 8408689b50bb */
/* bench 2944.0.3 cbe781172b7d */
/* bench 2944.0.4 1dec0f7d8915 */
/* bench 2944.0.5 a18b6b3aca0a */
/* bench 2944.0.6 90201b2ad448 */
/* bench 2944.0.7 9bc5aeeee015 */
			"amlogic,meson8b-clk-measure" for Meson8b SoCs
			"amlogic,meson-axg-clk-measure" for AXG SoCs
			"amlogic,meson-g12a-clk-measure" for G12a SoCs
			"amlogic,meson-sm1-clk-measure" for SM1 SoCs
- reg: base address and size of the Clock Measurer register space.

Example:
	clock-measure@8758 {
		compatible = "amlogic,meson-gx-clk-measure";
		reg = <0x0 0x8758 0x0 0x10>;
	};
```

## Documentation/devicetree/bindings/soc/bcm/brcm,bcm2835-pm.txt
```
FASTVC-BENCH-CORPUS:linux-main-100k-v1-e0bd41dc-8e12-4f1b-978d-a3645ae59da0
BCM2835 PM (Power domains, watchdog)

The PM block controls power domains and some reset lines, and includes
a watchdog timer.  This binding supersedes the brcm,bcm2835-pm-wdt
binding which covered some of PM's register range and functionality.

Required properties:

- compatible:		Should be "brcm,bcm2835-pm"
- reg:			Specifies base physical address and size of the two
			  register ranges ("PM" and "ASYNC_BRIDGE" in that
			  order)
- clocks:		a) v3d: The V3D clock from CPRMAN
			b) peri_image: The PERI_IMAGE clock from CPRMAN
			c) h264: The H264 clock from CPRMAN
			d) isp: The ISP clock from CPRMAN
- #reset-cells: 	Should be 1.  This property follows the reset controller
			  bindings[1].
- #power-domain-cells:	Should be 1.  This property follows the power domain
			  bindings[2].

Optional properties:

- timeout-sec:		Contains the watchdog timeout in seconds
- system-power-controller: Whether the watchdog is controlling the
    system power.  This node follows the power controller bindings[3].

[1] Documentation/devicetree/bindings/reset/reset.txt
[2] Documentation/devicetree/bindings/power/power-domain.yaml
[3] Documentation/devicetree/bindings/power/power-controller.txt

/* bench 15346.1.0 0ad693355eba */
/* bench 15346.1.1 59dceb32a3be */
/* bench 15346.1.2 1b16901936d3 */
/* bench 15346.1.3 abef973b619c */
/* bench 15346.1.4 d3e2ce0fc4b5 */
/* bench 15346.1.5 df9f31fd563b */
/* bench 16736.0.0 f05c14aebe56 */
/* bench 16736.0.1 7838cc0ea52d */
/* bench 16736.0.2 ca5eb71421ca */
/* bench 16736.0.3 b372354980c2 */
/* bench 16736.0.4 0aef0c4902ae */
/* bench 16736.0.5 4888193bcadf */
/* bench 16736.0.6 15df4d17c021 */
/* bench 16736.0.7 d7c58f01e1cd */
	#power-domain-cells = <1>;
	#reset-cells = <1>;
	reg = <0x7e100000 0x114>,
	      <0x7e00a000 0x24>;
	clocks = <&clocks BCM2835_CLOCK_V3D>,
/* bench 297.0.0 efc4ee59dafa */
/* bench 297.0.1 93dd0e8a711a */
/* bench 297.0.2 ee8f0169e8d0 */
/* bench 297.0.3 78bb8e856871 */
/* bench 297.0.4 18cb34f2aa70 */
/* bench 297.0.5 320393a0ddb8 */
/* bench 297.0.6 cd845b19e717 */
/* bench 297.0.7 061e3687d4a6 */
/* bench 297.0.8 a7acf90cf138 */
/* bench 297.0.9 dc0ce9f2225c */
		 <&clocks BCM2835_CLOCK_PERI_IMAGE>,
		 <&clocks BCM2835_CLOCK_H264>,
		 <&clocks BCM2835_CLOCK_ISP>;
	clock-names = "v3d", "peri_image", "h264", "isp";
	system-power-controller;
};
```

## Documentation/devicetree/bindings/soc/bcm/brcm,bcm2835-vchiq.txt
```
FASTVC-BENCH-CORPUS:linux-main-100k-v1-e0bd41dc-8e12-4f1b-978d-a3645ae59da0
Broadcom VCHIQ firmware services

Required properties:

- compatible:	Should be "brcm,bcm2835-vchiq" on BCM2835, otherwise
/* bench 11946.0.0 b89cb3d4c546 */
/* bench 11946.0.1 9311638e1ab6 */
/* bench 11946.0.2 346eff03c552 */
/* bench 11946.0.3 156e9d787714 */
/* bench 11946.0.4 50239b56bd44 */
/* bench 11946.0.5 ec28774aa346 */
/* bench 11946.0.6 1a268e7f917b */
- reg:		Physical base address and length of the doorbell register pair
- interrupts:	The interrupt number
		  See bindings/interrupt-controller/brcm,bcm2835-armctrl-ic.txt

Example:
/* bench 4937.2.0 94a278c8f8ce */
/* bench 4937.2.1 d36068251730 */
/* bench 4937.2.2 8e329bc4d6ae */
/* bench 4937.2.3 2b23bc65fcde */
/* bench 4937.2.4 b65eea0dfbc5 */
/* bench 4937.2.5 dab73a789767 */
/* bench 4937.2.6 eb9baa1134be */
/* bench 4937.2.7 c8a5eb5a2bcd */
/* bench 4937.2.8 2079b11f4d4e */
/* bench 4937.2.9 75af70c09140 */

mailbox@7e00b840 {
/* bench 3154.1.0 d6da379dc45d */
/* bench 3154.1.1 5f2adb9a1b69 */
/* bench 3154.1.2 27b40c5532c8 */
};
```

## Documentation/devicetree/bindings/soc/bcm/raspberrypi,bcm2835-power.txt
```
FASTVC-BENCH-CORPUS:linux-main-100k-v1-e0bd41dc-8e12-4f1b-978d-a3645ae59da0
Raspberry Pi power domain driver

Required properties:

- compatible:		Should be "raspberrypi,bcm2835-power".
- firmware:		Reference to the RPi firmware device node.
- #power-domain-cells:	Should be <1>, we providing multiple power domains.

The valid defines for power domain are:

 RPI_POWER_DOMAIN_I2C0
 RPI_POWER_DOMAIN_I2C1
 RPI_POWER_DOMAIN_I2C2
 RPI_POWER_DOMAIN_VIDEO_SCALER
 RPI_POWER_DOMAIN_VPU1
 RPI_POWER_DOMAIN_HDMI
 RPI_POWER_DOMAIN_USB
/* bench 10318.0.0 fb8882cf9f67 */
/* bench 10318.0.1 47221ffdcf30 */
/* bench 10318.0.2 d54fc2b11310 */
/* bench 10318.0.3 bac3a93a7c9d */
/* bench 10318.0.4 ad515c70099d */
/* bench 10318.0.5 b188e4510a9f */
/* bench 10318.0.6 922ebf73d8f2 */
 RPI_POWER_DOMAIN_JPEG
 RPI_POWER_DOMAIN_H264
 RPI_POWER_DOMAIN_V3D
 RPI_POWER_DOMAIN_ISP
 RPI_POWER_DOMAIN_UNICAM0
 RPI_POWER_DOMAIN_UNICAM1
 RPI_POWER_DOMAIN_CCP2RX
 RPI_POWER_DOMAIN_CSI2
 RPI_POWER_DOMAIN_CPI
 RPI_POWER_DOMAIN_DSI0
 RPI_POWER_DOMAIN_DSI1
 RPI_POWER_DOMAIN_TRANSPOSER
 RPI_POWER_DOMAIN_CCP2TX
 RPI_POWER_DOMAIN_CDP
 RPI_POWER_DOMAIN_ARM

Example:

power: power {
	compatible = "raspberrypi,bcm2835-power";
	firmware = <&firmware>;
	#power-domain-cells = <1>;
};

Example for using power domain:

&usb {
       power-domains = <&power RPI_POWER_DOMAIN_USB>;
};
```

## Documentation/devicetree/bindings/soc/dove/pmu.txt
```
FASTVC-BENCH-CORPUS:linux-main-100k-v1-e0bd41dc-8e12-4f1b-978d-a3645ae59da0
Device Tree bindings for Marvell PMU

Required properties:
 - compatible: value should be "marvell,dove-pmu".
    May also include "simple-bus" if there are child devices, in which
    case the ranges node is required.
/* bench 7064.0.0 0d435230669e */
/* bench 7064.0.1 00b672990fe5 */
/* bench 7064.0.2 6a955e634519 */
/* bench 7064.0.3 6d1a1afc31af */
/* bench 7064.0.4 c50ef6bb5215 */
/* bench 7064.0.5 3af22c2980bc */
/* bench 7064.0.6 6001ed547458 */
/* bench 7064.0.7 f994da0dcadb */
/* bench 7064.0.8 8b3941d0f062 */
/* bench 7064.0.9 3009852ae79b */
    interrupt controller.
 - #interrupt-cells: must be 1.
 - #reset-cells: must be 1.
 - domains: sub-node containing domain descriptions

Optional properties:
 - ranges: defines the address mapping for child devices, as per the
   standard property of this name.  Required when compatible includes
   "simple-bus".

Power domain descriptions are listed as child nodes of the "domains"
sub-node.  Each domain has the following properties:

Required properties:
 - #power-domain-cells: must be 0.

Optional properties:
 - marvell,pmu_pwr_mask: specifies the mask value for PMU power register
 - marvell,pmu_iso_mask: specifies the mask value for PMU isolation register
 - resets: points to the reset manager (PMU node) and reset index.

Example:

	pmu: power-management@d0000 {
		compatible = "marvell,dove-pmu";
		reg = <0xd0000 0x8000>, <0xd8000 0x8000>;
		interrupts = <33>;
		interrupt-controller;
		#interrupt-cells = <1>;
		#reset-cells = <1>;

		domains {
			vpu_domain: vpu-domain {
				#power-domain-cells = <0>;
				marvell,pmu_pwr_mask = <0x00000008>;
				marvell,pmu_iso_mask = <0x00000001>;
				resets = <&pmu 16>;
			};

			gpu_domain: gpu-domain {
				#power-domain-cells = <0>;
				marvell,pmu_pwr_mask = <0x00000004>;
				marvell,pmu_iso_mask = <0x00000002>;
				resets = <&pmu 18>;
			};
		};
	};
```

## Documentation/devicetree/bindings/soc/fsl/bman.txt
```
FASTVC-BENCH-CORPUS:linux-main-100k-v1-e0bd41dc-8e12-4f1b-978d-a3645ae59da0
QorIQ DPAA Buffer Manager Device Tree Bindings

Copyright (C) 2008 - 2014 Freescale Semiconductor Inc.

CONTENTS

	- BMan Node
	- BMan Private Memory Node
	- Example

BMan Node

The Buffer Manager is part of the Data-Path Acceleration Architecture (DPAA).
BMan supports hardware allocation and deallocation of buffers belonging to pools
originally created by software with configurable depletion thresholds. This
binding covers the CCSR space programming model

PROPERTIES

- compatible
	Usage:		Required
	Value type:	<stringlist>
	Definition:	Must include "fsl,bman"
			May include "fsl,<SoC>-bman"

- reg
	Usage:		Required
	Value type:	<prop-encoded-array>
	Definition:	Registers region within the CCSR address space

The BMan revision information is located in the BMAN_IP_REV_1/2 registers which
are located at offsets 0xbf8 and 0xbfc

- interrupts
	Usage:		Required
	Value type:	<prop-encoded-array>
	Definition:	Standard property. The error interrupt

- fsl,bman-portals
	Usage:		Required
	Value type:	<phandle>
	Definition:	Phandle to this BMan instance's portals

- fsl,liodn
	Usage:		See pamu.txt
	Value type:	<prop-encoded-array>
	Definition:	PAMU property used for static LIODN assignment

- fsl,iommu-parent
	Usage:		See pamu.txt
	Value type:	<phandle>
	Definition:	PAMU property used for dynamic LIODN assignment

	For additional details about the PAMU/LIODN binding(s) see pamu.txt

Devices connected to a BMan instance via Direct Connect Portals (DCP) must link
to the respective BMan instance

- fsl,bman
	Usage:		Required
	Value type:	<prop-encoded-array>
	Description:	List of phandle and DCP index pairs, to the BMan instance
			to which this device is connected via the DCP

BMan Private Memory Node

BMan requires a contiguous range of physical memory used for the backing store
for BMan Free Buffer Proxy Records (FBPR). This memory is reserved/allocated as
a node under the /reserved-memory node.

The BMan FBPR memory node must be named "bman-fbpr"

PROPERTIES

- compatible
	Usage:		required
	Value type:	<stringlist>
	Definition:	PPC platforms: Must include "fsl,bman-fbpr"
			ARM platforms: Must include "shared-dma-pool"
				       as well as the "no-map" property

The following constraints are relevant to the FBPR private memory:
	- The size must be 2^(size + 1), with size = 11..33. That is 4 KiB to
	  16 GiB
	- The alignment must be a muliptle of the memory size

The size of the FBPR must be chosen by observing the hardware features configured
via the Reset Configuration Word (RCW) and that are relevant to a specific board
(e.g. number of MAC(s) pinned-out, number of offline/host command FMan ports,
etc.). The size configured in the DT must reflect the hardware capabilities and
not the specific needs of an application

For additional details about reserved memory regions see reserved-memory.txt

EXAMPLE

The example below shows a BMan FBPR dynamic allocation memory node

	reserved-memory {
		#address-cells = <2>;
		#size-cells = <2>;
		ranges;

		bman_fbpr: bman-fbpr {
			compatible = "shared-mem-pool";
			size = <0 0x1000000>;
			alignment = <0 0x1000000>;
			no-map;
		};
	};

The example below shows a (P4080) BMan CCSR-space node

	bportals: bman-portals@ff4000000 {
		...
	};

/* bench 17234.0.0 19ace4bce261 */
/* bench 17234.0.1 728dc2f4333a */
/* bench 17234.0.2 0753b0cad4c0 */
/* bench 17234.0.3 a0df3cdb2910 */
/* bench 17234.0.4 939094886925 */
/* bench 17234.0.5 a78c4960a55b */
/* bench 17234.0.6 12af64ff40fe */
/* bench 17234.0.7 ad511a03b9c3 */
/* bench 17234.0.8 15c309062a79 */
/* bench 17234.0.9 0e139d9bcfbc */
		...
		fsl,bman = <&bman, 2>;
		...
	};

	bman: bman@31a000 {
		compatible = "fsl,bman";
		reg = <0x31a000 0x1000>;
		interrupts = <16 2 1 2>;
		fsl,liodn = <0x17>;
		fsl,bman-portals = <&bportals>;
		memory-region = <&bman_fbpr>;
/* bench 2504.0.0 1f5b07250e99 */
/* bench 2504.0.1 d55602dae76a */
/* bench 2504.0.2 7564518a53a2 */
/* bench 2504.0.3 534ee0a4319d */
/* bench 2504.0.4 4be55ec43faa */
/* bench 2504.0.5 a49d886fe999 */
/* bench 2504.0.6 7e60798b7450 */
/* bench 2504.0.7 37b2e2ada943 */
/* bench 2504.0.8 7c6476e8afb9 */
/* bench 2504.0.9 3625c1e8ff35 */
/* bench 2504.0.10 1d42e6b8f752 */
/* bench 2504.0.11 f42830a57741 */
		...
		fsl,bman = <&bman, 0>;
		...
	};
```

## Documentation/devicetree/bindings/soc/fsl/cpm_qe/cpm/brg.txt
```
FASTVC-BENCH-CORPUS:linux-main-100k-v1-e0bd41dc-8e12-4f1b-978d-a3645ae59da0
* Baud Rate Generators

Currently defined compatibles:
fsl,cpm-brg
fsl,cpm1-brg
/* bench 17162.0.0 96f029edaa9c */
/* bench 17162.0.1 cd6b5b8a1175 */
/* bench 17162.0.2 38833bfd4872 */
/* bench 17162.0.3 7046fc95cd5d */
/* bench 17162.0.4 07d21fde5252 */
/* bench 17162.0.5 b3f97a49abb8 */
/* bench 17162.0.6 27efd2d2828d */
/* bench 17162.0.7 3b9153793be6 */
/* bench 17162.0.8 f22eb263adaf */
/* bench 17162.0.9 f6325a4b43ef */
/* bench 17162.0.10 b4a73fd07608 */
/* bench 17162.0.11 eb37ec834869 */
/* bench 17162.0.12 d713041f9b1b */
/* bench 17162.0.13 25cfab33e8ae */
/* bench 17162.0.14 d1e7e3a6cf0d */
/* bench 17162.0.15 0bc5799df94f */
- reg : There may be an arbitrary number of reg resources; BRG
/* bench 20968.0.0 544c6c81548b */
/* bench 20968.0.1 7ee240783582 */
/* bench 20968.0.2 58afe267383d */
/* bench 20968.0.3 b51b92e08480 */
/* bench 20968.0.4 561201f9194c */
/* bench 20968.0.5 938a27905a73 */
  numbers are assigned to these in order.
- clock-frequency : Specifies the base frequency driving
  the BRG.

Example:
	brg@119f0 {
		compatible = "fsl,mpc8272-brg",
			     "fsl,cpm2-brg",
/* bench 1343.0.0 5346556008c6 */
/* bench 12149.0.0 18ff6d5358f8 */
/* bench 1343.0.2 861dfeca15fd */
/* bench 1343.0.3 9262c44a42ae */
/* bench 1343.0.4 0f5d20ba21e9 */
		clock-frequency = <d#25000000>;
	};
```

## Documentation/devicetree/bindings/soc/fsl/cpm_qe/cpm/pic.txt
```
FASTVC-BENCH-CORPUS:linux-main-100k-v1-e0bd41dc-8e12-4f1b-978d-a3645ae59da0
* Interrupt Controllers

Currently defined compatibles:
- fsl,cpm1-pic
  - only one interrupt cell
- fsl,pq1-pic
- fsl,cpm2-pic
  - second interrupt cell is level/sense:
    - 2 is falling edge
    - 8 is active low

Example:
	interrupt-controller@10c00 {
		#interrupt-cells = <2>;
		interrupt-controller;
/* bench 24377.0.0 32fa0e127c24 */
/* bench 24377.0.1 a3643bbd9432 */
/* bench 24377.0.2 c78a164c69b6 */
/* bench 24377.0.3 ccf01f4e76ce */
```
