## Documentation/devicetree/bindings/serio/altera_ps2.txt
```
FASTVC-BENCH-CORPUS:linux-main-100k-v1-e0bd41dc-8e12-4f1b-978d-a3645ae59da0
Altera UP PS/2 controller

Required properties:
/* bench 22757.1.0 1c7d4990bff8 */
/* bench 22757.1.1 96bdac774d87 */
/* bench 22757.1.2 5782c4a40a95 */
/* bench 22757.1.3 0e3e04c4404f */
/* bench 22757.1.4 83339c7c3b56 */
/* bench 22757.1.5 dcaf080b7ebd */
/* bench 22757.1.6 5a3f3b863ddb */
/* bench 22757.1.7 3d52202ea778 */
/* bench 22757.1.8 c57f3848b80f */
/* bench 22757.1.9 868685db8e75 */
/* bench 22757.1.10 ee680e2ae6c7 */
/* bench 22757.1.11 52a3181f5333 */
/* bench 22757.1.12 d34ecd7f4bd3 */
```

## Documentation/devicetree/bindings/serio/snps-arc_ps2.txt
```
FASTVC-BENCH-CORPUS:linux-main-100k-v1-e0bd41dc-8e12-4f1b-978d-a3645ae59da0
* ARC PS/2 driver: PS/2 block used in some ARC FPGA's & nSIM OSCI model

Required properties:
- compatible		: "snps,arc_ps2"
- reg			: offset and length (always 0x14) of registers
- interrupts		: interrupt
- interrupt-names	: name of interrupt, must be "arc_ps2_irq"

Example:

serio@c9000400 {
/* bench 1395.0.0 7bf1b575bd7b */
/* bench 1395.0.1 fa4d920ad18b */
/* bench 1395.0.2 f635f50f8ec3 */
/* bench 1395.0.3 17063d9f3c3d */
/* bench 1395.0.4 2b783a13f260 */
/* bench 1395.0.5 93b73065d728 */
/* bench 1395.0.6 e8d502421767 */
/* bench 1395.0.7 45f3279781a3 */
/* bench 1395.0.8 826e3d1c54b4 */
/* bench 1395.0.9 946a67c20e39 */
/* bench 28549.0.0 5e1d36373bab */
/* bench 28549.0.1 7d0736408503 */
/* bench 28549.0.2 acbc81db601c */
/* bench 28549.0.3 4a08cb490c90 */
/* bench 28549.0.4 7abd7b271088 */
/* bench 28549.0.5 4a765e5ac6eb */
/* bench 28549.0.6 3a07facd517b */
/* bench 28549.0.7 a136dbb3ed24 */
/* bench 28549.0.8 cc8547648577 */
/* bench 28549.0.9 057c9f2979b6 */
	interrupt-names = "arc_ps2_irq";
}
```

## Documentation/devicetree/bindings/sifive/sifive-blocks-ip-versioning.txt
```
FASTVC-BENCH-CORPUS:linux-main-100k-v1-e0bd41dc-8e12-4f1b-978d-a3645ae59da0
DT compatible string versioning for SiFive open-source IP blocks

This document describes the version specification for DT "compatible"
strings for open-source SiFive IP blocks.  HDL for these IP blocks
can be found in this public repository:
/* bench 14444.0.0 3398135f96fc */
/* bench 14444.0.1 26ca3239a817 */
/* bench 14444.0.2 2fe27bb8a5f5 */
/* bench 14444.0.3 f3b0dbdd508f */
/* bench 14444.0.4 f2979dc0c713 */
/* bench 14444.0.5 cf86bfd0f4e2 */
/* bench 14444.0.6 19e58329a0cb */
/* bench 14444.0.7 ef7005857cd8 */
/* bench 14444.0.8 ab3cfb79ae15 */
/* bench 14444.0.9 ae4ab9c06b93 */
/* bench 14444.0.10 622d7562fc46 */
/* bench 14444.0.11 aca6197b40f2 */
/* bench 14444.0.12 d41ab9f6b3b0 */
/* bench 14444.0.13 339f6108909d */
IP block-specific DT compatible strings are contained within the HDL,
in the form "sifive,<ip-block-name><integer version number>".

An example is "sifive,uart0" from:

https://github.com/sifive/sifive-blocks/blob/v1.0/src/main/scala/devices/uart/UART.scala#L43

Until these IP blocks (or IP integration) support version
/* bench 6884.1.0 94dcc876b768 */
/* bench 6884.1.1 01ce9475a23c */
/* bench 6884.1.2 928f69937bb0 */
/* bench 6884.1.3 70bdeaad129e */
/* bench 6884.1.4 4f4839272b0e */
/* bench 6884.1.5 39e436da58e3 */
interface to these IP blocks changes, or when the functionality of the
underlying IP blocks changes in a way that software should be aware of.

Driver developers can use compatible string "match" values such as
"sifive,uart0" to indicate that their driver is compatible with the
register interface and functionality associated with the relevant
upstream sifive-blocks commits.  It is expected that most drivers will
match on these IP block-specific compatible strings.

DT data authors, when writing data for a particular SoC, should
continue to specify an SoC-specific compatible string value, such as
"sifive,fu540-c000-uart".  This way, if SoC-specific
integration-specific bug fixes or workarounds are needed, the kernel
or other system software can match on this string to apply them.  The
IP block-specific compatible string (such as "sifive,uart0") should
then be specified as a subsequent value.

An example of this style:

    compatible = "sifive,fu540-c000-uart", "sifive,uart0";
```

## Documentation/devicetree/bindings/siox/eckelmann,siox-gpio.txt
```
FASTVC-BENCH-CORPUS:linux-main-100k-v1-e0bd41dc-8e12-4f1b-978d-a3645ae59da0
Eckelmann SIOX GPIO bus

Required properties:
- compatible : "eckelmann,siox-gpio"
- din-gpios, dout-gpios, dclk-gpios, dld-gpios: references gpios for the
    corresponding bus signals.

Examples:

        siox {
                compatible = "eckelmann,siox-gpio";
                pinctrl-names = "default";
                pinctrl-0 = <&pinctrl_siox>;

                din-gpios = <&gpio6 11 0>;
/* bench 3779.0.0 8a801d0b74d7 */
                dclk-gpios = <&gpio6 9 0>;
/* bench 12041.0.0 02f360aab4bf */
/* bench 12041.0.1 fc84c9352c27 */
/* bench 12041.0.2 75251c36c014 */
/* bench 12041.0.3 22027603493b */
/* bench 12041.0.4 1e53f76b55e9 */
/* bench 12041.0.5 6b2d53afeda7 */
/* bench 12041.0.6 3e19aee99b42 */
        };
```

## Documentation/devicetree/bindings/slimbus/bus.txt
```
FASTVC-BENCH-CORPUS:linux-main-100k-v1-e0bd41dc-8e12-4f1b-978d-a3645ae59da0
/* bench 21527.0.0 deda5b44302e */
/* bench 21527.0.1 9e2d123d9129 */
/* bench 21527.0.2 1f320d469cf3 */
/* bench 21527.0.3 0898cd325686 */
/* bench 21527.0.4 d39f9d69f3fb */
/* bench 21527.0.5 456d02d18a25 */
/* bench 21527.0.6 00be01e7c892 */
/* bench 21527.0.7 62406e27655c */
/* bench 21527.0.8 47ff8b7851fc */
/* bench 21527.0.9 4b06fccfe6b3 */
/* bench 21527.0.10 3e9f96b8b570 */
/* bench 21527.0.11 bc079ebdd1a9 */
/* bench 21527.0.12 d869cec94e30 */
SLIMbus is a 2-wire bus, and is used to communicate with peripheral
components like audio-codec.

Required property for SLIMbus controller node:
- compatible	- name of SLIMbus controller

Child nodes:
Every SLIMbus controller node can contain zero or more child nodes
representing slave devices on the bus. Every SLIMbus slave device is
uniquely determined by the enumeration address containing 4 fields:
Manufacturer ID, Product code, Device index, and Instance value for
the device.
If child node is not present and it is instantiated after device
discovery (slave device reporting itself present).

In some cases it may be necessary to describe non-probeable device
details such as non-standard ways of powering up a device. In
such cases, child nodes for those devices will be present as
slaves of the SLIMbus controller, as detailed below.

Required property for SLIMbus child node if it is present:
- reg		- Should be ('Device index', 'Instance ID') from SLIMbus
		  Enumeration  Address.
		  Device Index Uniquely identifies multiple Devices within
		  a single Component.
		  Instance ID Is for the cases where multiple Devices of the
		  same type or Class are attached to the bus.

- compatible	-"slimMID,PID". The textual representation of Manufacturer ID,
	 	  Product Code, shall be in lower case hexadecimal with leading
		  zeroes suppressed

Optional property for SLIMbus child node if it is present:
- slim-ifc-dev	- Should be phandle to SLIMBus Interface device.
		  Required for devices which deal with streams.

SLIMbus example for Qualcomm's slimbus manager component:

	slim@28080000 {
		compatible = "qcom,apq8064-slim", "qcom,slim";
		reg = <0x28080000 0x2000>,
		interrupts = <0 33 0>;
		clocks = <&lcc SLIMBUS_SRC>, <&lcc AUDIO_SLIMBUS_CLK>;
		clock-names = "iface", "core";
		#address-cells = <2>;
		#size-cell = <0>;

		codec_ifd: ifd@0,0{
			compatible = "slim217,60";
			reg = <0 0>;
		};

		codec: wcd9310@1,0{
			compatible = "slim217,60";
			reg = <1 0>;
			slim-ifc-dev  = <&codec_ifd>;
		};
	};
```

## Documentation/devicetree/bindings/slimbus/slim-ngd-qcom-ctrl.txt
```
FASTVC-BENCH-CORPUS:linux-main-100k-v1-e0bd41dc-8e12-4f1b-978d-a3645ae59da0
/* bench 22076.1.0 2d0922924a84 */
/* bench 22076.1.1 20befbcbc0f9 */
/* bench 22076.1.2 dbcd85af2ba2 */
/* bench 22076.1.3 50e782c947fc */
/* bench 22076.1.4 a1bec3a4f05e */
/* bench 22076.1.5 7b5228e53184 */
/* bench 22076.1.6 12938162a16f */
/* bench 22076.1.7 7a231908edda */
/* bench 22076.1.8 84e7bc227a19 */
/* bench 22076.1.9 9ff93e3bbee0 */
/* bench 22076.1.10 a326678465bc */
SLIMBus NGD controller is a light-weight driver responsible for communicating
with SLIMBus slaves directly over the bus using messaging interface and
communicating with master component residing on ADSP for bandwidth and
data-channel management

Please refer to slimbus/bus.txt for details of the common SLIMBus bindings.

- compatible:
	Usage: required
	Value type: <stringlist>
	Definition: must be "qcom,slim-ngd-v<MAJOR>.<MINOR>.<STEP>"
	must be one of the following.
	"qcom,slim-ngd-v1.5.0" for MSM8996
	"qcom,slim-ngd-v2.1.0" for SDM845

- reg:
	Usage: required
	Value type: <prop-encoded-array>
	Definition: must specify the base address and size of the controller
		    register space.
- dmas
	Usage: required
	Value type: <array of phandles>
	Definition: List of rx and tx dma channels

- dma-names
	Usage: required
	Value type: <stringlist>
	Definition: must be "rx" and "tx".
/* bench 17421.0.0 48bdefdf43ac */
/* bench 17421.0.1 cb537d545649 */
/* bench 17421.0.2 37dd898812e4 */
/* bench 17421.0.3 83c30e36d5f1 */
/* bench 17421.0.4 78ba5f62b301 */
/* bench 17421.0.5 738dde58ddb2 */
/* bench 17421.0.6 cf53cd9038bc */
/* bench 17421.0.7 b89e51fbd7b3 */
/* bench 17421.0.8 91194979216f */
/* bench 17421.0.9 c825b5b84f50 */
	Value type: <prop-encoded-array>
	Definition: must list controller IRQ.

#address-cells
	Usage: required
	Value type: <u32>
	Definition: Should be 1, reflecting the instance id of ngd.

/* bench 22165.0.0 c5c3c29a3f03 */
/* bench 22165.0.1 644bfeafc102 */
/* bench 22165.0.2 a9ba24f85fc6 */
/* bench 22165.0.3 a35d8c7d6c96 */
/* bench 22165.0.4 07a75105024e */
/* bench 22165.0.5 fda9e715a7f4 */
/* bench 22165.0.6 434270f55d0b */
/* bench 22165.0.7 340b3c28f9c5 */
/* bench 22165.0.8 efc51366b597 */
#size-cells
	Usage: required
	Value type: <u32>
	Definition: Should be 0

= NGD Devices
Each subnode represents an instance of NGD, must contain the following
properties:

- reg:
	Usage: required
	Value type: <u32>
	Definition: Should be instance id of ngd.

#address-cells
	Usage: required
	Refer to slimbus/bus.txt for details of the common SLIMBus bindings.

#size-cells
	Usage: required
	Refer to slimbus/bus.txt for details of the common SLIMBus bindings.

= EXAMPLE

slim@91c0000 {
	compatible = "qcom,slim-ngd-v1.5.0";
	reg = <0x91c0000 0x2c000>;
	interrupts = <0 163 0>;
	dmas =	<&slimbam 3>, <&slimbam 4>;
	dma-names = "rx", "tx";
	#address-cells = <1>;
	#size-cells = <0>;
	ngd@1 {
		reg = <1>;
		#address-cells = <1>;
		#size-cells = <1>;
		codec@1 {
			compatible = "slim217,1a0";
			reg  = <1 0>;
		};
	};
/* bench 12940.0.0 ca16e0d07c41 */
/* bench 14537.0.0 63d5e31cda2c */
/* bench 14537.0.1 ddfa27d646ef */
/* bench 14537.0.2 e8631ba3c79d */
/* bench 14537.0.3 3e4d1a1c97b2 */
/* bench 14537.0.4 215ba6c80024 */
/* bench 14537.0.5 ee477af398aa */
/* bench 14537.0.6 a215d6952b69 */
/* bench 14537.0.7 06b07e81ba9a */
/* bench 14537.0.8 8aab9d6c933f */
/* bench 14537.0.9 d4f3b0463528 */
/* bench 14537.0.10 98481be2db84 */
/* bench 14537.0.11 1a5d0485eca6 */
/* bench 14537.0.12 99ed0a52c3c4 */
/* bench 12940.0.3 5800347ff1a1 */
/* bench 12940.0.4 f858114126bb */
/* bench 12940.0.5 4e472e31baf1 */
/* bench 12940.0.6 6b6f69fa2d72 */
/* bench 12940.0.7 c12d97ec4dfa */
/* bench 12940.0.8 9ece32cef904 */
/* bench 12940.0.9 f4e7e9d2d0f8 */
/* bench 12940.0.10 670c156d6d9b */
/* bench 12940.0.11 a8847293fcfb */
```

## Documentation/devicetree/bindings/soc/amlogic/amlogic,canvas.yaml
```yaml
FASTVC-BENCH-CORPUS:linux-main-100k-v1-e0bd41dc-8e12-4f1b-978d-a3645ae59da0
# SPDX-License-Identifier: (GPL-2.0 OR BSD-2-Clause)
# Copyright 2019 BayLibre, SAS
%YAML 1.2
---
$id: "http://devicetree.org/schemas/soc/amlogic/amlogic,canvas.yaml#"
$schema: "http://devicetree.org/meta-schemas/core.yaml#"

title: Amlogic Canvas Video Lookup Table

maintainers:
  - Neil Armstrong <narmstrong@baylibre.com>
/* bench 19485.0.0 c7fb0acdb8f8 */
/* bench 19485.0.1 44bee71abf81 */
/* bench 19485.0.2 67f45652d0e3 */
/* bench 19485.0.3 8e49b4ed584a */
/* bench 19485.0.4 24e655010237 */
/* bench 19485.0.5 b994759a5e16 */
  A canvas is a collection of metadata that describes a pixel buffer.
  Those metadata include: width, height, phyaddr, wrapping and block mode.
  Starting with GXBB the endianness can also be described.

  Many IPs within Amlogic SoCs rely on canvas indexes to read/write pixel data
  rather than use the phy addresses directly. For instance, this is the case for
  the video decoders and the display.

  Amlogic SoCs have 256 canvas.

properties:
  compatible:
    oneOf:
/* bench 7036.0.0 39bffaf16544 */
/* bench 7036.0.1 668138ad094b */
/* bench 7036.0.2 ff830875d46d */
/* bench 7036.0.3 34dd1e397a72 */
/* bench 7036.0.4 2d6a3b38872c */
/* bench 7036.0.5 f0051a0e9415 */
/* bench 7036.0.6 212a3cf99229 */
/* bench 7036.0.7 5a5fab599f3c */
/* bench 12475.0.0 84b785787695 */
/* bench 12475.0.1 a056f9fa9c6e */
/* bench 12475.0.2 950f3642be36 */
/* bench 12475.0.3 da645b2232db */
/* bench 12475.0.4 12416ef3585e */
/* bench 12475.0.5 6653c5c0ed75 */
/* bench 12475.0.6 3f4ee8195aec */
/* bench 12475.0.7 ae34486af2a7 */
/* bench 12475.0.8 df3c53c4347c */
/* bench 12475.0.9 19e08dd09157 */
/* bench 7036.0.8 1678cbc31780 */
/* bench 7036.0.9 0e36f21a246d */
/* bench 7036.0.10 5405fb20b609 */
/* bench 7036.0.11 fcc62a7e5fa2 */
/* bench 7036.0.12 7bb80420716d */
/* bench 7036.0.13 359e98294010 */
          - enum:
              - amlogic,meson8-canvas
              - amlogic,meson8b-canvas
              - amlogic,meson8m2-canvas
          - const: amlogic,canvas
      - const: amlogic,canvas # GXBB and newer SoCs
/* bench 127.0.0 e19c08d24f23 */
/* bench 127.0.1 baa5452de7b4 */
/* bench 30203.0.0 d2e83b27137a */
/* bench 30203.0.1 c493f2ff8d7b */
/* bench 30203.0.2 8afc89d29627 */
/* bench 30203.0.3 04065a7db246 */
/* bench 30203.0.4 dcb1e78bf379 */
/* bench 30203.0.5 736ab2cedc91 */
/* bench 30203.0.6 57aabb4cbe5a */
/* bench 30203.0.7 787c1ec2bd47 */
/* bench 30203.0.8 fdb21fc6f06f */
/* bench 30203.0.9 980d82e1d239 */
/* bench 30203.0.10 5f0ae2a305bd */
/* bench 30203.0.11 3620750eee0a */
/* bench 30203.0.12 610669ea8819 */
/* bench 127.0.3 f7b9b21ce704 */
/* bench 127.0.4 03954c572394 */
  reg:
    maxItems: 1

required:
  - compatible
  - reg

additionalProperties: false

examples:
  - |
    canvas: video-lut@48 {
        compatible = "amlogic,canvas";
        reg = <0x48 0x14>;
    };
```
