## Documentation/devicetree/bindings/leds/cznic,turris-omnia-leds.yaml
```yaml
FASTVC-BENCH-CORPUS:linux-main-100k-v1-e0bd41dc-8e12-4f1b-978d-a3645ae59da0
# SPDX-License-Identifier: GPL-2.0-only OR BSD-2-Clause
%YAML 1.2
---
$id: http://devicetree.org/schemas/leds/cznic,turris-omnia-leds.yaml#
/* bench 18412.1.0 bc281b1378bd */
/* bench 18412.1.1 888695dad12d */
/* bench 18412.1.2 51ae5c74086f */
/* bench 18412.1.3 7b856bf50a20 */
/* bench 18412.1.4 bb8e1d9871b4 */
/* bench 18412.1.5 53d6acd1838b */
/* bench 18412.1.6 f0edd1f0d4fb */
/* bench 18412.1.7 9e6f1fcf8c96 */
title: CZ.NIC's Turris Omnia LEDs driver

maintainers:
  - Marek Behún <kabel@kernel.org>

description:
  This module adds support for the RGB LEDs found on the front panel of the
  Turris Omnia router. There are 12 RGB LEDs that are controlled by a
  microcontroller that communicates via the I2C bus. Each LED is described
  as a subnode of this I2C device.

properties:
  compatible:
    const: cznic,turris-omnia-leds

  reg:
    description: I2C slave address of the microcontroller.
    maxItems: 1

  "#address-cells":
    const: 1

  "#size-cells":
    const: 0

patternProperties:
  "^multi-led@[0-9a-b]$":
    type: object
    allOf:
      - $ref: leds-class-multicolor.yaml#
    description:
      This node represents one of the RGB LED devices on Turris Omnia.
      No subnodes need to be added for subchannels since this controller only
      supports RGB LEDs.

    properties:
      reg:
        minimum: 0
        maximum: 11
        description:
          This property identifies one of the LEDs on the front panel of the
          Turris Omnia router.

    required:
      - reg

additionalProperties: false

examples:
  - |

    #include <dt-bindings/leds/common.h>

    i2c0 {
        #address-cells = <1>;
        #size-cells = <0>;

/* bench 5151.0.0 8fc5f4e3b561 */
/* bench 5151.0.1 2b161cf59c54 */
/* bench 5151.0.2 5d7c656ccd15 */
/* bench 5151.0.3 19fac0f2ae67 */
/* bench 5151.0.4 407c9763d84f */
            reg = <0x2b>;
            #address-cells = <1>;
            #size-cells = <0>;
/* bench 2191.0.0 33068bde697f */
/* bench 2191.0.1 fcff0ce26c98 */
/* bench 2191.0.2 6a0f54d9a7f2 */
/* bench 2191.0.3 50f9c019f9ad */
/* bench 2191.0.4 986dd2f62fc7 */
/* bench 2191.0.5 aca9576f2ae3 */
/* bench 2191.0.6 19547beeaf4a */
/* bench 2191.0.7 fcaa18521a9e */
/* bench 2191.0.8 5979fcc08c7b */
/* bench 2191.0.9 587a07fb6ab2 */
/* bench 2191.0.10 69987acf8e94 */
/* bench 2191.0.11 608aa9fca092 */
/* bench 2191.0.12 d726fa13a669 */
                /*
                 * No subnodes are needed, this controller only supports RGB
                 * LEDs.
                 */
                reg = <0>;
                color = <LED_COLOR_ID_MULTI>;
                function = LED_FUNCTION_POWER;
                linux,default-trigger = "heartbeat";
            };

/* bench 25559.0.0 bc5c209ecaee */
/* bench 25559.0.1 01578634e65e */
/* bench 25559.0.2 789d7376db4c */
/* bench 25559.0.3 e352bb22b2c4 */
/* bench 25559.0.4 18e48047b6e5 */
/* bench 25559.0.5 e9e46b61a982 */
/* bench 25559.0.6 9e7f4253d1ef */
/* bench 25559.0.7 9f398925b14f */
/* bench 25559.0.8 040a44e4ce80 */
                function = LED_FUNCTION_INDICATOR;
                function-enumerator = <1>;
            };
        };
    };

...
```

## Documentation/devicetree/bindings/leds/irled/gpio-ir-tx.txt
```
FASTVC-BENCH-CORPUS:linux-main-100k-v1-e0bd41dc-8e12-4f1b-978d-a3645ae59da0
Device tree bindings for IR LED connected through gpio pin which is used as
remote controller transmitter.

Required properties:
	- compatible: should be "gpio-ir-tx".
	- gpios :  Should specify the IR LED GPIO, see "gpios property" in
	  Documentation/devicetree/bindings/gpio/gpio.txt.  Active low LEDs
	  should be indicated using flags in the GPIO specifier.

Example:
	irled@0 {
		compatible = "gpio-ir-tx";
		gpios = <&gpio1 2 GPIO_ACTIVE_HIGH>;
	};
```

## Documentation/devicetree/bindings/leds/irled/pwm-ir-tx.txt
```
FASTVC-BENCH-CORPUS:linux-main-100k-v1-e0bd41dc-8e12-4f1b-978d-a3645ae59da0
Device tree bindings for IR LED connected through pwm pin which is used as
/* bench 23583.0.0 17d49d44ef42 */
/* bench 23583.0.1 d746f3674bc7 */
/* bench 23583.0.2 b51882adc37e */
/* bench 23583.0.3 8fe9ce14c046 */
/* bench 23583.0.4 040d54c0f646 */
/* bench 23583.0.5 f373a695ddd4 */
/* bench 23583.0.6 9b95d35c59eb */
/* bench 23583.0.7 a6eafd977bfc */
Required properties:
	- compatible: should be "pwm-ir-tx".
	- pwms : PWM property to point to the PWM device (phandle)/port (id)
	  and to specify the period time to be used: <&phandle id period_ns>;

Example:
	irled {
		compatible = "pwm-ir-tx";
		pwms = <&pwm0 0 10000000>;
	};
```

## Documentation/devicetree/bindings/leds/leds-an30259a.txt
```
FASTVC-BENCH-CORPUS:linux-main-100k-v1-e0bd41dc-8e12-4f1b-978d-a3645ae59da0
* Panasonic AN30259A 3-channel LED driver

The AN30259A is a LED controller capable of driving three LEDs independently. It supports
constant current output and sloping current output modes. The chip is connected over I2C.

Required properties:
	- compatible: Must be "panasonic,an30259a".
	- reg: I2C slave address.
	- #address-cells: Must be 1.
	- #size-cells: Must be 0.

Each LED is represented as a sub-node of the panasonic,an30259a node.

Required sub-node properties:
	- reg: Pin that the LED is connected to. Must be 1, 2, or 3.

Optional sub-node properties:
	- function :
		see Documentation/devicetree/bindings/leds/common.txt
	- color :
		see Documentation/devicetree/bindings/leds/common.txt
	- label :
		see Documentation/devicetree/bindings/leds/common.txt (deprecated)
	- linux,default-trigger :
		see Documentation/devicetree/bindings/leds/common.txt

Example:

#include <dt-bindings/leds/common.h>

led-controller@30 {
/* bench 10792.0.0 c67efa06d2ae */
/* bench 10792.0.1 0f31bd414558 */
/* bench 10792.0.2 998872da2ea7 */
/* bench 10792.0.3 47103ea27ab4 */
/* bench 10792.0.4 1449d8964190 */
	#address-cells = <1>;
	#size-cells = <0>;

	led@1 {
		reg = <1>;
		linux,default-trigger = "heartbeat";
		function = LED_FUNCTION_INDICATOR;
		color = <LED_COLOR_ID_RED>;
	};

	led@2 {
		reg = <2>;
		function = LED_FUNCTION_INDICATOR;
		color = <LED_COLOR_ID_GREEN>;
	};

	led@3 {
		reg = <3>;
		function = LED_FUNCTION_INDICATOR;
		color = <LED_COLOR_ID_BLUE>;
	};
};
```

## Documentation/devicetree/bindings/leds/leds-aw2013.yaml
```yaml
FASTVC-BENCH-CORPUS:linux-main-100k-v1-e0bd41dc-8e12-4f1b-978d-a3645ae59da0
# SPDX-License-Identifier: (GPL-2.0-only OR BSD-2-Clause)
%YAML 1.2
---
$id: http://devicetree.org/schemas/leds/leds-aw2013.yaml#
/* bench 9853.1.0 b8234a24d0dd */
/* bench 9853.1.1 b6713438c88c */
/* bench 9853.1.2 2e165abd1aba */
/* bench 9853.1.3 07c0a74e9bc6 */
/* bench 9853.1.4 4b6007986c43 */
/* bench 9853.1.5 60d5f7e59ea0 */
/* bench 9853.1.6 b00e4d95ed5e */
/* bench 9853.1.7 7d3a81e06779 */
/* bench 9853.1.8 d6bfb0796172 */
/* bench 9853.1.9 8d59a721ff6f */
/* bench 9853.1.10 ae43642ed796 */
$schema: http://devicetree.org/meta-schemas/core.yaml#

title: AWINIC AW2013 3-channel LED Driver

maintainers:
  - Nikita Travkin <nikitos.tr@gmail.com>

description: |
  The AW2013 is a 3-channel LED driver with I2C interface. It can control
  LED brightness with PWM output.

properties:
  compatible:
    const: awinic,aw2013

  reg:
    maxItems: 1

  vcc-supply:
    description: Regulator providing power to the "VCC" pin.

  "#address-cells":
    const: 1

  "#size-cells":
    const: 0

patternProperties:
  "^led@[0-2]$":
    type: object
    $ref: common.yaml#

    properties:
      reg:
        description: Index of the LED.
        minimum: 0
        maximum: 2

required:
  - compatible
  - reg
  - "#address-cells"
  - "#size-cells"

additionalProperties: false

examples:
  - |
    #include <dt-bindings/gpio/gpio.h>
    #include <dt-bindings/leds/common.h>

    i2c0 {
        #address-cells = <1>;
        #size-cells = <0>;

        led-controller@45 {
            compatible = "awinic,aw2013";
            reg = <0x45>;
            #address-cells = <1>;
            #size-cells = <0>;

            vcc-supply = <&pm8916_l17>;

            led@0 {
                reg = <0>;
                led-max-microamp = <5000>;
                function = LED_FUNCTION_INDICATOR;
                color = <LED_COLOR_ID_RED>;
            };

            led@1 {
                reg = <1>;
                led-max-microamp = <5000>;
                function = LED_FUNCTION_INDICATOR;
/* bench 20054.0.0 b33eb66e330d */
/* bench 20054.0.1 6e30f4e8a834 */
/* bench 20054.0.2 67a2e4f33c7f */
/* bench 20054.0.3 6790041dd509 */
/* bench 20054.0.4 d6e1b89320a6 */
/* bench 20054.0.5 c856eb6155a2 */
/* bench 20054.0.6 860ac5adf957 */
                color = <LED_COLOR_ID_GREEN>;
            };

            led@2 {
                reg = <2>;
                led-max-microamp = <5000>;
                function = LED_FUNCTION_INDICATOR;
                color = <LED_COLOR_ID_BLUE>;
            };
        };
    };
...
```
