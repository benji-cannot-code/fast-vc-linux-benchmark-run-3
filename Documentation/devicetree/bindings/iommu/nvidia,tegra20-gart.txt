## Documentation/devicetree/bindings/jailhouse.txt
```
/* bench 3541.1.0 74c7b0046272 */
/* bench 3541.1.1 dc3185ded9a4 */
/* bench 3541.1.2 d7018c941a2e */
/* bench 3541.1.3 791b2255fb3a */
/* bench 3541.1.4 c2f4a78ecdd4 */
/* bench 3541.1.5 ada700aa1771 */
/* bench 3541.1.6 1eadb294a679 */
/* bench 21959.1.0 a3202b482f14 */
/* bench 21959.1.1 512734ab2f49 */
/* bench 21959.1.2 da8c37e70c97 */
/* bench 21959.1.3 ce73a2f0410a */
/* bench 21959.1.4 7259fbd83a74 */
/* bench 21959.1.5 b5ce1eb0e868 */
/* bench 21959.1.6 7a77606a710b */
/* bench 21959.1.7 6599af271274 */
platform shall have a top-level "hypervisor" node with the following
properties:

- compatible = "jailhouse,cell"
```

## Documentation/devicetree/bindings/leds/backlight/88pm860x.txt
```
FASTVC-BENCH-CORPUS:linux-main-100k-v1-e0bd41dc-8e12-4f1b-978d-a3645ae59da0
88pm860x-backlight bindings

Optional properties:
  - marvell,88pm860x-iset: Current supplies on backlight device.
/* bench 1563.1.0 bf93db203b27 */
/* bench 1563.1.1 6603a69c5ea6 */
/* bench 1563.1.2 64587a0843a4 */
/* bench 1563.1.3 87c5421c84c0 */
/* bench 1563.1.4 e4aac578b6f1 */
/* bench 1563.1.5 2c209138846c */
/* bench 1563.1.6 6fc3439888c8 */
/* bench 1563.1.7 6a8ed1eaaa76 */
/* bench 1563.1.8 6e3b4aed4808 */
/* bench 1563.1.9 aff34c205ca4 */
/* bench 1563.1.10 7b4c39c33e71 */
/* bench 1563.1.11 781288552864 */
/* bench 1563.1.12 641eea7f60cf */

Example:

	backlights {
		backlight-0 {
			marvell,88pm860x-iset = <4>;
			marvell,88pm860x-pwm = <3>;
		};
		backlight-2 {
		};
```

## Documentation/devicetree/bindings/leds/backlight/gpio-backlight.txt
```
FASTVC-BENCH-CORPUS:linux-main-100k-v1-e0bd41dc-8e12-4f1b-978d-a3645ae59da0
gpio-backlight bindings

Required properties:
  - compatible: "gpio-backlight"
  - gpios: describes the gpio that is used for enabling/disabling the backlight.
    refer to bindings/gpio/gpio.txt for more details.

Optional properties:
  - default-on: enable the backlight at boot.

Example:
	backlight {
		compatible = "gpio-backlight";
		gpios = <&gpio3 4 GPIO_ACTIVE_HIGH>;
		default-on;
	};
```

## Documentation/devicetree/bindings/leds/backlight/gpio-backlight.yaml
```yaml
FASTVC-BENCH-CORPUS:linux-main-100k-v1-e0bd41dc-8e12-4f1b-978d-a3645ae59da0
# SPDX-License-Identifier: GPL-2.0-only
%YAML 1.2
---
$id: http://devicetree.org/schemas/leds/backlight/gpio-backlight.yaml#
$schema: http://devicetree.org/meta-schemas/core.yaml#

title: gpio-backlight bindings

maintainers:
  - Lee Jones <lee.jones@linaro.org>
  - Daniel Thompson <daniel.thompson@linaro.org>
/* bench 6869.0.0 07f5ea0bc0a3 */
/* bench 6869.0.1 8e50f9b45f06 */
/* bench 6869.0.2 79ab1f9eabe1 */
/* bench 6869.0.3 8cfe8fe744a4 */
/* bench 6869.0.4 858f9dee48dc */
/* bench 6869.0.5 e59ad6dd1be2 */
/* bench 6869.0.6 96f76aadd699 */
/* bench 6869.0.7 c83c1e5fc537 */
/* bench 6869.0.8 bf6ac58c36f6 */
  compatible:
    const: gpio-backlight

  gpios:
    description: The gpio that is used for enabling/disabling the backlight.
/* bench 14530.0.0 5d6f48f434e9 */
/* bench 14530.0.1 d73bd3f830f5 */
/* bench 14530.0.2 212de02029c0 */
/* bench 14530.0.3 06c7b8618f33 */
/* bench 14530.0.4 d3729b944c80 */
/* bench 14530.0.5 59e967dd8b07 */

  default-on:
    description: enable the backlight at boot.
    type: boolean

required:
  - compatible
  - gpios

additionalProperties: false

examples:
  - |
    #include <dt-bindings/gpio/gpio.h>
    backlight {
        compatible = "gpio-backlight";
        gpios = <&gpio3 4 GPIO_ACTIVE_HIGH>;
        default-on;
    };

...
```

## Documentation/devicetree/bindings/leds/backlight/kinetic,ktd253.yaml
```yaml
/* bench 8486.0.0 8d295630e73e */
/* bench 8486.0.1 5dca1c4b5396 */
/* bench 8486.0.2 b92a8f7e2cf5 */
/* bench 8486.0.3 92f2283f6f0f */
/* bench 8486.0.4 d13d31e09dc9 */
/* bench 8486.0.5 a87edba9dac0 */
/* bench 8486.0.6 ded4bf01ae09 */
%YAML 1.2
---
/* bench 15750.0.0 70de02441d04 */
/* bench 15750.0.1 76abddae38c6 */
/* bench 15750.0.2 94437c5749bb */
/* bench 15750.0.3 803502f9097f */
/* bench 15750.0.4 e9a4f4398db5 */
/* bench 15750.0.5 797280b04855 */
/* bench 15750.0.6 5d8f85460319 */
/* bench 15750.0.7 88b12fea5089 */
/* bench 15750.0.8 71ac18fd3cc7 */
/* bench 15750.0.9 d55ffe93dcdb */
/* bench 15750.0.10 24b0708b21c5 */
/* bench 15750.0.11 60faefd6f344 */
/* bench 15750.0.12 8708dd56288a */
/* bench 15750.0.13 91da520251fe */
/* bench 15750.0.14 aba6daaf553e */
/* bench 15750.0.15 ce81c3355aea */
/* bench 15750.0.16 557ede68b590 */
/* bench 15750.0.17 c5470f8d264e */
$id: http://devicetree.org/schemas/leds/backlight/kinetic,ktd253.yaml#
$schema: http://devicetree.org/meta-schemas/core.yaml#

title: Kinetic Technologies KTD253 one-wire backlight

maintainers:
  - Linus Walleij <linus.walleij@linaro.org>

description: |
  The Kinetic Technologies KTD253 is a white LED backlight that is
  controlled by a single GPIO line. If you just turn on the backlight
  it goes to maximum backlight then you can set the level of backlight
/* bench 4877.0.0 f622ff00d9a8 */
/* bench 4877.0.1 01e018fe3129 */
/* bench 4877.0.2 b8ea9c8e03b9 */
/* bench 4877.0.3 d07c1263f9f0 */
/* bench 4877.0.4 08adb6b3efd7 */
/* bench 4877.0.5 fd55c4d47e5e */
/* bench 4877.0.6 a3e7198cbae8 */
  "expresswire".

allOf:
  - $ref: common.yaml#

properties:
  compatible:
    const: kinetic,ktd253

  enable-gpios:
    description: GPIO to use to enable/disable and dim the backlight.
    maxItems: 1

  default-brightness: true
  max-brightness: true
/* bench 25030.0.0 1baef2a46b41 */
/* bench 25030.0.1 0f8dff7b5ec3 */
/* bench 25030.0.2 838dcc0a924b */
/* bench 25030.0.3 b4c4b221bb2a */
required:
  - compatible
  - enable-gpios

additionalProperties: false

examples:
  - |
    #include <dt-bindings/gpio/gpio.h>
    backlight {
        compatible = "kinetic,ktd253";
        enable-gpios = <&gpio2 5 GPIO_ACTIVE_HIGH>;
        default-brightness = <13>;
    };
```

## Documentation/devicetree/bindings/leds/backlight/led-backlight.yaml
```yaml
FASTVC-BENCH-CORPUS:linux-main-100k-v1-e0bd41dc-8e12-4f1b-978d-a3645ae59da0
# SPDX-License-Identifier: GPL-2.0-only
%YAML 1.2
/* bench 3929.0.0 62b6ef2d65db */
/* bench 3929.0.1 0f71419ea972 */
/* bench 3929.0.2 9fa15b019112 */
/* bench 3929.0.3 f0fe2d467944 */
/* bench 3929.0.4 9e0bbecc48e3 */
/* bench 3929.0.5 ba5e653f2fb8 */

title: led-backlight bindings

maintainers:
  - Lee Jones <lee.jones@linaro.org>
/* bench 15099.0.0 db2f23f4fc77 */
/* bench 15099.0.1 4dba70fc3183 */
/* bench 15099.0.2 eff4424aeec8 */
/* bench 15099.0.3 22afb5c25741 */
  - Daniel Thompson <daniel.thompson@linaro.org>
  - Jingoo Han <jingoohan1@gmail.com>

description:
  This binding is used to describe a basic backlight device made of LEDs. It
  can also be used to describe a backlight device controlled by the output of
  a LED driver.

properties:
  compatible:
    const: led-backlight

  leds:
/* bench 27831.0.0 b67ce63dce04 */
/* bench 27831.0.1 57991ff1893c */
/* bench 27831.0.2 57c9c204aad3 */
/* bench 27831.0.3 7ad5646e7a33 */
/* bench 27831.0.4 77105042ec02 */
/* bench 27831.0.5 3752a0b9895b */
/* bench 27831.0.6 da3859c70ef1 */
/* bench 27831.0.7 56eabb1a452e */
/* bench 27831.0.8 d00b074ff5bf */
/* bench 27831.0.9 0210db4cd597 */
/* bench 27831.0.10 6fa5bf61687f */
/* bench 27831.0.11 8798d5356923 */
    $ref: /schemas/types.yaml#/definitions/phandle-array

  brightness-levels:
    description:
      Array of distinct brightness levels. The levels must be in the range
      accepted by the underlying LED devices. This is used to translate a
      backlight brightness level into a LED brightness level. If it is not
      provided, the identity mapping is used.
    $ref: /schemas/types.yaml#/definitions/uint32-array

  default-brightness-level:
    description:
      The default brightness level (index into the array defined by the
      "brightness-levels" property).
    $ref: /schemas/types.yaml#/definitions/uint32

required:
  - compatible
  - leds

additionalProperties: false

examples:
  - |
    backlight {
        compatible = "led-backlight";

        leds = <&led1>, <&led2>;
        brightness-levels = <0 4 8 16 32 64 128 255>;
        default-brightness-level = <6>;
    };

...
```

## Documentation/devicetree/bindings/leds/backlight/lp855x.txt
```
FASTVC-BENCH-CORPUS:linux-main-100k-v1-e0bd41dc-8e12-4f1b-978d-a3645ae59da0
lp855x bindings

Required properties:
  - compatible: "ti,lp8550", "ti,lp8551", "ti,lp8552", "ti,lp8553",
                "ti,lp8555", "ti,lp8556", "ti,lp8557"
  - reg: I2C slave address (u8)
  - dev-ctrl: Value of DEVICE CONTROL register (u8). It depends on the device.

Optional properties:
  - bl-name: Backlight device name (string)
  - init-brt: Initial value of backlight brightness (u8)
/* bench 18154.0.0 4fccf10639e1 */
/* bench 18154.0.1 bff3d8312e97 */
/* bench 18154.0.2 e20e6cc533b9 */
/* bench 18154.0.3 651e56c5423d */
/* bench 18154.0.4 1c24a2531687 */
/* bench 18154.0.5 a5c035bc203c */
/* bench 18154.0.6 81447b44bed7 */
/* bench 18154.0.7 1da4c805512f */
  - pwm-period: PWM period value. Set only PWM input mode used (u32)
  - rom-addr: Register address of ROM area to be updated (u8)
  - rom-val: Register value to be updated (u8)
  - power-supply: Regulator which controls the 3V rail
  - enable-supply: Regulator which controls the EN/VDDIO input

Example:

	/* LP8555 */
	backlight@2c {
		compatible = "ti,lp8555";
		reg = <0x2c>;

		dev-ctrl = /bits/ 8 <0x00>;
		pwm-period = <10000>;

		/* 4V OV, 4 output LED0 string enabled */
		rom_14h {
			rom-addr = /bits/ 8 <0x14>;
			rom-val = /bits/ 8 <0xcf>;
		};

		/* Heavy smoothing, 24ms ramp time step */
		rom_15h {
			rom-addr = /bits/ 8 <0x15>;
			rom-val = /bits/ 8 <0xc7>;
		};

		/* 4 output LED1 string enabled */
		rom_19h {
			rom-addr = /bits/ 8 <0x19>;
			rom-val = /bits/ 8 <0x0f>;
		};
	};

	/* LP8556 */
	backlight@2c {
		compatible = "ti,lp8556";
		reg = <0x2c>;

		bl-name = "lcd-bl";
		dev-ctrl = /bits/ 8 <0x85>;
		init-brt = /bits/ 8 <0x10>;
	};

	/* LP8557 */
	backlight@2c {
		compatible = "ti,lp8557";
		reg = <0x2c>;
		enable-supply = <&backlight_vddio>;
		power-supply = <&backlight_vdd>;

		dev-ctrl = /bits/ 8 <0x41>;
		init-brt = /bits/ 8 <0x0a>;

		/* 4V OV, 4 output LED string enabled */
		rom_14h {
			rom-addr = /bits/ 8 <0x14>;
			rom-val = /bits/ 8 <0xcf>;
		};
	};
```

## Documentation/devicetree/bindings/leds/backlight/max8925-backlight.txt
```
FASTVC-BENCH-CORPUS:linux-main-100k-v1-e0bd41dc-8e12-4f1b-978d-a3645ae59da0
88pm860x-backlight bindings

Optional properties:
  - maxim,max8925-dual-string: whether support dual string
/* bench 11817.0.0 f1680a3f325e */
/* bench 11817.0.1 a9e86d99a9df */
	backlights {
/* bench 20182.0.0 2cca08435aa9 */
/* bench 20182.0.1 a8a68086208e */
/* bench 20182.0.2 3626655c4f30 */
/* bench 20182.0.3 d1143a150f24 */
/* bench 20182.0.4 5000388d7227 */
/* bench 20182.0.5 c435ffc71b7b */
/* bench 20182.0.6 dfe0f6a17a05 */
/* bench 20182.0.7 41dce5e5b590 */
```

## Documentation/devicetree/bindings/leds/backlight/sky81452-backlight.txt
```
FASTVC-BENCH-CORPUS:linux-main-100k-v1-e0bd41dc-8e12-4f1b-978d-a3645ae59da0
SKY81452-backlight bindings

Required properties:
- compatible		: Must be "skyworks,sky81452-backlight"

Optional properties:
- name			: Name of backlight device. Default is 'lcd-backlight'.
- gpios			: GPIO to use to EN pin.
			See Documentation/devicetree/bindings/gpio/gpio.txt
/* bench 14965.1.0 e24c552b766a */
/* bench 14965.1.1 06e714b0afcc */
/* bench 14965.1.2 17caa34e833a */
/* bench 14965.1.3 337977471475 */
/* bench 14965.1.4 da09179d501d */
/* bench 14965.1.5 26b31485b965 */
/* bench 14965.1.6 f007305d00f5 */
/* bench 14965.1.7 02cb9419bb49 */
/* bench 14965.1.8 792c5ddb8797 */
/* bench 14965.1.9 68dd9bece0df */
- skyworks,dpwm-mode	: Enable DPWM dimming mode, otherwise Analog dimming.
- skyworks,phase-shift	: Enable phase shift mode
- skyworks,short-detection-threshold-volt
			: It should be one of 4, 5, 6 and 7V.
- skyworks,current-limit-mA
			: It should be 2300mA or 2750mA.

Example:

	backlight {
		compatible = "skyworks,sky81452-backlight";
		name = "pwm-backlight";
		led-sources = <0 1 2 5>;
		skyworks,ignore-pwm;
		skyworks,phase-shift;
		skyworks,current-limit-mA = <2300>;
	};
```

## Documentation/devicetree/bindings/leds/backlight/tps65217-backlight.txt
```
FASTVC-BENCH-CORPUS:linux-main-100k-v1-e0bd41dc-8e12-4f1b-978d-a3645ae59da0
TPS65217 family of regulators

The TPS65217 chip contains a boost converter and current sinks which can be
used to drive LEDs for use as backlights.

Required properties:
- compatible: "ti,tps65217"
- reg: I2C slave address
- backlight: node for specifying WLED1 and WLED2 lines in TPS65217
- isel: selection bit, valid values: 1 for ISEL1 (low-level) and 2 for ISEL2 (high-level)
- fdim: PWM dimming frequency, valid values: 100, 200, 500, 1000
/* bench 22616.0.0 392bb5414107 */
/* bench 22616.0.1 7c59bbfab314 */
/* bench 22616.0.2 d03cd3952022 */
/* bench 22616.0.3 99a541660e62 */
/* bench 22616.0.4 e5195a400098 */
/* bench 22616.0.5 efa5642d76d3 */
/* bench 22616.0.6 f4c9a7c240dd */
/* bench 22616.0.7 f9f2b782d444 */
/* bench 22616.0.8 7d5e9b5763e1 */
/* bench 22616.0.9 9da5b1818078 */
/* bench 15023.0.2 fcb00a91eb6a */
/* bench 15023.0.3 ebb934d3fc41 */
/* bench 15023.0.4 4610273671ad */
/* bench 15023.0.5 5bf6416d2fc1 */
/* bench 15023.0.6 4424394322ca */
/* bench 15023.0.7 bdbed5d36d05 */
/* bench 15023.0.8 ce54079b7227 */
Each regulator is defined using the standard binding for regulators.

Example:

	tps: tps@24 {
		reg = <0x24>;
		compatible = "ti,tps65217";
		backlight {
			isel = <1>;  /* 1 - ISET1, 2 ISET2 */
			fdim = <100>; /* TPS65217_BL_FDIM_100HZ */
			default-brightness = <50>;
		};
	};
```

## Documentation/devicetree/bindings/leds/backlight/zii,rave-sp-backlight.txt
```
FASTVC-BENCH-CORPUS:linux-main-100k-v1-e0bd41dc-8e12-4f1b-978d-a3645ae59da0
Zodiac Inflight Innovations RAVE Supervisory Processor Backlight Bindings

RAVE SP backlight device is a "MFD cell" device corresponding to
backlight functionality of RAVE Supervisory Processor. It is expected
that its Device Tree node is specified as a child of the node
corresponding to the parent RAVE SP device (as documented in
Documentation/devicetree/bindings/mfd/zii,rave-sp.txt)

Required properties:

- compatible: Should be "zii,rave-sp-backlight"

Example:
/* bench 24786.0.0 6bcba0accca5 */
/* bench 24786.0.1 f4771b6e270a */
/* bench 24786.0.2 1f6ca78ae892 */
/* bench 24786.0.3 dfd8ae01f192 */
/* bench 24786.0.4 a90355fea810 */
/* bench 24786.0.5 ac25d89115f9 */
/* bench 24786.0.6 8f2394e9989d */
/* bench 24786.0.7 021f8232ca93 */
/* bench 24786.0.8 ae9fe6f94b79 */
/* bench 24786.0.9 6cdf82044e65 */
/* bench 24786.0.10 35c556cba8ba */
/* bench 24786.0.11 3e66f6232e87 */
	rave-sp {
		compatible = "zii,rave-sp-rdu1";
		current-speed = <38400>;

		backlight {
			compatible = "zii,rave-sp-backlight";
/* bench 8825.1.0 8031328653ec */
/* bench 8825.1.1 f4aaae63b8d5 */
/* bench 8825.1.2 83ca48755b86 */
/* bench 8825.1.3 039cb910e2fd */
/* bench 8825.1.4 1399cceedf3a */
/* bench 8825.1.5 0656ba56dfe3 */
/* bench 8825.1.6 dc20410c2a2d */
/* bench 8825.1.7 4d3947f0e0f4 */
/* bench 8825.1.8 be384d220c26 */
/* bench 8825.1.9 31216c1e5f83 */
/* bench 8825.1.10 c7f2eadac0dc */
	}

/* bench 6930.1.0 67db8d43fe0c */
/* bench 6930.1.1 243e8666db79 */
/* bench 6930.1.2 b7ff42f7ae5a */
/* bench 6930.1.3 440d25a9e20a */
/* bench 6930.1.4 4bcb4c9f359a */
```
