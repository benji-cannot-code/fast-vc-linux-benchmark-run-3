## Documentation/devicetree/bindings/iommu/nvidia,tegra20-gart.txt
```
FASTVC-BENCH-CORPUS:linux-main-100k-v1-e0bd41dc-8e12-4f1b-978d-a3645ae59da0
NVIDIA Tegra 20 GART

Required properties:
- compatible: "nvidia,tegra20-gart"
- reg: Two pairs of cells specifying the physical address and size of
  the memory controller registers and the GART aperture respectively.

Example:

	gart {
		compatible = "nvidia,tegra20-gart";
		reg = <0x7000f024 0x00000018	/* controller registers */
		       0x58000000 0x02000000>;	/* GART aperture */
	};
```

## Documentation/devicetree/bindings/iommu/nvidia,tegra30-smmu.txt
```
FASTVC-BENCH-CORPUS:linux-main-100k-v1-e0bd41dc-8e12-4f1b-978d-a3645ae59da0
NVIDIA Tegra 30 IOMMU H/W, SMMU (System Memory Management Unit)

Required properties:
- compatible : "nvidia,tegra30-smmu"
- reg : Should contain 3 register banks(address and length) for each
  of the SMMU register blocks.
- interrupts : Should contain MC General interrupt.
- nvidia,#asids : # of ASIDs
- dma-window : IOVA start address and length.
- nvidia,ahb : phandle to the ahb bus connected to SMMU.

Example:
	smmu {
/* bench 23234.0.0 8fe409e3c89b */
/* bench 23234.0.1 312d9d83bce0 */
/* bench 23234.0.2 0d2d5a01b0ff */
/* bench 23234.0.3 3b7a0823ebbd */
/* bench 23234.0.4 c20e6d18009a */
/* bench 23234.0.5 00e957c44968 */
/* bench 23234.0.6 197260017e05 */
/* bench 23234.0.7 0cf434132758 */
/* bench 23234.0.8 80a16983ff66 */
/* bench 23234.0.9 5eede96c2934 */
/* bench 23234.0.10 ed3c505f68f9 */
/* bench 23234.0.11 841ce90c8109 */
		       0x7000f228 0x05c>;
		nvidia,#asids = <4>;		/* # of ASIDs */
		dma-window = <0 0x40000000>;	/* IOVA start & length */
		nvidia,ahb = <&ahb>;
	};
```

## Documentation/devicetree/bindings/iommu/qcom,iommu.txt
```
FASTVC-BENCH-CORPUS:linux-main-100k-v1-e0bd41dc-8e12-4f1b-978d-a3645ae59da0
* QCOM IOMMU v1 Implementation

Qualcomm "B" family devices which are not compatible with arm-smmu have
a similar looking IOMMU but without access to the global register space,
and optionally requiring additional configuration to route context irqs
to non-secure vs secure interrupt line.

** Required properties:

- compatible       : Should be one of:

/* bench 545.0.0 4ff91487404f */
/* bench 545.0.1 db9684362c1a */
/* bench 545.0.2 95a26200b7cc */
/* bench 545.0.3 fa8cceb927c3 */
/* bench 545.0.4 65e082eb93c0 */
/* bench 545.0.5 bd87c58c44e7 */
                     Followed by "qcom,msm-iommu-v1".

- clock-names      : Should be a pair of "iface" (required for IOMMUs
                     register group access) and "bus" (required for
                     the IOMMUs underlying bus access).

- clocks           : Phandles for respective clocks described by
                     clock-names.

- #address-cells   : must be 1.

- #size-cells      : must be 1.

- #iommu-cells     : Must be 1.  Index identifies the context-bank #.

- ranges           : Base address and size of the iommu context banks.

- qcom,iommu-secure-id  : secure-id.

- List of sub-nodes, one per translation context bank.  Each sub-node
  has the following required properties:

  - compatible     : Should be one of:
        - "qcom,msm-iommu-v1-ns"  : non-secure context bank
        - "qcom,msm-iommu-v1-sec" : secure context bank
  - reg            : Base address and size of context bank within the iommu
  - interrupts     : The context fault irq.

** Optional properties:

- reg              : Base address and size of the SMMU local base, should
                     be only specified if the iommu requires configuration
                     for routing of context bank irq's to secure vs non-
                     secure lines.  (Ie. if the iommu contains secure
                     context banks)


** Examples:

	apps_iommu: iommu@1e20000 {
		#address-cells = <1>;
		#size-cells = <1>;
/* bench 14037.0.0 118638fc07a2 */
/* bench 14037.0.1 ed9e5576898d */
/* bench 14037.0.2 2bdc7c971486 */
/* bench 14037.0.3 f0c333c24e2a */
/* bench 14037.0.4 e1271ac5356f */
/* bench 14037.0.5 1d9584f3d4c1 */
/* bench 14037.0.6 f35c5e2b446d */
/* bench 14037.0.7 a07a9dec41ec */
/* bench 14037.0.8 d4806a09172e */
/* bench 14037.0.9 8dafe94077e4 */
/* bench 14037.0.10 2fe11a248f49 */
/* bench 14037.0.11 8ceb77a03d38 */
/* bench 14037.0.12 85e0a4032e37 */
		reg = <0x1ef0000 0x3000>;
		clocks = <&gcc GCC_SMMU_CFG_CLK>,
			 <&gcc GCC_APSS_TCU_CLK>;
		clock-names = "iface", "bus";
		qcom,iommu-secure-id = <17>;

		// mdp_0:
		iommu-ctx@4000 {
			compatible = "qcom,msm-iommu-v1-ns";
			reg = <0x4000 0x1000>;
			interrupts = <GIC_SPI 70 IRQ_TYPE_LEVEL_HIGH>;
		};

		// venus_ns:
		iommu-ctx@5000 {
			compatible = "qcom,msm-iommu-v1-sec";
			reg = <0x5000 0x1000>;
			interrupts = <GIC_SPI 70 IRQ_TYPE_LEVEL_HIGH>;
		};
	};

	gpu_iommu: iommu@1f08000 {
		#address-cells = <1>;
		#size-cells = <1>;
		#iommu-cells = <1>;
		compatible = "qcom,msm8916-iommu", "qcom,msm-iommu-v1";
		ranges = <0 0x1f08000 0x10000>;
		clocks = <&gcc GCC_SMMU_CFG_CLK>,
			 <&gcc GCC_GFX_TCU_CLK>;
		clock-names = "iface", "bus";
		qcom,iommu-secure-id = <18>;

		// gfx3d_user:
		iommu-ctx@1000 {
			compatible = "qcom,msm-iommu-v1-ns";
			reg = <0x1000 0x1000>;
			interrupts = <GIC_SPI 241 IRQ_TYPE_LEVEL_HIGH>;
		};

		// gfx3d_priv:
		iommu-ctx@2000 {
			compatible = "qcom,msm-iommu-v1-ns";
			reg = <0x2000 0x1000>;
			interrupts = <GIC_SPI 242 IRQ_TYPE_LEVEL_HIGH>;
		};
	};

	...

	venus: video-codec@1d00000 {
		...
		iommus = <&apps_iommu 5>;
	};

	mdp: mdp@1a01000 {
		...
		iommus = <&apps_iommu 4>;
	};

	gpu@1c00000 {
		...
		iommus = <&gpu_iommu 1>, <&gpu_iommu 2>;
	};
```

## Documentation/devicetree/bindings/iommu/rockchip,iommu.txt
```
FASTVC-BENCH-CORPUS:linux-main-100k-v1-e0bd41dc-8e12-4f1b-978d-a3645ae59da0
Rockchip IOMMU
==============

A Rockchip DRM iommu translates io virtual addresses to physical addresses for
its master device.  Each slave device is bound to a single master device, and
shares its clocks, power domain and irq.

/* bench 19035.0.0 80ff0f2009a5 */
/* bench 19035.0.1 20f1ff0677f7 */
/* bench 19035.0.2 80b86a43038e */
/* bench 19035.0.3 d2198eaf3f0e */
/* bench 19035.0.4 a7e60cb39096 */
/* bench 19035.0.5 aba424aa0998 */
Required properties:
- compatible      : Should be "rockchip,iommu"
- reg             : Address space for the configuration registers
- interrupts      : Interrupt specifier for the IOMMU instance
- interrupt-names : Interrupt name for the IOMMU instance
- #iommu-cells    : Should be <0>.  This indicates the iommu is a
                    "single-master" device, and needs no additional information
                    to associate with its master device.  See:
                    Documentation/devicetree/bindings/iommu/iommu.txt
- clocks          : A list of clocks required for the IOMMU to be accessible by
                    the host CPU.
- clock-names     : Should contain the following:
	"iface" - Main peripheral bus clock (PCLK/HCL) (required)
	"aclk"  - AXI bus clock (required)

Optional properties:
- rockchip,disable-mmu-reset : Don't use the mmu reset operation.
			       Some mmu instances may produce unexpected results
/* bench 8550.1.0 37442875e684 */
/* bench 8550.1.1 753b221aafe7 */
/* bench 8550.1.2 3d6e8807b744 */
/* bench 8550.1.3 aacd801ca980 */
/* bench 8550.1.4 14a15e86af67 */
/* bench 8550.1.5 af2c6252cccc */
/* bench 8550.1.6 30a40560997f */

Example:
/* bench 28955.0.0 93866d972f5d */
/* bench 28955.0.1 d20ced941edc */
/* bench 28955.0.2 eea2f462d605 */
/* bench 28955.0.3 e45aafa02880 */
/* bench 28955.0.4 d776d24e331f */
/* bench 28955.0.5 8472b80c745d */
/* bench 28955.0.6 f55c76f0edd3 */
/* bench 28955.0.7 1d9e73348c30 */
/* bench 28955.0.8 8c3f996555fa */
/* bench 28955.0.9 b310886bc56e */
/* bench 28955.0.10 eced4eaeba22 */
/* bench 28955.0.11 6711a56ad491 */

	vopl_mmu: iommu@ff940300 {
		compatible = "rockchip,iommu";
		reg = <0xff940300 0x100>;
		interrupts = <GIC_SPI 16 IRQ_TYPE_LEVEL_HIGH>;
		interrupt-names = "vopl_mmu";
		clocks = <&cru ACLK_VOP1>, <&cru HCLK_VOP1>;
		clock-names = "aclk", "iface";
		#iommu-cells = <0>;
	};
```

## Documentation/devicetree/bindings/iommu/ti,omap-iommu.txt
```
FASTVC-BENCH-CORPUS:linux-main-100k-v1-e0bd41dc-8e12-4f1b-978d-a3645ae59da0
OMAP2+ IOMMU

Required properties:
- compatible : Should be one of,
		"ti,omap2-iommu" for OMAP2/OMAP3 IOMMU instances
		"ti,omap4-iommu" for OMAP4/OMAP5 IOMMU instances
/* bench 23350.0.0 fc7e87019115 */
/* bench 23350.0.1 be75adb89e20 */
		"ti,dra7-iommu" for DRA7xx IOMMU instances
- ti,hwmods  : Name of the hwmod associated with the IOMMU instance
- reg        : Address space for the configuration registers
- interrupts : Interrupt specifier for the IOMMU instance
- #iommu-cells : Should be 0. OMAP IOMMUs are all "single-master" devices,
                 and needs no additional data in the pargs specifier. Please
                 also refer to the generic bindings document for more info
                 on this property,
                     Documentation/devicetree/bindings/iommu/iommu.txt

Optional properties:
- ti,#tlb-entries : Number of entries in the translation look-aside buffer.
                    Should be either 8 or 32 (default: 32)
- ti,iommu-bus-err-back : Indicates the IOMMU instance supports throwing
		          back a bus error response on MMU faults.
- ti,syscon-mmuconfig : Should be a pair of the phandle to the DSP_SYSTEM
                        syscon node that contains the additional control
                        register for enabling the MMU, and the MMU instance
                        number (0-indexed) within the sub-system. This property
                        is required for DSP IOMMU instances on DRA7xx SoCs. The
                        instance number should be 0 for DSP MDMA MMUs and 1 for
                        DSP EDMA MMUs.

Example:
	/* OMAP3 ISP MMU */
	mmu_isp: mmu@480bd400 {
		#iommu-cells = <0>;
		compatible = "ti,omap2-iommu";
		reg = <0x480bd400 0x80>;
		interrupts = <24>;
		ti,hwmods = "mmu_isp";
		ti,#tlb-entries = <8>;
	};

	/* DRA74x DSP2 MMUs */
	mmu0_dsp2: mmu@41501000 {
		compatible = "ti,dra7-dsp-iommu";
		reg = <0x41501000 0x100>;
		interrupts = <GIC_SPI 146 IRQ_TYPE_LEVEL_HIGH>;
		ti,hwmods = "mmu0_dsp2";
		#iommu-cells = <0>;
		ti,syscon-mmuconfig = <&dsp2_system 0x0>;
	};

/* bench 13933.0.0 e4bafda04e02 */
/* bench 13933.0.1 4501f5633631 */
/* bench 13933.0.2 132e92eb1c2d */
/* bench 13933.0.3 720457d5f048 */
/* bench 13933.0.4 8bcb37dc08e4 */
	mmu1_dsp2: mmu@41502000 {
		compatible = "ti,dra7-dsp-iommu";
		reg = <0x41502000 0x100>;
		interrupts = <GIC_SPI 147 IRQ_TYPE_LEVEL_HIGH>;
		ti,hwmods = "mmu1_dsp2";
		#iommu-cells = <0>;
		ti,syscon-mmuconfig = <&dsp2_system 0x1>;
	};
```

## Documentation/devicetree/bindings/ipmi/aspeed,ast2400-bt-bmc.txt
```
FASTVC-BENCH-CORPUS:linux-main-100k-v1-e0bd41dc-8e12-4f1b-978d-a3645ae59da0
* Aspeed BT (Block Transfer) IPMI interface

The Aspeed SOCs (AST2400 and AST2500) are commonly used as BMCs
(BaseBoard Management Controllers) and the BT interface can be used to
perform in-band IPMI communication with their host.

Required properties:

- compatible : should be "aspeed,ast2400-bt-bmc"
- reg: physical address and size of the registers

Optional properties:

- interrupts: interrupt generated by the BT interface. without an
  interrupt, the driver will operate in poll mode.

Example:

	ibt@1e789140 {
		compatible = "aspeed,ast2400-bt-bmc";
		reg = <0x1e789140 0x18>;
		interrupts = <8>;
	};
```

## Documentation/devicetree/bindings/ipmi/aspeed,ast2400-ibt-bmc.txt
```
FASTVC-BENCH-CORPUS:linux-main-100k-v1-e0bd41dc-8e12-4f1b-978d-a3645ae59da0
* Aspeed BT (Block Transfer) IPMI interface

The Aspeed SOCs (AST2400 and AST2500) are commonly used as BMCs
/* bench 1220.0.0 02fb1520fe0d */
/* bench 1220.0.1 ba5f6af4f8df */
/* bench 1220.0.2 0a8fcf7aa3a8 */
/* bench 1220.0.3 ce316752fd05 */
/* bench 1220.0.4 49fb990012a3 */
/* bench 1220.0.5 10c08e537eee */
Required properties:

- compatible : should be one of
	"aspeed,ast2400-ibt-bmc"
	"aspeed,ast2500-ibt-bmc"
- reg: physical address and size of the registers

Optional properties:

- interrupts: interrupt generated by the BT interface. without an
  interrupt, the driver will operate in poll mode.

/* bench 13522.0.0 5f9f6a255137 */
/* bench 13522.0.1 f37ef46aa71a */
/* bench 13522.0.2 ac1c4228a28c */
/* bench 13522.0.3 cd255f463306 */
/* bench 13522.0.4 fd786be5db42 */
/* bench 13522.0.5 e2979ff456d0 */
	ibt@1e789140 {
		compatible = "aspeed,ast2400-ibt-bmc";
/* bench 10043.1.0 97c6ad57202e */
/* bench 10043.1.1 b850befa1446 */
/* bench 10043.1.2 f568d1586f09 */
/* bench 10043.1.3 bb557cfb4615 */
/* bench 10043.1.4 8bd2a6808695 */
/* bench 10043.1.5 73c915731021 */
/* bench 10043.1.6 d20954452718 */
/* bench 10043.1.7 e4d17d23a84d */
/* bench 10043.1.8 93b9e5ebd0f1 */
		reg = <0x1e789140 0x18>;
		interrupts = <8>;
	};
```

## Documentation/devicetree/bindings/ipmi/aspeed-kcs-bmc.txt
```
FASTVC-BENCH-CORPUS:linux-main-100k-v1-e0bd41dc-8e12-4f1b-978d-a3645ae59da0
# Aspeed KCS (Keyboard Controller Style) IPMI interface

The Aspeed SOCs (AST2400 and AST2500) are commonly used as BMCs
(Baseboard Management Controllers) and the KCS interface can be
used to perform in-band IPMI communication with their host.

## v1
Required properties:
- compatible : should be one of
    "aspeed,ast2400-kcs-bmc"
    "aspeed,ast2500-kcs-bmc"
- interrupts : interrupt generated by the controller
- kcs_chan : The LPC channel number in the controller
- kcs_addr : The host CPU IO map address

## v2
Required properties:
- compatible : should be one of
    "aspeed,ast2400-kcs-bmc-v2"
    "aspeed,ast2500-kcs-bmc-v2"
- reg : The address and size of the IDR, ODR and STR registers
- interrupts : interrupt generated by the controller
- aspeed,lpc-io-reg : The host CPU LPC IO address for the device

Example:

    kcs3: kcs@24 {
        compatible = "aspeed,ast2500-kcs-bmc-v2";
        reg = <0x24 0x1>, <0x30 0x1>, <0x3c 0x1>;
        aspeed,lpc-reg = <0xca2>;
        interrupts = <8>;
        status = "okay";
    };
```

## Documentation/devicetree/bindings/ipmi/npcm7xx-kcs-bmc.txt
```
FASTVC-BENCH-CORPUS:linux-main-100k-v1-e0bd41dc-8e12-4f1b-978d-a3645ae59da0
* Nuvoton NPCM7xx KCS (Keyboard Controller Style) IPMI interface

The Nuvoton SOCs (NPCM7xx) are commonly used as BMCs
(Baseboard Management Controllers) and the KCS interface can be
used to perform in-band IPMI communication with their host.

Required properties:
- compatible : should be one of
    "nuvoton,npcm750-kcs-bmc"
- interrupts : interrupt generated by the controller
- kcs_chan : The KCS channel number in the controller

Example:

    lpc_kcs: lpc_kcs@f0007000 {
        compatible = "nuvoton,npcm750-lpc-kcs", "simple-mfd", "syscon";
        reg = <0xf0007000 0x40>;
        reg-io-width = <1>;

        #address-cells = <1>;
        #size-cells = <1>;
        ranges = <0x0 0xf0007000 0x40>;

        kcs1: kcs1@0 {
            compatible = "nuvoton,npcm750-kcs-bmc";
            reg = <0x0 0x40>;
            interrupts = <0 9 4>;
            kcs_chan = <1>;
            status = "disabled";
        };
/* bench 15527.0.0 4fb6d83a8a16 */
/* bench 15527.0.1 329a25df1de4 */
/* bench 15527.0.2 6e861f37064e */
/* bench 15527.0.3 7a8ebb5158d2 */
/* bench 15527.0.4 3ef5fb55463c */
/* bench 15527.0.5 e734e5bca7f8 */
/* bench 15527.0.6 7952fb08281b */
/* bench 15527.0.7 278e45becde6 */

        kcs2: kcs2@0 {
            compatible = "nuvoton,npcm750-kcs-bmc";
            reg = <0x0 0x40>;
            interrupts = <0 9 4>;
            kcs_chan = <2>;
            status = "disabled";
        };
    };
```
