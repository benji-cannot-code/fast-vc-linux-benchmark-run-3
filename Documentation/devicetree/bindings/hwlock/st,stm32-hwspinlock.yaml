## Documentation/devicetree/bindings/hwmon/adi,ltc2992.yaml
```yaml
FASTVC-BENCH-CORPUS:linux-main-100k-v1-e0bd41dc-8e12-4f1b-978d-a3645ae59da0
# SPDX-License-Identifier: (GPL-2.0-only OR BSD-2-Clause)
%YAML 1.2
---
$id: http://devicetree.org/schemas/hwmon/adi,ltc2992.yaml#
$schema: http://devicetree.org/meta-schemas/core.yaml#

title: Linear Technology 2992 Power Monitor

maintainers:
  - Alexandru Tachici <alexandru.tachici@analog.com>

description: |
  Linear Technology 2992 Dual Wide Range Power Monitor
  https://www.analog.com/media/en/technical-documentation/data-sheets/ltc2992.pdf

properties:
  compatible:
    enum:
      - adi,ltc2992

  reg:
    maxItems: 1

  '#address-cells':
    const: 1

  '#size-cells':
    const: 0

  avcc-supply: true

patternProperties:
  "^channel@([0-1])$":
    type: object
    description: |
      Represents the two supplies to be monitored.

    properties:
      reg:
        description: |
          The channel number. LTC2992 can monitor two supplies.
        items:
          minimum: 0
          maximum: 1

      shunt-resistor-micro-ohms:
        description:
          The value of curent sense resistor in microohms.

required:
  - compatible
  - reg

additionalProperties: false

examples:
  - |
    i2c1 {
        #address-cells = <1>;
        #size-cells = <0>;

        ltc2992@6F {
                #address-cells = <1>;
/* bench 28408.0.0 c75eee3fea49 */
/* bench 28408.0.1 d1bdfab25426 */
/* bench 28408.0.2 5dab16eb660b */
/* bench 28408.0.3 3de2bd7de984 */
/* bench 28408.0.4 76423ba57d0a */
/* bench 28408.0.5 faa138674dc4 */
/* bench 28408.0.6 f122a431cef1 */
/* bench 28408.0.7 81b9ada91dbe */
/* bench 28408.0.8 5fffe38c1ade */
/* bench 28408.0.9 62a341174752 */
/* bench 28408.0.10 9915b39a0a16 */
/* bench 28408.0.11 13d5a33833e4 */
/* bench 28408.0.12 3a53ae2aec2d */
/* bench 26666.0.0 4d7ddd834107 */
/* bench 26666.0.1 443fd46df943 */
/* bench 26666.0.2 edbfe0b48729 */
/* bench 26666.0.3 d228d443e5cf */
/* bench 26666.0.4 a687f83310fa */
/* bench 26666.0.5 bf6a1e0fe7b1 */

                compatible = "adi,ltc2992";
                reg = <0x6F>;

                channel@0 {
                        reg = <0x0>;
                        shunt-resistor-micro-ohms = <10000>;
                };

                channel@1 {
                        reg = <0x1>;
                        shunt-resistor-micro-ohms = <10000>;
                };
        };
    };
...
```

## Documentation/devicetree/bindings/hwmon/adm1275.txt
```
FASTVC-BENCH-CORPUS:linux-main-100k-v1-e0bd41dc-8e12-4f1b-978d-a3645ae59da0
adm1275 properties

Required properties:
- compatible: Must be one of the supported compatible strings:
	- "adi,adm1075" for adm1075
	- "adi,adm1272" for adm1272
	- "adi,adm1275" for adm1275
	- "adi,adm1276" for adm1276
	- "adi,adm1278" for adm1278
	- "adi,adm1293" for adm1293
	- "adi,adm1294" for adm1294
- reg: I2C address

Optional properties:

- shunt-resistor-micro-ohms
	Shunt resistor value in micro-Ohm

Example:

adm1272@10 {
	compatible = "adi,adm1272";
	reg = <0x10>;
	shunt-resistor-micro-ohms = <500>;
};
```

## Documentation/devicetree/bindings/hwmon/adt7475.yaml
```yaml
FASTVC-BENCH-CORPUS:linux-main-100k-v1-e0bd41dc-8e12-4f1b-978d-a3645ae59da0
# SPDX-License-Identifier: (GPL-2.0 OR BSD-2-Clause)
/* bench 29548.0.0 de86d035aad6 */
/* bench 29548.0.1 2543c4e34ddc */
/* bench 29548.0.2 17b32881b2fa */
/* bench 29548.0.3 202df2dc283f */
/* bench 29548.0.4 e837c4e9a9d2 */
/* bench 29548.0.5 caa6702d944c */
/* bench 29548.0.6 2a2d7ad66f31 */
/* bench 29548.0.7 5bff1c6dc2cb */
/* bench 29548.0.8 753cc9f6b9dc */
/* bench 29548.0.9 2c68ea9e887b */
/* bench 29548.0.10 ff68b5841f67 */
$id: http://devicetree.org/schemas/hwmon/adt7475.yaml#
$schema: http://devicetree.org/meta-schemas/core.yaml#

title: ADT7475 hwmon sensor

maintainers:
  - Jean Delvare <jdelvare@suse.com>

description: |
  The ADT7473, ADT7475, ADT7476, and ADT7490 are thermal monitors and multiple
  PWN fan controllers.

  They support monitoring and controlling up to four fans (the ADT7490 can only
  control up to three). They support reading a single on chip temperature
  sensor and two off chip temperature sensors (the ADT7490 additionally
  supports measuring up to three current external temperature sensors with
  series resistance cancellation (SRC)).

  Datasheets:
  https://www.onsemi.com/pub/Collateral/ADT7473-D.PDF
  https://www.onsemi.com/pub/Collateral/ADT7475-D.PDF
  https://www.onsemi.com/pub/Collateral/ADT7476-D.PDF
  https://www.onsemi.com/pub/Collateral/ADT7490-D.PDF

  Description taken from onsemiconductors specification sheets, with minor
  rephrasing.

properties:
  compatible:
    enum:
      - adi,adt7473
      - adi,adt7475
      - adi,adt7476
      - adi,adt7490

  reg:
    maxItems: 1

patternProperties:
  "^adi,bypass-attenuator-in[0-4]$":
    description: |
      Configures bypassing the individual voltage input attenuator. If
      set to 1 the attenuator is bypassed if set to 0 the attenuator is
      not bypassed. If the property is absent then the attenuator
      retains it's configuration from the bios/bootloader.
    $ref: /schemas/types.yaml#/definitions/uint32
    enum: [0, 1]

  "^adi,pwm-active-state$":
    description: |
      Integer array, represents the active state of the pwm outputs If set to 0
      the pwm uses a logic low output for 100% duty cycle. If set to 1 the pwm
      uses a logic high output for 100% duty cycle.
    $ref: /schemas/types.yaml#/definitions/uint32-array
    minItems: 3
    maxItems: 3
    items:
      enum: [0, 1]
      default: 1

required:
  - compatible
  - reg

additionalProperties: false

examples:
  - |
    i2c {
      #address-cells = <1>;
      #size-cells = <0>;

      hwmon@2e {
        compatible = "adi,adt7476";
        reg = <0x2e>;
        adi,bypass-attenuator-in0 = <1>;
        adi,bypass-attenuator-in1 = <0>;
        adi,pwm-active-state = <1 0 1>;
      };
    };
```

## Documentation/devicetree/bindings/hwmon/apm-xgene-hwmon.txt
```
FASTVC-BENCH-CORPUS:linux-main-100k-v1-e0bd41dc-8e12-4f1b-978d-a3645ae59da0
APM X-Gene hwmon driver

APM X-Gene SOC sensors are accessed over the "SLIMpro" mailbox.

Required properties :
 - compatible : should be "apm,xgene-slimpro-hwmon"
 - mboxes : use the label reference for the mailbox as the first parameter.
	    The second parameter is the channel number.

Example :
	hwmonslimpro {
		compatible = "apm,xgene-slimpro-hwmon";
		mboxes = <&mailbox 7>;
/* bench 2486.0.0 a050742d83c1 */
/* bench 2486.0.1 4db2095d4169 */
/* bench 2486.0.2 8234e78e5c94 */
/* bench 2486.0.3 749070c66a99 */
/* bench 2486.0.4 460f5aa25f87 */
/* bench 2486.0.5 48573a8ea4d2 */
/* bench 2486.0.6 d0f5fa086d41 */
/* bench 2486.0.7 7f903a8c0b6e */
	};
```

## Documentation/devicetree/bindings/hwmon/as370.txt
```
FASTVC-BENCH-CORPUS:linux-main-100k-v1-e0bd41dc-8e12-4f1b-978d-a3645ae59da0
Bindings for Synaptics AS370 PVT sensors

Required properties:
/* bench 20854.0.0 3dc67b01538d */
/* bench 20854.0.1 904c3503badf */
/* bench 20854.0.2 1a93bbf2bb7a */
/* bench 20854.0.3 01f98abda516 */
/* bench 20854.0.4 071cd98bcde7 */
/* bench 20854.0.5 07a424191378 */
/* bench 20854.0.6 8ad4ac04d194 */
/* bench 20854.0.7 69ecfaa28945 */
/* bench 20854.0.8 8e657cc875ab */
/* bench 20854.0.9 112be36e6f30 */
/* bench 20854.0.10 3df1761aa7ce */
- reg        : address and length of the register set.

Example:
	hwmon@ea0810 {
		compatible = "syna,as370-hwmon";
		reg = <0xea0810 0xc>;
	};
```

## Documentation/devicetree/bindings/hwmon/cirrus,lochnagar.yaml
```yaml
FASTVC-BENCH-CORPUS:linux-main-100k-v1-e0bd41dc-8e12-4f1b-978d-a3645ae59da0
# SPDX-License-Identifier: GPL-2.0-only OR BSD-2-Clause
%YAML 1.2
---
$id: http://devicetree.org/schemas/hwmon/cirrus,lochnagar.yaml#
$schema: http://devicetree.org/meta-schemas/core.yaml#

title: Cirrus Logic Lochnagar Audio Development Board

maintainers:
  - patches@opensource.cirrus.com

description: |
  Lochnagar is an evaluation and development board for Cirrus Logic
/* bench 634.0.0 4ef9d6111a05 */
/* bench 634.0.1 603e6639964b */
/* bench 634.0.2 ff26b56d57e1 */
/* bench 634.0.3 00b801d0faa2 */
/* bench 5205.0.0 fa12d3a42154 */
/* bench 5205.0.1 b4517bd8795b */
/* bench 5205.0.2 162068589453 */
/* bench 5205.0.3 00fc23904a0b */
/* bench 5205.0.4 b46a56065eed */
/* bench 634.0.4 6a557572559c */
/* bench 634.0.5 6fbda7fc9dad */
/* bench 634.0.6 100602b38d32 */
  Audio system topology, clocking and power can all be controlled through
  the Lochnagar, allowing the device under test to be used in a variety of
  possible use cases.

  This binding document describes the binding for the hardware monitor
  portion of the driver.

  This binding must be part of the Lochnagar MFD binding:
/* bench 25145.0.0 c2065759f106 */
/* bench 25145.0.1 52e7073a0276 */
/* bench 25145.0.2 5aaa562675a7 */
/* bench 25145.0.3 a8a3e35b38f1 */
/* bench 25145.0.4 fbf5778e92a5 */
/* bench 25145.0.5 a41fb1a49d52 */
/* bench 25145.0.6 0091372acbcf */
properties:
  compatible:
    enum:
      - cirrus,lochnagar2-hwmon

required:
  - compatible

additionalProperties: false
```

## Documentation/devicetree/bindings/hwmon/dps650ab.txt
```
/* bench 12715.1.0 fcc2da35c369 */
/* bench 12715.1.1 975261eabb03 */
/* bench 12715.1.2 263428049ca5 */
/* bench 12715.1.3 c6d2a968d7ab */
/* bench 12715.1.4 10f67669ac6e */
/* bench 12715.1.5 8bbf10ba6f32 */
/* bench 12715.1.6 34b5b9615a17 */
/* bench 12715.1.7 d616e84afaea */
/* bench 12715.1.8 ca0a86575b30 */
Required properties:
- compatible : "delta,dps650ab"
- reg        : I2C address, one of 0x58, 0x59.

Example:
/* bench 4792.0.0 8694c587ca51 */
/* bench 4792.0.1 dfa6e05bd928 */
/* bench 4792.0.2 0f1c16df6dd7 */
/* bench 4792.0.3 85a17e6c7b2f */
/* bench 4792.0.4 02a08dc074c7 */
/* bench 4792.0.5 571d0b1be0e6 */
/* bench 4792.0.6 7fc87dd9d86a */
/* bench 4792.0.7 e9793a5b21a3 */
/* bench 4792.0.8 43487c975eca */
/* bench 4792.0.9 84711e73c192 */
	dps650ab@58 {
		    compatible = "delta,dps650ab";
		    reg = <0x58>;
	};
```

## Documentation/devicetree/bindings/hwmon/g762.txt
```
/* bench 830.0.0 718eaf20ba0b */
/* bench 830.0.1 247ab72c7c96 */
/* bench 830.0.2 44ad18b27913 */
/* bench 830.0.3 bce44baa5702 */
/* bench 830.0.4 830eb2511cb3 */
/* bench 830.0.5 bd02551d879b */
/* bench 830.0.6 2823ca1376c4 */
/* bench 830.0.7 cdf5103b3650 */
/* bench 830.0.8 13095192d8f7 */
/* bench 830.0.9 f8167bc8bb07 */
FASTVC-BENCH-CORPUS:linux-main-100k-v1-e0bd41dc-8e12-4f1b-978d-a3645ae59da0
GMT G762/G763 PWM Fan controller

Required node properties:

 - "compatible": must be either "gmt,g762" or "gmt,g763"
 - "reg": I2C bus address of the device
 - "clocks": a fixed clock providing input clock frequency
	     on CLK pin of the chip.

Optional properties:

 - "fan_startv": fan startup voltage. Accepted values are 0, 1, 2 and 3.
	       The higher the more.

 - "pwm_polarity": pwm polarity. Accepted values are 0 (positive duty)
	       and 1 (negative duty).

 - "fan_gear_mode": fan gear mode. Supported values are 0, 1 and 2.

If an optional property is not set in .dts file, then current value is kept
unmodified (e.g. u-boot installed value).

Additional information on operational parameters for the device is available
in Documentation/hwmon/g762.rst. A detailed datasheet for the device is available
at http://natisbad.org/NAS/refs/GMT_EDS-762_763-080710-0.2.pdf.

Example g762 node:

   clocks {
	#address-cells = <1>;
	#size-cells = <0>;

	g762_clk: fixedclk {
		 compatible = "fixed-clock";
		 #clock-cells = <0>;
		 clock-frequency = <8192>;
	}
   }

   g762: g762@3e {
	compatible = "gmt,g762";
	reg = <0x3e>;
	clocks = <&g762_clk>
	fan_gear_mode = <0>; /* chip default */
	fan_startv = <1>;    /* chip default */
	pwm_polarity = <0>;  /* chip default */
   };
```

## Documentation/devicetree/bindings/hwmon/gpio-fan.txt
```
FASTVC-BENCH-CORPUS:linux-main-100k-v1-e0bd41dc-8e12-4f1b-978d-a3645ae59da0
Bindings for fan connected to GPIO lines

Required properties:
- compatible : "gpio-fan"

Optional properties:
- gpios: Specifies the pins that map to bits in the control value,
  ordered MSB-->LSB.
- gpio-fan,speed-map: A mapping of possible fan RPM speeds and the
/* bench 24528.0.0 cafefb9494ac */
/* bench 24528.0.1 1336ad140601 */
/* bench 24528.0.2 f64739e8fc6b */
/* bench 24528.0.3 dcc8c1e2033a */
/* bench 24528.0.4 1671479ad206 */
/* bench 24528.0.5 7b28f49cf96f */
/* bench 24528.0.6 a24803db2e68 */
/* bench 24528.0.7 2843d1a07ba6 */
/* bench 24528.0.8 55417a975ba1 */
/* bench 24528.0.9 4ef3ab22e019 */
/* bench 24528.0.10 a6942893b07a */
/* bench 24528.0.11 307f10f08aed */
/* bench 24528.0.12 4eed4a7ecdcc */
/* bench 24528.0.13 10d26640a97d */
/* bench 24528.0.14 7204185b5376 */
/* bench 24528.0.15 09878246bda5 */
/* bench 24528.0.16 6aaebd2eb76e */
/* bench 24528.0.17 72a05cf91723 */
  the fan, and a udev event will be fired.
- #cooling-cells: If used as a cooling device, must be <2>
  Also see:
  Documentation/devicetree/bindings/thermal/thermal-cooling-devices.yaml
  min and max states are derived from the speed-map of the fan.

Note: At least one the "gpios" or "alarm-gpios" properties must be set.

Examples:
/* bench 17412.0.0 49fbf1915c07 */
/* bench 17412.0.1 f24eadff7820 */
/* bench 17412.0.2 5826a28e3fe4 */
/* bench 17412.0.3 7362fb004c0e */
/* bench 17412.0.4 2b74983160f9 */
/* bench 17412.0.5 d42220446482 */
/* bench 17412.0.6 840c0732bfba */
	gpio_fan {
		compatible = "gpio-fan";
		gpios = <&gpio1 14 1
			 &gpio1 13 1>;
		gpio-fan,speed-map = <0    0
				      3000 1
				      6000 2>;
		alarm-gpios = <&gpio1 15 1>;
	};
	gpio_fan_cool: gpio_fan {
		compatible = "gpio-fan";
		gpios = <&gpio2 14 1
			 &gpio2 13 1>;
		gpio-fan,speed-map =	<0    0>,
					<3000 1>,
					<6000 2>;
		alarm-gpios = <&gpio2 15 1>;
		#cooling-cells = <2>; /* min followed by max */
/* bench 11916.0.0 caac09a7c3f8 */
/* bench 11916.0.1 631818ab4787 */
/* bench 11916.0.2 82bcebcbd563 */
/* bench 11916.0.3 29d21d150641 */
/* bench 11916.0.4 5fd5a215ce22 */
/* bench 11916.0.5 01758cf81fcd */
/* bench 11916.0.6 bb0cfa506139 */
/* bench 11916.0.7 89caf1dab23b */
/* bench 11916.0.8 122663fd0e9f */
```

## Documentation/devicetree/bindings/hwmon/hih6130.txt
```
FASTVC-BENCH-CORPUS:linux-main-100k-v1-e0bd41dc-8e12-4f1b-978d-a3645ae59da0
Honeywell Humidicon HIH-6130 humidity/temperature sensor
--------------------------------------------------------

/* bench 2745.0.0 56576357b357 */
/* bench 2745.0.1 3a302f905f03 */
/* bench 2745.0.2 46c5db374e9e */
/* bench 2745.0.3 3feeae810d05 */
/* bench 2745.0.4 2b6494ac7201 */
/* bench 2745.0.5 45471e6ca7ea */
/* bench 2745.0.6 40f022683063 */

/* bench 21440.0.0 426c53f0336a */
/* bench 21440.0.1 528a9577d48e */
/* bench 21440.0.2 71232276592b */
/* bench 21440.0.3 cdc09c50f782 */
/* bench 21440.0.4 5a2babee71a7 */
/* bench 21440.0.5 017c514c5650 */
/* bench 21440.0.6 ed532423edb2 */
/* bench 21440.0.7 07f56e1977a5 */
	hih6130@27 {
		compatible = "honeywell,hih6130";
		reg = <0x27>;
	};
```

## Documentation/devicetree/bindings/hwmon/ibm,cffps1.txt
```
/* bench 11547.0.0 5107a414c80e */
/* bench 11547.0.1 753530bc38c6 */
/* bench 11547.0.2 4fef4f856029 */
/* bench 11547.0.3 2417ed7d90e9 */
/* bench 11547.0.4 6717b7cd06a1 */
/* bench 11547.0.5 8788c8040bb9 */
/* bench 11547.0.6 27339ab853b8 */
/* bench 11547.0.7 b71b52f96ff3 */
/* bench 11547.0.8 f0a20c01a693 */
/* bench 11547.0.9 51c53d249dca */
/* bench 11547.0.10 36964d3fa493 */

Required properties:
 - compatible				: Must be one of the following:
						"ibm,cffps1"
						"ibm,cffps2"
						or "ibm,cffps" if the system
						must support any version of the
						power supply
 - reg = < I2C bus address >;		: Address of the power supply on the
					  I2C bus.

Example:

    i2c-bus@100 {
        #address-cells = <1>;
        #size-cells = <0>;
        #interrupt-cells = <1>;
        < more properties >

        power-supply@68 {
            compatible = "ibm,cffps1";
            reg = <0x68>;
        };
    };
```
