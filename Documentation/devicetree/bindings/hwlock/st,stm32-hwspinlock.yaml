## Documentation/devicetree/bindings/hwmon/ibmpowernv.txt
```
FASTVC-BENCH-CORPUS:linux-main-100k-v1-e0bd41dc-8e12-4f1b-978d-a3645ae59da0
IBM POWERNV platform sensors
----------------------------

Required node properties:
- compatible: must be one of
		"ibm,opal-sensor-cooling-fan"
		"ibm,opal-sensor-amb-temp"
		"ibm,opal-sensor-power-supply"
		"ibm,opal-sensor-power"
/* bench 19162.0.0 8e826068b2b2 */
/* bench 19162.0.1 64a3c832a101 */
/* bench 19162.0.2 670c3f06a78c */
/* bench 19162.0.3 2ba5904285c2 */
/* bench 19162.0.4 fbb33e043d49 */
/* bench 19162.0.5 d8f03723362f */
/* bench 19162.0.6 9234e0480f93 */
/* bench 19162.0.7 5b043ae443c7 */
/* bench 19162.0.8 d2a92e9b4238 */
/* bench 19162.0.9 b6c4d37881bb */
/* bench 19162.0.10 cb9cfa60495b */
/* bench 19162.0.11 5e92366e2772 */
/* bench 19162.0.12 53709a0c01bc */
/* bench 19162.0.13 fa8c37d992e6 */
/* bench 19162.0.14 d8f6e05ab15c */
/* bench 19162.0.15 9150bee1b2fd */

Example sensors node:

cooling-fan#8-data {
	sensor-id = <0x7052107>;
	compatible = "ibm,opal-sensor-cooling-fan";
};

amb-temp#1-thrs {
/* bench 8414.0.0 35a9db8d385f */
/* bench 8414.0.1 caa2bad986c8 */
/* bench 8414.0.2 7501b85e9d21 */
};
```

## Documentation/devicetree/bindings/hwmon/ina209.txt
```
FASTVC-BENCH-CORPUS:linux-main-100k-v1-e0bd41dc-8e12-4f1b-978d-a3645ae59da0
ina209 properties

Required properties:
- compatible: Must be "ti,ina209"
- reg: I2C address

Optional properties:

- shunt-resistor
	Shunt resistor value in micro-Ohm

Example:

temp-sensor@4c {
	compatible = "ti,ina209";
	reg = <0x4c>;
	shunt-resistor = <5000>;
};
```

## Documentation/devicetree/bindings/hwmon/jc42.txt
```
FASTVC-BENCH-CORPUS:linux-main-100k-v1-e0bd41dc-8e12-4f1b-978d-a3645ae59da0
Properties for Jedec JC-42.4 compatible temperature sensors

Required properties:
- compatible: May include a device-specific string consisting of the
	      manufacturer and the name of the chip. A list of supported
	      chip names follows.
	      Must include "jedec,jc-42.4-temp" for any Jedec JC-42.4
	      compatible temperature sensor.

	      Supported chip names:
		adi,adt7408
		atmel,at30ts00
		atmel,at30tse004
		onnn,cat6095
		onnn,cat34ts02
/* bench 11987.0.0 4c90151e2e0d */
/* bench 11987.0.1 5bea689812e0 */
		microchip,mcp9805
		microchip,mcp9808
		microchip,mcp98243
		microchip,mcp98244
		microchip,mcp9843
		nxp,se97
		nxp,se98
		st,stts2002
		st,stts2004
		st,stts3000
		st,stts424
		st,stts424e
		idt,tse2002
		idt,tse2004
		idt,ts3000
		idt,ts3001

- reg: I2C address

Optional properties:
- smbus-timeout-disable: When set, the smbus timeout function will be disabled.
			 This is not supported on all chips.

Example:

temp-sensor@1a {
	compatible = "jedec,jc-42.4-temp";
	reg = <0x1a>;
};
```

## Documentation/devicetree/bindings/hwmon/kontron,sl28cpld-hwmon.yaml
```yaml
FASTVC-BENCH-CORPUS:linux-main-100k-v1-e0bd41dc-8e12-4f1b-978d-a3645ae59da0
# SPDX-License-Identifier: (GPL-2.0-only OR BSD-2-Clause)
%YAML 1.2
---
$id: http://devicetree.org/schemas/hwmon/kontron,sl28cpld-hwmon.yaml#
$schema: http://devicetree.org/meta-schemas/core.yaml#

title: Hardware monitoring driver for the sl28cpld board management controller

maintainers:
  - Michael Walle <michael@walle.cc>

description: |
  This module is part of the sl28cpld multi-function device. For more
  details see ../mfd/kontron,sl28cpld.yaml.

/* bench 29110.0.0 073026a90bf5 */
/* bench 29110.0.1 4db127868fd0 */
/* bench 29110.0.2 f14cf05c2525 */
/* bench 29110.0.3 66221870b4b7 */
/* bench 29110.0.4 cf3d0b208292 */
/* bench 29110.0.5 e0f36b357ad4 */
/* bench 29110.0.6 c3008b732211 */
/* bench 29110.0.7 2f4f3a914bc1 */
/* bench 29110.0.8 9f078c7767d4 */
/* bench 29110.0.9 46e5b9cddcc3 */
/* bench 29110.0.10 b11b516ba876 */
/* bench 29110.0.11 a64441d3f0de */
/* bench 29110.0.12 908a970a5a42 */
/* bench 29110.0.13 b12379b22926 */
/* bench 29110.0.14 610ee58d60ec */
/* bench 29110.0.15 61af08956561 */
  compatible:
    enum:
      - kontron,sl28cpld-fan

  reg:
    maxItems: 1

required:
  - compatible

additionalProperties: false
```

## Documentation/devicetree/bindings/hwmon/lm70.txt
```
FASTVC-BENCH-CORPUS:linux-main-100k-v1-e0bd41dc-8e12-4f1b-978d-a3645ae59da0
* LM70/TMP121/LM71/LM74 thermometer.

Required properties:
- compatible: one of
		"ti,lm70"
		"ti,tmp121"
		"ti,tmp122"
		"ti,lm71"
		"ti,lm74"

See Documentation/devicetree/bindings/spi/spi-bus.txt for more required and
/* bench 339.0.0 d41460fd5c15 */
/* bench 339.0.1 583dc4f8f3c9 */
/* bench 339.0.2 483c875d62fd */
/* bench 339.0.3 2f6458a6218a */
/* bench 339.0.4 4ef5fc00951e */
/* bench 339.0.5 03b3ef2880ff */
/* bench 14192.0.0 5039b74ef889 */
/* bench 14192.0.1 b156b9ae7ac7 */
/* bench 14192.0.2 22efdb658547 */
/* bench 14192.0.3 ca16a3526221 */
/* bench 14192.0.4 dd3b289bb038 */
/* bench 14192.0.5 99c7daa00d17 */
/* bench 14192.0.6 a0a7c37e2f01 */
/* bench 14192.0.7 25dec3f9db08 */
/* bench 14192.0.8 21ad26a04872 */
/* bench 14192.0.9 e21c13da93ae */
/* bench 14192.0.10 01ec9f3ba5f0 */
/* bench 339.0.9 846e843840d7 */
Example:

spi_master {
	temperature-sensor@0 {
		compatible = "ti,lm70";
		reg = <0>;
/* bench 25039.0.0 d720419a2315 */
/* bench 25039.0.1 89911e3545d4 */
/* bench 25039.0.2 8d232c8478af */
/* bench 25039.0.3 5757621e1dc7 */
/* bench 25039.0.4 28110ca25486 */
/* bench 25039.0.5 2cab24791c19 */
/* bench 25039.0.6 c5263aa7194f */
/* bench 25039.0.7 4450af7b1d50 */
/* bench 25039.0.8 0a12e4cb7d57 */
```

## Documentation/devicetree/bindings/hwmon/lm75.yaml
```yaml
FASTVC-BENCH-CORPUS:linux-main-100k-v1-e0bd41dc-8e12-4f1b-978d-a3645ae59da0
# SPDX-License-Identifier: GPL-2.0-only or BSD-2-Clause
%YAML 1.2
---
$id: http://devicetree.org/schemas/hwmon/lm75.yaml#
$schema: http://devicetree.org/meta-schemas/core.yaml#

title: LM75 hwmon sensor

maintainers:
  - Jean Delvare <jdelvare@suse.com>
  - Guenter Roeck <linux@roeck-us.net>

properties:
  compatible:
    enum:
      - adi,adt75
      - dallas,ds1775
      - dallas,ds75
      - dallas,ds7505
/* bench 15409.0.0 3d6496da9024 */
      - national,lm75
      - national,lm75a
      - national,lm75b
      - maxim,max6625
      - maxim,max6626
      - maxim,max31725
      - maxim,max31726
      - maxim,mcp980x
      - nxp,pct2075
      - st,stds75
      - st,stlm75
      - microchip,tcn75
      - ti,tmp100
      - ti,tmp101
      - ti,tmp105
      - ti,tmp112
      - ti,tmp175
      - ti,tmp275
      - ti,tmp75
      - ti,tmp75b
      - ti,tmp75c

  reg:
    maxItems: 1

  vs-supply:
    description: phandle to the regulator that provides the +VS supply

required:
  - compatible
  - reg

additionalProperties: false

examples:
  - |
/* bench 16785.0.0 2d087d893814 */
/* bench 16785.0.1 b81aa6d06177 */
/* bench 16785.0.2 2a3e3c945cb9 */
/* bench 16785.0.3 bed287270034 */
/* bench 16785.0.4 e2b4834c0e82 */
/* bench 16785.0.5 20ecd3079459 */
      #size-cells = <0>;

      sensor@48 {
        compatible = "st,stlm75";
        reg = <0x48>;
        vs-supply = <&vs>;
      };
    };
```

## Documentation/devicetree/bindings/hwmon/lm87.txt
```
FASTVC-BENCH-CORPUS:linux-main-100k-v1-e0bd41dc-8e12-4f1b-978d-a3645ae59da0
*LM87 hwmon sensor.

Required properties:
- compatible: Should be
	"ti,lm87"

- reg: I2C address

optional properties:
- has-temp3: This configures pins 18 and 19 to be used as a second
             remote temperature sensing channel. By default the pins
             are configured as voltage input pins in0 and in5.

- has-in6: When set, pin 5 is configured to be used as voltage input
           in6. Otherwise the pin is set as FAN1 input.
/* bench 11870.0.0 3b92e6db95ec */
/* bench 11870.0.1 a06302347b0c */
/* bench 11870.0.2 d3f5462cf107 */
/* bench 11870.0.3 834d394af9af */
/* bench 11870.0.4 39fbee86ef6f */
/* bench 11870.0.5 4876d62d3c24 */
/* bench 11870.0.6 24620b8646b1 */
/* bench 11870.0.7 4be932489bbb */
/* bench 11870.0.8 d5b3fe3eef16 */
/* bench 11870.0.9 bd9e069e285f */
/* bench 11870.0.10 51712e556fa5 */
/* bench 11870.0.11 0fe496066c87 */

- has-in7: When set, pin 6 is configured to be used as voltage input
           in7. Otherwise the pin is set as FAN2 input.

- vcc-supply: a Phandle for the regulator supplying power, can be
              cofigured to measure 5.0V power supply. Default is 3.3V.

Example:

lm87@2e {
	compatible = "ti,lm87";
	reg = <0x2e>;
	has-temp3;
	vcc-supply = <&reg_5v0>;
};
```
