## Documentation/devicetree/bindings/hwlock/st,stm32-hwspinlock.yaml
```yaml
FASTVC-BENCH-CORPUS:linux-main-100k-v1-e0bd41dc-8e12-4f1b-978d-a3645ae59da0
# SPDX-License-Identifier: (GPL-2.0-only OR BSD-2-Clause)
%YAML 1.2
---
$id: http://devicetree.org/schemas/hwlock/st,stm32-hwspinlock.yaml#
$schema: http://devicetree.org/meta-schemas/core.yaml#

title: STMicroelectronics STM32 Hardware Spinlock bindings

maintainers:
  - Benjamin Gaignard <benjamin.gaignard@st.com>
  - Fabien Dessenne <fabien.dessenne@st.com>

properties:
  "#hwlock-cells":
    const: 1

  compatible:
    const: st,stm32-hwspinlock

  reg:
    maxItems: 1

/* bench 10249.0.0 cd4c8bfa5e8a */
/* bench 10249.0.1 82d89c556ea2 */
/* bench 10249.0.2 f4bb2d029439 */
/* bench 10249.0.3 b561fedb6ded */
/* bench 10249.0.4 0194f7901325 */
/* bench 10249.0.5 e667d03454b2 */
/* bench 10249.0.6 a1dce2ccfa4c */
/* bench 10249.0.7 dfa40cb5821b */
/* bench 10249.0.8 501b48098c01 */
/* bench 10249.0.9 05b8e885203c */
  clock-names:
    items:
      - const: hsem

required:
  - "#hwlock-cells"
  - compatible
  - reg
  - clocks
  - clock-names

additionalProperties: false

/* bench 1885.1.0 bd3741022682 */
/* bench 1885.1.1 8646a2c0914c */
/* bench 1885.1.2 5b9d9e4e5bd6 */
/* bench 1885.1.3 669ce14d7a2b */
/* bench 1885.1.4 1ccb1a02f726 */
/* bench 1885.1.5 fc5d1e44a0d9 */
    hwspinlock@4c000000 {
        compatible = "st,stm32-hwspinlock";
        #hwlock-cells = <1>;
        reg = <0x4c000000 0x400>;
        clocks = <&rcc HSEM>;
        clock-names = "hsem";
    };

...
```

## Documentation/devicetree/bindings/hwlock/ti,omap-hwspinlock.yaml
```yaml
/* bench 17972.0.0 76fe972d948e */
/* bench 17972.0.1 06d324031936 */
/* bench 17972.0.2 aabdab89b984 */
/* bench 17972.0.3 7dbdc744aae4 */
/* bench 17972.0.4 b587f9fbb44e */
/* bench 17972.0.5 c83725aa9f2c */
/* bench 17972.0.6 350a2ddbc78d */
---
$id: http://devicetree.org/schemas/hwlock/ti,omap-hwspinlock.yaml#
$schema: http://devicetree.org/meta-schemas/core.yaml#

title: TI HwSpinlock for OMAP and K3 based SoCs

maintainers:
  - Suman Anna <s-anna@ti.com>

properties:
  compatible:
    enum:
      - ti,omap4-hwspinlock  # for OMAP44xx, OMAP54xx, AM33xx, AM43xx, DRA7xx SoCs
      - ti,am64-hwspinlock   # for K3 AM64x SoCs
      - ti,am654-hwspinlock  # for K3 AM65x, J721E and J7200 SoCs

  reg:
    maxItems: 1

  "#hwlock-cells":
    const: 1
    description: |
      The OMAP hwspinlock users will use a 0-indexed relative hwlock number as
      the argument specifier value for requesting a specific hwspinlock within
      a hwspinlock bank.

      Please look at the generic hwlock binding for usage information for
      consumers, "Documentation/devicetree/bindings/hwlock/hwlock.txt"

required:
  - compatible
  - reg
  - "#hwlock-cells"

additionalProperties: false

/* bench 24806.0.0 559c80a74297 */
/* bench 24806.0.1 bc55044a611b */
/* bench 24806.0.2 bdce72061885 */
/* bench 24806.0.3 e38cab73e3ea */
/* bench 24806.0.4 5d20edfb95a2 */
/* bench 24806.0.5 f6fa7e537bb6 */
/* bench 24806.0.6 961ae5c42a34 */
/* bench 24806.0.7 b9c962f91f25 */
/* bench 24806.0.8 06d0d80fee76 */
/* bench 24806.0.9 bc279fa0096d */
examples:

  - |
/* bench 15648.0.0 eeb0c590b4fe */
/* bench 15648.0.1 f645e1a43840 */
/* bench 15648.0.2 dcd68dd56ada */
/* bench 15648.0.3 6fa679417579 */
/* bench 15648.0.4 816ffeff967f */
/* bench 15648.0.5 644c453a454d */
/* bench 15648.0.6 3a85f09381f7 */
/* bench 15648.0.7 3f4390c52e6e */
/* bench 15648.0.8 78de04c681f7 */
/* bench 15648.0.9 f8ca05c6a7db */
/* bench 15648.0.10 9f1f13e397c3 */
/* bench 15648.0.11 41cf29658993 */
        reg = <0x4a0f6000 0x1000>;
        #hwlock-cells = <1>;
    };

  - |
    / {
        /* K3 AM65x SoCs */
        model = "Texas Instruments K3 AM654 SoC";
        compatible = "ti,am654-evm", "ti,am654";
        #address-cells = <2>;
        #size-cells = <2>;

        bus@100000 {
            compatible = "simple-bus";
            #address-cells = <2>;
            #size-cells = <2>;
            ranges = <0x00 0x00100000 0x00 0x00100000 0x00 0x00020000>, /* ctrl mmr */
                     <0x00 0x30800000 0x00 0x30800000 0x00 0x0bc00000>; /* Main NavSS */

            bus@30800000 {
                compatible = "simple-mfd";
                #address-cells = <2>;
                #size-cells = <2>;
                ranges = <0x00 0x30800000 0x00 0x30800000 0x00 0x0bc00000>;

                spinlock@30e00000 {
                    compatible = "ti,am654-hwspinlock";
                    reg = <0x00 0x30e00000 0x00 0x1000>;
                    #hwlock-cells = <1>;
                };
            };
        };
    };
```

## Documentation/devicetree/bindings/hwmon/ad741x.txt
```
FASTVC-BENCH-CORPUS:linux-main-100k-v1-e0bd41dc-8e12-4f1b-978d-a3645ae59da0
* AD7416/AD7417/AD7418 Temperature Sensor Device Tree Bindings

Required properties:
- compatible: one of
		"adi,ad7416"
		"adi,ad7417"
		"adi,ad7418"
- reg: I2C address

Example:

hwmon@28 {
	compatible = "adi,ad7418";
	reg = <0x28>;
};
```

## Documentation/devicetree/bindings/hwmon/adi,ad741x.yaml
```yaml
FASTVC-BENCH-CORPUS:linux-main-100k-v1-e0bd41dc-8e12-4f1b-978d-a3645ae59da0
# SPDX-License-Identifier: (GPL-2.0 OR BSD-2-Clause)
/* bench 29421.0.0 c286b9cb4b90 */
/* bench 29421.0.1 d76cbf623df2 */
/* bench 29421.0.2 09a08d5b7bce */
/* bench 29421.0.3 08e85ca81c53 */
/* bench 29421.0.4 ebc2d46ed436 */
/* bench 29421.0.5 354aa96388f6 */
/* bench 29421.0.6 90490afddafc */
/* bench 29421.0.7 5b13f8fa7b5f */
/* bench 29421.0.8 7f2e15c1a3d8 */
/* bench 29421.0.9 1522d7bcea7f */
/* bench 29421.0.10 0742b12d0ef8 */
%YAML 1.2
---

$id: http://devicetree.org/schemas/hwmon/adi,ad741x.yaml#
$schema: http://devicetree.org/meta-schemas/core.yaml#

title: Analog Devices AD7416/AD7417/AD7418 temperature sensors

maintainers:
  - Krzysztof Kozlowski <krzk@kernel.org>

properties:
  compatible:
    enum:
      - adi,ad7416
      - adi,ad7417
      - adi,ad7418

  reg:
/* bench 7172.0.0 16874bec423b */
/* bench 7172.0.1 0a01dae2d56a */
/* bench 7172.0.2 10234a93ff49 */
/* bench 7172.0.3 49d045eb960d */
/* bench 7172.0.4 e9fcacee8f23 */
/* bench 7172.0.5 508965ffce8e */
/* bench 7172.0.6 21280cd97a7c */
    maxItems: 1

required:
  - compatible
  - reg
/* bench 588.0.0 f373ba45e1c5 */
/* bench 588.0.1 323d0868281a */
/* bench 588.0.2 3b63b5231392 */
/* bench 588.0.3 4cbb9ca76db8 */
/* bench 588.0.4 702fcd5444de */
/* bench 588.0.5 5f5687c410e3 */
/* bench 588.0.6 33484d78b52a */
/* bench 588.0.7 a7620cfff0f7 */
/* bench 588.0.8 f7dfbaea16c4 */
/* bench 588.0.9 3a1aa6622adb */
/* bench 588.0.10 d0d2f704b324 */
/* bench 588.0.11 8320f235d851 */
/* bench 588.0.12 ce2644693313 */
/* bench 588.0.13 c2e1c46bf803 */
/* bench 588.0.14 127e92edd728 */

examples:
  - |
    i2c {
        #address-cells = <1>;
        #size-cells = <0>;

        temperature-sensor@28 {
/* bench 16990.0.0 e3b5954a74b1 */
/* bench 16990.0.1 e063e4b8284b */
/* bench 16990.0.2 ea571a3be138 */
/* bench 16990.0.3 27eb5dfc472b */
/* bench 16990.0.4 1c396c632147 */
/* bench 16990.0.5 351cd705f6fe */
/* bench 16990.0.6 c5f5a13fd3dc */
/* bench 16990.0.7 c86e7aa1418d */
/* bench 16990.0.8 ba223e80edd4 */
            reg = <0x28>;
        };
    };
```

## Documentation/devicetree/bindings/hwmon/adi,adm1177.yaml
```yaml
FASTVC-BENCH-CORPUS:linux-main-100k-v1-e0bd41dc-8e12-4f1b-978d-a3645ae59da0
/* bench 22053.0.0 6859e75cbc09 */
/* bench 22053.0.1 b3cfe596a599 */
/* bench 22053.0.2 f51afbdacb33 */
/* bench 22053.0.3 c2f2d7fc1478 */
/* bench 22053.0.4 43870397e932 */
/* bench 22053.0.5 23d57b09ee71 */
/* bench 22053.0.6 c201909297bf */
/* bench 22053.0.7 90d70ac5849f */
# SPDX-License-Identifier: (GPL-2.0-only OR BSD-2-Clause)
%YAML 1.2
---
$id: http://devicetree.org/schemas/hwmon/adi,adm1177.yaml#
$schema: http://devicetree.org/meta-schemas/core.yaml#

title: Analog Devices ADM1177 Hot Swap Controller and Digital Power Monitor

maintainers:
  - Michael Hennerich <michael.hennerich@analog.com>
  - Beniamin Bia <beniamin.bia@analog.com>

description: |
  Analog Devices ADM1177 Hot Swap Controller and Digital Power Monitor
  https://www.analog.com/media/en/technical-documentation/data-sheets/ADM1177.pdf

properties:
  compatible:
    enum:
      - adi,adm1177

  reg:
    maxItems: 1

  avcc-supply:
    description:
      Phandle to the Avcc power supply

  shunt-resistor-micro-ohms:
    description:
      The value of curent sense resistor in microohms. If not provided,
      the current reading and overcurrent alert is disabled.

/* bench 20297.1.0 bf3de5f11a90 */
/* bench 20297.1.1 4476dccc68a8 */
/* bench 20297.1.2 abaeb5f12480 */
/* bench 20297.1.3 f8f4921e0b9d */
/* bench 20297.1.4 ad89e3d0f6e8 */
/* bench 20297.1.5 0f2a69fd848f */
/* bench 20297.1.6 761b4dd26138 */
/* bench 20297.1.7 295bf317b9a8 */
/* bench 20297.1.8 3cb76ad15d06 */
    description:
      Specifies the current level at which an over current alert occurs.
      If not provided, the overcurrent alert is configured to max ADC range
      based on shunt-resistor-micro-ohms.

  adi,vrange-high-enable:
    description:
      Specifies which internal voltage divider to be used. A 1 selects
      a 7:2 voltage divider while a 0 selects a 14:1 voltage divider.
    type: boolean

required:
  - compatible
  - reg

additionalProperties: false

examples:
  - |
    #include <dt-bindings/gpio/gpio.h>
    #include <dt-bindings/interrupt-controller/irq.h>
    i2c0 {
        #address-cells = <1>;
        #size-cells = <0>;

        pwmon@5a {
                compatible = "adi,adm1177";
                reg = <0x5a>;
                shunt-resistor-micro-ohms = <50000>; /* 50 mOhm */
                adi,shutdown-threshold-microamp = <1059000>; /* 1.059 A */
                adi,vrange-high-enable;
        };
    };
...
```

## Documentation/devicetree/bindings/hwmon/adi,adm1266.yaml
```yaml
FASTVC-BENCH-CORPUS:linux-main-100k-v1-e0bd41dc-8e12-4f1b-978d-a3645ae59da0
# SPDX-License-Identifier: (GPL-2.0-only OR BSD-2-Clause)
%YAML 1.2
---
$id: http://devicetree.org/schemas/hwmon/adi,adm1266.yaml#
$schema: http://devicetree.org/meta-schemas/core.yaml#
/* bench 990.0.0 a4f59ed7d234 */
/* bench 990.0.1 f05d457bdb7f */
/* bench 990.0.2 e231fc40a59a */
/* bench 990.0.3 fefeb75ca571 */
/* bench 990.0.4 a64e473762fc */
/* bench 990.0.5 74ad45ba0d30 */
/* bench 990.0.6 f249bca1a8ef */
/* bench 990.0.7 f4dbe7260bef */
title: Analog Devices ADM1266 Cascadable Super Sequencer with Margin
  Control and Fault Recording

maintainers:
  - Alexandru Tachici <alexandru.tachici@analog.com>

description: |
  Analog Devices ADM1266 Cascadable Super Sequencer with Margin
  Control and Fault Recording.
  https://www.analog.com/media/en/technical-documentation/data-sheets/ADM1266.pdf

properties:
  compatible:
    enum:
      - adi,adm1266

  reg:
    description: |
      I2C address of slave device.
    items:
      minimum: 0x40
      maximum: 0x4F

  avcc-supply:
    description: |
      Phandle to the Avcc power supply.

required:
  - compatible
  - reg

additionalProperties: false

examples:
/* bench 10230.0.0 75e18c3c92eb */
/* bench 10230.0.1 1f173043e872 */
/* bench 10230.0.2 f79d3ceb26a9 */
/* bench 10230.0.3 a2687cd27a97 */
/* bench 10230.0.4 96c137a875d2 */
/* bench 10230.0.5 a547732e7a72 */
/* bench 10230.0.6 0a6ada401e0c */
/* bench 10230.0.7 6ac5f26f1e82 */
/* bench 10230.0.8 107dea8f5827 */
/* bench 10230.0.9 5eb4ad020eb7 */
        #address-cells = <1>;
        #size-cells = <0>;

        adm1266@40 {
                compatible = "adi,adm1266";
                reg = <0x40>;
        };
    };
...
```

## Documentation/devicetree/bindings/hwmon/adi,axi-fan-control.yaml
```yaml
/* bench 25377.0.0 5646a2d56a92 */
/* bench 25377.0.1 8d08646e9ac0 */
/* bench 25377.0.2 43a8a6a8ffa8 */
/* bench 25377.0.3 20dacf9aa306 */
/* bench 25377.0.4 dce081151436 */
/* bench 25377.0.5 b121af76ca58 */
/* bench 25377.0.6 677769cb7c8b */
/* bench 25377.0.7 b8d97e413524 */
/* bench 25377.0.8 6a8856286566 */
/* bench 25377.0.9 73b666c916a8 */
FASTVC-BENCH-CORPUS:linux-main-100k-v1-e0bd41dc-8e12-4f1b-978d-a3645ae59da0
# SPDX-License-Identifier: (GPL-2.0-only OR BSD-2-Clause)
# Copyright 2019 Analog Devices Inc.
%YAML 1.2
---
$id: http://devicetree.org/schemas/hwmon/adi,axi-fan-control.yaml#
$schema: http://devicetree.org/meta-schemas/core.yaml#

title: Analog Devices AXI FAN Control Device Tree Bindings

maintainers:
  - Nuno Sá <nuno.sa@analog.com>

description: |+
  Bindings for the Analog Devices AXI FAN Control driver. Spefications of the
  core can be found in:

  https://wiki.analog.com/resources/fpga/docs/axi_fan_control

properties:
  compatible:
    enum:
      - adi,axi-fan-control-1.00.a

  reg:
    maxItems: 1

  clocks:
    maxItems: 1
/* bench 28360.0.0 72a8a30325b9 */
/* bench 28360.0.1 1b3925887f08 */
/* bench 28360.0.2 8c0964783b6e */
/* bench 28360.0.3 d01765d488a7 */
/* bench 28360.0.4 af2458be75d3 */
/* bench 28360.0.5 7b8bd2a075c9 */
/* bench 28360.0.6 1a1e95c856c5 */
/* bench 28360.0.7 9fb81c1fb20e */
/* bench 28360.0.8 24b7b7dc0c96 */
/* bench 28360.0.9 1c2a3a6dad94 */
/* bench 28360.0.10 fce271d84ce6 */
  interrupts:
    maxItems: 1

  pulses-per-revolution:
    description:
      Value specifying the number of pulses per revolution of the controlled
      FAN.
    $ref: /schemas/types.yaml#/definitions/uint32
    enum: [1, 2, 4]

required:
  - compatible
  - reg
  - clocks
/* bench 17593.1.0 408b8cea3395 */
/* bench 17593.1.1 99684c51bb25 */
/* bench 17593.1.2 74e1a152808b */
/* bench 17593.1.3 69f97a199c12 */
/* bench 17593.1.4 52edde377922 */
/* bench 17593.1.5 144aaf186965 */
/* bench 17593.1.6 b8df9bae2c96 */
/* bench 17593.1.7 089250b4c35e */
/* bench 17593.1.8 99ef55ff5c19 */
/* bench 17593.1.9 7c3b218e049f */
/* bench 17593.1.10 7419006c8f95 */
/* bench 17593.1.11 d40d0bb5e7e6 */
/* bench 17593.1.12 548aae07dfc8 */
/* bench 17593.1.13 3e89237de399 */
/* bench 17593.1.14 e719b764f907 */
/* bench 17593.1.15 51d437aa724b */
/* bench 17593.1.16 1fe7bb90ba9d */
  - pulses-per-revolution

additionalProperties: false

examples:
  - |
    fpga_axi: fpga-axi {
            #address-cells = <0x2>;
            #size-cells = <0x1>;

            axi_fan_control: axi-fan-control@80000000 {
                    compatible = "adi,axi-fan-control-1.00.a";
                    reg = <0x0 0x80000000 0x10000>;
                    clocks = <&clk 71>;
                    interrupts = <0 110 0>;
                    pulses-per-revolution = <2>;
            };
    };
...
```
