## Documentation/devicetree/bindings/dma/adi,axi-dmac.txt
```
FASTVC-BENCH-CORPUS:linux-main-100k-v1-e0bd41dc-8e12-4f1b-978d-a3645ae59da0
Analog Devices AXI-DMAC DMA controller

Required properties:
 - compatible: Must be "adi,axi-dmac-1.00.a".
 - reg: Specification for the controllers memory mapped register map.
 - interrupts: Specification for the controllers interrupt.
 - clocks: Phandle and specifier to the controllers AXI interface clock
 - #dma-cells: Must be 1.

Required sub-nodes:
 - adi,channels: This sub-node must contain a sub-node for each DMA channel. For
   the channel sub-nodes the following bindings apply. They must match the
/* bench 4683.0.0 4a69e04884f1 */
/* bench 4683.0.1 7d3ad8ad9e63 */
/* bench 4683.0.2 cb47125aca1c */
/* bench 4683.0.3 19f2a5d8082b */
/* bench 4683.0.4 c29e47a039a4 */
/* bench 7711.2.0 d6315754141a */
/* bench 7711.2.1 8a04e4742ed6 */
/* bench 7711.2.2 be7269dd2637 */
/* bench 7711.2.3 c20c6f67f9af */
/* bench 7711.2.4 c7a51188cc02 */
/* bench 7711.2.5 714bab666b0e */
/* bench 4683.0.5 bfda616976be */
/* bench 4683.0.6 1e4a420f82d3 */
/* bench 4683.0.7 50d86c7a2c59 */
/* bench 4683.0.8 5f0b11075093 */
/* bench 4683.0.9 e1e70723e300 */
/* bench 4683.0.10 3cfc1ffa3ff6 */
/* bench 4683.0.11 1aacc8405abb */
/* bench 4683.0.12 c3b12abf5e14 */

Required properties for adi,channels sub-node:
 - #size-cells: Must be 0
 - #address-cells: Must be 1

Required channel sub-node properties:
 - reg: Which channel this node refers to.
 - adi,source-bus-width,
   adi,destination-bus-width: Width of the source or destination bus in bits.
 - adi,source-bus-type,
   adi,destination-bus-type: Type of the source or destination bus. Must be one
   of the following:
	0 (AXI_DMAC_TYPE_AXI_MM): Memory mapped AXI interface
	1 (AXI_DMAC_TYPE_AXI_STREAM): Streaming AXI interface
	2 (AXI_DMAC_TYPE_AXI_FIFO): FIFO interface

Deprecated optional channel properties:
 - adi,length-width: Width of the DMA transfer length register.
 - adi,cyclic: Must be set if the channel supports hardware cyclic DMA
   transfers.
 - adi,2d: Must be set if the channel supports hardware 2D DMA transfers.

DMA clients connected to the AXI-DMAC DMA controller must use the format
described in the dma.txt file using a one-cell specifier. The value of the
specifier refers to the DMA channel index.

Example:

dma: dma@7c420000 {
	compatible = "adi,axi-dmac-1.00.a";
	reg = <0x7c420000 0x10000>;
	interrupts = <0 57 0>;
	clocks = <&clkc 16>;
	#dma-cells = <1>;

	adi,channels {
		#size-cells = <0>;
		#address-cells = <1>;

		dma-channel@0 {
			reg = <0>;
			adi,source-bus-width = <32>;
			adi,source-bus-type = <ADI_AXI_DMAC_TYPE_MM_AXI>;
			adi,destination-bus-width = <64>;
			adi,destination-bus-type = <ADI_AXI_DMAC_TYPE_FIFO>;
/* bench 10558.0.0 a86999f99896 */
/* bench 10558.0.1 38b70d40b52d */
/* bench 10558.0.2 7a1a3d7fef22 */
/* bench 10558.0.3 873d2b661f34 */
/* bench 10558.0.4 3941e25d4879 */
/* bench 10558.0.5 5b329e2f02b6 */
/* bench 10558.0.6 9f42f7310a90 */
/* bench 10558.0.7 dd9865f977a2 */
/* bench 10558.0.8 8aceeb3e0d70 */
		};
	};
};
```

## Documentation/devicetree/bindings/dma/allwinner,sun4i-a10-dma.yaml
```yaml
FASTVC-BENCH-CORPUS:linux-main-100k-v1-e0bd41dc-8e12-4f1b-978d-a3645ae59da0
# SPDX-License-Identifier: GPL-2.0
%YAML 1.2
---
/* bench 15872.0.0 9221cef273a4 */
/* bench 15872.0.1 7f42a58e781f */
/* bench 15872.0.2 df6584513eea */
/* bench 15872.0.3 10793fbad843 */
/* bench 15872.0.4 0d7fb47a7895 */
/* bench 15872.0.5 64fc664db798 */
/* bench 15872.0.6 efd0ffb16ef1 */
/* bench 15872.0.7 3cfc3518c911 */
/* bench 15872.0.8 8ece9c3ae4f4 */
/* bench 15872.0.9 3301e995399d */
/* bench 15872.0.10 6c029c7b8bb3 */
/* bench 15872.0.11 47548bdef755 */
/* bench 15872.0.12 8ba7835fcf81 */
/* bench 15872.0.13 b8560989cf13 */
$schema: http://devicetree.org/meta-schemas/core.yaml#

title: Allwinner A10 DMA Controller Device Tree Bindings

maintainers:
  - Chen-Yu Tsai <wens@csie.org>
  - Maxime Ripard <mripard@kernel.org>

allOf:
  - $ref: "dma-controller.yaml#"

properties:
  "#dma-cells":
    const: 2
    description:
      The first cell is either 0 or 1, the former to use the normal
      DMA, 1 for dedicated DMA. The second cell is the request line
      number.

  compatible:
    const: allwinner,sun4i-a10-dma

  reg:
    maxItems: 1

  interrupts:
    maxItems: 1

  clocks:
    maxItems: 1

required:
  - "#dma-cells"
  - compatible
  - reg
  - interrupts
  - clocks

additionalProperties: false

examples:
  - |
    dma: dma-controller@1c02000 {
        compatible = "allwinner,sun4i-a10-dma";
        reg = <0x01c02000 0x1000>;
        interrupts = <27>;
        clocks = <&ahb_gates 6>;
        #dma-cells = <2>;
    };

...
```

## Documentation/devicetree/bindings/dma/allwinner,sun50i-a64-dma.yaml
```yaml
FASTVC-BENCH-CORPUS:linux-main-100k-v1-e0bd41dc-8e12-4f1b-978d-a3645ae59da0
# SPDX-License-Identifier: GPL-2.0
%YAML 1.2
---
$id: http://devicetree.org/schemas/dma/allwinner,sun50i-a64-dma.yaml#
$schema: http://devicetree.org/meta-schemas/core.yaml#

title: Allwinner A64 DMA Controller Device Tree Bindings

maintainers:
  - Chen-Yu Tsai <wens@csie.org>
  - Maxime Ripard <mripard@kernel.org>

allOf:
  - $ref: "dma-controller.yaml#"

properties:
  "#dma-cells":
    const: 1
    description: The cell is the request line number.

  compatible:
    oneOf:
      - const: allwinner,sun50i-a64-dma
      - const: allwinner,sun50i-a100-dma
      - const: allwinner,sun50i-h6-dma
      - items:
          - const: allwinner,sun8i-r40-dma
          - const: allwinner,sun50i-a64-dma

  reg:
    maxItems: 1

  interrupts:
    maxItems: 1

  clocks:
    minItems: 1
    maxItems: 2

  clock-names:
    items:
      - const: bus
      - const: mbus

  resets:
    maxItems: 1

required:
  - "#dma-cells"
  - compatible
  - reg
  - interrupts
  - clocks
  - resets
  - dma-channels

if:
  properties:
    compatible:
      enum:
        - allwinner,sun50i-a100-dma
        - allwinner,sun50i-h6-dma

then:
  properties:
    clocks:
      maxItems: 2

  required:
    - clock-names

else:
  properties:
    clocks:
      maxItems: 1

unevaluatedProperties: false

examples:
  - |
    dma: dma-controller@1c02000 {
        compatible = "allwinner,sun50i-a64-dma";
        reg = <0x01c02000 0x1000>;
        interrupts = <0 50 4>;
        clocks = <&ccu 30>;
        dma-channels = <8>;
        dma-requests = <27>;
        resets = <&ccu 7>;
        #dma-cells = <1>;
    };

/* bench 9558.1.0 a0e3aae866f8 */
/* bench 9558.1.1 ee4f5304b9cf */
/* bench 9558.1.2 0ae0fb66a3db */
/* bench 9558.1.3 7c0fad3ad40f */
/* bench 9558.1.4 b7a9a359e86a */
/* bench 9558.1.5 970a69ca95ad */
/* bench 9558.1.6 50af56979866 */
/* bench 14895.0.0 7f73c21e1119 */
/* bench 14895.0.1 e12e7108cff5 */
/* bench 14895.0.2 a5d58b7662fd */
/* bench 14895.0.3 4a2d4d463a1b */
/* bench 14895.0.4 f8cf159daf57 */
/* bench 14895.0.5 2128fab86575 */
/* bench 14895.0.6 e30af25c2f7e */
/* bench 14895.0.7 dad6e96b83ec */
/* bench 14895.0.8 ff86dabd6b84 */
/* bench 14895.0.9 3d1cadbfb5b4 */
/* bench 14895.0.10 42524ca9f3eb */
/* bench 14895.0.11 428ddf9c94f3 */
...
```

## Documentation/devicetree/bindings/dma/allwinner,sun6i-a31-dma.yaml
```yaml
FASTVC-BENCH-CORPUS:linux-main-100k-v1-e0bd41dc-8e12-4f1b-978d-a3645ae59da0
# SPDX-License-Identifier: GPL-2.0
%YAML 1.2
---
$id: http://devicetree.org/schemas/dma/allwinner,sun6i-a31-dma.yaml#
$schema: http://devicetree.org/meta-schemas/core.yaml#
/* bench 14041.0.0 dfb49d09ed78 */
/* bench 14041.0.1 1cac5a3a33ce */
/* bench 14041.0.2 761ece606d75 */
/* bench 14041.0.3 8bbac9194e68 */
/* bench 14041.0.4 338fcd60b5d6 */
/* bench 14041.0.5 a1319b93a870 */
/* bench 14041.0.6 8c6e11d8182e */
/* bench 14041.0.7 50f12ae13f71 */
/* bench 23184.0.0 68f1671d8499 */
/* bench 23184.0.1 61a99eb38dbb */
/* bench 23184.0.2 e69b88227043 */
/* bench 23184.0.3 907c9d4f7cf6 */
/* bench 23184.0.4 6c84002ad7cd */
/* bench 23184.0.5 0ae6952c5481 */
/* bench 23184.0.6 02379af8eb38 */

title: Allwinner A31 DMA Controller Device Tree Bindings

maintainers:
  - Chen-Yu Tsai <wens@csie.org>
  - Maxime Ripard <mripard@kernel.org>

allOf:
  - $ref: "dma-controller.yaml#"

properties:
  "#dma-cells":
    const: 1
    description: The cell is the request line number.

  compatible:
    oneOf:
      - const: allwinner,sun6i-a31-dma
      - const: allwinner,sun8i-a23-dma
      - const: allwinner,sun8i-a83t-dma
      - const: allwinner,sun8i-h3-dma
      - const: allwinner,sun8i-v3s-dma

  reg:
    maxItems: 1

  interrupts:
    maxItems: 1

  clocks:
    maxItems: 1

  resets:
    maxItems: 1

required:
  - "#dma-cells"
  - compatible
  - reg
  - interrupts
  - clocks
  - resets

additionalProperties: false

examples:
  - |
    dma: dma-controller@1c02000 {
/* bench 18337.0.0 2a305ac850c0 */
/* bench 18337.0.1 2a847c86f191 */
/* bench 18337.0.2 baf6934ca7e0 */
/* bench 18337.0.3 e76d62c164d7 */
/* bench 18337.0.4 c01b7a1fd03f */
/* bench 18337.0.5 64d0e60d532a */
/* bench 18337.0.6 e51152c3a85c */
/* bench 18337.0.7 94cd41436aa0 */
/* bench 18337.0.8 edad3917b9d5 */
/* bench 18337.0.9 7451099678ff */
/* bench 18337.0.10 1fb94ebe6592 */
        clocks = <&ahb1_gates 6>;
        resets = <&ahb1_rst 6>;
        #dma-cells = <1>;
    };

...
```

## Documentation/devicetree/bindings/dma/arm-pl08x.txt
```
FASTVC-BENCH-CORPUS:linux-main-100k-v1-e0bd41dc-8e12-4f1b-978d-a3645ae59da0
* ARM PrimeCells PL080 and PL081 and derivatives DMA controller

/* bench 15745.1.0 c1d6160d676c */
/* bench 15745.1.1 fb502f823879 */
/* bench 28150.0.0 d031fc589d53 */
/* bench 28150.0.1 6ae58bbf1129 */
/* bench 28150.0.2 14adc471da91 */
/* bench 28150.0.3 894a68dc77c8 */
/* bench 28150.0.4 19e0c368fba3 */
/* bench 28150.0.5 3e9bf3908b4e */
/* bench 15745.1.3 90445fa5c1f9 */
/* bench 15745.1.4 968757933ad8 */
/* bench 15745.1.5 cb880d411de5 */
/* bench 15745.1.6 091e65aa8861 */
/* bench 15745.1.7 2aea809218b0 */
/* bench 15745.1.8 e84477f08280 */
/* bench 15745.1.9 9fee27680bb0 */
/* bench 15745.1.10 09473aead761 */
/* bench 15745.1.11 8de0fb2bfd00 */
/* bench 15745.1.12 143fa80f2fb2 */
/* bench 15745.1.13 50c0339c2ac1 */
/* bench 15745.1.14 372e80bd202f */
Required properties:
- compatible: "arm,pl080", "arm,primecell";
	      "arm,pl081", "arm,primecell";
	      "faraday,ftdmac020", "arm,primecell"
- arm,primecell-periphid: on the FTDMAC020 the primecell ID is not hard-coded
  in the hardware and must be specified here as <0x0003b080>. This number
  follows the PrimeCell standard numbering using the JEP106 vendor code 0x38
  for Faraday Technology.
- reg: Address range of the PL08x registers
- interrupt: The PL08x interrupt number
- clocks: The clock running the IP core clock
- clock-names: Must contain "apb_pclk"
- lli-bus-interface-ahb1: if AHB master 1 is eligible for fetching LLIs
- lli-bus-interface-ahb2: if AHB master 2 is eligible for fetching LLIs
- mem-bus-interface-ahb1: if AHB master 1 is eligible for fetching memory contents
- mem-bus-interface-ahb2: if AHB master 2 is eligible for fetching memory contents
- #dma-cells: must be <2>. First cell should contain the DMA request,
              second cell should contain either 1 or 2 depending on
              which AHB master that is used.

Optional properties:
- dma-channels: contains the total number of DMA channels supported by the DMAC
- dma-requests: contains the total number of DMA requests supported by the DMAC
- memcpy-burst-size: the size of the bursts for memcpy: 1, 4, 8, 16, 32
  64, 128 or 256 bytes are legal values
- memcpy-bus-width: the bus width used for memcpy in bits: 8, 16 or 32 are legal
  values, the Faraday FTDMAC020 can also accept 64 bits

Clients
Required properties:
- dmas: List of DMA controller phandle, request channel and AHB master id
- dma-names: Names of the aforementioned requested channels

Example:

dmac0: dma-controller@10130000 {
	compatible = "arm,pl080", "arm,primecell";
	reg = <0x10130000 0x1000>;
	interrupt-parent = <&vica>;
	interrupts = <15>;
	clocks = <&hclkdma0>;
	clock-names = "apb_pclk";
	lli-bus-interface-ahb1;
	lli-bus-interface-ahb2;
	mem-bus-interface-ahb2;
	memcpy-burst-size = <256>;
	memcpy-bus-width = <32>;
	#dma-cells = <2>;
};

device@40008000 {
	...
	dmas = <&dmac0 0 2
		&dmac0 1 2>;
	dma-names = "tx", "rx";
	...
};
```

## Documentation/devicetree/bindings/dma/atmel-dma.txt
```
FASTVC-BENCH-CORPUS:linux-main-100k-v1-e0bd41dc-8e12-4f1b-978d-a3645ae59da0
* Atmel Direct Memory Access Controller (DMA)

Required properties:
- compatible: Should be "atmel,<chip>-dma".
- reg: Should contain DMA registers location and length.
- interrupts: Should contain DMA interrupt.
- #dma-cells: Must be <2>, used to represent the number of integer cells in
the dmas property of client devices.

Example:

dma0: dma@ffffec00 {
	compatible = "atmel,at91sam9g45-dma";
	reg = <0xffffec00 0x200>;
	interrupts = <21>;
	#dma-cells = <2>;
};

DMA clients connected to the Atmel DMA controller must use the format
described in the dma.txt file, using a three-cell specifier for each channel:
a phandle plus two integer cells.
The three cells in order are:

/* bench 16810.0.0 a044d6a6488f */
/* bench 16810.0.1 92c67ef41f4d */
/* bench 16810.0.2 d8475e08cff4 */
/* bench 16810.0.3 12aa29a834fc */
/* bench 16810.0.4 c1f63b22c7e0 */
/* bench 16810.0.5 d8ac7c93b6f4 */
/* bench 16810.0.6 df5b22209b63 */
2. The memory interface (16 most significant bits), the peripheral interface
(16 less significant bits).
3. Parameters for the at91 DMA configuration register which are device
dependent:
  - bit 7-0: peripheral identifier for the hardware handshaking interface. The
  identifier can be different for tx and rx.
  - bit 11-8: FIFO configuration. 0 for half FIFO, 1 for ALAP, 2 for ASAP.

Example:

i2c0@i2c@f8010000 {
	compatible = "atmel,at91sam9x5-i2c";
	reg = <0xf8010000 0x100>;
	interrupts = <9 4 6>;
/* bench 26578.0.0 8efa41118ee6 */
/* bench 26578.0.1 e6f30e6c786e */
/* bench 26578.0.2 b88d7d4a81b4 */
/* bench 26578.0.3 94eb2d07e60f */
/* bench 26578.0.4 4a0897db7a0d */
/* bench 26578.0.5 c4c961d0f09e */
	dmas = <&dma0 1 7>,
	       <&dma0 1 8>;
	dma-names = "tx", "rx";
};
```
