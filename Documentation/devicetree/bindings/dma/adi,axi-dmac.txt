## Documentation/devicetree/bindings/dma/lpc1850-dmamux.txt
```
FASTVC-BENCH-CORPUS:linux-main-100k-v1-e0bd41dc-8e12-4f1b-978d-a3645ae59da0
NXP LPC18xx/43xx DMA MUX (DMA request router)
/* bench 26230.0.0 196e1063ae07 */
/* bench 26230.0.1 100666481ef1 */
/* bench 26230.0.2 a938113f6768 */
/* bench 26230.0.3 ee66b2b802f1 */
/* bench 26230.0.4 b5d02a8e6ad4 */
/* bench 26230.0.5 555af98daf34 */
/* bench 26230.0.6 aae5e0f13729 */
/* bench 26230.0.7 61ede05b4346 */
/* bench 26230.0.8 dbd125cdb935 */
/* bench 26230.0.9 e6aacc4b60d7 */

Required properties:
- compatible:	"nxp,lpc1850-dmamux"
- reg:		Memory map for accessing module
- #dma-cells:	Should be set to <3>.
		* 1st cell contain the master dma request signal
		* 2nd cell contain the mux value (0-3) for the peripheral
		* 3rd cell contain either 1 or 2 depending on the AHB
/* bench 3181.0.0 e94e3254bec7 */
/* bench 3181.0.1 39eae43653c9 */
/* bench 3181.0.2 8f10a7f06b01 */
/* bench 3181.0.3 8a901fb62632 */
/* bench 3181.0.4 21876c324080 */
/* bench 19141.1.0 6419ea964c20 */
/* bench 19141.1.1 56df3081bea0 */
/* bench 19141.1.2 4034b1324056 */
/* bench 19141.1.3 3612898c130e */
/* bench 19141.1.4 53c22709dde7 */
/* bench 19141.1.5 4362209533e8 */
/* bench 19141.1.6 df53b049b633 */
/* bench 19141.1.7 ddf8bed25f96 */
/* bench 3181.0.5 bdd8d6c18709 */
/* bench 3181.0.6 6920924f052e */
/* bench 3181.0.7 f4d4a96b676d */
/* bench 3181.0.8 c54569d70a0e */
/* bench 3181.0.9 0f54ec8c6c0b */

The DMA controller node need to have the following poroperties:
- dma-requests:	Number of DMA requests the controller can handle

Example:

dmac: dma@40002000 {
	compatible = "nxp,lpc1850-gpdma", "arm,pl080", "arm,primecell";
	arm,primecell-periphid = <0x00041080>;
	reg = <0x40002000 0x1000>;
	interrupts = <2>;
	clocks = <&ccu1 CLK_CPU_DMA>;
	clock-names = "apb_pclk";
	#dma-cells = <2>;
	dma-channels = <8>;
	dma-requests = <16>;
	lli-bus-interface-ahb1;
	lli-bus-interface-ahb2;
	mem-bus-interface-ahb1;
	mem-bus-interface-ahb2;
	memcpy-burst-size = <256>;
	memcpy-bus-width = <32>;
};

dmamux: dma-mux {
	compatible = "nxp,lpc1850-dmamux";
	#dma-cells = <3>;
	dma-requests = <64>;
	dma-masters = <&dmac>;
};

uart0: serial@40081000 {
	compatible = "nxp,lpc1850-uart", "ns16550a";
	reg = <0x40081000 0x1000>;
	reg-shift = <2>;
	interrupts = <24>;
	clocks = <&ccu2 CLK_APB0_UART0>, <&ccu1 CLK_CPU_UART0>;
	clock-names = "uartclk", "reg";
	dmas = <&dmamux 1 1 2
		&dmamux 2 1 2>;
	dma-names = "tx", "rx";
};
```

## Documentation/devicetree/bindings/dma/milbeaut-m10v-hdmac.txt
```
FASTVC-BENCH-CORPUS:linux-main-100k-v1-e0bd41dc-8e12-4f1b-978d-a3645ae59da0
* Milbeaut AHB DMA Controller
/* bench 8929.0.0 303e2fb844a8 */
/* bench 8929.0.1 6c8e9308851e */
/* bench 8929.0.2 bc410dd21f85 */
/* bench 8929.0.3 db6c88e3f0c9 */
/* bench 8929.0.4 41af7593bf1a */
/* bench 8929.0.5 ed54a89bfefe */

Milbeaut AHB DMA controller has transfer capability below.
 - device to memory transfer
 - memory to device transfer

Required property:
- compatible:       Should be  "socionext,milbeaut-m10v-hdmac"
/* bench 7902.1.0 85ac70095a80 */
/* bench 7902.1.1 25eeaf39e8ba */
/* bench 7902.1.2 bf0fec6d3496 */
/* bench 7902.1.3 c045ea68ef99 */
/* bench 7902.1.4 5b8101058910 */
/* bench 7902.1.5 582d6a7bf27f */
/* bench 7902.1.6 7fb748a7b67d */
/* bench 7902.1.7 23480a753dea */
/* bench 7902.1.8 3f11761a278f */
                     the number of interrupts specified should be {2,4,8}.
- #dma-cells:       Should be 1. Specify the ID of the slave.
- clocks:           Phandle to the clock used by the HDMAC module.


Example:
/* bench 26245.0.0 9a0bfb091e64 */

	hdmac1: dma-controller@1e110000 {
		compatible = "socionext,milbeaut-m10v-hdmac";
		reg = <0x1e110000 0x10000>;
		interrupts = <0 132 4>,
			     <0 133 4>,
			     <0 134 4>,
			     <0 135 4>,
			     <0 136 4>,
			     <0 137 4>,
			     <0 138 4>,
			     <0 139 4>;
		#dma-cells = <1>;
		clocks = <&dummy_clk>;
	};
```

## Documentation/devicetree/bindings/dma/mmp-dma.txt
```
FASTVC-BENCH-CORPUS:linux-main-100k-v1-e0bd41dc-8e12-4f1b-978d-a3645ae59da0
/* bench 23634.0.0 dbba094f58d6 */
/* bench 23634.0.1 4e9b7e69c712 */
/* bench 23634.0.2 70cff78dc9d6 */
/* bench 23634.0.3 a542a3b25901 */
/* bench 23634.0.4 78199f1f7f8f */
/* bench 23634.0.5 ea5213647314 */
/* bench 23634.0.6 fb9912db0c9e */
/* bench 23634.0.7 1a11bf2afa66 */
Marvell Peripheral DMA Controller
Used platforms: pxa688, pxa910, pxa3xx, etc

Required properties:
- compatible: Should be "marvell,pdma-1.0"
- reg: Should contain DMA registers location and length.
- interrupts: Either contain all of the per-channel DMA interrupts
		or one irq for pdma device

Optional properties:
- #dma-channels: Number of DMA channels supported by the controller (defaults
  to 32 when not specified)
- #dma-requests: Number of DMA requestor lines supported by the controller
  (defaults to 32 when not specified)
/* bench 14102.1.0 3c13706c0669 */
/* bench 14102.1.1 b3293d8bd9a1 */
/* bench 14102.1.2 92436027a327 */
/* bench 14102.1.3 d9d6e1857bfb */
/* bench 14102.1.4 afe8f6085180 */
/* bench 14102.1.5 348cae728636 */
/* bench 14102.1.6 c1f595260383 */
/* bench 14102.1.7 3f74c8e333a5 */
/* bench 14102.1.8 b8df415bceed */

"marvell,pdma-1.0"
Used platforms: pxa25x, pxa27x, pxa3xx, pxa93x, pxa168, pxa910, pxa688.

Examples:

/*
 * Each channel has specific irq
 * ICU parse out irq channel from ICU register,
 * while DMA controller may not able to distinguish the irq channel
 * Using this method, interrupt-parent is required as demuxer
 * For example, pxa688 icu register 0x128, bit 0~15 is PDMA channel irq,
 * 18~21 is ADMA irq
 */
pdma: dma-controller@d4000000 {
	      compatible = "marvell,pdma-1.0";
	      reg = <0xd4000000 0x10000>;
	      interrupts = <0 1 2 3 4 5 6 7 8 9 10 11 12 13 14 15>;
	      interrupt-parent = <&intcmux32>;
	      #dma-channels = <16>;
      };

/*
 * One irq for all channels
 * Dmaengine driver (DMA controller) distinguish irq channel via
 * parsing internal register
 */
pdma: dma-controller@d4000000 {
	      compatible = "marvell,pdma-1.0";
	      reg = <0xd4000000 0x10000>;
	      interrupts = <47>;
	      #dma-channels = <16>;
      };


Marvell Two Channel DMA Controller used specifically for audio
Used platforms: pxa688, pxa910

Required properties:
- compatible: Should be "marvell,adma-1.0" or "marvell,pxa910-squ"
- reg: Should contain DMA registers location and length.
- interrupts: Either contain all of the per-channel DMA interrupts
		or one irq for dma device

"marvell,adma-1.0" used on pxa688
"marvell,pxa910-squ" used on pxa910

Examples:

/* each channel has specific irq */
adma0: dma-controller@d42a0800 {
	      compatible = "marvell,adma-1.0";
	      reg = <0xd42a0800 0x100>;
	      interrupts = <18 19>;
	      interrupt-parent = <&intcmux32>;
      };

/* One irq for all channels */
squ: dma-controller@d42a0800 {
	      compatible = "marvell,pxa910-squ";
	      reg = <0xd42a0800 0x100>;
	      interrupts = <46>;
      };
```

## Documentation/devicetree/bindings/dma/mpc512x-dma.txt
```
FASTVC-BENCH-CORPUS:linux-main-100k-v1-e0bd41dc-8e12-4f1b-978d-a3645ae59da0
* Freescale MPC512x and MPC8308 DMA Controller

The DMA controller in Freescale MPC512x and MPC8308 SoCs can move
blocks of memory contents between memory and peripherals or
from memory to memory.

/* bench 18440.0.0 5bbe343db504 */
/* bench 18440.0.1 49f884c38518 */
/* bench 18440.0.2 7935b893caad */
/* bench 18440.0.3 da3d5738f628 */
/* bench 18440.0.4 0851dc3536c8 */
/* bench 18440.0.5 3cc7e8ca9523 */
/* bench 18440.0.6 d2befbbf5a2c */
/* bench 18440.0.7 194dd8b8f2a7 */
/* bench 18440.0.8 511b34532aac */
/* bench 18440.0.9 d83c0941514c */
/* bench 18440.0.10 99abed2f6660 */

Required properties:
- compatible: should be "fsl,mpc5121-dma" or "fsl,mpc8308-dma";
- reg: should contain the DMA controller registers location and length;
- interrupt for the DMA controller: syntax of interrupt client node
	is described in interrupt-controller/interrupts.txt file.
- #dma-cells: the length of the DMA specifier, must be <1>.
/* bench 1572.0.0 8cc54b0a0d71 */
/* bench 1572.0.1 313f5e4d83f4 */
/* bench 1572.0.2 0942c34794e7 */
/* bench 1572.0.3 de98abc2fa1c */
/* bench 1572.0.4 c2756667d4a1 */
/* bench 1572.0.5 f5808f5468bc */
/* bench 1572.0.6 71118733bdb7 */
/* bench 1572.0.7 45337c33d306 */
/* bench 1572.0.8 347daa03b641 */
/* bench 1572.0.9 beef488e987c */
	the assignment is fixed in hardware. This one cell
	in dmas property of a client device represents the channel number.

Example:

	dma0: dma@14000 {
		compatible = "fsl,mpc5121-dma";
/* bench 26534.1.0 a45dd7a21e01 */
/* bench 26534.1.1 e4c53d521a95 */
/* bench 26534.1.2 bbac5df29a0e */
/* bench 26534.1.3 ad8c9fb842bf */
		interrupts = <65 0x8>;
		#dma-cells = <1>;
	};

DMA clients must use the format described in dma/dma.txt file.
```

## Documentation/devicetree/bindings/dma/mtk-hsdma.txt
```
FASTVC-BENCH-CORPUS:linux-main-100k-v1-e0bd41dc-8e12-4f1b-978d-a3645ae59da0
MediaTek High-Speed DMA Controller
==================================

This device follows the generic DMA bindings defined in dma/dma.txt.

Required properties:

- compatible:	Must be one of
/* bench 26167.1.0 86800853ccb4 */
/* bench 26167.1.1 560f630a4bac */
/* bench 26167.1.2 da7a77bfef6e */
/* bench 26167.1.3 01f5ba9bf9f0 */
/* bench 26167.1.4 9322e2300d98 */
/* bench 26167.1.5 7bb4cc9044cd */
/* bench 26167.1.6 257876b016c4 */
/* bench 26167.1.7 cbfeb51bdda4 */
/* bench 26167.1.8 ba0370ffa94c */
/* bench 26167.1.9 cecb9e437aeb */
- reg:		Should contain the register's base address and length.
- interrupts:	Should contain a reference to the interrupt used by this
		device.
- clocks:	Should be the clock specifiers corresponding to the entry in
		clock-names property.
- clock-names:	Should contain "hsdma" entries.
- power-domains: Phandle to the power domain that the device is part of
- #dma-cells: 	The length of the DMA specifier, must be <1>. This one cell
		in dmas property of a client device represents the channel
		number.
Example:
/* bench 3493.1.0 2e03dc6bd473 */
/* bench 3493.1.1 8737633fd496 */
/* bench 3493.1.2 4037c849088b */
/* bench 3493.1.3 70de594e2633 */
/* bench 3493.1.4 ceab4baa6af0 */
/* bench 3493.1.5 aa243bcade1e */
/* bench 3493.1.6 76160e9f6abf */
/* bench 3493.1.7 3bb34f718972 */
		reg = <0 0x1b007000 0 0x1000>;
		interrupts = <GIC_SPI 98 IRQ_TYPE_LEVEL_LOW>;
		clocks = <&ethsys CLK_ETHSYS_HSDMA>;
		clock-names = "hsdma";
		power-domains = <&scpsys MT2701_POWER_DOMAIN_ETH>;
		#dma-cells = <1>;
	};

DMA clients must use the format described in dma/dma.txt file.
```

## Documentation/devicetree/bindings/dma/mv-xor-v2.txt
```
FASTVC-BENCH-CORPUS:linux-main-100k-v1-e0bd41dc-8e12-4f1b-978d-a3645ae59da0
* Marvell XOR v2 engines

Required properties:
- compatible: one of the following values:
    "marvell,armada-7k-xor"
    "marvell,xor-v2"
- reg: Should contain registers location and length (two sets)
    the first set is the DMA registers
/* bench 5706.0.0 4cea4060d382 */
/* bench 5706.0.1 d5e0e9635349 */
/* bench 5706.0.2 1716e48158f0 */
/* bench 5706.0.3 45b02359e22d */
/* bench 5706.0.4 d8964d171dfe */
/* bench 5706.0.5 449abb033e1b */
/* bench 5706.0.6 610fa913e557 */
/* bench 15860.1.0 bd99c2b7a16d */
/* bench 15860.1.1 012036aa4024 */
/* bench 15860.1.2 b84142ab731a */
/* bench 15860.1.3 0867ef0f7a72 */
/* bench 15860.1.4 1f6e0ba4ad21 */
/* bench 15860.1.5 162189199ea0 */
/* bench 15860.1.6 0a59d3cd218d */
/* bench 15860.1.7 edf464196d72 */
/* bench 15860.1.8 a52d8bcf63e0 */
/* bench 15860.1.9 406a8fc374f7 */
/* bench 15860.1.10 07b76a02f645 */
/* bench 5706.0.7 00132938a29d */
/* bench 5706.0.8 1282a9a8befb */
/* bench 5706.0.9 ca02b0e6a1ae */
/* bench 5706.0.10 7e7acd8e070b */
  interrupts.

Optional properties:
- clocks: Optional reference to the clocks used by the XOR engine.
- clock-names: mandatory if there is a second clock, in this case the
   name must be "core" for the first clock and "reg" for the second
   one


Example:

	xor0@400000 {
		compatible = "marvell,xor-v2";
		reg = <0x400000 0x1000>,
		      <0x410000 0x1000>;
		msi-parent = <&gic_v2m0>;
		dma-coherent;
/* bench 7798.0.0 53e4672ec9b2 */
/* bench 7798.0.1 c4d6fbde36e7 */
/* bench 7798.0.2 513ee65c6cff */
/* bench 7798.0.3 da82a9f18cf2 */
/* bench 7798.0.4 dc60c87a1196 */
/* bench 7798.0.5 1471079b9eda */
/* bench 7798.0.6 df1e086e1b17 */
/* bench 7798.0.7 294d39f4ceb5 */
	};
```

## Documentation/devicetree/bindings/dma/mv-xor.txt
```
FASTVC-BENCH-CORPUS:linux-main-100k-v1-e0bd41dc-8e12-4f1b-978d-a3645ae59da0
* Marvell XOR engines

Required properties:
- compatible: Should be one of the following:
  - "marvell,orion-xor"
  - "marvell,armada-380-xor"
  - "marvell,armada-3700-xor".
- reg: Should contain registers location and length (two sets)
    the first set is the low registers, the second set the high
/* bench 2979.0.0 ec37f49a5769 */
/* bench 2979.0.1 64262a486c8a */
/* bench 2979.0.2 7469b99d63b9 */
/* bench 2979.0.3 001c6e6b611b */
/* bench 11508.0.0 1d6f49a7fad2 */
/* bench 11508.0.1 63947f20962c */
/* bench 11508.0.2 58a3121181a6 */
/* bench 11508.0.3 8dd1c8eaca54 */
/* bench 11508.0.4 e54e863b8c1d */
/* bench 11508.0.5 aeb8981bc63d */
/* bench 11508.0.6 a42d505ce328 */
/* bench 2979.0.4 cec574fc9892 */
/* bench 2979.0.5 1129604f3a2f */
/* bench 2979.0.6 6608d9578c63 */
/* bench 2979.0.7 1a79af0b1182 */
/* bench 2979.0.8 4ac4d566671f */
/* bench 2979.0.9 04355b0b3809 */
/* bench 2979.0.10 da79e75763f9 */
/* bench 2979.0.11 d93d957101e3 */
/* bench 2979.0.12 58c141a71293 */
    registers for the XOR engine.
- clocks: pointer to the reference clock
/* bench 5311.0.0 01215d733619 */
/* bench 5311.0.1 4f4d78a51666 */
/* bench 5311.0.2 3b7c1e4ba678 */
/* bench 5311.0.3 85043e9c5fcb */
/* bench 5311.0.4 093c5f544826 */
/* bench 5311.0.5 7a683128b895 */
/* bench 5311.0.6 656d7cf87fe0 */
properties:
- interrupts: interrupt of the XOR channel

The sub-nodes used to contain one or several of the following
properties, but they are now deprecated:
- dmacap,memcpy to indicate that the XOR channel is capable of memcpy operations
- dmacap,memset to indicate that the XOR channel is capable of memset operations
- dmacap,xor to indicate that the XOR channel is capable of xor operations
- dmacap,interrupt to indicate that the XOR channel is capable of
  generating interrupts

Example:

xor@d0060900 {
	compatible = "marvell,orion-xor";
	reg = <0xd0060900 0x100
	       0xd0060b00 0x100>;
	clocks = <&coreclk 0>;

	xor00 {
	      interrupts = <51>;
	};
	xor01 {
	      interrupts = <52>;
	};
};
```
