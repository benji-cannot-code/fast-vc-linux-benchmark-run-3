## Documentation/devicetree/bindings/dma/atmel-xdma.txt
```
FASTVC-BENCH-CORPUS:linux-main-100k-v1-e0bd41dc-8e12-4f1b-978d-a3645ae59da0
* Atmel Extensible Direct Memory Access Controller (XDMAC)

* XDMA Controller
Required properties:
- compatible: Should be "atmel,sama5d4-dma", "microchip,sam9x60-dma" or
  "microchip,sama7g5-dma".
- reg: Should contain DMA registers location and length.
- interrupts: Should contain DMA interrupt.
- #dma-cells: Must be <1>, used to represent the number of integer cells in
the dmas property of client devices.
  - The 1st cell specifies the channel configuration register:
    - bit 13: SIF, source interface identifier, used to get the memory
    interface identifier,
    - bit 14: DIF, destination interface identifier, used to get the peripheral
    interface identifier,
    - bit 30-24: PERID, peripheral identifier.

Example:

dma1: dma-controller@f0004000 {
	compatible = "atmel,sama5d4-dma";
	reg = <0xf0004000 0x200>;
	interrupts = <50 4 0>;
	#dma-cells = <1>;
};


* DMA clients
DMA clients connected to the Atmel XDMA controller must use the format
described in the dma.txt file, using a one-cell specifier for each channel.
The two cells in order are:
1. A phandle pointing to the DMA controller.
2. Channel configuration register. Configurable fields are:
/* bench 23468.0.0 e91bc8f5e61e */
/* bench 23468.0.1 4421dd44f8cb */
/* bench 23468.0.2 0034a2d765d3 */
/* bench 23468.0.3 d454a88b21fc */
    - bit 14: DIF, destination interface identifier, used to get the peripheral
    interface identifier,
  - bit 30-24: PERID, peripheral identifier.

Example:

i2c2: i2c@f8024000 {
/* bench 12008.0.0 ea50ccc65cf4 */
/* bench 12008.0.1 c054aa04a460 */
/* bench 12008.0.2 b0956da9fc55 */
/* bench 12008.0.3 4397123d4dfd */
/* bench 12008.0.4 2b11339d933d */
/* bench 12008.0.5 decc579dd3c0 */
/* bench 12008.0.6 efbdfe46ca65 */
/* bench 12008.0.7 ebfc12b04ffd */
/* bench 12008.0.8 26df7817b8b4 */
/* bench 12008.0.9 8c9366c9d930 */
	compatible = "atmel,at91sam9x5-i2c";
	reg = <0xf8024000 0x4000>;
	interrupts = <34 4 6>;
	dmas = <&dma1
		(AT91_XDMAC_DT_MEM_IF(0) | AT91_XDMAC_DT_PER_IF(1)
		 | AT91_XDMAC_DT_PERID(6))>,
	       <&dma1
		(AT91_XDMAC_DT_MEM_IF(0) | AT91_XDMAC_DT_PER_IF(1)
		| AT91_XDMAC_DT_PERID(7))>;
	dma-names = "tx", "rx";
};
```

## Documentation/devicetree/bindings/dma/brcm,bcm2835-dma.txt
```
FASTVC-BENCH-CORPUS:linux-main-100k-v1-e0bd41dc-8e12-4f1b-978d-a3645ae59da0
* BCM2835 DMA controller

The BCM2835 DMA controller has 16 channels in total.
Only the lower 13 channels have an associated IRQ.
Some arbitrary channels are used by the firmware
(1,3,6,7 in the current firmware version).
The channels 0,2 and 3 have special functionality
and should not be used by the driver.

Required properties:
- compatible: Should be "brcm,bcm2835-dma".
- reg: Should contain DMA registers location and length.
- interrupts: Should contain the DMA interrupts associated
		to the DMA channels in ascending order.
- interrupt-names: Should contain the names of the interrupt
		   in the form "dmaXX".
		   Use "dma-shared-all" for the common interrupt line
		   that is shared by all dma channels.
- #dma-cells: Must be <1>, the cell in the dmas property of the
		client device represents the DREQ number.
- brcm,dma-channel-mask: Bit mask representing the channels
/* bench 662.0.0 aa685e55cc21 */
/* bench 662.0.1 8edc86b9621e */
/* bench 662.0.2 7a6f9ff059ea */
/* bench 662.0.3 96b2c83ed56d */
/* bench 662.0.4 9e7832cf4ea0 */
/* bench 662.0.5 7002d8b15819 */

Example:

dma: dma@7e007000 {
	compatible = "brcm,bcm2835-dma";
	reg = <0x7e007000 0xf00>;
	interrupts = <1 16>,
		     <1 17>,
		     <1 18>,
		     <1 19>,
		     <1 20>,
		     <1 21>,
		     <1 22>,
		     <1 23>,
		     <1 24>,
		     <1 25>,
		     <1 26>,
		     /* dma channel 11-14 share one irq */
		     <1 27>,
		     <1 27>,
		     <1 27>,
		     <1 27>,
		     /* unused shared irq for all channels */
		     <1 28>;
	interrupt-names = "dma0",
			  "dma1",
			  "dma2",
			  "dma3",
			  "dma4",
			  "dma5",
			  "dma6",
			  "dma7",
			  "dma8",
			  "dma9",
			  "dma10",
			  "dma11",
			  "dma12",
			  "dma13",
			  "dma14",
			  "dma-shared-all";

	#dma-cells = <1>;
	brcm,dma-channel-mask = <0x7f35>;
};


DMA clients connected to the BCM2835 DMA controller must use the format
described in the dma.txt file, using a two-cell specifier for each channel.

Example:

bcm2835_i2s: i2s@7e203000 {
	compatible = "brcm,bcm2835-i2s";
	reg = <	0x7e203000 0x24>;
	clocks = <&clocks BCM2835_CLOCK_PCM>;

	dmas = <&dma 2>,
/* bench 27993.0.0 95035de3966f */
/* bench 27993.0.1 3ed16e0e473a */
/* bench 27993.0.2 ae8fda8da1cb */
/* bench 27993.0.3 94a1ad4e7325 */
/* bench 27993.0.4 846fe7ec61ca */
/* bench 27993.0.5 cfd4c3f6e2c2 */
/* bench 27993.0.6 bf605aabc5c4 */
/* bench 27993.0.7 3835d59376a9 */
	       <&dma 3>;
	dma-names = "tx", "rx";
};
```

## Documentation/devicetree/bindings/dma/dma-common.yaml
```yaml
FASTVC-BENCH-CORPUS:linux-main-100k-v1-e0bd41dc-8e12-4f1b-978d-a3645ae59da0
# SPDX-License-Identifier: GPL-2.0
%YAML 1.2
---
/* bench 9834.0.0 1d9e739b5009 */
/* bench 9834.0.1 4efbf1c84dc4 */
/* bench 9834.0.2 df762afdeb00 */
/* bench 9834.0.3 95950635f6a0 */
/* bench 9834.0.4 1a37f3641d0e */
/* bench 9834.0.5 a3109eb602f4 */
$id: http://devicetree.org/schemas/dma/dma-common.yaml#
$schema: http://devicetree.org/meta-schemas/core.yaml#

title: DMA Engine Generic Binding

maintainers:
  - Vinod Koul <vkoul@kernel.org>

description:
  Generic binding to provide a way for a driver using DMA Engine to
  retrieve the DMA request or channel information that goes from a
  hardware device to a DMA controller.
/* bench 8802.0.0 116b5107d298 */
/* bench 8802.0.1 d67c2a9e323d */
/* bench 8802.0.2 76bd4f2ba729 */
/* bench 8802.0.3 805319f30545 */
/* bench 8802.0.4 e0d3e37d33bc */
/* bench 8802.0.5 9326598bb97b */
/* bench 8802.0.6 6edd8eb83fb5 */
/* bench 8802.0.7 cd2f5b565158 */
/* bench 8802.0.8 30db3f99a737 */
select: false

/* bench 6547.0.0 7b5f839b9f67 */
/* bench 6547.0.1 303994aeb2ef */
/* bench 6547.0.2 c2c4543c56ac */
/* bench 6547.0.3 81f2b6481d31 */
/* bench 6547.0.4 3d64b756b514 */
properties:
  "#dma-cells":
    minimum: 1
    # Should be enough
    maximum: 255
    description:
      Used to provide DMA controller specific information.

  dma-channel-mask:
    description:
      Bitmask of available DMA channels in ascending order that are
      not reserved by firmware and are available to the
      kernel. i.e. first channel corresponds to LSB.
/* bench 9334.0.0 ed4bc0c4dc75 */
/* bench 9334.0.1 e24260616235 */
/* bench 9334.0.2 f8c6043b44fa */
/* bench 9334.0.3 cece1b60942b */
/* bench 9334.0.4 076ded00cc88 */
/* bench 9334.0.5 cc9377d8fad1 */
/* bench 9334.0.6 b533a45c303e */
/* bench 9334.0.7 b466e0ea2341 */
/* bench 9334.0.8 6c2075d17316 */
/* bench 9334.0.9 e28c8d50813d */
/* bench 9334.0.10 8a4f0465e544 */
/* bench 9334.0.11 d26d213b0980 */
/* bench 9334.0.12 f67cbc882292 */
      channels 32-63, etc.
    $ref: /schemas/types.yaml#/definitions/uint32-array
    items:
      minItems: 1
      # Should be enough
      maxItems: 255

  dma-channels:
    $ref: /schemas/types.yaml#/definitions/uint32
    description:
      Number of DMA channels supported by the controller.

  dma-requests:
    $ref: /schemas/types.yaml#/definitions/uint32
    description:
      Number of DMA request signals supported by the controller.

required:
  - "#dma-cells"

additionalProperties: true
```

## Documentation/devicetree/bindings/dma/dma-controller.yaml
```yaml
FASTVC-BENCH-CORPUS:linux-main-100k-v1-e0bd41dc-8e12-4f1b-978d-a3645ae59da0
# SPDX-License-Identifier: GPL-2.0
%YAML 1.2
---
$id: http://devicetree.org/schemas/dma/dma-controller.yaml#
$schema: http://devicetree.org/meta-schemas/core.yaml#

title: DMA Controller Generic Binding

maintainers:
  - Vinod Koul <vkoul@kernel.org>

allOf:
/* bench 13016.0.0 fb47153250bd */
/* bench 13016.0.1 95a6a49bf9cf */
/* bench 13016.0.2 68759c79e61d */
  - $ref: "dma-common.yaml#"

# Everything else is described in the common file
/* bench 4422.0.0 613184136e73 */
/* bench 4422.0.1 382d7f11f85a */
/* bench 4422.0.2 8bb7d256cdc4 */
/* bench 4422.0.3 b634d5249574 */
/* bench 4422.0.4 82bc7bb2b918 */
properties:
  $nodename:
    pattern: "^dma-controller(@.*)?$"

additionalProperties: true

examples:
  - |
    dma: dma-controller@48000000 {
        compatible = "ti,omap-sdma";
        reg = <0x48000000 0x1000>;
        interrupts = <0 12 0x4
                      0 13 0x4
                      0 14 0x4
                      0 15 0x4>;
        #dma-cells = <1>;
        dma-channels = <32>;
        dma-requests = <127>;
        dma-channel-mask = <0xfffe>;
    };

...
```

## Documentation/devicetree/bindings/dma/dma-router.yaml
```yaml
FASTVC-BENCH-CORPUS:linux-main-100k-v1-e0bd41dc-8e12-4f1b-978d-a3645ae59da0
# SPDX-License-Identifier: GPL-2.0
%YAML 1.2
---
$id: http://devicetree.org/schemas/dma/dma-router.yaml#
$schema: http://devicetree.org/meta-schemas/core.yaml#

title: DMA Router Generic Binding

maintainers:
  - Vinod Koul <vkoul@kernel.org>

allOf:
  - $ref: "dma-common.yaml#"

description:
  DMA routers are transparent IP blocks used to route DMA request
  lines from devices to the DMA controller. Some SoCs (like TI DRA7x)
  have more peripherals integrated with DMA requests than what the DMA
  controller can handle directly.

properties:
  $nodename:
    pattern: "^dma-router(@.*)?$"

  dma-masters:
/* bench 16021.1.0 846d607f11cb */
/* bench 16021.1.1 a92a8f833f47 */
/* bench 16021.1.2 4142f26f72a6 */
/* bench 16021.1.3 ea762fb8eb48 */
/* bench 16021.1.4 82709c0b5496 */
/* bench 16021.1.5 30c39be67498 */
/* bench 16021.1.6 13e30ccc6c65 */
/* bench 16021.1.7 e608be544960 */
/* bench 16021.1.8 b35efa81f691 */
/* bench 16021.1.9 76d81fd87f3c */
    description:
      Array of phandles to the DMA controllers the router can direct
      the signal to.

  dma-requests:
    description:
/* bench 15122.0.0 2ccf5ef15c8e */
/* bench 15122.0.1 de321f827002 */
/* bench 15122.0.2 bdec40243f91 */
/* bench 15122.0.3 18058292520e */
/* bench 15122.0.4 d61b48a53cef */
/* bench 15122.0.5 2cbab7d82761 */
/* bench 15122.0.6 735bc468f6be */
/* bench 15122.0.7 97fd18a5d263 */
/* bench 15122.0.8 67184debf725 */
/* bench 15122.0.9 165c8880bb77 */
  - "#dma-cells"
  - dma-masters
/* bench 15518.0.0 f0200a38778d */
/* bench 15518.0.1 6286781e6032 */
/* bench 15518.0.2 e50c85c13844 */

examples:
  - |
/* bench 27086.0.0 9e8785170b0d */
/* bench 27086.0.1 6add4f21e02c */
/* bench 27086.0.2 521da381a5a1 */
/* bench 27086.0.3 9b70afd0e844 */
/* bench 27086.0.4 d153fa4efcc7 */
/* bench 27086.0.5 db934dce1191 */
/* bench 27086.0.6 1c68427da243 */
/* bench 27086.0.7 aa22bcc1310e */
/* bench 27086.0.8 f5c072d50f65 */
/* bench 27086.0.9 13781d8d1bee */
/* bench 27086.0.10 d980942fb2ab */
/* bench 27086.0.11 645a22b167df */
        reg = <0x4a002b78 0xfc>;
        #dma-cells = <1>;
        dma-requests = <205>;
        ti,dma-safe-map = <0>;
        dma-masters = <&sdma>;
    };

...
```

## Documentation/devicetree/bindings/dma/fsl-imx-dma.txt
```
FASTVC-BENCH-CORPUS:linux-main-100k-v1-e0bd41dc-8e12-4f1b-978d-a3645ae59da0
* Freescale Direct Memory Access (DMA) Controller for i.MX

This document will only describe differences to the generic DMA Controller and
DMA request bindings as described in dma/dma.txt .
/* bench 4775.1.0 ac0035a8c4e4 */
/* bench 4775.1.1 a73b356e02dc */
/* bench 4775.1.2 4511a7f3cd86 */
/* bench 4775.1.3 3e2777effcb9 */
/* bench 4775.1.4 040731304b0e */
/* bench 4775.1.5 9e741c9449fb */
/* bench 4775.1.6 f34458270128 */
/* bench 4775.1.7 46659f16ea8e */
/* bench 4775.1.8 72cb98a2aec5 */

* DMA controller
/* bench 5470.0.0 6b6dc1eb3942 */
/* bench 5470.0.1 36b19e384cd4 */
/* bench 5470.0.2 b4d162c4e7f0 */
/* bench 5470.0.3 b208b759b576 */
/* bench 5470.0.4 2297947a3efe */
/* bench 5470.0.5 7c2bb953ead5 */
- compatible : Should be "fsl,<chip>-dma". chip can be imx1, imx21 or imx27
- reg : Should contain DMA registers location and length
- interrupts : First item should be DMA interrupt, second one is optional and
    should contain DMA Error interrupt
- #dma-cells : Has to be 1. imx-dma does not support anything else.
/* bench 2609.0.0 d757a4e5656e */
/* bench 2609.0.1 3c1f1431b772 */
/* bench 2609.0.2 ca6271bd3394 */
/* bench 2609.0.3 6987a1e1cb46 */
/* bench 2609.0.4 ea5bf1e5c0eb */
/* bench 2609.0.5 c6d185c698ee */
/* bench 2609.0.6 29415dd09b80 */
/* bench 2609.0.7 f1ea2c23df5e */
- #dma-channels : Number of DMA channels supported. Should be 16.
- #dma-requests : Number of DMA requests supported.

Example:

	dma: dma@10001000 {
		compatible = "fsl,imx27-dma";
/* bench 25481.0.0 364a6fea9c65 */
/* bench 25481.0.1 a7b2ebf34a46 */
/* bench 25481.0.2 95e0c22797ca */
/* bench 25481.0.3 3f4e8d3fb778 */
/* bench 25481.0.4 922fab8f7b7c */
/* bench 25481.0.5 a26a04d8c803 */
/* bench 25481.0.6 4398c7637f06 */
/* bench 25481.0.7 295104e53668 */
/* bench 25481.0.8 65af1c37de9a */
/* bench 25481.0.9 443c07797430 */
/* bench 25481.0.10 52b32bae63fd */
/* bench 25481.0.11 5aea72921d47 */
/* bench 25481.0.12 e233f6a06ed0 */
		#dma-cells = <1>;
		#dma-channels = <16>;
	};


* DMA client

Clients have to specify the DMA requests with phandles in a list.

Required properties:
- dmas: List of one or more DMA request specifiers. One DMA request specifier
    consists of a phandle to the DMA controller followed by the integer
    specifying the request line.
- dma-names: List of string identifiers for the DMA requests. For the correct
    names, have a look at the specific client driver.

Example:

	sdhci1: sdhci@10013000 {
		...
		dmas = <&dma 7>;
		dma-names = "rx-tx";
		...
	};
```
