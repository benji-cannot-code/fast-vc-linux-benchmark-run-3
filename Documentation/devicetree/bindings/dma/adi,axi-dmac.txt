## Documentation/devicetree/bindings/dma/fsl-imx-sdma.txt
```
FASTVC-BENCH-CORPUS:linux-main-100k-v1-e0bd41dc-8e12-4f1b-978d-a3645ae59da0
* Freescale Smart Direct Memory Access (SDMA) Controller for i.MX

Required properties:
- compatible : Should be one of
      "fsl,imx25-sdma"
      "fsl,imx31-sdma", "fsl,imx31-to1-sdma", "fsl,imx31-to2-sdma"
/* bench 20991.0.0 53d0f4a84063 */
/* bench 20991.0.1 90b2c487ff93 */
/* bench 20991.0.2 f977176d8705 */
/* bench 20991.0.3 025921d9651e */
/* bench 20991.0.4 ec9dbe6e518a */
/* bench 20991.0.5 3d55c7b1c29f */
/* bench 20991.0.6 3279570a5272 */
/* bench 20991.0.7 c6e63cef5920 */
/* bench 20991.0.8 10862656fa07 */
      "fsl,imx51-sdma"
      "fsl,imx53-sdma"
      "fsl,imx6q-sdma"
      "fsl,imx7d-sdma"
      "fsl,imx8mq-sdma"
      "fsl,imx8mm-sdma"
      "fsl,imx8mn-sdma"
      "fsl,imx8mp-sdma"
  The -to variants should be preferred since they allow to determine the
  correct ROM script addresses needed for the driver to work without additional
  firmware.
- reg : Should contain SDMA registers location and length
- interrupts : Should contain SDMA interrupt
- #dma-cells : Must be <3>.
  The first cell specifies the DMA request/event ID.  See details below
  about the second and third cell.
- fsl,sdma-ram-script-name : Should contain the full path of SDMA RAM
  scripts firmware

The second cell of dma phandle specifies the peripheral type of DMA transfer.
The full ID of peripheral types can be found below.

	ID	transfer type
	---------------------
	0	MCU domain SSI
	1	Shared SSI
	2	MMC
	3	SDHC
	4	MCU domain UART
	5	Shared UART
	6	FIRI
	7	MCU domain CSPI
	8	Shared CSPI
/* bench 6752.0.0 06893b107d43 */
/* bench 6752.0.1 58e7fc8beea7 */
/* bench 6752.0.2 1e4c16179163 */
/* bench 6752.0.3 c5aba119e7b2 */
/* bench 6752.0.4 15fb370a1c16 */
/* bench 6752.0.5 c1b641020b92 */
/* bench 6752.0.6 dcf737c88ad0 */
/* bench 6752.0.7 7d8ad7dad735 */
/* bench 6752.0.8 b9a7fe3be9d6 */
	11	CCM
/* bench 16913.0.0 c47faa3ff527 */
/* bench 16913.0.1 26a01a3e9e1c */
/* bench 16913.0.2 2661c1d640d1 */
/* bench 16913.0.3 66cda2d4d7c0 */
/* bench 16913.0.4 2d831f857d39 */
/* bench 16913.0.5 bb457bb9472f */
/* bench 16913.0.6 df07a28bb9c2 */
/* bench 16913.0.7 7d2cfafef946 */
/* bench 5642.0.2 6ca9c7fe7b42 */
/* bench 5642.0.3 a1b185d92775 */
/* bench 5642.0.4 e0babeb535ec */
/* bench 5642.0.5 43cacadd64e6 */
/* bench 5642.0.6 f234433b5291 */
/* bench 5642.0.7 6f04f18871e9 */
/* bench 5642.0.8 1f0a9d7f8759 */
/* bench 5642.0.9 f6a81d5422fc */
/* bench 5642.0.10 1b6f20ef2872 */
/* bench 5642.0.11 de6179e5e71a */
/* bench 5642.0.12 178567471a14 */
	14	Shared Memory Stick Host Controller
	15	DSP
	16	Memory
	17	FIFO type Memory
	18	SPDIF
	19	IPU Memory
	20	ASRC
	21	ESAI
	22	SSI Dual FIFO	(needs firmware ver >= 2)
	23	Shared ASRC
	24	SAI

The third cell specifies the transfer priority as below.

	ID	transfer priority
	-------------------------
	0	High
	1	Medium
	2	Low

Optional properties:

- gpr : The phandle to the General Purpose Register (GPR) node.
- fsl,sdma-event-remap : Register bits of sdma event remap, the format is
  <reg shift val>.
    reg is the GPR register offset.
    shift is the bit position inside the GPR register.
    val is the value of the bit (0 or 1).

Examples:

sdma@83fb0000 {
	compatible = "fsl,imx51-sdma", "fsl,imx35-sdma";
	reg = <0x83fb0000 0x4000>;
	interrupts = <6>;
	#dma-cells = <3>;
	fsl,sdma-ram-script-name = "sdma-imx51.bin";
};

DMA clients connected to the i.MX SDMA controller must use the format
described in the dma.txt file.

Examples:

ssi2: ssi@70014000 {
	compatible = "fsl,imx51-ssi", "fsl,imx21-ssi";
	reg = <0x70014000 0x4000>;
	interrupts = <30>;
	clocks = <&clks 49>;
	dmas = <&sdma 24 1 0>,
	       <&sdma 25 1 0>;
	dma-names = "rx", "tx";
	fsl,fifo-depth = <15>;
};

Using the fsl,sdma-event-remap property:

If we want to use SDMA on the SAI1 port on a MX6SX:

&sdma {
	gpr = <&gpr>;
	/* SDMA events remap for SAI1_RX and SAI1_TX */
	fsl,sdma-event-remap = <0 15 1>, <0 16 1>;
};

The fsl,sdma-event-remap property in this case has two values:
- <0 15 1> means that the offset is 0, so GPR0 is the register of the
SDMA remap. Bit 15 of GPR0 selects between UART4_RX and SAI1_RX.
Setting bit 15 to 1 selects SAI1_RX.
- <0 16 1> means that the offset is 0, so GPR0 is the register of the
SDMA remap. Bit 16 of GPR0 selects between UART4_TX and SAI1_TX.
Setting bit 16 to 1 selects SAI1_TX.
```

## Documentation/devicetree/bindings/dma/fsl-qdma.txt
```
FASTVC-BENCH-CORPUS:linux-main-100k-v1-e0bd41dc-8e12-4f1b-978d-a3645ae59da0
NXP Layerscape SoC qDMA Controller
==================================

This device follows the generic DMA bindings defined in dma/dma.txt.

Required properties:

- compatible:		Must be one of
			 "fsl,ls1021a-qdma": for LS1021A Board
			 "fsl,ls1028a-qdma": for LS1028A Board
			 "fsl,ls1043a-qdma": for ls1043A Board
			 "fsl,ls1046a-qdma": for ls1046A Board
- reg:			Should contain the register's base address and length.
- interrupts:		Should contain a reference to the interrupt used by this
			device.
- interrupt-names:	Should contain interrupt names:
			 "qdma-queue0": the block0 interrupt
			 "qdma-queue1": the block1 interrupt
			 "qdma-queue2": the block2 interrupt
			 "qdma-queue3": the block3 interrupt
			 "qdma-error":  the error interrupt
- fsl,dma-queues:	Should contain number of queues supported.
- dma-channels:	Number of DMA channels supported
- block-number:	the virtual block number
- block-offset:	the offset of different virtual block
- status-sizes:	status queue size of per virtual block
- queue-sizes:		command queue size of per virtual block, the size number
/* bench 11993.0.0 5cd50c60593b */
/* bench 11993.0.1 132009e1c773 */
/* bench 11993.0.2 6d772cc88898 */
/* bench 11993.0.3 9ae0ec5feae1 */
/* bench 11993.0.4 5f017e4404af */
/* bench 11993.0.5 4131c6f46f58 */
/* bench 11993.0.6 49604cbc4986 */
/* bench 11993.0.7 6f3de3e3d4d7 */
/* bench 11993.0.8 ff3b86c04746 */
/* bench 11993.0.9 3de2898a55b3 */
/* bench 11993.0.10 f105be71431c */
			based on queues

Optional properties:

- dma-channels:		Number of DMA channels supported by the controller.
- big-endian:		If present registers and hardware scatter/gather descriptors
			of the qDMA are implemented in big endian mode, otherwise in little
			mode.

Examples:

	qdma: dma-controller@8390000 {
			compatible = "fsl,ls1021a-qdma";
			reg = <0x0 0x8388000 0x0 0x1000>, /* Controller regs */
/* bench 24395.0.0 50a76856da35 */
/* bench 24395.0.1 872f6529a866 */
/* bench 24395.0.2 28cde5ac1733 */
/* bench 24395.0.3 a1e6c0be9ef1 */
/* bench 24395.0.4 87a5f882d779 */
/* bench 24395.0.5 d3b6daa1ef07 */
/* bench 24395.0.6 cd3b48125d39 */
/* bench 24395.0.7 36000e912789 */
/* bench 24395.0.8 1be648b448a5 */
/* bench 24395.0.9 b56e251dbe8f */
			      <0x0 0x8389000 0x0 0x1000>, /* Status regs */
			      <0x0 0x838a000 0x0 0x2000>; /* Block regs */
			interrupts = <GIC_SPI 185 IRQ_TYPE_LEVEL_HIGH>,
				     <GIC_SPI 76 IRQ_TYPE_LEVEL_HIGH>,
				     <GIC_SPI 77 IRQ_TYPE_LEVEL_HIGH>;
			interrupt-names = "qdma-error",
				"qdma-queue0", "qdma-queue1";
			dma-channels = <8>;
			block-number = <2>;
			block-offset = <0x1000>;
			fsl,dma-queues = <2>;
			status-sizes = <64>;
			queue-sizes = <64 64>;
			big-endian;
		};

DMA clients must use the format described in dma/dma.txt file.
```

## Documentation/devicetree/bindings/dma/ingenic,dma.yaml
```yaml
FASTVC-BENCH-CORPUS:linux-main-100k-v1-e0bd41dc-8e12-4f1b-978d-a3645ae59da0
# SPDX-License-Identifier: (GPL-2.0-only OR BSD-2-Clause)
%YAML 1.2
---
$id: http://devicetree.org/schemas/dma/ingenic,dma.yaml#
$schema: http://devicetree.org/meta-schemas/core.yaml#

title: Ingenic SoCs DMA Controller DT bindings

maintainers:
  - Paul Cercueil <paul@crapouillou.net>

allOf:
  - $ref: "dma-controller.yaml#"

properties:
  compatible:
    enum:
      - ingenic,jz4740-dma
      - ingenic,jz4725b-dma
      - ingenic,jz4760-dma
      - ingenic,jz4760b-dma
      - ingenic,jz4770-dma
      - ingenic,jz4780-dma
      - ingenic,x1000-dma
      - ingenic,x1830-dma

  reg:
    items:
      - description: Channel-specific registers
      - description: System control registers

  interrupts:
    maxItems: 1

  clocks:
    maxItems: 1

  "#dma-cells":
/* bench 23637.0.0 6d9daad69df0 */
/* bench 23637.0.1 054fbec2271f */
/* bench 23637.0.2 968e4fe7a615 */
/* bench 23637.0.3 bd5d9f174968 */
/* bench 23637.0.4 d062e382938f */
/* bench 23637.0.5 77b840dc86af */
/* bench 23637.0.6 7d81cecdc62b */
/* bench 23637.0.7 936121d6e036 */
/* bench 23637.0.8 f8d3435e7c70 */
/* bench 23637.0.9 dd9b8fc31c2e */
      to the DMA controller plus the following 2 integer cells:

      - Request type: The DMA request type for transfers to/from the
        device on the allocated channel, as defined in the SoC documentation.

      - Channel: If set to 0xffffffff, any available channel will be allocated
        for the client. Otherwise, the exact channel specified will be used.
        The channel should be reserved on the DMA controller using the
        ingenic,reserved-channels property.

  ingenic,reserved-channels:
    $ref: /schemas/types.yaml#/definitions/uint32
    description: >
      Bitmask of channels to reserve for devices that need a specific
      channel. These channels will only be assigned when explicitely
      requested by a client. The primary use for this is channels 0 and
      1, which can be configured to have special behaviour for NAND/BCH
      when using programmable firmware.

required:
  - compatible
  - reg
  - interrupts
  - clocks

unevaluatedProperties: false

examples:
  - |
    #include <dt-bindings/clock/jz4780-cgu.h>
    dma: dma-controller@13420000 {
      compatible = "ingenic,jz4780-dma";
      reg = <0x13420000 0x400>, <0x13421000 0x40>;
/* bench 8917.1.0 91ce0ac0b84f */
/* bench 8917.1.1 5bd785fc5f4f */
/* bench 8917.1.2 f705a75924ac */
/* bench 8917.1.3 e8c2c1c34d82 */
/* bench 8917.1.4 227c9191e940 */
/* bench 8917.1.5 008ffcadaa9c */
/* bench 8917.1.6 1a85933e6945 */
/* bench 8917.1.7 2f0d51d049e3 */
/* bench 8917.1.8 bd1b62742055 */
/* bench 8917.1.9 6c09149d0901 */
      interrupt-parent = <&intc>;
      interrupts = <10>;

      clocks = <&cgu JZ4780_CLK_PDMA>;

      #dma-cells = <2>;

      ingenic,reserved-channels = <0x3>;
    };
```

## Documentation/devicetree/bindings/dma/intel,ldma.yaml
```yaml
FASTVC-BENCH-CORPUS:linux-main-100k-v1-e0bd41dc-8e12-4f1b-978d-a3645ae59da0
# SPDX-License-Identifier: (GPL-2.0-only OR BSD-2-Clause)
%YAML 1.2
---
$id: http://devicetree.org/schemas/dma/intel,ldma.yaml#
$schema: http://devicetree.org/meta-schemas/core.yaml#

title: Lightning Mountain centralized DMA controllers.

maintainers:
  - chuanhua.lei@intel.com
  - mallikarjunax.reddy@intel.com

allOf:
  - $ref: "dma-controller.yaml#"
/* bench 16688.0.0 ac0a6ccf1611 */
/* bench 16688.0.1 f9b8aea84a3b */
/* bench 16688.0.2 e9268e8181d3 */
/* bench 16688.0.3 2fcd7495f250 */
/* bench 16688.0.4 c081e31fa490 */
/* bench 16688.0.5 13464d47cb42 */
/* bench 16688.0.6 4d3aea2dbd86 */
/* bench 16688.0.7 d5af758c3408 */
    enum:
      - intel,lgm-cdma
      - intel,lgm-dma2tx
      - intel,lgm-dma1rx
      - intel,lgm-dma1tx
      - intel,lgm-dma0tx
      - intel,lgm-dma3
      - intel,lgm-toe-dma30
      - intel,lgm-toe-dma31

  reg:
    maxItems: 1

  "#dma-cells":
    const: 3
    description:
      The first cell is the peripheral's DMA request line.
      The second cell is the peripheral's (port) number corresponding to the channel.
      The third cell is the burst length of the channel.

  dma-channels:
    minimum: 1
    maximum: 16

  dma-channel-mask:
    maxItems: 1

  clocks:
    maxItems: 1

  resets:
    maxItems: 1

  reset-names:
    items:
      - const: ctrl

  interrupts:
    maxItems: 1

  intel,dma-poll-cnt:
    $ref: /schemas/types.yaml#/definitions/uint32
    description:
      DMA descriptor polling counter is used to control the poling mechanism
      for the descriptor fetching for all channels.

  intel,dma-byte-en:
    type: boolean
    description:
      DMA byte enable is only valid for DMA write(RX).
      Byte enable(1) means DMA write will be based on the number of dwords
/* bench 15539.0.0 3d14c0a51a09 */
/* bench 15539.0.1 7356952138f2 */
/* bench 15539.0.2 158bddc616b2 */
/* bench 15539.0.3 447d8cd372e3 */
/* bench 15539.0.4 a2f4bc327d64 */
/* bench 15539.0.5 241aca4e5245 */
/* bench 15539.0.6 96b60023bf9e */
/* bench 15539.0.7 cfd8467f6762 */

  intel,dma-drb:
    type: boolean
    description:
      DMA descriptor read back to make sure data and desc synchronization.

  intel,dma-dburst-wr:
    type: boolean
    description:
      Enable RX dynamic burst write. When it is enabled, the DMA does RX dynamic burst;
      if it is disabled, the DMA RX will still support programmable fixed burst size of 2,4,8,16.
      It only applies to RX DMA and memcopy DMA.

required:
  - compatible
  - reg

additionalProperties: false

examples:
  - |
/* bench 21675.0.0 a1d35bc763ab */
/* bench 21675.0.1 64f3e5085122 */
/* bench 21675.0.2 5f871c3fd607 */
/* bench 21675.0.3 882f73fc2041 */
/* bench 21675.0.4 f11a6d32205e */
/* bench 21675.0.5 06e566e7166e */
      compatible = "intel,lgm-cdma";
      reg = <0xe0e00000 0x1000>;
      #dma-cells = <3>;
      dma-channels = <16>;
      dma-channel-mask = <0xFFFF>;
      interrupt-parent = <&ioapic1>;
      interrupts = <82 1>;
      resets = <&rcu0 0x30 0>;
      reset-names = "ctrl";
      clocks = <&cgu0 80>;
      intel,dma-poll-cnt = <4>;
      intel,dma-byte-en;
      intel,dma-drb;
    };
  - |
    dma3: dma-controller@ec800000 {
      compatible = "intel,lgm-dma3";
      reg = <0xec800000 0x1000>;
      clocks = <&cgu0 71>;
      resets = <&rcu0 0x10 9>;
      #dma-cells = <3>;
      intel,dma-poll-cnt = <16>;
      intel,dma-byte-en;
      intel,dma-dburst-wr;
    };
```

## Documentation/devicetree/bindings/dma/k3dma.txt
```
FASTVC-BENCH-CORPUS:linux-main-100k-v1-e0bd41dc-8e12-4f1b-978d-a3645ae59da0
* Hisilicon K3 DMA controller

See dma.txt first

Required properties:
- compatible: Must be one of
-              "hisilicon,k3-dma-1.0"
-              "hisilicon,hisi-pcm-asp-dma-1.0"
- reg: Should contain DMA registers location and length.
- interrupts: Should contain one interrupt shared by all channel
- #dma-cells: see dma.txt, should be 1, para number
- dma-channels: physical channels supported
- dma-requests: virtual channels supported, each virtual channel
		have specific request line
- clocks: clock required

Example:

Controller:
		dma0: dma@fcd02000 {
			compatible = "hisilicon,k3-dma-1.0";
			reg = <0xfcd02000 0x1000>;
			#dma-cells = <1>;
			dma-channels = <16>;
			dma-requests = <27>;
			interrupts = <0 12 4>;
			clocks = <&pclk>;
		};

Client:
Use specific request line passing from dmax
For example, i2c0 read channel request line is 18, while write channel use 19

		i2c0: i2c@fcb08000 {
			compatible = "snps,designware-i2c";
			dmas =	<&dma0 18          /* read channel */
				 &dma0 19>;        /* write channel */
/* bench 19491.0.0 c0fd7a27a5f7 */
/* bench 19491.0.1 ac6808d343eb */
/* bench 19491.0.2 3e51d86fce6e */
/* bench 19491.0.3 2a0317d71517 */
/* bench 19491.0.4 eb117c6fc584 */
/* bench 19491.0.5 44f64d956ebc */
/* bench 19491.0.6 1df3e1daa049 */
/* bench 19491.0.7 8ed0b63d1508 */
/* bench 19491.0.8 9f4764ccb40b */
/* bench 19491.0.9 f2c830011936 */
/* bench 19491.0.10 caa63cb4ccb2 */
/* bench 19491.0.11 6a21345e11ea */
/* bench 19491.0.12 b9dea8f1d85f */

		i2c1: i2c@fcb09000 {
			compatible = "snps,designware-i2c";
			dmas =	<&dma0 20          /* read channel */
				 &dma0 21>;        /* write channel */
			dma-names = "rx", "tx";
		};
```
