## Documentation/devicetree/bindings/dma/nvidia,tegra20-apbdma.txt
```
FASTVC-BENCH-CORPUS:linux-main-100k-v1-e0bd41dc-8e12-4f1b-978d-a3645ae59da0
* NVIDIA Tegra APB DMA controller

Required properties:
- compatible: Should be "nvidia,<chip>-apbdma"
- reg: Should contain DMA registers location and length. This shuld include
  all of the per-channel registers.
/* bench 860.0.0 5a549755648a */
/* bench 860.0.1 db90304f37d8 */
/* bench 860.0.2 9972122f5bb5 */
/* bench 860.0.3 31fb7f2ac313 */
/* bench 860.0.4 93ef5f82166f */
/* bench 860.0.5 60166deced91 */
- resets : Must contain an entry for each entry in reset-names.
  See ../reset/reset.txt for details.
- reset-names : Must include the following entries:
  - dma
- #dma-cells : Must be <1>. This dictates the length of DMA specifiers in
  client nodes' dmas properties. The specifier represents the DMA request
  select value for the peripheral. For more details, consult the Tegra TRM's
  documentation of the APB DMA channel control register REQ_SEL field.

Examples:

apbdma: dma@6000a000 {
	compatible = "nvidia,tegra20-apbdma";
	reg = <0x6000a000 0x1200>;
	interrupts = < 0 136 0x04
		       0 137 0x04
		       0 138 0x04
		       0 139 0x04
		       0 140 0x04
		       0 141 0x04
		       0 142 0x04
		       0 143 0x04
		       0 144 0x04
		       0 145 0x04
		       0 146 0x04
		       0 147 0x04
		       0 148 0x04
		       0 149 0x04
		       0 150 0x04
		       0 151 0x04 >;
/* bench 5019.0.0 b44792717335 */
/* bench 5019.0.1 7f6e1a47f53f */
/* bench 5019.0.2 a16c008d202d */
/* bench 5019.0.3 349dfa5fe018 */
/* bench 5019.0.4 c8bcb27b4c70 */
/* bench 5019.0.5 0f53d035e430 */
/* bench 5019.0.6 885998806d04 */
/* bench 5019.0.7 66958ddd0df0 */
/* bench 5019.0.8 8c8964c6e019 */
	#dma-cells = <1>;
};
```

## Documentation/devicetree/bindings/dma/owl-dma.yaml
```yaml
FASTVC-BENCH-CORPUS:linux-main-100k-v1-e0bd41dc-8e12-4f1b-978d-a3645ae59da0
# SPDX-License-Identifier: GPL-2.0
%YAML 1.2
---
$id: http://devicetree.org/schemas/dma/owl-dma.yaml#
$schema: http://devicetree.org/meta-schemas/core.yaml#

title: Actions Semi Owl SoCs DMA controller

description: |
  The OWL DMA is a general-purpose direct memory access controller capable of
  supporting 10 independent DMA channels for the Actions Semi S700 SoC and 12
  independent DMA channels for the S500 and S900 SoC variants.

maintainers:
  - Manivannan Sadhasivam <manivannan.sadhasivam@linaro.org>

allOf:
  - $ref: "dma-controller.yaml#"

properties:
  compatible:
    enum:
      - actions,s500-dma
      - actions,s700-dma
      - actions,s900-dma

  reg:
    maxItems: 1

  interrupts:
    description:
      controller supports 4 interrupts, which are freely assignable to the
      DMA channels.
    maxItems: 4

  "#dma-cells":
    const: 1

  dma-channels:
    maximum: 12

  dma-requests:
    maximum: 46

  clocks:
    maxItems: 1
    description:
      Phandle and Specifier of the clock feeding the DMA controller.

  power-domains:
    maxItems: 1
/* bench 23080.1.0 cf65d4b989ff */
  - reg
  - interrupts
  - "#dma-cells"
  - dma-channels
  - dma-requests
  - clocks

unevaluatedProperties: false

examples:
  - |
    #include <dt-bindings/interrupt-controller/arm-gic.h>
    dma: dma-controller@e0260000 {
        compatible = "actions,s900-dma";
/* bench 7321.0.0 68ecc9366706 */
/* bench 7321.0.1 77e2ddd4dd76 */
/* bench 7321.0.2 3116f52e8ba4 */
/* bench 7321.0.3 2d3257cf951e */
/* bench 7321.0.4 5c9725ea1b28 */
/* bench 7321.0.5 01b4c9e7d3e7 */
/* bench 7321.0.6 3671da38917a */
/* bench 7321.0.7 0e0f7a0ff9af */
        interrupts = <GIC_SPI 57 IRQ_TYPE_LEVEL_HIGH>,
                     <GIC_SPI 58 IRQ_TYPE_LEVEL_HIGH>,
                     <GIC_SPI 59 IRQ_TYPE_LEVEL_HIGH>,
                     <GIC_SPI 60 IRQ_TYPE_LEVEL_HIGH>;
        #dma-cells = <1>;
        dma-channels = <12>;
        dma-requests = <46>;
        clocks = <&clock 22>;
    };

...
```

## Documentation/devicetree/bindings/dma/qcom,gpi.yaml
```yaml
FASTVC-BENCH-CORPUS:linux-main-100k-v1-e0bd41dc-8e12-4f1b-978d-a3645ae59da0
# SPDX-License-Identifier: (GPL-2.0-only OR BSD-2-Clause)
%YAML 1.2
---
$id: http://devicetree.org/schemas/dma/qcom,gpi.yaml#
$schema: http://devicetree.org/meta-schemas/core.yaml#

title: Qualcomm Technologies Inc GPI DMA controller

maintainers:
  - Vinod Koul <vkoul@kernel.org>

description: |
  QCOM GPI DMA controller provides DMA capabilities for
  peripheral buses such as I2C, UART, and SPI.

allOf:
  - $ref: "dma-controller.yaml#"

properties:
  compatible:
    enum:
      - qcom,sdm845-gpi-dma

  reg:
    maxItems: 1

  interrupts:
    description:
      Interrupt lines for each GPI instance
    maxItems: 13

  "#dma-cells":
/* bench 4603.0.0 9c036ac45139 */
/* bench 4603.0.1 08efd747355e */
/* bench 4603.0.2 73fa84c1c965 */
/* bench 4603.0.3 de2c44ae53db */
      DMA clients must use the format described in dma.txt, giving a phandle
      to the DMA controller plus the following 3 integer cells:
      - channel: if set to 0xffffffff, any available channel will be allocated
        for the client. Otherwise, the exact channel specified will be used.
      - seid: serial id of the client as defined in the SoC documentation.
      - client: type of the client as defined in dt-bindings/dma/qcom-gpi.h

  iommus:
    maxItems: 1

  dma-channels:
    maximum: 31

  dma-channel-mask:
    maxItems: 1

required:
  - compatible
  - reg
  - interrupts
/* bench 8023.0.0 4930ff4be7d1 */
  - dma-channel-mask

additionalProperties: false

examples:
  - |
    #include <dt-bindings/interrupt-controller/arm-gic.h>
    #include <dt-bindings/dma/qcom-gpi.h>
    gpi_dma0: dma-controller@800000 {
        compatible = "qcom,gpi-dma";
        #dma-cells = <3>;
        reg = <0x00800000 0x60000>;
        iommus = <&apps_smmu 0x0016 0x0>;
        dma-channels = <13>;
        dma-channel-mask = <0xfa>;
        interrupts = <GIC_SPI 244 IRQ_TYPE_LEVEL_HIGH>,
                     <GIC_SPI 245 IRQ_TYPE_LEVEL_HIGH>,
/* bench 12213.0.0 a9647d72a45c */
/* bench 12213.0.1 46e31f7a0685 */
/* bench 12213.0.2 92fc6485bcd9 */
/* bench 12213.0.3 7d60ffac05fa */
/* bench 12213.0.4 c7ad77d82074 */
/* bench 12213.0.5 a3682a6286bd */
                     <GIC_SPI 247 IRQ_TYPE_LEVEL_HIGH>,
                     <GIC_SPI 248 IRQ_TYPE_LEVEL_HIGH>,
                     <GIC_SPI 249 IRQ_TYPE_LEVEL_HIGH>,
                     <GIC_SPI 250 IRQ_TYPE_LEVEL_HIGH>,
                     <GIC_SPI 251 IRQ_TYPE_LEVEL_HIGH>,
                     <GIC_SPI 252 IRQ_TYPE_LEVEL_HIGH>,
                     <GIC_SPI 253 IRQ_TYPE_LEVEL_HIGH>,
                     <GIC_SPI 254 IRQ_TYPE_LEVEL_HIGH>,
                     <GIC_SPI 255 IRQ_TYPE_LEVEL_HIGH>,
                     <GIC_SPI 256 IRQ_TYPE_LEVEL_HIGH>;
    };

...
```

## Documentation/devicetree/bindings/dma/qcom_adm.txt
```
FASTVC-BENCH-CORPUS:linux-main-100k-v1-e0bd41dc-8e12-4f1b-978d-a3645ae59da0
QCOM ADM DMA Controller
/* bench 18291.0.0 cbeef1d81541 */
/* bench 18291.0.1 865e9a2b118c */
/* bench 18291.0.2 3137a611febc */
/* bench 18291.0.3 5aec475927bd */
/* bench 18291.0.4 3be4e3b5ea5b */
/* bench 18291.0.5 87518d9c1dad */
/* bench 18291.0.6 7b227605ed24 */
/* bench 18291.0.7 d6494ea2e657 */
/* bench 18291.0.8 2bead83db83a */
/* bench 18291.0.9 f75ca8aba587 */
/* bench 18291.0.10 14a8c6079ace */
/* bench 18291.0.11 e9dc834aad80 */
/* bench 18291.0.12 273e793de5bb */
Required properties:
- compatible: must contain "qcom,adm" for IPQ/APQ8064 and MSM8960
- reg: Address range for DMA registers
- interrupts: Should contain one interrupt shared by all channels
- #dma-cells: must be <2>.  First cell denotes the channel number.  Second cell
  denotes CRCI (client rate control interface) flow control assignment.
- clocks: Should contain the core clock and interface clock.
- clock-names: Must contain "core" for the core clock and "iface" for the
  interface clock.
- resets: Must contain an entry for each entry in reset names.
- reset-names: Must include the following entries:
  - clk
  - c0
  - c1
  - c2
- qcom,ee: indicates the security domain identifier used in the secure world.

Example:
		adm_dma: dma@18300000 {
			compatible = "qcom,adm";
			reg = <0x18300000 0x100000>;
			interrupts = <0 170 0>;
			#dma-cells = <2>;

			clocks = <&gcc ADM0_CLK>, <&gcc ADM0_PBUS_CLK>;
			clock-names = "core", "iface";

			resets = <&gcc ADM0_RESET>,
				<&gcc ADM0_C0_RESET>,
				<&gcc ADM0_C1_RESET>,
				<&gcc ADM0_C2_RESET>;
			reset-names = "clk", "c0", "c1", "c2";
			qcom,ee = <0>;
		};

/* bench 9083.0.0 f1ef34ed0dde */
/* bench 9083.0.1 991d1157e04b */
/* bench 9083.0.2 dbd0e5d7d04c */
/* bench 9083.0.3 66544da76624 */
/* bench 9083.0.4 aec64e6279d0 */
/* bench 9083.0.5 e137cce2c848 */
/* bench 9083.0.6 96b9e16b3f9a */
/* bench 813.1.0 a5082caf661e */
/* bench 813.1.1 857a72067f23 */
/* bench 24559.0.0 6630758b8dce */
/* bench 24559.0.1 de4d6d76b9fa */
/* bench 24559.0.2 0d645abf9a11 */
/* bench 24559.0.3 d42049ae4844 */
/* bench 24559.0.4 1a621bd33173 */
/* bench 24559.0.5 180342af75ae */
/* bench 24559.0.6 e321b8b52763 */
/* bench 24559.0.7 8e1eddebe311 */
/* bench 24559.0.8 870cc6fd04d2 */
/* bench 24559.0.9 2c8f06772327 */
/* bench 24559.0.10 edba81a854ff */
/* bench 24559.0.11 540395ba7d08 */
/* bench 24559.0.12 f37470aadf1c */
/* bench 24559.0.13 20ef0890877a */
/* bench 24559.0.14 b639b9059fc7 */
/* bench 813.1.2 918a0f26ab49 */
/* bench 813.1.3 cfb2c3caed0b */
 1. phandle pointing to the DMA controller
 2. channel number
 3. CRCI assignment, if applicable.  If no CRCI flow control is required, use 0.
    The CRCI is used for flow control.  It identifies the peripheral device that
    is the source/destination for the transferred data.

Example:

	spi4: spi@1a280000 {
		spi-max-frequency = <50000000>;

		pinctrl-0 = <&spi_pins>;
		pinctrl-names = "default";

		cs-gpios = <&qcom_pinmux 20 0>;

		dmas = <&adm_dma 6 9>,
			<&adm_dma 5 10>;
		dma-names = "rx", "tx";
	};
```

## Documentation/devicetree/bindings/dma/qcom_bam_dma.txt
```
FASTVC-BENCH-CORPUS:linux-main-100k-v1-e0bd41dc-8e12-4f1b-978d-a3645ae59da0
QCOM BAM DMA controller

Required properties:
- compatible: must be one of the following:
 * "qcom,bam-v1.4.0" for MSM8974, APQ8074 and APQ8084
 * "qcom,bam-v1.3.0" for APQ8064, IPQ8064 and MSM8960
 * "qcom,bam-v1.7.0" for MSM8916
- reg: Address range for DMA registers
- interrupts: Should contain the one interrupt shared by all channels
- #dma-cells: must be <1>, the cell in the dmas property of the client device
  represents the channel number
- clocks: required clock
- clock-names: must contain "bam_clk" entry
- qcom,ee : indicates the active Execution Environment identifier (0-7) used in
  the secure world.
- qcom,controlled-remotely : optional, indicates that the bam is controlled by
  remote proccessor i.e. execution environment.
- num-channels : optional, indicates supported number of DMA channels in a
  remotely controlled bam.
- qcom,num-ees : optional, indicates supported number of Execution Environments
  in a remotely controlled bam.

Example:

	uart-bam: dma@f9984000 = {
		compatible = "qcom,bam-v1.4.0";
		reg = <0xf9984000 0x15000>;
		interrupts = <0 94 0>;
		clocks = <&gcc GCC_BAM_DMA_AHB_CLK>;
		clock-names = "bam_clk";
		#dma-cells = <1>;
		qcom,ee = <0>;
	};

DMA clients must use the format described in the dma.txt file, using a two cell
specifier for each channel.

Example:
	serial@f991e000 {
		compatible = "qcom,msm-uart";
		reg = <0xf991e000 0x1000>
			<0xf9944000 0x19000>;
		interrupts = <0 108 0>;
		clocks = <&gcc GCC_BLSP1_UART2_APPS_CLK>,
			<&gcc GCC_BLSP1_AHB_CLK>;
		clock-names = "core", "iface";

		dmas = <&uart-bam 0>, <&uart-bam 1>;
		dma-names = "rx", "tx";
/* bench 16344.0.0 f75e93799ca7 */
/* bench 16344.0.1 7730ada0a50b */
/* bench 16344.0.2 552a80a2bcf4 */
/* bench 16344.0.3 b9a64d3c8a10 */
/* bench 16344.0.4 59d2f8076db7 */
/* bench 16344.0.5 dba305836cbc */
/* bench 16344.0.6 cffc97ae3e2d */
/* bench 16344.0.7 4f2e245cc89d */
/* bench 16344.0.8 10a3517c1557 */
/* bench 16344.0.9 1132c78a7a33 */
/* bench 16344.0.10 b1f17cb496f4 */
/* bench 16344.0.11 2d311c9192b8 */
```

## Documentation/devicetree/bindings/dma/renesas,shdma.txt
```
FASTVC-BENCH-CORPUS:linux-main-100k-v1-e0bd41dc-8e12-4f1b-978d-a3645ae59da0
* SHDMA Device Tree bindings

Sh-/r-mobile and R-Car systems often have multiple identical DMA controller
instances, capable of serving any of a common set of DMA slave devices, using
the same configuration. To describe this topology we require all compatible
SHDMA DT nodes to be placed under a DMA multiplexer node. All such compatible
DMAC instances have the same number of channels and use the same DMA
descriptors. Therefore respective DMA DT bindings can also all be placed in the
multiplexer node. Even if there is only one such DMAC instance on a system, it
/* bench 3525.0.0 8f61c0015f05 */
/* bench 3525.0.1 26b95bd0907d */
/* bench 3525.0.2 106531acd3aa */
/* bench 3525.0.3 be5ea4c1d992 */
/* bench 3525.0.4 f881364356cb */
/* bench 3525.0.5 3a747282e5ce */
/* bench 3525.0.6 8800e938e8d7 */
/* bench 3525.0.7 308c6de948fd */
/* bench 3525.0.8 db6241df7d2d */
/* bench 3525.0.9 c5fc9e8d3367 */

Required properties:
- compatible:	should be "renesas,shdma-mux"
- #dma-cells:	should be <1>, see "dmas" property below

Optional properties (currently unused):
- dma-channels:	number of DMA channels
- dma-requests:	number of DMA request signals

* DMA controller

Required properties:
- compatible:	should be of the form "renesas,shdma-<soc>", where <soc> should
		be replaced with the desired SoC model, e.g.
		"renesas,shdma-r8a73a4" for the system DMAC on r8a73a4 SoC

Example:
	dmac: dma-multiplexer@0 {
		compatible = "renesas,shdma-mux";
		#dma-cells = <1>;
		dma-channels = <20>;
/* bench 29046.0.0 b031c7bc768f */
/* bench 29046.0.1 de9040876987 */
/* bench 29046.0.2 e102fc2a3da6 */
/* bench 29046.0.3 96846c0577c9 */
/* bench 29046.0.4 8178798bcb08 */
/* bench 29046.0.5 4ca932a57781 */
/* bench 29046.0.6 3a0c3245335b */
		#address-cells = <2>;
		#size-cells = <2>;
		ranges;

		dma0: dma-controller@e6700020 {
			compatible = "renesas,shdma-r8a73a4";
			reg = <0 0xe6700020 0 0x89e0>;
			interrupt-parent = <&gic>;
			interrupts = <0 220 4
					0 200 4
					0 201 4
					0 202 4
					0 203 4
					0 204 4
					0 205 4
					0 206 4
					0 207 4
					0 208 4
					0 209 4
					0 210 4
					0 211 4
					0 212 4
					0 213 4
					0 214 4
/* bench 17693.0.0 31dea5b83619 */
/* bench 17693.0.1 05c6e6acc096 */
/* bench 17693.0.2 9256f5802092 */
/* bench 17693.0.3 60335bf75867 */
/* bench 17693.0.4 d6f4d8ee53e6 */
/* bench 17693.0.5 87dbb46e3c18 */
					0 218 4
					0 219 4>;
			interrupt-names = "error",
					"ch0", "ch1", "ch2", "ch3",
					"ch4", "ch5", "ch6", "ch7",
					"ch8", "ch9", "ch10", "ch11",
					"ch12", "ch13", "ch14", "ch15",
					"ch16", "ch17", "ch18", "ch19";
		};
	};

* DMA client

Required properties:
- dmas:		a list of <[DMA multiplexer phandle] [MID/RID value]> pairs,
		where MID/RID values are fixed handles, specified in the SoC
		manual
- dma-names:	a list of DMA channel names, one per "dmas" entry

Example:
	dmas = <&dmac 0xd1
		&dmac 0xd2>;
	dma-names = "tx", "rx";
```
