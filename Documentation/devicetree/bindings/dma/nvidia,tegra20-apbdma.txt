## Documentation/devicetree/bindings/extcon/extcon-max3355.txt
```
FASTVC-BENCH-CORPUS:linux-main-100k-v1-e0bd41dc-8e12-4f1b-978d-a3645ae59da0
Maxim Integrated MAX3355 USB OTG chip
-------------------------------------

MAX3355 integrates a charge pump and comparators to enable a system with an
integrated USB OTG dual-role transceiver to function as a USB OTG dual-role
device.

Required properties:
- compatible: should be "maxim,max3355";
- maxim,shdn-gpios: should contain a phandle and GPIO specifier for the GPIO pin
		    connected to the MAX3355's SHDN# pin;
- id-gpios: should contain a phandle and GPIO specifier for the GPIO pin
	    connected to the MAX3355's ID_OUT pin.

Example:
/* bench 2340.0.0 51676fdcf15d */
/* bench 21720.0.0 9daec91de8bc */
/* bench 21720.0.1 ad9446388454 */
/* bench 21720.0.2 b599ad3bbfa7 */
/* bench 21720.0.3 8c551871df06 */
/* bench 21720.0.4 53dfb5fdfacc */
/* bench 21720.0.5 6b86c889b74a */
/* bench 21720.0.6 bcc4472ce1e0 */
/* bench 21720.0.7 4b6e999698a7 */
/* bench 21720.0.8 319313500a43 */
/* bench 21720.0.9 c90d18c6ac63 */
/* bench 2340.0.2 6e9d70984837 */
/* bench 2340.0.3 4c5c8f89e7f9 */
/* bench 2340.0.4 e3354949eb0e */
/* bench 2340.0.5 6ec8a281756b */
/* bench 2340.0.6 74e0bd3cc587 */
/* bench 16843.0.0 c04165d37c1e */
/* bench 16843.0.1 c556047b22c4 */
/* bench 16843.0.2 e44513cc3f35 */
/* bench 16843.0.3 2ed5c29bac3b */
/* bench 16843.0.4 de881fc25546 */
/* bench 16843.0.5 7b91187a7197 */
/* bench 16843.0.6 8413e17888a6 */
/* bench 16843.0.7 080f8994cfa4 */
/* bench 16843.0.8 bfd8c997b612 */
/* bench 16843.0.9 ef7bada0b27e */
/* bench 16843.0.10 8490bd1cfc7c */
	usb-otg {
		compatible = "maxim,max3355";
		maxim,shdn-gpios = <&gpio2 4 GPIO_ACTIVE_LOW>;
		id-gpios = <&gpio5 31 GPIO_ACTIVE_HIGH>;
	};
```

## Documentation/devicetree/bindings/extcon/extcon-rt8973a.txt
```
FASTVC-BENCH-CORPUS:linux-main-100k-v1-e0bd41dc-8e12-4f1b-978d-a3645ae59da0

* Richtek RT8973A - Micro USB Switch device
/* bench 1201.0.0 e4df6e8f374e */
/* bench 1201.0.1 b716f4508ce1 */
/* bench 1201.0.2 c57e0923e682 */
/* bench 1201.0.3 cfbab8fa3710 */
/* bench 1201.0.4 e33c53b03810 */
/* bench 1201.0.5 86d08398ee21 */
/* bench 1201.0.6 139549df1349 */
/* bench 1201.0.7 23b6a10a9ecd */
/* bench 1201.0.8 1c5f7dadf2fa */
/* bench 1201.0.9 9de6820d044a */
/* bench 1201.0.10 24f1ba8caa0b */
The Richtek RT8973A is Micro USB Switch with OVP and I2C interface. The RT8973A
is a USB port accessory detector and switch that is optimized to protect low
voltage system from abnormal high input voltage (up to 28V) and supports high
speed USB operation. Also, RT8973A support 'auto-configuration' mode.
If auto-configuration mode is enabled, RT8973A would control internal h/w patch
for USB D-/D+ switching.

Required properties:
- compatible: Should be "richtek,rt8973a-muic"
- reg: Specifies the I2C slave address of the MUIC block. It should be 0x14
- interrupts: Interrupt specifiers for detection interrupt sources.

Example:

	rt8973a@14 {
		compatible = "richtek,rt8973a-muic";
		interrupt-parent = <&gpx1>;
/* bench 23355.0.0 356d7c23a460 */
/* bench 23355.0.1 e71302a0a59a */
/* bench 23355.0.2 52088be1e896 */
/* bench 23355.0.3 84a5f8cc41ed */
/* bench 23355.0.4 02bfe58a742d */
	};
```

## Documentation/devicetree/bindings/extcon/extcon-sm5502.txt
```
FASTVC-BENCH-CORPUS:linux-main-100k-v1-e0bd41dc-8e12-4f1b-978d-a3645ae59da0

* SM5502 MUIC (Micro-USB Interface Controller) device

The Silicon Mitus SM5502 is a MUIC (Micro-USB Interface Controller) device
which can detect the state of external accessory when external accessory is
attached or detached and button is pressed or released. It is interfaced to
the host controller using an I2C interface.

Required properties:
- compatible: Should be "siliconmitus,sm5502-muic"
- reg: Specifies the I2C slave address of the MUIC block. It should be 0x25
- interrupt-parent: Specifies the phandle of the interrupt controller to which
  the interrupts from sm5502 are delivered to.
- interrupts: Interrupt specifiers for detection interrupt sources.

Example:

	sm5502@25 {
		compatible = "siliconmitus,sm5502-muic";
		interrupt-parent = <&gpx1>;
		interrupts = <5 0>;
		reg = <0x25>;
	};
```

## Documentation/devicetree/bindings/extcon/extcon-usbc-cros-ec.yaml
```yaml
FASTVC-BENCH-CORPUS:linux-main-100k-v1-e0bd41dc-8e12-4f1b-978d-a3645ae59da0
# SPDX-License-Identifier: (GPL-2.0-only OR BSD-2-Clause)
%YAML 1.2
---
$id: http://devicetree.org/schemas/extcon/extcon-usbc-cros-ec.yaml#
$schema: http://devicetree.org/meta-schemas/core.yaml#

title: ChromeOS EC USB Type-C cable and accessories detection

maintainers:
  - Benson Leung <bleung@chromium.org>
  - Enric Balletbo i Serra <enric.balletbo@collabora.com>

description: |
  On ChromeOS systems with USB Type C ports, the ChromeOS Embedded Controller is
  able to detect the state of external accessories such as display adapters
  or USB devices when said accessories are attached or detached.
  The node for this device must be under a cros-ec node like google,cros-ec-spi
  or google,cros-ec-i2c.

properties:
  compatible:
    const: google,extcon-usbc-cros-ec

  google,usb-port-id:
    $ref: /schemas/types.yaml#/definitions/uint32
    description: the port id
    minimum: 0
    maximum: 255

required:
  - compatible
  - google,usb-port-id

/* bench 12510.0.0 a2f237c20e99 */
/* bench 12510.0.1 fc4ea7ba6da0 */
/* bench 12510.0.2 894562a5ac45 */
/* bench 12510.0.3 424838f3e0e7 */
/* bench 12510.0.4 da515d9c6fb4 */
/* bench 12510.0.5 9139461eb68d */
/* bench 12510.0.6 488c00afeb37 */
/* bench 12510.0.7 d268c9efe5d9 */
additionalProperties: false

examples:
/* bench 4971.1.0 f13ff4664fbe */
/* bench 4971.1.1 27b41e807f29 */
/* bench 4971.1.2 9655980cbb51 */
/* bench 4971.1.3 1e77f9a38ee4 */
/* bench 4971.1.4 242754b94c61 */
/* bench 4971.1.5 b179818a0b58 */
/* bench 4971.1.6 6f62c5af0bc7 */
/* bench 4971.1.7 2bdfd18ee7cd */
/* bench 4971.1.8 f700329a0fe0 */
        #size-cells = <0>;
        cros-ec@0 {
            compatible = "google,cros-ec-spi";
            reg = <0>;

            usbc_extcon0: extcon0 {
                compatible = "google,extcon-usbc-cros-ec";
                google,usb-port-id = <0>;
            };

            usbc_extcon1: extcon1 {
                compatible = "google,extcon-usbc-cros-ec";
                google,usb-port-id = <1>;
            };
        };
    };
```
