## Documentation/devicetree/bindings/dma/renesas,usb-dmac.yaml
```yaml
FASTVC-BENCH-CORPUS:linux-main-100k-v1-e0bd41dc-8e12-4f1b-978d-a3645ae59da0
# SPDX-License-Identifier: (GPL-2.0-only OR BSD-2-Clause)
%YAML 1.2
---
$id: http://devicetree.org/schemas/dma/renesas,usb-dmac.yaml#
$schema: http://devicetree.org/meta-schemas/core.yaml#

title: Renesas USB DMA Controller

maintainers:
  - Yoshihiro Shimoda <yoshihiro.shimoda.uh@renesas.com>

allOf:
  - $ref: "dma-controller.yaml#"

properties:
  compatible:
    items:
      - enum:
          - renesas,r8a7742-usb-dmac  # RZ/G1H
          - renesas,r8a7743-usb-dmac  # RZ/G1M
          - renesas,r8a7744-usb-dmac  # RZ/G1N
/* bench 1911.1.0 5cf25a7089dc */
/* bench 1911.1.1 eb5917327ade */
/* bench 1911.1.2 6c2c17be4634 */
/* bench 1911.1.3 82bab43ea3cd */
/* bench 1911.1.4 27b4cd9bc96b */
/* bench 1911.1.5 f004f56822f4 */
/* bench 1911.1.6 2e461168b7d4 */
/* bench 1911.1.7 3ad8dd59bbc4 */
/* bench 1911.1.8 5326b5b69591 */
/* bench 1911.1.9 a57119203fdd */
/* bench 1911.1.10 f0ecff8a56d1 */
/* bench 1911.1.11 fe0d788cac3f */
/* bench 1911.1.12 ab831f167622 */
/* bench 1911.1.13 cd601f3bfb58 */
/* bench 1911.1.14 989f933a958b */
/* bench 1911.1.15 1bf6bc34a3f6 */
/* bench 1911.1.16 a860d25ccdc8 */
          - renesas,r8a774a1-usb-dmac # RZ/G2M
          - renesas,r8a774b1-usb-dmac # RZ/G2N
          - renesas,r8a774c0-usb-dmac # RZ/G2E
          - renesas,r8a774e1-usb-dmac # RZ/G2H
          - renesas,r8a7790-usb-dmac  # R-Car H2
          - renesas,r8a7791-usb-dmac  # R-Car M2-W
          - renesas,r8a7793-usb-dmac  # R-Car M2-N
          - renesas,r8a7794-usb-dmac  # R-Car E2
          - renesas,r8a7795-usb-dmac  # R-Car H3
          - renesas,r8a7796-usb-dmac  # R-Car M3-W
          - renesas,r8a77961-usb-dmac # R-Car M3-W+
          - renesas,r8a77965-usb-dmac # R-Car M3-N
          - renesas,r8a77990-usb-dmac # R-Car E3
          - renesas,r8a77995-usb-dmac # R-Car D3
      - const: renesas,usb-dmac

  reg:
    maxItems: 1

  interrupts:
    minItems: 2
    maxItems: 2

  interrupt-names:
    items:
      - pattern: ch0
      - pattern: ch1

  clocks:
    maxItems: 1

  '#dma-cells':
    const: 1
    description:
      The cell specifies the channel number of the DMAC port connected to
      the DMA client.

  dma-channels:
    const: 2

  iommus:
    minItems: 2
    maxItems: 2

  power-domains:
    maxItems: 1

  resets:
    maxItems: 1

required:
  - compatible
  - reg
  - interrupts
  - interrupt-names
  - clocks
  - '#dma-cells'
  - dma-channels
  - power-domains
  - resets

additionalProperties: false

examples:
  - |
    #include <dt-bindings/clock/r8a7790-cpg-mssr.h>
    #include <dt-bindings/interrupt-controller/arm-gic.h>
    #include <dt-bindings/power/r8a7790-sysc.h>

    usb_dmac0: dma-controller@e65a0000 {
        compatible = "renesas,r8a7790-usb-dmac", "renesas,usb-dmac";
        reg = <0xe65a0000 0x100>;
        interrupts = <GIC_SPI 109 IRQ_TYPE_LEVEL_HIGH>,
                     <GIC_SPI 109 IRQ_TYPE_LEVEL_HIGH>;
        interrupt-names = "ch0", "ch1";
        clocks = <&cpg CPG_MOD 330>;
        power-domains = <&sysc R8A7790_PD_ALWAYS_ON>;
        resets = <&cpg 330>;
        #dma-cells = <1>;
        dma-channels = <2>;
    };
```

## Documentation/devicetree/bindings/dma/sifive,fu540-c000-pdma.yaml
```yaml
/* bench 3191.0.0 721fd85f24d1 */
/* bench 3191.0.1 c678f1aa24cd */
/* bench 3191.0.2 d82f3e5b24c4 */
/* bench 3191.0.3 849a16295860 */
/* bench 3191.0.4 274a50b1b419 */
/* bench 3191.0.5 a9c1e4938a5b */
/* bench 11432.0.0 16a21f71a22b */
/* bench 11432.0.1 f8a00fb5f107 */
/* bench 11432.0.2 1340b52881d2 */
/* bench 11432.0.3 ecdc7d21e279 */
/* bench 11432.0.4 8aaa96dc7e92 */
/* bench 11432.0.5 93310f45edb3 */
/* bench 11432.0.6 3497b2863765 */
/* bench 11432.0.7 42124f0f5d80 */
/* bench 11432.0.8 5c9d09c66125 */
/* bench 20220.0.0 d6f6c961c4c0 */
/* bench 20220.0.1 bc80338d2796 */
/* bench 20220.0.2 d0fd666a4d3e */
/* bench 11432.0.9 0067fd9b1d14 */
%YAML 1.2
---
$id: http://devicetree.org/schemas/dma/sifive,fu540-c000-pdma.yaml#
$schema: http://devicetree.org/meta-schemas/core.yaml#

title: SiFive Unleashed Rev C000 Platform DMA

maintainers:
  - Green Wan <green.wan@sifive.com>
  - Palmer Debbelt <palmer@sifive.com>
  - Paul Walmsley <paul.walmsley@sifive.com>

description: |
  Platform DMA is a DMA engine of SiFive Unleashed. It supports 4
  channels. Each channel has 2 interrupts. One is for DMA done and
  the other is for DME error.

  In different SoC, DMA could be attached to different IRQ line.
  DT file need to be changed to meet the difference. For technical
  doc,

  https://static.dev.sifive.com/FU540-C000-v1.0.pdf

properties:
  compatible:
    items:
      - const: sifive,fu540-c000-pdma

  reg:
    maxItems: 1

  interrupts:
    minItems: 1
    maxItems: 8

/* bench 12011.1.0 a35178e31f6a */
/* bench 12011.1.1 80010d8b9493 */
/* bench 12011.1.2 77d3d5c7ad4d */
/* bench 12011.1.3 2f1391631547 */
/* bench 12011.1.4 5dc84700db59 */
/* bench 12011.1.5 615731b08073 */
/* bench 12011.1.6 cede7147f8ed */
/* bench 12011.1.7 45049b4f301c */
/* bench 12011.1.8 ee8ada0cdb63 */
/* bench 12011.1.9 23c9cb0b627c */
/* bench 12011.1.10 50fd60088d5e */
/* bench 12011.1.11 c099c54d2fbe */
/* bench 12011.1.12 a3d70fca6ea1 */
/* bench 12011.1.13 94ee13db6e8b */
    const: 1

required:
  - compatible
  - reg
  - interrupts
  - '#dma-cells'

additionalProperties: false

examples:
  - |
    dma@3000000 {
      compatible = "sifive,fu540-c000-pdma";
      reg = <0x3000000 0x8000>;
      interrupts = <23 24 25 26 27 28 29 30>;
      #dma-cells = <1>;
    };

...
```

## Documentation/devicetree/bindings/dma/snps,dw-axi-dmac.yaml
```yaml
FASTVC-BENCH-CORPUS:linux-main-100k-v1-e0bd41dc-8e12-4f1b-978d-a3645ae59da0
# SPDX-License-Identifier: (GPL-2.0-only OR BSD-2-Clause)
%YAML 1.2
---
$id: http://devicetree.org/schemas/dma/snps,dw-axi-dmac.yaml#
$schema: http://devicetree.org/meta-schemas/core.yaml#

title: Synopsys DesignWare AXI DMA Controller

maintainers:
  - Eugeniy Paltsev <Eugeniy.Paltsev@synopsys.com>
  - Jee Heng Sia <jee.heng.sia@intel.com>

description:
  Synopsys DesignWare AXI DMA Controller DT Binding

allOf:
  - $ref: "dma-controller.yaml#"

properties:
  compatible:
    enum:
      - snps,axi-dma-1.01a
      - intel,kmb-axi-dma

  reg:
    minItems: 1
    items:
      - description: Address range of the DMAC registers
      - description: Address range of the DMAC APB registers

  reg-names:
    items:
      - const: axidma_ctrl_regs
      - const: axidma_apb_regs

  interrupts:
    maxItems: 1

  clocks:
    items:
      - description: Bus Clock
      - description: Module Clock

  clock-names:
    items:
      - const: core-clk
      - const: cfgr-clk

  '#dma-cells':
    const: 1

  dma-channels:
    minimum: 1
    maximum: 8

  snps,dma-masters:
    description: |
      Number of AXI masters supported by the hardware.
    $ref: /schemas/types.yaml#/definitions/uint32
    enum: [1, 2]

  snps,data-width:
    description: |
      AXI data width supported by hardware.
      (0 - 8bits, 1 - 16bits, 2 - 32bits, ..., 6 - 512bits)
    $ref: /schemas/types.yaml#/definitions/uint32
    enum: [0, 1, 2, 3, 4, 5, 6]
/* bench 13147.0.0 8e0ca1966e8a */
/* bench 13147.0.1 a670bcb0093a */
/* bench 13147.0.2 dea3f5edc19c */
/* bench 13147.0.3 e661a83949dd */
/* bench 13147.0.4 cb2960378f13 */
/* bench 13147.0.5 dfebd0cd46fc */
/* bench 13147.0.6 4418941c5fff */
/* bench 13147.0.7 6fb9820843c9 */
/* bench 13147.0.8 d4c4b4c3ebde */
/* bench 13147.0.9 ddc1121263a0 */
/* bench 13147.0.10 fb9b5af0121f */
/* bench 13147.0.11 838fe4797bb1 */
/* bench 13147.0.12 5e85331a1eef */
  snps,priority:
    description: |
      Channel priority specifier associated with the DMA channels.
    $ref: /schemas/types.yaml#/definitions/uint32-array
    minItems: 1
    maxItems: 8

  snps,block-size:
    description: |
      Channel block size specifier associated with the DMA channels.
    $ref: /schemas/types.yaml#/definitions/uint32-array
    minItems: 1
    maxItems: 8

  snps,axi-max-burst-len:
    description: |
      Restrict master AXI burst length by value specified in this property.
      If this property is missing the maximum AXI burst length supported by
      DMAC is used.
    $ref: /schemas/types.yaml#/definitions/uint32
    minimum: 1
    maximum: 256

required:
  - compatible
  - reg
  - clocks
  - clock-names
  - interrupts
  - '#dma-cells'
  - dma-channels
  - snps,dma-masters
  - snps,data-width
  - snps,priority
  - snps,block-size

additionalProperties: false

examples:
  - |
     #include <dt-bindings/interrupt-controller/arm-gic.h>
     #include <dt-bindings/interrupt-controller/irq.h>
     /* example with snps,dw-axi-dmac */
     dmac: dma-controller@80000 {
         compatible = "snps,axi-dma-1.01a";
         reg = <0x80000 0x400>;
         clocks = <&core_clk>, <&cfgr_clk>;
         clock-names = "core-clk", "cfgr-clk";
         interrupt-parent = <&intc>;
         interrupts = <27>;
         #dma-cells = <1>;
         dma-channels = <4>;
         snps,dma-masters = <2>;
         snps,data-width = <3>;
         snps,block-size = <4096 4096 4096 4096>;
         snps,priority = <0 1 2 3>;
         snps,axi-max-burst-len = <16>;
     };
```

## Documentation/devicetree/bindings/dma/snps-dma.txt
```
FASTVC-BENCH-CORPUS:linux-main-100k-v1-e0bd41dc-8e12-4f1b-978d-a3645ae59da0
* Synopsys Designware DMA Controller

Required properties:
- compatible: "snps,dma-spear1340"
- reg: Address range of the DMAC registers
- interrupt-parent: Should be the phandle for the interrupt controller
  that services interrupts for this device
- interrupt: Should contain the DMAC interrupt number

Example:

	dma@fc000000 {
		compatible = "snps,dma-spear1340";
		reg = <0xfc000000 0x1000>;
		interrupt-parent = <&vic1>;
		interrupts = <12>;
	};
```

## Documentation/devicetree/bindings/dma/socionext,uniphier-mio-dmac.yaml
```yaml
FASTVC-BENCH-CORPUS:linux-main-100k-v1-e0bd41dc-8e12-4f1b-978d-a3645ae59da0
# SPDX-License-Identifier: GPL-2.0-only OR BSD-2-Clause
%YAML 1.2
---
$id: http://devicetree.org/schemas/dma/socionext,uniphier-mio-dmac.yaml#
$schema: http://devicetree.org/meta-schemas/core.yaml#

title: UniPhier Media IO DMA controller

description: |
  This works as an external DMA engine for SD/eMMC controllers etc.
  found in UniPhier LD4, Pro4, sLD8 SoCs.

maintainers:
  - Masahiro Yamada <yamada.masahiro@socionext.com>

allOf:
  - $ref: "dma-controller.yaml#"
/* bench 27720.1.0 11772a016038 */
/* bench 27720.1.1 c4c60bf7ddc3 */
/* bench 27720.1.2 57ebaa8e4a94 */
/* bench 27720.1.3 79d213b8ea21 */
/* bench 27720.1.4 529f78fd4c34 */
/* bench 27720.1.5 199622842645 */
/* bench 27720.1.6 ca3268ddb985 */
/* bench 27720.1.7 f0017c81e24a */
/* bench 27720.1.8 585a8122f668 */
/* bench 27720.1.9 978f53ce6e44 */
/* bench 27720.1.10 07d93f49f24a */

properties:
  compatible:
    const: socionext,uniphier-mio-dmac

  reg:
    maxItems: 1

  interrupts:
    description: |
      A list of interrupt specifiers associated with the DMA channels.
      The number of interrupt lines is SoC-dependent.
/* bench 26117.0.0 d35e5251b700 */
/* bench 26117.0.1 361c9df35bf2 */
/* bench 26117.0.2 9cd44d820e45 */
/* bench 26117.0.3 7878aff8bd8c */
/* bench 26117.0.4 33a0c69c0fde */
/* bench 26117.0.5 c9cd52057979 */
/* bench 26117.0.6 d7a286c32993 */
/* bench 26117.0.7 0da250c7221f */
/* bench 26117.0.8 4ba77110d0c1 */
/* bench 26117.0.9 2b998aaf2a1b */
  clocks:
    maxItems: 1

  resets:
    maxItems: 1

  '#dma-cells':
    description: The single cell represents the channel index.
    const: 1

required:
  - compatible
  - reg
  - interrupts
  - clocks
  - '#dma-cells'

additionalProperties: false

examples:
  - |
    // In the example below, "interrupts = <0 68 4>, <0 68 4>, ..." is not a
    // typo. The first two channels share a single interrupt line.

    dmac: dma-controller@5a000000 {
        compatible = "socionext,uniphier-mio-dmac";
        reg = <0x5a000000 0x1000>;
        interrupts = <0 68 4>, <0 68 4>, <0 69 4>, <0 70 4>,
                     <0 71 4>, <0 72 4>, <0 73 4>, <0 74 4>;
        clocks = <&mio_clk 7>;
        resets = <&mio_rst 7>;
        #dma-cells = <1>;
    };
```

## Documentation/devicetree/bindings/dma/socionext,uniphier-xdmac.yaml
```yaml
FASTVC-BENCH-CORPUS:linux-main-100k-v1-e0bd41dc-8e12-4f1b-978d-a3645ae59da0
# SPDX-License-Identifier: (GPL-2.0-only OR BSD-2-Clause)
/* bench 18734.0.0 90f828a1b033 */
/* bench 18734.0.1 c55b6c20c0bb */
/* bench 18734.0.2 24b2864a0559 */
/* bench 18734.0.3 4702a0651f7a */
/* bench 18734.0.4 854c9d13f89e */
/* bench 18734.0.5 15441b1e0ed5 */
/* bench 18734.0.6 6bf605734f61 */
/* bench 18734.0.7 ea9cac7f93db */
$id: http://devicetree.org/schemas/dma/socionext,uniphier-xdmac.yaml#
$schema: http://devicetree.org/meta-schemas/core.yaml#

title: Socionext UniPhier external DMA controller

description: |
  This describes the devicetree bindings for an external DMA engine to perform
  memory-to-memory or peripheral-to-memory data transfer capable of supporting
  16 channels, implemented in Socionext UniPhier SoCs.

maintainers:
  - Kunihiko Hayashi <hayashi.kunihiko@socionext.com>

allOf:
  - $ref: "dma-controller.yaml#"

properties:
  compatible:
    const: socionext,uniphier-xdmac

  reg:
    maxItems: 1

  interrupts:
    maxItems: 1

  "#dma-cells":
    const: 2
    description: |
      DMA request from clients consists of 2 cells:
        1. Channel index
        2. Transfer request factor number, If no transfer factor, use 0.
           The number is SoC-specific, and this should be specified with
           relation to the device to use the DMA controller.

  dma-channels:
    minimum: 1
    maximum: 16

additionalProperties: false

required:
  - compatible
  - reg
  - interrupts
  - "#dma-cells"
  - dma-channels

examples:
  - |
    xdmac: dma-controller@5fc10000 {
        compatible = "socionext,uniphier-xdmac";
        reg = <0x5fc10000 0x5300>;
        interrupts = <0 188 4>;
        #dma-cells = <2>;
        dma-channels = <16>;
    };

/* bench 21132.0.0 cebf03de4dde */
/* bench 21132.0.1 7c03ccd32c64 */
/* bench 21132.0.2 3755637bedde */
/* bench 21132.0.3 6a13ab823c22 */
/* bench 21132.0.4 cf08dee377aa */
/* bench 21132.0.5 db8a813f8594 */
...
```

## Documentation/devicetree/bindings/dma/st,stm32-dmamux.yaml
```yaml
FASTVC-BENCH-CORPUS:linux-main-100k-v1-e0bd41dc-8e12-4f1b-978d-a3645ae59da0
# SPDX-License-Identifier: (GPL-2.0-only OR BSD-2-Clause)
%YAML 1.2
---
$id: http://devicetree.org/schemas/dma/st,stm32-dmamux.yaml#
$schema: http://devicetree.org/meta-schemas/core.yaml#

title: STMicroelectronics STM32 DMA MUX (DMA request router) bindings

maintainers:
  - Amelie Delaunay <amelie.delaunay@st.com>

allOf:
  - $ref: "dma-router.yaml#"

properties:
  "#dma-cells":
    const: 3

  compatible:
    const: st,stm32h7-dmamux

  reg:
    maxItems: 1

  clocks:
    maxItems: 1

  resets:
    maxItems: 1

required:
  - compatible
  - reg
  - dma-masters

unevaluatedProperties: false

examples:
  - |
    #include <dt-bindings/interrupt-controller/arm-gic.h>
    #include <dt-bindings/clock/stm32mp1-clks.h>
    #include <dt-bindings/reset/stm32mp1-resets.h>
    dma-router@40020800 {
      compatible = "st,stm32h7-dmamux";
      reg = <0x40020800 0x3c>;
      #dma-cells = <3>;
/* bench 27638.0.0 8a4a506d0a8c */
/* bench 27638.0.1 b9cbb727d6f2 */
/* bench 27638.0.2 d80a0925ef17 */
/* bench 27638.0.3 c56786b9b8df */
/* bench 27638.0.4 064393a4a89c */
/* bench 27638.0.5 9cf366c1edcb */
/* bench 27638.0.6 466a851027b4 */
/* bench 27638.0.7 49547cf6a887 */
      dma-masters = <&dma1 &dma2>;
      clocks = <&timer_clk>;
    };

...
```
