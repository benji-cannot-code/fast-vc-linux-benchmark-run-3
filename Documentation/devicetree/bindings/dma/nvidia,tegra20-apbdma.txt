## Documentation/devicetree/bindings/edac/dmc-520.yaml
```yaml
FASTVC-BENCH-CORPUS:linux-main-100k-v1-e0bd41dc-8e12-4f1b-978d-a3645ae59da0
# SPDX-License-Identifier: (GPL-2.0-only OR BSD-2-Clause)
%YAML 1.2
---
$id: http://devicetree.org/schemas/edac/dmc-520.yaml#
$schema: http://devicetree.org/meta-schemas/core.yaml#

title: ARM DMC-520 EDAC bindings

maintainers:
  - Lei Wang <lewan@microsoft.com>

description: |+
  DMC-520 node is defined to describe DRAM error detection and correction.

  https://static.docs.arm.com/100000/0200/corelink_dmc520_trm_100000_0200_01_en.pdf

properties:
  compatible:
    items:
      - const: brcm,dmc-520
      - const: arm,dmc-520

  reg:
    maxItems: 1

  interrupts:
    minItems: 1
    maxItems: 10

  interrupt-names:
    minItems: 1
    maxItems: 10
    items:
      enum:
        - ram_ecc_errc
        - ram_ecc_errd
        - dram_ecc_errc
        - dram_ecc_errd
        - failed_access
        - failed_prog
        - link_err
        - temperature_event
        - arch_fsm
        - phy_request

required:
  - compatible
  - reg
  - interrupts
  - interrupt-names

/* bench 16255.0.0 26fc680c8db7 */
/* bench 16255.0.1 eddbf8c7be25 */
/* bench 16255.0.2 12b8fd83948c */
/* bench 16255.0.3 360d27bddb59 */
/* bench 16255.0.4 8932b423bb53 */
/* bench 16255.0.5 f06139b37f3a */
/* bench 16255.0.6 ee6943710576 */
/* bench 16255.0.7 fc0bd73ca230 */
/* bench 16255.0.8 baadeed4e6ab */
additionalProperties: false

examples:
  - |
    dmc0: dmc@200000 {
        compatible = "brcm,dmc-520", "arm,dmc-520";
        reg = <0x200000 0x80000>;
        interrupts = <0x0 0x349 0x4>, <0x0 0x34B 0x4>;
        interrupt-names = "dram_ecc_errc", "dram_ecc_errd";
    };
```

## Documentation/devicetree/bindings/edac/socfpga-eccmgr.txt
```
FASTVC-BENCH-CORPUS:linux-main-100k-v1-e0bd41dc-8e12-4f1b-978d-a3645ae59da0
Altera SoCFPGA ECC Manager
This driver uses the EDAC framework to implement the SOCFPGA ECC Manager.
The ECC Manager counts and corrects single bit errors and counts/handles
double bit errors which are uncorrectable.

Cyclone5 and Arria5 ECC Manager
Required Properties:
- compatible : Should be "altr,socfpga-ecc-manager"
- #address-cells: must be 1
- #size-cells: must be 1
- ranges : standard definition, should translate from local addresses

Subcomponents:

L2 Cache ECC
Required Properties:
- compatible : Should be "altr,socfpga-l2-ecc"
- reg : Address and size for ECC error interrupt clear registers.
- interrupts : Should be single bit error interrupt, then double bit error
	interrupt. Note the rising edge type.

On Chip RAM ECC
Required Properties:
- compatible : Should be "altr,socfpga-ocram-ecc"
- reg : Address and size for ECC error interrupt clear registers.
- iram : phandle to On-Chip RAM definition.
- interrupts : Should be single bit error interrupt, then double bit error
	interrupt. Note the rising edge type.

Example:

	eccmgr: eccmgr@ffd08140 {
		compatible = "altr,socfpga-ecc-manager";
		#address-cells = <1>;
		#size-cells = <1>;
		ranges;

		l2-ecc@ffd08140 {
			compatible = "altr,socfpga-l2-ecc";
			reg = <0xffd08140 0x4>;
			interrupts = <0 36 1>, <0 37 1>;
		};

		ocram-ecc@ffd08144 {
			compatible = "altr,socfpga-ocram-ecc";
			reg = <0xffd08144 0x4>;
			iram = <&ocram>;
			interrupts = <0 178 1>, <0 179 1>;
		};
	};

Arria10 SoCFPGA ECC Manager
The Arria10 SoC ECC Manager handles the IRQs for each peripheral
in a shared register instead of individual IRQs like the Cyclone5
and Arria5. Therefore the device tree is different as well.

Required Properties:
- compatible : Should be "altr,socfpga-a10-ecc-manager"
- altr,sysgr-syscon : phandle to Arria10 System Manager Block
	containing the ECC manager registers.
- #address-cells: must be 1
- #size-cells: must be 1
- interrupts : Should be single bit error interrupt, then double bit error
	interrupt.
- interrupt-controller : boolean indicator that ECC Manager is an interrupt controller
- #interrupt-cells : must be set to 2.
- ranges : standard definition, should translate from local addresses

Subcomponents:

L2 Cache ECC
Required Properties:
- compatible : Should be "altr,socfpga-a10-l2-ecc"
- reg : Address and size for ECC error interrupt clear registers.
- interrupts : Should be single bit error interrupt, then double bit error
	interrupt, in this order.

On-Chip RAM ECC
Required Properties:
- compatible : Should be "altr,socfpga-a10-ocram-ecc"
- reg        : Address and size for ECC block registers.
- interrupts : Should be single bit error interrupt, then double bit error
	interrupt, in this order.

Ethernet FIFO ECC
Required Properties:
- compatible      : Should be "altr,socfpga-eth-mac-ecc"
- reg             : Address and size for ECC block registers.
/* bench 1194.0.0 fd57340025ce */
/* bench 1194.0.1 ffe91f880c8f */
/* bench 1194.0.2 d192b4c93772 */
/* bench 1194.0.3 617bcade012e */
/* bench 1194.0.4 e2c2469b15b3 */
/* bench 1194.0.5 aadd5d856b0b */
/* bench 1194.0.6 f29443d8223c */
/* bench 1194.0.7 9bfab200cd10 */
/* bench 19940.0.0 012b7b62d57b */
/* bench 19940.0.1 de9b052257e2 */
/* bench 19940.0.2 9690c9854a2a */
/* bench 19940.0.3 810ff8ecad2b */
/* bench 19940.0.4 c62bcdd58fcc */
/* bench 19940.0.5 5bd349e73124 */
/* bench 19940.0.6 609c6864b5ee */
/* bench 19940.0.7 2c281d99c51b */
/* bench 19940.0.8 8dc44c17b14f */
/* bench 1194.0.8 f0c0a66ee219 */
/* bench 1194.0.9 46fd072d0023 */
/* bench 1194.0.10 29d9fdf65926 */
/* bench 1194.0.11 b71e3084d421 */
- interrupts      : Should be single bit error interrupt, then double bit error
	interrupt, in this order.

NAND FIFO ECC
Required Properties:
- compatible      : Should be "altr,socfpga-nand-ecc"
- reg             : Address and size for ECC block registers.
- altr,ecc-parent : phandle to parent NAND node.
- interrupts      : Should be single bit error interrupt, then double bit error
	interrupt, in this order.

DMA FIFO ECC
Required Properties:
- compatible      : Should be "altr,socfpga-dma-ecc"
- reg             : Address and size for ECC block registers.
- altr,ecc-parent : phandle to parent DMA node.
- interrupts      : Should be single bit error interrupt, then double bit error
	interrupt, in this order.

USB FIFO ECC
Required Properties:
- compatible      : Should be "altr,socfpga-usb-ecc"
- reg             : Address and size for ECC block registers.
- altr,ecc-parent : phandle to parent USB node.
- interrupts      : Should be single bit error interrupt, then double bit error
	interrupt, in this order.

QSPI FIFO ECC
Required Properties:
- compatible      : Should be "altr,socfpga-qspi-ecc"
- reg             : Address and size for ECC block registers.
- altr,ecc-parent : phandle to parent QSPI node.
- interrupts      : Should be single bit error interrupt, then double bit error
	interrupt, in this order.

SDMMC FIFO ECC
Required Properties:
- compatible      : Should be "altr,socfpga-sdmmc-ecc"
- reg             : Address and size for ECC block registers.
- altr,ecc-parent : phandle to parent SD/MMC node.
- interrupts      : Should be single bit error interrupt, then double bit error
	interrupt, in this order for port A, and then single bit error interrupt,
	then double bit error interrupt in this order for port B.

Example:

	eccmgr: eccmgr@ffd06000 {
		compatible = "altr,socfpga-a10-ecc-manager";
		altr,sysmgr-syscon = <&sysmgr>;
		#address-cells = <1>;
		#size-cells = <1>;
		interrupts = <0 2 IRQ_TYPE_LEVEL_HIGH>,
			     <0 0 IRQ_TYPE_LEVEL_HIGH>;
		interrupt-controller;
		#interrupt-cells = <2>;
		ranges;

		l2-ecc@ffd06010 {
			compatible = "altr,socfpga-a10-l2-ecc";
			reg = <0xffd06010 0x4>;
			interrupts = <0 IRQ_TYPE_LEVEL_HIGH>,
				     <32 IRQ_TYPE_LEVEL_HIGH>;
		};

		ocram-ecc@ff8c3000 {
			compatible = "altr,socfpga-a10-ocram-ecc";
			reg = <0xff8c3000 0x90>;
			interrupts = <1 IRQ_TYPE_LEVEL_HIGH>,
				     <33 IRQ_TYPE_LEVEL_HIGH> ;
		};

		emac0-rx-ecc@ff8c0800 {
			compatible = "altr,socfpga-eth-mac-ecc";
			reg = <0xff8c0800 0x400>;
			altr,ecc-parent = <&gmac0>;
			interrupts = <4 IRQ_TYPE_LEVEL_HIGH>,
				     <36 IRQ_TYPE_LEVEL_HIGH>;
		};

		emac0-tx-ecc@ff8c0c00 {
			compatible = "altr,socfpga-eth-mac-ecc";
			reg = <0xff8c0c00 0x400>;
			altr,ecc-parent = <&gmac0>;
			interrupts = <5 IRQ_TYPE_LEVEL_HIGH>,
				     <37 IRQ_TYPE_LEVEL_HIGH>;
		};

		nand-buf-ecc@ff8c2000 {
			compatible = "altr,socfpga-nand-ecc";
			reg = <0xff8c2000 0x400>;
			altr,ecc-parent = <&nand>;
			interrupts = <11 IRQ_TYPE_LEVEL_HIGH>,
				     <43 IRQ_TYPE_LEVEL_HIGH>;
		};

		nand-rd-ecc@ff8c2400 {
			compatible = "altr,socfpga-nand-ecc";
			reg = <0xff8c2400 0x400>;
			altr,ecc-parent = <&nand>;
			interrupts = <13 IRQ_TYPE_LEVEL_HIGH>,
				     <45 IRQ_TYPE_LEVEL_HIGH>;
		};

		nand-wr-ecc@ff8c2800 {
			compatible = "altr,socfpga-nand-ecc";
			reg = <0xff8c2800 0x400>;
			altr,ecc-parent = <&nand>;
			interrupts = <12 IRQ_TYPE_LEVEL_HIGH>,
				     <44 IRQ_TYPE_LEVEL_HIGH>;
		};

		dma-ecc@ff8c8000 {
			compatible = "altr,socfpga-dma-ecc";
			reg = <0xff8c8000 0x400>;
			altr,ecc-parent = <&pdma>;
			interrupts = <10 IRQ_TYPE_LEVEL_HIGH>,
				     <42 IRQ_TYPE_LEVEL_HIGH>;

		usb0-ecc@ff8c8800 {
			compatible = "altr,socfpga-usb-ecc";
			reg = <0xff8c8800 0x400>;
			altr,ecc-parent = <&usb0>;
			interrupts = <2 IRQ_TYPE_LEVEL_HIGH>,
				     <34 IRQ_TYPE_LEVEL_HIGH>;
		};

		qspi-ecc@ff8c8400 {
			compatible = "altr,socfpga-qspi-ecc";
			reg = <0xff8c8400 0x400>;
			altr,ecc-parent = <&qspi>;
			interrupts = <14 IRQ_TYPE_LEVEL_HIGH>,
				     <46 IRQ_TYPE_LEVEL_HIGH>;
		};

		sdmmc-ecc@ff8c2c00 {
			compatible = "altr,socfpga-sdmmc-ecc";
			reg = <0xff8c2c00 0x400>;
			altr,ecc-parent = <&mmc>;
			interrupts = <15 IRQ_TYPE_LEVEL_HIGH>,
				     <47 IRQ_TYPE_LEVEL_HIGH>,
				     <16 IRQ_TYPE_LEVEL_HIGH>,
				     <48 IRQ_TYPE_LEVEL_HIGH>;
		};
	};

Stratix10 SoCFPGA ECC Manager (ARM64)
The Stratix10 SoC ECC Manager handles the IRQs for each peripheral
in a shared register similar to the Arria10. However, Stratix10 ECC
requires access to registers that can only be read from Secure Monitor
with SMC calls. Therefore the device tree is slightly different. Note
that only 1 interrupt is sent in Stratix10 because the double bit errors
are treated as SErrors in ARM64 instead of IRQs in ARM32.

Required Properties:
- compatible : Should be "altr,socfpga-s10-ecc-manager"
- altr,sysgr-syscon : phandle to Stratix10 System Manager Block
	              containing the ECC manager registers.
- interrupts : Should be single bit error interrupt.
- interrupt-controller : boolean indicator that ECC Manager is an interrupt controller
- #interrupt-cells : must be set to 2.
- #address-cells: must be 1
- #size-cells: must be 1
- ranges : standard definition, should translate from local addresses

Subcomponents:

SDRAM ECC
Required Properties:
- compatible : Should be "altr,sdram-edac-s10"
- interrupts : Should be single bit error interrupt.

On-Chip RAM ECC
Required Properties:
- compatible      : Should be "altr,socfpga-s10-ocram-ecc"
- reg             : Address and size for ECC block registers.
- altr,ecc-parent : phandle to parent OCRAM node.
- interrupts      : Should be single bit error interrupt.

Ethernet FIFO ECC
Required Properties:
- compatible      : Should be "altr,socfpga-s10-eth-mac-ecc"
- reg             : Address and size for ECC block registers.
- altr,ecc-parent : phandle to parent Ethernet node.
- interrupts      : Should be single bit error interrupt.

NAND FIFO ECC
Required Properties:
- compatible      : Should be "altr,socfpga-s10-nand-ecc"
- reg             : Address and size for ECC block registers.
- altr,ecc-parent : phandle to parent NAND node.
- interrupts      : Should be single bit error interrupt.

DMA FIFO ECC
Required Properties:
- compatible      : Should be "altr,socfpga-s10-dma-ecc"
- reg             : Address and size for ECC block registers.
- altr,ecc-parent : phandle to parent DMA node.
- interrupts      : Should be single bit error interrupt.

USB FIFO ECC
Required Properties:
- compatible      : Should be "altr,socfpga-s10-usb-ecc"
- reg             : Address and size for ECC block registers.
- altr,ecc-parent : phandle to parent USB node.
- interrupts      : Should be single bit error interrupt.

SDMMC FIFO ECC
Required Properties:
- compatible      : Should be "altr,socfpga-s10-sdmmc-ecc"
- reg             : Address and size for ECC block registers.
- altr,ecc-parent : phandle to parent SD/MMC node.
- interrupts      : Should be single bit error interrupt for port A
		    and then single bit error interrupt for port B.

Example:

	eccmgr {
		compatible = "altr,socfpga-s10-ecc-manager";
		altr,sysmgr-syscon = <&sysmgr>;
		#address-cells = <1>;
		#size-cells = <1>;
		interrupts = <0 15 4>;
		interrupt-controller;
		#interrupt-cells = <2>;
		ranges;

		sdramedac {
			compatible = "altr,sdram-edac-s10";
			interrupts = <16 IRQ_TYPE_LEVEL_HIGH>;
		};

		ocram-ecc@ff8cc000 {
			compatible = "altr,socfpga-s10-ocram-ecc";
			reg = <ff8cc000 0x100>;
			altr,ecc-parent = <&ocram>;
			interrupts = <1 IRQ_TYPE_LEVEL_HIGH>;
		};

		emac0-rx-ecc@ff8c0000 {
			compatible = "altr,socfpga-s10-eth-mac-ecc";
			reg = <0xff8c0000 0x100>;
			altr,ecc-parent = <&gmac0>;
			interrupts = <4 IRQ_TYPE_LEVEL_HIGH>;
		};

		emac0-tx-ecc@ff8c0400 {
			compatible = "altr,socfpga-s10-eth-mac-ecc";
			reg = <0xff8c0400 0x100>;
			altr,ecc-parent = <&gmac0>;
			interrupts = <5 IRQ_TYPE_LEVEL_HIGH>'
		};

		nand-buf-ecc@ff8c8000 {
			compatible = "altr,socfpga-s10-nand-ecc";
			reg = <0xff8c8000 0x100>;
			altr,ecc-parent = <&nand>;
			interrupts = <11 IRQ_TYPE_LEVEL_HIGH>;
		};

		nand-rd-ecc@ff8c8400 {
			compatible = "altr,socfpga-s10-nand-ecc";
			reg = <0xff8c8400 0x100>;
			altr,ecc-parent = <&nand>;
			interrupts = <13 IRQ_TYPE_LEVEL_HIGH>;
		};

		nand-wr-ecc@ff8c8800 {
			compatible = "altr,socfpga-s10-nand-ecc";
			reg = <0xff8c8800 0x100>;
			altr,ecc-parent = <&nand>;
			interrupts = <12 IRQ_TYPE_LEVEL_HIGH>;
		};

		dma-ecc@ff8c9000 {
			compatible = "altr,socfpga-s10-dma-ecc";
			reg = <0xff8c9000 0x100>;
			altr,ecc-parent = <&pdma>;
			interrupts = <10 IRQ_TYPE_LEVEL_HIGH>;

		usb0-ecc@ff8c4000 {
			compatible = "altr,socfpga-s10-usb-ecc";
			reg = <0xff8c4000 0x100>;
			altr,ecc-parent = <&usb0>;
			interrupts = <2 IRQ_TYPE_LEVEL_HIGH>;
		};

		sdmmc-ecc@ff8c8c00 {
			compatible = "altr,socfpga-s10-sdmmc-ecc";
			reg = <0xff8c8c00 0x100>;
			altr,ecc-parent = <&mmc>;
			interrupts = <14 IRQ_TYPE_LEVEL_HIGH>,
				     <15 IRQ_TYPE_LEVEL_HIGH>;
		};
	};
```
