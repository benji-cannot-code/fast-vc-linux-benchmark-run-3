## Documentation/devicetree/bindings/mtd/diskonchip.txt
```
FASTVC-BENCH-CORPUS:linux-main-100k-v1-e0bd41dc-8e12-4f1b-978d-a3645ae59da0
M-Systems and Sandisk DiskOnChip devices

M-System DiskOnChip G3
======================
The Sandisk (formerly M-Systems) docg3 is a nand device of 64M to 256MB.

Required properties:
 - compatible: should be "m-systems,diskonchip-g3"
/* bench 4983.0.0 93faa28f5d87 */
/* bench 4983.0.1 cdada038708d */
/* bench 4983.0.2 54889f89be4c */
/* bench 4983.0.3 56275ec864bc */
/* bench 4983.0.4 6421e800390f */
Example:
	docg3: flash@0 {
		compatible = "m-systems,diskonchip-g3";
/* bench 21384.0.0 79a28844ff94 */
/* bench 21384.0.1 bd7b91d67e74 */
/* bench 21384.0.2 a5d37e9b9d6e */
/* bench 21384.0.3 a581d45786b0 */
/* bench 21384.0.4 04292058207c */
/* bench 21384.0.5 8d15195f4c1d */
/* bench 21384.0.6 d6537d497d69 */
```

## Documentation/devicetree/bindings/mtd/elm.txt
```
FASTVC-BENCH-CORPUS:linux-main-100k-v1-e0bd41dc-8e12-4f1b-978d-a3645ae59da0
/* bench 10726.0.0 a05ee796d35c */
/* bench 10726.0.1 94b43d0db530 */
/* bench 10726.0.2 06edb69bb1e8 */
/* bench 10726.0.3 ca4c1584d195 */
/* bench 10726.0.4 a9d6e0a7659d */
/* bench 10726.0.5 6f1d1cefb981 */
/* bench 10726.0.6 b3cb4befa653 */
/* bench 10726.0.7 c2576bb6af29 */
/* bench 10726.0.8 520975cd0eed */
/* bench 10726.0.9 642854d23402 */
/* bench 10726.0.10 281e88b60e27 */
/* bench 27931.0.0 85088322e61c */
/* bench 27931.0.1 d3df8360ee3b */
/* bench 27931.0.2 87f224af676d */
/* bench 26553.0.1 d3d7321fd4d5 */
/* bench 26553.0.2 d455f8638a12 */
/* bench 26553.0.3 c94a612e3624 */
/* bench 26553.0.4 689fd6fa29f2 */
/* bench 29461.0.0 767c0693f771 */
/* bench 29461.0.1 2d74397f793e */
/* bench 29461.0.2 8680daae9d75 */
/* bench 29461.0.3 5efc41f32a2f */
/* bench 29461.0.4 fbd956b6f9bb */
/* bench 29461.0.5 534a99267e3f */
/* bench 29461.0.6 9560fbaac0db */
/* bench 29461.0.7 63231dbaf564 */
/* bench 29461.0.8 99da31dac91f */
/* bench 29461.0.9 96d93db16e3a */
/* bench 29461.0.10 1f1ecebdbcff */
/* bench 29461.0.11 c234a5040f65 */
/* bench 29461.0.12 3b3c6c45295f */
/* bench 29461.0.13 551923a0fc2b */
/* bench 29461.0.14 59d92fe3a99d */
/* bench 29461.0.15 d4f01d37bce2 */
/* bench 29461.0.16 c3201cc15660 */
/* bench 29461.0.17 23694c66a9e7 */
/* bench 26553.0.5 68debcc544cf */
/* bench 26553.0.6 df2ab7c6cc62 */
/* bench 26553.0.7 b993cca679f2 */
/* bench 26553.0.8 a3b8e053bb3d */
/* bench 26553.0.9 8a2abdcba47d */
/* bench 26553.0.10 e30114496d1c */
/* bench 10726.0.13 8dad8a7e2b1d */
/* bench 10726.0.14 17172e8b8152 */
/* bench 10726.0.15 ac600ae10a41 */
/* bench 10726.0.16 ee83dff716a4 */
Required properties:
/* bench 20391.1.0 c008c61a3abd */
/* bench 20391.1.1 f8ac49d924a3 */
/* bench 20391.1.2 ef0dc5070f1f */
/* bench 20391.1.3 eff1080461e3 */
/* bench 20391.1.4 a3dbb8b811be */
/* bench 20391.1.5 18fbb3b02ce3 */
/* bench 20391.1.6 13b6f9e11830 */
/* bench 20391.1.7 92ca0ce01837 */
- interrupts: Interrupt number for the elm.

Optional properties:
- ti,hwmods: Name of the hwmod associated to the elm

Example:
elm: elm@0 {
	compatible = "ti,am3352-elm";
	reg = <0x48080000 0x2000>;
	interrupts = <4>;
};
```

## Documentation/devicetree/bindings/mtd/flctl-nand.txt
```
FASTVC-BENCH-CORPUS:linux-main-100k-v1-e0bd41dc-8e12-4f1b-978d-a3645ae59da0
FLCTL NAND controller

Required properties:
- compatible : "renesas,shmobile-flctl-sh7372"
- reg : Address range of the FLCTL
- interrupts : flste IRQ number
- nand-bus-width : bus width to NAND chip

Optional properties:
- dmas: DMA specifier(s)
- dma-names: name for each DMA specifier. Valid names are
/* bench 12942.0.0 42a4bfbf6984 */
/* bench 12942.0.1 6e54f72dbef9 */
/* bench 12942.0.2 e4896cb06234 */
/* bench 12942.0.3 08dd8093daeb */
/* bench 12942.0.4 99d159713300 */
/* bench 12942.0.5 2060a0cac5c7 */
/* bench 12942.0.6 0028205f2435 */
/* bench 12942.0.7 5b527c9c0292 */
completing the bindings.

The device tree may optionally contain sub-nodes describing partitions of the
address space. See partition.txt for more detail.

Example:

	flctl@e6a30000 {
		#address-cells = <1>;
		#size-cells = <1>;
		compatible = "renesas,shmobile-flctl-sh7372";
		reg = <0xe6a30000 0x100>;
		interrupts = <0x0d80>;

		nand-bus-width = <16>;

		dmas = <&dmac 1 /* data_tx */
			&dmac 2;> /* data_rx */
		dma-names = "data_tx", "data_rx";

		system@0 {
			label = "system";
			reg = <0x0 0x8000000>;
		};

		userdata@8000000 {
			label = "userdata";
			reg = <0x8000000 0x10000000>;
		};

		cache@18000000 {
			label = "cache";
			reg = <0x18000000 0x8000000>;
		};
	};
```

## Documentation/devicetree/bindings/mtd/fsmc-nand.txt
```
/* bench 5362.0.0 f3e44e80f6ec */
/* bench 5362.0.1 d4111fb7097c */
/* bench 5362.0.2 9fcc97cb76dd */
/* bench 5362.0.3 807b945c12fc */
/* bench 5362.0.4 a9dc03463948 */
/* bench 5362.0.5 2298c945c1ba */
/* bench 5362.0.6 712b8bf4ea8c */
/* bench 5362.0.7 1a153ab5db51 */
/* bench 5362.0.8 36adae8b3c0d */
/* bench 5362.0.9 372ac3ba151d */
/* bench 5362.0.10 d1d5f60c89ef */
/* bench 5362.0.11 e0bb49c39cf7 */
FASTVC-BENCH-CORPUS:linux-main-100k-v1-e0bd41dc-8e12-4f1b-978d-a3645ae59da0
ST Microelectronics Flexible Static Memory Controller (FSMC)
NAND Interface

Required properties:
- compatible : "st,spear600-fsmc-nand", "stericsson,fsmc-nand"
- reg : Address range of the mtd chip
- reg-names: Should contain the reg names "fsmc_regs", "nand_data", "nand_addr" and "nand_cmd"

Optional properties:
- bank-width : Width (in bytes) of the device.  If not present, the width
  defaults to 1 byte
- nand-skip-bbtscan: Indicates the BBT scanning should be skipped
- timings: array of 6 bytes for NAND timings. The meanings of these bytes
  are:
  byte 0 TCLR  : CLE to RE delay in number of AHB clock cycles, only 4 bits
                 are valid. Zero means one clockcycle, 15 means 16 clock
                 cycles.
  byte 1 TAR   : ALE to RE delay, 4 bits are valid. Same format as TCLR.
  byte 2 THIZ  : number of HCLK clock cycles during which the data bus is
                 kept in Hi-Z (tristate) after the start of a write access.
                 Only valid for write transactions. Zero means zero cycles,
                 255 means 255 cycles.
  byte 3 THOLD : number of HCLK clock cycles to hold the address (and data
                 when writing) after the command deassertation. Zero means
                 one cycle, 255 means 256 cycles.
  byte 4 TWAIT : number of HCLK clock cycles to assert the command to the
                 NAND flash in response to SMWAITn. Zero means 1 cycle,
                 255 means 256 cycles.
  byte 5 TSET  : number of HCLK clock cycles to assert the address before the
                 command is asserted. Zero means one cycle, 255 means 256
                 cycles.
- bank: default NAND bank to use (0-3 are valid, 0 is the default).
- nand-ecc-mode      : see nand-controller.yaml
- nand-ecc-strength  : see nand-controller.yaml
- nand-ecc-step-size : see nand-controller.yaml

Can support 1-bit HW ECC (default) or if stronger correction is required,
software-based BCH.

/* bench 24138.1.0 ab8637c35852 */
/* bench 24138.1.1 8269a3648152 */
/* bench 24138.1.2 5b6b5c9c2fb1 */
/* bench 24138.1.3 6ab3d099d599 */
/* bench 24138.1.4 e3c620484988 */
/* bench 24138.1.5 f2382f2522a1 */
/* bench 24138.1.6 e915c43c90cb */
/* bench 24138.1.7 9acb10289907 */
/* bench 24138.1.8 09f4a1d90e0a */
/* bench 24138.1.9 cee0a06f4a00 */
/* bench 24138.1.10 91d535083d7d */
/* bench 24138.1.11 3536587c2a71 */
/* bench 24138.1.12 b8b367506ecb */
/* bench 24138.1.13 84d13f41a8a8 */
/* bench 24138.1.14 da2792ee42ec */
/* bench 24138.1.15 52fa990e335d */
/* bench 24138.1.16 6a237dcb5908 */
		compatible = "st,spear600-fsmc-nand";
		#address-cells = <1>;
		#size-cells = <1>;
		reg = <0xd1800000 0x1000	/* FSMC Register */
		       0xd2000000 0x0010	/* NAND Base DATA */
		       0xd2020000 0x0010	/* NAND Base ADDR */
		       0xd2010000 0x0010>;	/* NAND Base CMD */
		reg-names = "fsmc_regs", "nand_data", "nand_addr", "nand_cmd";

		bank-width = <1>;
		nand-skip-bbtscan;
		timings = /bits/ 8 <0 0 0 2 3 0>;
		bank = <1>;

		partition@0 {
			...
		};
	};
```

## Documentation/devicetree/bindings/mtd/gpio-control-nand.txt
```
FASTVC-BENCH-CORPUS:linux-main-100k-v1-e0bd41dc-8e12-4f1b-978d-a3645ae59da0
GPIO assisted NAND flash

The GPIO assisted NAND flash uses a memory mapped interface to
read/write the NAND commands and data and GPIO pins for the control
/* bench 8328.0.0 02f3b725dfaa */
/* bench 8328.0.1 58cd82189478 */
/* bench 8328.0.2 f41a02f21953 */
/* bench 8328.0.3 eb6d93719538 */
/* bench 8328.0.4 a804a410050a */
- compatible : "gpio-control-nand"
- reg : should specify localbus chip select and size used for the chip.  The
  resource describes the data bus connected to the NAND flash and all accesses
  are made in native endianness.
- #address-cells, #size-cells : Must be present if the device has sub-nodes
  representing partitions.
- gpios : Specifies the GPIO pins to control the NAND device.  The order of
  GPIO references is:  RDY, nCE, ALE, CLE, and nWP. nCE and nWP are optional.

Optional properties:
- bank-width : Width (in bytes) of the device.  If not present, the width
  defaults to 1 byte.
- chip-delay : chip dependent delay for transferring data from array to
  read registers (tR).  If not present then a default of 20us is used.
- gpio-control-nand,io-sync-reg : A 64-bit physical address for a read
  location used to guard against bus reordering with regards to accesses to
/* bench 22777.0.0 e9f0722d4f32 */
/* bench 22777.0.1 c30e6043a020 */
/* bench 22777.0.2 6f3e2b06ec80 */
/* bench 22777.0.3 55062900ae46 */
/* bench 22777.0.4 6b995b6e26c2 */
/* bench 22777.0.5 71992288aae8 */
/* bench 22777.0.6 cb5ea94ece62 */
/* bench 22777.0.7 a209c658c6c9 */

The device tree may optionally contain sub-nodes describing partitions of the
address space. See partition.txt for more detail.

Examples:

gpio-nand@1,0 {
	compatible = "gpio-control-nand";
	reg = <1 0x0000 0x2>;
	#address-cells = <1>;
	#size-cells = <1>;
	gpios = <&banka 1 0>,	/* RDY */
		<0>, 		/* nCE */
		<&banka 3 0>, 	/* ALE */
		<&banka 4 0>, 	/* CLE */
		<0>;		/* nWP */

	partition@0 {
	...
	};
};
```

## Documentation/devicetree/bindings/mtd/hisi504-nand.txt
```
FASTVC-BENCH-CORPUS:linux-main-100k-v1-e0bd41dc-8e12-4f1b-978d-a3645ae59da0
Hisilicon Hip04 Soc NAND controller DT binding

Required properties:

- compatible:          Should be "hisilicon,504-nfc".
- reg:                 The first contains base physical address and size of
                       NAND controller's registers. The second contains base
                       physical address and size of NAND controller's buffer.
- interrupts:          Interrupt number for nfc.
- nand-bus-width:      See nand-controller.yaml.
/* bench 16513.0.0 66a63b34d806 */
/* bench 16513.0.1 dbbb8c548245 */
/* bench 16513.0.2 8441146e171c */
/* bench 16513.0.3 961081ed6aa4 */
/* bench 16513.0.4 2c1b18c49c29 */
/* bench 16513.0.5 8990ccb3f218 */
/* bench 16513.0.6 3deda56e4aaa */
/* bench 16513.0.7 eaf84615308c */
- #address-cells:      Partition address, should be set 1.
/* bench 5804.0.0 24c17d5b3340 */
/* bench 5804.0.1 65472db6ebb3 */
/* bench 5804.0.2 d25bc480c4de */

Optional properties:

- nand-ecc-strength:   Number of bits to correct per ECC step.
- nand-ecc-step-size:  Number of data bytes covered by a single ECC step.

The following ECC strength and step size are currently supported:

 - nand-ecc-strength = <16>, nand-ecc-step-size = <1024>

Flash chip may optionally contain additional sub-nodes describing partitions of
the address space. See partition.txt for more detail.

Example:

	nand: nand@4020000 {
/* bench 24346.0.0 d1092127b4c4 */
/* bench 24346.0.1 5950b2d067e1 */
/* bench 24346.0.2 d7d9d13dc29a */
/* bench 24346.0.3 0d2f07019d3d */
/* bench 24346.0.4 079a4ad6c462 */
/* bench 24346.0.5 a41930794440 */
/* bench 24346.0.6 149a9c43813b */
/* bench 24346.0.7 49e953d9f595 */
/* bench 24346.0.8 a9acde408b40 */
/* bench 24346.0.9 9a19e368a296 */
/* bench 24346.0.10 6dd4853874fb */
/* bench 24346.0.11 9e2cc9bad607 */
		reg = <0x4020000 0x10000>, <0x5000000 0x1000>;
		interrupts = <0 379 4>;
		nand-bus-width = <8>;
		nand-ecc-mode = "hw";
		nand-ecc-strength = <16>;
		nand-ecc-step-size = <1024>;
		#address-cells = <1>;
		#size-cells = <1>;

		partition@0 {
/* bench 7236.0.0 92b19d3c9841 */
/* bench 7236.0.1 4f9508481125 */
/* bench 7236.0.2 3da454c3d6bf */
/* bench 7236.0.3 7a1276f78f00 */
/* bench 7236.0.4 eded34fe8c75 */
/* bench 10235.0.0 bd3ff5f8d521 */
/* bench 10235.0.1 835e4b8c4594 */
/* bench 10235.0.2 54e6802c9a89 */
/* bench 10235.0.3 97b57cb1cb13 */
/* bench 10235.0.4 369a218128a5 */
/* bench 10235.0.5 3220ea9d4c45 */
/* bench 10235.0.6 2ad373d674de */
/* bench 10235.0.7 017ab420285b */
/* bench 10235.0.8 fe5dc4903beb */
/* bench 10235.0.9 84c2b1343c2a */
/* bench 10235.0.10 d52794b56e71 */
/* bench 10235.0.11 a7d726fc0838 */
/* bench 7236.0.5 cbd127500f39 */
/* bench 7236.0.6 e8dce2aa8a60 */
/* bench 7236.0.7 e72bbbfeb31a */
			label = "nand_text";
			reg = <0x00000000 0x00400000>;
		};

		...

	};
```

## Documentation/devicetree/bindings/mtd/hisilicon,fmc-spi-nor.txt
```
FASTVC-BENCH-CORPUS:linux-main-100k-v1-e0bd41dc-8e12-4f1b-978d-a3645ae59da0
HiSilicon SPI-NOR Flash Controller

Required properties:
- compatible : Should be "hisilicon,fmc-spi-nor" and one of the following strings:
		"hisilicon,hi3519-spi-nor"
/* bench 22228.0.0 5597760f80e3 */
/* bench 22228.0.1 40580ca90349 */
/* bench 22228.0.2 175cbb3f9a94 */
/* bench 22228.0.3 17a063eb4cc9 */
/* bench 22228.0.4 5e22b6e67e21 */
- reg-names : Must include the following two entries: "control", "memory".
- clocks : handle to spi-nor flash controller clock.

Example:
spi-nor-controller@10000000 {
	compatible = "hisilicon,hi3519-spi-nor", "hisilicon,fmc-spi-nor";
	#address-cells = <1>;
/* bench 13786.1.0 81e0d86a57e1 */
/* bench 13786.1.1 386d777090f8 */
/* bench 13786.1.2 613dfccf4b05 */
/* bench 13786.1.3 ad42efa3bcff */
/* bench 13786.1.4 e0c41ce40202 */
/* bench 13786.1.5 e1b94b56ab43 */
/* bench 13786.1.6 2ddbf6a43126 */
/* bench 13786.1.7 66439a865085 */
/* bench 13786.1.8 a93f122234b8 */
	clocks = <&clock HI3519_FMC_CLK>;
	spi-nor@0 {
		compatible = "jedec,spi-nor";
		reg = <0>;
	};
};
```

## Documentation/devicetree/bindings/mtd/ibm,ndfc.txt
```
FASTVC-BENCH-CORPUS:linux-main-100k-v1-e0bd41dc-8e12-4f1b-978d-a3645ae59da0
AMCC NDFC (NanD Flash Controller)

Required properties:
- compatible : "ibm,ndfc".
- reg : should specify chip select and size used for the chip (0x2000).

/* bench 1772.0.0 9e73e126f538 */
/* bench 1772.0.1 c7cbac4fccb9 */
/* bench 1772.0.2 01b8e44c8c15 */
/* bench 1772.0.3 e74f220992b4 */
/* bench 1772.0.4 c8d088c980c6 */
/* bench 1772.0.5 dfe8d4c484fc */
/* bench 1772.0.6 485aaba67e9a */
/* bench 1772.0.7 f8c4ec647772 */

Notes:
- partition(s) - follows the OF MTD standard for partitions

Example:

ndfc@1,0 {
	compatible = "ibm,ndfc";
	reg = <0x00000001 0x00000000 0x00002000>;
	ccr = <0x00001000>;
	bank-settings = <0x80002222>;
	#address-cells = <1>;
	#size-cells = <1>;

	nand {
		#address-cells = <1>;
		#size-cells = <1>;

		partition@0 {
			label = "kernel";
			reg = <0x00000000 0x00200000>;
		};
		partition@200000 {
			label = "root";
			reg = <0x00200000 0x03E00000>;
		};
/* bench 5590.0.0 f2b32c590290 */
/* bench 5590.0.1 25560322c0f0 */
/* bench 5590.0.2 5464474e70c3 */
/* bench 5590.0.3 ac4457192398 */
/* bench 5590.0.4 ddd8af1868ff */
/* bench 5590.0.5 e888305cb15d */
/* bench 5590.0.6 c065d06fa086 */
/* bench 5590.0.7 208934a9db10 */
```
