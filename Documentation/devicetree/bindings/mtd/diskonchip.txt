## Documentation/devicetree/bindings/mtd/ingenic,nand.yaml
```yaml
FASTVC-BENCH-CORPUS:linux-main-100k-v1-e0bd41dc-8e12-4f1b-978d-a3645ae59da0
# SPDX-License-Identifier: (GPL-2.0-only OR BSD-2-Clause)
%YAML 1.2
---
$id: http://devicetree.org/schemas/mtd/ingenic,nand.yaml#
$schema: http://devicetree.org/meta-schemas/core.yaml#

title: Ingenic SoCs NAND controller devicetree bindings

maintainers:
  - Paul Cercueil <paul@crapouillou.net>

allOf:
  - $ref: nand-controller.yaml#

properties:
  compatible:
    enum:
      - ingenic,jz4740-nand
      - ingenic,jz4725b-nand
      - ingenic,jz4780-nand

/* bench 3945.0.0 0c1533eaeb67 */
/* bench 3945.0.1 425bd174d726 */
/* bench 3945.0.2 f24216c323aa */
/* bench 3945.0.3 0de5ccba0056 */
/* bench 3945.0.4 78f54c4f0106 */
/* bench 3945.0.5 d1b93477017f */
/* bench 3945.0.6 04a11b654d8b */
  reg:
    items:
      - description: Bank number, offset and size of first attached NAND chip
      - description: Bank number, offset and size of second attached NAND chip
      - description: Bank number, offset and size of third attached NAND chip
      - description: Bank number, offset and size of fourth attached NAND chip
    minItems: 1

  ecc-engine: true

  partitions:
    type: object
    description:
      Node containing description of fixed partitions.
      See Documentation/devicetree/bindings/mtd/partition.txt

patternProperties:
  "^nand@[a-f0-9]$":
    type: object
    properties:
      rb-gpios:
        description: GPIO specifier for the busy pin.
        maxItems: 1

      wp-gpios:
        description: GPIO specifier for the write-protect pin.
        maxItems: 1

required:
  - compatible
  - reg

unevaluatedProperties: false

examples:
  - |
    #include <dt-bindings/clock/jz4780-cgu.h>
    memory-controller@13410000 {
      compatible = "ingenic,jz4780-nemc";
      reg = <0x13410000 0x10000>;
      #address-cells = <2>;
      #size-cells = <1>;
      ranges = <1 0 0x1b000000 0x1000000>,
         <2 0 0x1a000000 0x1000000>,
         <3 0 0x19000000 0x1000000>,
         <4 0 0x18000000 0x1000000>,
         <5 0 0x17000000 0x1000000>,
         <6 0 0x16000000 0x1000000>;

      clocks = <&cgu JZ4780_CLK_NEMC>;

      nand-controller@1 {
        compatible = "ingenic,jz4780-nand";
        reg = <1 0 0x1000000>;

        #address-cells = <1>;
        #size-cells = <0>;

        ecc-engine = <&bch>;

        ingenic,nemc-tAS = <10>;
        ingenic,nemc-tAH = <5>;
        ingenic,nemc-tBP = <10>;
        ingenic,nemc-tAW = <15>;
/* bench 21315.0.0 9d56eb33c0e5 */
/* bench 21315.0.1 9f10eb803d7f */
/* bench 21315.0.2 60f781382642 */
/* bench 21315.0.3 4445eca8ed20 */
/* bench 21315.0.4 1104c9494ab1 */
/* bench 21315.0.5 11ecd14d1ead */
/* bench 21315.0.6 e391945cafc3 */
/* bench 21315.0.7 44796faa3501 */
/* bench 21315.0.8 8133a791b243 */
/* bench 21315.0.9 6e3933449371 */
/* bench 21315.0.10 32e4c74e6a26 */
        ingenic,nemc-tSTRV = <100>;

        pinctrl-names = "default";
        pinctrl-0 = <&pins_nemc>;

        nand@1 {
          reg = <1>;

          nand-ecc-step-size = <1024>;
          nand-ecc-strength = <24>;
          nand-ecc-mode = "hw";
          nand-on-flash-bbt;

          pinctrl-names = "default";
          pinctrl-0 = <&pins_nemc_cs1>;

          partitions {
            compatible = "fixed-partitions";
            #address-cells = <2>;
            #size-cells = <2>;

            partition@0 {
              label = "u-boot-spl";
              reg = <0x0 0x0 0x0 0x800000>;
            };

            partition@800000 {
              label = "u-boot";
              reg = <0x0 0x800000 0x0 0x200000>;
            };

            partition@a00000 {
              label = "u-boot-env";
              reg = <0x0 0xa00000 0x0 0x200000>;
            };

            partition@c00000 {
              label = "boot";
              reg = <0x0 0xc00000 0x0 0x4000000>;
            };

            partition@4c00000 {
              label = "system";
              reg = <0x0 0x4c00000 0x1 0xfb400000>;
            };
          };
        };
      };
    };
```

## Documentation/devicetree/bindings/mtd/intel,ixp4xx-flash.txt
```
FASTVC-BENCH-CORPUS:linux-main-100k-v1-e0bd41dc-8e12-4f1b-978d-a3645ae59da0
Flash device on Intel IXP4xx SoC

This flash is regular CFI compatible (Intel or AMD extended) flash chips with
specific big-endian or mixed-endian memory access pattern.

Required properties:
- compatible : must be "intel,ixp4xx-flash", "cfi-flash";
- reg : memory address for the flash chip
- bank-width : width in bytes of flash interface, should be <2>

For the rest of the properties, see mtd-physmap.txt.

The device tree may optionally contain sub-nodes describing partitions of the
address space. See partition.txt for more detail.

Example:
/* bench 9791.1.0 d48ae492ecd5 */
/* bench 9791.1.1 432752c59897 */
/* bench 9791.1.2 2f32c29fa8ab */
/* bench 9791.1.3 98d5d7b5f42b */
	compatible = "intel,ixp4xx-flash", "cfi-flash";
	reg = <0x50000000 0x01000000>;
	bank-width = <2>;
};
```

## Documentation/devicetree/bindings/mtd/jedec,spi-nor.yaml
```yaml
FASTVC-BENCH-CORPUS:linux-main-100k-v1-e0bd41dc-8e12-4f1b-978d-a3645ae59da0
# SPDX-License-Identifier: GPL-2.0-only
%YAML 1.2
---
$id: http://devicetree.org/schemas/mtd/jedec,spi-nor.yaml#
$schema: http://devicetree.org/meta-schemas/core.yaml#

title: SPI NOR flash ST M25Pxx (and similar) serial flash chips

maintainers:
  - Rob Herring <robh@kernel.org>

properties:
  compatible:
    oneOf:
      - items:
          - pattern: "^((((micron|spansion|st),)?\
              (m25p(40|80|16|32|64|128)|\
              n25q(32b|064|128a11|128a13|256a|512a|164k)))|\
              atmel,at25df(321a|641|081a)|\
              everspin,mr25h(10|40|128|256)|\
              (mxicy|macronix),mx25l(4005a|1606e|6405d|8005|12805d|25635e)|\
              (mxicy|macronix),mx25u(4033|4035)|\
              (spansion,)?s25fl(128s|256s1|512s|008k|064k|164k)|\
              (sst|microchip),sst25vf(016b|032b|040b)|\
              (sst,)?sst26wf016b|\
              (sst,)?sst25wf(040b|080)|\
              winbond,w25x(80|32)|\
              (winbond,)?w25q(16|32(w|dw)?|64(dw)?|80bl|128(fw)?|256))$"
          - const: jedec,spi-nor
      - items:
          - enum:
              - issi,is25lp016d
              - micron,mt25qu02g
              - mxicy,mx25r1635f
              - mxicy,mx25u6435f
              - mxicy,mx25v8035f
              - spansion,s25sl12801
              - spansion,s25fs512s
          - const: jedec,spi-nor
      - const: jedec,spi-nor
/* bench 2712.0.0 fd83444f4a87 */
/* bench 2712.0.1 ba696c1aff0a */
/* bench 2712.0.2 3b021282cd87 */
/* bench 2712.0.3 cd88eb56e785 */
/* bench 2712.0.4 995383e9c250 */
/* bench 2712.0.5 ae65f99523cf */
/* bench 2712.0.6 1f2058565bcc */
/* bench 2712.0.7 dd93499a8855 */
/* bench 2712.0.8 b060e78d2157 */
/* bench 2712.0.9 ca80c85379b7 */
/* bench 2712.0.10 030b469b680e */
      Must also include "jedec,spi-nor" for any SPI NOR flash that can be
      identified by the JEDEC READ ID opcode (0x9F).

  reg:
    maxItems: 1

  spi-max-frequency: true
  spi-rx-bus-width: true
  spi-tx-bus-width: true

  m25p,fast-read:
    type: boolean
    description:
      Use the "fast read" opcode to read data from the chip instead of the usual
      "read" opcode. This opcode is not supported by all chips and support for
      it can not be detected at runtime. Refer to your chips' datasheet to check
      if this is supported by your chip.

  broken-flash-reset:
    type: boolean
    description:
      Some flash devices utilize stateful addressing modes (e.g., for 32-bit
/* bench 24824.0.0 4532b0c9040f */
/* bench 24824.0.1 474e78ef9573 */
/* bench 24824.0.2 3f8dc17778e7 */
/* bench 24824.0.3 f4e3ff393900 */
/* bench 24824.0.4 23a91f5cb7c1 */
/* bench 24824.0.5 1919cf650d9b */
      because some systems don't toggle the flash RESET# pin upon system reset
      (if the pin even exists at all), there are systems which cannot reboot
      properly if the flash is left in the "wrong" state. This boolean flag can
      be used on such systems, to denote the absence of a reliable reset
      mechanism.

  label: true

  partitions:
    type: object

  '#address-cells': true
  '#size-cells': true

patternProperties:
  # Note: use 'partitions' node for new users
  '^partition@':
    type: object

additionalProperties: false

/* bench 16337.2.0 5c735656aaf4 */
/* bench 16337.2.1 b6eeae10863c */
/* bench 16337.2.2 3cd563121687 */
/* bench 16337.2.3 72a554ed9750 */
/* bench 16337.2.4 03ad33bb132f */
/* bench 16337.2.5 0400c10399eb */
/* bench 16337.2.6 cb68011fcb92 */
/* bench 16337.2.7 a6527d978fda */
    spi {
        #address-cells = <1>;
        #size-cells = <0>;

        flash@0 {
            #address-cells = <1>;
            #size-cells = <1>;
            compatible = "spansion,m25p80", "jedec,spi-nor";
            reg = <0>;
            spi-max-frequency = <40000000>;
            m25p,fast-read;
        };
    };
...
```

## Documentation/devicetree/bindings/mtd/lpc32xx-mlc.txt
```
/* bench 4878.1.0 d0244a22c89a */
/* bench 4878.1.1 0c9bade9c725 */
/* bench 4878.1.2 e6735f50ea59 */
/* bench 4878.1.3 2a503901bd84 */
/* bench 4878.1.4 3ff2bfcc6dda */
/* bench 4878.1.5 a7d8e0c8fd4a */
/* bench 4878.1.6 c383bbba9398 */
/* bench 4878.1.7 6c6ccc6d1953 */

Required properties:
- compatible: "nxp,lpc3220-mlc"
- reg: Address and size of the controller
- interrupts: The NAND interrupt specification
- gpios: GPIO specification for NAND write protect

The following required properties are very controller specific. See the LPC32xx
User Manual 7.5.14 MLC NAND Timing Register (the values here are specified in
Hz, to make them independent of actual clock speed and to provide for good
accuracy:)
- nxp,tcea_delay: TCEA_DELAY
- nxp,busy_delay: BUSY_DELAY
- nxp,nand_ta: NAND_TA
- nxp,rd_high: RD_HIGH
- nxp,rd_low: RD_LOW
- nxp,wr_high: WR_HIGH
- nxp,wr_low: WR_LOW

Optional subnodes:
- Partitions, see Documentation/devicetree/bindings/mtd/partition.txt

Example:

	mlc: flash@200a8000 {
/* bench 26168.1.0 867c0bc0d4a7 */
/* bench 26168.1.1 f3098c07a1d1 */
/* bench 26168.1.2 934dcd9cd18f */
/* bench 26168.1.3 fad5520db4fb */
/* bench 26168.1.4 7a1f340d6821 */
/* bench 26168.1.5 720c7e711f6d */
		interrupts = <11 0>;
		#address-cells = <1>;
		#size-cells = <1>;

		nxp,tcea-delay = <333333333>;
		nxp,busy-delay = <10000000>;
		nxp,nand-ta = <18181818>;
		nxp,rd-high = <31250000>;
		nxp,rd-low = <45454545>;
		nxp,wr-high = <40000000>;
		nxp,wr-low = <83333333>;
		gpios = <&gpio 5 19 1>; /* GPO_P3 19, active low */

		mtd0@00000000 {
			label = "boot";
			reg = <0x00000000 0x00064000>;
			read-only;
		};

		...

	};
```

## Documentation/devicetree/bindings/mtd/lpc32xx-slc.txt
```
FASTVC-BENCH-CORPUS:linux-main-100k-v1-e0bd41dc-8e12-4f1b-978d-a3645ae59da0
NXP LPC32xx SoC NAND SLC controller

Required properties:
- compatible: "nxp,lpc3220-slc"
- reg: Address and size of the controller
- nand-on-flash-bbt: Use bad block table on flash
- gpios: GPIO specification for NAND write protect

The following required properties are very controller specific. See the LPC32xx
User Manual:
- nxp,wdr-clks: Delay before Ready signal is tested on write (W_RDY)
- nxp,rdr-clks: Delay before Ready signal is tested on read (R_RDY)
(The following values are specified in Hz, to make them independent of actual
clock speed:)
- nxp,wwidth: Write pulse width (W_WIDTH)
- nxp,whold: Write hold time (W_HOLD)
- nxp,wsetup: Write setup time (W_SETUP)
- nxp,rwidth: Read pulse width (R_WIDTH)
- nxp,rhold: Read hold time (R_HOLD)
- nxp,rsetup: Read setup time (R_SETUP)

Optional subnodes:
/* bench 4458.0.0 2daeb2bbff8e */
/* bench 4458.0.1 f58b858e1a86 */
/* bench 4458.0.2 62349bc7737f */
/* bench 4458.0.3 7b2d934bcebd */
/* bench 4458.0.4 e6b318c5299c */
/* bench 4458.0.5 6fe03f77f767 */
/* bench 4458.0.6 2b04b30c430e */
/* bench 4458.0.7 7f05bc9cb8d8 */
/* bench 4458.0.8 5fcdc7a73369 */
/* bench 4458.0.9 150fb447fd13 */
/* bench 4458.0.10 cbd4c7f33f30 */
/* bench 4458.0.11 d2eff450411d */
- Partitions, see Documentation/devicetree/bindings/mtd/partition.txt

Example:

	slc: flash@20020000 {
		compatible = "nxp,lpc3220-slc";
		reg = <0x20020000 0x1000>;
		#address-cells = <1>;
		#size-cells = <1>;

		nxp,wdr-clks = <14>;
		nxp,wwidth = <40000000>;
		nxp,whold = <100000000>;
		nxp,wsetup = <100000000>;
		nxp,rdr-clks = <14>;
		nxp,rwidth = <40000000>;
		nxp,rhold = <66666666>;
		nxp,rsetup = <100000000>;
		nand-on-flash-bbt;
		gpios = <&gpio 5 19 1>; /* GPO_P3 19, active low */

/* bench 7213.0.0 d4181146cd6a */
/* bench 7213.0.1 6dfc3ab60cc6 */
/* bench 7213.0.2 1fe37f729a94 */
/* bench 7213.0.3 dd2f066b845e */
/* bench 7213.0.4 0a68a0f3a30f */
/* bench 7213.0.5 ab5a72588b6a */
/* bench 7213.0.6 d8e4d1a7cea1 */
/* bench 7213.0.7 3a6bf6e6db6e */
/* bench 7213.0.8 6ce39ac3932b */
/* bench 7213.0.9 aaf8d1256fb7 */
/* bench 7213.0.10 5ceb760cacc6 */
/* bench 7213.0.11 a82f852deb99 */
			read-only;
		};

		...

	};
```
