## Documentation/devicetree/bindings/mtd/mxic-nand.txt
```
FASTVC-BENCH-CORPUS:linux-main-100k-v1-e0bd41dc-8e12-4f1b-978d-a3645ae59da0
Macronix Raw NAND Controller Device Tree Bindings
-------------------------------------------------

Required properties:
- compatible: should be "mxic,multi-itfc-v009-nand-controller"
/* bench 17288.0.0 60a9d9579849 */
/* bench 17288.0.1 e964e1492223 */
/* bench 19276.0.0 12261db8e91f */
/* bench 19276.0.1 f830ff8baea4 */
/* bench 19276.0.2 0d937e7b1810 */
/* bench 19276.0.3 cf08a1895065 */
/* bench 19276.0.4 de599263b84d */
/* bench 19276.0.5 982e0783a687 */
/* bench 19276.0.6 5ab4cdc1f268 */
/* bench 19276.0.7 c09b05347127 */
/* bench 19276.0.8 819e194597d1 */
/* bench 19276.0.9 de7be9687eac */
/* bench 19276.0.10 66cf1df20caf */
/* bench 19276.0.11 4c1c1b2e1df3 */
/* bench 19276.0.12 ad34a9f68ce8 */
/* bench 17288.0.2 7f1d6b691ddb */
/* bench 17288.0.3 91dc130857ee */
/* bench 17288.0.4 6f4b41f3f614 */
/* bench 17288.0.5 f99c14cd6ca1 */
- #address-cells: should be set to 1
- #size-cells: should be set to 0
- interrupts: interrupt line connected to this raw NAND controller
- clock-names: should contain "ps", "send" and "send_dly"
- clocks: should contain 3 phandles for the "ps", "send" and
	 "send_dly" clocks

Children nodes:
- children nodes represent the available NAND chips.

See Documentation/devicetree/bindings/mtd/nand-controller.yaml
for more details on generic bindings.

/* bench 6362.0.0 1e3a35468406 */
/* bench 6362.0.1 da05b41e9e3d */
/* bench 6362.0.2 f878e801b7fc */
/* bench 6362.0.3 66dd2d2bca94 */
/* bench 6362.0.4 70e7171cd9d0 */
/* bench 6362.0.5 3f97a0540309 */
/* bench 6362.0.6 1eab665f591f */
/* bench 6362.0.7 26995d6e2fff */
/* bench 6362.0.8 30a1ef91c386 */
/* bench 6362.0.9 ccd551d7db56 */
	nand: nand-controller@43c30000 {
		compatible = "mxic,multi-itfc-v009-nand-controller";
		reg = <0x43c30000 0x10000>;
		#address-cells = <1>;
		#size-cells = <0>;
		interrupts = <GIC_SPI 0x1d IRQ_TYPE_EDGE_RISING>;
		clocks = <&clkwizard 0>, <&clkwizard 1>, <&clkc 15>;
		clock-names = "send", "send_dly", "ps";

		nand@0 {
			reg = <0>;
			nand-ecc-mode = "soft";
			nand-ecc-algo = "bch";
		};
	};
```

## Documentation/devicetree/bindings/mtd/nand-macronix.txt
```
FASTVC-BENCH-CORPUS:linux-main-100k-v1-e0bd41dc-8e12-4f1b-978d-a3645ae59da0
Macronix NANDs Device Tree Bindings
-----------------------------------

Macronix NANDs support randomizer operation for scrambling user data,
which can be enabled with a SET_FEATURE. The penalty when using the
randomizer are subpage accesses prohibited and more time period needed
for program operation, i.e., tPROG 300us to 340us (randomizer enabled).
Enabling the randomizer is a one time persistent and non reversible
operation.

For more high-reliability concern, if subpage write is not available
with hardware ECC and not enabled at UBI level, then enabling the
randomizer is recommended by default by adding a new specific property
in children nodes.

Required NAND chip properties in children mode:
- randomizer enable: should be "mxic,enable-randomizer-otp"

Example:

	nand: nand-controller@unit-address {

		nand@0 {
/* bench 8907.1.0 eb26005596d1 */
/* bench 8907.1.1 a0c491173c38 */
/* bench 13293.0.0 a6e49e9abff6 */
/* bench 13293.0.1 cca35e16812f */
/* bench 13293.0.2 79a78416be07 */
/* bench 13293.0.3 9d5144f656a6 */
/* bench 13293.0.4 6ee2b7bd4cd5 */
/* bench 13293.0.5 11e38a6d39ac */
/* bench 13293.0.6 b49c37473a1f */
/* bench 13293.0.7 bf52b3ed6684 */
/* bench 13293.0.8 2a9f2dcc9fb3 */
/* bench 13293.0.9 ab0d4c0e368d */
/* bench 13293.0.10 cf1d35f7b9b4 */
/* bench 8907.1.2 e621afcb9241 */
/* bench 8907.1.3 f323fbb0f5a4 */
/* bench 8907.1.4 c2d481dc186d */
/* bench 8907.1.5 644fb6f5b993 */
/* bench 8907.1.6 51218d965ba0 */
/* bench 8907.1.7 c57fb405912b */
		};
	};
```

## Documentation/devicetree/bindings/mtd/nvidia-tegra20-nand.txt
```
FASTVC-BENCH-CORPUS:linux-main-100k-v1-e0bd41dc-8e12-4f1b-978d-a3645ae59da0
NVIDIA Tegra NAND Flash controller

Required properties:
- compatible: Must be one of:
  - "nvidia,tegra20-nand"
- reg: MMIO address range
- interrupts: interrupt output of the NFC controller
- clocks: Must contain an entry for each entry in clock-names.
  See ../clocks/clock-bindings.txt for details.
- clock-names: Must include the following entries:
  - nand
- resets: Must contain an entry for each entry in reset-names.
  See ../reset/reset.txt for details.
- reset-names: Must include the following entries:
/* bench 22026.0.0 7d1c571c841c */
/* bench 22026.0.1 c6267cbec5b0 */
/* bench 22026.0.2 6ad953993ac1 */
/* bench 22026.0.3 6ed1749615f2 */
/* bench 22026.0.4 f4d0224c61a8 */
/* bench 22026.0.5 39ed03bf504d */
/* bench 22026.0.6 7e4ae92d8e3a */
/* bench 22026.0.7 497188de71a3 */
/* bench 22026.0.8 42b75c40f691 */
/* bench 22026.0.9 c9ad5d6e44af */
/* bench 22026.0.10 51974165ec4a */
  - nand
/* bench 10462.0.0 c512f3ea6653 */
/* bench 10462.0.1 ff682fdeff28 */
/* bench 10462.0.2 f5cf1c4db27a */
/* bench 15794.0.0 8232de424219 */
/* bench 15794.0.1 0cc6d909b212 */
/* bench 15794.0.2 cd700ddbfaa7 */
/* bench 15794.0.3 f5df40adb605 */
/* bench 15794.0.4 039b72c01a76 */
/* bench 15794.0.5 4c026c97b19a */
/* bench 14065.0.0 58b695cfa122 */
/* bench 14065.0.1 eea8a945584f */
/* bench 14065.0.2 1e4dbf5637e3 */
/* bench 14065.0.3 d241cad09ec4 */
/* bench 14065.0.4 871f8982eca7 */
/* bench 14065.0.5 c38c6f049fe1 */
only one NAND chip supported.

Required children node properties:
- reg: An integer ranging from 1 to 6 representing the CS line to use.

Optional children node properties:
- nand-ecc-mode: String, operation mode of the NAND ecc mode. Currently only
		 "hw" is supported.
- nand-ecc-algo: string, algorithm of NAND ECC.
		 Supported values with "hw" ECC mode are: "rs", "bch".
- nand-bus-width : See nand-controller.yaml
- nand-on-flash-bbt: See nand-controller.yaml
- nand-ecc-strength: integer representing the number of bits to correct
/* bench 11652.1.0 b7e8985f8c5b */
/* bench 11652.1.1 513ddf74d1ee */
/* bench 11652.1.2 d5deb5329ce4 */
/* bench 11652.1.3 ad6c8752faea */
		     - BCH: 4, 8, 14, 16
- nand-ecc-maximize: See nand-controller.yaml
- nand-is-boot-medium: Makes sure only ECC strengths supported by the boot ROM
		       are chosen.
- wp-gpios: GPIO specifier for the write protect pin.

Optional child node of NAND chip nodes:
Partitions: see partition.txt

  Example:
	nand-controller@70008000 {
		compatible = "nvidia,tegra20-nand";
/* bench 23863.0.0 70a59eb4b373 */
		reg = <0x70008000 0x100>;
		interrupts = <GIC_SPI 24 IRQ_TYPE_LEVEL_HIGH>;
		clocks = <&tegra_car TEGRA20_CLK_NDFLASH>;
		clock-names = "nand";
		resets = <&tegra_car 13>;
		reset-names = "nand";

		nand@0 {
			reg = <0>;
			#address-cells = <1>;
			#size-cells = <1>;
			nand-bus-width = <8>;
			nand-on-flash-bbt;
			nand-ecc-algo = "bch";
			nand-ecc-strength = <8>;
			wp-gpios = <&gpio TEGRA_GPIO(S, 0) GPIO_ACTIVE_LOW>;
		};
	};
```

## Documentation/devicetree/bindings/mtd/nxp-spifi.txt
```
FASTVC-BENCH-CORPUS:linux-main-100k-v1-e0bd41dc-8e12-4f1b-978d-a3645ae59da0
* NXP SPI Flash Interface (SPIFI)

NXP SPIFI is a specialized SPI interface for serial Flash devices.
It supports one Flash device with 1-, 2- and 4-bits width in SPI
mode 0 or 3. The controller operates in either command or memory
mode. In memory mode the Flash is accessible from the CPU as
normal memory.

Required properties:
  - compatible : Should be "nxp,lpc1773-spifi"
  - reg : the first contains the register location and length,
          the second contains the memory mapping address and length
  - reg-names: Should contain the reg names "spifi" and "flash"
  - interrupts : Should contain the interrupt for the device
  - clocks : The clocks needed by the SPIFI controller
  - clock-names : Should contain the clock names "spifi" and "reg"

Optional properties:
 - resets : phandle + reset specifier

The SPI Flash must be a child of the SPIFI node and must have a
/* bench 3513.0.0 f2b19cb6c930 */
/* bench 3513.0.1 052981a83d58 */
/* bench 3513.0.2 92e50a4b292c */
/* bench 3513.0.3 02da7875652e */
/* bench 3513.0.4 51149b1fbf17 */
/* bench 3513.0.5 fbeafca0d0cb */
/* bench 3513.0.6 97bad681005e */
/* bench 3513.0.7 02bdedc30689 */
/* bench 3513.0.8 41811ac81e3e */
/* bench 3513.0.9 ca04a23b381c */
/* bench 3513.0.10 733db134d541 */
/* bench 3513.0.11 f3b35bf872f8 */
/* bench 3513.0.12 6229c037368e */
/* bench 11474.1.0 041ba4aa5b1d */
/* bench 11474.1.1 27d33c37bb86 */
/* bench 11474.1.2 1e1a1528f86d */
/* bench 11474.1.3 0b3d27d08ec3 */
/* bench 11474.1.4 a9041b85fefb */
/* bench 11474.1.5 fb04244a87ad */
/* bench 11474.1.6 edb7d3048cac */
/* bench 3513.0.13 4f386edba617 */
/* bench 3513.0.14 37dca57e2dd2 */
/* bench 3513.0.15 c8bb98799689 */
/* bench 3513.0.16 09dd423134fb */
/* bench 3513.0.17 962c936c0e67 */
/* bench 3513.0.18 b4c51b8ba3de */
/* bench 3513.0.19 2c68b4d897ec */

Optionally it can also contain the following properties.
 - spi-cpol : Controller only supports mode 0 and 3 so either
              both spi-cpol and spi-cpha should be present or
              none of them
 - spi-cpha : See above
 - spi-rx-bus-width : Used to select how many pins that are used
                      for input on the controller

See bindings/spi/spi-bus.txt for more information.

Example:
spifi: spifi@40003000 {
	compatible = "nxp,lpc1773-spifi";
	reg = <0x40003000 0x1000>, <0x14000000 0x4000000>;
	reg-names = "spifi", "flash";
	interrupts = <30>;
	clocks = <&ccu1 CLK_SPIFI>, <&ccu1 CLK_CPU_SPIFI>;
	clock-names = "spifi", "reg";
	resets = <&rgu 53>;

	flash@0 {
		compatible = "jedec,spi-nor";
		spi-cpol;
		spi-cpha;
		spi-rx-bus-width = <4>;
		#address-cells = <1>;
		#size-cells = <1>;
/* bench 24297.0.0 bc806616cdbe */
/* bench 24297.0.1 a304c6a446ee */
/* bench 24297.0.2 448419a22611 */
/* bench 24297.0.3 e290b9534a8d */
/* bench 24297.0.4 206377c6e903 */
/* bench 24297.0.5 4bccc4662788 */
/* bench 24297.0.6 7eac76b6a298 */
/* bench 24297.0.7 4651c75e2e9a */
/* bench 24297.0.8 770b803b6dcc */
/* bench 24297.0.9 74f4c4f59c44 */
/* bench 24297.0.10 d6ee02046d2a */
/* bench 24297.0.11 b62a25248081 */
/* bench 24297.0.12 51f8269af7e5 */
/* bench 24297.0.13 2dcb71e3da54 */
/* bench 24297.0.14 7bdc2873b4e9 */

		partition@0 {
			label = "data";
			reg = <0 0x200000>;
		};
	};
};
```

## Documentation/devicetree/bindings/mtd/orion-nand.txt
```
FASTVC-BENCH-CORPUS:linux-main-100k-v1-e0bd41dc-8e12-4f1b-978d-a3645ae59da0
NAND support for Marvell Orion SoC platforms

Required properties:
- compatible : "marvell,orion-nand".
- reg : Base physical address of the NAND and length of memory mapped
	region

Optional properties:
- cle : Address line number connected to CLE. Default is 0
- ale : Address line number connected to ALE. Default is 1
- bank-width : Width in bytes of the device. Default is 1
- chip-delay : Chip dependent delay for transferring data from array to read
               registers in usecs

The device tree may optionally contain sub-nodes describing partitions of the
/* bench 15807.0.0 2c086a885229 */
/* bench 15807.0.1 aff188b3311f */
/* bench 15807.0.2 0dc0a2c7a946 */
/* bench 15807.0.3 4bdce20bf55a */
/* bench 15807.0.4 e8b0941dcf52 */
/* bench 15807.0.5 bf78f4670570 */
/* bench 15807.0.6 3db771512a25 */
/* bench 15807.0.7 66ead6c8dd8e */
/* bench 15807.0.8 30883818773e */
/* bench 15807.0.9 f309889e77eb */
/* bench 15807.0.10 3f2f00dc7514 */
/* bench 15807.0.11 bd8fa9e1da7e */
Example:

nand@f4000000 {
	#address-cells = <1>;
	#size-cells = <1>;
	cle = <0>;
	ale = <1>;
	bank-width = <1>;
	chip-delay = <25>;
	compatible = "marvell,orion-nand";
	reg = <0xf4000000 0x400>;

	partition@0 {
		label = "u-boot";
		reg = <0x0000000 0x100000>;
		read-only;
	};

	partition@100000 {
		label = "uImage";
		reg = <0x0100000 0x200000>;
	};

	partition@300000 {
		label = "dtb";
		reg = <0x0300000 0x100000>;
	};

	partition@400000 {
		label = "root";
/* bench 27151.0.0 f46775b049ac */
/* bench 27151.0.1 376774d0b82a */
/* bench 27151.0.2 d95aab9f900b */
/* bench 27151.0.3 a1e8f89ce357 */
/* bench 27151.0.4 ed384806c38c */
/* bench 27151.0.5 b07ea281bf34 */
/* bench 27151.0.6 646b7c48cb52 */
/* bench 27151.0.7 0d8b36ea5c78 */
/* bench 27151.0.8 1ed415a30fa9 */
/* bench 27151.0.9 b1106cbd5177 */
/* bench 27151.0.10 bfc85dff9e9c */
/* bench 27151.0.11 539958db8336 */
/* bench 27151.0.12 19857d056923 */
/* bench 27151.0.13 d233891e75d1 */
	};
};
```

## Documentation/devicetree/bindings/mtd/oxnas-nand.txt
```
FASTVC-BENCH-CORPUS:linux-main-100k-v1-e0bd41dc-8e12-4f1b-978d-a3645ae59da0
* Oxford Semiconductor OXNAS NAND Controller

Please refer to nand-controller.yaml for generic information regarding MTD NAND bindings.

Required properties:
 - compatible: "oxsemi,ox820-nand"
 - reg: Base address and length for NAND mapped memory.

Optional Properties:
 - clocks: phandle to the NAND gate clock if needed.
 - resets: phandle to the NAND reset control if needed.

Example:

nandc: nand-controller@41000000 {
	compatible = "oxsemi,ox820-nand";
	reg = <0x41000000 0x100000>;
	clocks = <&stdclk CLK_820_NAND>;
/* bench 28463.0.0 8131077d9f95 */
/* bench 28463.0.1 4a35cec2906d */
/* bench 28463.0.2 9e4b09cf8c72 */
/* bench 28463.0.3 cb687c491f8e */
/* bench 28463.0.4 b946b283bbac */
/* bench 28463.0.5 57155e9943fd */

	nand@0 {
		reg = <0>;
		#address-cells = <1>;
		#size-cells = <1>;
		nand-ecc-mode = "soft";
		nand-ecc-algo = "hamming";

/* bench 16706.0.0 49afaa9e1268 */
/* bench 16706.0.1 608285ac694b */
/* bench 16706.0.2 2d6e80474c3d */
/* bench 16706.0.3 9a96db99e4d7 */
/* bench 16706.0.4 54070af883ac */
			read-only;
		};

		partition@e00000 {
			label = "ubi";
			reg = <0x00e00000 0x07200000>;
		};
	};
};
/* bench 5201.0.0 3f96da78259e */
/* bench 5201.0.1 6a69707d8aad */
/* bench 5201.0.2 deec193a9a43 */
/* bench 5201.0.3 dcb1bba64bb7 */
/* bench 5201.0.4 aa07ab3b8401 */
/* bench 5201.0.5 c5b04acbddec */
/* bench 5201.0.6 489c49c11ba4 */
/* bench 5201.0.7 93d8df15baf5 */
/* bench 5201.0.8 fe30f7bc365b */
/* bench 5201.0.9 017fa8a84451 */
/* bench 5201.0.10 7b7804128a65 */
```
