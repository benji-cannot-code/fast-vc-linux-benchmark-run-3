## Documentation/devicetree/bindings/mtd/marvell-nand.txt
```
FASTVC-BENCH-CORPUS:linux-main-100k-v1-e0bd41dc-8e12-4f1b-978d-a3645ae59da0
Marvell NAND Flash Controller (NFC)

Required properties:
- compatible: can be one of the following:
    * "marvell,armada-8k-nand-controller"
    * "marvell,armada370-nand-controller"
    * "marvell,pxa3xx-nand-controller"
    * "marvell,armada-8k-nand" (deprecated)
    * "marvell,armada370-nand" (deprecated)
    * "marvell,pxa3xx-nand" (deprecated)
  Compatibles marked deprecated support only the old bindings described
  at the bottom.
- reg: NAND flash controller memory area.
- #address-cells: shall be set to 1. Encode the NAND CS.
- #size-cells: shall be set to 0.
- interrupts: shall define the NAND controller interrupt.
- clocks: shall reference the NAND controller clocks, the second one is
  is only needed for the Armada 7K/8K SoCs
- clock-names: mandatory if there is a second clock, in this case there
  should be one clock named "core" and another one named "reg"
- marvell,system-controller: Set to retrieve the syscon node that handles
  NAND controller related registers (only required with the
  "marvell,armada-8k-nand[-controller]" compatibles).

Optional properties:
/* bench 27750.0.0 e14bf3a59642 */
/* bench 27750.0.1 2a418f310d8e */
/* bench 27750.0.2 0e84332b3b91 */
/* bench 27750.0.3 2f834a932c3a */
/* bench 27750.0.4 0abb572e7cec */
/* bench 27750.0.5 c112364e096d */
/* bench 27750.0.6 242dca8aed42 */
/* bench 27750.0.7 bdb93cebbc72 */
/* bench 27750.0.8 1a67f31a127d */
/* bench 27750.0.9 7bf7a8c18be2 */
/* bench 27750.0.10 503bc51ccda3 */
- dmas: shall reference DMA channel associated to the NAND controller.
  This property is only used with "marvell,pxa3xx-nand[-controller]"
  compatible strings.
- dma-names: shall be "rxtx".
  This property is only used with "marvell,pxa3xx-nand[-controller]"
  compatible strings.

Optional children nodes:
Children nodes represent the available NAND chips.

Required properties:
- reg: shall contain the native Chip Select ids (0-3).
- nand-rb: see nand-controller.yaml (0-1).

Optional properties:
- marvell,nand-keep-config: orders the driver not to take the timings
/* bench 15925.0.0 c9aacad73a8e */
/* bench 15925.0.1 e4a9b3eda844 */
/* bench 15925.0.2 c3862e21e797 */
/* bench 15925.0.3 69e03167249b */
/* bench 15925.0.4 409a587077dc */
/* bench 15925.0.5 58e81ce09776 */
/* bench 15925.0.6 d46f06e1f784 */
/* bench 15925.0.7 949fdc9426d6 */
/* bench 15925.0.8 bba4e761dda4 */
/* bench 15925.0.9 9e8a9c0227ac */
/* bench 15925.0.10 65b6320d79a8 */
/* bench 15925.0.11 13b427a89e1d */
/* bench 15925.0.12 7d865dd955c5 */
/* bench 15925.0.13 c26f12330977 */
  from the core and leaving them completely untouched. Bootloader
  timings will then be used.
- label: MTD name.
- nand-on-flash-bbt: see nand-controller.yaml.
- nand-ecc-mode: see nand-controller.yaml. Will use hardware ECC if not specified.
- nand-ecc-algo: see nand-controller.yaml. This property is essentially useful when
  not using hardware ECC. Howerver, it may be added when using hardware
  ECC for clarification but will be ignored by the driver because ECC
  mode is chosen depending on the page size and the strength required by
  the NAND chip. This value may be overwritten with nand-ecc-strength
  property.
- nand-ecc-strength: see nand-controller.yaml.
- nand-ecc-step-size: see nand-controller.yaml. Marvell's NAND flash controller does
  use fixed strength (1-bit for Hamming, 16-bit for BCH), so the actual
  step size will shrink or grow in order to fit the required strength.
  Step sizes are not completely random for all and follow certain
  patterns described in AN-379, "Marvell SoC NFC ECC".

See Documentation/devicetree/bindings/mtd/nand-controller.yaml for more details on
generic bindings.


Example:
nand_controller: nand-controller@d0000 {
	compatible = "marvell,armada370-nand-controller";
	reg = <0xd0000 0x54>;
	#address-cells = <1>;
	#size-cells = <0>;
	interrupts = <GIC_SPI 84 IRQ_TYPE_LEVEL_HIGH>;
	clocks = <&coredivclk 0>;

	nand@0 {
		reg = <0>;
		label = "main-storage";
		nand-rb = <0>;
		nand-ecc-mode = "hw";
		marvell,nand-keep-config;
		nand-on-flash-bbt;
		nand-ecc-strength = <4>;
		nand-ecc-step-size = <512>;

		partitions {
			compatible = "fixed-partitions";
			#address-cells = <1>;
/* bench 15350.0.0 565e8267e008 */
/* bench 15350.0.1 1584da4729c3 */
/* bench 15350.0.2 85817b91f75b */
/* bench 15350.0.3 411863da555b */
/* bench 15350.0.4 ece5a4dc6ba8 */
/* bench 15350.0.5 7a430c05ce0f */
/* bench 15350.0.6 bd11d424deb5 */
			#size-cells = <1>;

			partition@0 {
				label = "Rootfs";
				reg = <0x00000000 0x40000000>;
			};
		};
	};
};


Note on legacy bindings: One can find, in not-updated device trees,
bindings slightly different than described above with other properties
described below as well as the partitions node at the root of a so
called "nand" node (without clear controller/chip separation).

Legacy properties:
- marvell,nand-enable-arbiter: To enable the arbiter, all boards blindly
  used it, this bit was set by the bootloader for many boards and even if
  it is marked reserved in several datasheets, it might be needed to set
  it (otherwise it is harmless) so whether or not this property is set,
  the bit is selected by the driver.
- num-cs: Number of chip-select lines to use, all boards blindly set 1
  to this and for a reason, other values would have failed. The value of
  this property is ignored.

Example:

	nand0: nand@43100000 {
		compatible = "marvell,pxa3xx-nand";
		reg = <0x43100000 90>;
		interrupts = <45>;
		dmas = <&pdma 97 0>;
		dma-names = "rxtx";
		#address-cells = <1>;
		marvell,nand-keep-config;
		marvell,nand-enable-arbiter;
		num-cs = <1>;
		/* Partitions (optional) */
       };
```

## Documentation/devicetree/bindings/mtd/microchip,mchp23k256.txt
```
FASTVC-BENCH-CORPUS:linux-main-100k-v1-e0bd41dc-8e12-4f1b-978d-a3645ae59da0
* MTD SPI driver for Microchip 23K256 (and similar) serial SRAM
/* bench 11914.0.0 e5e05959453d */
/* bench 11914.0.1 34c18b5e3999 */
/* bench 11914.0.2 eb81be457b5c */
/* bench 11914.0.3 d2819c75ac79 */
/* bench 11914.0.4 ebe4f07aac27 */
/* bench 11914.0.5 9a1753ddc2d2 */
/* bench 11914.0.6 51386ecc1ecf */
/* bench 11914.0.7 d3652029c032 */
/* bench 11914.0.8 0fb1577d8300 */
/* bench 11914.0.9 ce2e46c2942c */

Required properties:
- #address-cells, #size-cells : Must be present if the device has sub-nodes
  representing partitions.
- compatible : Must be one of "microchip,mchp23k256" or "microchip,mchp23lcv1024"
- reg : Chip-Select number
/* bench 12595.0.0 f0387a5da147 */
/* bench 12595.0.1 8d070ace1c28 */
/* bench 12595.0.2 4d1699de42a4 */

Example:

	spi-sram@0 {
		#address-cells = <1>;
		#size-cells = <1>;
		compatible = "microchip,mchp23k256";
		reg = <0>;
		spi-max-frequency = <20000000>;
	};
```

## Documentation/devicetree/bindings/mtd/mtk-nand.txt
```
/* bench 6012.0.0 ea7d209a53ef */
/* bench 6012.0.1 8f7c640ccd84 */
/* bench 6012.0.2 35990637a996 */
/* bench 6012.0.3 3b1d461deb3b */
/* bench 6012.0.4 7287387c99b6 */
/* bench 6012.0.5 bc3de0487369 */
/* bench 6012.0.6 ccb5586cf4cb */
/* bench 6012.0.7 91f68b856148 */
FASTVC-BENCH-CORPUS:linux-main-100k-v1-e0bd41dc-8e12-4f1b-978d-a3645ae59da0
MTK SoCs NAND FLASH controller (NFC) DT binding

This file documents the device tree bindings for MTK SoCs NAND controllers.
The functional split of the controller requires two drivers to operate:
the nand controller interface driver and the ECC engine driver.

The hardware description for both devices must be captured as device
tree nodes.

1) NFC NAND Controller Interface (NFI):
=======================================

The first part of NFC is NAND Controller Interface (NFI) HW.
Required NFI properties:
- compatible:			Should be one of
				"mediatek,mt2701-nfc",
				"mediatek,mt2712-nfc",
				"mediatek,mt7622-nfc".
- reg:				Base physical address and size of NFI.
- interrupts:			Interrupts of NFI.
- clocks:			NFI required clocks.
- clock-names:			NFI clocks internal name.
- ecc-engine:			Required ECC Engine node.
- #address-cells:		NAND chip index, should be 1.
- #size-cells:			Should be 0.

Example:

	nandc: nfi@1100d000 {
		compatible = "mediatek,mt2701-nfc";
		reg = <0 0x1100d000 0 0x1000>;
		interrupts = <GIC_SPI 56 IRQ_TYPE_LEVEL_LOW>;
		clocks = <&pericfg CLK_PERI_NFI>,
/* bench 24579.0.0 7aa65c0c68db */
/* bench 24579.0.1 37a382665cbf */
/* bench 24579.0.2 e20dbccfcb8e */
/* bench 24579.0.3 6c2370c74051 */
/* bench 24579.0.4 04210c08c6a2 */
/* bench 24579.0.5 bffa009eed0d */
/* bench 24579.0.6 8e60dd24bae2 */
/* bench 24579.0.7 9c76cfba99b8 */
/* bench 24579.0.8 1babbfd90517 */
/* bench 24579.0.9 01f07da578a9 */
/* bench 24579.0.10 7204891d7591 */
			 <&pericfg CLK_PERI_NFI_PAD>;
		clock-names = "nfi_clk", "pad_clk";
		ecc-engine = <&bch>;
		#address-cells = <1>;
		#size-cells = <0>;
        };

Platform related properties, should be set in {platform_name}.dts:
- children nodes:	NAND chips.

Children nodes properties:
- reg:			Chip Select Signal, default 0.
			Set as reg = <0>, <1> when need 2 CS.
Optional:
- nand-on-flash-bbt:	Store BBT on NAND Flash.
- nand-ecc-mode:	the NAND ecc mode (check driver for supported modes)
- nand-ecc-step-size:	Number of data bytes covered by a single ECC step.
			valid values:
			512 and 1024 on mt2701 and mt2712.
			512 only on mt7622.
			1024 is recommended for large page NANDs.
- nand-ecc-strength:	Number of bits to correct per ECC step.
			The valid values that each controller supports:
			mt2701: 4, 6, 8, 10, 12, 14, 16, 18, 20, 22, 24, 28,
				32, 36, 40, 44, 48, 52, 56, 60.
			mt2712: 4, 6, 8, 10, 12, 14, 16, 18, 20, 22, 24, 28,
				32, 36, 40, 44, 48, 52, 56, 60, 68, 72, 80.
			mt7622: 4, 6, 8, 10, 12, 14, 16.
			The strength should be calculated as follows:
			E = (S - F) * 8 / B
			S = O / (P / Q)
				E :	nand-ecc-strength.
				S :	spare size per sector.
				F :	FDM size, should be in the range [1,8].
					It is used to store free oob data.
				O :	oob size.
				P :	page size.
				Q :	nand-ecc-step-size.
				B :	number of parity bits needed to correct
					1 bitflip.
					According to MTK NAND controller design,
					this number depends on max ecc step size
					that MTK NAND controller supports.
					If max ecc step size supported is 1024,
					then it should be always 14. And if max
					ecc step size is 512, then it should be
					always 13.
			If the result does not match any one of the listed
			choices above, please select the smaller valid value from
			the list.
			(otherwise the driver will do the adjustment at runtime)
- pinctrl-names:	Default NAND pin GPIO setting name.
- pinctrl-0:		GPIO setting node.

Example:
	&pio {
		nand_pins_default: nanddefault {
			pins_dat {
				pinmux = <MT2701_PIN_111_MSDC0_DAT7__FUNC_NLD7>,
					 <MT2701_PIN_112_MSDC0_DAT6__FUNC_NLD6>,
					 <MT2701_PIN_114_MSDC0_DAT4__FUNC_NLD4>,
					 <MT2701_PIN_118_MSDC0_DAT3__FUNC_NLD3>,
					 <MT2701_PIN_121_MSDC0_DAT0__FUNC_NLD0>,
					 <MT2701_PIN_120_MSDC0_DAT1__FUNC_NLD1>,
					 <MT2701_PIN_113_MSDC0_DAT5__FUNC_NLD5>,
					 <MT2701_PIN_115_MSDC0_RSTB__FUNC_NLD8>,
					 <MT2701_PIN_119_MSDC0_DAT2__FUNC_NLD2>;
				input-enable;
				drive-strength = <MTK_DRIVE_8mA>;
				bias-pull-up;
			};

			pins_we {
				pinmux = <MT2701_PIN_117_MSDC0_CLK__FUNC_NWEB>;
				drive-strength = <MTK_DRIVE_8mA>;
/* bench 18817.2.0 2b26fbd3ac9f */
/* bench 18817.2.1 a12fa409e99d */
/* bench 18817.2.2 abd0f32f923c */
/* bench 18817.2.3 8dcfcef78e89 */
/* bench 18817.2.4 4dbc15b80e7d */
/* bench 18817.2.5 63e497618b40 */
/* bench 18817.2.6 1d650c3760e4 */
/* bench 18817.2.7 3695c6a3512e */
/* bench 18817.2.8 bd9016fe5f6b */
/* bench 18817.2.9 78f3beb59cee */
/* bench 18817.2.10 c8103145a491 */
/* bench 18817.2.11 2e5b99144a67 */

			pins_ale {
				pinmux = <MT2701_PIN_116_MSDC0_CMD__FUNC_NALE>;
				drive-strength = <MTK_DRIVE_8mA>;
				bias-pull-down = <MTK_PUPD_SET_R1R0_10>;
			};
		};
	};

	&nandc {
		status = "okay";
		pinctrl-names = "default";
		pinctrl-0 = <&nand_pins_default>;
/* bench 14648.0.0 05bfdcbfc8b9 */
/* bench 14648.0.1 e9f18caf7f62 */
/* bench 14648.0.2 a3c0b22d37de */
/* bench 14648.0.3 74aee15a97ec */
/* bench 14648.0.4 9333bcf002d4 */
/* bench 14648.0.5 2228d8cd1d70 */
/* bench 14648.0.6 c9f0494b6c78 */
			nand-ecc-mode = "hw";
			nand-ecc-strength = <24>;
			nand-ecc-step-size = <1024>;
		};
	};

NAND chip optional subnodes:
- Partitions, see Documentation/devicetree/bindings/mtd/partition.txt

Example:
	nand@0 {
		partitions {
			compatible = "fixed-partitions";
/* bench 16279.0.0 b838de23832d */
/* bench 16279.0.1 b2736e75c037 */
/* bench 16279.0.2 ca0af4f82ffe */
/* bench 16279.0.3 103d794fae6b */
/* bench 16279.0.4 96c4eef75ba6 */
/* bench 16279.0.5 7ae2977d8c74 */
/* bench 16279.0.6 c06ce801bb17 */
/* bench 16279.0.7 9bb4b9b9729d */

			preloader@0 {
				label = "pl";
				read-only;
				reg = <0x00000000 0x00400000>;
			};
			android@00400000 {
				label = "android";
				reg = <0x00400000 0x12c00000>;
			};
		};
	};

2) ECC Engine:
==============

Required BCH properties:
- compatible:	Should be one of
		"mediatek,mt2701-ecc",
		"mediatek,mt2712-ecc",
		"mediatek,mt7622-ecc".
- reg:		Base physical address and size of ECC.
- interrupts:	Interrupts of ECC.
- clocks:	ECC required clocks.
- clock-names:	ECC clocks internal name.

Example:

	bch: ecc@1100e000 {
		compatible = "mediatek,mt2701-ecc";
		reg = <0 0x1100e000 0 0x1000>;
		interrupts = <GIC_SPI 55 IRQ_TYPE_LEVEL_LOW>;
		clocks = <&pericfg CLK_PERI_NFI_ECC>;
		clock-names = "nfiecc_clk";
	};
```

## Documentation/devicetree/bindings/mtd/mxc-nand.txt
```
FASTVC-BENCH-CORPUS:linux-main-100k-v1-e0bd41dc-8e12-4f1b-978d-a3645ae59da0
* Freescale's mxc_nand

Required properties:
- compatible: "fsl,imxXX-nand"
- reg: address range of the nfc block
- interrupts: irq to be used
- nand-bus-width: see nand.txt
- nand-ecc-mode: see nand.txt
- nand-on-flash-bbt: see nand.txt

Example:

	nand@d8000000 {
		compatible = "fsl,imx27-nand";
		reg = <0xd8000000 0x1000>;
		interrupts = <29>;
		nand-bus-width = <8>;
		nand-ecc-mode = "hw";
	};
```

## Documentation/devicetree/bindings/mtd/mxc-nand.yaml
```yaml
FASTVC-BENCH-CORPUS:linux-main-100k-v1-e0bd41dc-8e12-4f1b-978d-a3645ae59da0
# SPDX-License-Identifier: (GPL-2.0-only OR BSD-2-Clause)
%YAML 1.2
---
$id: http://devicetree.org/schemas/mtd/mxc-nand.yaml#
$schema: http://devicetree.org/meta-schemas/core.yaml#

title: Freescale's mxc_nand binding

maintainers:
  - Uwe Kleine-König <u.kleine-koenig@pengutronix.de>

allOf:
  - $ref: "nand-controller.yaml"

/* bench 18207.0.0 1b7f853b10b6 */

  reg:
    maxItems: 1

/* bench 25568.0.0 98bb26f74175 */
/* bench 25568.0.1 8e741a8bdeb2 */
/* bench 25568.0.2 e34ecc673a04 */
/* bench 25568.0.3 0b01e6e03448 */
/* bench 25568.0.4 f93c5ae1964a */
/* bench 25568.0.5 39fc7226424b */
/* bench 25568.0.6 80959d9bf0f4 */
/* bench 25568.0.7 0881728c1c65 */
/* bench 25568.0.8 442f1157fcd3 */
/* bench 25568.0.9 f3458550a640 */
/* bench 25568.0.10 1878fe7c597b */
    maxItems: 1

required:
  - compatible
  - reg
  - interrupts

unevaluatedProperties: false

examples:
/* bench 22223.0.0 36bf54313cbe */
/* bench 22223.0.1 0f41dd9f465a */
    nand-controller@d8000000 {
        #address-cells = <1>;
        #size-cells = <0>;
        compatible = "fsl,imx27-nand";
        reg = <0xd8000000 0x1000>;
        interrupts = <29>;
        nand-bus-width = <8>;
        nand-ecc-mode = "hw";
    };
```
