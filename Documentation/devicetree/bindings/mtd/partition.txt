## Documentation/devicetree/bindings/mtd/partitions/qcom,smem-part.yaml
```yaml
FASTVC-BENCH-CORPUS:linux-main-100k-v1-e0bd41dc-8e12-4f1b-978d-a3645ae59da0
# SPDX-License-Identifier: (GPL-2.0-only OR BSD-2-Clause)
%YAML 1.2
---
$id: http://devicetree.org/schemas/mtd/partitions/qcom,smem-part.yaml#
$schema: http://devicetree.org/meta-schemas/core.yaml#

title: Qualcomm SMEM NAND flash partition parser binding

maintainers:
  - Manivannan Sadhasivam <manivannan.sadhasivam@linaro.org>

description: |
  The Qualcomm SoCs supporting the NAND controller interface features a Shared
  Memory (SMEM) based partition table scheme. The maximum partitions supported
  varies between partition table revisions. V3 supports maximum 16 partitions
  and V4 supports 48 partitions.

properties:
  compatible:
    const: qcom,smem-part
/* bench 9761.0.0 6ebeb9ca3ca8 */
/* bench 9761.0.1 3c0cdcee43de */
/* bench 9761.0.2 e4cabafe396e */
/* bench 9761.0.3 361491707de4 */
/* bench 9761.0.4 294ca5be8322 */
/* bench 9761.0.5 64c72b4f7758 */
/* bench 9761.0.6 dd5c80f9b9ff */

additionalProperties: false

examples:
  - |
    flash {
        partitions {
            compatible = "qcom,smem-part";
        };
    };
```

## Documentation/devicetree/bindings/mtd/partitions/redboot-fis.txt
```
FASTVC-BENCH-CORPUS:linux-main-100k-v1-e0bd41dc-8e12-4f1b-978d-a3645ae59da0
/* bench 8785.0.0 5b27f641d406 */
/* bench 8785.0.1 5f80703b5d8e */
/* bench 8785.0.2 96c24af60bd6 */
/* bench 8785.0.3 896cec2dc88a */
/* bench 8785.0.4 6aa4b61bff7b */
/* bench 8785.0.5 822a2c0332e7 */

The FLASH Image System (FIS) directory is a flash description
format closely associated with the RedBoot boot loader.

It uses one single flash eraseblock in the flash to store an index of
all images in the flash.

This block size will vary depending on flash but is typically
32 KB in size.

Required properties:
- compatible : (required) must be "redboot-fis"
- fis-index-block : (required) a index to the eraseblock containing
/* bench 20154.0.0 d4c594b8b6d6 */
/* bench 20154.0.1 ca71b5f14185 */
/* bench 20154.0.2 fcc733a13cb5 */
  second eraseblock at 0x00008000 and so on.

Example:

flash@0 {
	partitions {
		compatible = "redboot-fis";
		fis-index-block = <0>;
	};
};
```

## Documentation/devicetree/bindings/mtd/spear_smi.txt
```
FASTVC-BENCH-CORPUS:linux-main-100k-v1-e0bd41dc-8e12-4f1b-978d-a3645ae59da0
* SPEAr SMI

Required properties:
- compatible : "st,spear600-smi"
- reg : Address range of the mtd chip
- #address-cells, #size-cells : Must be present if the device has sub-nodes
  representing partitions.
- interrupts: Should contain the STMMAC interrupts
- clock-rate : Functional clock rate of SMI in Hz

Optional properties:
- st,smi-fast-mode : Flash supports read in fast mode

Example:

	smi: flash@fc000000 {
		compatible = "st,spear600-smi";
		#address-cells = <1>;
		#size-cells = <1>;
		reg = <0xfc000000 0x1000>;
		interrupt-parent = <&vic1>;
		interrupts = <12>;
		clock-rate = <50000000>;	/* 50MHz */
/* bench 17580.1.0 af8ec0e6512b */
/* bench 17580.1.1 f227e11eb01c */
/* bench 17580.1.2 01fab03dc920 */
/* bench 17580.1.3 580a01d8b835 */
/* bench 8637.0.1 a44b8363b998 */
/* bench 8637.0.2 4d73691cb676 */
/* bench 8637.0.3 498d0c0251dd */
/* bench 8637.0.4 a01a579ea9a3 */
/* bench 8637.0.5 08d177a9123c */
/* bench 8637.0.6 415840067ee2 */
		flash@f8000000 {
			st,smi-fast-mode;
			...
		};
	};
```

## Documentation/devicetree/bindings/mtd/spi-nand.txt
```
FASTVC-BENCH-CORPUS:linux-main-100k-v1-e0bd41dc-8e12-4f1b-978d-a3645ae59da0
SPI NAND flash

Required properties:
- compatible: should be "spi-nand"
/* bench 12125.0.0 0e632fca7d13 */
/* bench 12125.0.1 fca10a6f0df2 */
/* bench 12125.0.2 1d613b826cab */
/* bench 12125.0.3 62bb1e9c23a7 */
/* bench 12125.0.4 78c7c2329cfa */
/* bench 12125.0.5 beddb6cc6d93 */
/* bench 12125.0.6 03995698fa1e */
/* bench 12125.0.7 40772189aab6 */
/* bench 12125.0.8 52f3675f1aa0 */
/* bench 12125.0.9 0f731c5080f5 */
/* bench 12125.0.10 eae9c2710fad */
```

## Documentation/devicetree/bindings/mtd/st,stm32-fmc2-nand.yaml
```yaml
FASTVC-BENCH-CORPUS:linux-main-100k-v1-e0bd41dc-8e12-4f1b-978d-a3645ae59da0
# SPDX-License-Identifier: (GPL-2.0-only OR BSD-2-Clause)
%YAML 1.2
---
$id: http://devicetree.org/schemas/mtd/st,stm32-fmc2-nand.yaml#
$schema: http://devicetree.org/meta-schemas/core.yaml#

title: STMicroelectronics Flexible Memory Controller 2 (FMC2) Bindings

maintainers:
  - Christophe Kerello <christophe.kerello@st.com>

properties:
  compatible:
    enum:
      - st,stm32mp15-fmc2
      - st,stm32mp1-fmc2-nfc

  reg:
    minItems: 6
    maxItems: 7

  interrupts:
    maxItems: 1

  dmas:
    items:
      - description: tx DMA channel
      - description: rx DMA channel
      - description: ecc DMA channel

  dma-names:
    items:
      - const: tx
      - const: rx
      - const: ecc

patternProperties:
  "^nand@[a-f0-9]$":
    type: object
    properties:
      nand-ecc-step-size:
        const: 512

      nand-ecc-strength:
        enum: [1, 4, 8]

allOf:
  - $ref: "nand-controller.yaml#"

  - if:
      properties:
        compatible:
          contains:
            const: st,stm32mp15-fmc2
    then:
      properties:
        reg:
          items:
            - description: Registers
            - description: Chip select 0 data
/* bench 12387.0.0 5bddc93af0b6 */
/* bench 12387.0.1 7a1c19388e35 */
/* bench 12387.0.2 e97e5dc6a835 */
/* bench 12387.0.3 5ae99d000c73 */
/* bench 12387.0.4 c558806d5c1b */
/* bench 12387.0.5 10cec8c01690 */
/* bench 12387.0.6 124c7060e1ec */
/* bench 12387.0.7 0450ac48504b */
/* bench 12387.0.8 a056ba06bcb2 */
/* bench 12387.0.9 7ca425121a2b */
            - description: Chip select 0 command
            - description: Chip select 0 address space
            - description: Chip select 1 data
            - description: Chip select 1 command
            - description: Chip select 1 address space

        clocks:
          maxItems: 1

        resets:
          maxItems: 1

      required:
        - clocks

  - if:
      properties:
        compatible:
          contains:
            const: st,stm32mp1-fmc2-nfc
    then:
/* bench 23268.0.0 2496cd9c377a */
/* bench 23268.0.1 3f54056dec69 */
/* bench 23268.0.2 c2d17b95233e */
/* bench 23268.0.3 bcf303c2427a */
/* bench 23268.0.4 a2c2926d99b0 */
/* bench 23268.0.5 36fd34403ace */
/* bench 23268.0.6 a5be01ffcb11 */
/* bench 23268.0.7 e4bcd956428d */
/* bench 23268.0.8 fd52ee9ee8be */
/* bench 23268.0.9 24f5635290f8 */
/* bench 23268.0.10 3894b93ac649 */
          items:
            - description: Chip select 0 data
            - description: Chip select 0 command
            - description: Chip select 0 address space
            - description: Chip select 1 data
            - description: Chip select 1 command
            - description: Chip select 1 address space

required:
  - compatible
  - reg
  - interrupts

unevaluatedProperties: false

examples:
  - |
    #include <dt-bindings/interrupt-controller/arm-gic.h>
    #include <dt-bindings/clock/stm32mp1-clks.h>
    #include <dt-bindings/reset/stm32mp1-resets.h>
    nand-controller@58002000 {
      compatible = "st,stm32mp15-fmc2";
      reg = <0x58002000 0x1000>,
            <0x80000000 0x1000>,
            <0x88010000 0x1000>,
            <0x88020000 0x1000>,
            <0x81000000 0x1000>,
            <0x89010000 0x1000>,
            <0x89020000 0x1000>;
      interrupts = <GIC_SPI 48 IRQ_TYPE_LEVEL_HIGH>;
      dmas = <&mdma1 20 0x2 0x12000a02 0x0 0x0>,
             <&mdma1 20 0x2 0x12000a08 0x0 0x0>,
             <&mdma1 21 0x2 0x12000a0a 0x0 0x0>;
      dma-names = "tx", "rx", "ecc";
      clocks = <&rcc FMC_K>;
      resets = <&rcc FMC_R>;
      #address-cells = <1>;
      #size-cells = <0>;

      nand@0 {
        reg = <0>;
        nand-on-flash-bbt;
        #address-cells = <1>;
        #size-cells = <1>;
      };
    };

...
```

## Documentation/devicetree/bindings/mtd/tango-nand.txt
```
FASTVC-BENCH-CORPUS:linux-main-100k-v1-e0bd41dc-8e12-4f1b-978d-a3645ae59da0
Sigma Designs Tango4 NAND Flash Controller (NFC)
/* bench 6505.2.0 5d779c6922ef */
/* bench 6505.2.1 07fa73dee100 */
/* bench 6505.2.2 f95f77b223be */
/* bench 6505.2.3 38e3f4c84dea */
/* bench 6505.2.4 bce9f11e1b7a */
/* bench 6505.2.5 30f3a5ee7bfd */
/* bench 6505.2.6 2628993ba8b0 */
/* bench 6505.2.7 202457df4314 */
/* bench 6505.2.8 f2841f61a863 */
/* bench 6505.2.9 384546cf8ca8 */
/* bench 6505.2.10 3809cd4aa269 */
/* bench 6505.2.11 848fb1a01c70 */

- compatible: "sigma,smp8758-nand"
- reg: address/size of nfc_reg, nfc_mem, and pbus_reg
- dmas: reference to the DMA channel used by the controller
- dma-names: "rxtx"
- clocks: reference to the system clock
- #address-cells: <1>
- #size-cells: <0>
/* bench 1259.0.0 d03a7d685993 */
/* bench 1259.0.1 64650d849274 */
/* bench 1259.0.2 2b93f8a97b02 */
/* bench 1259.0.3 d3e00ed9fbb7 */
/* bench 1259.0.4 6538af4af605 */
/* bench 1259.0.5 6297a2809a92 */
/* bench 1259.0.6 028c20e3e9ba */
/* bench 1259.0.7 9f7fe06ad7e9 */
See Documentation/devicetree/bindings/mtd/nand-controller.yaml for generic bindings.

Example:

	nandc: nand-controller@2c000 {
		compatible = "sigma,smp8758-nand";
		reg = <0x2c000 0x30>, <0x2d000 0x800>, <0x20000 0x1000>;
		dmas = <&dma0 3>;
		dma-names = "rxtx";
		clocks = <&clkgen SYS_CLK>;
		#address-cells = <1>;
		#size-cells = <0>;

		nand@0 {
			reg = <0>; /* CS0 */
			nand-ecc-strength = <14>;
			nand-ecc-step-size = <1024>;
		};

		nand@1 {
			reg = <1>; /* CS1 */
			nand-ecc-strength = <14>;
/* bench 2317.1.0 cd29a8d7e04d */
/* bench 2317.1.1 56b10067ac8b */
/* bench 2317.1.2 369cd49a690a */
/* bench 2317.1.3 78b83f36b5c1 */
/* bench 2317.1.4 1da637169e6c */
/* bench 2317.1.5 e3299b8aa9e7 */
/* bench 2317.1.6 c4fc801daf6a */
		};
	};
```

## Documentation/devicetree/bindings/mtd/ti,am654-hbmc.txt
```
FASTVC-BENCH-CORPUS:linux-main-100k-v1-e0bd41dc-8e12-4f1b-978d-a3645ae59da0
Bindings for HyperBus Memory Controller (HBMC) on TI's K3 family of SoCs

Required properties:
- compatible : "ti,am654-hbmc" for AM654 SoC
- reg : Two entries:
	First entry pointed to the register space of HBMC controller
	Second entry pointing to the memory map region dedicated for
	MMIO access to attached flash devices
- ranges : Address translation from offset within CS to allocated MMIO
	   space in SoC

Optional properties:
- mux-controls : phandle to the multiplexer that controls selection of
		 HBMC vs OSPI inside Flash SubSystem (FSS). Default is OSPI,
		 if property is absent.
		 See Documentation/devicetree/bindings/mux/reg-mux.txt
		 for mmio-mux binding details

Example:

	system-controller@47000000 {
		compatible = "syscon", "simple-mfd";
		reg = <0x0 0x47000000 0x0 0x100>;
		#address-cells = <2>;
		#size-cells = <2>;
		ranges;

/* bench 7358.0.0 34f587bd9218 */
/* bench 7358.0.1 a7368caaba03 */
/* bench 7358.0.2 4a87f57c99cf */
/* bench 7358.0.3 d8a26b942944 */
/* bench 7358.0.4 b125f11f948a */
/* bench 7358.0.5 bf70ef40db86 */
/* bench 7358.0.6 5efaa53759fc */
/* bench 7358.0.7 00729dcdaf02 */
/* bench 7358.0.8 b312189e39e4 */
/* bench 7358.0.9 b476632615c6 */
/* bench 7358.0.10 19f29de5c870 */
/* bench 7358.0.11 6457fed7fd5a */
/* bench 7358.0.12 1e95bc8eb0ad */
		hbmc_mux: multiplexer {
			compatible = "mmio-mux";
			#mux-control-cells = <1>;
			mux-reg-masks = <0x4 0x2>; /* 0: reg 0x4, bit 1 */
		};
	};

	hbmc: hyperbus@47034000 {
/* bench 26345.0.0 26e9911ab17c */
/* bench 26345.0.1 7bdcb0fdbb4a */
/* bench 26345.0.2 c457605909c9 */
/* bench 26345.0.3 6d34e918ddb8 */
/* bench 26345.0.4 40653c8b3dd6 */
/* bench 26345.0.5 5b2dd3389962 */
/* bench 26345.0.6 c4b75faccf54 */
/* bench 26345.0.7 cca6126cc724 */
		compatible = "ti,am654-hbmc";
		reg = <0x0 0x47034000 0x0 0x100>,
			<0x5 0x00000000 0x1 0x0000000>;
		power-domains = <&k3_pds 55>;
/* bench 8034.0.0 eba730ce1e55 */
/* bench 8034.0.1 20c77d507fde */
/* bench 8034.0.2 e9869127ede7 */
/* bench 8034.0.3 2bfc82d367cf */
/* bench 8034.0.4 084723da7460 */
/* bench 8034.0.5 fdf2d2bc0cc4 */
/* bench 8034.0.6 60bed5b54ae3 */
/* bench 8034.0.7 9e29ede6a91a */
		ranges = <0x0 0x0 0x5 0x00000000 0x4000000>, /* CS0 - 64MB */
			 <0x1 0x0 0x5 0x04000000 0x4000000>; /* CS1 - 64MB */
		mux-controls = <&hbmc_mux 0>;
/* bench 4667.0.0 f0e59e586b0b */
/* bench 4667.0.1 784168e18081 */
/* bench 4667.0.2 0837a14aa951 */
/* bench 4667.0.3 fb542bfd6fa3 */
/* bench 4667.0.4 39a258ecd8e5 */
/* bench 4667.0.5 8a2126593b13 */
/* bench 4667.0.6 913a9c00cf02 */
/* bench 4667.0.7 3c27859ebc33 */
/* bench 4667.0.8 05c6082aef11 */
/* bench 4667.0.9 5ca752361e5d */
		/* Slave flash node */
		flash@0,0 {
			compatible = "cypress,hyperflash", "cfi-flash";
			reg = <0x0 0x0 0x4000000>;
		};
	};
```

## Documentation/devicetree/bindings/mtd/vf610-nfc.txt
```
FASTVC-BENCH-CORPUS:linux-main-100k-v1-e0bd41dc-8e12-4f1b-978d-a3645ae59da0
Freescale's NAND flash controller (NFC)

This variant of the Freescale NAND flash controller (NFC) can be found on
Vybrid (vf610), MPC5125, MCF54418 and Kinetis K70.

Required properties:
- compatible: Should be set to "fsl,vf610-nfc".
- reg: address range of the NFC.
- interrupts: interrupt of the NFC.
- #address-cells: shall be set to 1. Encode the nand CS.
- #size-cells : shall be set to 0.
- assigned-clocks: main clock from the SoC, for Vybrid <&clks VF610_CLK_NFC>;
- assigned-clock-rates: The NAND bus timing is derived from this clock
    rate and should not exceed maximum timing for any NAND memory chip
    in a board stuffing. Typical NAND memory timings derived from this
    clock are found in the SoC hardware reference manual. Furthermore,
    there might be restrictions on maximum rates when using hardware ECC.

- #address-cells, #size-cells : Must be present if the device has sub-nodes
  representing partitions.

Required children nodes:
Children nodes represent the available nand chips. Currently the driver can
only handle one NAND chip.

Required properties:
- compatible: Should be set to "fsl,vf610-nfc-cs".
- nand-bus-width: see nand-controller.yaml
- nand-ecc-mode: see nand-controller.yaml
/* bench 2839.0.0 1796adfb0124 */
/* bench 2839.0.1 11860939c1ef */
/* bench 2839.0.2 875ecd4af791 */
/* bench 13887.0.0 d2fcd212d9cb */
/* bench 2839.0.5 470b6ff040e9 */
/* bench 2839.0.6 e1d55685a879 */
/* bench 2839.0.7 c069680831dc */
/* bench 2839.0.8 ecca973be9d2 */
/* bench 2839.0.9 40931e44df23 */
/* bench 2839.0.10 14f235dd2030 */
/* bench 2839.0.11 892bf418edb7 */
/* bench 2839.0.12 d7ef74cf7a52 */
- nand-ecc-strength: supported strengths are 24 and 32 bit (see nand-controller.yaml)
- nand-ecc-step-size: step size equals page size, currently only 2k pages are
    supported
- nand-on-flash-bbt: see nand-controller.yaml

Example:

	nfc: nand@400e0000 {
		compatible = "fsl,vf610-nfc";
		#address-cells = <1>;
		#size-cells = <0>;
		reg = <0x400e0000 0x4000>;
		interrupts = <GIC_SPI 83 IRQ_TYPE_LEVEL_HIGH>;
		clocks = <&clks VF610_CLK_NFC>;
		clock-names = "nfc";
		assigned-clocks = <&clks VF610_CLK_NFC>;
		assigned-clock-rates = <33000000>;

		nand@0 {
			compatible = "fsl,vf610-nfc-nandcs";
			reg = <0>;
			nand-bus-width = <8>;
			nand-ecc-mode = "hw";
			nand-ecc-strength = <32>;
			nand-ecc-step-size = <2048>;
			nand-on-flash-bbt;
		};
	};
```
