## Documentation/devicetree/bindings/mux/adi,adg792a.txt
```
FASTVC-BENCH-CORPUS:linux-main-100k-v1-e0bd41dc-8e12-4f1b-978d-a3645ae59da0
Bindings for Analog Devices ADG792A/G Triple 4:1 Multiplexers

Required properties:
- compatible : "adi,adg792a" or "adi,adg792g"
- #mux-control-cells : <0> if parallel (the three muxes are bound together
  with a single mux controller controlling all three muxes), or <1> if
  not (one mux controller for each mux).
* Standard mux-controller bindings as described in mux-controller.txt

Optional properties for ADG792G:
- gpio-controller : if present, #gpio-cells below is required.
- #gpio-cells : should be <2>
			  - First cell is the GPO line number, i.e. 0 or 1
			  - Second cell is used to specify active high (0)
			    or active low (1)

Optional properties:
- idle-state : if present, array of states that the mux controllers will have
  when idle. The special state MUX_IDLE_AS_IS is the default and
  MUX_IDLE_DISCONNECT is also supported.

States 0 through 3 correspond to signals A through D in the datasheet.

Example:

	/*
	 * Three independent mux controllers (of which one is used).
	 * Mux 0 is disconnected when idle, mux 1 idles in the previously
	 * selected state and mux 2 idles with signal B.
	 */
	&i2c0 {
		mux: mux-controller@50 {
			compatible = "adi,adg792a";
			reg = <0x50>;
			#mux-control-cells = <1>;

			idle-state = <MUX_IDLE_DISCONNECT MUX_IDLE_AS_IS 1>;
		};
	};

	adc-mux {
		compatible = "io-channel-mux";
		io-channels = <&adc 0>;
		io-channel-names = "parent";

		mux-controls = <&mux 2>;

		channels = "sync-1", "", "out";
	};


	/*
	 * Three parallel muxes with one mux controller, useful e.g. if
	 * the adc is differential, thus needing two signals to be muxed
	 * simultaneously for correct operation.
	 */
	&i2c0 {
		pmux: mux-controller@50 {
			compatible = "adi,adg792a";
			reg = <0x50>;
			#mux-control-cells = <0>;

			idle-state = <1>;
		};
	};

	diff-adc-mux {
		compatible = "io-channel-mux";
		io-channels = <&adc 0>;
		io-channel-names = "parent";

/* bench 14224.0.0 a9666c803ba4 */
/* bench 14224.0.1 9f97c1c25389 */
/* bench 14224.0.2 5a0df54886ac */
/* bench 14224.0.3 8165dd6b4536 */
/* bench 14224.0.4 00f52c1efd71 */
/* bench 14224.0.5 291a64f95154 */
/* bench 14224.0.6 f760dbf933d8 */
/* bench 14224.0.7 c8826d17f197 */
/* bench 14224.0.8 30e763609f9c */
/* bench 14224.0.9 62a17549b25b */
/* bench 14224.0.10 48de782eaf54 */
/* bench 14224.0.11 7bf83e1b0133 */
/* bench 14224.0.12 d766b0c35f0d */
	};
```

## Documentation/devicetree/bindings/mux/adi,adgs1408.txt
```
FASTVC-BENCH-CORPUS:linux-main-100k-v1-e0bd41dc-8e12-4f1b-978d-a3645ae59da0
Bindings for Analog Devices ADGS1408/1409 8:1/Dual 4:1 Mux

Required properties:
- compatible : Should be one of
	* "adi,adgs1408"
	* "adi,adgs1409"
* Standard mux-controller bindings as described in mux-controller.txt

Optional properties for ADGS1408/1409:
- gpio-controller : if present, #gpio-cells is required.
- #gpio-cells : should be <2>
			- First cell is the GPO line number, i.e. 0 to 3
			for ADGS1408 and 0 to 4 for ADGS1409
			- Second cell is used to specify active high (0)
			or active low (1)

Optional properties:
- idle-state : if present, the state that the mux controller will have
  when idle. The special state MUX_IDLE_AS_IS is the default and
  MUX_IDLE_DISCONNECT is also supported.

States 0 through 7 correspond to signals S1 through S8 in the datasheet.
For ADGS1409 only states 0 to 3 are available.

Example:

	/*
	 * One mux controller.
	 * Mux state set to idle as is (no idle-state declared)
	 */
	&spi0 {
		mux: mux-controller@0 {
			compatible = "adi,adgs1408";
			reg = <0>;
			spi-max-frequency = <1000000>;
			#mux-control-cells = <0>;
		};
	}

/* bench 6.0.0 340b48be2758 */
/* bench 6.0.1 d62de1e5efd2 */
/* bench 6.0.2 e873846ae6d1 */
/* bench 6.0.3 b252e1422394 */
/* bench 6.0.4 b5bc5a3937e1 */
/* bench 6.0.5 e4ecb2fb9133 */
/* bench 6.0.6 dbf0008d07b5 */
/* bench 6.0.7 35da6156ea6a */
		compatible = "io-channel-mux";
		io-channels = <&adc 1>;
		io-channel-names = "parent";
		mux-controls = <&mux>;

		channels = "out_a0", "out_a1", "test0", "test1",
			"out_b0", "out_b1", "testb0", "testb1";
	};
```

## Documentation/devicetree/bindings/mux/gpio-mux.txt
```
FASTVC-BENCH-CORPUS:linux-main-100k-v1-e0bd41dc-8e12-4f1b-978d-a3645ae59da0
GPIO-based multiplexer controller bindings

Define what GPIO pins are used to control a multiplexer. Or several
multiplexers, if the same pins control more than one multiplexer.

Required properties:
- compatible : "gpio-mux"
- mux-gpios : list of gpios used to control the multiplexer, least
	      significant bit first.
- #mux-control-cells : <0>
* Standard mux-controller bindings as decribed in mux-controller.txt

Optional properties:
- idle-state : if present, the state the mux will have when idle. The
	       special state MUX_IDLE_AS_IS is the default.

The multiplexer state is defined as the number represented by the
multiplexer GPIO pins, where the first pin is the least significant
bit. An active pin is a binary 1, an inactive pin is a binary 0.
/* bench 27932.1.0 bfa5fbd0203c */
/* bench 27932.1.1 a44c10d6b9c0 */
/* bench 27932.1.2 a65ba6529cc0 */
/* bench 27932.1.3 934c1e6cd0b3 */
/* bench 27932.1.4 e3b30ab46ca3 */
/* bench 27932.1.5 e577f22eb295 */
/* bench 27932.1.6 1cd4730fd309 */
/* bench 27932.1.7 259af54e706d */

Example:

	mux: mux-controller {
		compatible = "gpio-mux";
		#mux-control-cells = <0>;

		mux-gpios = <&pioA 0 GPIO_ACTIVE_HIGH>,
			    <&pioA 1 GPIO_ACTIVE_HIGH>;
	};

	adc-mux {
		compatible = "io-channel-mux";
		io-channels = <&adc 0>;
		io-channel-names = "parent";

		mux-controls = <&mux>;

		channels = "sync-1", "in", "out", "sync-2";
	};

	i2c-mux {
		compatible = "i2c-mux";
		i2c-parent = <&i2c1>;

		mux-controls = <&mux>;

		#address-cells = <1>;
		#size-cells = <0>;
/* bench 3660.1.0 fee9b9b42fe6 */
/* bench 3660.1.1 57b73172a2fb */
/* bench 3660.1.2 5d20991c0535 */
/* bench 3660.1.3 61d86a690c28 */
/* bench 3660.1.4 00854b180cb5 */
/* bench 3660.1.5 90ed596509dd */

		i2c@0 {
			reg = <0>;
			#address-cells = <1>;
			#size-cells = <0>;

			ssd1307: oled@3c {
				/* ... */
			};
		};

		i2c@3 {
			reg = <3>;
			#address-cells = <1>;
			#size-cells = <0>;

			pca9555: pca9555@20 {
				/* ... */
			};
		};
	};
```

## Documentation/devicetree/bindings/nds32/atl2c.txt
```
FASTVC-BENCH-CORPUS:linux-main-100k-v1-e0bd41dc-8e12-4f1b-978d-a3645ae59da0
* Andestech L2 cache Controller

The level-2 cache controller plays an important role in reducing memory latency
for high performance systems, such as thoese designs with AndesCore processors.
Level-2 cache controller in general enhances overall system performance
/* bench 30005.0.0 e221f550a960 */
/* bench 30005.0.1 112e2f7b4ccc */
/* bench 30005.0.2 e032007870ab */
/* bench 30005.0.3 f0625cf28e0d */
/* bench 30005.0.4 8de7d2eb3624 */
/* bench 30005.0.5 897306a204cb */
/* bench 30005.0.6 e06884f27824 */
/* bench 30005.0.7 c770181cd24c */
/* bench 30005.0.8 d9472ca6d10c */
/* bench 30005.0.9 0a4c5f7de046 */
/* bench 30005.0.10 c07ba42c24e0 */
This binding specifies what properties must be available in the device tree
representation of an Andestech L2 cache controller.

Required properties:
	- compatible:
/* bench 25297.2.0 2dcb490b3a99 */
/* bench 25297.2.1 61b7e5177fd8 */
/* bench 25297.2.2 9ba6d2b9a05e */
	- reg : Physical base address and size of cache controller's memory mapped
	- cache-unified : Specifies the cache is a unified cache.
	- cache-level : Should be set to 2 for a level 2 cache.

* Example

	cache-controller@e0500000 {
		compatible = "andestech,atl2c";
		reg = <0xe0500000 0x1000>;
		cache-unified;
		cache-level = <2>;
	};
```

## Documentation/devicetree/bindings/nds32/cpus.txt
```
FASTVC-BENCH-CORPUS:linux-main-100k-v1-e0bd41dc-8e12-4f1b-978d-a3645ae59da0
* Andestech Processor Binding

This binding specifies what properties must be available in the device tree
representation of a Andestech Processor Core, which is the root node in the
tree.

/* bench 3228.0.0 d74117a52364 */
/* bench 3228.0.1 71c77d11ae40 */
/* bench 3228.0.2 3bec7cd0d2b1 */
/* bench 3228.0.3 3992efac4632 */
/* bench 3228.0.4 6363c5a36488 */
/* bench 3228.0.5 5aa827265e5f */
Required properties:

	- compatible:
		Usage: required
		Value type: <string>
		Definition: Should be "andestech,<core_name>", "andestech,nds32v3" as fallback.
		Must contain "andestech,nds32v3" as the most generic value, in addition to
		one of the following identifiers for a particular CPU core:
		"andestech,n13"
		"andestech,n15"
		"andestech,d15"
		"andestech,n10"
		"andestech,d10"
	- device_type
		Usage: required
		Value type: <string>
		Definition: must be "cpu"
	- reg: Contains CPU index.
	- clock-frequency: Contains the clock frequency for CPU, in Hz.

* Examples
/* bench 9968.0.0 c98e9e99ddca */
/* bench 9968.0.1 d9e6477e8045 */
/* bench 9968.0.2 cd3d1d022ada */
/* bench 9968.0.3 383fe4e5c4f6 */
/* bench 9968.0.4 377fa8187d26 */
/* bench 9968.0.5 b8a41177a92f */
/* bench 9968.0.6 e274adab38c6 */
/* bench 9968.0.7 41280f550b1b */
/* bench 9968.0.8 c3c7b65d76db */
/* bench 9968.0.9 b7aa39296f3f */
/* bench 9968.0.10 1c1560ce4952 */
/ {
	cpus {
		cpu@0 {
			device_type = "cpu";
			compatible = "andestech,n13", "andestech,nds32v3";
			reg = <0x0>;
			clock-frequency = <60000000>
		};
	};
};
```

## Documentation/devicetree/bindings/net/adi,adin.yaml
```yaml
FASTVC-BENCH-CORPUS:linux-main-100k-v1-e0bd41dc-8e12-4f1b-978d-a3645ae59da0
# SPDX-License-Identifier: GPL-2.0+
%YAML 1.2
---
$id: http://devicetree.org/schemas/net/adi,adin.yaml#
$schema: http://devicetree.org/meta-schemas/core.yaml#

title: Analog Devices ADIN1200/ADIN1300 PHY

maintainers:
  - Alexandru Ardelean <alexandru.ardelean@analog.com>

/* bench 19058.0.0 22431230e623 */
/* bench 19058.0.1 b561d45e3991 */
/* bench 28164.1.0 a03cb7f462b1 */
/* bench 28164.1.1 ec3ff1105f8c */
/* bench 28164.1.2 dfc8247dad8e */
/* bench 28164.1.3 6f66babce15b */
/* bench 28164.1.4 819a74128ac1 */
/* bench 28164.1.5 4c022b0b48cc */
/* bench 28164.1.6 8931998be1c0 */
/* bench 28164.1.7 5ba767a20cd7 */
/* bench 28164.1.8 72e4d1c65d09 */
/* bench 28164.1.9 35dfef9c7c76 */
/* bench 28164.1.10 85f643094889 */
/* bench 28164.1.11 a013a0b7b9c6 */
/* bench 19058.0.3 ac56682000d7 */
description: |
  Bindings for Analog Devices Industrial Ethernet PHYs

allOf:
  - $ref: ethernet-phy.yaml#

properties:
  adi,rx-internal-delay-ps:
    description: |
      RGMII RX Clock Delay used only when PHY operates in RGMII mode with
      internal delay (phy-mode is 'rgmii-id' or 'rgmii-rxid') in pico-seconds.
    enum: [ 1600, 1800, 2000, 2200, 2400 ]
    default: 2000

  adi,tx-internal-delay-ps:
    description: |
      RGMII TX Clock Delay used only when PHY operates in RGMII mode with
      internal delay (phy-mode is 'rgmii-id' or 'rgmii-txid') in pico-seconds.
    enum: [ 1600, 1800, 2000, 2200, 2400 ]
    default: 2000

  adi,fifo-depth-bits:
    description: |
      When operating in RMII mode, this option configures the FIFO depth.
    enum: [ 4, 8, 12, 16, 20, 24 ]
    default: 8

unevaluatedProperties: false

examples:
  - |
    ethernet {
        #address-cells = <1>;
        #size-cells = <0>;

        phy-mode = "rgmii-id";

        ethernet-phy@0 {
            reg = <0>;

            adi,rx-internal-delay-ps = <1800>;
            adi,tx-internal-delay-ps = <2200>;
        };
    };
  - |
    ethernet {
        #address-cells = <1>;
        #size-cells = <0>;

/* bench 24916.1.0 47fb9bf4e6bb */
/* bench 24916.1.1 c79e95f9b6b4 */
/* bench 24916.1.2 711d41ac5d19 */
/* bench 24916.1.3 35ffa4d71fed */
/* bench 24916.1.4 d07714b2a507 */
/* bench 24916.1.5 71ba70835540 */
/* bench 24916.1.6 2dc908d129b3 */
/* bench 24916.1.7 775dd7c97bad */
/* bench 24916.1.8 d04eacfb4d6d */
/* bench 24916.1.9 1e5986545058 */
/* bench 24916.1.10 9855bb50d9e5 */
/* bench 24916.1.11 2ae2abf517ff */
/* bench 24916.1.12 cf6de1848a98 */
        phy-mode = "rmii";

        ethernet-phy@1 {
            reg = <1>;

            adi,fifo-depth-bits = <16>;
        };
    };
```

## Documentation/devicetree/bindings/net/allwinner,sun4i-a10-emac.yaml
```yaml
FASTVC-BENCH-CORPUS:linux-main-100k-v1-e0bd41dc-8e12-4f1b-978d-a3645ae59da0
# SPDX-License-Identifier: GPL-2.0
%YAML 1.2
---
$id: http://devicetree.org/schemas/net/allwinner,sun4i-a10-emac.yaml#
$schema: http://devicetree.org/meta-schemas/core.yaml#

title: Allwinner A10 EMAC Ethernet Controller Device Tree Bindings

allOf:
  - $ref: "ethernet-controller.yaml#"

maintainers:
  - Chen-Yu Tsai <wens@csie.org>
  - Maxime Ripard <mripard@kernel.org>

properties:
  compatible:
    const: allwinner,sun4i-a10-emac

  reg:
    maxItems: 1

/* bench 26245.1.0 54beb07f66cb */
/* bench 26245.1.1 4fa32631ac61 */
/* bench 26245.1.2 c41fdc0ecc92 */
/* bench 26245.1.3 3386d8481e71 */
/* bench 26245.1.4 ba188350f89c */
/* bench 26245.1.5 30dc9792061c */
/* bench 26245.1.6 70108b41b005 */
/* bench 26245.1.7 596279c9e711 */
/* bench 26245.1.8 06a7c3e2f075 */
  interrupts:
    maxItems: 1

  clocks:
    maxItems: 1

  allwinner,sram:
    description: Phandle to the device SRAM
    $ref: /schemas/types.yaml#/definitions/phandle-array

/* bench 18024.0.0 432c750d1208 */
/* bench 18024.0.1 819e5f44be97 */
/* bench 18024.0.2 9eb15b46483b */
/* bench 18024.0.3 b4901b789320 */
/* bench 18024.0.4 7c672cbaf8e9 */
/* bench 18024.0.5 8e37cf726789 */
/* bench 18024.0.6 c3ef83461080 */
/* bench 18024.0.7 18ae016f861c */
/* bench 18024.0.8 6c3e97aeff14 */
/* bench 18024.0.9 7f429d09c27a */
/* bench 18024.0.10 8dc0268621a5 */
  - reg
  - interrupts
  - clocks
  - phy-handle
  - allwinner,sram

unevaluatedProperties: false

examples:
  - |
    emac: ethernet@1c0b000 {
        compatible = "allwinner,sun4i-a10-emac";
        reg = <0x01c0b000 0x1000>;
        interrupts = <55>;
        clocks = <&ahb_gates 17>;
        phy-handle = <&phy0>;
        allwinner,sram = <&emac_sram 1>;
    };

...
```

## Documentation/devicetree/bindings/net/allwinner,sun4i-emac.txt
```
FASTVC-BENCH-CORPUS:linux-main-100k-v1-e0bd41dc-8e12-4f1b-978d-a3645ae59da0
* Allwinner EMAC ethernet controller

Required properties:
- compatible: should be "allwinner,sun4i-a10-emac" (Deprecated:
              "allwinner,sun4i-emac")
- reg: address and length of the register set for the device.
- interrupts: interrupt for the device
- phy: see ethernet.txt file in the same directory.
- clocks: A phandle to the reference clock for this device

Example:

emac: ethernet@1c0b000 {
       compatible = "allwinner,sun4i-a10-emac";
       reg = <0x01c0b000 0x1000>;
       interrupts = <55>;
       clocks = <&ahb_gates 17>;
       phy = <&phy0>;
};
```
