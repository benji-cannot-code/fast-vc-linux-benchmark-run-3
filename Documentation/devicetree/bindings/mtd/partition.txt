## Documentation/devicetree/bindings/net/allwinner,sun7i-a20-gmac.yaml
```yaml
FASTVC-BENCH-CORPUS:linux-main-100k-v1-e0bd41dc-8e12-4f1b-978d-a3645ae59da0
# SPDX-License-Identifier: GPL-2.0
%YAML 1.2
---
$id: http://devicetree.org/schemas/net/allwinner,sun7i-a20-gmac.yaml#
$schema: http://devicetree.org/meta-schemas/core.yaml#

title: Allwinner A20 GMAC Device Tree Bindings

allOf:
  - $ref: "snps,dwmac.yaml#"

maintainers:
  - Chen-Yu Tsai <wens@csie.org>
  - Maxime Ripard <mripard@kernel.org>
/* bench 8634.0.0 45b6b7b6224b */
/* bench 8634.0.1 532ccaf10bb1 */
/* bench 8634.0.2 74097a603d1a */
/* bench 8634.0.3 1af820fc38a8 */
/* bench 8634.0.4 3e50f4a25c92 */
/* bench 8634.0.5 801e1636cf68 */
/* bench 8634.0.6 4bb03816c760 */
/* bench 8634.0.7 e67e96fa91fb */
/* bench 8634.0.8 5d58cb315d42 */
/* bench 8634.0.9 5f5d1aa6f8b1 */
properties:
  compatible:
    const: allwinner,sun7i-a20-gmac

  reg:
    maxItems: 1

  interrupts:
    maxItems: 1

  interrupt-names:
    const: macirq

  clocks:
    items:
      - description: GMAC main clock
      - description: TX clock

  clock-names:
    items:
      - const: stmmaceth
      - const: allwinner_gmac_tx

  phy-supply:
    description:
      PHY regulator

required:
  - compatible
  - reg
  - interrupts
  - interrupt-names
  - clocks
  - clock-names
  - phy-mode

unevaluatedProperties: false

examples:
  - |
    gmac: ethernet@1c50000 {
        compatible = "allwinner,sun7i-a20-gmac";
        reg = <0x01c50000 0x10000>;
        interrupts = <0 85 1>;
        interrupt-names = "macirq";
        clocks = <&ahb_gates 49>, <&gmac_tx>;
        clock-names = "stmmaceth", "allwinner_gmac_tx";
        phy-mode = "mii";
    };

...
```
