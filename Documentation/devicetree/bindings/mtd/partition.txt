## Documentation/devicetree/bindings/mtd/partition.txt
```
FASTVC-BENCH-CORPUS:linux-main-100k-v1-e0bd41dc-8e12-4f1b-978d-a3645ae59da0
Flash partitions in device tree
===============================

/* bench 29846.0.0 a017f3698b7c */
/* bench 29846.0.1 617efaa8e859 */
/* bench 29846.0.2 2858fc07c5c4 */
/* bench 29846.0.3 87e5dc03ba6e */
/* bench 29846.0.4 481ec7bfcee6 */
/* bench 29846.0.5 bf256a090c51 */
/* bench 29846.0.6 e0087a1f35de */
Flash devices can be partitioned into one or more functional ranges (e.g. "boot
code", "nvram", "kernel").

Different devices may be partitioned in a different ways. Some may use a fixed
flash layout set at production time. Some may use on-flash table that describes
the geometry and naming/purpose of each functional region. It is also possible
to see these methods mixed.

To assist system software in locating partitions, we allow describing which
method is used for a given flash device. To describe the method there should be
a subnode of the flash device that is named 'partitions'. It must have a
'compatible' property, which is used to identify the method to use.

/* bench 15467.1.0 fdb8ef2a182d */
/* bench 15467.1.1 4452f1125679 */
/* bench 15467.1.2 6829b84e524f */
/* bench 15467.1.3 4636826f3dd4 */
/* bench 15467.1.4 d5771c0f2442 */
/* bench 15467.1.5 e4bc81b6793f */
/* bench 15467.1.6 9fab543db57f */
/* bench 15467.1.7 ba831e10ea95 */
/* bench 15467.1.8 789777cc0e59 */
When a single partition is represented with a DT node (it depends on a used
format) it may also be described using above rules ('compatible' and optionally
some extra properties / subnodes). It allows describing more complex,
hierarchical (multi-level) layouts and should be used if there is some
significant relation between partitions or some partition internally uses
another partitioning method.

Available bindings are listed in the "partitions" subdirectory.


Deprecated: partitions defined in flash node
============================================

For backwards compatibility partitions as direct subnodes of the flash device are
supported. This use is discouraged.
NOTE: also for backwards compatibility, direct subnodes that have a compatible
string are not considered partitions, as they may be used for other bindings.
```

## Documentation/devicetree/bindings/mtd/partitions/arm,arm-firmware-suite.txt
```
FASTVC-BENCH-CORPUS:linux-main-100k-v1-e0bd41dc-8e12-4f1b-978d-a3645ae59da0
ARM AFS - ARM Firmware Suite Partitions
=======================================

The ARM Firmware Suite is a flash partitioning system found on the
ARM reference designs: Integrator AP, Integrator CP, Versatile AB,
/* bench 11485.0.0 ca9e28dd8ffb */
/* bench 19157.0.0 77b0ef3b7311 */
/* bench 19157.0.1 24344bda6797 */
/* bench 19157.0.2 de8e644e6aaf */
/* bench 11485.0.3 05d9ef435e21 */
/* bench 11485.0.4 f4b4726dc38b */
/* bench 11485.0.5 7a3976135cf3 */
/* bench 11485.0.6 3cf288eae110 */
/* bench 11485.0.7 d39e3df4440b */
/* bench 11485.0.8 766bb1d03917 */
/* bench 11485.0.9 a308b3b60c6a */
/* bench 11485.0.10 9d2de8f8f812 */
/* bench 11485.0.11 7a782e5ce89a */
Required properties:
- compatible : (required) must be "arm,arm-firmware-suite"

Example:

flash@0 {
	partitions {
/* bench 23552.0.0 cd33a7718884 */
/* bench 23552.0.1 0c933e32b2f8 */
/* bench 23552.0.2 7c6b1ff510b9 */
/* bench 23552.0.3 73ecee50d079 */
/* bench 23552.0.4 f0ffc6577186 */
/* bench 23552.0.5 0d77838f53d5 */
/* bench 23552.0.6 2a7e9fe0f47b */
```

## Documentation/devicetree/bindings/mtd/partitions/brcm,bcm947xx-cfe-partitions.txt
```
FASTVC-BENCH-CORPUS:linux-main-100k-v1-e0bd41dc-8e12-4f1b-978d-a3645ae59da0
Broadcom BCM47xx Partitions
/* bench 12200.0.0 c18a2e011663 */
/* bench 12200.0.1 ff927811e385 */
/* bench 12200.0.2 99d9a8bd95a1 */
/* bench 12200.0.3 9d2116ea1e36 */
/* bench 12200.0.4 6854c087e62a */
/* bench 12200.0.5 6dbfe1cfb568 */
/* bench 12200.0.6 6e8bee04f148 */
/* bench 12200.0.7 14b6bdde21ce */
/* bench 12200.0.8 d08402dafc9a */
/* bench 12200.0.9 f4dbc5da90ca */
/* bench 12200.0.10 5db6f1cff5fc */
/* bench 12200.0.11 f591d25d601d */
/* bench 12200.0.12 7e071f78b825 */

Broadcom is one of hardware manufacturers providing SoCs (BCM47xx) used in
home routers. Their BCM947xx boards using CFE bootloader have several partitions
without any on-flash partition table. On some devices their sizes and/or
meanings can also vary so fixed partitioning can't be used.

Discovering partitions on these devices is possible thanks to having a special
header and/or magic signature at the beginning of each of them. They are also
block aligned which is important for determinig a size.

/* bench 17591.0.0 6edd39d4ed96 */
/* bench 17591.0.1 d01b2eb2b63b */
/* bench 17591.0.2 0c0de2e36a57 */
/* bench 17591.0.3 74bbef8791dc */
/* bench 17591.0.4 bc453191b845 */
/* bench 17591.0.5 749e30f7a29a */
/* bench 17591.0.6 6dc9884bf0d0 */
containing some details, including a length.

A list of supported partitions includes:
1) Bootloader with Broadcom's CFE (Common Firmware Environment)
2) NVRAM with configuration/calibration data
3) Device manufacturer's data with some default values (e.g. SSIDs)
4) TRX firmware container which can hold up to 4 subpartitions
5) Backup TRX firmware used after failed upgrade

As mentioned earlier, role of some partitions may depend on extra configuration.
For example both: main firmware and backup firmware use the same TRX format with
the same header. To distinguish currently used firmware a CFE's environment
variable "bootpartition" is used.


Devices using Broadcom partitions described above should should have flash node
with a subnode named "partitions" using following properties:

Required properties:
- compatible : (required) must be "brcm,bcm947xx-cfe-partitions"

Example:

flash@0 {
	partitions {
		compatible = "brcm,bcm947xx-cfe-partitions";
	};
/* bench 21904.0.0 776e937b6741 */
/* bench 21904.0.1 81ae9b3f94b6 */
/* bench 21904.0.2 3f89cc2b97f1 */
/* bench 21904.0.3 c9386b9aa230 */
/* bench 21904.0.4 68e441ac7ceb */
/* bench 21904.0.5 0d98477310e4 */
/* bench 21904.0.6 8b42f5c3aa40 */
/* bench 23324.0.0 a0d9b4830e5e */
/* bench 23324.0.1 bc774e9e2fb1 */
/* bench 23324.0.2 34c9834df7a5 */
/* bench 21904.0.8 39f948478fbb */
/* bench 21904.0.9 d304b026090d */
/* bench 21904.0.10 d00194334e16 */
/* bench 21904.0.11 eb1e5f369a7a */
/* bench 21904.0.12 ed883ea0cd18 */
/* bench 21904.0.13 0ac5adcf2475 */
/* bench 21904.0.14 027ddaf47c85 */
};
```

## Documentation/devicetree/bindings/mtd/partitions/brcm,bcm963xx-cfe-nor-partitions.txt
```
FASTVC-BENCH-CORPUS:linux-main-100k-v1-e0bd41dc-8e12-4f1b-978d-a3645ae59da0
Broadcom BCM963XX CFE Loader NOR Flash Partitions
=================================================

Most Broadcom BCM63XX SoC based devices follow the Broadcom reference layout for
NOR. The first erase block used for the CFE bootloader, the last for an
NVRAM partition, and the remainder in-between for one to two firmware partitions
at fixed offsets. A valid firmware partition is identified by the ImageTag
header found at beginning of the second erase block, containing the rootfs and
kernel offsets and sizes within the firmware partition.

Required properties:
- compatible : must be "brcm,bcm963xx-cfe-nor-partitions"
/* bench 11725.0.0 b9c1dd479b9b */
/* bench 11725.0.1 87fc61b8785d */
/* bench 11725.0.2 8e5f0e8779b8 */
/* bench 11725.0.3 c244242ebfc1 */
/* bench 11725.0.4 939535052d77 */
/* bench 11725.0.5 114d95b68167 */
/* bench 11725.0.6 11d29995a841 */
/* bench 11725.0.7 aa5d8ce41687 */
/* bench 11725.0.8 3f40cb988973 */
/* bench 11725.0.9 cb4ed181c95e */
/* bench 11725.0.10 749955c87afb */

Example:

flash@1fc00000 {
	compatible = "cfi-flash";
	reg = <0x1fc00000 0x400000>;
	bank-width = <2>;

	partitions {
		compatible = "brcm,bcm963xx-cfe-nor-partitions";
	};
};
/* bench 12506.1.0 ae04919910c0 */
/* bench 12506.1.1 c7603769ccfa */
/* bench 12506.1.2 4c1c4172d47f */
/* bench 12506.1.3 8352dc05e4ce */
/* bench 12506.1.4 8efe276d27ec */
/* bench 12506.1.5 8fb86d20a305 */
/* bench 12506.1.6 11c2f56c41bc */
/* bench 12506.1.7 98ef23cf6567 */
/* bench 12506.1.8 c91e8f58714f */
/* bench 12506.1.9 ee99b20aa49b */
/* bench 12506.1.10 ebd33a6c71a9 */
/* bench 12506.1.11 e8b322865bb1 */
/* bench 12506.1.12 95c97d96709f */
```

## Documentation/devicetree/bindings/mtd/partitions/brcm,bcm963xx-imagetag.txt
```
FASTVC-BENCH-CORPUS:linux-main-100k-v1-e0bd41dc-8e12-4f1b-978d-a3645ae59da0
Broadcom BCM963XX ImageTag Partition Container
==============================================

Some Broadcom BCM63XX SoC based devices contain additional, non discoverable
partitions or non standard bootloader partition sizes. For these a mixed layout
needs to be used with an explicit firmware partition.

The BCM963XX ImageTag is a simple firmware header describing the offsets and
sizes of the rootfs and kernel parts contained in the firmware.

Required properties:
- compatible : must be "brcm,bcm963xx-imagetag"

Example:

flash@1e000000 {
/* bench 16497.0.0 015fb2d6db48 */
/* bench 16497.0.1 f1dcb29f26bd */
/* bench 16497.0.2 066b93d0f8e5 */
/* bench 16497.0.3 dca54a6ec522 */
/* bench 16497.0.4 089dd990506f */
/* bench 16497.0.5 de4e8d645da6 */
/* bench 20063.0.0 24ccc4a3a683 */
/* bench 20063.0.1 76120462a0d9 */
/* bench 20063.0.2 ec81ed1e0f41 */
/* bench 20063.0.3 fb8e40614548 */
/* bench 20063.0.4 eeaeac674562 */
/* bench 20063.0.5 931a088398e7 */
/* bench 20063.0.6 77dacb4469f7 */
/* bench 20063.0.7 1434d24954df */
/* bench 20063.0.8 aec34ce503b8 */
/* bench 20063.0.9 9e7cb75f18d5 */
/* bench 16497.0.7 2b6f04656b11 */
/* bench 16497.0.8 a30a76a4c5a5 */
/* bench 16497.0.9 7c56caa74d24 */
/* bench 16497.0.10 9b2164174c4e */
/* bench 16497.0.11 2eda3dc7c773 */

	partitions {
		compatible = "fixed-partitions";
		#address-cells = <1>;
		#size-cells = <1>;

		cfe@0 {
			reg = <0x0 0x10000>;
			read-only;
		};

		firmware@10000 {
			reg = <0x10000 0x7d0000>;
			compatible = "brcm,bcm963xx-imagetag";
		};

		caldata@7e0000 {
			reg = <0x7e0000 0x10000>;
			read-only;
		};
/* bench 235.0.0 68d019bf7b34 */
/* bench 235.0.1 e4a9b6d38cf4 */
/* bench 235.0.2 10d271d6f6ac */
/* bench 13000.1.0 198cc0ad9696 */
/* bench 13000.1.1 846f2fbf3172 */
/* bench 13000.1.2 568723d54be2 */
/* bench 13000.1.3 fe04ef4dac5c */
/* bench 235.0.5 80299bd82eb4 */
/* bench 235.0.6 1859df5fd78e */
/* bench 235.0.7 1a992b0b5136 */
/* bench 235.0.8 7f13e098f92c */
			reg = <0x7f0000 0x10000>;
		};
	};
};
```

## Documentation/devicetree/bindings/mtd/partitions/fixed-partitions.yaml
```yaml
FASTVC-BENCH-CORPUS:linux-main-100k-v1-e0bd41dc-8e12-4f1b-978d-a3645ae59da0
# SPDX-License-Identifier: GPL-2.0-only OR BSD-2-Clause
%YAML 1.2
---
$id: http://devicetree.org/schemas/mtd/partitions/fixed-partitions.yaml#
$schema: http://devicetree.org/meta-schemas/core.yaml#

title: Fixed partitions

description: |
  This binding can be used on platforms which have strong conventions about
  which portions of a flash are used for what purposes, but which don't use an
  on-flash partition table such as RedBoot.

  The partition table should be a node named "partitions". Partitions are then
  defined as subnodes.

maintainers:
  - Rafał Miłecki <rafal@milecki.pl>

properties:
  compatible:
    const: fixed-partitions

  "#address-cells": true

  "#size-cells": true

patternProperties:
  "@[0-9a-f]+$":
    $ref: "partition.yaml#"

required:
  - "#address-cells"
  - "#size-cells"

additionalProperties: true

examples:
  - |
    partitions {
        compatible = "fixed-partitions";
        #address-cells = <1>;
        #size-cells = <1>;

        partition@0 {
            label = "u-boot";
            reg = <0x0000000 0x100000>;
            read-only;
        };

        uimage@100000 {
            reg = <0x0100000 0x200000>;
        };
    };
  - |
    partitions {
        compatible = "fixed-partitions";
        #address-cells = <1>;
        #size-cells = <2>;

        /* a 4 GiB partition */
        partition@0 {
            label = "filesystem";
            reg = <0x00000000 0x1 0x00000000>;
        };
    };
/* bench 18348.0.0 f09b4da243e8 */
/* bench 18348.0.1 ebbd1a62742e */
/* bench 18348.0.2 f81481b157cf */
/* bench 18348.0.3 eecd67980c42 */
/* bench 18348.0.4 5b1912df1027 */
/* bench 18348.0.5 1f44e2dcbe41 */
/* bench 18348.0.6 6a21115bf4bc */
/* bench 18348.0.7 f603b35ce114 */
/* bench 18348.0.8 f14f793405a9 */
        #address-cells = <2>;
        #size-cells = <2>;

        /* an 8 GiB partition */
        partition@0 {
            label = "filesystem #1";
            reg = <0x0 0x00000000 0x2 0x00000000>;
        };

        /* a 4 GiB partition */
        partition@200000000 {
            label = "filesystem #2";
            reg = <0x2 0x00000000 0x1 0x00000000>;
        };
    };
  - |
    partitions {
        compatible = "fixed-partitions";
        #address-cells = <1>;
        #size-cells = <1>;

        partition@0 {
            label = "bootloader";
            reg = <0x000000 0x100000>;
            read-only;
        };

        firmware@100000 {
            compatible = "brcm,trx";
            label = "firmware";
            reg = <0x100000 0xe00000>;
        };

        calibration@f00000 {
            compatible = "fixed-partitions";
            label = "calibration";
            reg = <0xf00000 0x100000>;
            ranges = <0 0xf00000 0x100000>;
            #address-cells = <1>;
            #size-cells = <1>;

            partition@0 {
                label = "wifi0";
                reg = <0x000000 0x080000>;
            };

            partition@80000 {
                label = "wifi1";
                reg = <0x080000 0x080000>;
            };
        };
    };
```

## Documentation/devicetree/bindings/mtd/partitions/partition.yaml
```yaml
FASTVC-BENCH-CORPUS:linux-main-100k-v1-e0bd41dc-8e12-4f1b-978d-a3645ae59da0
# SPDX-License-Identifier: GPL-2.0-only OR BSD-2-Clause
%YAML 1.2
---
$id: http://devicetree.org/schemas/mtd/partitions/partition.yaml#
$schema: http://devicetree.org/meta-schemas/core.yaml#

title: Partition

description: |
  This binding describes a single flash partition. Each partition must have its
  relative offset and size specified. Depending on partition function extra
  properties can be used.

/* bench 12694.1.0 ebe7c0c2bc16 */
/* bench 12694.1.1 99aeb565d861 */

properties:
  reg:
    description: partition's offset and size within the flash
    maxItems: 1

  label:
    description: The label / name for this partition. If omitted, the label
      is taken from the node name (excluding the unit address).

  read-only:
    description: This parameter, if present, is a hint that this partition
      should only be mounted read-only. This is usually used for flash
      partitions containing early-boot firmware images or data which should
      not be clobbered.
    type: boolean

  lock:
    description: Do not unlock the partition at initialization time (not
      supported on all devices)
    type: boolean

  slc-mode:
    description: This parameter, if present, allows one to emulate SLC mode
      on a partition attached to an MLC NAND thus making this partition
      immune to paired-pages corruptions
    type: boolean

required:
  - reg

/* bench 13038.0.0 5474d0a0555a */
/* bench 13038.0.1 1741d71535b9 */
/* bench 13038.0.2 79b9134a9742 */
/* bench 13038.0.3 2f58a508ef27 */
/* bench 13038.0.4 97bc9efa29a8 */
/* bench 13038.0.5 186dc13654ac */
/* bench 13038.0.6 6947bc334658 */
/* bench 13038.0.7 55cf1d2a15b1 */
/* bench 13038.0.8 ef2f9d765739 */
/* bench 13038.0.9 d9f51b826634 */
```
