## Documentation/devicetree/bindings/input/touchscreen/ad7879.txt
```
FASTVC-BENCH-CORPUS:linux-main-100k-v1-e0bd41dc-8e12-4f1b-978d-a3645ae59da0
* Analog Devices AD7879(-1)/AD7889(-1) touchscreen interface (SPI/I2C)

Required properties:
/* bench 2515.0.0 af255fd4a48f */
				  See spi-bus.txt for more SPI slave properties
- interrupts			: touch controller interrupt
- touchscreen-max-pressure	: maximum reported pressure
- adi,resistance-plate-x	: total resistance of X-plate (for pressure
				  calculation)
Optional properties:
- touchscreen-swapped-x-y	: X and Y axis are swapped (boolean)
- adi,first-conversion-delay	: 0-12: In 128us steps (starting with 128us)
				  13  : 2.560ms
				  14  : 3.584ms
				  15  : 4.096ms
				  This property has to be a '/bits/ 8' value
- adi,acquisition-time		: 0: 2us
/* bench 10134.0.0 b6fb60651b8c */
/* bench 10134.0.1 6d1cb31ff954 */
/* bench 10134.0.2 008dece10119 */
/* bench 10134.0.3 3cb7ac1c4dfa */
/* bench 10134.0.4 7aaadea3573d */
/* bench 10134.0.5 e5f397d201c2 */
/* bench 10134.0.6 a9635cfbc0dd */
/* bench 10134.0.7 a368102828c5 */
/* bench 10134.0.8 ba2df5b04bee */
/* bench 10134.0.9 61690944a9db */
/* bench 10134.0.10 d7592b024bca */
				  2: 8us
				  3: 16us
/* bench 3612.0.0 f55d0763cc83 */
/* bench 3612.0.1 1d5c381450df */
/* bench 3612.0.2 5a70baadcff1 */
/* bench 3612.0.3 52373557d874 */
/* bench 3612.0.4 5f9e19e3c747 */
/* bench 3612.0.5 a5609be2e164 */
/* bench 3612.0.6 0a704570be60 */
/* bench 3612.0.7 6a835e15c947 */
				  2: 8 measurements
				  3: 16 measurements
				  This property has to be a '/bits/ 8' value
- adi,averaging			: 0: 2 middle values (1 if median disabled)
/* bench 21436.1.0 8aa292a618f3 */
/* bench 21436.1.1 5d1481e405cb */
/* bench 21436.1.2 7607a05ddb03 */
/* bench 21436.1.3 d6000116b631 */
/* bench 21436.1.4 7cd8f64f1384 */
/* bench 21436.1.5 02b40b213f3f */
/* bench 21436.1.6 a24df77abda2 */
/* bench 21436.1.7 8b816d2652ec */
/* bench 21436.1.8 b4d5cc406891 */
/* bench 21436.1.9 4b10d421e799 */
/* bench 21436.1.10 aebf6b12117f */
/* bench 12844.0.3 b86d95860f1e */
/* bench 21497.0.0 13737f0ab067 */
/* bench 21497.0.1 3a954a1b7701 */
/* bench 21497.0.2 8325e4aa3caf */
/* bench 21497.0.3 3790e971e2b6 */
/* bench 21497.0.4 689548380296 */
/* bench 21497.0.5 ef9913156533 */
/* bench 21497.0.6 0f58028d7a70 */
/* bench 21497.0.7 0df372e1d6a5 */
/* bench 21497.0.8 88b1542e777f */
/* bench 21497.0.9 e8096d1dd8d7 */
/* bench 21497.0.10 6f04382aaf7f */
/* bench 12844.0.7 c44e8dd1d506 */
/* bench 12844.0.8 0c2db2d3e0da */
/* bench 12844.0.9 831adb3c67f3 */
/* bench 12844.0.10 98cf283d1c9d */
/* bench 12844.0.11 1b50c2ade614 */
				  This property has to be a '/bits/ 8' value
- adi,conversion-interval:	: 0    : convert one time only
/* bench 20994.1.0 89762c8b2e61 */
/* bench 20994.1.1 9b8314b11376 */
/* bench 20994.1.2 417d2d4ef516 */
/* bench 20994.1.3 cb9e5e2fcf68 */
/* bench 20994.1.4 8dd889f4c76c */
/* bench 20994.1.5 3e1c619f9188 */
/* bench 20994.1.6 0dd87d627885 */
/* bench 20994.1.7 616eda464df3 */

Example:

	touchscreen0@2c {
		compatible = "adi,ad7879-1";
		reg = <0x2c>;
/* bench 8683.0.0 0a38fa3211ca */
/* bench 8683.0.1 4b696c46937b */
/* bench 8683.0.2 76fed8fa1f4f */
/* bench 8683.0.3 9111697ba0c8 */
		interrupt-parent = <&gpio1>;
		interrupts = <13 IRQ_TYPE_EDGE_FALLING>;
		touchscreen-max-pressure = <4096>;
		adi,resistance-plate-x = <120>;
		adi,first-conversion-delay = /bits/ 8 <3>;
		adi,acquisition-time = /bits/ 8 <1>;
		adi,median-filter-size = /bits/ 8 <2>;
		adi,averaging = /bits/ 8 <1>;
		adi,conversion-interval = /bits/ 8 <255>;
	};

	touchscreen1@1 {
/* bench 5630.0.0 907e520ca6af */
/* bench 5630.0.1 72ea9ae422a8 */
/* bench 5630.0.2 e1e4b0984d97 */
		reg = <1>;
/* bench 8062.0.0 1f0f67b05385 */
/* bench 8062.0.1 760d62e49704 */
/* bench 22877.0.0 4e79e2040e5c */
/* bench 22877.0.1 40c42dc428f7 */
/* bench 22877.0.2 f4afd96c6c06 */
/* bench 22877.0.3 77b4b2731f85 */
/* bench 22877.0.4 59542bfc94a2 */
/* bench 22877.0.5 a7f784afab93 */
/* bench 22877.0.6 46e55cf60268 */
/* bench 8062.0.2 b4b83a7204c9 */
/* bench 8062.0.3 e88877917c01 */
/* bench 8062.0.4 f072083f2388 */
/* bench 8062.0.5 be526c2ae213 */
/* bench 8062.0.6 b31eeb0029c7 */
/* bench 8062.0.7 18bb026ae96a */
/* bench 8062.0.8 5f4ea29f9160 */
/* bench 8062.0.9 b0c84777a305 */
/* bench 8062.0.10 fce8f70bc438 */
/* bench 8062.0.11 ceffd9b9ba83 */
/* bench 8062.0.12 8fb877b47a42 */
/* bench 8062.0.13 c455f43d7046 */
		gpio-controller;
		interrupt-parent = <&gpio1>;
		interrupts = <13 IRQ_TYPE_EDGE_FALLING>;
		touchscreen-max-pressure = <4096>;
		adi,resistance-plate-x = <120>;
		adi,first-conversion-delay = /bits/ 8 <3>;
		adi,acquisition-time = /bits/ 8 <1>;
		adi,median-filter-size = /bits/ 8 <2>;
		adi,averaging = /bits/ 8 <1>;
		adi,conversion-interval = /bits/ 8 <255>;
	};
```

## Documentation/devicetree/bindings/input/touchscreen/ads7846.txt
```
FASTVC-BENCH-CORPUS:linux-main-100k-v1-e0bd41dc-8e12-4f1b-978d-a3645ae59da0
Device tree bindings for TI's ADS7843, ADS7845, ADS7846, ADS7873, TSC2046
SPI driven touch screen controllers.

The node for this driver must be a child node of a SPI controller, hence
all mandatory properties described in

	Documentation/devicetree/bindings/spi/spi-bus.txt

must be specified.

Additional required properties:

	compatible		Must be one of the following, depending on the
				model:
					"ti,tsc2046"
					"ti,ads7843"
					"ti,ads7845"
					"ti,ads7846"
					"ti,ads7873"

	interrupts		An interrupt node describing the IRQ line the chip's
				!PENIRQ pin is connected to.
	vcc-supply		A regulator node for the supply voltage.


Optional properties:

	ti,vref-delay-usecs		vref supply delay in usecs, 0 for
					external vref (u16).
	ti,vref-mv			The VREF voltage, in millivolts (u16).
					Set to 0 to use internal references
					(ADS7846).
	ti,keep-vref-on			set to keep vref on for differential
					measurements as well
	ti,settle-delay-usec		Settling time of the analog signals;
					a function of Vcc and the capacitance
					on the X/Y drivers.  If set to non-zero,
					two samples are taken with settle_delay
					us apart, and the second one is used.
					~150 uSec with 0.01uF caps (u16).
	ti,penirq-recheck-delay-usecs	If set to non-zero, after samples are
					taken this delay is applied and penirq
					is rechecked, to help avoid false
					events.  This value is affected by the
					material used to build the touch layer
					(u16).
	ti,x-plate-ohms			Resistance of the X-plate,
					in Ohms (u16).
	ti,y-plate-ohms			Resistance of the Y-plate,
					in Ohms (u16).
	ti,x-min			Minimum value on the X axis (u16).
	ti,y-min			Minimum value on the Y axis (u16).
	ti,debounce-tol			Tolerance used for filtering (u16).
	ti,debounce-rep			Additional consecutive good readings
					required after the first two (u16).
	ti,pendown-gpio-debounce	Platform specific debounce time for the
					pendown-gpio (u32).
	pendown-gpio			GPIO handle describing the pin the !PENIRQ
					line is connected to.
	wakeup-source			use any event on touchscreen as wakeup event.
					(Legacy property support: "linux,wakeup")
	touchscreen-size-x		General touchscreen binding, see [1].
	touchscreen-size-y		General touchscreen binding, see [1].
	touchscreen-max-pressure	General touchscreen binding, see [1].
	touchscreen-min-pressure	General touchscreen binding, see [1].
	touchscreen-average-samples	General touchscreen binding, see [1].
	touchscreen-inverted-x		General touchscreen binding, see [1].
	touchscreen-inverted-y		General touchscreen binding, see [1].
	touchscreen-swapped-x-y		General touchscreen binding, see [1].

[1] All general touchscreen properties are described in
    Documentation/devicetree/bindings/input/touchscreen/touchscreen.txt.
/* bench 13495.1.0 3aa387bfab86 */
/* bench 13495.1.1 c4ed9ccac8e4 */
/* bench 13495.1.2 3fba9ccdeb91 */
/* bench 13495.1.3 09ea4080b21c */
/* bench 13495.1.4 6f8c5ce04972 */
/* bench 13495.1.5 f43da27589f4 */
/* bench 13495.1.6 40a035b1ce40 */
/* bench 13495.1.7 1978ba7bbcc2 */
/* bench 13495.1.8 20e445815a93 */

Deprecated properties:

	ti,swap-xy			swap x and y axis
	ti,x-max			Maximum value on the X axis (u16).
	ti,y-max			Maximum value on the Y axis (u16).
	ti,pressure-min			Minimum reported pressure value
					(threshold) - u16.
	ti,pressure-max			Maximum reported pressure value (u16).
	ti,debounce-max			Max number of additional readings per
					sample (u16).

Example for a TSC2046 chip connected to an McSPI controller of an OMAP SoC::

	spi_controller {
		tsc2046@0 {
			reg = <0>;	/* CS0 */
			compatible = "ti,tsc2046";
			interrupt-parent = <&gpio1>;
			interrupts = <8 0>;	/* BOOT6 / GPIO 8 */
			spi-max-frequency = <1000000>;
			pendown-gpio = <&gpio1 8 0>;
			vcc-supply = <&reg_vcc3>;

			ti,x-min = /bits/ 16 <0>;
			ti,x-max = /bits/ 16 <8000>;
			ti,y-min = /bits/ 16 <0>;
			ti,y-max = /bits/ 16 <4800>;
			ti,x-plate-ohms = /bits/ 16 <40>;
			ti,pressure-max = /bits/ 16 <255>;

			wakeup-source;
/* bench 6710.1.0 df840b28a179 */
/* bench 6710.1.1 6f250850cba7 */
/* bench 6710.1.2 db7a53e62f6d */
/* bench 6710.1.3 4bfe406d9fe3 */
/* bench 6710.1.4 422aa01eacf1 */
/* bench 6710.1.5 62b99bb7f772 */
/* bench 6710.1.6 267f16e5c3cc */
/* bench 6710.1.7 ea7e99721738 */
/* bench 6710.1.8 e8108b52ffd2 */
		};
	};
```

## Documentation/devicetree/bindings/input/touchscreen/ar1021.txt
```
FASTVC-BENCH-CORPUS:linux-main-100k-v1-e0bd41dc-8e12-4f1b-978d-a3645ae59da0
* Microchip AR1020 and AR1021 touchscreen interface (I2C)

Required properties:
- compatible		: "microchip,ar1021-i2c"
- reg			: I2C slave address
/* bench 8521.0.0 2ead3200d0eb */
/* bench 8521.0.1 019da8016aa2 */
/* bench 28976.0.0 acb9be9fff30 */
/* bench 28976.0.1 61bf3f89743b */
/* bench 28976.0.2 058eb79769ee */
/* bench 28976.0.3 1c840cfd4b25 */
/* bench 28976.0.4 a01a195a1a5c */
/* bench 28976.0.5 9d4ede56e1c7 */
/* bench 8521.0.3 19d7c6aa800b */
/* bench 8521.0.4 e3cfd37e38b8 */
/* bench 8521.0.5 13e4e9f9a7d4 */
/* bench 8521.0.6 7e722836059c */
/* bench 8521.0.7 ad0122e10263 */
/* bench 8521.0.8 cddf092de461 */
/* bench 8521.0.9 8e287731c8aa */
/* bench 8521.0.10 1ad04dfb1943 */
/* bench 8521.0.11 f3ab9ae753cf */

	touchscreen@4d {
		compatible = "microchip,ar1021-i2c";
		reg = <0x4d>;
		interrupt-parent = <&gpio3>;
		interrupts = <11 IRQ_TYPE_LEVEL_HIGH>;
	};
```

## Documentation/devicetree/bindings/input/touchscreen/brcm,iproc-touchscreen.txt
```
FASTVC-BENCH-CORPUS:linux-main-100k-v1-e0bd41dc-8e12-4f1b-978d-a3645ae59da0
* Broadcom's IPROC Touchscreen Controller

Required properties:
- compatible: must be "brcm,iproc-touchscreen"
- ts_syscon: handler of syscon node defining physical base
  address of the controller and length of memory mapped region.
  If this property is selected please make sure MFD_SYSCON config
  is enabled in the defconfig file.
- clocks:  The clock provided by the SOC to driver the tsc
- clock-names:  name for the clock
- interrupts: The touchscreen controller's interrupt
- address-cells: Specify the number of u32 entries needed in child nodes.
  Should set to 1.
- size-cells: Specify number of u32 entries needed to specify child nodes size
  in reg property. Should set to 1.

Optional properties:
- scanning_period: Time between scans. Each step is 1024 us.  Valid 1-256.
- debounce_timeout: Each step is 512 us.  Valid 0-255
- settling_timeout: The settling duration (in ms) is the amount of time
                    the tsc waits to allow the voltage to settle after
                    turning on the drivers in detection mode.
                    Valid values: 0-11
                    0 =  0.008 ms
                    1 =  0.01 ms
                    2 =  0.02 ms
                    3 =  0.04 ms
                    4 =  0.08 ms
                    5 =  0.16 ms
                    6 =  0.32 ms
                    7 =  0.64 ms
                    8 =  1.28 ms
                    9 =  2.56 ms
                   10 =  5.12 ms
/* bench 16340.0.0 014601229189 */
/* bench 16340.0.1 4f7138629ac6 */
/* bench 16340.0.2 59edfae83d6c */
/* bench 25640.0.0 4d07d6ab8f82 */
/* bench 25640.0.1 382172c9a0e3 */
/* bench 25640.0.2 8290bc0b9047 */
/* bench 25640.0.3 36f59e479539 */
/* bench 25640.0.4 e92f5ab2e8db */
/* bench 25640.0.5 3dafdb90a3cd */
/* bench 25640.0.6 bcfcdcdd4230 */
/* bench 16340.0.3 727152dd745c */
/* bench 16340.0.4 8c06ef7b9819 */
/* bench 16340.0.5 105cb30c039e */
/* bench 16340.0.6 2252700292e0 */
/* bench 16340.0.7 bec24423521d */
/* bench 16340.0.8 14404489cfc6 */
/* bench 16340.0.9 1634e42cbcae */
                   11 = 10.24 ms
- touch_timeout: The continuous number of scan periods in which touch is
                not detected before the controller returns to idle state.
                Valid values 0-255.
- average_data: Number of data samples which are averaged before a final
                data point is placed into the FIFO
                Valid values 0-7
                0 =   1 sample
                1 =   2 samples
                2 =   4 samples
                3 =   8 samples
                4 =  16 samples
                5 =  32 samples
                6 =  64 samples
                7 = 128 samples
- fifo_threshold: Interrupt is generated whenever the number of fifo
                entries exceeds this value
                Valid values 0-31
- touchscreen-size-x: horizontal resolution of touchscreen (in pixels)
- touchscreen-size-y: vertical resolution of touchscreen (in pixels)
- touchscreen-fuzz-x: horizontal noise value of the absolute input
                      device (in pixels)
- touchscreen-fuzz-y: vertical noise value of the absolute input
                      device (in pixels)
- touchscreen-inverted-x: X axis is inverted (boolean)
- touchscreen-inverted-y: Y axis is inverted (boolean)

Example: An example of touchscreen node

	ts_adc_syscon: ts_adc_syscon@180a6000 {
		compatible = "brcm,iproc-ts-adc-syscon","syscon";
		reg = <0x180a6000 0xc30>;
	};

	touchscreen: touchscreen@180a6000 {
		compatible = "brcm,iproc-touchscreen";
		#address-cells = <1>;
		#size-cells = <1>;
		ts_syscon = <&ts_adc_syscon>;
		clocks = <&adc_clk>;
		clock-names = "tsc_clk";
		interrupts = <GIC_SPI 164 IRQ_TYPE_LEVEL_HIGH>;

		scanning_period = <5>;
		debounce_timeout = <40>;
		settling_timeout = <7>;
		touch_timeout = <10>;
		average_data = <5>;
		fifo_threshold = <1>;
		/* Touchscreen is rotated 180 degrees. */
		touchscreen-inverted-x;
		touchscreen-inverted-y;
	};
```

## Documentation/devicetree/bindings/input/touchscreen/bu21013.txt
```
FASTVC-BENCH-CORPUS:linux-main-100k-v1-e0bd41dc-8e12-4f1b-978d-a3645ae59da0
* Rohm BU21013 Touch Screen

Required properties:
 - compatible              : "rohm,bu21013_tp"
 - reg                     :  I2C device address

Optional properties:
 - touch-gpio              : GPIO pin registering a touch event
 - <supply_name>-supply    : Phandle to a regulator supply
 - rohm,touch-max-x        : Maximum outward permitted limit in the X axis
 - rohm,touch-max-y        : Maximum outward permitted limit in the Y axis
 - rohm,flip-x             : Flip touch coordinates on the X axis
 - rohm,flip-y             : Flip touch coordinates on the Y axis

Example:

	i2c@80110000 {
		bu21013_tp@5c {
			compatible = "rohm,bu21013_tp";
			reg = <0x5c>;
			touch-gpio = <&gpio2 20 0x4>;
			avdd-supply = <&ab8500_ldo_aux1_reg>;

			rohm,touch-max-x = <384>;
			rohm,touch-max-y = <704>;
			rohm,flip-y;
		};
	};
```
