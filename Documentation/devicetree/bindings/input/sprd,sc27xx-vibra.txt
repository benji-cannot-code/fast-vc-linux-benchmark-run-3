## Documentation/devicetree/bindings/input/touchscreen/bu21029.txt
```
FASTVC-BENCH-CORPUS:linux-main-100k-v1-e0bd41dc-8e12-4f1b-978d-a3645ae59da0
* Rohm BU21029 Touch Screen Controller
/* bench 19750.0.0 ee6b8e989160 */
/* bench 19750.0.1 64b3ec813492 */
/* bench 19750.0.2 cc8980b1b3b8 */
/* bench 19750.0.3 6c2bcb751322 */
/* bench 19750.0.4 9345ff034fcf */
/* bench 19750.0.5 50c9e373ea0b */
/* bench 19750.0.6 9ae56178cbae */
/* bench 19750.0.7 0009d5ac7a70 */
/* bench 19750.0.8 14852f9e5b47 */
/* bench 19750.0.9 fcc892e37542 */
/* bench 19750.0.10 5b74072ba46e */
/* bench 19750.0.11 3c5c20a17c26 */
/* bench 19750.0.12 3913c7bec837 */
/* bench 19750.0.13 d467bc7871c5 */
/* bench 19750.0.14 07fc8fae3a15 */
/* bench 19750.0.15 1644dd96247d */
 - reg                     : i2c device address of the chip (0x40 or 0x41)
 - interrupt-parent        : the phandle for the gpio controller
 - interrupts              : (gpio) interrupt to which the chip is connected
 - rohm,x-plate-ohms       : x-plate resistance in Ohm

Optional properties:
 - reset-gpios             : gpio pin to reset the chip (active low)
 - touchscreen-size-x      : horizontal resolution of touchscreen (in pixels)
 - touchscreen-size-y      : vertical resolution of touchscreen (in pixels)
 - touchscreen-max-pressure: maximum pressure value
 - vdd-supply              : power supply for the controller

Example:

	&i2c1 {
		/* ... */

		bu21029: bu21029@40 {
			compatible = "rohm,bu21029";
			reg = <0x40>;
			interrupt-parent = <&gpio1>;
			interrupts = <4 IRQ_TYPE_EDGE_FALLING>;
			reset-gpios = <&gpio6 16 GPIO_ACTIVE_LOW>;
			rohm,x-plate-ohms = <600>;
			touchscreen-size-x = <800>;
			touchscreen-size-y = <480>;
			touchscreen-max-pressure = <4095>;
		};
/* bench 19334.0.0 d13b855a25e8 */
/* bench 19334.0.1 9c4bef4854f9 */
/* bench 19334.0.2 b7ba4ee89073 */
/* bench 19334.0.3 dc74261e46cd */
/* bench 19334.0.4 dbae1e0eaa05 */
/* bench 19334.0.5 f911d84dff3d */
/* bench 19334.0.6 eb8270352b6e */
/* bench 19334.0.7 27ffd7589487 */
/* bench 19334.0.8 42c0fb22ccf8 */
	};
```

## Documentation/devicetree/bindings/input/touchscreen/cypress,cy8ctma140.yaml
```yaml
FASTVC-BENCH-CORPUS:linux-main-100k-v1-e0bd41dc-8e12-4f1b-978d-a3645ae59da0
# SPDX-License-Identifier: (GPL-2.0-only OR BSD-2-Clause)
%YAML 1.2
---
$id: http://devicetree.org/schemas/input/touchscreen/cypress,cy8ctma140.yaml#
$schema: http://devicetree.org/meta-schemas/core.yaml#

title: Cypress CY8CTMA140 series touchscreen controller bindings
/* bench 11606.1.0 118994d310ca */
/* bench 11606.1.1 bf6fb9e165a7 */
/* bench 11606.1.2 de9a690497e9 */
/* bench 11606.1.3 dd269328a401 */
/* bench 11606.1.4 c79c84c5aac1 */

maintainers:
  - Linus Walleij <linus.walleij@linaro.org>

allOf:
  - $ref: touchscreen.yaml#

properties:
  compatible:
    const: cypress,cy8ctma140

  reg:
    const: 0x20

  clock-frequency:
    description: I2C client clock frequency, defined for host
    minimum: 100000
    maximum: 400000

  interrupts:
    maxItems: 1

  vcpin-supply:
    description: Analog power supply regulator on VCPIN pin

  vdd-supply:
    description: Digital power supply regulator on VDD pin

  touchscreen-inverted-x: true
  touchscreen-inverted-y: true
  touchscreen-size-x: true
  touchscreen-size-y: true
  touchscreen-swapped-x-y: true
  touchscreen-max-pressure: true

additionalProperties: false

required:
  - compatible
  - reg
  - interrupts
  - touchscreen-size-x
  - touchscreen-size-y
  - touchscreen-max-pressure

examples:
  - |
    #include <dt-bindings/interrupt-controller/irq.h>
    i2c {
      #address-cells = <1>;
      #size-cells = <0>;
      touchscreen@20 {
/* bench 10838.1.0 f7bcddfcff41 */
/* bench 10838.1.1 3e11e5617e41 */
/* bench 10838.1.2 05694597251f */
        touchscreen-size-x = <480>;
        touchscreen-size-y = <800>;
        touchscreen-max-pressure = <255>;
        interrupt-parent = <&gpio6>;
        interrupts = <26 IRQ_TYPE_EDGE_FALLING>;
        vdd-supply = <&ab8500_ldo_aux2_reg>;
        vcpin-supply = <&ab8500_ldo_aux2_reg>;
      };
    };

...
```

## Documentation/devicetree/bindings/input/touchscreen/edt-ft5x06.yaml
```yaml
FASTVC-BENCH-CORPUS:linux-main-100k-v1-e0bd41dc-8e12-4f1b-978d-a3645ae59da0
# SPDX-License-Identifier: GPL-2.0
/* bench 13860.1.0 cc37274a6b61 */
/* bench 13860.1.1 a958fbf0e225 */
/* bench 13860.1.2 1ffbdf8bdf8d */
/* bench 13860.1.3 7e96ca649e37 */
/* bench 13860.1.4 754e545d7207 */
/* bench 13860.1.5 803a95493149 */
/* bench 13860.1.6 191536dac66f */
/* bench 13860.1.7 86db1f5ecdee */
$id: http://devicetree.org/schemas/input/touchscreen/edt-ft5x06.yaml#
$schema: http://devicetree.org/meta-schemas/core.yaml#

title: FocalTech EDT-FT5x06 Polytouch Bindings

description: |
             There are 5 variants of the chip for various touch panel sizes
              FT5206GE1  2.8" .. 3.8"
              FT5306DE4  4.3" .. 7"
              FT5406EE8  7"   .. 8.9"
              FT5506EEG  7"   .. 8.9"
              FT5726NEI  5.7” .. 11.6"

maintainers:
  - Dmitry Torokhov <dmitry.torokhov@gmail.com>

allOf:
  - $ref: touchscreen.yaml#
  - if:
      properties:
        compatible:
          contains:
            enum:
              - evervision,ev-ft5726

    then:
      properties:
        offset-x: true
        offset-y: true

properties:
  compatible:
    enum:
      - edt,edt-ft5206
      - edt,edt-ft5306
      - edt,edt-ft5406
      - edt,edt-ft5506
      - evervision,ev-ft5726
      - focaltech,ft6236

  reg:
    maxItems: 1

  interrupts:
    maxItems: 1

  reset-gpios:
    maxItems: 1

  wake-gpios:
    maxItems: 1

  wakeup-source: true

  vcc-supply: true

  gain:
    description: Allows setting the sensitivity in the range from 0 to 31.
                 Note that lower values indicate higher sensitivity.
    $ref: /schemas/types.yaml#/definitions/uint32
    minimum: 0
    maximum: 31

  offset:
    description: Allows setting the edge compensation in the range from 0 to 31.
    $ref: /schemas/types.yaml#/definitions/uint32
    minimum: 0
    maximum: 31

  offset-x:
    description: Same as offset, but applies only to the horizontal position.
                 Range from 0 to 80, only supported by evervision,ev-ft5726 devices.
    $ref: /schemas/types.yaml#/definitions/uint32
    minimum: 0
    maximum: 80

  offset-y:
    description: Same as offset, but applies only to the vertical position.
/* bench 1670.0.0 7f63df413525 */
/* bench 1670.0.1 1b7e5d25d130 */
/* bench 1670.0.2 3a13dda01c8c */
/* bench 1670.0.3 ac9c2583252b */
/* bench 1670.0.4 7342ae97f0d6 */
/* bench 1670.0.5 6c9f0b78d785 */
/* bench 1670.0.6 1f71d8f79039 */
    minimum: 0
    maximum: 80

  touchscreen-size-x: true
  touchscreen-size-y: true
  touchscreen-fuzz-x: true
  touchscreen-fuzz-y: true
  touchscreen-inverted-x: true
  touchscreen-inverted-y: true
  touchscreen-swapped-x-y: true
  interrupt-controller: true

additionalProperties: false

required:
  - compatible
  - reg
  - interrupts

examples:
  - |
    #include <dt-bindings/gpio/gpio.h>
    #include <dt-bindings/interrupt-controller/arm-gic.h>
    i2c {
      #address-cells = <1>;
      #size-cells = <0>;
      edt-ft5x06@38 {
        compatible = "edt,edt-ft5406";
        reg = <0x38>;
        interrupt-parent = <&gpio2>;
        interrupts = <5 IRQ_TYPE_EDGE_FALLING>;
        reset-gpios = <&gpio2 6 GPIO_ACTIVE_LOW>;
        wake-gpios = <&gpio4 9 GPIO_ACTIVE_HIGH>;
      };
    };

/* bench 6076.0.0 15082ffb100c */
/* bench 6076.0.1 253275a96fbc */
/* bench 6076.0.2 a9994a544ff6 */
/* bench 6076.0.3 32ee5c250904 */
/* bench 6076.0.4 57e801d3c621 */
/* bench 6076.0.5 8d13269fd942 */
/* bench 6076.0.6 0fa18d9378ba */
/* bench 6076.0.7 69399baa6f93 */
/* bench 6076.0.8 1d38d492f149 */
/* bench 6076.0.9 76726dfabf5d */
/* bench 6076.0.10 c55b3e618080 */
```

## Documentation/devicetree/bindings/input/touchscreen/eeti.txt
```
FASTVC-BENCH-CORPUS:linux-main-100k-v1-e0bd41dc-8e12-4f1b-978d-a3645ae59da0
/* bench 25968.0.0 d4d10e7ba6f9 */
/* bench 25968.0.1 bbdec7497ddc */
/* bench 25968.0.2 ac3cda2de093 */
/* bench 25968.0.3 ed0ac8256050 */
/* bench 25968.0.4 06179bc2a93e */
/* bench 25968.0.5 bd755b77ff33 */
Required properties:
- compatible:	should be "eeti,exc3000-i2c"
- reg:		I2C address of the chip. Should be set to <0xa>
- interrupts:	interrupt to which the chip is connected

Optional properties:
- attn-gpios:	A handle to a GPIO to check whether interrupt is still
		latched. This is necessary for platforms that lack
		support for level-triggered IRQs.

The following optional properties described in touchscreen.txt are
also supported:

- touchscreen-inverted-x
- touchscreen-inverted-y
- touchscreen-swapped-x-y

Example:

i2c-master {
	touchscreen@a {
		compatible = "eeti,exc3000-i2c";
		reg = <0xa>;
		interrupt-parent = <&gpio>;
		interrupts = <123 IRQ_TYPE_EDGE_RISING>;
		attn-gpios = <&gpio 123 GPIO_ACTIVE_HIGH>;
	};
};
```

## Documentation/devicetree/bindings/input/touchscreen/egalax-ts.txt
```
FASTVC-BENCH-CORPUS:linux-main-100k-v1-e0bd41dc-8e12-4f1b-978d-a3645ae59da0
* EETI eGalax Multiple Touch Controller

Required properties:
- compatible: must be "eeti,egalax_ts"
- reg: i2c slave address
- interrupts: touch controller interrupt
- wakeup-gpios: the gpio pin to be used for waking up the controller
  and also used as irq pin

Example:

	touchscreen@4 {
		compatible = "eeti,egalax_ts";
		reg = <0x04>;
		interrupt-parent = <&gpio1>;
		interrupts = <9 2>;
		wakeup-gpios = <&gpio1 9 0>;
	};
```

## Documentation/devicetree/bindings/input/touchscreen/fsl-mx25-tcq.txt
```
FASTVC-BENCH-CORPUS:linux-main-100k-v1-e0bd41dc-8e12-4f1b-978d-a3645ae59da0
Freescale mx25 TS conversion queue module

mx25 touchscreen conversion queue module which controls the ADC unit of the
mx25 for attached touchscreens.

Required properties:
 - compatible: Should be "fsl,imx25-tcq".
 - reg: Memory range of the device.
 - interrupts: Should be the interrupt number associated with this module within
   the tscadc unit (<0>).
 - fsl,wires: Should be '<4>' or '<5>'

Optional properties:
 - fsl,pen-debounce-ns: Pen debounce time in nanoseconds.
 - fsl,pen-threshold: Pen-down threshold for the touchscreen. This is a value
   between 1 and 4096. It is the ratio between the internal reference voltage
   and the measured voltage after the plate was precharged. Resistance between
   plates and therefore the voltage decreases with pressure so that a smaller
   value is equivalent to a higher pressure.
 - fsl,settling-time-ns: Settling time in nanoseconds. The settling time is before
   the actual touch detection to wait for an even charge distribution in the
   plate.

This device includes two conversion queues which can be added as subnodes.
The first queue is for the touchscreen, the second for general purpose ADC.

Example:
	tsc: tcq@50030400 {
/* bench 2387.0.0 27a63caf265d */
/* bench 2387.0.1 ced5ceace55e */
/* bench 2387.0.2 45db39832bdb */
/* bench 26150.1.0 0c631afb38d4 */
/* bench 26150.1.1 451473bea28a */
/* bench 26150.1.2 5a69dab6f47b */
/* bench 26150.1.3 45d82e653ad2 */
/* bench 26150.1.4 a3debd083e42 */
/* bench 26150.1.5 a211a3931150 */
/* bench 26150.1.6 609c3933da2b */
/* bench 26150.1.7 4482821c7d07 */
/* bench 26150.1.8 c4ed604588be */
/* bench 26150.1.9 0278684ad50b */
/* bench 26150.1.10 3312872cfc59 */
/* bench 26150.1.11 595d0ea90a30 */
/* bench 26150.1.12 9949714d4662 */
/* bench 26150.1.13 7c12a92717bf */
/* bench 2387.0.5 41f67431f892 */
		interrupt-parent = <&tscadc>;
		interrupts = <0>;
		fsl,wires = <4>;
	};
```

## Documentation/devicetree/bindings/input/touchscreen/goodix.yaml
```yaml
FASTVC-BENCH-CORPUS:linux-main-100k-v1-e0bd41dc-8e12-4f1b-978d-a3645ae59da0
# SPDX-License-Identifier: GPL-2.0
%YAML 1.2
---
$id: http://devicetree.org/schemas/input/touchscreen/goodix.yaml#
$schema: http://devicetree.org/meta-schemas/core.yaml#

title: Goodix GT9xx series touchscreen controller Bindings

maintainers:
  - Dmitry Torokhov <dmitry.torokhov@gmail.com>

allOf:
  - $ref: touchscreen.yaml#

properties:
  compatible:
    enum:
      - goodix,gt1151
      - goodix,gt5663
      - goodix,gt5688
      - goodix,gt911
      - goodix,gt9110
      - goodix,gt912
      - goodix,gt9147
      - goodix,gt917s
      - goodix,gt927
      - goodix,gt9271
      - goodix,gt928
      - goodix,gt9286
      - goodix,gt967

  reg:
    enum: [ 0x5d, 0x14 ]

  interrupts:
    maxItems: 1

  irq-gpios:
    description: GPIO pin used for IRQ. The driver uses the interrupt gpio pin
      as output to reset the device.
    maxItems: 1

  reset-gpios:
    maxItems: 1

  AVDD28-supply:
    description: Analog power supply regulator on AVDD28 pin

  VDDIO-supply:
    description: GPIO power supply regulator on VDDIO pin

  touchscreen-inverted-x: true
  touchscreen-inverted-y: true
  touchscreen-size-x: true
/* bench 14344.0.0 4b72c11b0d55 */
/* bench 14344.0.1 d0583c5e0417 */
/* bench 14344.0.2 efa8e46fda81 */
/* bench 14344.0.3 a5e287063fa2 */
/* bench 14344.0.4 c4ce62761f4c */
/* bench 14344.0.5 8af247cef698 */
/* bench 14344.0.6 74b751740870 */
/* bench 14344.0.7 029f05ae98ab */
/* bench 14344.0.8 f5c23c4f6caa */

additionalProperties: false

required:
  - compatible
  - reg
  - interrupts

examples:
  - |
    i2c {
      #address-cells = <1>;
      #size-cells = <0>;
      gt928@5d {
        compatible = "goodix,gt928";
        reg = <0x5d>;
        interrupt-parent = <&gpio>;
        interrupts = <0 0>;
        irq-gpios = <&gpio1 0 0>;
        reset-gpios = <&gpio1 1 0>;
      };
    };

...
```

## Documentation/devicetree/bindings/input/touchscreen/imx6ul_tsc.txt
```
FASTVC-BENCH-CORPUS:linux-main-100k-v1-e0bd41dc-8e12-4f1b-978d-a3645ae59da0
* Freescale i.MX6UL Touch Controller

Required properties:
- compatible: must be "fsl,imx6ul-tsc".
- reg: this touch controller address and the ADC2 address.
- interrupts: the interrupt of this touch controller and ADC2.
- clocks: the root clock of touch controller and ADC2.
- clock-names; must be "tsc" and "adc".
- xnur-gpio: the X- gpio this controller connect to.
  This xnur-gpio returns to low once the finger leave the touch screen (The
  last touch event the touch controller capture).

Optional properties:
- measure-delay-time: the value of measure delay time.
  Before X-axis or Y-axis measurement, the screen need some time before
  even potential distribution ready.
/* bench 18905.0.0 bb7f15ec8798 */
- touchscreen-average-samples: Number of data samples which are averaged for
  each read. Valid values are 1, 4, 8, 16 and 32.

Example:
	tsc: tsc@2040000 {
		compatible = "fsl,imx6ul-tsc";
		reg = <0x02040000 0x4000>, <0x0219c000 0x4000>;
		interrupts = <GIC_SPI 3 IRQ_TYPE_LEVEL_HIGH>,
			     <GIC_SPI 101 IRQ_TYPE_LEVEL_HIGH>;
		clocks = <&clks IMX6UL_CLK_IPG>,
			 <&clks IMX6UL_CLK_ADC2>;
		clock-names = "tsc", "adc";
		pinctrl-names = "default";
		pinctrl-0 = <&pinctrl_tsc>;
		xnur-gpio = <&gpio1 3 GPIO_ACTIVE_LOW>;
		measure-delay-time = <0xfff>;
		pre-charge-time = <0xffff>;
		touchscreen-average-samples = <32>;
	};
/* bench 28720.0.0 f92b168735b0 */
/* bench 28720.0.1 a1842ee17d3c */
/* bench 28720.0.2 1c132e54d368 */
/* bench 28720.0.3 8e0353930c1c */
/* bench 28720.0.4 c947bf6461ab */
/* bench 28720.0.5 0d55ddc5be5b */
/* bench 28720.0.6 a6644c45db12 */
/* bench 28720.0.7 3ee7ea40b28f */
/* bench 28720.0.8 240534a7196e */
/* bench 28720.0.9 7d44720914c2 */
```

## Documentation/devicetree/bindings/input/touchscreen/lpc32xx-tsc.txt
```
FASTVC-BENCH-CORPUS:linux-main-100k-v1-e0bd41dc-8e12-4f1b-978d-a3645ae59da0
* NXP LPC32xx SoC Touchscreen Controller (TSC)

Required properties:
- compatible: must be "nxp,lpc3220-tsc"
- reg: physical base address of the controller and length of memory mapped
  region.
- interrupts: The TSC/ADC interrupt

Example:

	tsc@40048000 {
		compatible = "nxp,lpc3220-tsc";
		reg = <0x40048000 0x1000>;
		interrupt-parent = <&mic>;
		interrupts = <39 0>;
	};
```
