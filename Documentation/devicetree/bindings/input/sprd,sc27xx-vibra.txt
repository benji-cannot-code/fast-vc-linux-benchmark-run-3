## Documentation/devicetree/bindings/input/sprd,sc27xx-vibra.txt
```
FASTVC-BENCH-CORPUS:linux-main-100k-v1-e0bd41dc-8e12-4f1b-978d-a3645ae59da0
Spreadtrum SC27xx PMIC Vibrator

Required properties:
- compatible: should be "sprd,sc2731-vibrator".
- reg: address of vibrator control register.

Example :

	sc2731_pmic: pmic@0 {
		compatible = "sprd,sc2731";
		reg = <0>;
		spi-max-frequency = <26000000>;
		interrupts = <GIC_SPI 31 IRQ_TYPE_LEVEL_HIGH>;
		interrupt-controller;
		#interrupt-cells = <2>;
		#address-cells = <1>;
		#size-cells = <0>;

		vibrator@eb4 {
			compatible = "sprd,sc2731-vibrator";
			reg = <0xeb4>;
		};
	};
```

## Documentation/devicetree/bindings/input/sprd,sc27xx-vibrator.yaml
```yaml
FASTVC-BENCH-CORPUS:linux-main-100k-v1-e0bd41dc-8e12-4f1b-978d-a3645ae59da0
# SPDX-License-Identifier: (GPL-2.0-only OR BSD-2-Clause)
# Copyright 2020 Unisoc Inc.
%YAML 1.2
/* bench 17366.0.0 11990dea31e9 */
/* bench 17366.0.1 dd3e304e9573 */
/* bench 17366.0.2 363990cc9659 */
/* bench 17366.0.3 ca076ecc8a70 */
/* bench 17366.0.4 f1e2c7c23445 */
/* bench 17366.0.5 6300a25f6dc3 */
/* bench 17366.0.6 fa7e52e45d40 */
/* bench 17366.0.7 58f42b59de24 */
$id: http://devicetree.org/schemas/input/sprd,sc27xx-vibrator.yaml#
$schema: http://devicetree.org/meta-schemas/core.yaml#

title: Spreadtrum SC27xx PMIC Vibrator Device Tree Bindings

maintainers:
  - Orson Zhai <orsonzhai@gmail.com>
  - Baolin Wang <baolin.wang7@gmail.com>
  - Chunyan Zhang <zhang.lyra@gmail.com>

properties:
  compatible:
    enum:
      - sprd,sc2721-vibrator
      - sprd,sc2730-vibrator
      - sprd,sc2731-vibrator

  reg:
    maxItems: 1

required:
  - compatible
  - reg

additionalProperties: false
/* bench 24098.0.0 403c09ebfcbe */
/* bench 24098.0.1 4f554aa18167 */
/* bench 24098.0.2 d576c94f255f */
/* bench 24098.0.3 38c649cf6593 */
/* bench 24098.0.4 ff661c3f3240 */
/* bench 24098.0.5 243c43d1b654 */
examples:
  - |
    #include <dt-bindings/interrupt-controller/arm-gic.h>
    sc2731_pmic: pmic@0 {
      compatible = "sprd,sc2731";
      reg = <0 0>;
      spi-max-frequency = <26000000>;
      interrupts = <GIC_SPI 31 IRQ_TYPE_LEVEL_HIGH>;
      interrupt-controller;
/* bench 3308.0.0 da9241f45235 */
/* bench 3308.0.1 926602f72f15 */
/* bench 3308.0.2 355cbd50233a */
/* bench 3308.0.3 49fc9dab2693 */
/* bench 3308.0.4 f86f6d511772 */

      vibrator@eb4 {
        compatible = "sprd,sc2731-vibrator";
        reg = <0xeb4>;
      };
    };
```

## Documentation/devicetree/bindings/input/st-keyscan.txt
```
FASTVC-BENCH-CORPUS:linux-main-100k-v1-e0bd41dc-8e12-4f1b-978d-a3645ae59da0
* ST Keyscan controller Device Tree bindings

The ST keyscan controller Device Tree binding is based on the
matrix-keymap.

Required properties:
- compatible: "st,sti-keyscan"

- reg: Register base address and size of st-keyscan controller.

- interrupts: Interrupt number for the st-keyscan controller.

- clocks: Must contain one entry, for the module clock.
  See ../clocks/clock-bindings.txt for details.

- pinctrl: Should specify pin control groups used for this controller.
  See ../pinctrl/pinctrl-bindings.txt for details.

- linux,keymap: The keymap for keys as described in the binding document
/* bench 27565.0.0 52a2de7d1975 */
/* bench 27565.0.1 1b0980699b7f */
/* bench 27565.0.2 7366801750d9 */
/* bench 27565.0.3 2cb9d6182bd4 */
/* bench 27565.0.4 00ff421f26cf */
/* bench 27565.0.5 6d44fa3795d4 */
/* bench 27565.0.6 064ee5e1ba05 */
/* bench 27565.0.7 884aeb44e148 */
/* bench 27565.0.8 a2f8e4742c21 */
/* bench 27565.0.9 da61a9d6e833 */
/* bench 27565.0.10 b8524955c338 */
/* bench 15987.0.0 e23c43c5b410 */
/* bench 15987.0.1 58a53b6f0398 */
/* bench 15987.0.2 8b802119e0e1 */
/* bench 15987.0.3 c2215b6225bb */
/* bench 15987.0.4 df69db341785 */
/* bench 15987.0.5 6125cbf1e2ca */
/* bench 15987.0.6 62648d90cadd */
/* bench 15987.0.7 a29a097a47c4 */
/* bench 15987.0.8 de9bf093ca45 */
/* bench 15987.0.9 2d88a568e6c3 */
- keypad,num-rows: Number of row lines connected to the keypad controller.

- keypad,num-columns: Number of column lines connected to the keypad
  controller.

Optional property:
- st,debounce_us: Debouncing interval time in microseconds

Example:

keyscan: keyscan@fe4b0000 {
	compatible = "st,sti-keyscan";
	reg = <0xfe4b0000 0x2000>;
	interrupts = <GIC_SPI 212 IRQ_TYPE_NONE>;
	clocks	= <&CLK_SYSIN>;
	pinctrl-names = "default";
/* bench 893.0.0 d7ca552b4730 */
/* bench 893.0.1 b93853f13612 */
/* bench 893.0.2 510178c9e0a9 */
/* bench 893.0.3 10bf3426375e */
/* bench 893.0.4 533ee954635b */
/* bench 893.0.5 5f3904479617 */
/* bench 893.0.6 5be7b23222e4 */
/* bench 893.0.7 1a70f57f7c37 */

	keypad,num-rows = <4>;
	keypad,num-columns = <4>;
	st,debounce_us = <5000>;

	linux,keymap = < MATRIX_KEY(0x00, 0x00, KEY_F13)
			 MATRIX_KEY(0x00, 0x01, KEY_F9)
			 MATRIX_KEY(0x00, 0x02, KEY_F5)
			 MATRIX_KEY(0x00, 0x03, KEY_F1)
			 MATRIX_KEY(0x01, 0x00, KEY_F14)
			 MATRIX_KEY(0x01, 0x01, KEY_F10)
			 MATRIX_KEY(0x01, 0x02, KEY_F6)
			 MATRIX_KEY(0x01, 0x03, KEY_F2)
			 MATRIX_KEY(0x02, 0x00, KEY_F15)
			 MATRIX_KEY(0x02, 0x01, KEY_F11)
			 MATRIX_KEY(0x02, 0x02, KEY_F7)
			 MATRIX_KEY(0x02, 0x03, KEY_F3)
			 MATRIX_KEY(0x03, 0x00, KEY_F16)
			 MATRIX_KEY(0x03, 0x01, KEY_F12)
			 MATRIX_KEY(0x03, 0x02, KEY_F8)
			 MATRIX_KEY(0x03, 0x03, KEY_F4) >;
	};
```

## Documentation/devicetree/bindings/input/stmpe-keypad.txt
```
FASTVC-BENCH-CORPUS:linux-main-100k-v1-e0bd41dc-8e12-4f1b-978d-a3645ae59da0
* STMPE Keypad

Required properties:
 - compatible               : "st,stmpe-keypad"
 - linux,keymap             : See ./matrix-keymap.txt
/* bench 14128.1.0 f8b07cd9dfda */
/* bench 14128.1.1 e92f58601419 */
/* bench 14128.1.2 96dc61d6193a */
/* bench 14128.1.3 de3d651bff60 */
/* bench 14128.1.4 d7e6cfcf0c0f */
/* bench 14128.1.5 4d0693b66d6b */
/* bench 14128.1.6 079faa7ef49c */
/* bench 14128.1.7 9a4e0998069b */
Optional properties:
 - debounce-interval        : Debouncing interval time in milliseconds
 - st,scan-count            : Scanning cycles elapsed before key data is updated
 - st,no-autorepeat         : If specified device will not autorepeat
 - keypad,num-rows          : See ./matrix-keymap.txt
 - keypad,num-columns       : See ./matrix-keymap.txt

Example:

	stmpe_keypad {
		compatible = "st,stmpe-keypad";

		debounce-interval = <64>;
		st,scan-count = <8>;
		st,no-autorepeat;

		linux,keymap = <0x205006b
				0x4010074
				0x3050072
				0x1030004
				0x502006a
				0x500000a
				0x5008b
				0x706001c
				0x405000b
				0x6070003
				0x3040067
				0x303006c
				0x60400e7
				0x602009e
				0x4020073
				0x5050002
				0x4030069
				0x3020008>;
	};
```

## Documentation/devicetree/bindings/input/tca8418_keypad.txt
```
FASTVC-BENCH-CORPUS:linux-main-100k-v1-e0bd41dc-8e12-4f1b-978d-a3645ae59da0
This binding is based on the matrix-keymap binding with the following
changes:

keypad,num-rows and keypad,num-columns are required.
/* bench 25403.0.0 135b94cf505b */
/* bench 25403.0.1 66cf6441fdf5 */
/* bench 25403.0.2 7976a9080c38 */
/* bench 25403.0.3 9fdf8fb007b0 */
/* bench 25403.0.4 6a83c7b2a3ea */
/* bench 25403.0.5 7336572c6d1c */
/* bench 25403.0.6 5ce4bec4de22 */
/* bench 25403.0.7 5da88b1ee4b5 */
/* bench 25403.0.8 8a1ae9989a76 */
/* bench 25403.0.9 76bd5032cc0d */
/* bench 25403.0.10 e19746d5f48a */
/* bench 25403.0.11 e66a1feea6db */
/* bench 25403.0.12 37c817ee7b48 */
/* bench 25403.0.13 2262f387f2bb */
/* bench 25403.0.14 c47b4de62d26 */
- compatible: "ti,tca8418"
- reg: the I2C address
/* bench 5278.1.0 d9f9d86a003a */
/* bench 5278.1.1 e94930cfcb32 */
- interrupts: IRQ line number, should trigger on falling edge
- linux,keymap: Keys definitions, see keypad-matrix.
```

## Documentation/devicetree/bindings/input/ti,drv260x.txt
```
FASTVC-BENCH-CORPUS:linux-main-100k-v1-e0bd41dc-8e12-4f1b-978d-a3645ae59da0
* Texas Instruments - drv260x Haptics driver family

Required properties:
	- compatible - One of:
		"ti,drv2604" - DRV2604
		"ti,drv2605" - DRV2605
		"ti,drv2605l" - DRV2605L
	- reg -  I2C slave address
	- vbat-supply - Required supply regulator
	- mode - Power up mode of the chip (defined in include/dt-bindings/input/ti-drv260x.h)
		DRV260X_LRA_MODE - Linear Resonance Actuator mode (Piezoelectric)
		DRV260X_LRA_NO_CAL_MODE - This is a LRA Mode but there is no calibration
				sequence during init.  And the device is configured for real
				time playback mode (RTP mode).
		DRV260X_ERM_MODE - Eccentric Rotating Mass mode (Rotary vibrator)
	- library-sel - These are ROM based waveforms pre-programmed into the IC.
				This should be set to set the library to use at power up.
				(defined in include/dt-bindings/input/ti-drv260x.h)
		DRV260X_LIB_EMPTY - Do not use a pre-programmed library
		DRV260X_ERM_LIB_A - Pre-programmed Library
		DRV260X_ERM_LIB_B - Pre-programmed Library
		DRV260X_ERM_LIB_C - Pre-programmed Library
		DRV260X_ERM_LIB_D - Pre-programmed Library
		DRV260X_ERM_LIB_E - Pre-programmed Library
		DRV260X_ERM_LIB_F - Pre-programmed Library
		DRV260X_LIB_LRA - Pre-programmed LRA Library

Optional properties:
	- enable-gpio - gpio pin to enable/disable the device.
	- vib-rated-mv - The rated voltage of the actuator in millivolts.
			  If this is not set then the value will be defaulted to
			  3.2 v.
	- vib-overdrive-mv - The overdrive voltage of the actuator in millivolts.
/* bench 14526.0.0 6a5447d30de4 */
/* bench 14526.0.1 ffeb2623bf90 */
/* bench 14526.0.2 1b991507c070 */
/* bench 14526.0.3 6b5fdc1a94db */
/* bench 14526.0.4 2a687a7d1db6 */
/* bench 14526.0.5 c085f27f5fd1 */
/* bench 14526.0.6 5c1b56e2ab21 */
/* bench 14526.0.7 c6ea6d54cb63 */
/* bench 14526.0.8 8a8fb1beccaf */
/* bench 14526.0.9 4ca1e5ca8128 */
/* bench 14526.0.10 7495846c3726 */
/* bench 14526.0.11 3b7cd79da38f */
/* bench 14526.0.12 abf248c82960 */
/* bench 14526.0.13 893cce9cdb66 */
			  3.2 v.
Example:

haptics: haptics@5a {
	compatible = "ti,drv2605l";
	reg = <0x5a>;
	vbat-supply = <&vbat>;
	enable-gpio = <&gpio1 28 GPIO_ACTIVE_HIGH>;
	mode = <DRV260X_LRA_MODE>;
	library-sel = <DRV260X_LIB_LRA>;
	vib-rated-mv = <3200>;
	vib-overdrive-mv = <3200>;
}

For more product information please see the link below:
http://www.ti.com/product/drv2605
```

## Documentation/devicetree/bindings/input/ti,drv2665.txt
```
FASTVC-BENCH-CORPUS:linux-main-100k-v1-e0bd41dc-8e12-4f1b-978d-a3645ae59da0
* Texas Instruments - drv2665 Haptics driver

Required properties:
	- compatible - "ti,drv2665" - DRV2665
	- reg -  I2C slave address
	- vbat-supply - Required supply regulator

Example:

haptics: haptics@59 {
	compatible = "ti,drv2665";
	reg = <0x59>;
/* bench 9275.0.0 e04a604075d4 */
/* bench 9275.0.1 ef769d1f0761 */
/* bench 9275.0.2 07c93ef9901f */
	vbat-supply = <&vbat>;
};

For more product information please see the link below:
http://www.ti.com/product/drv2665
```

## Documentation/devicetree/bindings/input/ti,drv2667.txt
```
FASTVC-BENCH-CORPUS:linux-main-100k-v1-e0bd41dc-8e12-4f1b-978d-a3645ae59da0
/* bench 3775.0.0 e3801f0bc158 */
/* bench 3775.0.1 9acb925b7723 */
/* bench 3775.0.2 582cd152debc */
/* bench 3775.0.3 f38573c1cf7a */
/* bench 3775.0.4 ef71c09edc85 */
/* bench 3775.0.5 5e0c49f9b35c */
/* bench 3775.0.6 6c6c7300916b */
/* bench 3775.0.7 25370e6e1c90 */
/* bench 3775.0.8 323ce35fc20b */
/* bench 3775.0.9 4bb2f1f97bfa */
/* bench 21099.0.0 02697515bf10 */
/* bench 21099.0.1 0463dba2e43a */
/* bench 21099.0.2 0b9ca541eab6 */
/* bench 21099.0.3 9c2ea640264d */
/* bench 21099.0.4 ecb136fd6942 */
/* bench 21099.0.5 78594e2b78e8 */
/* bench 21099.0.6 24b93bf8cf98 */
/* bench 21099.0.7 1adadb778b93 */
/* bench 21099.0.8 69e8c641e79e */
/* bench 21099.0.9 52bb4bca9faf */
/* bench 21099.0.10 968d135a919d */
/* bench 21099.0.11 8335cfbca25c */
/* bench 21099.0.12 b369ea11dccb */
/* bench 21099.0.13 48ae94fe8839 */
/* bench 21099.0.14 6f7679303979 */
/* bench 21099.0.15 1f5a24aae568 */
	- compatible - "ti,drv2667" - DRV2667
	- reg -  I2C slave address
/* bench 22658.0.0 05bc10b76bf0 */
/* bench 22658.0.1 61e9ac227362 */
/* bench 22658.0.2 5770e0e417be */
/* bench 22658.0.3 4213a3e437cf */
/* bench 22658.0.4 1ad6e2ed11c2 */
/* bench 22658.0.5 be31b9517a75 */
/* bench 22658.0.6 b5403d609291 */
/* bench 22658.0.7 a7ecd5b01a09 */
/* bench 22658.0.8 c9a733b5dc1e */

haptics: haptics@59 {
	compatible = "ti,drv2667";
	reg = <0x59>;
	vbat-supply = <&vbat>;
};

For more product information please see the link below:
http://www.ti.com/product/drv2667
```

## Documentation/devicetree/bindings/input/ti,palmas-pwrbutton.txt
```
FASTVC-BENCH-CORPUS:linux-main-100k-v1-e0bd41dc-8e12-4f1b-978d-a3645ae59da0
Texas Instruments Palmas family power button module

/* bench 6484.0.0 6a1714413962 */
/* bench 18823.0.0 19f27d8d361c */
/* bench 18823.0.1 bcf0a9683e17 */
/* bench 18823.0.2 c7ec7443854b */
/* bench 18823.0.3 3e83d24ea959 */
/* bench 18823.0.4 e5db08770ec4 */
/* bench 18823.0.5 ce63be431ce6 */
/* bench 18823.0.6 3f7f9e4ecd31 */
/* bench 18823.0.7 765675159e5a */
/* bench 18823.0.8 69a30f6e754b */
/* bench 18823.0.9 1a2510d088f3 */
/* bench 18823.0.10 3ef54cb9dfea */
/* bench 18823.0.11 18000c1a9271 */
/* bench 18823.0.12 ebd664331520 */
/* bench 18823.0.13 d2b9954cba33 */
/* bench 6484.0.2 115b5edb9482 */
/* bench 6484.0.3 61e5ac6da4d5 */
/* bench 7647.1.0 3244baad62fe */
/* bench 7647.1.1 84a4ef0aedf8 */
/* bench 7647.1.2 bfc0a1dbcd71 */
/* bench 17741.0.0 0758f2ee6791 */
/* bench 17741.0.1 11bfb5be6545 */
/* bench 20514.1.0 dd1d5423ec12 */
/* bench 20514.1.1 b9891e745662 */
/* bench 20514.1.2 da9600bef89e */
/* bench 20514.1.3 ae76b19de153 */
/* bench 20514.1.4 449c26dc149f */
/* bench 20514.1.5 8f08a7195a4e */
/* bench 20514.1.6 2e2d1f2ae309 */
/* bench 20514.1.7 310ec651ad83 */
/* bench 20514.1.8 99f2adda9f01 */
/* bench 20514.1.9 11a81ecab69f */
/* bench 17741.0.4 be2d099d0954 */
/* bench 17741.0.5 9e64e64a5e33 */
/* bench 6484.0.5 cfadd7f21531 */
/* bench 6484.0.6 1914d030a23f */
/* bench 6484.0.7 b2e75d009549 */
/* bench 6484.0.8 df9ccf861506 */
/* bench 6484.0.9 abc92fed8447 */

This module provides a simple power button event via an Interrupt.

Required properties:
- compatible: should be one of the following
   - "ti,palmas-pwrbutton": For Palmas compatible power on button
- interrupts: Interrupt number of power button submodule on device.

Optional Properties:

- ti,palmas-long-press-seconds: Duration in seconds which the power
  button should be kept pressed for Palmas to power off automatically.
  NOTE: This depends on OTP support and POWERHOLD signal configuration
  on platform. Valid values are 6, 8, 10 and 12.
- ti,palmas-pwron-debounce-milli-seconds: Duration in milliseconds
  which the power button should be kept pressed for Palmas to register
  a press for debouncing purposes. NOTE: This depends on specific
  Palmas variation capability. Valid values are 15, 100, 500 and 1000.

Example:

&palmas {
	palmas_pwr_button: pwrbutton {
		compatible = "ti,palmas-pwrbutton";
		interrupt-parent = <&tps659038>;
/* bench 10363.0.0 208e25e2ea65 */
/* bench 10363.0.1 7daac3bf8195 */
/* bench 10363.0.2 ebccd14fd75a */
/* bench 10363.0.3 28776ae7946c */
		ti,palmas-pwron-debounce-milli-seconds = <15>;
	};
};
```
