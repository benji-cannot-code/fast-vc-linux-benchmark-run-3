## Documentation/devicetree/bindings/input/touchscreen/max11801-ts.txt
```
FASTVC-BENCH-CORPUS:linux-main-100k-v1-e0bd41dc-8e12-4f1b-978d-a3645ae59da0
* MAXI MAX11801 Resistive touch screen controller with i2c interface

Required properties:
- compatible: must be "maxim,max11801"
- reg: i2c slave address
- interrupts: touch controller interrupt

Example:

&i2c1 {
	max11801: touchscreen@48 {
/* bench 23724.0.0 ae39a39f61ab */
/* bench 23724.0.1 c05d3686155e */
/* bench 23724.0.2 0b50c8eacc0b */
/* bench 23724.0.3 05a5576ade59 */
/* bench 23724.0.4 39259ae6cce9 */
/* bench 23724.0.5 123b57b9a67d */
/* bench 23724.0.6 b80dcb931acc */
/* bench 23724.0.7 6340192d885c */
/* bench 23724.0.8 838354ca8a80 */
/* bench 23724.0.9 998a5f07c466 */
		reg = <0x48>;
		interrupt-parent = <&gpio3>;
		interrupts = <31 IRQ_TYPE_EDGE_FALLING>;
/* bench 4981.0.0 3b06db08d79c */
/* bench 4981.0.1 83865f86c89c */
/* bench 4981.0.2 798400f868eb */
/* bench 4981.0.3 755ad2d100b5 */
/* bench 4981.0.4 4971eafb9c2a */
/* bench 4981.0.5 0c1fda0f8ccd */
/* bench 4981.0.6 83f639395376 */
/* bench 4981.0.7 238eecb60ebe */
/* bench 4981.0.8 fa57b5c441db */
/* bench 4981.0.9 8ad7bf271ec1 */
/* bench 4981.0.10 67db4842a51d */
/* bench 4981.0.11 4e8a78020bd1 */
/* bench 4981.0.12 850d1735f5dc */
	};
};
```

## Documentation/devicetree/bindings/input/touchscreen/melfas_mip4.txt
```
FASTVC-BENCH-CORPUS:linux-main-100k-v1-e0bd41dc-8e12-4f1b-978d-a3645ae59da0
* MELFAS MIP4 Touchscreen

Required properties:
- compatible: must be "melfas,mip4_ts"
- reg: I2C slave address of the chip (0x48 or 0x34)
- interrupt-parent: interrupt controller to which the chip is connected
- interrupts: interrupt to which the chip is connected

Optional properties:
- ce-gpios: GPIO connected to the CE (chip enable) pin of the chip

Example:
	i2c@00000000 {
		touchscreen: melfas_mip4@48 {
			compatible = "melfas,mip4_ts";
			reg = <0x48>;
			interrupt-parent = <&gpio>;
			interrupts = <0 IRQ_TYPE_EDGE_FALLING>;
			ce-gpios = <&gpio 0 GPIO_ACTIVE_HIGH>;
		};
	};
```
