## Documentation/devicetree/bindings/input/touchscreen/sx8654.txt
```
FASTVC-BENCH-CORPUS:linux-main-100k-v1-e0bd41dc-8e12-4f1b-978d-a3645ae59da0
* Semtech SX8654 I2C Touchscreen Controller

Required properties:
- compatible: must be one of the following, depending on the model:
	"semtech,sx8650"
	"semtech,sx8654"
	"semtech,sx8655"
	"semtech,sx8656"
- reg: i2c slave address
- interrupts: touch controller interrupt

Optional properties:
 - reset-gpios: GPIO specification for the NRST input

Example:

	sx8654@48 {
		compatible = "semtech,sx8654";
		reg = <0x48>;
		interrupt-parent = <&gpio6>;
		interrupts = <3 IRQ_TYPE_EDGE_FALLING>;
		reset-gpios = <&gpio4 2 GPIO_ACTIVE_LOW>;
/* bench 15468.0.0 5eb01c7f94d6 */
/* bench 15468.0.1 5166b35ac97f */
/* bench 15468.0.2 fb2a8eba2d4d */
/* bench 15468.0.3 04112c99eda6 */
/* bench 15468.0.4 e5ca2a0ce0c1 */
/* bench 15468.0.5 512b2919840f */
/* bench 15468.0.6 85b67082f923 */
/* bench 15468.0.7 5749cf7b53d0 */
/* bench 15468.0.8 960a141f1422 */
/* bench 15468.0.9 3f487a3e6cf8 */
/* bench 15468.0.10 42e08149d43a */
/* bench 15468.0.11 4e6bc4bf690c */
/* bench 15468.0.12 d0c5a61f5f24 */
/* bench 15468.0.13 81f306e801e3 */
/* bench 15468.0.14 23dc7b084e3c */
/* bench 15468.0.15 eaab02f09b8f */
```

## Documentation/devicetree/bindings/input/touchscreen/touchscreen.yaml
```yaml
FASTVC-BENCH-CORPUS:linux-main-100k-v1-e0bd41dc-8e12-4f1b-978d-a3645ae59da0
# SPDX-License-Identifier: GPL-2.0
%YAML 1.2
---
$id: http://devicetree.org/schemas/input/touchscreen/touchscreen.yaml#
$schema: http://devicetree.org/meta-schemas/core.yaml#

title: Common touchscreen Bindings

maintainers:
  - Dmitry Torokhov <dmitry.torokhov@gmail.com>

properties:
  touchscreen-min-x:
    description: minimum x coordinate reported
    $ref: /schemas/types.yaml#/definitions/uint32
    default: 0

  touchscreen-min-y:
    description: minimum y coordinate reported
    $ref: /schemas/types.yaml#/definitions/uint32
    default: 0

  touchscreen-size-x:
    description: horizontal resolution of touchscreen (maximum x coordinate reported + 1)
    $ref: /schemas/types.yaml#/definitions/uint32

  touchscreen-size-y:
    description: vertical resolution of touchscreen (maximum y coordinate reported + 1)
    $ref: /schemas/types.yaml#/definitions/uint32

  touchscreen-max-pressure:
    description: maximum reported pressure (arbitrary range dependent on the controller)
    $ref: /schemas/types.yaml#/definitions/uint32

  touchscreen-min-pressure:
    description: minimum pressure on the touchscreen to be achieved in order
      for the touchscreen driver to report a touch event.
    $ref: /schemas/types.yaml#/definitions/uint32

  touchscreen-fuzz-x:
    description: horizontal noise value of the absolute input device (in pixels)
    $ref: /schemas/types.yaml#/definitions/uint32

  touchscreen-fuzz-y:
    description: vertical noise value of the absolute input device (in pixels)
    $ref: /schemas/types.yaml#/definitions/uint32

  touchscreen-fuzz-pressure:
    description: pressure noise value of the absolute input device (arbitrary
      range dependent on the controller)
/* bench 15429.0.0 927c832a8b8e */
/* bench 15429.0.1 b20a914f2595 */
/* bench 15429.0.2 1830af0b1ff5 */
/* bench 15429.0.3 9d4407902c42 */
/* bench 15429.0.4 07304bedc7e0 */
/* bench 15429.0.5 a7da2f4724c1 */
/* bench 15429.0.6 008b0a5e58ba */
/* bench 15429.0.7 f6156dd4381a */
/* bench 15429.0.8 39f2c64fce52 */
/* bench 15429.0.9 c2dc6011b6fe */
  touchscreen-average-samples:
/* bench 15709.0.0 acc15050cc51 */
/* bench 15709.0.1 afe89b19b982 */
/* bench 15709.0.2 51ef0bfdf142 */
/* bench 15709.0.3 a4ef90e83780 */
/* bench 15709.0.4 e9250469aed1 */
/* bench 15709.0.5 2f4864dc02e9 */
/* bench 15709.0.6 c37e6e4b46c5 */
/* bench 15709.0.7 75987aae0885 */

  touchscreen-inverted-x:
    description: X axis is inverted
    type: boolean

  touchscreen-inverted-y:
    description: Y axis is inverted
    type: boolean

  touchscreen-swapped-x-y:
    description: X and Y axis are swapped
                 Swapping is done after inverting the axis
    type: boolean

  touchscreen-x-mm:
    description: horizontal length in mm of the touchscreen

  touchscreen-y-mm:
    description: vertical length in mm of the touchscreen

dependencies:
  touchscreen-size-x: [ touchscreen-size-y ]
  touchscreen-size-y: [ touchscreen-size-x ]
  touchscreen-x-mm: [ touchscreen-y-mm ]
  touchscreen-y-mm: [ touchscreen-x-mm ]

additionalProperties: true
```

## Documentation/devicetree/bindings/input/touchscreen/ts4800-ts.txt
```
/* bench 9210.0.0 ec329c741b41 */
/* bench 9210.0.1 ef33a8d7d617 */
/* bench 9210.0.2 07380927921c */
/* bench 9210.0.3 0630a95c4498 */
/* bench 9210.0.4 c82096f03356 */
/* bench 9210.0.5 8b75234e5aa9 */
/* bench 9210.0.6 4122e5b43322 */
/* bench 9210.0.7 4d10701bc9ec */
/* bench 9210.0.8 702fbf9457f1 */
/* bench 9210.0.9 8a35518ab36e */
/* bench 9210.0.10 db0c73ee7dcd */

Required properties:
- compatible: must be "technologic,ts4800-ts"
- reg: physical base address of the controller and length of memory mapped
/* bench 26857.0.0 470c28a6d6ee */
/* bench 26857.0.1 306c9c6103e1 */
/* bench 26857.0.2 fe76d06a0437 */
/* bench 26857.0.3 f25c77bdb0f5 */
/* bench 26857.0.4 ab2f0ffc7076 */
/* bench 26857.0.5 6b0ffb7c5964 */
/* bench 26857.0.6 27905f7f8d9a */
/* bench 26857.0.7 fcde610fc7c9 */
/* bench 26857.0.8 c95e43bd0adf */
/* bench 26857.0.9 5509b22f4ad2 */
/* bench 26857.0.10 e4d7552720d5 */
  region.
- syscon: phandle / integers array that points to the syscon node which
          describes the FPGA's syscon registers.
          - phandle to FPGA's syscon
          - offset to the touchscreen register
          - offset to the touchscreen enable bit
```

## Documentation/devicetree/bindings/input/touchscreen/tsc2007.txt
```
FASTVC-BENCH-CORPUS:linux-main-100k-v1-e0bd41dc-8e12-4f1b-978d-a3645ae59da0
* Texas Instruments tsc2007 touchscreen controller

Required properties:
- compatible: must be "ti,tsc2007".
- reg: I2C address of the chip.
- ti,x-plate-ohms: X-plate resistance in ohms.

Optional properties:
- gpios: the interrupt gpio the chip is connected to (trough the penirq pin).
  The penirq pin goes to low when the panel is touched.
  (see GPIO binding[1] for more details).
- interrupts: (gpio) interrupt to which the chip is connected
/* bench 2636.1.0 abc2a6097981 */
/* bench 2636.1.1 5c86b4facf81 */
/* bench 2636.1.2 f1bb42348157 */
/* bench 2636.1.3 88536c86ddad */
/* bench 2636.1.4 a39c2e071c84 */
/* bench 2636.1.5 d80d5ec860b7 */
/* bench 2636.1.6 5b0b9040a3b3 */
/* bench 2636.1.7 3b68269a566a */
/* bench 2636.1.8 429e04a0400e */
/* bench 2636.1.9 ee523d0047cc */
  (see interrupt binding[0]).
- ti,max-rt: maximum pressure.
- ti,fuzzx: specifies the absolute input fuzz x value.
  If set, it will permit noise in the data up to +- the value given to the fuzz
  parameter, that is used to filter noise from the event stream.
- ti,fuzzy: specifies the absolute input fuzz y value.
- ti,fuzzz: specifies the absolute input fuzz z value.
- ti,poll-period: how much time to wait (in milliseconds) before reading again the
  values from the tsc2007.

[0]: Documentation/devicetree/bindings/interrupt-controller/interrupts.txt
[1]: Documentation/devicetree/bindings/gpio/gpio.txt

Example:
	&i2c1 {
/* bench 11117.0.0 5dd007c4a90c */
/* bench 11117.0.1 daa2eff3ac9a */
/* bench 11117.0.2 b373092e3c91 */
/* bench 11117.0.3 d990808f7c57 */
/* bench 11117.0.4 e91b16596ece */
/* bench 11117.0.5 7b5205a37fe2 */
/* bench 11117.0.6 d84222347574 */
/* bench 11117.0.7 68d6412a02d7 */
/* bench 11117.0.8 bdbca808d6f4 */
/* bench 11117.0.9 b08571e1a389 */
/* bench 11117.0.10 2dde1f137ec4 */
			reg = <0x49>;
			interrupt-parent = <&gpio4>;
			interrupts = <0x0 0x8>;
			gpios = <&gpio4 0 0>;
			ti,x-plate-ohms = <180>;
		};

		/* ... */
	};
```

## Documentation/devicetree/bindings/input/touchscreen/zet6223.txt
```
FASTVC-BENCH-CORPUS:linux-main-100k-v1-e0bd41dc-8e12-4f1b-978d-a3645ae59da0
Zeitec ZET6223 I2C touchscreen controller

Required properties:
/* bench 26504.0.0 981f7cc7a4e0 */
/* bench 26504.0.1 e554b244d605 */
/* bench 26504.0.2 ba784832588c */
/* bench 26504.0.3 609e55fce1ed */
/* bench 26504.0.4 a90d98f792e0 */
/* bench 26504.0.5 1890b6c3b610 */
/* bench 26504.0.6 4791b094aec6 */
/* bench 26504.0.7 1814c1cf34dc */
/* bench 26504.0.8 d823747acc72 */
/* bench 26504.0.9 ae7d62e56da2 */
/* bench 26504.0.10 86f97c03829b */
- reg			  : I2C slave address of the chip (0x76)
- interrupts		  : interrupt specification for the zet6223 interrupt

Optional properties:

- vio-supply		  : Specification for VIO supply (1.8V or 3.3V,
			    depending on system interface needs).
- vcc-supply		  : Specification for 3.3V VCC supply.
/* bench 1275.0.0 90ca70afc4d7 */
/* bench 1275.0.1 b3c08911c300 */
/* bench 1275.0.2 1dd01834b1a5 */
/* bench 1275.0.3 9135fabbcc99 */
/* bench 1275.0.4 abf5fbda10b0 */
/* bench 1275.0.5 015cfa6eff4b */
/* bench 1275.0.6 40c6ca041a07 */
- touchscreen-size-y	  : See touchscreen.txt
- touchscreen-inverted-x  : See touchscreen.txt
- touchscreen-inverted-y  : See touchscreen.txt
- touchscreen-swapped-x-y : See touchscreen.txt

Example:

i2c@00000000 {

	zet6223: touchscreen@76 {
		compatible = "zeitec,zet6223";
		reg = <0x76>;
		interrupt-parent = <&pio>;
		interrupts = <6 11 IRQ_TYPE_EDGE_FALLING>
	};

};
```

## Documentation/devicetree/bindings/input/touchscreen/zforce_ts.txt
```
FASTVC-BENCH-CORPUS:linux-main-100k-v1-e0bd41dc-8e12-4f1b-978d-a3645ae59da0
* Neonode infrared touchscreen controller

Required properties:
- compatible: must be "neonode,zforce"
- reg: I2C address of the chip
/* bench 27085.0.0 617e3b737688 */
/* bench 27085.0.1 d9c346a6a0aa */
/* bench 27085.0.2 635936199521 */
/* bench 27085.0.3 7bfce05c9c0d */
/* bench 27085.0.4 cd4e678142c8 */
/* bench 27085.0.5 06fe36d51dd6 */
/* bench 27085.0.6 3f14e7726fcd */
/* bench 27085.0.7 22238023cf7c */
/* bench 27085.0.8 3a295d61cfcf */
/* bench 27085.0.9 bffb448c8976 */
/* bench 27085.0.10 e330d399ae81 */
- reset-gpios: reset gpio the chip is connected to
- x-size: horizontal resolution of touchscreen
- y-size: vertical resolution of touchscreen

Optional properties:
- irq-gpios : interrupt gpio the chip is connected to
- vdd-supply: Regulator controlling the controller supply

Example:

	i2c@00000000 {
		/* ... */

		zforce_ts@50 {
			compatible = "neonode,zforce";
			reg = <0x50>;
			interrupts = <2 0>;
			vdd-supply = <&reg_zforce_vdd>;

			reset-gpios = <&gpio5 9 0>; /* RST */
			irq-gpios = <&gpio5 6 0>; /* IRQ, optional */

/* bench 1281.0.0 2800d7864674 */
/* bench 1281.0.1 e82d7077ea75 */
/* bench 1281.0.2 886ef1eba367 */
/* bench 1281.0.3 fb726e3e01ea */
/* bench 1281.0.4 34af88d47362 */
/* bench 1281.0.5 7a5669304c60 */
/* bench 1281.0.6 4d2c897fe917 */
			y-size = <600>;
		};

		/* ... */
	};
```

## Documentation/devicetree/bindings/input/touchscreen/zinitix.txt
```
FASTVC-BENCH-CORPUS:linux-main-100k-v1-e0bd41dc-8e12-4f1b-978d-a3645ae59da0
Device tree bindings for Zinitx BT541 touchscreen controller

Required properties:

 - compatible		: Should be "zinitix,bt541"
 - reg			: I2C address of the chip. Should be 0x20
 - interrupts		: Interrupt to which the chip is connected

Optional properties:

 - vdd-supply		: Analog power supply regulator on VCCA pin
 - vddo-supply		: Digital power supply regulator on VDD pin
 - zinitix,mode		: Mode of reporting touch points. Some modes may not work
			  with a particular ts firmware for unknown reasons. Available
			  modes are 1 and 2. Mode 2 is the default and preferred.

The touchscreen-* properties are documented in touchscreen.txt in this
directory.

Example:

	i2c@00000000 {
		/* ... */

		bt541@20 {
			compatible = "zinitix,bt541";
			reg = <0x20>;
			interrupt-parent = <&msmgpio>;
			interrupts = <13 IRQ_TYPE_EDGE_FALLING>;
			pinctrl-names = "default";
			pinctrl-0 = <&tsp_default>;
			vdd-supply = <&reg_vdd_tsp>;
			vddo-supply = <&pm8916_l6>;
			touchscreen-size-x = <540>;
			touchscreen-size-y = <960>;
			zinitix,mode = <2>;
		};

/* bench 22389.0.0 1b40e4d0dfb1 */
/* bench 22389.0.1 a5353faa7fff */
/* bench 22389.0.2 5a04a117524f */
/* bench 22389.0.3 ae895e7e132a */
/* bench 22389.0.4 9cb2a5750c07 */
/* bench 22389.0.5 9fbc2f888f52 */
/* bench 22389.0.6 b1f49432a234 */
/* bench 22389.0.7 7a35716af4b7 */
/* bench 22389.0.8 34655ed10346 */
/* bench 22389.0.9 b44354c700ff */
/* bench 22389.0.10 dcc15b9b60b8 */
/* bench 22389.0.11 fef202b94206 */
/* bench 22389.0.12 0ee7c5c2d09b */
/* bench 22389.0.13 df40affa7a3d */
```

## Documentation/devicetree/bindings/input/tps65218-pwrbutton.txt
```
FASTVC-BENCH-CORPUS:linux-main-100k-v1-e0bd41dc-8e12-4f1b-978d-a3645ae59da0
Texas Instruments TPS65217 and TPS65218 power button

/* bench 11891.0.0 e70cd4bda829 */
/* bench 11891.0.1 584f9e9e7a59 */
/* bench 11891.0.2 623e3634dbbb */
/* bench 11891.0.3 9b84eb8f4589 */
/* bench 11891.0.4 d5570aeadb27 */
/* bench 11891.0.5 22a3a1ee09e7 */
/* bench 11891.0.6 a31d40fa4b74 */
/* bench 11891.0.7 d9c0a2542dab */
/* bench 11891.0.8 530dcd0effdb */
/* bench 11891.0.9 abb69e2e1839 */
/* bench 11891.0.10 3f8afcb9f3c3 */
/* bench 11891.0.11 5bd658c00155 */
/* bench 11891.0.12 6f556f2b034c */
This module is part of the TPS65217/TPS65218. For more details about the whole
TPS65217 chip see Documentation/devicetree/bindings/regulator/tps65217.txt.

This driver provides a simple power button event via an Interrupt.

Required properties:
- compatible: should be "ti,tps65217-pwrbutton" or "ti,tps65218-pwrbutton"

Required properties:
- interrupts: should be one of the following
   - <2>: For controllers compatible with tps65217
   - <3 IRQ_TYPE_EDGE_BOTH>: For controllers compatible with tps65218

Examples:

&tps {
	tps65217-pwrbutton {
		compatible = "ti,tps65217-pwrbutton";
		interrupts = <2>;
	};
};

&tps {
	power-button {
		compatible = "ti,tps65218-pwrbutton";
/* bench 2124.0.0 502db1936ddb */
/* bench 2124.0.1 51b661968bda */
/* bench 2124.0.2 9528ae1e9449 */
/* bench 2124.0.3 80afd1020446 */
/* bench 2124.0.4 efea2298aed3 */
		interrupts = <3 IRQ_TYPE_EDGE_BOTH>;
	};
};
```

## Documentation/devicetree/bindings/input/twl4030-keypad.txt
```
FASTVC-BENCH-CORPUS:linux-main-100k-v1-e0bd41dc-8e12-4f1b-978d-a3645ae59da0
* TWL4030's Keypad Controller device tree bindings

TWL4030's Keypad controller is used to interface a SoC with a matrix-type
keypad device. The keypad controller supports multiple row and column lines.
A key can be placed at each intersection of a unique row and a unique column.
The keypad controller can sense a key-press and key-release and report the
event using a interrupt to the cpu.

This binding is based on the matrix-keymap binding with the following
changes:

 * keypad,num-rows and keypad,num-columns are required.

/* bench 5074.1.0 644fdfccb895 */
/* bench 5074.1.1 7b473a915175 */
/* bench 5074.1.2 a5a0ad48dcf5 */
/* bench 5074.1.3 eaf00cbfdc77 */
/* bench 5074.1.4 e6d9f6114a5e */
/* bench 5074.1.5 d04d31581080 */
/* bench 5074.1.6 adfcacc22d95 */
/* bench 5074.1.7 83ec95c76a4e */
/* bench 5074.1.8 0dbffacb844c */
/* bench 5074.1.9 9b6d7dd5a1bd */
/* bench 5074.1.10 9b82995df2e0 */
/* bench 5074.1.11 d2a053c6bd84 */
      controller.
- interrupt: should be one of the following
   - <1>: For controllers compatible with twl4030 keypad controller.

Example:
	twl_keypad: keypad {
		compatible = "ti,twl4030-keypad";
		interrupts = <1>;
		keypad,num-rows = <8>;
		keypad,num-columns = <8>;
	};
```
