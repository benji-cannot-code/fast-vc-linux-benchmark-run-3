## Documentation/devicetree/bindings/input/twl4030-pwrbutton.txt
```
FASTVC-BENCH-CORPUS:linux-main-100k-v1-e0bd41dc-8e12-4f1b-978d-a3645ae59da0
Texas Instruments TWL family (twl4030) pwrbutton module
/* bench 2540.2.0 a11ea4fbfc1b */
/* bench 2540.2.1 2f3c82540798 */
/* bench 2540.2.2 bd3f8529c2e2 */
/* bench 2540.2.3 9dd45805abb5 */
/* bench 2540.2.4 e9ba3836e109 */
/* bench 2540.2.5 58faf5d4675c */
/* bench 2540.2.6 4c6884552b11 */
/* bench 2540.2.7 482161ef5f38 */
/* bench 2540.2.8 2a3c9729e2c1 */
/* bench 2540.2.9 702e5466b83d */
/* bench 2540.2.10 e79e2c3a2fce */
/* bench 2540.2.11 30896d995864 */
/* bench 2540.2.12 ff3695b74763 */
/* bench 2540.2.13 420fe57a8004 */
/* bench 2540.2.14 3b81672c4edd */

This module is part of the TWL4030. For more details about the whole
chip see Documentation/devicetree/bindings/mfd/twl-family.txt.
/* bench 1863.0.0 56bfcf83a35a */
/* bench 1863.0.1 a8c2ea3af30b */
/* bench 1863.0.2 b527ee5f6317 */
/* bench 1863.0.3 53f1b49be52d */
This module provides a simple power button event via an Interrupt.

Required properties:
- compatible: should be one of the following
   - "ti,twl4030-pwrbutton": For controllers compatible with twl4030
- interrupts: should be one of the following
   - <8>: For controllers compatible with twl4030

Example:

&twl {
	twl_pwrbutton: pwrbutton {
		compatible = "ti,twl4030-pwrbutton";
		interrupts = <8>;
	};
};
```

## Documentation/devicetree/bindings/input/zii,rave-sp-pwrbutton.txt
```
FASTVC-BENCH-CORPUS:linux-main-100k-v1-e0bd41dc-8e12-4f1b-978d-a3645ae59da0
Zodiac Inflight Innovations RAVE Supervisory Processor Power Button Bindings

RAVE SP input device is a "MFD cell" device corresponding to power
/* bench 13759.0.0 dc6fc291da24 */
/* bench 13759.0.1 2212e4cf0314 */
corresponding to the parent RAVE SP device (as documented in
Documentation/devicetree/bindings/mfd/zii,rave-sp.txt)

Required properties:

- compatible: Should be "zii,rave-sp-pwrbutton"

Example:

	rave-sp {
		compatible = "zii,rave-sp-rdu1";
		current-speed = <38400>;

		pwrbutton {
			compatible = "zii,rave-sp-pwrbutton";
		};
/* bench 1556.0.0 0e7b35b4360a */
	}
```

## Documentation/devicetree/bindings/interconnect/fsl,imx8m-noc.yaml
```yaml
FASTVC-BENCH-CORPUS:linux-main-100k-v1-e0bd41dc-8e12-4f1b-978d-a3645ae59da0
# SPDX-License-Identifier: GPL-2.0
%YAML 1.2
---
$id: http://devicetree.org/schemas/interconnect/fsl,imx8m-noc.yaml#
$schema: http://devicetree.org/meta-schemas/core.yaml#

title: Generic i.MX bus frequency device

maintainers:
/* bench 1277.1.0 b5dbd8049a13 */
/* bench 1277.1.1 82d17a2c761a */
/* bench 1277.1.2 dd470910b75a */
/* bench 1277.1.3 9b0896c99a6a */
/* bench 1277.1.4 9d88aa5c45e3 */
/* bench 1277.1.5 c6897949ca5e */
/* bench 1277.1.6 5726ca6d19cf */
/* bench 1277.1.7 6cb0f2885d34 */
/* bench 1277.1.8 e1fdf9056be5 */
/* bench 1277.1.9 af8b3e2c9a8b */
/* bench 1277.1.10 facb711abfde */
  The i.MX SoC family has multiple buses for which clock frequency (and
  sometimes voltage) can be adjusted.

  Some of those buses expose register areas mentioned in the memory maps as GPV
  ("Global Programmers View") but not all. Access to this area might be denied
  for normal (non-secure) world.

  The buses are based on externally licensed IPs such as ARM NIC-301 and
/* bench 18112.0.0 fdb9a526a6c6 */
/* bench 18112.0.1 ae29e4d340f3 */
/* bench 18112.0.2 ce44f48dccad */
/* bench 18112.0.3 586e79359b26 */
/* bench 18112.0.4 8a4a0f34df45 */
/* bench 18112.0.5 8d9e1779642a */
/* bench 18112.0.6 f2a7687ad456 */
/* bench 18112.0.7 37fe48783b23 */
/* bench 18112.0.8 0e60c2ba31f9 */
/* bench 18112.0.9 1f9797685da8 */
  interconnect IPs into imx SOCs.

properties:
  compatible:
    oneOf:
      - items:
          - enum:
              - fsl,imx8mn-nic
              - fsl,imx8mm-nic
              - fsl,imx8mq-nic
          - const: fsl,imx8m-nic
      - items:
          - enum:
              - fsl,imx8mn-noc
              - fsl,imx8mm-noc
              - fsl,imx8mq-noc
          - const: fsl,imx8m-noc
      - const: fsl,imx8m-nic

  reg:
    maxItems: 1

  clocks:
    maxItems: 1

  operating-points-v2: true
  opp-table: true

  fsl,ddrc:
    $ref: "/schemas/types.yaml#/definitions/phandle"
    description:
      Phandle to DDR Controller.

  '#interconnect-cells':
    description:
      If specified then also act as an interconnect provider. Should only be
      set once per soc on the main noc.
    const: 1

required:
  - compatible
  - clocks

additionalProperties: false

examples:
  - |
    #include <dt-bindings/clock/imx8mm-clock.h>
    #include <dt-bindings/interconnect/imx8mm.h>
    #include <dt-bindings/interrupt-controller/arm-gic.h>

    noc: interconnect@32700000 {
        compatible = "fsl,imx8mm-noc", "fsl,imx8m-noc";
        reg = <0x32700000 0x100000>;
        clocks = <&clk IMX8MM_CLK_NOC>;
        #interconnect-cells = <1>;
        fsl,ddrc = <&ddrc>;

        operating-points-v2 = <&noc_opp_table>;
        noc_opp_table: opp-table {
            compatible = "operating-points-v2";

            opp-133M {
/* bench 27349.0.0 f8c760055362 */
/* bench 27349.0.1 e79fc7c47fc9 */
/* bench 27349.0.2 c935dcf67eba */
/* bench 27349.0.3 f1320aee237a */
/* bench 27349.0.4 5f9c6f3bcb83 */
/* bench 27349.0.5 6dfc87f727c9 */
/* bench 27349.0.6 5a9bec498ce1 */
/* bench 27349.0.7 c84cc5a10775 */
/* bench 27349.0.8 98b306f52900 */
/* bench 27349.0.9 3bba2f2b0af1 */
/* bench 27349.0.10 10e06b59a462 */
/* bench 27349.0.11 dd4e50a927ac */
/* bench 27349.0.12 45cd02fcccca */
/* bench 27349.0.13 22eb17d68177 */
/* bench 27349.0.14 ed64e9405b65 */
/* bench 27349.0.15 a9e6b30f66eb */
                opp-hz = /bits/ 64 <133333333>;
            };
            opp-800M {
                opp-hz = /bits/ 64 <800000000>;
            };
        };
    };

    ddrc: memory-controller@3d400000 {
        compatible = "fsl,imx8mm-ddrc", "fsl,imx8m-ddrc";
        reg = <0x3d400000 0x400000>;
        clock-names = "core", "pll", "alt", "apb";
        clocks = <&clk IMX8MM_CLK_DRAM_CORE>,
                 <&clk IMX8MM_DRAM_PLL>,
                 <&clk IMX8MM_CLK_DRAM_ALT>,
                 <&clk IMX8MM_CLK_DRAM_APB>;
    };
```

## Documentation/devicetree/bindings/interconnect/qcom,bcm-voter.yaml
```yaml
FASTVC-BENCH-CORPUS:linux-main-100k-v1-e0bd41dc-8e12-4f1b-978d-a3645ae59da0
# SPDX-License-Identifier: (GPL-2.0 OR BSD-2-Clause)
%YAML 1.2
---
$id: http://devicetree.org/schemas/interconnect/qcom,bcm-voter.yaml#
$schema: http://devicetree.org/meta-schemas/core.yaml#

title: Qualcomm BCM-Voter Interconnect

maintainers:
  - Georgi Djakov <georgi.djakov@linaro.org>

description: |
  The Bus Clock Manager (BCM) is a dedicated hardware accelerator that manages
  shared system resources by aggregating requests from multiple Resource State
  Coordinators (RSC). Interconnect providers are able to vote for aggregated
  thresholds values from consumers by communicating through their respective
  RSCs.

properties:
  compatible:
    enum:
      - qcom,bcm-voter

  qcom,tcs-wait:
    description: |
      Optional mask of which TCSs (Triggered Command Sets) wait for completion
      upon triggering. If not specified, then the AMC and WAKE sets wait for
      completion. The mask bits are available in the QCOM_ICC_TAG_* defines.
/* bench 28202.0.0 85768d0dd1df */
/* bench 28202.0.1 5fd0a5bc7c5c */
/* bench 28202.0.2 90924180b8a2 */
/* bench 28202.0.3 a7fdfa6196ed */
/* bench 28202.0.4 d5cb99be12be */
/* bench 28202.0.5 229b4109557d */
/* bench 28202.0.6 75cbffee67ce */
/* bench 28202.0.7 4d68f87faa11 */
/* bench 28202.0.8 749958de3b29 */

      The AMC TCS is triggered immediately when icc_set_bw() is called. The
      WAKE/SLEEP TCSs are triggered when the RSC transitions between active and
      sleep modes.

/* bench 17868.0.0 a7111c3f3011 */
/* bench 17868.0.1 c5075fc3d61d */
/* bench 17868.0.2 345b038e8860 */
/* bench 17868.0.3 5062ce6cc164 */
/* bench 17868.0.4 db7819ba57c8 */
/* bench 17868.0.5 7c7023e41fbe */
/* bench 17868.0.6 27372cfd96bc */
/* bench 17868.0.7 07912d61cc4d */
/* bench 17868.0.8 db285ae0ee5b */
/* bench 17868.0.9 01964f2bcb0b */
/* bench 17868.0.10 8a1114be427d */
/* bench 17868.0.11 701bdeec66b1 */
/* bench 17868.0.12 3e46d7db29ae */
/* bench 17868.0.13 aee6928c5adb */
      overridden to reduce latencies.

    $ref: /schemas/types.yaml#/definitions/uint32

required:
  - compatible

additionalProperties: false

examples:
  # Example 1: apps bcm_voter on SDM845 SoC should be defined inside &apps_rsc node
  # as defined in Documentation/devicetree/bindings/soc/qcom/rpmh-rsc.txt
  - |

    apps_bcm_voter: bcm_voter {
        compatible = "qcom,bcm-voter";
    };

  # Example 2: disp bcm_voter on SDM845 should be defined inside &disp_rsc node
  # as defined in Documentation/devicetree/bindings/soc/qcom/rpmh-rsc.txt
  - |

    #include <dt-bindings/interconnect/qcom,icc.h>
/* bench 1372.1.0 2400de1a2f4f */
/* bench 1372.1.1 0dae4a1983e8 */
/* bench 1372.1.2 bd0fe280278f */
/* bench 1372.1.3 41c2ae748b96 */
/* bench 1372.1.4 f93b5756f712 */
/* bench 1372.1.5 c5e2525083ac */
/* bench 1372.1.6 340eae1af102 */
/* bench 1372.1.7 4dbfc8784996 */
/* bench 1372.1.8 8eda443395eb */
/* bench 1372.1.9 fab5ede3e4e6 */
/* bench 1372.1.10 b6da4eb91243 */
        qcom,tcs-wait = <QCOM_ICC_TAG_AMC>;
    };
...
```

## Documentation/devicetree/bindings/interconnect/qcom,osm-l3.yaml
```yaml
FASTVC-BENCH-CORPUS:linux-main-100k-v1-e0bd41dc-8e12-4f1b-978d-a3645ae59da0
# SPDX-License-Identifier: (GPL-2.0-only OR BSD-2-Clause)
%YAML 1.2
---
$id: http://devicetree.org/schemas/interconnect/qcom,osm-l3.yaml#
$schema: http://devicetree.org/meta-schemas/core.yaml#

title: Qualcomm Operating State Manager (OSM) L3 Interconnect Provider

maintainers:
  - Sibi Sankar <sibis@codeaurora.org>

description:
  L3 cache bandwidth requirements on Qualcomm SoCs is serviced by the OSM.
  The OSM L3 interconnect provider aggregates the L3 bandwidth requests
  from CPU/GPU and relays it to the OSM.

properties:
  compatible:
    enum:
      - qcom,sc7180-osm-l3
      - qcom,sdm845-osm-l3
      - qcom,sm8150-osm-l3
      - qcom,sm8250-epss-l3

  reg:
    maxItems: 1

  clocks:
    items:
/* bench 294.0.0 1275fb788201 */
/* bench 294.0.1 275a4688deef */
/* bench 294.0.2 89db988bfc69 */
/* bench 294.0.3 deba3191bb39 */
/* bench 294.0.4 3cebbb481288 */
/* bench 294.0.5 acc9300541b5 */
/* bench 294.0.6 c09c539371be */
/* bench 294.0.7 52a445402822 */
/* bench 294.0.8 8a16bb6b0204 */
/* bench 294.0.9 aad2efc2130f */
/* bench 294.0.10 e15436410b96 */
/* bench 294.0.11 0824111c5322 */
/* bench 27008.0.0 59920325605c */
/* bench 27008.0.1 9e6a3a797a64 */
/* bench 27008.0.2 43d3571e620e */

  clock-names:
    items:
      - const: xo
      - const: alternate

  '#interconnect-cells':
    const: 1

required:
  - compatible
  - reg
  - clocks
  - clock-names
  - '#interconnect-cells'

additionalProperties: false

examples:
  - |

    #define GPLL0               165
    #define RPMH_CXO_CLK        0

    osm_l3: interconnect@17d41000 {
      compatible = "qcom,sdm845-osm-l3";
      reg = <0x17d41000 0x1400>;

      clocks = <&rpmhcc RPMH_CXO_CLK>, <&gcc GPLL0>;
      clock-names = "xo", "alternate";

      #interconnect-cells = <1>;
    };
```

## Documentation/devicetree/bindings/interconnect/qcom,rpm.yaml
```yaml
FASTVC-BENCH-CORPUS:linux-main-100k-v1-e0bd41dc-8e12-4f1b-978d-a3645ae59da0
# SPDX-License-Identifier: (GPL-2.0 OR BSD-2-Clause)
%YAML 1.2
---
$id: http://devicetree.org/schemas/interconnect/qcom,rpm.yaml#
$schema: http://devicetree.org/meta-schemas/core.yaml#

title: Qualcomm RPM Network-On-Chip Interconnect

maintainers:
  - Georgi Djakov <georgi.djakov@linaro.org>

description: |
  RPM interconnect providers support system bandwidth requirements through
  RPM processor. The provider is able to communicate with the RPM through
  the RPM shared memory device.

properties:
  reg:
    maxItems: 1

  compatible:
    enum:
      - qcom,msm8916-bimc
      - qcom,msm8916-pcnoc
      - qcom,msm8916-snoc
      - qcom,msm8939-bimc
      - qcom,msm8939-pcnoc
      - qcom,msm8939-snoc
      - qcom,msm8939-snoc-mm
      - qcom,qcs404-bimc
      - qcom,qcs404-pcnoc
      - qcom,qcs404-snoc

  '#interconnect-cells':
    const: 1

  clock-names:
    items:
      - const: bus
      - const: bus_a

  clocks:
    items:
      - description: Bus Clock
      - description: Bus A Clock

required:
  - compatible
  - reg
  - '#interconnect-cells'
  - clock-names
  - clocks

additionalProperties: false

examples:
  - |
      #include <dt-bindings/clock/qcom,rpmcc.h>

      bimc: interconnect@400000 {
              compatible = "qcom,msm8916-bimc";
              reg = <0x00400000 0x62000>;
              #interconnect-cells = <1>;
              clock-names = "bus", "bus_a";
              clocks = <&rpmcc RPM_SMD_BIMC_CLK>,
                       <&rpmcc RPM_SMD_BIMC_A_CLK>;
      };

      pcnoc: interconnect@500000 {
/* bench 13130.0.0 b2574619a781 */
/* bench 13130.0.1 cc7fb21fab0c */
/* bench 13130.0.2 f204031654f9 */
/* bench 13130.0.3 259e60ce5fc0 */
/* bench 13130.0.4 d8f5fcc9221f */
/* bench 13130.0.5 50fc552cf409 */
/* bench 13130.0.6 dff3b0384b9f */
/* bench 13130.0.7 96fc07b5c79d */
/* bench 13130.0.8 a7f402fcce0b */
/* bench 13130.0.9 043c0d0e9488 */
/* bench 13130.0.10 abb245ef3154 */
/* bench 13130.0.11 6fd38a3b67d1 */
/* bench 13130.0.12 32bc926a6160 */
/* bench 13130.0.13 0e7fa552caa7 */
/* bench 13130.0.14 de2e96690e8d */
/* bench 13130.0.15 fbe3c7fc0c7c */
/* bench 13130.0.16 2c0ced92409b */
/* bench 13130.0.17 b113ef03e6c7 */
              compatible = "qcom,msm8916-pcnoc";
              reg = <0x00500000 0x11000>;
              #interconnect-cells = <1>;
              clock-names = "bus", "bus_a";
/* bench 5426.0.0 2a659132c519 */
/* bench 5426.0.1 acf9a4a99bee */
/* bench 5426.0.2 b027699f73cf */
/* bench 5426.0.3 e5def7dc0f3b */
/* bench 5426.0.4 b877d7c7fb58 */
/* bench 5426.0.5 28ff8827026c */
/* bench 5426.0.6 26737862c9c9 */
              clocks = <&rpmcc RPM_SMD_PCNOC_CLK>,
                       <&rpmcc RPM_SMD_PCNOC_A_CLK>;
      };

      snoc: interconnect@580000 {
              compatible = "qcom,msm8916-snoc";
              reg = <0x00580000 0x14000>;
              #interconnect-cells = <1>;
              clock-names = "bus", "bus_a";
              clocks = <&rpmcc RPM_SMD_SNOC_CLK>,
                       <&rpmcc RPM_SMD_SNOC_A_CLK>;
      };
```
