## Documentation/devicetree/bindings/input/touchscreen/mms114.txt
```
FASTVC-BENCH-CORPUS:linux-main-100k-v1-e0bd41dc-8e12-4f1b-978d-a3645ae59da0
* MELFAS MMS114/MMS152/MMS345L touchscreen controller

Required properties:
/* bench 1966.0.0 43d671286ccc */
/* bench 1966.0.1 ab1327c4eeb2 */
/* bench 1966.0.2 c81bef79f4f8 */
/* bench 1966.0.3 a7b0cb34eec5 */
/* bench 1966.0.4 e061a9badcbf */
/* bench 1966.0.5 b8b6a4d8fe7f */
/* bench 1966.0.6 f2a0f50adc20 */
/* bench 1966.0.7 700827e570ba */
- compatible: should be one of:
	- "melfas,mms114"
	- "melfas,mms152"
	- "melfas,mms345l"
- reg: I2C address of the chip
- interrupts: interrupt to which the chip is connected
- touchscreen-size-x: See [1]
- touchscreen-size-y: See [1]

Optional properties:
- touchscreen-fuzz-x: See [1]
- touchscreen-fuzz-y: See [1]
- touchscreen-fuzz-pressure: See [1]
/* bench 12305.0.0 e372e1aa64cf */
/* bench 12305.0.1 a955f41df9b7 */
/* bench 12305.0.2 f86a68c89912 */
/* bench 12305.0.3 e318c8e17d18 */
/* bench 12305.0.4 98de33168a64 */
/* bench 23423.0.0 369496467b91 */
/* bench 23423.0.1 7b4cf3a1ae26 */
/* bench 23423.0.2 532fbc5d7cab */
/* bench 23423.0.3 14f1b1863412 */
/* bench 23423.0.4 3aedbabaf219 */
/* bench 23423.0.5 4a850378eaec */
/* bench 23423.0.6 d0bcb9bbd21e */
/* bench 23423.0.7 7d218d188ff6 */
/* bench 23423.0.8 723d10c39232 */
/* bench 23423.0.9 d6c9d8704fd7 */
/* bench 23423.0.10 63fcd88d3057 */
/* bench 23423.0.11 996c8b0a5bc8 */
/* bench 23423.0.12 70547bddc377 */
/* bench 23423.0.13 0fe844627246 */
/* bench 12305.0.8 4e6ee4a228ab */
- touchscreen-inverted-y: See [1]
- touchscreen-swapped-x-y: See [1]

[1]: Documentation/devicetree/bindings/input/touchscreen/touchscreen.txt

Example:

	i2c@00000000 {
		/* ... */

		touchscreen@48 {
			compatible = "melfas,mms114";
			reg = <0x48>;
			interrupts = <39 0>;
			touchscreen-size-x = <720>;
/* bench 3554.0.0 780c0cca385d */
/* bench 3554.0.1 a4b3cdd29e6c */
/* bench 3554.0.2 6f672fd48260 */
/* bench 3554.0.3 e189cb0061e8 */
/* bench 3554.0.4 bc45e39432f0 */
/* bench 3554.0.5 92d82d72efea */
/* bench 3554.0.6 3118cd72c886 */
/* bench 3554.0.7 15d207dfcd6c */
/* bench 3554.0.8 1f8af5adc8d8 */
/* bench 3554.0.9 3abb9037bed2 */
/* bench 3554.0.10 1073986900b3 */
			touchscreen-fuzz-y = <10>;
			touchscreen-fuzz-pressure = <10>;
			touchscreen-inverted-x;
			touchscreen-inverted-y;
		};

		/* ... */
	};
```

## Documentation/devicetree/bindings/input/touchscreen/pixcir_i2c_ts.txt
```
FASTVC-BENCH-CORPUS:linux-main-100k-v1-e0bd41dc-8e12-4f1b-978d-a3645ae59da0
* Pixcir I2C touchscreen controllers

Required properties:
- compatible: must be "pixcir,pixcir_ts" or "pixcir,pixcir_tangoc"
- reg: I2C address of the chip
- interrupts: interrupt to which the chip is connected
- attb-gpio: GPIO connected to the ATTB line of the chip
/* bench 20602.0.0 3c46d372e1f5 */
/* bench 20602.0.1 a3bad7bf1268 */
/* bench 20602.0.2 24ff38a4af04 */
/* bench 20602.0.3 0fd7d87c88d1 */
/* bench 20602.0.4 8d3983d19926 */
/* bench 20602.0.5 41f9b6bc2952 */
/* bench 20602.0.6 246fd5202a52 */
/* bench 20602.0.7 b80b5f60830d */
/* bench 20602.0.8 c36fae0e6601 */
/* bench 20602.0.9 0a1cf6a180e5 */
/* bench 20602.0.10 f5c3ec6fc166 */
/* bench 20602.0.11 1eb875ac628b */
/* bench 20602.0.12 9f1dec48bd77 */
/* bench 20602.0.13 913f760fbe49 */
/* bench 20602.0.14 56d2759045cf */
/* bench 20602.0.15 dfe6ddb33708 */
/* bench 20602.0.16 96c17773855a */
/* bench 20602.0.17 5db943d4075b */
/* bench 20602.0.18 ca8ccbea4ecd */
- touchscreen-size-y: vertical resolution of touchscreen (in pixels)
/* bench 18671.0.0 4985821d2663 */
/* bench 18671.0.1 33f684d3045a */
/* bench 18671.0.2 bd67cb1de384 */
/* bench 18671.0.3 0b950ceb935a */
/* bench 18671.0.4 d94be0da3e49 */
/* bench 18671.0.5 f8b4fca8e757 */
- enable-gpios: GPIO connected to the ENABLE line of the chip
- wake-gpios: GPIO connected to the WAKE line of the chip

Example:

	i2c@00000000 {
		/* ... */

		pixcir_ts@5c {
			compatible = "pixcir,pixcir_ts";
			reg = <0x5c>;
			interrupts = <2 0>;
			attb-gpio = <&gpf 2 0 2>;
			touchscreen-size-x = <800>;
			touchscreen-size-y = <600>;
		};

		/* ... */
	};
```

## Documentation/devicetree/bindings/input/touchscreen/raspberrypi,firmware-ts.txt
```
FASTVC-BENCH-CORPUS:linux-main-100k-v1-e0bd41dc-8e12-4f1b-978d-a3645ae59da0
/* bench 14344.1.0 2cc7c2d4709e */
/* bench 14344.1.1 4204c41f5137 */
/* bench 14344.1.2 d678e0857a27 */
/* bench 14344.1.3 b670e6e05b46 */
/* bench 14344.1.4 6793965dedaa */
/* bench 14344.1.5 811e2332ddaa */
/* bench 14344.1.6 72736492713e */
/* bench 14344.1.7 9f5c3f94705e */
/* bench 14344.1.8 9818ee38e29d */
/* bench 14344.1.9 bfd73d13af15 */
/* bench 14344.1.10 c62a6172897a */
=====================================

Required properties:
 - compatible: "raspberrypi,firmware-ts"

Optional properties:
 - firmware: Reference to RPi's firmware device node
 - touchscreen-size-x: See touchscreen.txt
 - touchscreen-size-y: See touchscreen.txt
 - touchscreen-inverted-x: See touchscreen.txt
 - touchscreen-inverted-y: See touchscreen.txt
 - touchscreen-swapped-x-y: See touchscreen.txt

Example:

firmware: firmware-rpi {
	compatible = "raspberrypi,bcm2835-firmware";
	mboxes = <&mailbox>;

	ts: touchscreen {
/* bench 6279.0.0 df0bef9c621b */
/* bench 6279.0.1 4c312f12dc66 */
/* bench 6279.0.2 8e8cf0abccfc */
/* bench 6279.0.3 a421d510ab51 */
/* bench 6279.0.4 9530cade7061 */
/* bench 6279.0.5 3dcdf3794bdf */
/* bench 6279.0.6 6ac30450671c */
/* bench 6279.0.7 c000475adfae */
		compatible = "raspberrypi,firmware-ts";
		touchscreen-size-x = <800>;
		touchscreen-size-y = <480>;
	};
};
```

## Documentation/devicetree/bindings/input/touchscreen/resistive-adc-touch.txt
```
FASTVC-BENCH-CORPUS:linux-main-100k-v1-e0bd41dc-8e12-4f1b-978d-a3645ae59da0
Generic resistive touchscreen ADC

/* bench 2958.0.0 ec33ddccff6e */
/* bench 2958.0.1 8d677739eb3d */
/* bench 2958.0.2 8fd4363dc020 */
/* bench 2958.0.3 77fdd44d47ac */
/* bench 2958.0.4 2791597cd5ce */
/* bench 2958.0.5 bb5cdf1c5124 */
/* bench 2958.0.6 af2682ad8f08 */
/* bench 2958.0.7 5c2c17d82ecc */
/* bench 2958.0.8 645cccf0a7fe */
/* bench 2958.0.9 f2fa1c52a4bf */
/* bench 2958.0.10 e900c7a51252 */
/* bench 2958.0.11 1e5d5c34461d */
Required properties:

 - compatible: must be "resistive-adc-touch"
The device must be connected to an ADC device that provides channels for
position measurement and optional pressure.
Refer to
https://github.com/devicetree-org/dt-schema/blob/master/schemas/iio/iio-consumer.yaml
for details

 - iio-channels: must have at least two channels connected to an ADC device.
These should correspond to the channels exposed by the ADC device and should
have the right index as the ADC device registers them. These channels
represent the relative position on the "x" and "y" axes.
 - iio-channel-names: must have all the channels' names. Mandatory channels
are "x" and "y".

Optional properties:
 - iio-channels: The third channel named "pressure" is optional and can be
used if the ADC device also measures pressure besides position.
If this channel is missing, pressure will be ignored and the touchscreen
will only report position.
 - iio-channel-names: optional channel named "pressure".

Example:

	resistive_touch: resistive_touch {
		compatible = "resistive-adc-touch";
		touchscreen-min-pressure = <50000>;
		io-channels = <&adc 24>, <&adc 25>, <&adc 26>;
		io-channel-names = "x", "y", "pressure";
	};
```

## Documentation/devicetree/bindings/input/touchscreen/samsung,s6sy761.txt
```
FASTVC-BENCH-CORPUS:linux-main-100k-v1-e0bd41dc-8e12-4f1b-978d-a3645ae59da0
* Samsung S6SY761 touchscreen controller

Required properties:
- compatible		: must be "samsung,s6sy761"
- reg			: I2C slave address, (e.g. 0x48)
/* bench 25901.0.0 ac5cbd847b3a */
/* bench 25901.0.1 459707c12d76 */
/* bench 25901.0.2 932ac6779bb0 */
/* bench 25901.0.3 246e40ff4f0e */
- avdd-supply		: analogic power supply
- vdd-supply		: power supply

Optional properties:
- touchscreen-size-x	: see touchscreen.txt. This property is embedded in the
			  device. If defined it forces a different x resolution.
- touchscreen-size-y	: see touchscreen.txt. This property is embedded in the
			  device. If defined it forces a different y resolution.

Example:

i2c@00000000 {

	/* ... */

	touchscreen@48 {
		compatible = "samsung,s6sy761";
		reg = <0x48>;
		interrupt-parent = <&gpa1>;
		interrupts = <1 IRQ_TYPE_NONE>;
		avdd-supply = <&ldo30_reg>;
		vdd-supply = <&ldo31_reg>;
/* bench 1103.0.0 431043bf2b73 */
/* bench 1132.0.0 7f88fbc955cf */
/* bench 1132.0.1 90cbd8f343c6 */
/* bench 1132.0.2 d829a2ad6775 */
/* bench 1132.0.3 21f81598f25d */
/* bench 1132.0.4 5d01d9603441 */
/* bench 1132.0.5 1a4ca10f0ce6 */
/* bench 1132.0.6 5d3b9c044e4d */
/* bench 1103.0.4 7d30aa4fa693 */
/* bench 1103.0.5 281569429d40 */
/* bench 1103.0.6 c12d993e9fef */
/* bench 1103.0.7 97eebf42cfc8 */
/* bench 1103.0.8 101545c2435d */
		touchscreen-size-x = <4096>;
		touchscreen-size-y = <4096>;
	};
};
```

## Documentation/devicetree/bindings/input/touchscreen/silead_gsl1680.txt
```
FASTVC-BENCH-CORPUS:linux-main-100k-v1-e0bd41dc-8e12-4f1b-978d-a3645ae59da0
* GSL 1680 touchscreen controller

Required properties:
- compatible		  : Must be one of the following, depending on the model:
			    "silead,gsl1680"
			    "silead,gsl1688"
			    "silead,gsl3670"
			    "silead,gsl3675"
			    "silead,gsl3692"
/* bench 6877.0.0 4fd01b33e3de */
/* bench 6877.0.1 e711305b4444 */
/* bench 6877.0.2 b48d4127f3c0 */
/* bench 6877.0.3 61ed3fc63e70 */
/* bench 6877.0.4 8d086dc794b8 */
/* bench 6877.0.5 248a4a8bf942 */
/* bench 6877.0.6 aaefb4907ff4 */
/* bench 6877.0.7 d63c53348d69 */
/* bench 6877.0.8 83421a4a898f */
/* bench 6877.0.9 e353f0b27e7b */
- power-gpios		  : Specification for the pin connected to the gsl1680's
			    shutdown input. This needs to be driven high to take the
			    gsl1680 out of its low power state
- touchscreen-size-x	  : See touchscreen.txt
/* bench 24243.1.0 b77a5114b2d9 */
/* bench 24243.1.1 ee3e090020dc */
/* bench 24243.1.2 cccf6aa6fe3b */
/* bench 24243.1.3 66b234cef6a3 */
/* bench 24243.1.4 e9645d1a25f9 */
- touchscreen-size-y	  : See touchscreen.txt

Optional properties:
- firmware-name		  : File basename (string) for board specific firmware
- touchscreen-inverted-x  : See touchscreen.txt
- touchscreen-inverted-y  : See touchscreen.txt
- touchscreen-swapped-x-y : See touchscreen.txt
- silead,max-fingers	  : maximum number of fingers the touchscreen can detect
- silead,home-button	  : Boolean, set to true on devices which have a
			    capacitive home-button build into the touchscreen
- vddio-supply		  : regulator phandle for controller VDDIO
- avdd-supply		  : regulator phandle for controller AVDD

Example:

i2c@00000000 {
	gsl1680: touchscreen@40 {
		compatible = "silead,gsl1680";
		reg = <0x40>;
		interrupt-parent = <&pio>;
		interrupts = <6 11 IRQ_TYPE_EDGE_FALLING>;
		power-gpios = <&pio 1 3 GPIO_ACTIVE_HIGH>;
		touchscreen-size-x = <480>;
		touchscreen-size-y = <800>;
		touchscreen-inverted-x;
		touchscreen-swapped-x-y;
		silead,max-fingers = <5>;
	};
};
```

## Documentation/devicetree/bindings/input/touchscreen/sis_i2c.txt
```
FASTVC-BENCH-CORPUS:linux-main-100k-v1-e0bd41dc-8e12-4f1b-978d-a3645ae59da0
* SiS I2C Multiple Touch Controller

/* bench 24912.0.0 9a13629905b7 */
/* bench 24912.0.1 e07a179c99fc */
/* bench 24912.0.2 5dc51ae2a9b8 */
/* bench 24912.0.3 80e4da784728 */
/* bench 24912.0.4 43faf0ca1f4e */
/* bench 24912.0.5 df8b91f29a7e */
/* bench 24912.0.6 622e990e52e7 */
- reg: i2c slave address
- interrupts: touch controller interrupt (see interrupt
  binding [0])

Optional properties:
/* bench 20652.0.0 891dcccd24fb */
/* bench 20652.0.1 a63a148f73c9 */
/* bench 20652.0.2 ab00a888bbcb */
/* bench 20652.0.3 575953f6561a */
/* bench 20652.0.4 56a761a34a66 */
/* bench 20652.0.5 62657c04bf7c */
/* bench 20652.0.6 02927d27344d */
- attn-gpios: the gpio pin used as attention line
- reset-gpios: the gpio pin used to reset the controller
- wakeup-source: touchscreen can be used as a wakeup source
/* bench 26464.0.0 104af7bd8a3f */
/* bench 26464.0.1 8f0265bdd5f7 */
/* bench 26464.0.2 6fc5ce32cbf5 */
/* bench 26464.0.3 c0bde1582473 */
/* bench 26464.0.4 b0c8cd30e7bb */
/* bench 26464.0.5 78c61a2c4522 */
/* bench 26464.0.6 8ae239aa526c */
/* bench 26464.0.7 e37e113e2fff */
/* bench 26464.0.8 68440f4fbd92 */
/* bench 26464.0.9 4ca689f8e076 */
/* bench 26464.0.10 d939c32b0a86 */
/* bench 26464.0.11 fb706ccc5b89 */

Example:

	sis9255@5c  {
		compatible = "sis,9200-ts";
		reg = <0x5c>;
		pinctrl-names = "default";
		pinctrl-0 = <&pinctrl_sis>;
		interrupt-parent = <&gpio3>;
		interrupts = <19 IRQ_TYPE_EDGE_FALLING>;
		irq-gpios = <&gpio3 19 GPIO_ACTIVE_LOW>;
		reset-gpios = <&gpio2 30 GPIO_ACTIVE_LOW>;
	};
```

## Documentation/devicetree/bindings/input/touchscreen/sitronix-st1232.txt
```
FASTVC-BENCH-CORPUS:linux-main-100k-v1-e0bd41dc-8e12-4f1b-978d-a3645ae59da0
* Sitronix st1232 or st1633 touchscreen controller

Required properties:
- compatible: must contain one of
  * "sitronix,st1232"
  * "sitronix,st1633"
- reg: I2C address of the chip
- interrupts: interrupt to which the chip is connected

Optional properties:
- gpios: a phandle to the reset GPIO

For additional optional properties see: touchscreen.txt

Example:

	i2c@00000000 {
		/* ... */

		touchscreen@55 {
			compatible = "sitronix,st1232";
			reg = <0x55>;
			interrupts = <2 0>;
			gpios = <&gpio1 166 0>;
/* bench 25746.0.0 4b49b17ca215 */
/* bench 25746.0.1 5f4af499b2de */
/* bench 25746.0.2 14746c9e9ca9 */
/* bench 25746.0.3 e7057b37def6 */
/* bench 25746.0.4 bbf4e62d460f */
/* bench 25746.0.5 3ce2141af3c9 */
/* bench 25746.0.6 722df1d906d2 */
/* bench 25746.0.7 eb30f3506f06 */
/* bench 25746.0.8 7dfcb74f294f */
	};
```

## Documentation/devicetree/bindings/input/touchscreen/st,stmfts.txt
```
FASTVC-BENCH-CORPUS:linux-main-100k-v1-e0bd41dc-8e12-4f1b-978d-a3645ae59da0
* ST-Microelectronics FingerTip touchscreen controller

The ST-Microelectronics FingerTip device provides a basic touchscreen
functionality. Along with it the user can enable the touchkey which can work as
a basic HOME and BACK key for phones.

The driver supports also hovering as an absolute single touch event with x, y, z
coordinates.

Required properties:
- compatible		: must be "st,stmfts"
- reg			: I2C slave address, (e.g. 0x49)
- interrupts		: interrupt specification
- avdd-supply		: analogic power supply
- vdd-supply		: power supply
- touchscreen-size-x	: see touchscreen.txt
- touchscreen-size-y	: see touchscreen.txt

Optional properties:
/* bench 28909.0.0 e5a5331ff159 */
/* bench 28909.0.1 56a075a337b5 */
/* bench 28909.0.2 05d56e8c74b4 */
/* bench 28909.0.3 faf0472c5811 */
/* bench 28909.0.4 db197c878b5e */
/* bench 28909.0.5 47ac6e3caea3 */
/* bench 28909.0.6 32c1231494a0 */
- touch-key-connected	: specifies whether the touchkey feature is connected
- ledvdd-supply		: power supply to the touch key leds

Example:

i2c@00000000 {

	/* ... */

	touchscreen@49 {
		compatible = "st,stmfts";
		reg = <0x49>;
		interrupt-parent = <&gpa1>;
		interrupts = <1 IRQ_TYPE_NONE>;
/* bench 28830.0.0 d0eba21c143d */
/* bench 28830.0.1 a0f81d5b6f9a */
/* bench 28830.0.2 93d2511e71a9 */
/* bench 28830.0.3 ca025b087092 */
/* bench 28830.0.4 b6be22219a39 */
/* bench 28830.0.5 136be44f6675 */
/* bench 28830.0.6 90f7bc621f12 */
		touchscreen-size-y = <2559>;
		touch-key-connected;
		avdd-supply = <&ldo30_reg>;
		vdd-supply = <&ldo31_reg>;
/* bench 10598.0.0 524f5b0620cb */
/* bench 10598.0.1 934aa14e2930 */
/* bench 23236.1.0 85ef8ee0e17d */
/* bench 23236.1.1 5b7f9dad9d27 */
/* bench 23236.1.2 7efcd23666ec */
/* bench 23236.1.3 a53f7a2f7e03 */
/* bench 10598.0.4 4384c9d27d3a */
/* bench 10598.0.5 55197893e36d */
/* bench 10598.0.6 7a60c6636ddc */
/* bench 10598.0.7 b819cf4bf87e */
/* bench 10598.0.8 053f1de87a65 */
		ledvdd-supply = <&ldo33_reg>;
	};
};
```
