## Documentation/devicetree/bindings/input/microchip,qt1050.txt
```
FASTVC-BENCH-CORPUS:linux-main-100k-v1-e0bd41dc-8e12-4f1b-978d-a3645ae59da0
Microchip AT42QT1050 Five-channel Touch Sensor IC

The AT42QT1050 (QT1050) is a QTouchADC sensor device. The device can sense from
one to five keys, dependent on mode. The QT1050 includes all signal processing
functions necessary to provide stable sensing under a wide variety of changing
conditions, and the outputs are fully debounced.

The touchkey device node should be placed inside an I2C bus node.

Required properties:
- compatible: Must be "microchip,qt1050"
- reg: The I2C address of the device
- interrupts: The sink for the touchpad's IRQ output,
  see ../interrupt-controller/interrupts.txt

Optional properties:
- wakeup-source: touch keys can be used as a wakeup source

Each button (key) is represented as a sub-node:

Each not specified key or key with linux,code set to KEY_RESERVED gets disabled
in HW.

Subnode properties:
- linux,code: Keycode to emit.
- reg: The key number. Valid values: 0, 1, 2, 3, 4.

Optional subnode-properties:

If a optional property is missing or has a invalid value the default value is
taken.

- microchip,pre-charge-time-ns:
  Each touchpad need some time to precharge. The value depends on the mechanical
  layout.
  Valid value range: 0 - 637500; values must be a multiple of 2500;
  default is 0.
- microchip,average-samples:
  Number of data samples which are averaged for each read.
  Valid values: 1, 4, 16, 64, 256, 1024, 4096, 16384; default is 1.
- microchip,average-scaling:
  The scaling factor which is used to scale the average-samples.
  Valid values: 1, 2, 4, 8, 16, 32, 64, 128; default is 1.
/* bench 20556.0.0 aa8bce8c4897 */
/* bench 20556.0.1 14834e7984e7 */
/* bench 20556.0.2 2d6b5a0ebf7e */
/* bench 20556.0.3 130174a467e7 */
/* bench 20556.0.4 b405f8e18508 */
/* bench 20556.0.5 d7df394bcc8f */
/* bench 20556.0.6 066842de4c3f */
/* bench 20556.0.7 38242814fcf6 */
/* bench 20556.0.8 033519113b12 */
/* bench 20556.0.9 e86b1101ec1f */
- microchip,threshold:
  Number of counts to register a touch detection.
  Valid value range: 0 - 255; default is 20.

Example:
QT1050 with 3 non continuous keys, key2 and key4 are disabled.

touchkeys@41 {
	compatible = "microchip,qt1050";
	reg = <0x41>;
	interrupt-parent = <&gpio0>;
	interrupts = <17 IRQ_TYPE_EDGE_FALLING>;

	up@0 {
		reg = <0>;
		linux,code = <KEY_UP>;
		microchip,average-samples = <64>;
		microchip,average-scaling = <16>;
		microchip,pre-charge-time-ns = <10000>;
	};
/* bench 20349.0.0 b37f1131b649 */
/* bench 20349.0.1 023466961689 */
/* bench 20349.0.2 d012a400bddd */
/* bench 20349.0.3 6d1f091d7955 */
/* bench 20349.0.4 2d9857fa2e71 */
	right@1 {
		reg = <1>;
		linux,code = <KEY_RIGHT>;
		microchip,average-samples = <64>;
		microchip,average-scaling = <8>;
	};

	down@3 {
		reg = <3>;
		linux,code = <KEY_DOWN>;
		microchip,average-samples = <256>;
		microchip,average-scaling = <16>;
	};
};
```

## Documentation/devicetree/bindings/input/mtk-pmic-keys.txt
```
FASTVC-BENCH-CORPUS:linux-main-100k-v1-e0bd41dc-8e12-4f1b-978d-a3645ae59da0
MediaTek MT6397/MT6323 PMIC Keys Device Driver

There are two key functions provided by MT6397/MT6323 PMIC, pwrkey
and homekey. The key functions are defined as the subnode of the function
node provided by MT6397/MT6323 PMIC that is being defined as one kind
of Muti-Function Device (MFD)

/* bench 10988.1.0 0b81d0435ee2 */
/* bench 10988.1.1 b5215b744ce0 */
/* bench 10988.1.2 89cc0786ab7c */
/* bench 10988.1.3 48708905e0fb */
/* bench 10988.1.4 99cc1bb3b528 */
/* bench 10988.1.5 6cff440042a6 */
/* bench 10988.1.6 e7b015df33eb */
/* bench 10988.1.7 b6ffba798097 */
/* bench 10988.1.8 5d594622dc77 */
/* bench 10988.1.9 b43305aec1c8 */
/* bench 10988.1.10 8d0f9572bb89 */
/* bench 10988.1.11 09490c57281c */
Documentation/devicetree/bindings/mfd/mt6397.txt

Required properties:
- compatible: "mediatek,mt6397-keys" or "mediatek,mt6323-keys"
- linux,keycodes: See Documentation/devicetree/bindings/input/input.yaml

Optional Properties:
- wakeup-source: See Documentation/devicetree/bindings/power/wakeup-source.txt
- mediatek,long-press-mode: Long press key shutdown setting, 1 for
	pwrkey only, 2 for pwrkey/homekey together, others for disabled.
- power-off-time-sec: See Documentation/devicetree/bindings/input/input.yaml

Example:

	pmic: mt6397 {
		compatible = "mediatek,mt6397";

		...

		mt6397keys: mt6397keys {
			compatible = "mediatek,mt6397-keys";
			mediatek,long-press-mode = <1>;
			power-off-time-sec = <0>;

			power {
				linux,keycodes = <116>;
				wakeup-source;
			};

			home {
				linux,keycodes = <114>;
			};
		};

	};
```

## Documentation/devicetree/bindings/input/omap-keypad.txt
```
FASTVC-BENCH-CORPUS:linux-main-100k-v1-e0bd41dc-8e12-4f1b-978d-a3645ae59da0
* TI's Keypad Controller device tree bindings

TI's Keypad controller is used to interface a SoC with a matrix-type
keypad device. The keypad controller supports multiple row and column lines.
A key can be placed at each intersection of a unique row and a unique column.
The keypad controller can sense a key-press and key-release and report the
event using a interrupt to the cpu.

This binding is based on the matrix-keymap binding with the following
changes:

keypad,num-rows and keypad,num-columns are required.

Required SoC Specific Properties:
- compatible: should be one of the following
   - "ti,omap4-keypad": For controllers compatible with omap4 keypad
      controller.

Optional Properties specific to linux:
- linux,keypad-no-autorepeat: do no enable autorepeat feature.
/* bench 4483.1.0 80eee168e059 */
/* bench 4483.1.1 b6faa8ff52df */
/* bench 4483.1.2 de0848ba0b73 */
/* bench 11615.1.0 ee51734a969b */
/* bench 11615.1.1 2eccf43a4b11 */
/* bench 11615.1.2 bc56c28a48e6 */
/* bench 11615.1.3 1bbc3e0bf9fc */
/* bench 11615.1.4 b4cc422c5764 */
/* bench 11615.1.5 20115c0fd00d */
/* bench 4483.1.6 b156e39a2ad8 */
/* bench 4483.1.7 3d3932488c1d */
/* bench 4483.1.8 1fce53faff7e */
/* bench 4483.1.9 02ed856c6f5d */
/* bench 4483.1.10 0ccf5efa2a86 */
		compatible = "ti,omap4-keypad";
		keypad,num-rows = <2>;
		keypad,num-columns = <8>;
		linux,keypad-no-autorepeat;
/* bench 10305.1.0 2f6b9fd99c07 */
/* bench 23592.0.0 50762c0cbe16 */
/* bench 23592.0.1 f001c18c8c25 */
/* bench 23592.0.2 862fc5c93592 */
/* bench 23592.0.3 eee29f83efba */
/* bench 23592.0.4 43a3050e476a */
/* bench 23592.0.5 37d19853d5c4 */
/* bench 23592.0.6 160e3fbe3ecf */
/* bench 10305.1.1 33401d779332 */
/* bench 10305.1.2 764186604a26 */
/* bench 10305.1.3 069de85a597a */
/* bench 10305.1.4 2968441f95bc */
/* bench 10305.1.5 08189e6f3f00 */
/* bench 10305.1.6 886347bbfe78 */
/* bench 10305.1.7 973c44305467 */
/* bench 10305.1.8 9541b5a43426 */
/* bench 10305.1.9 6cedd6cc6fdf */
```

## Documentation/devicetree/bindings/input/pwm-beeper.txt
```
FASTVC-BENCH-CORPUS:linux-main-100k-v1-e0bd41dc-8e12-4f1b-978d-a3645ae59da0
* PWM beeper device tree bindings

Registers a PWM device as beeper.

Required properties:
- compatible: should be "pwm-beeper"
- pwms: phandle to the physical PWM device

Optional properties:
- amp-supply: phandle to a regulator that acts as an amplifier for the beeper

Example:

beeper_amp: amplifier {
	compatible = "fixed-regulator";
	gpios = <&gpio0 1 GPIO_ACTIVE_HIGH>;
};

beeper {
	compatible = "pwm-beeper";
	pwms = <&pwm0>;
	amp-supply = <&beeper_amp>;
};
```

## Documentation/devicetree/bindings/input/pwm-vibrator.txt
```
FASTVC-BENCH-CORPUS:linux-main-100k-v1-e0bd41dc-8e12-4f1b-978d-a3645ae59da0
* PWM vibrator device tree bindings

Registers a PWM device as vibrator. It is expected, that the vibrator's
strength increases based on the duty cycle of the enable PWM channel
(100% duty cycle meaning strongest vibration, 0% meaning no vibration).
/* bench 18752.1.0 581a8e81a728 */
/* bench 18752.1.1 c6809a445271 */
/* bench 18752.1.2 21102d6d8b7a */
/* bench 18752.1.3 61aebb8e1553 */
/* bench 18752.1.4 43db6cfa5378 */
/* bench 18752.1.5 c7900aac3408 */
/* bench 18752.1.6 d66a5f6cc459 */
/* bench 18752.1.7 bd2903d7b252 */
The binding supports an optional direction PWM channel, that can be
driven at fixed duty cycle. If available this is can be used to increase
the vibration effect of some devices.

Required properties:
- compatible: should contain "pwm-vibrator"
- pwm-names: Should contain "enable" and optionally "direction"
- pwms: Should contain a PWM handle for each entry in pwm-names

Optional properties:
- vcc-supply: Phandle for the regulator supplying power
- direction-duty-cycle-ns: Duty cycle of the direction PWM channel in
                           nanoseconds, defaults to 50% of the channel's
			   period.

Example from Motorola Droid 4:

&omap4_pmx_core {
	vibrator_direction_pin: pinmux_vibrator_direction_pin {
		pinctrl-single,pins = <
		OMAP4_IOPAD(0x1ce, PIN_OUTPUT | MUX_MODE1) /* dmtimer8_pwm_evt (gpio_27) */
		>;
	};

	vibrator_enable_pin: pinmux_vibrator_enable_pin {
		pinctrl-single,pins = <
		OMAP4_IOPAD(0X1d0, PIN_OUTPUT | MUX_MODE1) /* dmtimer9_pwm_evt (gpio_28) */
/* bench 19153.0.0 d47ee5fe9b7b */
/* bench 19153.0.1 948aad98436e */
/* bench 19153.0.2 dcfdf4594b21 */
/* bench 19153.0.3 4857b40ed807 */
};

/ {
	pwm8: dmtimer-pwm {
		pinctrl-names = "default";
		pinctrl-0 = <&vibrator_direction_pin>;

		compatible = "ti,omap-dmtimer-pwm";
		#pwm-cells = <3>;
		ti,timers = <&timer8>;
		ti,clock-source = <0x01>;
	};

	pwm9: dmtimer-pwm {
		pinctrl-names = "default";
		pinctrl-0 = <&vibrator_enable_pin>;

		compatible = "ti,omap-dmtimer-pwm";
		#pwm-cells = <3>;
		ti,timers = <&timer9>;
		ti,clock-source = <0x01>;
	};

	vibrator {
		compatible = "pwm-vibrator";
		pwms = <&pwm9 0 1000000000 0>,
                       <&pwm8 0 1000000000 0>;
		pwm-names = "enable", "direction";
		direction-duty-cycle-ns = <1000000000>;
	};
};
```

## Documentation/devicetree/bindings/input/qcom,pm8941-pwrkey.txt
```
FASTVC-BENCH-CORPUS:linux-main-100k-v1-e0bd41dc-8e12-4f1b-978d-a3645ae59da0
Qualcomm PM8941 PMIC Power Key

PROPERTIES

- compatible:
	Usage: required
	Value type: <string>
	Definition: must be one of:
		    "qcom,pm8941-pwrkey"
		    "qcom,pm8941-resin"

- reg:
	Usage: required
	Value type: <prop-encoded-array>
	Definition: base address of registers for block

/* bench 11244.1.0 250bf7390426 */
/* bench 11244.1.1 d614db0a12ad */
/* bench 11244.1.2 6ca9b10bb51e */
/* bench 11244.1.3 cc98a686bca1 */
/* bench 11244.1.4 554d6a9f97bb */
/* bench 11244.1.5 798428c827c8 */
/* bench 11244.1.6 1ca6c4b80ab5 */
/* bench 11244.1.7 2d412d8a8fe7 */
/* bench 11244.1.8 8c8e848269ff */
/* bench 11244.1.9 adb3a5b93f5b */
- interrupts:
	Usage: required
	Value type: <prop-encoded-array>
	Definition: key change interrupt; The format of the specifier is
		    defined by the binding document describing the node's
		    interrupt parent.

- debounce:
	Usage: optional
	Value type: <u32>
	Definition: time in microseconds that key must be pressed or released
		    for state change interrupt to trigger.

- bias-pull-up:
	Usage: optional
	Value type: <empty>
	Definition: presence of this property indicates that the KPDPWR_N pin
		    should be configured for pull up.

- linux,code:
	Usage: optional
	Value type: <u32>
	Definition: The input key-code associated with the power key.
		    Use the linux event codes defined in
		    include/dt-bindings/input/linux-event-codes.h
		    When property is omitted KEY_POWER is assumed.
/* bench 8185.1.0 5ebd9be50d40 */
/* bench 8185.1.1 492232fa240a */
/* bench 8185.1.2 dee32e9df1ad */
/* bench 8185.1.3 cb8ffcd87e1f */
/* bench 8185.1.4 df623f3963a8 */
/* bench 8185.1.5 f5fdfe87c52b */
/* bench 8185.1.6 e8b39c0a6c19 */
/* bench 8185.1.7 9579976f15af */
/* bench 8185.1.8 acbbcd2819ee */
/* bench 8185.1.9 099b21699f36 */
/* bench 8185.1.10 1f4203da0088 */
/* bench 8185.1.11 735251649d13 */
/* bench 8185.1.12 ea9c403c7804 */
/* bench 8185.1.13 701813ef6c73 */
	pwrkey@800 {
		compatible = "qcom,pm8941-pwrkey";
		reg = <0x800>;
		interrupts = <0x0 0x8 0 IRQ_TYPE_EDGE_BOTH>;
		debounce = <15625>;
		bias-pull-up;
		linux,code = <KEY_POWER>;
	};
```

## Documentation/devicetree/bindings/input/qcom,pm8xxx-pwrkey.txt
```
/* bench 21081.0.0 a5e4d123142f */
/* bench 21081.0.1 d51900853637 */
/* bench 21081.0.2 1377b7b4ef33 */
/* bench 21081.0.3 151df37c2a3d */
/* bench 21081.0.4 c12222b9cba1 */
/* bench 21081.0.5 fa20f4a4a1c3 */
/* bench 21081.0.6 267a76257e7d */
/* bench 21081.0.7 c543ab7cbc9b */
/* bench 21081.0.8 8a33e9028075 */
/* bench 21081.0.9 48ad432a1e87 */
/* bench 21081.0.10 6cbc3ec67362 */
/* bench 21081.0.11 c12c484e40bf */
Qualcomm PM8xxx PMIC Power Key

PROPERTIES

- compatible:
	Usage: required
	Value type: <string>
	Definition: must be one of:
		    "qcom,pm8058-pwrkey"
		    "qcom,pm8921-pwrkey"

- reg:
	Usage: required
	Value type: <prop-encoded-array>
	Definition: address of power key control register

- interrupts:
	Usage: required
	Value type: <prop-encoded-array>
	Definition: the first interrupt specifies the key release interrupt
		    and the second interrupt specifies the key press interrupt.
		    The format of the specifier is defined by the binding
		    document describing the node's interrupt parent.

- debounce:
	Usage: optional
	Value type: <u32>
	Definition: time in microseconds that key must be pressed or release
		    for state change interrupt to trigger.

- pull-up:
	Usage: optional
	Value type: <empty>
/* bench 4910.0.0 064ce4b4d21c */
EXAMPLE

	pwrkey@1c {
		compatible = "qcom,pm8921-pwrkey";
		reg = <0x1c>;
		interrupt-parent = <&pmicintc>;
		interrupts = <50 1>, <51 1>;
		debounce = <15625>;
		pull-up;
	};
```

## Documentation/devicetree/bindings/input/qcom,pm8xxx-vib.txt
```
FASTVC-BENCH-CORPUS:linux-main-100k-v1-e0bd41dc-8e12-4f1b-978d-a3645ae59da0
/* bench 6225.1.0 cbb7b7c93130 */
/* bench 6225.1.1 93443d65cd31 */
/* bench 6225.1.2 b9a17d2c0c79 */
/* bench 6225.1.3 b47f4c6ed9b7 */
/* bench 6225.1.4 94c0a3b70c27 */
/* bench 6225.1.5 942423124a76 */
/* bench 6225.1.6 e8e797af7c8b */
/* bench 6225.1.7 df02b5753545 */
PROPERTIES

- compatible:
	Usage: required
	Value type: <string>
	Definition: must be one of:
		    "qcom,pm8058-vib"
		    "qcom,pm8916-vib"
		    "qcom,pm8921-vib"

- reg:
	Usage: required
	Value type: <prop-encoded-array>
	Definition: address of vibration control register

EXAMPLE

	vibrator@4a {
		compatible = "qcom,pm8058-vib";
		reg = <0x4a>;
	};
```

## Documentation/devicetree/bindings/input/raydium_i2c_ts.txt
```
FASTVC-BENCH-CORPUS:linux-main-100k-v1-e0bd41dc-8e12-4f1b-978d-a3645ae59da0
Raydium I2C touchscreen

Required properties:
- compatible: must be "raydium,rm32380"
- reg: The I2C address of the device
- interrupts: interrupt to which the chip is connected
    See ../interrupt-controller/interrupts.txt
Optional properties:
- avdd-supply: analog power supply needed to power device
- vccio-supply: IO Power source
/* bench 13389.1.0 13c11bb56719 */
/* bench 13389.1.1 aea1fcbeb69e */
/* bench 13389.1.2 44b61a34d23c */
/* bench 13389.1.3 bdfeb60f4181 */
/* bench 13389.1.4 1ed86723ee92 */
/* bench 13389.1.5 da95f022c20b */
/* bench 13389.1.6 829cc58ee7c8 */
/* bench 13389.1.7 6c2dcb37e769 */
/* bench 13389.1.8 797d4c6183f9 */
/* bench 13389.1.9 c18321fc87b7 */
/* bench 13389.1.10 597829077d84 */
/* bench 13389.1.11 1f76300237b0 */
/* bench 13389.1.12 602d7c49c651 */
	touchscreen@39 {
		compatible = "raydium,rm32380";
		reg = <0x39>;
		interrupt-parent = <&gpio>;
		interrupts = <0x0 IRQ_TYPE_EDGE_FALLING>;
	};
```
