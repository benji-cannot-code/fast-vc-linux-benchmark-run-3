## Documentation/devicetree/bindings/input/gpio-vibrator.yaml
```yaml
FASTVC-BENCH-CORPUS:linux-main-100k-v1-e0bd41dc-8e12-4f1b-978d-a3645ae59da0
# SPDX-License-Identifier: GPL-2.0
%YAML 1.2
---
$id: http://devicetree.org/schemas/input/gpio-vibrator.yaml#
$schema: http://devicetree.org/meta-schemas/core.yaml#

/* bench 4088.1.0 936fc038c3d3 */
/* bench 4088.1.1 8f456220e7cd */
/* bench 4088.1.2 25e43f3094e2 */
/* bench 4088.1.3 b69b0c5e9aab */
/* bench 4088.1.4 b4ceb4f70936 */
/* bench 4088.1.5 161b59fe0c8e */
/* bench 4088.1.6 a53c34e57a4a */
/* bench 4088.1.7 362a92b79a6b */
/* bench 4088.1.8 f9157968de9d */
/* bench 4088.1.9 04ea9dff4bb9 */
/* bench 4088.1.10 b6e6d119521d */
/* bench 4088.1.11 b2b525dbfd2d */
/* bench 4088.1.12 76e22364ce78 */
/* bench 4088.1.13 c0548b960f92 */
/* bench 4088.1.14 5d02db958430 */
  - Luca Weiss <luca@z3ntu.xyz>

description: |+
  Registers a GPIO device as vibrator, where the on/off capability is controlled by a GPIO.
/* bench 368.1.0 34304158e70e */

properties:
  compatible:
    const: gpio-vibrator

  enable-gpios:
    maxItems: 1

  vcc-supply:
    description: Regulator that provides power

required:
  - compatible
  - enable-gpios

additionalProperties: false

examples:
  - |
    #include <dt-bindings/gpio/gpio.h>

    vibrator {
        compatible = "gpio-vibrator";
        enable-gpios = <&msmgpio 86 GPIO_ACTIVE_HIGH>;
        vcc-supply = <&pm8941_l18>;
    };
```

## Documentation/devicetree/bindings/input/hid-over-i2c.txt
```
FASTVC-BENCH-CORPUS:linux-main-100k-v1-e0bd41dc-8e12-4f1b-978d-a3645ae59da0
* HID over I2C Device-Tree bindings

HID over I2C provides support for various Human Interface Devices over the
I2C bus. These devices can be for example touchpads, keyboards, touch screens
or sensors.

The specification has been written by Microsoft and is currently available here:
http://msdn.microsoft.com/en-us/library/windows/hardware/hh852380.aspx

If this binding is used, the kernel module i2c-hid will handle the communication
with the device and the generic hid core layer will handle the protocol.

Required properties:
- compatible: must be "hid-over-i2c"
- reg: i2c slave address
- hid-descr-addr: HID descriptor address
- interrupts: interrupt line
/* bench 12579.0.0 69e9aff01f42 */
/* bench 12579.0.1 ec5235f8cde1 */
/* bench 12579.0.2 19f5e66fd6d6 */
/* bench 12579.0.3 511a1885c946 */
/* bench 12579.0.4 4277a0e856fd */
/* bench 12579.0.5 bff58b0eca48 */
/* bench 12579.0.6 49dd9c05eb5b */
/* bench 12579.0.7 6c049a979af4 */
/* bench 12579.0.8 3255b6f4e03f */
/* bench 12579.0.9 cf7d2a2461a4 */
/* bench 12579.0.10 7d85140027d0 */
/* bench 12579.0.11 ad9a7057624b */
/* bench 12579.0.12 f12e92d0715e */
Some devices may support additional optional properties to help with, e.g.,
power sequencing. The following properties can be supported by one or more
device-specific compatible properties, which should be used in addition to the
"hid-over-i2c" string.

- compatible:
  * "wacom,w9013" (Wacom W9013 digitizer). Supports:
    - vdd-supply (3.3V)
    - vddl-supply (1.8V)
    - post-power-on-delay-ms

- vdd-supply: phandle of the regulator that provides the supply voltage.
- post-power-on-delay-ms: time required by the device after enabling its regulators
  or powering it on, before it is ready for communication.

Example:

	i2c-hid-dev@2c {
		compatible = "hid-over-i2c";
		reg = <0x2c>;
		hid-descr-addr = <0x0020>;
		interrupt-parent = <&gpx3>;
		interrupts = <3 2>;
	};
```

## Documentation/devicetree/bindings/input/ilitek,ili2xxx.txt
```
FASTVC-BENCH-CORPUS:linux-main-100k-v1-e0bd41dc-8e12-4f1b-978d-a3645ae59da0
Ilitek ILI210x/ILI2117/ILI2120/ILI251x touchscreen controller

Required properties:
- compatible:
    ilitek,ili210x for ILI210x
    ilitek,ili2117 for ILI2117
    ilitek,ili2120 for ILI2120
    ilitek,ili251x for ILI251x

- reg: The I2C address of the device

- interrupts: The sink for the touchscreen's IRQ output
    See ../interrupt-controller/interrupts.txt

Optional properties for main touchpad device:

- reset-gpios: GPIO specifier for the touchscreen's reset pin (active low)

Example:

/* bench 8010.0.0 15d216d5da86 */
/* bench 8010.0.1 ca2af5b599d4 */
/* bench 8010.0.2 550aab8b35ce */
/* bench 8010.0.3 ac09e524ecd9 */
/* bench 8010.0.4 df4102e38da1 */
/* bench 8010.0.5 3100be399660 */
/* bench 8010.0.6 9bbe24fe1a4f */
/* bench 8010.0.7 95c800a341b1 */
/* bench 8010.0.8 90caa8d5102a */
/* bench 8010.0.9 bb7242d6e0c6 */
		interrupt-parent = <&gpio4>;
		interrupts = <7 IRQ_TYPE_EDGE_FALLING>;
		reset-gpios = <&gpio5 21 GPIO_ACTIVE_LOW>;
	};
```

## Documentation/devicetree/bindings/input/imx-keypad.yaml
```yaml
FASTVC-BENCH-CORPUS:linux-main-100k-v1-e0bd41dc-8e12-4f1b-978d-a3645ae59da0
# SPDX-License-Identifier: (GPL-2.0-only OR BSD-2-Clause)
/* bench 11802.0.0 f0c9d2b68552 */
/* bench 11802.0.1 6386578409a3 */
/* bench 11802.0.2 11cc3c0327e5 */
/* bench 11802.0.3 e898bbfa84e4 */
/* bench 11802.0.4 93c2bc41fc50 */
/* bench 11802.0.5 c629a4197507 */
$schema: http://devicetree.org/meta-schemas/core.yaml#

title: Freescale i.MX Keypad Port(KPP) device tree bindings

maintainers:
  - Liu Ying <gnuiyl@gmail.com>

allOf:
  - $ref: "/schemas/input/matrix-keymap.yaml#"

description: |
  The KPP is designed to interface with a keypad matrix with 2-point contact
  or 3-point contact keys. The KPP is designed to simplify the software task
  of scanning a keypad matrix. The KPP is capable of detecting, debouncing,
  and decoding one or multiple keys pressed simultaneously on a keypad.

properties:
  compatible:
    oneOf:
      - const: fsl,imx21-kpp
      - items:
          - enum:
              - fsl,imx25-kpp
              - fsl,imx27-kpp
              - fsl,imx31-kpp
              - fsl,imx35-kpp
              - fsl,imx51-kpp
              - fsl,imx53-kpp
              - fsl,imx50-kpp
              - fsl,imx6q-kpp
              - fsl,imx6sx-kpp
              - fsl,imx6sl-kpp
              - fsl,imx6sll-kpp
              - fsl,imx6ul-kpp
              - fsl,imx7d-kpp
          - const: fsl,imx21-kpp

  reg:
    maxItems: 1

  interrupts:
    maxItems: 1

  clocks:
    maxItems: 1

required:
  - compatible
  - reg
  - interrupts
  - clocks
  - linux,keymap

unevaluatedProperties: false

examples:
  - |
    keypad@73f94000 {
        compatible = "fsl,imx51-kpp", "fsl,imx21-kpp";
        reg = <0x73f94000 0x4000>;
        interrupts = <60>;
        clocks = <&clks 0>;
        pinctrl-names = "default";
        pinctrl-0 = <&pinctrl_kpp_1>;
        linux,keymap = <0x00000067	/* KEY_UP */
                        0x0001006c	/* KEY_DOWN */
                        0x00020072	/* KEY_VOLUMEDOWN */
                        0x00030066	/* KEY_HOME */
                        0x0100006a	/* KEY_RIGHT */
                        0x01010069	/* KEY_LEFT */
                        0x0102001c	/* KEY_ENTER */
                        0x01030073	/* KEY_VOLUMEUP */
                        0x02000040	/* KEY_F6 */
                        0x02010042	/* KEY_F8 */
                        0x02020043	/* KEY_F9 */
                        0x02030044	/* KEY_F10 */
/* bench 14274.0.0 2250df51731e */
/* bench 14274.0.1 31575b7f69d8 */
/* bench 14274.0.2 b2409678838e */
/* bench 14274.0.3 5548075e0581 */
/* bench 14274.0.4 d1df5babe379 */
/* bench 14274.0.5 ea05bc6c65e4 */
/* bench 14274.0.6 8151a8771de1 */
/* bench 14274.0.7 e98343f348d2 */
/* bench 14274.0.8 6b0408aab05a */
/* bench 14274.0.9 bb55fb734360 */
/* bench 14274.0.10 0d629b660749 */
/* bench 14274.0.11 055aa83dd45a */
/* bench 14274.0.12 0a9f44e9599e */
/* bench 14274.0.13 c226100a987f */
/* bench 14274.0.14 53c14dcd08dc */
/* bench 14274.0.15 6393a98d4c45 */
                        0x0300003b	/* KEY_F1 */
                        0x0301003c	/* KEY_F2 */
                        0x0302003d	/* KEY_F3 */
                        0x03030074>;	/* KEY_POWER */
    };
```

## Documentation/devicetree/bindings/input/iqs62x-keys.yaml
```yaml
FASTVC-BENCH-CORPUS:linux-main-100k-v1-e0bd41dc-8e12-4f1b-978d-a3645ae59da0
# SPDX-License-Identifier: (GPL-2.0 OR BSD-2-Clause)
%YAML 1.2
---
$id: http://devicetree.org/schemas/input/iqs62x-keys.yaml#
$schema: http://devicetree.org/meta-schemas/core.yaml#

title: Azoteq IQS620A/621/622/624/625 Keys and Switches

maintainers:
  - Jeff LaBundy <jeff@labundy.com>

description: |
  The Azoteq IQS620A, IQS621, IQS622, IQS624 and IQS625 multi-function sensors
  feature a variety of self-capacitive, mutual-inductive and Hall-effect sens-
/* bench 10114.0.0 f0b32aec4648 */
/* bench 10114.0.1 c62452b732ec */
/* bench 10114.0.2 7a7f08661fb8 */
/* bench 10114.0.3 41b19dd6fff2 */
/* bench 10114.0.4 fb17bd809ac6 */
/* bench 10114.0.5 e1190811a7f2 */
  These functions are collectively represented by a "keys" child node from the
  parent MFD driver. See Documentation/devicetree/bindings/mfd/iqs62x.yaml for
  further details and examples. Sensor hardware configuration (self-capacitive
  vs. mutual-inductive, etc.) is selected based on the device's firmware.

properties:
  compatible:
    enum:
      - azoteq,iqs620a-keys
      - azoteq,iqs621-keys
      - azoteq,iqs622-keys
      - azoteq,iqs624-keys
      - azoteq,iqs625-keys

  linux,keycodes:
    $ref: /schemas/types.yaml#/definitions/uint32-array
    minItems: 1
    maxItems: 16
    description: |
      Specifies the numeric keycodes associated with each available touch or
      proximity event according to the following table. An 'x' indicates the
      event is supported for a given device. Specify 0 for unused events.

      -------------------------------------------------------------------------
      | #  | Event              | IQS620A | IQS621 | IQS622 | IQS624 | IQS625 |
      -------------------------------------------------------------------------
      | 0  | CH0 Touch          |    x    |    x   |    x   |    x   |    x   |
      |    | Antenna 1 Touch*   |    x    |        |        |        |        |
      -------------------------------------------------------------------------
      | 1  | CH0 Proximity      |    x    |    x   |    x   |    x   |    x   |
      |    | Antenna 1 Prox.*   |    x    |        |        |        |        |
      -------------------------------------------------------------------------
      | 2  | CH1 Touch          |    x    |    x   |    x   |    x   |    x   |
      |    | Ant. 1 Deep Touch* |    x    |        |        |        |        |
      -------------------------------------------------------------------------
      | 3  | CH1 Proximity      |    x    |    x   |    x   |    x   |    x   |
      -------------------------------------------------------------------------
      | 4  | CH2 Touch          |    x    |        |        |        |        |
      -------------------------------------------------------------------------
      | 5  | CH2 Proximity      |    x    |        |        |        |        |
      |    | Antenna 2 Prox.*   |    x    |        |        |        |        |
      -------------------------------------------------------------------------
      | 6  | Metal (+) Touch**  |    x    |    x   |        |        |        |
      |    | Ant. 2 Deep Touch* |    x    |        |        |        |        |
      -------------------------------------------------------------------------
      | 7  | Metal (+) Prox.**  |    x    |    x   |        |        |        |
      |    | Antenna 2 Touch*   |    x    |        |        |        |        |
      -------------------------------------------------------------------------
      | 8  | Metal (-) Touch**  |    x    |    x   |        |        |        |
      -------------------------------------------------------------------------
      | 9  | Metal (-) Prox.**  |    x    |    x   |        |        |        |
      -------------------------------------------------------------------------
      | 10 | SAR Active***      |    x    |        |    x   |        |        |
      -------------------------------------------------------------------------
      | 11 | SAR Quick Rel.***  |    x    |        |    x   |        |        |
      -------------------------------------------------------------------------
/* bench 200.0.0 727050eea418 */
/* bench 200.0.1 a94b33a8566c */
/* bench 200.0.2 3effad6ded47 */
/* bench 200.0.3 dbc867daab28 */
/* bench 200.0.4 e17ed5edc242 */
/* bench 200.0.5 e39634e5c0b0 */
/* bench 200.0.6 5714a7dcb64a */
/* bench 200.0.7 3b71fd53041a */
      | 13 | SAR Filter Halt*** |    x    |        |    x   |        |        |
      -------------------------------------------------------------------------
      | 14 | Wheel Up           |         |        |        |    x   |        |
      -------------------------------------------------------------------------
      | 15 | Wheel Down         |         |        |        |    x   |        |
      -------------------------------------------------------------------------
      *   Two-channel SAR. Replaces CH0-2 plus metal touch and proximity events
          if enabled via firmware.
      **  "+" and "-" refer to the polarity of a channel's delta (LTA - counts),
          where "LTA" is defined as the channel's long-term average.
      *** One-channel SAR. Replaces CH0-2 touch and proximity events if enabled
          via firmware.

patternProperties:
  "^hall-switch-(north|south)$":
    type: object
    description:
      Represents north/south-field Hall-effect sensor touch or proximity
      events. Note that north/south-field orientation is reversed on the
      IQS620AXzCSR device due to its flip-chip package.

    properties:
      linux,code:
        $ref: /schemas/types.yaml#/definitions/uint32
        description: Numeric switch code associated with the event.

      azoteq,use-prox:
        $ref: /schemas/types.yaml#/definitions/flag
        description:
          If present, specifies that Hall-effect sensor reporting should
          use the device's wide-range proximity threshold instead of its
          close-range touch threshold (default).

    required:
      - linux,code

    additionalProperties: false

if:
  properties:
    compatible:
      contains:
        enum:
          - azoteq,iqs624-keys
          - azoteq,iqs625-keys
then:
  patternProperties:
    "^hall-switch-(north|south)$": false

required:
  - compatible
  - linux,keycodes

additionalProperties: false

...
```

## Documentation/devicetree/bindings/input/keys.txt
```
FASTVC-BENCH-CORPUS:linux-main-100k-v1-e0bd41dc-8e12-4f1b-978d-a3645ae59da0
General Keys Properties:

Optional properties for Keys:
- power-off-time-sec: Duration in seconds which the key should be kept
	pressed for device to power off automatically. Device with key pressed
	shutdown feature can specify this property.
- linux,keycodes: Specifies the numeric keycode values to be used for
	reporting key presses.
```

## Documentation/devicetree/bindings/input/max77650-onkey.txt
```
FASTVC-BENCH-CORPUS:linux-main-100k-v1-e0bd41dc-8e12-4f1b-978d-a3645ae59da0
Onkey driver for MAX77650 PMIC from Maxim Integrated.

This module is part of the MAX77650 MFD device. For more details
see Documentation/devicetree/bindings/mfd/max77650.txt.

The onkey controller is represented as a sub-node of the PMIC node on
the device tree.

Required properties:
--------------------
- compatible:		Must be "maxim,max77650-onkey".

Optional properties:
- linux,code:		The key-code to be reported when the key is pressed.
			Defaults to KEY_POWER.
- maxim,onkey-slide:	The system's button is a slide switch, not the default
			push button.

Example:
--------

	onkey {
		compatible = "maxim,max77650-onkey";
		linux,code = <KEY_END>;
		maxim,onkey-slide;
	};
```
