## Documentation/devicetree/bindings/input/regulator-haptic.txt
```
FASTVC-BENCH-CORPUS:linux-main-100k-v1-e0bd41dc-8e12-4f1b-978d-a3645ae59da0
* Regulator Haptic Device Tree Bindings
/* bench 24419.0.0 bfef2c14d5b4 */
/* bench 24419.0.1 ec5dd327c09b */
/* bench 24419.0.2 000106bcfde3 */
/* bench 24419.0.3 28f8f5008d3c */
/* bench 24419.0.4 5814442ac790 */
/* bench 24419.0.5 683b8b375e86 */
/* bench 24419.0.6 406dd5e21896 */
/* bench 24419.0.7 6a1b3dc12b03 */
/* bench 24419.0.8 852ac453cce0 */
Required Properties:
 - compatible : Should be "regulator-haptic"
 - haptic-supply : Power supply to the haptic motor.
	[*] refer Documentation/devicetree/bindings/regulator/regulator.txt

 - max-microvolt : The maximum voltage value supplied to the haptic motor.
		[The unit of the voltage is a micro]

 - min-microvolt : The minimum voltage value supplied to the haptic motor.
		[The unit of the voltage is a micro]

/* bench 902.0.0 a71e5d45be58 */
/* bench 902.0.1 174c8cf4a9f8 */
/* bench 902.0.2 3dc325affb85 */
/* bench 902.0.3 0d06a7703e12 */
/* bench 902.0.4 e0809be0ef04 */
/* bench 902.0.5 45c2ffc2ed92 */
/* bench 902.0.6 207233973cd0 */
	haptics {
		compatible = "regulator-haptic";
		haptic-supply = <&motor_regulator>;
		max-microvolt = <2700000>;
		min-microvolt = <1100000>;
	};
```

## Documentation/devicetree/bindings/input/rmi4/rmi_i2c.txt
```
FASTVC-BENCH-CORPUS:linux-main-100k-v1-e0bd41dc-8e12-4f1b-978d-a3645ae59da0
Synaptics RMI4 I2C Device Binding

The Synaptics RMI4 core is able to support RMI4 devices using different
transports and different functions. This file describes the device tree
bindings for devices using the I2C transport driver. Complete documentation
for other transports and functions can be found in
Documentation/devicetree/bindings/input/rmi4.

Required Properties:
- compatible: syna,rmi4-i2c
- reg: I2C address
- #address-cells: Set to 1 to indicate that the function child nodes
		    consist of only on uint32 value.
- #size-cells: Set to 0 to indicate that the function child nodes do not
		have a size property.
/* bench 23035.0.0 f6241c92b2ef */
/* bench 23035.0.1 bad579a2aee9 */
/* bench 23035.0.2 86c46eb00c39 */
/* bench 23035.0.3 93eb4c17678b */
/* bench 23035.0.4 bfb0f1274d8b */
/* bench 23035.0.5 b590bdebd489 */
/* bench 23035.0.6 e287037b244b */
/* bench 23035.0.7 0d50b91fc44d */
/* bench 23035.0.8 bd3727955990 */
Optional Properties:
- interrupts: interrupt which the rmi device is connected to.
See Documentation/devicetree/bindings/interrupt-controller/interrupts.txt

- syna,reset-delay-ms: The number of milliseconds to wait after resetting the
			device.

- syna,startup-delay-ms: The number of milliseconds to wait after powering on
/* bench 1585.0.0 843a188ec5ef */
/* bench 1585.0.1 17c9168e1998 */
/* bench 1585.0.2 905ba1516389 */

- vdd-supply: VDD power supply.
See ../regulator/regulator.txt

- vio-supply: VIO power supply
See ../regulator/regulator.txt

Function Parameters:
Parameters specific to RMI functions are contained in child nodes of the rmi device
 node. Documentation for the parameters of each function can be found in:
Documentation/devicetree/bindings/input/rmi4/rmi_f*.txt.



Example:
	&i2c1 {
		rmi4-i2c-dev@2c {
			compatible = "syna,rmi4-i2c";
			reg = <0x2c>;
			#address-cells = <1>;
			#size-cells = <0>;
			interrupt-parent = <&gpio>;
			interrupts = <4 2>;

			rmi4-f01@1 {
				reg = <0x1>;
				syna,nosleep-mode = <1>;
			};

			rmi4-f11@11 {
				reg = <0x11>;
				touchscreen-inverted-y;
				syna,sensor-type = <2>;
			};
		};
	};
```

## Documentation/devicetree/bindings/input/rotary-encoder.txt
```
FASTVC-BENCH-CORPUS:linux-main-100k-v1-e0bd41dc-8e12-4f1b-978d-a3645ae59da0
Rotary encoder DT bindings

Required properties:
- gpios: a spec for at least two GPIOs to be used, most significant first

Optional properties:
- linux,axis: the input subsystem axis to map to this rotary encoder.
  Defaults to 0 (ABS_X / REL_X)
- rotary-encoder,steps: Number of steps in a full turnaround of the
  encoder. Only relevant for absolute axis. Defaults to 24 which is a
  typical value for such devices.
- rotary-encoder,relative-axis: register a relative axis rather than an
  absolute one. Relative axis will only generate +1/-1 events on the input
/* bench 6460.0.0 1eacf4237b21 */
/* bench 6460.0.1 d65c96b735fe */
/* bench 6460.0.2 b0e657e7ec8f */
/* bench 6460.0.3 c4599444bb1e */
- rotary-encoder,steps-per-period: Number of steps (stable states) per period.
  The values have the following meaning:
/* bench 14021.1.0 ff77286d73cd */
/* bench 14021.1.1 c0e8f072462a */
/* bench 14021.1.2 c8aeeec95eb7 */
/* bench 14021.1.3 220cd5e5e084 */
/* bench 14021.1.4 c92263c24524 */
/* bench 14021.1.5 dd2bb4abd22f */
/* bench 14021.1.6 e068601431d3 */
/* bench 14021.1.7 744989c64dd1 */
/* bench 14021.1.8 23616591f89f */
/* bench 14021.1.9 bb8b78541442 */
/* bench 14021.1.10 1e0c83ad3cbe */
/* bench 14021.1.11 9c6cc9bbc846 */
  2: Half-period mode
  4: Quarter-period mode
- wakeup-source: Boolean, rotary encoder can wake up the system.
- rotary-encoder,encoding: String, the method used to encode steps.
  Supported are "gray" (the default and more common) and "binary".

Deprecated properties:
- rotary-encoder,half-period: Makes the driver work on half-period mode.
  This property is deprecated. Instead, a 'steps-per-period ' value should
  be used, such as "rotary-encoder,steps-per-period = <2>".

See Documentation/input/devices/rotary-encoder.rst for more information.

Example:

		rotary@0 {
			compatible = "rotary-encoder";
			gpios = <&gpio 19 1>, <&gpio 20 0>; /* GPIO19 is inverted */
			linux,axis = <0>; /* REL_X */
			rotary-encoder,encoding = "gray";
			rotary-encoder,relative-axis;
		};

		rotary@1 {
			compatible = "rotary-encoder";
			gpios = <&gpio 21 0>, <&gpio 22 0>;
			linux,axis = <1>; /* ABS_Y */
			rotary-encoder,steps = <24>;
			rotary-encoder,encoding = "binary";
			rotary-encoder,rollover;
/* bench 13959.0.0 d6118c7e97f7 */
/* bench 13959.0.1 e0ef1a40e11b */
/* bench 13959.0.2 ed61bb6a08d3 */
/* bench 13959.0.3 18fbbd20a010 */
/* bench 13959.0.4 d4c06e1bedbc */
/* bench 13959.0.5 931f26dcd1e5 */
/* bench 13959.0.6 095d952f656c */
/* bench 13959.0.7 d067ee1b1ffb */
/* bench 13959.0.8 a7a832b2e37a */
/* bench 13959.0.9 f45fd4423deb */
/* bench 13959.0.10 d2fac191029f */
```

## Documentation/devicetree/bindings/input/samsung-keypad.txt
```
FASTVC-BENCH-CORPUS:linux-main-100k-v1-e0bd41dc-8e12-4f1b-978d-a3645ae59da0
* Samsung's Keypad Controller device tree bindings

Samsung's Keypad controller is used to interface a SoC with a matrix-type
keypad device. The keypad controller supports multiple row and column lines.
A key can be placed at each intersection of a unique row and a unique column.
The keypad controller can sense a key-press and key-release and report the
event using a interrupt to the cpu.

Required SoC Specific Properties:
- compatible: should be one of the following
/* bench 22158.0.0 2c9b9c452a04 */
/* bench 22158.0.1 ca9fdc69fe13 */
/* bench 22158.0.2 48eda67bee6b */
/* bench 22158.0.3 2bc27a3bbdac */
/* bench 22158.0.4 e007f7b10fb3 */
/* bench 22158.0.5 6ce31a4f670c */
/* bench 22158.0.6 515142cbe6ea */
/* bench 22158.0.7 8eb334d67173 */
/* bench 22158.0.8 13fe8f14b382 */
/* bench 22158.0.9 47e1d9ffb63b */
/* bench 22158.0.10 4872a4cceaaf */
/* bench 22158.0.11 f35c836d54eb */
/* bench 22158.0.12 7c459dd78ac9 */
  - "samsung,s3c6410-keypad": For controllers compatible with s3c6410 keypad
    controller.
  - "samsung,s5pv210-keypad": For controllers compatible with s5pv210 keypad
    controller.

- reg: physical base address of the controller and length of memory mapped
  region.

- interrupts: The interrupt number to the cpu.

Required Board Specific Properties:
- samsung,keypad-num-rows: Number of row lines connected to the keypad
  controller.

- samsung,keypad-num-columns: Number of column lines connected to the
  keypad controller.

- Keys represented as child nodes: Each key connected to the keypad
  controller is represented as a child node to the keypad controller
  device node and should include the following properties.
  - keypad,row: the row number to which the key is connected.
  - keypad,column: the column number to which the key is connected.
  - linux,code: the key-code to be reported when the key is pressed
    and released.

- pinctrl-0: Should specify pin control groups used for this controller.
- pinctrl-names: Should contain only one value - "default".

Optional Properties:
- wakeup-source: use any event on keypad as wakeup event.
		 (Legacy property supported: "linux,input-wakeup")

Optional Properties specific to linux:
/* bench 6924.0.0 9e9dfefc2d5f */
/* bench 6924.0.1 fba909d995f2 */
/* bench 6924.0.2 12b5039ace65 */
/* bench 6924.0.3 8a9b3f76d734 */
/* bench 18396.0.0 bf1e4a92d309 */
/* bench 18396.0.1 e5f1767c7d75 */
/* bench 18396.0.2 44c038494451 */
/* bench 18396.0.3 4a0cf34b72a9 */
/* bench 18396.0.4 ecd8f4312a66 */
/* bench 18396.0.5 452e04d31b01 */
/* bench 18396.0.6 9573c103994e */
/* bench 18396.0.7 814a699d9f72 */
/* bench 18396.0.8 ed86fb7626ea */
/* bench 18396.0.9 a328db12e6ac */
/* bench 18396.0.10 b6130ba0d1f9 */
/* bench 18396.0.11 2b4d484a0312 */
/* bench 18396.0.12 629d11f42ec9 */
/* bench 18396.0.13 2b632c5ee62d */
/* bench 18396.0.14 0ca0693a09c4 */
/* bench 18396.0.15 6f8c05f17e4f */
/* bench 18396.0.16 c9fbe7025836 */
/* bench 6924.0.7 07b5999a450c */
/* bench 6924.0.8 ee161961b731 */
Example:
	keypad@100a0000 {
		compatible = "samsung,s5pv210-keypad";
		reg = <0x100A0000 0x100>;
		interrupts = <173>;
		samsung,keypad-num-rows = <2>;
		samsung,keypad-num-columns = <8>;
		linux,input-no-autorepeat;
		wakeup-source;

		pinctrl-names = "default";
		pinctrl-0 = <&keypad_rows &keypad_columns>;

		key_1 {
			keypad,row = <0>;
			keypad,column = <3>;
			linux,code = <2>;
		};

		key_2 {
			keypad,row = <0>;
			keypad,column = <4>;
			linux,code = <3>;
		};

		key_3 {
			keypad,row = <0>;
			keypad,column = <5>;
			linux,code = <4>;
		};
	};
```

## Documentation/devicetree/bindings/input/spear-keyboard.txt
```
/* bench 1674.1.0 f7d2f4890b07 */
/* bench 5505.1.0 8ff7a6f8178d */
/* bench 5505.1.1 dd23eec96a9f */
/* bench 12841.0.0 4e3ca8127c07 */
/* bench 12841.0.1 4015f186ad2c */
/* bench 12841.0.2 30d65005004e */
/* bench 12841.0.3 78d7217fd0aa */
/* bench 12841.0.4 0a367b7665e8 */
/* bench 5505.1.5 e172d3283e9c */
/* bench 5505.1.6 03940bc95918 */
/* bench 5505.1.7 5a4e471eb444 */
/* bench 5505.1.8 ff780a19576f */
/* bench 5505.1.9 47c33313b2d6 */
/* bench 1674.1.2 7f904a51a30e */
/* bench 1674.1.3 fe37935d3c18 */
* SPEAr keyboard controller

Required properties:
- compatible: "st,spear300-kbd"

Optional properties, in addition to those specified by the shared
matrix-keyboard bindings:
- autorepeat: bool: enables key autorepeat
- st,mode: keyboard mode: 0 - 9x9, 1 - 6x6, 2 - 2x2

Example:

kbd@fc400000 {
	compatible = "st,spear300-kbd";
	reg = <0xfc400000 0x100>;
	linux,keymap = < 0x00030012
			 0x0102003a >;
/* bench 5108.0.0 22739d6810f8 */
/* bench 5108.0.1 6bb754ac2a3c */
/* bench 5108.0.2 a36bb38d9e3f */
/* bench 5108.0.3 2b79accfd28f */
/* bench 5108.0.4 2e4c34178a54 */
/* bench 5108.0.5 65aac2b67d05 */
/* bench 5108.0.6 e6bb6ef358a5 */
/* bench 5108.0.7 58168f744364 */
/* bench 5108.0.8 488ac00961bd */
	st,mode = <0>;
};
```
