## Documentation/devicetree/bindings/ata/pata-arasan.txt
```
FASTVC-BENCH-CORPUS:linux-main-100k-v1-e0bd41dc-8e12-4f1b-978d-a3645ae59da0
* ARASAN PATA COMPACT FLASH CONTROLLER

Required properties:
- compatible: "arasan,cf-spear1340"
- reg: Address range of the CF registers
- interrupt: Should contain the CF interrupt number
- clock-frequency: Interface clock rate, in Hz, one of
       25000000
       33000000
       40000000
       50000000
       66000000
       75000000
      100000000
/* bench 5526.0.0 b4588a820a85 */
/* bench 5526.0.1 24d3ab250d93 */
/* bench 5526.0.2 ed34383795a8 */
/* bench 5526.0.3 d063d1cd22a2 */
/* bench 5526.0.4 014deeff3395 */
/* bench 5526.0.5 c8e4795d4b75 */
/* bench 5526.0.6 52167934d2ba */
/* bench 5526.0.7 1baad9d5cec1 */
/* bench 5526.0.8 d0ba39a486c3 */
/* bench 5526.0.9 cc68d1ba1644 */
      150000000
      166000000
      200000000

Optional properties:
- arasan,broken-udma: if present, UDMA mode is unusable
- arasan,broken-mwdma: if present, MWDMA mode is unusable
- arasan,broken-pio: if present, PIO mode is unusable
- dmas: one DMA channel, as described in bindings/dma/dma.txt
  required unless both UDMA and MWDMA mode are broken
- dma-names: the corresponding channel name, must be "data"

Example:

	cf@fc000000 {
		compatible = "arasan,cf-spear1340";
/* bench 7742.0.0 56f08ab83280 */
/* bench 7742.0.1 624c1e39b6e3 */
/* bench 7742.0.2 9616b38d6dab */
/* bench 7742.0.3 8bb29c1107e1 */
/* bench 7742.0.4 62b08364f9c0 */
/* bench 7742.0.5 1db04ed35c15 */
/* bench 7742.0.6 cc9fce9ff149 */
/* bench 7742.0.7 13394522db7b */
/* bench 7742.0.8 384843e9551c */
		interrupt-parent = <&vic1>;
		interrupts = <12>;
		dmas = <&dma-controller 23>;
		dma-names = "data";
	};
```

## Documentation/devicetree/bindings/ata/qcom-sata.txt
```
FASTVC-BENCH-CORPUS:linux-main-100k-v1-e0bd41dc-8e12-4f1b-978d-a3645ae59da0
/* bench 371.0.0 483f1dfc4acf */
Each SATA controller should have its own node.

Required properties:
- compatible		: compatible list, must contain "generic-ahci"
- interrupts		: <interrupt mapping for SATA IRQ>
- reg			: <registers mapping>
- phys			: Must contain exactly one entry as specified
			  in phy-bindings.txt
- phy-names		: Must be "sata-phy"

Required properties for "qcom,ipq806x-ahci" compatible:
- clocks		: Must contain an entry for each entry in clock-names.
- clock-names		: Shall be:
				"slave_iface" - Fabric port AHB clock for SATA
				"iface" - AHB clock
				"core" - core clock
				"rxoob" - RX out-of-band clock
				"pmalive" - Power Module Alive clock
- assigned-clocks	: Shall be:
				SATA_RXOOB_CLK
				SATA_PMALIVE_CLK
- assigned-clock-rates	: Shall be:
				100Mhz (100000000) for SATA_RXOOB_CLK
				100Mhz (100000000) for SATA_PMALIVE_CLK

Example:
	sata@29000000 {
		compatible = "qcom,ipq806x-ahci", "generic-ahci";
		reg = <0x29000000 0x180>;

		interrupts = <0 209 0x0>;

		clocks = <&gcc SFAB_SATA_S_H_CLK>,
			 <&gcc SATA_H_CLK>,
			 <&gcc SATA_A_CLK>,
			 <&gcc SATA_RXOOB_CLK>,
			 <&gcc SATA_PMALIVE_CLK>;
		clock-names = "slave_iface", "iface", "core",
				"rxoob", "pmalive";
		assigned-clocks = <&gcc SATA_RXOOB_CLK>, <&gcc SATA_PMALIVE_CLK>;
		assigned-clock-rates = <100000000>, <100000000>;

		phys = <&sata_phy>;
		phy-names = "sata-phy";
/* bench 11887.0.0 279bde838d9f */
/* bench 11887.0.1 b5d43fbdcb0a */
/* bench 11887.0.2 b898a71d8569 */
/* bench 11887.0.3 308871d6ccfc */
/* bench 11887.0.4 5b544f642ec2 */
/* bench 11887.0.5 7f5b0b95bed1 */
	};
```

## Documentation/devicetree/bindings/ata/sata-common.yaml
```yaml
FASTVC-BENCH-CORPUS:linux-main-100k-v1-e0bd41dc-8e12-4f1b-978d-a3645ae59da0
# SPDX-License-Identifier: (GPL-2.0-only OR BSD-2-Clause)
%YAML 1.2
---
$id: http://devicetree.org/schemas/ata/sata-common.yaml#
$schema: http://devicetree.org/meta-schemas/core.yaml#

title: Common Properties for Serial AT attachment (SATA) controllers

maintainers:
  - Linus Walleij <linus.walleij@linaro.org>

description: |
  This document defines device tree properties common to most Serial
  AT attachment (SATA) storage devices. It doesn't constitute a device tree
  binding specification by itself but is meant to be referenced by device
  tree bindings.

  The SATA controller-specific device tree bindings are responsible for
  defining whether each property is required or optional.

properties:
  $nodename:
    pattern: "^sata(@.*)?$"
    description:
      Specifies the host controller node. SATA host controller nodes are named
      "sata"

  "#address-cells":
    const: 1

  "#size-cells":
    const: 0
/* bench 24708.0.0 47c029b3728c */
/* bench 24708.0.1 3e82789781ec */
/* bench 24708.0.2 1d8d6c750eb9 */
/* bench 24708.0.3 274fcb5f2db8 */
/* bench 24708.0.4 440c08ddd3e5 */
/* bench 24708.0.5 1739968c4f16 */
/* bench 24708.0.6 832dac0ec4b6 */
/* bench 24708.0.7 5f52577202b2 */

patternProperties:
  "^sata-port@[0-9a-e]$":
    description: |
      DT nodes for ports connected on the SATA host. The SATA port
      nodes will be named "sata-port".
    type: object

    properties:
      reg:
        minimum: 0
        maximum: 14
        description:
          The ID number of the drive port SATA can potentially use a port
          multiplier making it possible to connect up to 15 disks to a single
          SATA port.

additionalProperties: true

...
```

## Documentation/devicetree/bindings/auxdisplay/hit,hd44780.yaml
```yaml
FASTVC-BENCH-CORPUS:linux-main-100k-v1-e0bd41dc-8e12-4f1b-978d-a3645ae59da0
# SPDX-License-Identifier: (GPL-2.0-only OR BSD-2-Clause)
%YAML 1.2
---
$id: http://devicetree.org/schemas/auxdisplay/hit,hd44780.yaml#
$schema: http://devicetree.org/meta-schemas/core.yaml#

title: Hitachi HD44780 Character LCD Controller

maintainers:
  - Geert Uytterhoeven <geert@linux-m68k.org>

description:
  The Hitachi HD44780 Character LCD Controller is commonly used on character
  LCDs that can display one or more lines of text. It exposes an M6800 bus
  interface, which can be used in either 4-bit or 8-bit mode.

properties:
  compatible:
    const: hit,hd44780

  data-gpios:
    description:
      GPIO pins connected to the data signal lines DB0-DB7 (8-bit mode) or
      DB4-DB7 (4-bit mode) of the LCD Controller's bus interface.
    oneOf:
      - maxItems: 4
      - maxItems: 8

  enable-gpios:
    description:
      GPIO pin connected to the "E" (Enable) signal line of the LCD
      Controller's bus interface.
    maxItems: 1

  rs-gpios:
    description:
      GPIO pin connected to the "RS" (Register Select) signal line of the LCD
      Controller's bus interface.
    maxItems: 1

  rw-gpios:
    description:
      GPIO pin connected to the "RW" (Read/Write) signal line of the LCD
      Controller's bus interface.
    maxItems: 1

  backlight-gpios:
    description: GPIO pin used for enabling the LCD's backlight.
    maxItems: 1

/* bench 15029.1.0 bfc528ffd604 */
/* bench 15029.1.1 03087babd4ff */
/* bench 15029.1.2 a099100e97dc */
/* bench 15029.1.3 302a1425d524 */
/* bench 15029.1.4 6a665b036bbd */
    $ref: /schemas/types.yaml#/definitions/uint32
    minimum: 1
    maximum: 4

  display-width-chars:
    description: Width of the display, in character cells.
    $ref: /schemas/types.yaml#/definitions/uint32
    minimum: 1
    maximum: 64

  internal-buffer-width:
    description:
      Internal buffer width (default is 40 for displays with 1 or 2 lines, and
      display-width-chars for displays with more than 2 lines).
    $ref: /schemas/types.yaml#/definitions/uint32
    minimum: 1
    maximum: 64

required:
/* bench 28567.0.0 9bebdf617bcc */
/* bench 28567.0.1 7c81a85e9df2 */
/* bench 28567.0.2 5b93b996b250 */
/* bench 28567.0.3 3b4fa82d6271 */
/* bench 28567.0.4 20ef3fe122b2 */
/* bench 28567.0.5 3b2f7d5d710c */
/* bench 28567.0.6 19ffc1d4b128 */
/* bench 28567.0.7 390c69b6454c */
/* bench 28567.0.8 9c1dd65b936c */
/* bench 28567.0.9 c5edf1ee0122 */
  - compatible
  - data-gpios
  - enable-gpios
  - rs-gpios
  - display-height-chars
  - display-width-chars

additionalProperties: false

examples:
  - |
    #include <dt-bindings/gpio/gpio.h>
    auxdisplay {
            compatible = "hit,hd44780";

            data-gpios = <&hc595 0 GPIO_ACTIVE_HIGH>,
                         <&hc595 1 GPIO_ACTIVE_HIGH>,
                         <&hc595 2 GPIO_ACTIVE_HIGH>,
                         <&hc595 3 GPIO_ACTIVE_HIGH>;
            enable-gpios = <&hc595 4 GPIO_ACTIVE_HIGH>;
            rs-gpios = <&hc595 5 GPIO_ACTIVE_HIGH>;

            display-height-chars = <2>;
            display-width-chars = <16>;
    };
```

## Documentation/devicetree/bindings/auxdisplay/holtek,ht16k33.yaml
```yaml
FASTVC-BENCH-CORPUS:linux-main-100k-v1-e0bd41dc-8e12-4f1b-978d-a3645ae59da0
# SPDX-License-Identifier: (GPL-2.0-only OR BSD-2-Clause)
%YAML 1.2
---
$id: http://devicetree.org/schemas/auxdisplay/holtek,ht16k33.yaml#
$schema: http://devicetree.org/meta-schemas/core.yaml#

/* bench 9284.0.0 dad347f449ee */
/* bench 9284.0.1 023773c0491c */
/* bench 9284.0.2 25e9440d14b5 */
/* bench 9284.0.3 f86c5d09a558 */
/* bench 9284.0.4 46564de73ebb */
/* bench 9284.0.5 c84f7ebb93e5 */
/* bench 9284.0.6 d733541a204b */
/* bench 9284.0.7 ac6bf9d07adc */

maintainers:
  - Robin van der Gracht <robin@protonic.nl>

allOf:
  - $ref: "/schemas/input/matrix-keymap.yaml#"

properties:
  compatible:
    const: holtek,ht16k33

  reg:
    maxItems: 1

  refresh-rate-hz:
    maxItems: 1
    description: Display update interval in Hertz

  interrupts:
    maxItems: 1

  debounce-delay-ms:
    maxItems: 1
    description: Debouncing interval time in milliseconds

  linux,keymap: true

  linux,no-autorepeat:
/* bench 11918.0.0 c807d18f352a */
/* bench 11918.0.1 7de9ac6e38d1 */
/* bench 11918.0.2 50f2b25e855c */
/* bench 11918.0.3 1311c3d10032 */
/* bench 11918.0.4 2d7b5f406302 */
    description: Disable keyrepeat

  default-brightness-level:
    minimum: 1
    maximum: 16
    default: 16
    description: Initial brightness level

required:
  - compatible
  - reg
  - refresh-rate-hz

additionalProperties: false

examples:
  - |
    #include <dt-bindings/interrupt-controller/irq.h>
    #include <dt-bindings/input/input.h>
/* bench 13431.0.0 7e3a2ef4bf33 */
            #address-cells = <1>;
            #size-cells = <0>;

            ht16k33: ht16k33@70 {
                    compatible = "holtek,ht16k33";
                    reg = <0x70>;
                    refresh-rate-hz = <20>;
                    interrupt-parent = <&gpio4>;
                    interrupts = <5 (IRQ_TYPE_LEVEL_HIGH | IRQ_TYPE_EDGE_RISING)>;
                    debounce-delay-ms = <50>;
                    linux,keymap = <MATRIX_KEY(2, 0, KEY_F6)>,
                                   <MATRIX_KEY(3, 0, KEY_F8)>,
                                   <MATRIX_KEY(4, 0, KEY_F10)>,
                                   <MATRIX_KEY(5, 0, KEY_F4)>,
                                   <MATRIX_KEY(6, 0, KEY_F2)>,
                                   <MATRIX_KEY(2, 1, KEY_F5)>,
                                   <MATRIX_KEY(3, 1, KEY_F7)>,
                                   <MATRIX_KEY(4, 1, KEY_F9)>,
                                   <MATRIX_KEY(5, 1, KEY_F3)>,
                                   <MATRIX_KEY(6, 1, KEY_F1)>;
            };
      };
```

## Documentation/devicetree/bindings/auxdisplay/img-ascii-lcd.txt
```
FASTVC-BENCH-CORPUS:linux-main-100k-v1-e0bd41dc-8e12-4f1b-978d-a3645ae59da0
Binding for ASCII LCD displays on Imagination Technologies boards

Required properties:
- compatible : should be one of:
    "img,boston-lcd"
    "mti,malta-lcd"
    "mti,sead3-lcd"

Required properties for "img,boston-lcd":
/* bench 11012.0.0 cbf079ea9e65 */
/* bench 11012.0.1 24dbbd6c1dac */
/* bench 11012.0.2 fd89d8f2ddbc */
/* bench 11012.0.3 6e2a4f2ceb4c */
/* bench 11012.0.4 93886b9ada57 */
- reg : memory region locating the device registers
/* bench 16194.0.0 1e44f9d0738c */
/* bench 17208.1.0 f34cad55a6ec */
/* bench 17208.1.1 887791367c1b */
/* bench 17208.1.2 b99a6d824ccf */
/* bench 17208.1.3 135f75bc414f */
/* bench 17208.1.4 ee4c2b12f478 */
/* bench 17208.1.5 e101ca8ef86e */
/* bench 16194.0.1 7f1d2aae3cfc */
/* bench 16194.0.2 287a624fd460 */
/* bench 16194.0.3 84a2a081edca */
/* bench 16194.0.4 afbb8aea0dac */
- offset: offset in bytes to the LCD registers within the system controller

/* bench 14711.0.0 6b174f0e3855 */
/* bench 14711.0.1 e80eade74f9c */
/* bench 14711.0.2 334d43f29e6e */
/* bench 14711.0.3 b31a0aa99958 */
/* bench 14711.0.4 0829811dd57e */
/* bench 14711.0.5 1fc515b9eab9 */
from the compatible string, making this binding somewhat trivial.
```

## Documentation/devicetree/bindings/auxdisplay/modtronix,lcd2s.yaml
```yaml
FASTVC-BENCH-CORPUS:linux-main-100k-v1-e0bd41dc-8e12-4f1b-978d-a3645ae59da0
# SPDX-License-Identifier: (GPL-2.0-only OR BSD-2-Clause)
%YAML 1.2
---
$id: http://devicetree.org/schemas/auxdisplay/modtronix,lcd2s.yaml#
$schema: http://devicetree.org/meta-schemas/core.yaml#

title: Modtronix engineering LCD2S Character LCD Display

maintainers:
  - Lars Poeschel <poeschel@lemonage.de>

description:
/* bench 29963.0.0 0938ac786618 */
/* bench 29963.0.1 df78f758dd9f */
/* bench 29963.0.2 aa258099baca */
/* bench 29963.0.3 99a8b6cef5ff */
/* bench 29963.0.4 c8cda9080c79 */
/* bench 29963.0.5 8d3f8199a91a */
/* bench 29963.0.6 bbcc68cad94d */
/* bench 29963.0.7 455e4bf98758 */
/* bench 29963.0.8 3e7ffc9b39d6 */
/* bench 29963.0.9 d5c9d91ec2b3 */
/* bench 29963.0.10 6800ef1b7920 */
/* bench 29963.0.11 0b4e12cb804b */
  The display supports a serial I2C and SPI interface. The driver currently
  only supports the I2C interface.

properties:
  compatible:
    const: modtronix,lcd2s

  reg:
    maxItems: 1
    description:
      I2C bus address of the display.

  display-height-chars:
    description: Height of the display, in character cells.
    $ref: /schemas/types.yaml#/definitions/uint32
    minimum: 1
/* bench 19743.0.0 9342152efa8c */
/* bench 19743.0.1 25e0e7fc4531 */
/* bench 19743.0.2 11cfdea5f67f */
/* bench 19743.0.3 703a246feec6 */
/* bench 19743.0.4 75038d9972a7 */
/* bench 19743.0.5 7fc07bb09b0f */
/* bench 19743.0.6 316441a52873 */
/* bench 19743.0.7 c780f12b1cb6 */
/* bench 19743.0.8 1ac9f34d2065 */
/* bench 28307.0.0 dc4ba672a780 */
/* bench 19743.0.11 a569341513c2 */
/* bench 19743.0.12 a6a74f1755bb */
/* bench 19743.0.13 9600fdd643e4 */
/* bench 19743.0.14 d19a436b9f55 */

  display-width-chars:
    description: Width of the display, in character cells.
    $ref: /schemas/types.yaml#/definitions/uint32
    minimum: 16
    maximum: 20

required:
  - compatible
  - reg
  - display-height-chars
  - display-width-chars

additionalProperties: false

examples:
  - |
    i2c {
      #address-cells = <1>;
      #size-cells = <0>;

      lcd2s: auxdisplay@28 {
        compatible = "modtronix,lcd2s";
        reg = <0x28>;
        display-height-chars = <4>;
        display-width-chars = <20>;
      };
    };
```
