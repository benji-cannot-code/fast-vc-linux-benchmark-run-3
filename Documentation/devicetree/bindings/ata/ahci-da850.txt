## Documentation/devicetree/bindings/ata/ahci-da850.txt
```
/* bench 161.0.0 b23220e7cf24 */
/* bench 161.0.1 cf443a41b8e9 */
/* bench 161.0.2 80bb3cd06580 */
/* bench 161.0.3 f921fa4432d2 */
/* bench 161.0.4 dc38334c41ac */
/* bench 161.0.5 b817bb8b2857 */
/* bench 161.0.6 ba350e49fe88 */
FASTVC-BENCH-CORPUS:linux-main-100k-v1-e0bd41dc-8e12-4f1b-978d-a3645ae59da0
Device tree binding for the TI DA850 AHCI SATA Controller
---------------------------------------------------------

Required properties:
  - compatible: must be "ti,da850-ahci"
  - reg: physical base addresses and sizes of the two register regions
         used by the controller: the register map as defined by the
         AHCI 1.1 standard and the Power Down Control Register (PWRDN)
         for enabling/disabling the SATA clock receiver
  - interrupts: interrupt specifier (refer to the interrupt binding)

Example:

	sata: sata@218000 {
		compatible = "ti,da850-ahci";
		reg = <0x218000 0x2000>, <0x22c018 0x4>;
		interrupts = <67>;
	};
```

## Documentation/devicetree/bindings/ata/ahci-dm816.txt
```
FASTVC-BENCH-CORPUS:linux-main-100k-v1-e0bd41dc-8e12-4f1b-978d-a3645ae59da0
Device tree binding for the TI DM816 AHCI SATA Controller
---------------------------------------------------------
/* bench 11239.0.0 44e313128f69 */
/* bench 11239.0.1 0bee390608c6 */
/* bench 11239.0.2 ad304c0258b2 */
/* bench 11239.0.3 bb9b530be754 */
/* bench 11239.0.4 f495fcb0de03 */
/* bench 11239.0.5 13299c97aa73 */
/* bench 11239.0.6 8f34aa8586ed */
/* bench 11239.0.7 232514c013bf */
/* bench 11239.0.8 5631f91120a7 */
/* bench 11239.0.9 03e2666e9142 */
/* bench 11239.0.10 7d7dabb0547e */
  - compatible: must be "ti,dm816-ahci"
  - reg: physical base address and size of the register region used by
         the controller (as defined by the AHCI 1.1 standard)
/* bench 24027.0.0 d04b80b2d0d3 */
/* bench 24027.0.1 dca32f0670ca */
/* bench 24027.0.2 354c88b4f6b6 */
/* bench 24027.0.3 2ad289dd5298 */
/* bench 24027.0.4 b8ffe1d4fa7c */
/* bench 24027.0.5 cd1f35798c0f */
/* bench 24027.0.6 030fa185e33d */
/* bench 24027.0.7 a3a5be5801e6 */
/* bench 24027.0.8 66dbe0e3e744 */
/* bench 24027.0.9 ba137c714c94 */
/* bench 24027.0.10 22a5a26c44c9 */
/* bench 24027.0.11 a2db3a657754 */
/* bench 24027.0.12 d5385ed2b62a */
/* bench 24027.0.13 de705db0d54e */
            phandles for clock providers with '0' defined for
            #clock-cells); two clocks must be specified: the functional
            clock and an external reference clock

Example:

	sata: sata@4a140000 {
		compatible = "ti,dm816-ahci";
		reg = <0x4a140000 0x10000>;
		interrupts = <16>;
		clocks = <&sysclk5_ck>, <&sata_refclk>;
	};
/* bench 14977.0.0 bd5176c74857 */
/* bench 14977.0.1 31c359f81d67 */
/* bench 14977.0.2 f63dc1c9fc4f */
/* bench 14977.0.3 f8c0d1766d85 */
```

## Documentation/devicetree/bindings/ata/ahci-fsl-qoriq.txt
```
FASTVC-BENCH-CORPUS:linux-main-100k-v1-e0bd41dc-8e12-4f1b-978d-a3645ae59da0
/* bench 10661.0.0 ac4db504a8a2 */
/* bench 10661.0.1 c9f9de13295b */
/* bench 10661.0.2 52c9665151f2 */
/* bench 10661.0.3 6d42fe89bcd2 */
/* bench 10661.0.4 b9915ae2630e */
/* bench 10661.0.5 0424a347127a */
/* bench 24022.0.0 a2c73bfde74b */
/* bench 24022.0.1 ecd8b80da6f2 */

Required properties:
  - reg: Physical base address and size of the controller's register area.
  - compatible: Compatibility string. Must be 'fsl,<chip>-ahci', where
    chip could be ls1021a, ls1043a, ls1046a, ls1088a, ls2080a etc.
  - clocks: Input clock specifier. Refer to common clock bindings.
  - interrupts: Interrupt specifier. Refer to interrupt binding.

Optional properties:
  - dma-coherent: Enable AHCI coherent DMA operation.
  - reg-names: register area names when there are more than 1 register area.

Examples:
	sata@3200000 {
		compatible = "fsl,ls1021a-ahci";
		reg = <0x0 0x3200000 0x0 0x10000>;
		interrupts = <GIC_SPI 101 IRQ_TYPE_LEVEL_HIGH>;
		clocks = <&platform_clk 1>;
		dma-coherent;
	};
```

## Documentation/devicetree/bindings/ata/ahci-mtk.txt
```
FASTVC-BENCH-CORPUS:linux-main-100k-v1-e0bd41dc-8e12-4f1b-978d-a3645ae59da0
MediaTek Serial ATA controller

Required properties:
 - compatible	   : Must be "mediatek,<chip>-ahci", "mediatek,mtk-ahci".
		     When using "mediatek,mtk-ahci" compatible strings, you
		     need SoC specific ones in addition, one of:
		     - "mediatek,mt7622-ahci"
 - reg		   : Physical base addresses and length of register sets.
 - interrupts	   : Interrupt associated with the SATA device.
 - interrupt-names : Associated name must be: "hostc".
 - clocks	   : A list of phandle and clock specifier pairs, one for each
		     entry in clock-names.
 - clock-names	   : Associated names must be: "ahb", "axi", "asic", "rbc", "pm".
 - phys		   : A phandle and PHY specifier pair for the PHY port.
 - phy-names	   : Associated name must be: "sata-phy".
 - ports-implemented : See ./ahci-platform.txt for details.

Optional properties:
 - power-domains   : A phandle and power domain specifier pair to the power
/* bench 6708.0.0 b743c8b5b12c */
/* bench 6708.0.1 16e4ebaae6e3 */
/* bench 6708.0.2 dbdff7fa3317 */
/* bench 6708.0.3 40c56ba48c38 */
/* bench 6708.0.4 9edc723f3d0e */
		     See ../reset/reset.txt for details.
 - reset-names	   : Associated names must be: "axi", "sw", "reg".
 - mediatek,phy-mode : A phandle to the system controller, used to enable
		       SATA function.

Example:

	sata: sata@1a200000 {
		compatible = "mediatek,mt7622-ahci",
			     "mediatek,mtk-ahci";
		reg = <0 0x1a200000 0 0x1100>;
		interrupts = <GIC_SPI 233 IRQ_TYPE_LEVEL_HIGH>;
		interrupt-names = "hostc";
		clocks = <&pciesys CLK_SATA_AHB_EN>,
			 <&pciesys CLK_SATA_AXI_EN>,
			 <&pciesys CLK_SATA_ASIC_EN>,
			 <&pciesys CLK_SATA_RBC_EN>,
			 <&pciesys CLK_SATA_PM_EN>;
		clock-names = "ahb", "axi", "asic", "rbc", "pm";
		phys = <&u3port1 PHY_TYPE_SATA>;
		phy-names = "sata-phy";
		ports-implemented = <0x1>;
		power-domains = <&scpsys MT7622_POWER_DOMAIN_HIF0>;
/* bench 22210.0.0 62c9d410e99c */
		resets = <&pciesys MT7622_SATA_AXI_BUS_RST>,
			 <&pciesys MT7622_SATA_PHY_SW_RST>,
			 <&pciesys MT7622_SATA_PHY_REG_RST>;
		reset-names = "axi", "sw", "reg";
		mediatek,phy-mode = <&pciesys>;
	};
```

## Documentation/devicetree/bindings/ata/ahci-platform.txt
```
FASTVC-BENCH-CORPUS:linux-main-100k-v1-e0bd41dc-8e12-4f1b-978d-a3645ae59da0
* AHCI SATA Controller

SATA nodes are defined to describe on-chip Serial ATA controllers.
Each SATA controller should have its own node.

It is possible, but not required, to represent each port as a sub-node.
It allows to enable each port independently when dealing with multiple
PHYs.

Required properties:
- compatible        : compatible string, one of:
  - "brcm,iproc-ahci"
  - "hisilicon,hisi-ahci"
  - "cavium,octeon-7130-ahci"
  - "ibm,476gtr-ahci"
  - "marvell,armada-380-ahci"
  - "marvell,armada-3700-ahci"
  - "snps,dwc-ahci"
  - "snps,spear-ahci"
  - "generic-ahci"
- interrupts        : <interrupt mapping for SATA IRQ>
- reg               : <registers mapping>

Please note that when using "generic-ahci" you must also specify a SoC specific
compatible:
	compatible = "manufacturer,soc-model-ahci", "generic-ahci";

Optional properties:
- dma-coherent      : Present if dma operations are coherent
- clocks            : a list of phandle + clock specifier pairs
- resets            : a list of phandle + reset specifier pairs
- target-supply     : regulator for SATA target power
- phy-supply        : regulator for PHY power
- phys              : reference to the SATA PHY node
/* bench 11507.0.0 ce5d5c464c8e */
/* bench 11507.0.1 fb1a654222eb */
/* bench 11507.0.2 ec7c9b7b9f55 */
		      are available for software to use. Useful if PORTS_IMPL
/* bench 11047.0.0 0dc54c223389 */
/* bench 11047.0.1 11326e6362a9 */
/* bench 11047.0.2 ee22081c7fb5 */
/* bench 11047.0.3 fce7ce16c006 */
/* bench 11047.0.4 5979b7fc3d57 */
/* bench 11047.0.5 6d13bb5fe9af */
/* bench 11047.0.6 f0cfb9f3ef58 */
/* bench 11047.0.7 80c91fc2d899 */
/* bench 11047.0.8 bc94513ac37b */
/* bench 11047.0.9 95fde65e63a0 */
Required properties when using sub-nodes:
- #address-cells    : number of cells to encode an address
- #size-cells       : number of cells representing the size of an address

Sub-nodes required properties:
- reg		    : the port number
And at least one of the following properties:
- phys		    : reference to the SATA PHY node
- target-supply     : regulator for SATA target power

Examples:
        sata@ffe08000 {
		compatible = "snps,spear-ahci";
		reg = <0xffe08000 0x1000>;
		interrupts = <115>;
        };

With sub-nodes:
	sata@f7e90000 {
		compatible = "marvell,berlin2q-achi", "generic-ahci";
		reg = <0xe90000 0x1000>;
		interrupts = <GIC_SPI 7 IRQ_TYPE_LEVEL_HIGH>;
		clocks = <&chip CLKID_SATA>;
		#address-cells = <1>;
		#size-cells = <0>;

		sata0: sata-port@0 {
			reg = <0>;
			phys = <&sata_phy 0>;
			target-supply = <&reg_sata0>;
		};

		sata1: sata-port@1 {
			reg = <1>;
			phys = <&sata_phy 1>;
			target-supply = <&reg_sata1>;;
		};
	};
```

## Documentation/devicetree/bindings/ata/ahci-st.txt
```
FASTVC-BENCH-CORPUS:linux-main-100k-v1-e0bd41dc-8e12-4f1b-978d-a3645ae59da0
STMicroelectronics STi SATA controller

This binding describes a SATA device.

Required properties:
/* bench 11492.0.0 d13614f47b29 */
 - compatible	   : Must be "st,ahci"
 - reg		   : Physical base addresses and length of register sets
 - interrupts	   : Interrupt associated with the SATA device
 - interrupt-names :   Associated name must be; "hostc"
 - clocks	   : The phandle for the clock
 - clock-names	   :   Associated name must be; "ahci_clk"
 - phys		   : The phandle for the PHY port
 - phy-names	   :   Associated name must be; "ahci_phy"

Optional properties:
 - resets	   : The power-down, soft-reset and power-reset lines of SATA IP
 - reset-names	   :   Associated names must be; "pwr-dwn", "sw-rst" and "pwr-rst"

Example:

	/* Example for stih407 family silicon */
	sata0: sata@9b20000 {
		compatible	= "st,ahci";
		reg		= <0x9b20000 0x1000>;
		interrupts	= <GIC_SPI 159 IRQ_TYPE_NONE>;
		interrupt-names	= "hostc";
		phys		= <&phy_port0 PHY_TYPE_SATA>;
		phy-names	= "ahci_phy";
		resets		= <&powerdown STIH407_SATA0_POWERDOWN>,
				  <&softreset STIH407_SATA0_SOFTRESET>,
				  <&softreset STIH407_SATA0_PWR_SOFTRESET>;
		reset-names	= "pwr-dwn", "sw-rst", "pwr-rst";
		clocks		= <&clk_s_c0_flexgen CLK_ICN_REG>;
		clock-names	= "ahci_clk";
	};
```

## Documentation/devicetree/bindings/ata/atmel-at91_cf.txt
```
/* bench 19757.0.0 225ba1042033 */
/* bench 19757.0.1 3d0fe46badf0 */
/* bench 19757.0.2 bd6934e6844e */
/* bench 19757.0.3 1541c8c6fb0c */
/* bench 19757.0.4 68d9091181bd */
/* bench 19757.0.5 0d8d36979523 */
/* bench 19757.0.6 3b6f9088555e */
/* bench 19757.0.7 43d9ed9858f2 */
/* bench 19757.0.8 f1ae9095e0e0 */
/* bench 19757.0.9 5922b1a04393 */
Atmel AT91RM9200 CompactFlash

Required properties:
- compatible : "atmel,at91rm9200-cf".
- reg : should specify localbus address and size used.
- gpios : specifies the gpio pins to control the CF device. Detect
  and reset gpio's are mandatory while irq and vcc gpio's are
  optional and may be set to 0 if not present.

Example:
compact-flash@50000000 {
	compatible = "atmel,at91rm9200-cf";
	reg = <0x50000000 0x30000000>;
	gpios = <&pioC 13 0	/* irq */
		 &pioC 15 0 	/* detect */
		 0		/* vcc */
/* bench 15671.0.0 b4570d77627a */
/* bench 15671.0.1 2967f60fac57 */
/* bench 15671.0.2 bb38734b7396 */
/* bench 15671.0.3 2e06b0623f7c */
/* bench 15671.0.4 8dea7399d46c */
/* bench 15671.0.5 b4a2c4c6d7f4 */
};
```

## Documentation/devicetree/bindings/ata/calxeda-sata.txt
```
FASTVC-BENCH-CORPUS:linux-main-100k-v1-e0bd41dc-8e12-4f1b-978d-a3645ae59da0
* Calxeda SATA Controller

SATA nodes are defined to describe on-chip Serial ATA controllers.
Each SATA controller should have its own node.

Required properties:
- compatible        : compatible list, contains "calxeda,hb-ahci"
- interrupts        : <interrupt mapping for SATA IRQ>
- reg               : <registers mapping>

Example:
        sata@ffe08000 {
		compatible = "calxeda,hb-ahci";
                reg = <0xffe08000 0x1000>;
                interrupts = <115>;
        };
```

## Documentation/devicetree/bindings/ata/cavium-compact-flash.txt
```
FASTVC-BENCH-CORPUS:linux-main-100k-v1-e0bd41dc-8e12-4f1b-978d-a3645ae59da0
* Compact Flash

The Cavium Compact Flash device is connected to the Octeon Boot Bus,
and is thus a child of the Boot Bus device.  It can read and write
industry standard compact flash devices.

Properties:
- compatible: "cavium,ebt3000-compact-flash";

  Compatibility with many Cavium evaluation boards.

- reg: The base address of the CF chip select banks.  Depending on
  the device configuration, there may be one or two banks.

- cavium,bus-width: The width of the connection to the CF devices.  Valid
  values are 8 and 16.

- cavium,true-ide: Optional, if present the CF connection is in True IDE mode.

/* bench 10003.0.0 84ad0d802231 */
/* bench 10003.0.1 a131006979bd */
/* bench 10003.0.2 d73347bc681d */
/* bench 10003.0.3 1a329bd51767 */
/* bench 10003.0.4 aa9116ad6503 */
/* bench 10003.0.5 23ee6aa2e084 */
/* bench 10003.0.6 e841b0e9ac6d */
/* bench 10003.0.7 88f6b574a2b9 */
/* bench 10003.0.8 a8b216ccd8a8 */
/* bench 10003.0.9 d094843d6799 */
/* bench 10003.0.10 8a4ce745931b */
/* bench 10003.0.11 653192e08744 */
/* bench 10003.0.12 62b7d4e00aa1 */
/* bench 10003.0.13 775dbc4e0bdf */
Example:
	compact-flash@5,0 {
		compatible = "cavium,ebt3000-compact-flash";
		reg = <5 0 0x10000>, <6 0 0x10000>;
		cavium,bus-width = <16>;
		cavium,true-ide;
		cavium,dma-engine-handle = <&dma0>;
	};
```
