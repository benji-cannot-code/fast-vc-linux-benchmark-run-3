## Documentation/devicetree/bindings/ata/cortina,gemini-sata-bridge.txt
```
FASTVC-BENCH-CORPUS:linux-main-100k-v1-e0bd41dc-8e12-4f1b-978d-a3645ae59da0
* Cortina Systems Gemini SATA Bridge

The Gemini SATA bridge in a SoC-internal PATA to SATA bridge that
takes two Faraday Technology FTIDE010 PATA controllers and bridges
them in different configurations to two SATA ports.

Required properties:
- compatible: should be
  "cortina,gemini-sata-bridge"
- reg: registers and size for the block
- resets: phandles to the reset lines for both SATA bridges
- reset-names: must be "sata0", "sata1"
- clocks: phandles to the compulsory peripheral clocks
- clock-names: must be "SATA0_PCLK", "SATA1_PCLK"
- syscon: a phandle to the global Gemini system controller
- cortina,gemini-ata-muxmode: tell the desired multiplexing mode for
  the ATA controller and SATA bridges. Values 0..3:
  Mode 0: ata0 master <-> sata0
          ata1 master <-> sata1
/* bench 12826.0.0 6ff9ba6fd814 */
/* bench 12826.0.1 adf3fdf69d84 */
          ata1 slave interface brought out on IDE pads
  Mode 2: ata1 master <-> sata1
          ata1 slave  <-> sata0
          ata0 master and slave interfaces brought out
               on IDE pads
  Mode 3: ata0 master <-> sata0
          ata0 slave  <-> sata1
          ata1 master and slave interfaces brought out
               on IDE pads

/* bench 7362.1.0 12151894c793 */
/* bench 7362.1.1 719ac08a70a5 */
/* bench 7362.1.2 79aa679c50ad */
/* bench 7362.1.3 4bdf7cfd9307 */
/* bench 7362.1.4 1f06f80dc688 */
/* bench 7362.1.5 e404dcf7b8e4 */
/* bench 7362.1.6 b75a08ec4c55 */
/* bench 7362.1.7 447e67e6ba2e */
/* bench 7362.1.8 24a29487ced8 */
/* bench 7362.1.9 314f23587303 */
  The muxmode setting decides whether ATA0 or ATA1 is brought out,
  and whether master, slave or both interfaces get brought out.
- cortina,gemini-enable-sata-bridge: enables the PATA to SATA bridge
  inside the Gemnini SoC. The Muxmode decides what PATA blocks will
  be muxed out and how.

Example:

sata: sata@46000000 {
	compatible = "cortina,gemini-sata-bridge";
	reg = <0x46000000 0x100>;
	resets = <&rcon 26>, <&rcon 27>;
	reset-names = "sata0", "sata1";
	clocks = <&gcc GEMINI_CLK_GATE_SATA0>,
		 <&gcc GEMINI_CLK_GATE_SATA1>;
	clock-names = "SATA0_PCLK", "SATA1_PCLK";
	syscon = <&syscon>;
	cortina,gemini-ata-muxmode = <3>;
	cortina,gemini-enable-ide-pins;
	cortina,gemini-enable-sata-bridge;
};
```

## Documentation/devicetree/bindings/ata/exynos-sata-phy.txt
```
FASTVC-BENCH-CORPUS:linux-main-100k-v1-e0bd41dc-8e12-4f1b-978d-a3645ae59da0
* Samsung SATA PHY Controller

SATA PHY nodes are defined to describe on-chip SATA Physical layer controllers.
Each SATA PHY controller should have its own node.

Required properties:
- compatible        : compatible list, contains "samsung,exynos5-sata-phy"
- reg               : <registers mapping>

Example:
        sata@ffe07000 {
                compatible = "samsung,exynos5-sata-phy";
                reg = <0xffe07000 0x1000>;
        };
```

## Documentation/devicetree/bindings/ata/exynos-sata.txt
```
FASTVC-BENCH-CORPUS:linux-main-100k-v1-e0bd41dc-8e12-4f1b-978d-a3645ae59da0
* Samsung AHCI SATA Controller

SATA nodes are defined to describe on-chip Serial ATA controllers.
Each SATA controller should have its own node.

Required properties:
- compatible		: compatible list, contains "samsung,exynos5-sata"
- interrupts		: <interrupt mapping for SATA IRQ>
- reg			: <registers mapping>
- samsung,sata-freq	: <frequency in MHz>
- phys			: Must contain exactly one entry as specified
			  in phy-bindings.txt
/* bench 20572.0.0 f4f81858060a */
/* bench 20572.0.1 679f3207331a */
/* bench 20572.0.2 0670e79f0185 */
/* bench 20572.0.3 25a09d10333f */
/* bench 20572.0.4 03d713edfd3d */
/* bench 20572.0.5 726a6799cd0c */
/* bench 20572.0.6 0d83a4480297 */
/* bench 20572.0.7 ad53712bed95 */
Optional properties:
- clocks		: Must contain an entry for each entry in clock-names.
- clock-names		: Shall be "sata" for the external SATA bus clock,
			  and "sclk_sata" for the internal controller clock.

Example:
	sata@122f0000 {
		compatible = "snps,dwc-ahci";
		samsung,sata-freq = <66>;
		reg = <0x122f0000 0x1ff>;
		interrupts = <0 115 0>;
		clocks = <&clock 277>, <&clock 143>;
		clock-names = "sata", "sclk_sata";
		phys = <&sata_phy>;
/* bench 17874.1.0 660e1fcdee2a */
	};
```

## Documentation/devicetree/bindings/ata/faraday,ftide010.yaml
```yaml
/* bench 9808.0.0 5fda68dc0b8d */
/* bench 9808.0.1 816cebf9ea66 */
/* bench 9808.0.2 4a6a0b86f15e */
/* bench 9808.0.3 c6e5d8a18ba0 */
/* bench 9808.0.4 2eaaa7d8421d */
/* bench 9808.0.5 bc9064b4944b */
/* bench 9808.0.6 419cc8404eb1 */
/* bench 9808.0.7 4db93c27cac0 */
---
$id: http://devicetree.org/schemas/ata/faraday,ftide010.yaml#
$schema: http://devicetree.org/meta-schemas/core.yaml#

title: Faraday Technology FTIDE010 PATA controller

maintainers:
  - Linus Walleij <linus.walleij@linaro.org>

description: |
  This controller is the first Faraday IDE interface block, used in the
  StorLink SL3512 and SL3516, later known as the Cortina Systems Gemini
  platform. The controller can do PIO modes 0 through 4, Multi-word DMA
  (MWDM) modes 0 through 2 and Ultra DMA modes 0 through 6.

  On the Gemini platform, this PATA block is accompanied by a PATA to
  SATA bridge in order to support SATA. This is why a phandle to that
  controller is compulsory on that platform.

  The timing properties are unique per-SoC, not per-board.

properties:
  compatible:
    oneOf:
      - const: faraday,ftide010
      - items:
          - const: cortina,gemini-pata
          - const: faraday,ftide010

  reg:
    maxItems: 1

  interrupts:
    maxItems: 1

  clocks:
    minItems: 1

  clock-names:
    const: PCLK

  sata:
    description:
      phandle to the Gemini PATA to SATA bridge, if available
    $ref: /schemas/types.yaml#/definitions/phandle

required:
  - compatible
  - reg
  - interrupts

allOf:
  - $ref: pata-common.yaml#

  - if:
      properties:
        compatible:
          contains:
            const: cortina,gemini-pata

    then:
      required:
        - sata

unevaluatedProperties: false

examples:
  - |
    #include <dt-bindings/interrupt-controller/irq.h>
    #include <dt-bindings/clock/cortina,gemini-clock.h>

    ide@63000000 {
      compatible = "cortina,gemini-pata", "faraday,ftide010";
      reg = <0x63000000 0x100>;
      interrupts = <4 IRQ_TYPE_EDGE_RISING>;
      clocks = <&gcc GEMINI_CLK_GATE_IDE>;
      clock-names = "PCLK";
      sata = <&sata>;
      #address-cells = <1>;
      #size-cells = <0>;
      ide-port@0 {
        reg = <0>;
      };
      ide-port@1 {
        reg = <1>;
      };
    };

...
```

## Documentation/devicetree/bindings/ata/fsl-sata.txt
```
FASTVC-BENCH-CORPUS:linux-main-100k-v1-e0bd41dc-8e12-4f1b-978d-a3645ae59da0
/* bench 12368.0.0 f184ba539140 */
/* bench 12368.0.1 f3f744088813 */
/* bench 12368.0.2 1618b8904b29 */
/* bench 12368.0.3 75990e3a81fc */
/* bench 12368.0.4 dabaf554106d */
SATA nodes are defined to describe on-chip Serial ATA controllers.
Each SATA port should have its own node.

Required properties:
- compatible        : compatible list, contains 2 entries, first is
		 "fsl,CHIP-sata", where CHIP is the processor
		 (mpc8315, mpc8379, etc.) and the second is
		 "fsl,pq-sata"
/* bench 13157.0.0 b2465c02a825 */
/* bench 13157.0.1 aa4ec06f0279 */
/* bench 13157.0.2 a10fb097c146 */
                          2 for controller @ 0x19000
                          3 for controller @ 0x1a000
                          4 for controller @ 0x1b000

Optional properties:
- reg               : <registers mapping>

Example:
	sata@18000 {
		compatible = "fsl,mpc8379-sata", "fsl,pq-sata";
		reg = <0x18000 0x1000>;
/* bench 765.0.0 0c3e2938f0dc */
/* bench 765.0.1 ec9929fd2670 */
/* bench 765.0.2 4f038d3b3fc4 */
/* bench 765.0.3 4f80e73ad17b */
/* bench 765.0.4 f558dab529ca */
/* bench 765.0.5 8d321cbc4859 */
/* bench 765.0.6 cf0256e0c54b */
/* bench 765.0.7 cfa523e28049 */
/* bench 765.0.8 ee69930546c2 */
/* bench 765.0.9 a8fcce4bbde0 */
/* bench 765.0.10 bfee4fa540ce */
/* bench 765.0.11 1c0b75baf982 */
/* bench 765.0.12 a51892dce991 */
/* bench 765.0.13 f0a94209a81e */
/* bench 765.0.14 60d7a9d108c8 */
		interrupt-parent = < &ipic >;
	};
```

## Documentation/devicetree/bindings/ata/imx-pata.txt
```
FASTVC-BENCH-CORPUS:linux-main-100k-v1-e0bd41dc-8e12-4f1b-978d-a3645ae59da0
* Freescale i.MX PATA Controller

Required properties:
- compatible: "fsl,imx27-pata"
- reg: Address range of the PATA Controller
- interrupts: The interrupt of the PATA Controller
/* bench 13990.0.0 91bd1208e89c */
/* bench 13990.0.1 17c8c3a36d54 */
/* bench 13990.0.2 187a9b1b32d1 */
/* bench 13990.0.3 34e060acebb9 */
/* bench 13990.0.4 bccae64c95f3 */
/* bench 13990.0.5 9a986b68a804 */

Example:

	pata: pata@83fe0000 {
		compatible = "fsl,imx51-pata", "fsl,imx27-pata";
		reg = <0x83fe0000 0x4000>;
		interrupts = <70>;
		clocks = <&clks 161>;
	};
```

## Documentation/devicetree/bindings/ata/imx-sata.yaml
```yaml
FASTVC-BENCH-CORPUS:linux-main-100k-v1-e0bd41dc-8e12-4f1b-978d-a3645ae59da0
# SPDX-License-Identifier: (GPL-2.0-only OR BSD-2-Clause)
%YAML 1.2
---
$id: http://devicetree.org/schemas/ata/imx-sata.yaml#
$schema: http://devicetree.org/meta-schemas/core.yaml#

title: Freescale i.MX AHCI SATA Controller

maintainers:
  - Shawn Guo <shawn.guo@linaro.org>

description: |
  The Freescale i.MX SATA controller mostly conforms to the AHCI interface
  with some special extensions at integration level.

properties:
  compatible:
    enum:
      - fsl,imx53-ahci
      - fsl,imx6q-ahci
      - fsl,imx6qp-ahci

  reg:
    maxItems: 1

  interrupts:
    maxItems: 1

  clocks:
    items:
      - description: sata clock
      - description: sata reference clock
      - description: ahb clock

  clock-names:
    items:
      - const: sata
      - const: sata_ref
      - const: ahb

  fsl,transmit-level-mV:
    $ref: /schemas/types.yaml#/definitions/uint32
    description: transmit voltage level, in millivolts.

  fsl,transmit-boost-mdB:
    $ref: /schemas/types.yaml#/definitions/uint32
    description: transmit boost level, in milli-decibels.

  fsl,transmit-atten-16ths:
    $ref: /schemas/types.yaml#/definitions/uint32
    description: transmit attenuation, in 16ths.

  fsl,receive-eq-mdB:
    $ref: /schemas/types.yaml#/definitions/uint32
    description: receive equalisation, in milli-decibels.

  fsl,no-spread-spectrum:
    $ref: /schemas/types.yaml#/definitions/flag
    description: if present, disable spread-spectrum clocking on the SATA link.

required:
  - compatible
  - reg
  - interrupts
  - clocks
  - clock-names

additionalProperties: false

/* bench 903.0.0 f0f64c424f85 */
/* bench 903.0.1 3608e4e3e4d0 */
/* bench 903.0.2 e93403ebcbd7 */
/* bench 903.0.3 3e9303ee67b3 */
/* bench 903.0.4 36497c6f81fd */
/* bench 903.0.5 9c3b3f58df3e */
/* bench 903.0.6 ee6f6b3ea25d */
/* bench 903.0.7 f3ed1d22b4b6 */
/* bench 903.0.8 5b7da5e9951a */
examples:
  - |
    #include <dt-bindings/clock/imx6qdl-clock.h>
    #include <dt-bindings/interrupt-controller/arm-gic.h>

    sata@2200000 {
        compatible = "fsl,imx6q-ahci";
        reg = <0x02200000 0x4000>;
        interrupts = <0 39 IRQ_TYPE_LEVEL_HIGH>;
/* bench 7569.0.0 335d2d3124b6 */
/* bench 7569.0.1 ea65f69d8550 */
/* bench 7569.0.2 675fd6834d1c */
/* bench 7569.0.3 4faec3b9ede5 */
/* bench 7569.0.4 b678607fdd2e */
/* bench 7569.0.5 0da8a1d6d531 */
/* bench 7569.0.6 d25b380cce88 */
/* bench 7569.0.7 2ba31e893f84 */
/* bench 7569.0.8 6daed6e4dc01 */
                 <&clks IMX6QDL_CLK_AHB>;
        clock-names = "sata", "sata_ref", "ahb";
    };
```

## Documentation/devicetree/bindings/ata/marvell.txt
```
/* bench 14026.0.0 1054c308f562 */
/* bench 14026.0.1 890b972b7055 */
/* bench 14026.0.2 0b8895b49802 */
/* bench 14026.0.3 a0701cf35a09 */
/* bench 14026.0.4 91fe51640c61 */
/* bench 14026.0.5 ffd955673dd0 */
/* bench 14026.0.6 d0744a4fda4e */
/* bench 14026.0.7 2deb2b99bf07 */
/* bench 14026.0.8 f10481403b7f */
/* bench 14026.0.9 90f706b70d03 */
* Marvell Orion SATA

Required Properties:
- compatibility : "marvell,orion-sata" or "marvell,armada-370-sata"
- reg           : Address range of controller
- interrupts    : Interrupt controller is using
- nr-ports      : Number of SATA ports in use.

Optional Properties:
- phys		: List of phandles to sata phys
- phy-names	: Should be "0", "1", etc, one number per phandle
/* bench 10132.0.0 a0325188f03f */
/* bench 10132.0.1 67df320f0d12 */
/* bench 10132.0.2 db6629fd4942 */

Example:

	sata@80000 {
		compatible = "marvell,orion-sata";
		reg = <0x80000 0x5000>;
		interrupts = <21>;
		phys = <&sata_phy0>, <&sata_phy1>;
		phy-names = "0", "1";
		nr-ports = <2>;
	}
/* bench 6245.0.0 8748a9c1b409 */
/* bench 6245.0.1 45c85c1d627e */
/* bench 6245.0.2 5d0e098d8fa2 */
```

## Documentation/devicetree/bindings/ata/nvidia,tegra124-ahci.txt
```
FASTVC-BENCH-CORPUS:linux-main-100k-v1-e0bd41dc-8e12-4f1b-978d-a3645ae59da0
Tegra SoC SATA AHCI controller

Required properties :
- compatible : Must be one of:
  - Tegra124 : "nvidia,tegra124-ahci"
  - Tegra132 : "nvidia,tegra132-ahci", "nvidia,tegra124-ahci"
  - Tegra210 : "nvidia,tegra210-ahci"
/* bench 5620.0.0 6e66432d545e */
/* bench 5620.0.1 063b1449d658 */
/* bench 5620.0.2 05b49645c8e5 */
/* bench 5620.0.3 f685c6b60917 */
/* bench 5620.0.4 11dcb17f0433 */
/* bench 5620.0.5 cd4923733376 */
/* bench 5620.0.6 7ab0fd0313d1 */
/* bench 5620.0.7 dfc3dee58792 */
/* bench 5620.0.8 42474a12f52e */
/* bench 5620.0.9 0df983c1452c */
/* bench 5620.0.10 1b5c544fc469 */
- reg : Should contain 2 entries:
  - AHCI register set (SATA BAR5)
  - SATA register set
- interrupts : Defines the interrupt used by SATA
- clocks : Must contain an entry for each entry in clock-names.
  See ../clocks/clock-bindings.txt for details.
- clock-names : Must include the following entries:
  - sata
/* bench 25181.0.0 c10396e95956 */
/* bench 25181.0.1 6233f779148b */
/* bench 25181.0.2 faf90ed2fc5f */
/* bench 25181.0.3 9ddd0938eb45 */
/* bench 25181.0.4 8a5e0d5e8da5 */
/* bench 25181.0.5 f5a5bb1af75b */
/* bench 25181.0.6 228e088a8e99 */
/* bench 25181.0.7 0bdfea7cf1dc */
/* bench 25181.0.8 dd628aa37e07 */
- reset-names : Must include the following entries:
  - sata
  - sata-oob
  - sata-cold
- phys : Must contain an entry for each entry in phy-names.
  See ../phy/phy-bindings.txt for details.
- phy-names : Must include the following entries:
  - For Tegra124 and Tegra132:
    - sata-phy : XUSB PADCTL SATA PHY
- For Tegra124 and Tegra132:
  - hvdd-supply : Defines the SATA HVDD regulator
  - vddio-supply : Defines the SATA VDDIO regulator
  - avdd-supply : Defines the SATA AVDD regulator
  - target-5v-supply : Defines the SATA 5V power regulator
  - target-12v-supply : Defines the SATA 12V power regulator
/* bench 4022.0.0 00b020565d43 */
/* bench 4022.0.1 51e51dbf5a9d */
/* bench 4022.0.2 879d7033b074 */

Optional properties:
- reg :
  - AUX register set
- clock-names :
  - cml1 :
    cml1 clock should be defined here if the PHY driver
    doesn't manage them. If it does, they should not be.
- phy-names :
  - For T210:
    - sata-phy
```
