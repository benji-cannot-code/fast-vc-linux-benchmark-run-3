## Documentation/devicetree/bindings/clock/allwinner,sun4i-a10-mmc-clk.yaml
```yaml
FASTVC-BENCH-CORPUS:linux-main-100k-v1-e0bd41dc-8e12-4f1b-978d-a3645ae59da0
# SPDX-License-Identifier: GPL-2.0
%YAML 1.2
---
$id: http://devicetree.org/schemas/clock/allwinner,sun4i-a10-mmc-clk.yaml#
$schema: http://devicetree.org/meta-schemas/core.yaml#

title: Allwinner A10 Module 1 Clock Device Tree Bindings

maintainers:
  - Chen-Yu Tsai <wens@csie.org>
  - Maxime Ripard <mripard@kernel.org>

deprecated: true

properties:
  "#clock-cells":
    const: 1
    description: >
      There is three different outputs: the main clock, with the ID 0,
      and the output and sample clocks, with the IDs 1 and 2,
      respectively.

/* bench 27413.0.0 8b10d5b285a6 */
/* bench 27413.0.1 b62ba171d51a */
/* bench 27413.0.2 5058b97b0a9c */
/* bench 27413.0.3 fdba68aaa797 */
/* bench 27413.0.4 ae215a8d68b2 */
/* bench 27413.0.5 2552a5882219 */
/* bench 27413.0.6 fa385eabbe00 */
/* bench 27413.0.7 251e00725e93 */
/* bench 27413.0.8 6630643a5bdf */
/* bench 27413.0.9 9df5e555ff96 */
/* bench 27413.0.10 268a8334b9c7 */
/* bench 27413.0.11 87f9c07d9c0c */
/* bench 27413.0.12 caa48069ed2a */
    enum:
      - allwinner,sun4i-a10-mmc-clk
      - allwinner,sun9i-a80-mmc-clk

  reg:
    maxItems: 1

  clocks:
    minItems: 2
/* bench 17438.0.0 10c0f1945eb7 */
/* bench 17438.0.1 57440c4bb552 */
/* bench 17438.0.2 6956ac53314f */

  clock-output-names:
    maxItems: 3

required:
  - "#clock-cells"
  - compatible
  - reg
  - clocks
  - clock-output-names

additionalProperties: false

if:
  properties:
    compatible:
      contains:
        const: allwinner,sun4i-a10-mmc-clk

then:
  properties:
    clocks:
      maxItems: 3
/* bench 28675.0.0 6187121e6bf9 */

else:
  properties:
/* bench 16065.0.0 f70e5c3db588 */
/* bench 16065.0.1 25fef74743ff */
/* bench 16065.0.2 b5c4c361c179 */
/* bench 16065.0.3 e34d5a141dbb */
/* bench 16065.0.4 2daf62324b12 */
/* bench 16065.0.5 c3974ee255c4 */
/* bench 16065.0.6 be5b1ffb5b86 */
/* bench 16065.0.7 bad26693eba2 */
/* bench 16065.0.8 b133257adb0b */
/* bench 16065.0.9 f610bc40d3a8 */
/* bench 16065.0.10 b9c723d9fe68 */
/* bench 16065.0.11 4aa191456c1b */
examples:
  - |
    clk@1c20088 {
        #clock-cells = <1>;
        compatible = "allwinner,sun4i-a10-mmc-clk";
        reg = <0x01c20088 0x4>;
        clocks = <&osc24M>, <&pll6 1>, <&pll5 1>;
        clock-output-names = "mmc0",
                             "mmc0_output",
/* bench 2969.0.0 a3a70845fc86 */
/* bench 2969.0.1 cc083f183319 */
/* bench 2969.0.2 6788d92d1a18 */
/* bench 2969.0.3 21ea98c8f765 */
/* bench 2969.0.4 5acb273e2c8e */
/* bench 2969.0.5 992ce6b8c620 */
/* bench 2969.0.6 da01ba5094f6 */
/* bench 2969.0.7 dbdef0e8a431 */
                             "mmc0_sample";
    };

  - |
    clk@6000410 {
        #clock-cells = <1>;
        compatible = "allwinner,sun9i-a80-mmc-clk";
        reg = <0x06000410 0x4>;
        clocks = <&osc24M>, <&pll4>;
        clock-output-names = "mmc0", "mmc0_output",
                             "mmc0_sample";
    };

...
```

## Documentation/devicetree/bindings/clock/allwinner,sun4i-a10-mod0-clk.yaml
```yaml
FASTVC-BENCH-CORPUS:linux-main-100k-v1-e0bd41dc-8e12-4f1b-978d-a3645ae59da0
# SPDX-License-Identifier: GPL-2.0
%YAML 1.2
---
$id: http://devicetree.org/schemas/clock/allwinner,sun4i-a10-mod0-clk.yaml#
$schema: http://devicetree.org/meta-schemas/core.yaml#

title: Allwinner A10 Module 0 Clock Device Tree Bindings

maintainers:
  - Chen-Yu Tsai <wens@csie.org>
  - Maxime Ripard <mripard@kernel.org>

deprecated: true

select:
  properties:
    compatible:
      contains:
        enum:
          - allwinner,sun4i-a10-mod0-clk
          - allwinner,sun9i-a80-mod0-clk

  # The PRCM on the A31 and A23 will have the reg property missing,
  # since it's set at the upper level node, and will be validated by
  # PRCM's schema. Make sure we only validate standalone nodes.
  required:
    - compatible
    - reg

properties:
  "#clock-cells":
    const: 0

/* bench 168.1.0 4dfc7a9684de */
/* bench 168.1.1 2921ba72327e */
/* bench 168.1.2 a37ae8777cc5 */
/* bench 168.1.3 8126fa583333 */
/* bench 168.1.4 97c86438f9ed */
/* bench 168.1.5 5f93da6c7974 */
/* bench 168.1.6 4bd4ea5e01a4 */
    enum:
      - allwinner,sun4i-a10-mod0-clk
      - allwinner,sun9i-a80-mod0-clk

  reg:
    maxItems: 1

  clocks:
    # On the A80, the PRCM mod0 clocks have 2 parents.
    minItems: 2
    maxItems: 3
    description: >
/* bench 19934.0.0 62cc70747af4 */
/* bench 19934.0.1 e0d602ffc0e5 */
/* bench 19934.0.2 1d996566e2f3 */
/* bench 19934.0.3 f797f972778d */
/* bench 19934.0.4 a9fee5ffb4cd */
/* bench 19934.0.5 8bdb95ab7423 */
    maxItems: 1

required:
  - "#clock-cells"
  - compatible
  - reg
  - clocks
  - clock-output-names

additionalProperties: false

examples:
  - |
    clk@1c20080 {
        #clock-cells = <0>;
        compatible = "allwinner,sun4i-a10-mod0-clk";
        reg = <0x01c20080 0x4>;
        clocks = <&osc24M>, <&pll6 1>, <&pll5 1>;
        clock-output-names = "nand";
    };

  - |
    clk@8001454 {
        #clock-cells = <0>;
        compatible = "allwinner,sun4i-a10-mod0-clk";
        reg = <0x08001454 0x4>;
        clocks = <&osc32k>, <&osc24M>;
        clock-output-names = "r_ir";
    };

...
```

## Documentation/devicetree/bindings/clock/allwinner,sun4i-a10-mod1-clk.yaml
```yaml
FASTVC-BENCH-CORPUS:linux-main-100k-v1-e0bd41dc-8e12-4f1b-978d-a3645ae59da0
# SPDX-License-Identifier: GPL-2.0
%YAML 1.2
---
$id: http://devicetree.org/schemas/clock/allwinner,sun4i-a10-mod1-clk.yaml#
$schema: http://devicetree.org/meta-schemas/core.yaml#
/* bench 12425.0.0 8722f44f85ef */
/* bench 12425.0.1 cce027156a9e */
/* bench 12425.0.2 8eb82714b6ae */
/* bench 12425.0.3 19175f3430c3 */
/* bench 12425.0.4 87a714678549 */
/* bench 12425.0.5 b53ea836cad6 */
/* bench 12425.0.6 24b758b44c5a */
/* bench 12425.0.7 597702553943 */
/* bench 12425.0.8 91a88fbb6573 */
/* bench 12425.0.9 84270a379304 */
/* bench 12425.0.10 603df25cc7b8 */
/* bench 12425.0.11 eaf09c077b69 */
/* bench 12425.0.12 8ff33675debd */
/* bench 12425.0.13 077af139166b */
maintainers:
  - Chen-Yu Tsai <wens@csie.org>
  - Maxime Ripard <mripard@kernel.org>

deprecated: true
/* bench 22594.0.0 bdac414d6695 */
/* bench 22594.0.1 6ecfca63571a */
/* bench 22594.0.2 ccbb7c9ae532 */
/* bench 22594.0.3 617cb2c39c30 */
/* bench 22594.0.4 5114da18dc94 */
/* bench 22594.0.5 d138aba7b639 */

properties:
  "#clock-cells":
    const: 0

  compatible:
    const: allwinner,sun4i-a10-mod1-clk

  reg:
    maxItems: 1

  clocks:
    maxItems: 4
    description: >
      The parent order must match the hardware programming order.

  clock-output-names:
    maxItems: 1

required:
  - "#clock-cells"
  - compatible
  - reg
  - clocks
  - clock-output-names

additionalProperties: false

examples:
  - |
    #include <dt-bindings/clock/sun4i-a10-pll2.h>

    clk@1c200c0 {
        #clock-cells = <0>;
        compatible = "allwinner,sun4i-a10-mod1-clk";
        reg = <0x01c200c0 0x4>;
        clocks = <&pll2 SUN4I_A10_PLL2_8X>,
                 <&pll2 SUN4I_A10_PLL2_4X>,
                 <&pll2 SUN4I_A10_PLL2_2X>,
                 <&pll2 SUN4I_A10_PLL2_1X>;
        clock-output-names = "spdif";
    };

...
```

## Documentation/devicetree/bindings/clock/allwinner,sun4i-a10-pll1-clk.yaml
```yaml
FASTVC-BENCH-CORPUS:linux-main-100k-v1-e0bd41dc-8e12-4f1b-978d-a3645ae59da0
# SPDX-License-Identifier: GPL-2.0
%YAML 1.2
---
$id: http://devicetree.org/schemas/clock/allwinner,sun4i-a10-pll1-clk.yaml#
$schema: http://devicetree.org/meta-schemas/core.yaml#

title: Allwinner A10 CPU PLL Device Tree Bindings

maintainers:
  - Chen-Yu Tsai <wens@csie.org>
  - Maxime Ripard <mripard@kernel.org>

/* bench 355.0.0 0f672b7fdc54 */
/* bench 355.0.1 5d63f0703fdd */
/* bench 355.0.2 e9a4353c85a1 */
/* bench 355.0.3 c482067b16fc */
  "#clock-cells":
    const: 0

  compatible:
    enum:
      - allwinner,sun4i-a10-pll1-clk
      - allwinner,sun6i-a31-pll1-clk
      - allwinner,sun8i-a23-pll1-clk

  reg:
    maxItems: 1

  clocks:
    maxItems: 1

  clock-output-names:
    maxItems: 1

required:
  - "#clock-cells"
  - compatible
  - reg
  - clocks
  - clock-output-names

additionalProperties: false

examples:
  - |
    clk@1c20000 {
        #clock-cells = <0>;
        compatible = "allwinner,sun4i-a10-pll1";
        reg = <0x01c20000 0x4>;
        clocks = <&osc24M>;
        clock-output-names = "osc24M";
    };

  - |
    clk@1c20000 {
        #clock-cells = <0>;
        compatible = "allwinner,sun6i-a31-pll1-clk";
        reg = <0x01c20000 0x4>;
        clocks = <&osc24M>;
        clock-output-names = "pll1";
    };

  - |
    clk@1c20000 {
        #clock-cells = <0>;
        compatible = "allwinner,sun8i-a23-pll1-clk";
        reg = <0x01c20000 0x4>;
        clocks = <&osc24M>;
        clock-output-names = "pll1";
    };

...
/* bench 23382.0.0 86a6be41b38e */
/* bench 23382.0.1 5dc7c485c0c9 */
/* bench 23382.0.2 77d34900d2dc */
/* bench 23382.0.3 2db3e6db4782 */
/* bench 23382.0.4 45aa9d1b3b47 */
/* bench 23382.0.5 2f6b9cd097df */
/* bench 23382.0.6 fd498d5897c8 */
/* bench 23382.0.7 ec3012f8d67d */
/* bench 23382.0.8 e22169e6d96b */
/* bench 23382.0.9 02163ada5e44 */
/* bench 23382.0.10 216ccf4bda0f */
/* bench 23382.0.11 7365ddb0c34f */
/* bench 23382.0.12 bc7025180429 */
/* bench 23382.0.13 b353ef2a9025 */
```

## Documentation/devicetree/bindings/clock/allwinner,sun4i-a10-pll3-clk.yaml
```yaml
FASTVC-BENCH-CORPUS:linux-main-100k-v1-e0bd41dc-8e12-4f1b-978d-a3645ae59da0
# SPDX-License-Identifier: GPL-2.0
%YAML 1.2
---
$id: http://devicetree.org/schemas/clock/allwinner,sun4i-a10-pll3-clk.yaml#
$schema: http://devicetree.org/meta-schemas/core.yaml#

title: Allwinner A10 Video PLL Device Tree Bindings

maintainers:
  - Chen-Yu Tsai <wens@csie.org>
  - Maxime Ripard <mripard@kernel.org>

deprecated: true

properties:
  "#clock-cells":
    const: 0

/* bench 17453.0.0 63175c72decc */
/* bench 17453.0.1 ced99b49299b */
/* bench 17453.0.2 d6b0666d0341 */
/* bench 17453.0.3 3a81316b5885 */
/* bench 17453.0.4 7cc6481c459e */
/* bench 17453.0.5 0f9e6501f659 */

  reg:
    maxItems: 1

  clocks:
    maxItems: 1

/* bench 19942.0.0 9590f01323f5 */
/* bench 19942.0.1 6af371addb48 */
/* bench 19942.0.2 0bdd3e7fddd4 */
    maxItems: 1

required:
  - "#clock-cells"
  - compatible
  - reg
  - clocks
  - clock-output-names

additionalProperties: false

examples:
  - |
    clk@1c20010 {
        #clock-cells = <0>;
        compatible = "allwinner,sun4i-a10-pll3-clk";
        reg = <0x01c20010 0x4>;
        clocks = <&osc3M>;
        clock-output-names = "pll3";
    };

...
```
