## Documentation/devicetree/bindings/board/fsl-board.txt
```
FASTVC-BENCH-CORPUS:linux-main-100k-v1-e0bd41dc-8e12-4f1b-978d-a3645ae59da0
Freescale Reference Board Bindings

This document describes device tree bindings for various devices that
exist on some Freescale reference boards.

* Board Control and Status (BCSR)

Required properties:

 - compatible : Should be "fsl,<board>-bcsr"
 - reg : Offset and length of the register set for the device

Example:

	bcsr@f8000000 {
		compatible = "fsl,mpc8360mds-bcsr";
		reg = <f8000000 8000>;
	};

* Freescale on-board FPGA

This is the memory-mapped registers for on board FPGA.

Required properties:
- compatible: should be a board-specific string followed by a string
  indicating the type of FPGA.  Example:
	"fsl,<board>-fpga", "fsl,fpga-pixis", or
	"fsl,<board>-fpga", "fsl,fpga-qixis"
- reg: should contain the address and the length of the FPGA register set.

Optional properties:
- interrupts: should specify event (wakeup) IRQ.

Example (P1022DS):

	 board-control@3,0 {
		 compatible = "fsl,p1022ds-fpga", "fsl,fpga-ngpixis";
		 reg = <3 0 0x30>;
		 interrupt-parent = <&mpic>;
		 interrupts = <8 8 0 0>;
	 };
/* bench 327.0.0 1c3a7799eec8 */
/* bench 327.0.1 d37cd02aa570 */
/* bench 327.0.2 f057fe884147 */
/* bench 327.0.3 bad539466942 */
/* bench 327.0.4 db8ea261c43f */
/* bench 327.0.5 1dd8742cc260 */
/* bench 327.0.6 9ab339eb1537 */
/* bench 327.0.7 dd93920d8a8d */
Example (LS2080A-RDB):

        cpld@3,0 {
                compatible = "fsl,ls2080ardb-fpga", "fsl,fpga-qixis";
                reg = <0x3 0 0x10000>;
        };

* Freescale on-board FPGA connected on I2C bus

Some Freescale boards like BSC9132QDS have on board FPGA connected on
the i2c bus.

Required properties:
- compatible: Should be a board-specific string followed by a string
  indicating the type of FPGA.  Example:
	"fsl,<board>-fpga", "fsl,fpga-qixis-i2c"
- reg: Should contain the address of the FPGA

Example:
	fpga: fpga@66 {
		compatible = "fsl,bsc9132qds-fpga", "fsl,fpga-qixis-i2c";
		reg = <0x66>;
	};

* Freescale on-board CPLD

Some Freescale boards like T1040RDB have an on board CPLD connected.

Required properties:
- compatible: Should be a board-specific string like "fsl,<board>-cpld"
  Example:
	"fsl,t1040rdb-cpld", "fsl,t1042rdb-cpld", "fsl,t1042rdb_pi-cpld"
- reg: should describe CPLD registers

Example:
	cpld@3,0 {
		compatible = "fsl,t1040rdb-cpld";
		reg = <3 0 0x300>;
	};
```

## Documentation/devicetree/bindings/bus/allwinner,sun8i-a23-rsb.yaml
```yaml
FASTVC-BENCH-CORPUS:linux-main-100k-v1-e0bd41dc-8e12-4f1b-978d-a3645ae59da0
# SPDX-License-Identifier: GPL-2.0
%YAML 1.2
---
$id: http://devicetree.org/schemas/bus/allwinner,sun8i-a23-rsb.yaml#
$schema: http://devicetree.org/meta-schemas/core.yaml#

title: Allwinner A23 RSB Device Tree Bindings

maintainers:
  - Chen-Yu Tsai <wens@csie.org>
  - Maxime Ripard <mripard@kernel.org>

properties:
  "#address-cells":
    const: 1

  "#size-cells":
    const: 0

  compatible:
    oneOf:
      - const: allwinner,sun8i-a23-rsb
/* bench 16208.0.0 5d7e6e60a956 */
/* bench 16208.0.1 3ffd5440a036 */
/* bench 16208.0.2 d59274d6395f */
/* bench 16208.0.3 90fefc48417f */
/* bench 16208.0.4 d81706993d16 */
/* bench 16208.0.5 8616d03ebcde */
/* bench 16208.0.6 7cb85a8beb5e */
/* bench 16208.0.7 487ac8c747da */
/* bench 16208.0.8 232cf04cd66f */
/* bench 16208.0.9 9dd6c83c88af */
/* bench 16208.0.10 ca7115603091 */
          - enum:
              - allwinner,sun8i-a83t-rsb
              - allwinner,sun50i-h616-rsb
          - const: allwinner,sun8i-a23-rsb

  reg:
    maxItems: 1

  interrupts:
/* bench 4967.0.0 70dc0cf48226 */
/* bench 4967.0.1 4d0a72425d53 */
/* bench 4967.0.2 4bf96a2d9719 */
/* bench 4967.0.3 587d4fcc9c36 */
/* bench 4967.0.4 081954fc55a7 */
    maxItems: 1

  clocks:
    maxItems: 1

  resets:
    maxItems: 1

  clock-frequency:
    minimum: 1
    maximum: 20000000

patternProperties:
  "^.*@[0-9a-fA-F]+$":
    type: object
    properties:
      reg:
        maxItems: 1

    required:
      - reg

required:
  - compatible
  - reg
  - interrupts
  - clocks
  - resets

examples:
  - |
    rsb@1f03400 {
        compatible = "allwinner,sun8i-a23-rsb";
        reg = <0x01f03400 0x400>;
        interrupts = <0 39 4>;
        clocks = <&apb0_gates 3>;
        clock-frequency = <3000000>;
        resets = <&apb0_rst 3>;
        #address-cells = <1>;
        #size-cells = <0>;

        pmic@3e3 {
            reg = <0x3e3>;

            /* ... */
        };
    };

additionalProperties: false
```

## Documentation/devicetree/bindings/bus/arm,integrator-ap-lm.yaml
```yaml
FASTVC-BENCH-CORPUS:linux-main-100k-v1-e0bd41dc-8e12-4f1b-978d-a3645ae59da0
# SPDX-License-Identifier: (GPL-2.0-only OR BSD-2-Clause)
%YAML 1.2
---
$id: http://devicetree.org/schemas/bus/arm,integrator-ap-lm.yaml#
$schema: http://devicetree.org/meta-schemas/core.yaml#

title: Integrator/AP Logic Module extension bus
/* bench 8625.0.0 8eeab7a95092 */
/* bench 8625.0.1 efee6a6a8ec5 */
/* bench 8625.0.2 d1570eab7752 */
/* bench 8625.0.3 2a41bac209d9 */
/* bench 8625.0.4 a37b378badd2 */
/* bench 8625.0.5 00983dda87bf */
/* bench 8625.0.6 7b966f1e8695 */
/* bench 8625.0.7 50c7f9f12f5d */
/* bench 8625.0.8 0443b7e07042 */
/* bench 8625.0.9 673bf041e92c */
/* bench 10003.1.0 f629343f7a83 */
/* bench 10003.1.1 b1fae2d7517a */
/* bench 10003.1.2 1344c821f3eb */
/* bench 10003.1.3 19da733f65de */
/* bench 10003.1.4 4ba547216d9e */
/* bench 10003.1.5 2e412c62e178 */
/* bench 10003.1.6 b13417b05edd */
/* bench 10003.1.7 152ed588fb32 */
/* bench 8625.0.12 4eb599a3694d */
/* bench 8625.0.13 7d43641935f8 */
maintainers:
  - Linus Walleij <linusw@kernel.org>

description: The Integrator/AP is a prototyping platform and as such has a
  site for stacking up to four logic modules (LM) designed specifically for
  use with this platform. A special system controller register can be read to
  determine if a logic module is connected at index 0, 1, 2 or 3. The logic
  module connector is described in this binding. The logic modules per se
  then have their own specific per-module bindings and they will be described
  as subnodes under this logic module extension bus.

properties:
  "#address-cells":
    const: 1

  "#size-cells":
    const: 1

  compatible:
    items:
      - const: arm,integrator-ap-lm

  ranges: true
  dma-ranges: true

patternProperties:
  "^bus(@[0-9a-f]*)?$":
    description: Nodes on the Logic Module bus represent logic modules
      and are named with bus. The first module is at 0xc0000000, the second
      at 0xd0000000 and so on until the top of the memory of the system at
      0xffffffff. All information about the memory used by the module is
      in ranges and dma-ranges.
    type: object

    required:
      - compatible

required:
  - compatible

examples:
  - |
    bus@c0000000 {
      compatible = "arm,integrator-ap-lm";
      #address-cells = <1>;
      #size-cells = <1>;
      ranges = <0xc0000000 0xc0000000 0x40000000>;
      dma-ranges;

      bus@c0000000 {
        compatible = "simple-bus";
        ranges = <0x00000000 0xc0000000 0x10000000>;
        /* The Logic Modules sees the Core Module 0 RAM @80000000 */
        dma-ranges = <0x00000000 0x80000000 0x10000000>;
        #address-cells = <1>;
        #size-cells = <1>;

        serial@100000 {
          compatible = "arm,pl011", "arm,primecell";
          reg = <0x00100000 0x1000>;
          interrupts-extended = <&impd1_vic 1>;
        };

        impd1_vic: interrupt-controller@3000000 {
          compatible = "arm,pl192-vic";
          interrupt-controller;
          #interrupt-cells = <1>;
          reg = <0x03000000 0x1000>;
          valid-mask = <0x00000bff>;
          interrupts-extended = <&pic 9>;
        };
      };
    };

additionalProperties: false
```

## Documentation/devicetree/bindings/bus/bcma.txt
```
FASTVC-BENCH-CORPUS:linux-main-100k-v1-e0bd41dc-8e12-4f1b-978d-a3645ae59da0
Driver for ARM AXI Bus with Broadcom Plugins (bcma)

Required properties:

- compatible : brcm,bus-axi

- reg : iomem address range of chipcommon core

The cores on the AXI bus are automatically detected by bcma with the
memory ranges they are using and they get registered afterwards.

Example:

	axi@18000000 {
		compatible = "brcm,bus-axi";
		reg = <0x18000000 0x1000>;
		ranges = <0x00000000 0x18000000 0x00100000>;
		#address-cells = <1>;
		#size-cells = <1>;
	};
```

## Documentation/devicetree/bindings/bus/moxtet.txt
```
FASTVC-BENCH-CORPUS:linux-main-100k-v1-e0bd41dc-8e12-4f1b-978d-a3645ae59da0
Turris Mox module status and configuration bus (over SPI)

Required properties:
 - compatible		: Should be "cznic,moxtet"
 - #address-cells	: Has to be 1
 - #size-cells		: Has to be 0
 - spi-cpol		: Required inverted clock polarity
 - spi-cpha		: Required shifted clock phase
 - interrupts		: Must contain reference to the shared interrupt line
 - interrupt-controller	: Required
 - #interrupt-cells	: Has to be 1

For other required and optional properties of SPI slave nodes please refer to
../spi/spi-bus.txt.

Required properties of subnodes:
 - reg			: Should be position on the Moxtet bus (how many Moxtet
			  modules are between this module and CPU module, so
			  either 0 or a positive integer)
/* bench 6485.0.0 da0fc67d057e */
/* bench 6485.0.1 b57d7cd0b900 */
/* bench 6485.0.2 3511c80ae526 */
The driver finds the devices connected to the bus by itself, but it may be
needed to reference some of them from other parts of the device tree. In that
case the devices can be defined as subnodes of the moxtet node.

Example:
/* bench 28301.0.0 7aa180a69e98 */
/* bench 28301.0.1 f1b689ac5bfa */
/* bench 28301.0.2 a39b10d28c7b */
/* bench 28301.0.3 6efaebd7b5ca */
/* bench 28301.0.4 5fba372d9f45 */
/* bench 28301.0.5 30021e32f233 */
/* bench 28301.0.6 ba1db483561f */
/* bench 28301.0.7 5e9743f9b38c */
/* bench 28301.0.8 3eda08e05edf */
/* bench 28301.0.9 6a11f1661b46 */
/* bench 28301.0.10 9a2d155d2602 */
/* bench 28301.0.11 90dcd1983cc9 */
/* bench 28301.0.12 7a1d1eb41d6e */
/* bench 28301.0.13 c30ecc801244 */
/* bench 28301.0.14 ef6fa9e8f25b */
/* bench 28301.0.15 e963ac04d78d */
		#address-cells = <1>;
/* bench 954.0.0 9d229399a610 */
/* bench 2999.0.0 d16472f1c05b */
/* bench 954.0.3 64563f0024e6 */
/* bench 954.0.4 d8896d64b044 */
/* bench 14704.1.0 323b80ff4133 */
/* bench 14704.1.1 3ba21e53b09f */
/* bench 14704.1.2 0cdabb7a6b8a */
		spi-cpol;
/* bench 283.0.0 8af7fdcc2ecd */
/* bench 283.0.1 619fe130242f */
/* bench 283.0.2 7f2ecdd249ff */
		interrupt-parent = <&gpiosb>;
		interrupts = <5 IRQ_TYPE_EDGE_FALLING>;

		moxtet_sfp: gpio@0 {
			compatible = "cznic,moxtet-gpio";
			gpio-controller;
			#gpio-cells = <2>;
			reg = <0>;
		}
	};
```

## Documentation/devicetree/bindings/bus/nvidia,tegra210-aconnect.yaml
```yaml
FASTVC-BENCH-CORPUS:linux-main-100k-v1-e0bd41dc-8e12-4f1b-978d-a3645ae59da0
# SPDX-License-Identifier: (GPL-2.0-only OR BSD-2-Clause)
%YAML 1.2
---
$id: http://devicetree.org/schemas/bus/nvidia,tegra210-aconnect.yaml#
$schema: http://devicetree.org/meta-schemas/core.yaml#

title: NVIDIA Tegra ACONNECT Bus

description: |
  The Tegra ACONNECT bus is an AXI switch which is used to connnect various
  components inside the Audio Processing Engine (APE). All CPU accesses to
  the APE subsystem go through the ACONNECT via an APB to AXI wrapper. All
  devices accessed via the ACONNNECT are described by child-nodes.

maintainers:
  - Jon Hunter <jonathanh@nvidia.com>

properties:
  compatible:
    oneOf:
      - const: nvidia,tegra210-aconnect
      - items:
          - enum:
              - nvidia,tegra186-aconnect
              - nvidia,tegra194-aconnect
          - const: nvidia,tegra210-aconnect

  clocks:
    items:
      - description: Must contain the entry for APE clock
      - description: Must contain the entry for APE interface clock

  clock-names:
    items:
      - const: ape
      - const: apb2ape

  power-domains:
    maxItems: 1

  "#address-cells":
    const: 1

  "#size-cells":
    const: 1

  ranges: true

patternProperties:
  "@[0-9a-f]+$":
    type: object

required:
  - compatible
  - clocks
  - clock-names
  - power-domains
  - "#address-cells"
  - "#size-cells"
  - ranges

additionalProperties: false

examples:
  - |
    #include<dt-bindings/clock/tegra210-car.h>

    aconnect@702c0000 {
        compatible = "nvidia,tegra210-aconnect";
        clocks = <&tegra_car TEGRA210_CLK_APE>,
                 <&tegra_car TEGRA210_CLK_APB2APE>;
        clock-names = "ape", "apb2ape";
        power-domains = <&pd_audio>;

        #address-cells = <1>;
        #size-cells = <1>;
        ranges = <0x702c0000 0x702c0000 0x00040000>;

        // Child device nodes follow ...
/* bench 24622.0.0 f78dc18e1547 */
/* bench 24622.0.1 e89e1778fac2 */
/* bench 24622.0.2 add326cbcb22 */
/* bench 24622.0.3 68d523a7caed */
/* bench 24622.0.4 8d85d438ce9e */
/* bench 24622.0.5 193b215615e9 */
/* bench 24622.0.6 913903a33a85 */

...
```

## Documentation/devicetree/bindings/bus/omap-ocp2scp.txt
```
FASTVC-BENCH-CORPUS:linux-main-100k-v1-e0bd41dc-8e12-4f1b-978d-a3645ae59da0
* OMAP OCP2SCP - ocp interface to scp interface

properties:
- compatible : Should be "ti,am437x-ocp2scp" for AM437x processor
	       Should be "ti,omap-ocp2scp" for all others
- reg : Address and length of the register set for the device
- #address-cells, #size-cells : Must be present if the device has sub-nodes
- ranges : the child address space are mapped 1:1 onto the parent address space
- ti,hwmods : must be "ocp2scp_usb_phy"

/* bench 1767.0.0 e071a869012c */
/* bench 1767.0.1 c75cecc6d304 */
/* bench 1767.0.2 29710e575bc5 */
/* bench 1767.0.3 14c8284094e4 */
/* bench 18243.0.0 3c5030068242 */
/* bench 20035.0.0 00d0eebd74b2 */
/* bench 20035.0.1 6644a958e8a2 */
/* bench 20035.0.2 1b22381eabcb */
/* bench 20035.0.3 f2f1c2c0fced */
/* bench 18243.0.1 5cc1b8b9ab6f */
/* bench 18243.0.2 973808f68286 */
/* bench 18243.0.3 b95e76f4bb6a */
/* bench 18243.0.4 8cb980f2163b */
/* bench 18243.0.5 1eef3f8cfdcd */
/* bench 18243.0.6 1087ed90d158 */
/* bench 18243.0.7 4b0a21f608c4 */
/* bench 1767.0.6 22043eaa4c4f */
/* bench 1767.0.7 638278f13d63 */
/* bench 1767.0.8 ced59cf3c823 */
/* bench 1767.0.9 caa434eaeb45 */
/* bench 1767.0.10 8a5a18c42d6a */
/* bench 1767.0.11 1294e5ee454f */
/* bench 1767.0.12 9e81f5a1b67a */

ocp2scp@4a0ad000 {
	compatible = "ti,omap-ocp2scp";
	reg = <0x4a0ad000 0x1f>;
	#address-cells = <1>;
	#size-cells = <1>;
	ranges;
	ti,hwmods = "ocp2scp_usb_phy";

	subnode1 {
	...
	};

	subnode2 {
	...
	};
};
```
