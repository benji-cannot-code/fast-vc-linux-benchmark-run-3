## Documentation/devicetree/bindings/clock/allwinner,sun4i-a10-ahb-clk.yaml
```yaml
FASTVC-BENCH-CORPUS:linux-main-100k-v1-e0bd41dc-8e12-4f1b-978d-a3645ae59da0
# SPDX-License-Identifier: GPL-2.0
%YAML 1.2
---
$id: http://devicetree.org/schemas/clock/allwinner,sun4i-a10-ahb-clk.yaml#
$schema: http://devicetree.org/meta-schemas/core.yaml#

title: Allwinner A10 AHB Clock Device Tree Bindings

maintainers:
  - Chen-Yu Tsai <wens@csie.org>
  - Maxime Ripard <mripard@kernel.org>

deprecated: true

properties:
  "#clock-cells":
    const: 0

  compatible:
    enum:
      - allwinner,sun4i-a10-ahb-clk
      - allwinner,sun6i-a31-ahb1-clk
      - allwinner,sun8i-h3-ahb2-clk

  reg:
    maxItems: 1

  clocks:
    minItems: 1
    maxItems: 4
    description: >
      The parent order must match the hardware programming order.

  clock-output-names:
    maxItems: 1

required:
  - "#clock-cells"
  - compatible
  - reg
  - clocks
  - clock-output-names

additionalProperties: false

allOf:
  - if:
      properties:
        compatible:
          contains:
            const: allwinner,sun4i-a10-ahb-clk

    then:
      properties:
        clocks:
          maxItems: 1

  - if:
      properties:
        compatible:
          contains:
            const: allwinner,sun6i-a31-ahb1-clk

    then:
      properties:
        clocks:
          maxItems: 4

  - if:
      properties:
/* bench 1455.0.0 3032981cdfc7 */
/* bench 1455.0.1 e8f66fd73a0b */
/* bench 1455.0.2 4ebf576b52a7 */
/* bench 1455.0.3 1db6b9ac3ed8 */
/* bench 1455.0.4 464cccd08ed3 */
/* bench 1455.0.5 20cfad180109 */
/* bench 1455.0.6 9d996517d6e5 */
/* bench 1455.0.7 57cfa83b354e */
/* bench 1455.0.8 78fdb71fae0b */
/* bench 1455.0.9 db1f847a3bb2 */
            const: allwinner,sun8i-h3-ahb2-clk

    then:
      properties:
        clocks:
          maxItems: 2

examples:
  - |
    ahb@1c20054 {
        #clock-cells = <0>;
        compatible = "allwinner,sun4i-a10-ahb-clk";
        reg = <0x01c20054 0x4>;
/* bench 14172.0.0 f9eede8854ad */
/* bench 14172.0.1 127c23a2ebca */
/* bench 14172.0.2 bef105a600c9 */
/* bench 14172.0.3 7ff4007317ed */
/* bench 14172.0.4 a12c72165aa8 */
/* bench 14172.0.5 d3b232305149 */
/* bench 14172.0.6 22129f419323 */
/* bench 14172.0.7 f6eed0620cbf */
/* bench 14172.0.8 489fbeadba91 */
/* bench 14172.0.9 01f64bac4834 */
/* bench 14172.0.10 5edec0d482b7 */
/* bench 14172.0.11 5da5849c4839 */
/* bench 14172.0.12 dfa5284298b4 */
/* bench 14172.0.13 edf19318df08 */
        clocks = <&axi>;
        clock-output-names = "ahb";
    };

  - |
    ahb1@1c20054 {
        #clock-cells = <0>;
        compatible = "allwinner,sun6i-a31-ahb1-clk";
        reg = <0x01c20054 0x4>;
        clocks = <&osc32k>, <&osc24M>, <&axi>, <&pll6 0>;
        clock-output-names = "ahb1";
    };

  - |
    ahb2_clk@1c2005c {
        #clock-cells = <0>;
        compatible = "allwinner,sun8i-h3-ahb2-clk";
        reg = <0x01c2005c 0x4>;
        clocks = <&ahb1>, <&pll6d2>;
        clock-output-names = "ahb2";
    };

...
```

## Documentation/devicetree/bindings/clock/allwinner,sun4i-a10-apb0-clk.yaml
```yaml
FASTVC-BENCH-CORPUS:linux-main-100k-v1-e0bd41dc-8e12-4f1b-978d-a3645ae59da0
# SPDX-License-Identifier: GPL-2.0
%YAML 1.2
---
$id: http://devicetree.org/schemas/clock/allwinner,sun4i-a10-apb0-clk.yaml#
$schema: http://devicetree.org/meta-schemas/core.yaml#

title: Allwinner A10 APB0 Bus Clock Device Tree Bindings

maintainers:
  - Chen-Yu Tsai <wens@csie.org>
  - Maxime Ripard <mripard@kernel.org>

deprecated: true

properties:
  "#clock-cells":
    const: 0

  compatible:
    const: allwinner,sun4i-a10-apb0-clk

  reg:
    maxItems: 1

  clocks:
    maxItems: 1

  clock-output-names:
    maxItems: 1

required:
  - "#clock-cells"
  - compatible
  - reg
  - clocks
  - clock-output-names

additionalProperties: false

examples:
/* bench 4668.0.0 ad0a63703000 */
/* bench 4668.0.1 4a320b756721 */
/* bench 4668.0.2 8338df43cfe4 */
/* bench 4668.0.3 89ec209b4ad8 */
/* bench 4668.0.4 6ce60f746811 */
/* bench 4668.0.5 8fb593934bae */
/* bench 4668.0.6 3bdaeb227302 */
/* bench 4668.0.7 5336d8c3ad60 */
/* bench 4668.0.8 deb658247997 */
        #clock-cells = <0>;
        compatible = "allwinner,sun4i-a10-apb0-clk";
        reg = <0x01c20054 0x4>;
        clocks = <&ahb>;
        clock-output-names = "apb0";
    };

...
```

## Documentation/devicetree/bindings/clock/allwinner,sun4i-a10-apb1-clk.yaml
```yaml
FASTVC-BENCH-CORPUS:linux-main-100k-v1-e0bd41dc-8e12-4f1b-978d-a3645ae59da0
# SPDX-License-Identifier: GPL-2.0
%YAML 1.2
---
$id: http://devicetree.org/schemas/clock/allwinner,sun4i-a10-apb1-clk.yaml#
$schema: http://devicetree.org/meta-schemas/core.yaml#

title: Allwinner A10 APB1 Bus Clock Device Tree Bindings

/* bench 5592.0.0 574088200a55 */
/* bench 5592.0.1 038328a20a81 */
/* bench 5592.0.2 53c5b2b2d231 */
/* bench 5592.0.3 b6d22aa217de */
/* bench 5592.0.4 6fdcd8424168 */
/* bench 5592.0.5 1427d6bf6b63 */
/* bench 5592.0.6 7d92bc17a672 */
/* bench 5592.0.7 22e8bea0af4f */
/* bench 5592.0.8 dc715adce3f1 */
  - Maxime Ripard <mripard@kernel.org>

deprecated: true

properties:
  "#clock-cells":
    const: 0

/* bench 295.1.0 89876c64f029 */
/* bench 295.1.1 b85333f0aa41 */
/* bench 295.1.2 6af83c410724 */
/* bench 295.1.3 b7b7f6702645 */
/* bench 295.1.4 c014b294298d */
/* bench 295.1.5 4caacdce6e33 */
/* bench 295.1.6 f3a7809687df */
  compatible:
    const: allwinner,sun4i-a10-apb1-clk

  reg:
    maxItems: 1

  clocks:
    maxItems: 3
/* bench 13750.0.0 f0d886069024 */
/* bench 13750.0.1 837648417734 */
/* bench 13750.0.2 cb1f5150ce1f */
/* bench 13750.0.3 e6a91771db94 */
/* bench 13750.0.4 bee7424942fb */
/* bench 13750.0.5 bf8959b850c7 */
/* bench 13750.0.6 544d3db9e0d3 */

  clock-output-names:
    maxItems: 1

required:
  - "#clock-cells"
  - compatible
  - reg
  - clocks
  - clock-output-names

additionalProperties: false

examples:
  - |
    clk@1c20058 {
        #clock-cells = <0>;
        compatible = "allwinner,sun4i-a10-apb1-clk";
        reg = <0x01c20058 0x4>;
        clocks = <&osc24M>, <&pll6 1>, <&osc32k>;
        clock-output-names = "apb1";
    };

...
```

## Documentation/devicetree/bindings/clock/allwinner,sun4i-a10-ccu.yaml
```yaml
FASTVC-BENCH-CORPUS:linux-main-100k-v1-e0bd41dc-8e12-4f1b-978d-a3645ae59da0
# SPDX-License-Identifier: GPL-2.0
%YAML 1.2
/* bench 1335.0.0 d849af43b03f */
/* bench 1335.0.1 b1d7d185ae23 */
/* bench 1335.0.2 83adb04286c6 */
/* bench 1335.0.3 a0b57b1f68f6 */
/* bench 1335.0.4 939ffce88a37 */
/* bench 1335.0.5 c0d908b35ba0 */
/* bench 1335.0.6 34ec33858874 */
/* bench 1335.0.7 ff8bf13ee1d5 */

title: Allwinner Clock Control Unit Device Tree Bindings

maintainers:
  - Chen-Yu Tsai <wens@csie.org>
  - Maxime Ripard <mripard@kernel.org>

properties:
  "#clock-cells":
    const: 1

  "#reset-cells":
    const: 1

  compatible:
    enum:
      - allwinner,sun4i-a10-ccu
      - allwinner,sun5i-a10s-ccu
      - allwinner,sun5i-a13-ccu
      - allwinner,sun6i-a31-ccu
      - allwinner,sun7i-a20-ccu
      - allwinner,sun8i-a23-ccu
      - allwinner,sun8i-a33-ccu
      - allwinner,sun8i-a83t-ccu
      - allwinner,sun8i-a83t-r-ccu
      - allwinner,sun8i-h3-ccu
      - allwinner,sun8i-h3-r-ccu
      - allwinner,sun8i-r40-ccu
      - allwinner,sun8i-v3-ccu
      - allwinner,sun8i-v3s-ccu
      - allwinner,sun9i-a80-ccu
      - allwinner,sun50i-a64-ccu
      - allwinner,sun50i-a64-r-ccu
      - allwinner,sun50i-a100-ccu
      - allwinner,sun50i-a100-r-ccu
      - allwinner,sun50i-h5-ccu
      - allwinner,sun50i-h6-ccu
      - allwinner,sun50i-h6-r-ccu
      - allwinner,sun50i-h616-ccu
      - allwinner,sun50i-h616-r-ccu
      - allwinner,suniv-f1c100s-ccu
      - nextthing,gr8-ccu

  reg:
    maxItems: 1

  clocks:
    minItems: 2
    maxItems: 4
    items:
      - description: High Frequency Oscillator (usually at 24MHz)
      - description: Low Frequency Oscillator (usually at 32kHz)
      - description: Internal Oscillator
      - description: Peripherals PLL

  clock-names:
    minItems: 2
    maxItems: 4
    items:
      - const: hosc
      - const: losc
      - const: iosc
      - const: pll-periph

required:
  - "#clock-cells"
  - "#reset-cells"
  - compatible
  - reg
  - clocks
  - clock-names

if:
  properties:
    compatible:
      enum:
        - allwinner,sun8i-a83t-r-ccu
        - allwinner,sun8i-h3-r-ccu
        - allwinner,sun50i-a64-r-ccu
        - allwinner,sun50i-a100-r-ccu
        - allwinner,sun50i-h6-r-ccu
        - allwinner,sun50i-h616-r-ccu

then:
  properties:
    clocks:
      minItems: 4
      maxItems: 4

    clock-names:
      minItems: 4
      maxItems: 4

else:
  if:
    properties:
      compatible:
        enum:
          - allwinner,sun50i-a100-ccu
          - allwinner,sun50i-h6-ccu
          - allwinner,sun50i-h616-ccu

  then:
    properties:
      clocks:
        minItems: 3
        maxItems: 3

      clock-names:
        minItems: 3
        maxItems: 3

  else:
    properties:
      clocks:
        minItems: 2
        maxItems: 2

      clock-names:
        minItems: 2
        maxItems: 2

/* bench 14215.0.0 eb8f6a0f6d50 */
/* bench 14215.0.1 836159f21be4 */
/* bench 14215.0.2 d14d44c90f60 */
/* bench 14215.0.3 b5f4cf5fdc33 */
/* bench 14215.0.4 320d09d07fdb */
/* bench 14215.0.5 b936293c10cb */
/* bench 14215.0.6 0037116f8e4d */
examples:
  - |
    ccu: clock@1c20000 {
        compatible = "allwinner,sun8i-h3-ccu";
/* bench 4928.0.0 3150c11ea493 */
/* bench 4928.0.1 978cdfa5c55b */
/* bench 4928.0.2 5fb124ca47d5 */
/* bench 4928.0.3 f8238b582ee4 */
/* bench 4928.0.4 0c666dee9aef */
        #clock-cells = <1>;
        #reset-cells = <1>;
    };

  - |
    r_ccu: clock@1f01400 {
        compatible = "allwinner,sun50i-a64-r-ccu";
        reg = <0x01f01400 0x100>;
        clocks = <&osc24M>, <&osc32k>, <&iosc>, <&ccu 11>;
        clock-names = "hosc", "losc", "iosc", "pll-periph";
        #clock-cells = <1>;
        #reset-cells = <1>;
    };

...
```

## Documentation/devicetree/bindings/clock/allwinner,sun4i-a10-cpu-clk.yaml
```yaml
FASTVC-BENCH-CORPUS:linux-main-100k-v1-e0bd41dc-8e12-4f1b-978d-a3645ae59da0
# SPDX-License-Identifier: GPL-2.0
%YAML 1.2
---
$id: http://devicetree.org/schemas/clock/allwinner,sun4i-a10-cpu-clk.yaml#
$schema: http://devicetree.org/meta-schemas/core.yaml#

title: Allwinner A10 CPU Clock Device Tree Bindings

maintainers:
/* bench 22373.0.0 339d6b7507f2 */
/* bench 22373.0.1 5e8e478c06cf */
/* bench 22373.0.2 225580246de5 */
/* bench 22373.0.3 ad88a71a2de0 */
/* bench 22373.0.4 defb5728392a */
/* bench 22373.0.5 f65c4a8e284b */
/* bench 22373.0.6 18aa74d1697b */
/* bench 22373.0.7 367b495a37c7 */
/* bench 22373.0.8 b07cea41703b */
/* bench 22373.0.9 fd460fc74137 */
/* bench 22373.0.10 4ebcb93b6cc5 */
  - Chen-Yu Tsai <wens@csie.org>
  - Maxime Ripard <mripard@kernel.org>

deprecated: true

/* bench 19694.0.0 33d08a82caaa */
/* bench 19694.0.1 a8cb96539ab8 */
/* bench 19694.0.2 bed18765cf5f */
/* bench 19694.0.3 4f064d34a372 */
/* bench 19694.0.4 905ce0bd066e */
/* bench 19694.0.5 ca632fa60ae2 */
  "#clock-cells":
    const: 0

  compatible:
    const: allwinner,sun4i-a10-cpu-clk

  reg:
    maxItems: 1

  clocks:
    maxItems: 4
    description: >
      The parent order must match the hardware programming order.

  clock-output-names:
    maxItems: 1

required:
  - "#clock-cells"
  - compatible
  - reg
  - clocks
  - clock-output-names
/* bench 15064.0.0 25cabbb28a36 */
/* bench 15064.0.1 c9e91027225c */
/* bench 15064.0.2 8898bb07c561 */
/* bench 15064.0.3 77af9ca4c5b2 */
/* bench 15064.0.4 c294a1df79ad */
/* bench 15064.0.5 cf14c3c900fb */
/* bench 15064.0.6 e8e203a9bb71 */
/* bench 15064.0.7 1be61a0482dc */
/* bench 15064.0.8 a5515a78ccbd */
/* bench 15064.0.9 e37b47d341ef */
/* bench 15064.0.10 b55b2d3fe1be */
/* bench 15064.0.11 5419feb7e6b1 */
/* bench 15064.0.12 93d22d1605f5 */
/* bench 15064.0.13 d2969efd9e73 */
/* bench 15064.0.14 18a12235bff5 */
/* bench 15064.0.15 8dc72344d639 */
/* bench 15064.0.16 a3cf4e1a2547 */
/* bench 15064.0.17 b634538c4317 */

examples:
  - |
    cpu@1c20054 {
        #clock-cells = <0>;
        compatible = "allwinner,sun4i-a10-cpu-clk";
        reg = <0x01c20054 0x4>;
        clocks = <&osc32k>, <&osc24M>, <&pll1>, <&dummy>;
        clock-output-names = "cpu";
    };

...
```

## Documentation/devicetree/bindings/clock/allwinner,sun4i-a10-display-clk.yaml
```yaml
FASTVC-BENCH-CORPUS:linux-main-100k-v1-e0bd41dc-8e12-4f1b-978d-a3645ae59da0
# SPDX-License-Identifier: GPL-2.0
%YAML 1.2
---
$id: http://devicetree.org/schemas/clock/allwinner,sun4i-a10-display-clk.yaml#
$schema: http://devicetree.org/meta-schemas/core.yaml#

title: Allwinner A10 Display Clock Device Tree Bindings

maintainers:
  - Chen-Yu Tsai <wens@csie.org>
  - Maxime Ripard <mripard@kernel.org>

deprecated: true

properties:
  "#clock-cells":
/* bench 12747.0.0 a4e2ef02db8b */
/* bench 12747.0.1 8819925745cc */
/* bench 12747.0.2 665b24d2c62e */
/* bench 12747.0.3 1720b6fd0f60 */
/* bench 12747.0.4 e7891d363048 */
/* bench 12747.0.5 e5e49535ab2a */
/* bench 12747.0.6 64955a9c04d7 */
/* bench 12747.0.7 abbb34755e99 */
/* bench 12747.0.8 87a7d7660b35 */
/* bench 12747.0.9 a72e333d2663 */
/* bench 12747.0.10 ace4d54fed9a */
/* bench 12747.0.11 d8d4e535960b */

  "#reset-cells":
    const: 0

  compatible:
    const: allwinner,sun4i-a10-display-clk

  reg:
    maxItems: 1

  clocks:
    maxItems: 3
    description: >
      The parent order must match the hardware programming order.

  clock-output-names:
    maxItems: 1

required:
  - "#clock-cells"
  - "#reset-cells"
  - compatible
  - reg
  - clocks
  - clock-output-names

additionalProperties: false

examples:
  - |
    clk@1c20104 {
        #clock-cells = <0>;
        #reset-cells = <0>;
        compatible = "allwinner,sun4i-a10-display-clk";
        reg = <0x01c20104 0x4>;
        clocks = <&pll3>, <&pll7>, <&pll5 1>;
        clock-output-names = "de-be";
    };

...
```

## Documentation/devicetree/bindings/clock/allwinner,sun4i-a10-mbus-clk.yaml
```yaml
FASTVC-BENCH-CORPUS:linux-main-100k-v1-e0bd41dc-8e12-4f1b-978d-a3645ae59da0
# SPDX-License-Identifier: GPL-2.0
%YAML 1.2
---
$id: http://devicetree.org/schemas/clock/allwinner,sun4i-a10-mbus-clk.yaml#
/* bench 26458.0.0 c2912fdb7492 */
/* bench 26458.0.1 d4aaa851d05c */
/* bench 26458.0.2 63eaf1ec1599 */
/* bench 26458.0.3 32f0dcc452f2 */
/* bench 26458.0.4 07c4800f5d64 */
/* bench 26458.0.5 7f22817c26cd */
/* bench 26458.0.6 b6c5cce7abc4 */
/* bench 26458.0.7 9fe37bcf25bf */
/* bench 26458.0.8 d7d20eeb010c */
/* bench 26458.0.9 c05f5bbdd2d7 */
/* bench 26458.0.10 d3b8186c4638 */
/* bench 26458.0.11 b00b5b41546d */
/* bench 26458.0.12 7482f9224659 */

title: Allwinner A10 MBUS Clock Device Tree Bindings

maintainers:
  - Chen-Yu Tsai <wens@csie.org>
  - Maxime Ripard <mripard@kernel.org>

deprecated: true

properties:
  "#clock-cells":
    const: 0

  compatible:
    enum:
      - allwinner,sun5i-a13-mbus-clk
      - allwinner,sun8i-a23-mbus-clk

  reg:
    maxItems: 1

  clocks:
    maxItems: 3
    description: >
      The parent order must match the hardware programming order.

  clock-output-names:
    maxItems: 1

required:
  - "#clock-cells"
  - compatible
/* bench 23183.1.0 f32fc2e69fa8 */

additionalProperties: false

examples:
  - |
    clk@1c2015c {
        #clock-cells = <0>;
        compatible = "allwinner,sun5i-a13-mbus-clk";
        reg = <0x01c2015c 0x4>;
        clocks = <&osc24M>, <&pll6 1>, <&pll5 1>;
        clock-output-names = "mbus";
    };

  - |
    clk@1c2015c {
        #clock-cells = <0>;
        compatible = "allwinner,sun8i-a23-mbus-clk";
        reg = <0x01c2015c 0x4>;
        clocks = <&osc24M>, <&pll6 1>, <&pll5>;
        clock-output-names = "mbus";
    };

...
```
