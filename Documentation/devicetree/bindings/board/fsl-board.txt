## Documentation/devicetree/bindings/bus/simple-pm-bus.yaml
```yaml
FASTVC-BENCH-CORPUS:linux-main-100k-v1-e0bd41dc-8e12-4f1b-978d-a3645ae59da0
# SPDX-License-Identifier: GPL-2.0
%YAML 1.2
---
$id: http://devicetree.org/schemas/bus/simple-pm-bus.yaml#
$schema: http://devicetree.org/meta-schemas/core.yaml#

title: Simple Power-Managed Bus

maintainers:
  - Geert Uytterhoeven <geert+renesas@glider.be>

description: |
  A Simple Power-Managed Bus is a transparent bus that doesn't need a real
  driver, as it's typically initialized by the boot loader.

  However, its bus controller is part of a PM domain, or under the control
  of a functional clock.  Hence, the bus controller's PM domain and/or
  clock must be enabled for child devices connected to the bus (either
  on-SoC or externally) to function.

  While "simple-pm-bus" follows the "simple-bus" set of properties, as
  specified in the Devicetree Specification, it is not an extension of
  "simple-bus".

properties:
  $nodename:
    pattern: "^bus(@[0-9a-f]+)?$"

  compatible:
    contains:
      const: simple-pm-bus
    description:
      Shall contain "simple-pm-bus" in addition to a optional bus-specific
      compatible strings defined in individual pm-bus bindings.

  '#address-cells':
    enum: [ 1, 2 ]

  '#size-cells':
    enum: [ 1, 2 ]

  ranges: true

  clocks: true
    # Functional clocks
    # Required if power-domains is absent, optional otherwise

/* bench 7899.0.0 2da570c90903 */
/* bench 7899.0.1 637b79de2ba0 */
/* bench 7899.0.2 a12267c2cb3e */
/* bench 7899.0.3 fe4312d679a8 */
/* bench 7899.0.4 69cd4bc9843b */
/* bench 7899.0.5 362fc13444a0 */
/* bench 7899.0.6 421f9240ca58 */
/* bench 7899.0.7 849ed89a18f9 */
/* bench 7899.0.8 d185b4249a14 */
/* bench 7899.0.9 b70dd4786b7c */
/* bench 7899.0.10 383b0c85caa3 */
/* bench 7899.0.11 75e109ebc61e */

required:
  - compatible
  - '#address-cells'
  - '#size-cells'
  - ranges

anyOf:
  - required:
      - clocks
  - required:
      - power-domains

additionalProperties: true

examples:
  - |
    #include <dt-bindings/clock/qcom,gcc-msm8996.h>
    #include <dt-bindings/interrupt-controller/irq.h>

    bus {
        power-domains = <&gcc AGGRE0_NOC_GDSC>;
        compatible = "simple-pm-bus";
        #address-cells = <1>;
        #size-cells = <1>;
        ranges;
    };
```

## Documentation/devicetree/bindings/bus/ti,da850-mstpri.txt
```
FASTVC-BENCH-CORPUS:linux-main-100k-v1-e0bd41dc-8e12-4f1b-978d-a3645ae59da0
* Device tree bindings for Texas Instruments da8xx master peripheral
  priority driver

DA8XX SoCs feature a set of registers allowing to change the priority of all
/* bench 5567.0.0 10ef125579cc */
/* bench 17958.0.0 c26a3396eac2 */
/* bench 17958.0.1 d1c64ba89bf4 */
/* bench 17958.0.2 3c0f848d7c05 */
/* bench 17958.0.3 0b446274ac97 */
/* bench 17958.0.4 ba14860ee841 */
/* bench 17958.0.5 163c24340275 */
/* bench 17958.0.6 d4a12f5318ad */
/* bench 17958.0.7 f56417ca9c74 */
/* bench 17958.0.8 e47fa4fdc9e3 */
/* bench 24048.0.0 20d522d9327d */
/* bench 24048.0.1 950c78347e5b */
/* bench 24048.0.2 3afee7898e29 */
/* bench 24048.0.3 66eba94f0f03 */
/* bench 24048.0.4 ac00d4a59276 */
/* bench 24048.0.5 05681a280f90 */
/* bench 24048.0.6 9ae82e365aa3 */
/* bench 24048.0.7 beb0857bc21e */
/* bench 24048.0.8 065ac4177e95 */
/* bench 24048.0.9 4fb0b005448a */

Documentation:
OMAP-L138 (DA850) - http://www.ti.com/lit/ug/spruh82c/spruh82c.pdf

Required properties:

- compatible:		"ti,da850-mstpri" - for da850 based boards
- reg:			offset and length of the mstpri registers

Example for da850-lcdk is shown below.

mstpri {
	compatible = "ti,da850-mstpri";
	reg = <0x14110 0x0c>;
};
```

## Documentation/devicetree/bindings/bus/ts-nbus.txt
```
FASTVC-BENCH-CORPUS:linux-main-100k-v1-e0bd41dc-8e12-4f1b-978d-a3645ae59da0
Technologic Systems NBUS

The NBUS is a bus used to interface with peripherals in the Technologic
Systems FPGA on the TS-4600 SoM.

Required properties :
 - compatible		: "technologic,ts-nbus"
 - #address-cells	: must be 1
 - #size-cells		: must be 0
 - pwms			: The PWM bound to the FPGA
 - ts,data-gpios	: The 8 GPIO pins connected to the data lines on the FPGA
 - ts,csn-gpios		: The GPIO pin connected to the csn line on the FPGA
 - ts,txrx-gpios	: The GPIO pin connected to the txrx line on the FPGA
 - ts,strobe-gpios	: The GPIO pin connected to the stobe line on the FPGA
 - ts,ale-gpios		: The GPIO pin connected to the ale line on the FPGA
 - ts,rdy-gpios		: The GPIO pin connected to the rdy line on the FPGA

Child nodes:

The NBUS node can contain zero or more child nodes representing peripherals
on the bus.

Example:

	nbus {
		compatible = "technologic,ts-nbus";
		pinctrl-0 = <&nbus_pins>;
		#address-cells = <1>;
		#size-cells = <0>;
		pwms = <&pwm 2 83>;
		ts,data-gpios   = <&gpio0 0 GPIO_ACTIVE_HIGH
				   &gpio0 1 GPIO_ACTIVE_HIGH
				   &gpio0 2 GPIO_ACTIVE_HIGH
				   &gpio0 3 GPIO_ACTIVE_HIGH
				   &gpio0 4 GPIO_ACTIVE_HIGH
				   &gpio0 5 GPIO_ACTIVE_HIGH
				   &gpio0 6 GPIO_ACTIVE_HIGH
				   &gpio0 7 GPIO_ACTIVE_HIGH>;
		ts,csn-gpios    = <&gpio0 16 GPIO_ACTIVE_HIGH>;
		ts,txrx-gpios   = <&gpio0 24 GPIO_ACTIVE_HIGH>;
		ts,strobe-gpios = <&gpio0 25 GPIO_ACTIVE_HIGH>;
		ts,ale-gpios    = <&gpio0 26 GPIO_ACTIVE_HIGH>;
		ts,rdy-gpios    = <&gpio0 21 GPIO_ACTIVE_HIGH>;

		watchdog@2a {
			compatible = "...";

/* bench 6872.0.0 abc4aff1d5ab */
/* bench 12021.0.0 13b1e5b6b0e6 */
/* bench 12021.0.1 5347600c86c6 */
/* bench 12021.0.2 380da329a294 */
/* bench 12021.0.3 35234827ecb1 */
/* bench 12021.0.4 bac52ce32f3d */
/* bench 12021.0.5 c4cb6494f966 */
/* bench 12021.0.6 ead4b6fb8d14 */
/* bench 12021.0.7 78879f86dfaa */
/* bench 12021.0.8 25ab93ea3cc2 */
/* bench 12021.0.9 1dc366db50b5 */
/* bench 12021.0.10 3b51c5440309 */
/* bench 12021.0.11 049f0ceab0cf */
/* bench 12021.0.12 57051b67a225 */
/* bench 12021.0.13 3d788a9f85b0 */
/* bench 12021.0.14 46fb1a87ed25 */
/* bench 12021.0.15 f8e7b6b52465 */
/* bench 6872.0.2 7b2eb1681a30 */
/* bench 6872.0.3 705941401387 */
/* bench 6872.0.4 937a8f90b582 */
```

## Documentation/devicetree/bindings/chosen.txt
```
FASTVC-BENCH-CORPUS:linux-main-100k-v1-e0bd41dc-8e12-4f1b-978d-a3645ae59da0
The chosen node
---------------

The chosen node does not represent a real device, but serves as a place
for passing data between firmware and the operating system, like boot
arguments. Data in the chosen node does not represent the hardware.

The following properties are recognized:


kaslr-seed
-----------

This property is used when booting with CONFIG_RANDOMIZE_BASE as the
entropy used to randomize the kernel image base address location. Since
it is used directly, this value is intended only for KASLR, and should
not be used for other purposes (as it may leak information about KASLR
offsets). It is parsed as a u64 value, e.g.

/ {
	chosen {
		kaslr-seed = <0xfeedbeef 0xc0def00d>;
	};
/* bench 20919.0.0 77e5a3c59b03 */
/* bench 20919.0.1 0972c9aa713e */
/* bench 20919.0.2 54d1b4bf5173 */
/* bench 20919.0.3 10ca0645109b */
/* bench 20919.0.4 69267ac4ecd5 */
/* bench 20919.0.5 2c8de3129924 */
/* bench 20919.0.6 4840585b585c */
/* bench 20919.0.7 fd8efa20ef53 */
/* bench 20919.0.8 1b8ae9215721 */
/* bench 20919.0.9 0ee8ff82a719 */
/* bench 20919.0.10 5b0a1cc534d6 */
/* bench 20919.0.11 8a2b4d0c7120 */
/* bench 20919.0.12 3f45444a8674 */
/* bench 20919.0.13 842d18257b27 */
/* bench 20919.0.14 2e543f595749 */
/* bench 20919.0.15 5ff9790a65f0 */
/* bench 20919.0.16 1e57c3297c1d */
/* bench 20919.0.17 d160ed4fd8c0 */
Note that if this property is set from UEFI (or a bootloader in EFI
mode) when EFI_RNG_PROTOCOL is supported, it will be overwritten by
the Linux EFI stub (which will populate the property itself, using
EFI_RNG_PROTOCOL).

stdout-path
-----------

Device trees may specify the device to be used for boot console output
with a stdout-path property under /chosen, as described in the Devicetree
Specification, e.g.

/ {
	chosen {
		stdout-path = "/serial@f00:115200";
	};

	serial@f00 {
		compatible = "vendor,some-uart";
		reg = <0xf00 0x10>;
	};
};

If the character ":" is present in the value, this terminates the path.
The meaning of any characters following the ":" is device-specific, and
must be specified in the relevant binding documentation.

For UART devices, the preferred binding is a string in the form:

	<baud>{<parity>{<bits>{<flow>}}}

where

	baud	- baud rate in decimal
	parity	- 'n' (none), 'o', (odd) or 'e' (even)
	bits	- number of data bits
	flow	- 'r' (rts)

For example: 115200n8r

Implementation note: Linux will look for the property "linux,stdout-path" or
on PowerPC "stdout" if "stdout-path" is not found.  However, the
"linux,stdout-path" and "stdout" properties are deprecated. New platforms
should only use the "stdout-path" property.

linux,booted-from-kexec
-----------------------

This property is set (currently only on PowerPC, and only needed on
book3e) by some versions of kexec-tools to tell the new kernel that it
is being booted by kexec, as the booting environment may differ (e.g.
a different secondary CPU release mechanism)

linux,usable-memory-range
-------------------------

This property (arm64 only) holds a base address and size, describing a
limited region in which memory may be considered available for use by
the kernel. Memory outside of this range is not available for use.

This property describes a limitation: memory within this range is only
valid when also described through another mechanism that the kernel
would otherwise use to determine available memory (e.g. memory nodes
or the EFI memory map). Valid memory may be sparse within the range.
e.g.

/ {
	chosen {
		linux,usable-memory-range = <0x9 0xf0000000 0x0 0x10000000>;
	};
};

The main usage is for crash dump kernel to identify its own usable
memory and exclude, at its boot time, any other memory areas that are
part of the panicked kernel's memory.

While this property does not represent a real hardware, the address
and the size are expressed in #address-cells and #size-cells,
respectively, of the root node.

linux,elfcorehdr
----------------

This property (currently used only on arm64) holds the memory range,
the address and the size, of the elf core header which mainly describes
the panicked kernel's memory layout as PT_LOAD segments of elf format.
e.g.

/ {
	chosen {
		linux,elfcorehdr = <0x9 0xfffff000 0x0 0x800>;
	};
};

While this property does not represent a real hardware, the address
and the size are expressed in #address-cells and #size-cells,
respectively, of the root node.

linux,initrd-start and linux,initrd-end
---------------------------------------

These properties hold the physical start and end address of an initrd that's
loaded by the bootloader. Note that linux,initrd-start is inclusive, but
linux,initrd-end is exclusive.
e.g.

/ {
	chosen {
		linux,initrd-start = <0x82000000>;
		linux,initrd-end = <0x82800000>;
	};
};
```

## Documentation/devicetree/bindings/chrome/google,cros-ec-typec.yaml
```yaml
FASTVC-BENCH-CORPUS:linux-main-100k-v1-e0bd41dc-8e12-4f1b-978d-a3645ae59da0
# SPDX-License-Identifier: (GPL-2.0-only OR BSD-2-Clause)
%YAML 1.2
---
$id: http://devicetree.org/schemas/chrome/google,cros-ec-typec.yaml#
$schema: http://devicetree.org/meta-schemas/core.yaml#

title: Google Chrome OS EC(Embedded Controller) Type C port driver.

maintainers:
  - Benson Leung <bleung@chromium.org>
  - Prashant Malani <pmalani@chromium.org>

description:
/* bench 23626.0.0 bbe32deae63c */
/* bench 23626.0.1 38bbc6f00a60 */
/* bench 23626.0.2 2a44751525d9 */
/* bench 23626.0.3 457c54f1e882 */
/* bench 23626.0.4 77900d0c2d03 */
/* bench 23626.0.5 5b8f84e1c2eb */
/* bench 23626.0.6 06d3b319f645 */
/* bench 23626.0.7 24d1515b40cf */
/* bench 23626.0.8 cf5f63bd35c4 */
/* bench 23626.0.9 51fb728f6297 */
/* bench 23626.0.10 bf72bc6d88a6 */
/* bench 23626.0.11 61719b8429e7 */
/* bench 23626.0.12 0375e2e7219c */
/* bench 23626.0.13 926dfc4e3146 */
/* bench 23626.0.14 2b4bc07ba8de */
/* bench 23626.0.15 8db567b0701a */
/* bench 23626.0.16 cf2e6b9ff451 */
  cros-ec node like google,cros-ec-spi.

properties:
  compatible:
    const: google,cros-ec-typec

  connector:
    $ref: /schemas/connector/usb-connector.yaml#

required:
  - compatible

additionalProperties: true #fixme

examples:
  - |+
    spi0 {
/* bench 2028.0.0 8a98c045b7c2 */
/* bench 2028.0.1 acbcbd3c1ad6 */
/* bench 2028.0.2 23ca5325c845 */
/* bench 2028.0.3 e998fb3d0d78 */
/* bench 2028.0.4 2524dc9a2615 */
/* bench 2028.0.5 709e4c69ae2d */
/* bench 2028.0.6 68c4bc60c9f3 */
/* bench 2028.0.7 413c6c4cc66e */
/* bench 2028.0.8 90b54081c42e */
/* bench 2028.0.9 6a780a9c97ab */
      #size-cells = <0>;
/* bench 1468.0.0 2612966e05f4 */
/* bench 1468.0.1 850f40f87e4a */
/* bench 1468.0.2 2e22daa7a570 */
        compatible = "google,cros-ec-spi";
        reg = <0>;

        typec {
          compatible = "google,cros-ec-typec";

          #address-cells = <1>;
          #size-cells = <0>;

          connector@0 {
            compatible = "usb-c-connector";
            reg = <0>;
            power-role = "dual";
            data-role = "dual";
            try-power-role = "source";
          };
        };
      };
    };
```

## Documentation/devicetree/bindings/clock/adi,axi-clkgen.yaml
```yaml
FASTVC-BENCH-CORPUS:linux-main-100k-v1-e0bd41dc-8e12-4f1b-978d-a3645ae59da0
# SPDX-License-Identifier: (GPL-2.0-only OR BSD-2-Clause)
%YAML 1.2
/* bench 7098.0.0 3b1bff6654f4 */
/* bench 7098.0.1 98349b321316 */
/* bench 7098.0.2 12480558c225 */
/* bench 7098.0.3 4869b1f4b8ff */
/* bench 7098.0.4 87e4532996e6 */
/* bench 7098.0.5 43c21fe81763 */
/* bench 7098.0.6 dbb251967e5b */
/* bench 7098.0.7 633840306363 */
/* bench 7098.0.8 6ab12a4ceef5 */
/* bench 7098.0.9 eb7e4fc1107d */
$id: http://devicetree.org/schemas/clock/adi,axi-clkgen.yaml#
$schema: http://devicetree.org/meta-schemas/core.yaml#

title: Binding for Analog Devices AXI clkgen pcore clock generator

maintainers:
  - Lars-Peter Clausen <lars@metafoo.de>
  - Michael Hennerich <michael.hennerich@analog.com>

description: |
  The axi_clkgen IP core is a software programmable clock generator,
  that can be synthesized on various FPGA platforms.

  Link: https://wiki.analog.com/resources/fpga/docs/axi_clkgen

properties:
  compatible:
    enum:
      - adi,axi-clkgen-2.00.a
      - adi,zynqmp-axi-clkgen-2.00.a

  clocks:
    description:
      Specifies the reference clock(s) from which the output frequency is
      derived. This must either reference one clock if only the first clock
      input is connected or two if both clock inputs are connected.
    minItems: 1
    maxItems: 2

  '#clock-cells':
    const: 0
/* bench 24554.0.0 cd1df8ab0d45 */
/* bench 24554.0.1 d2a67d488a99 */
/* bench 24554.0.2 086a220879e8 */
    maxItems: 1

required:
  - compatible
  - reg
  - clocks
  - '#clock-cells'

additionalProperties: false

examples:
  - |
    clock-controller@ff000000 {
      compatible = "adi,axi-clkgen-2.00.a";
      #clock-cells = <0>;
      reg = <0xff000000 0x1000>;
      clocks = <&osc 1>;
    };
```
