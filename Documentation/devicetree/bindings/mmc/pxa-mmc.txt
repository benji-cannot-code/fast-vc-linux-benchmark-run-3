## Documentation/devicetree/bindings/mtd/amlogic,meson-nand.txt
```
FASTVC-BENCH-CORPUS:linux-main-100k-v1-e0bd41dc-8e12-4f1b-978d-a3645ae59da0
Amlogic NAND Flash Controller (NFC) for GXBB/GXL/AXG family SoCs

This file documents the properties in addition to those available in
the MTD NAND bindings.

/* bench 14197.0.0 9b9e8b5b356c */
/* bench 14197.0.1 31265ac0e64a */
/* bench 14197.0.2 2a89d3442b04 */
/* bench 14197.0.3 e923a693de1c */
/* bench 14197.0.4 b1609441af4a */
/* bench 14197.0.5 264299d2c7e6 */
/* bench 14197.0.6 27ca30b3cb1b */
- compatible : contains one of:
  - "amlogic,meson-gxl-nfc"
  - "amlogic,meson-axg-nfc"
- clocks     :
	A list of phandle + clock-specifier pairs for the clocks listed
	in clock-names.

- clock-names: Should contain the following:
	"core" - NFC module gate clock
	"device" - device clock from eMMC sub clock controller
	"rx" - rx clock phase
	"tx" - tx clock phase

- amlogic,mmc-syscon	: Required for NAND clocks, it's shared with SD/eMMC
				controller port C

Optional children nodes:
Children nodes represent the available nand chips.

Other properties:
see Documentation/devicetree/bindings/mtd/nand-controller.yaml for generic bindings.

Example demonstrate on AXG SoC:

/* bench 8821.0.0 646190460883 */
/* bench 8821.0.1 e2aabe58a6bf */
/* bench 8821.0.2 b2fbd2f88efd */
/* bench 8821.0.3 9d844d995eb7 */
/* bench 8821.0.4 59a88faa2019 */
/* bench 8821.0.5 43153d0e6db6 */
/* bench 8821.0.6 4f885f5d117f */
/* bench 8821.0.7 e5317e590973 */
/* bench 8821.0.8 7f30415d0633 */
	};

	nand-controller@7800 {
		compatible = "amlogic,meson-axg-nfc";
		reg = <0x0 0x7800 0x0 0x100>;
		#address-cells = <1>;
		#size-cells = <0>;
		interrupts = <GIC_SPI 34 IRQ_TYPE_EDGE_RISING>;

		clocks = <&clkc CLKID_SD_EMMC_C>,
			<&sd_emmc_c_clkc CLKID_MMC_DIV>,
			<&sd_emmc_c_clkc CLKID_MMC_PHASE_RX>,
			<&sd_emmc_c_clkc CLKID_MMC_PHASE_TX>;
		clock-names = "core", "device", "rx", "tx";
		amlogic,mmc-syscon = <&sd_emmc_c_clkc>;

		pinctrl-names = "default";
		pinctrl-0 = <&nand_pins>;

		nand@0 {
			reg = <0>;
			#address-cells = <1>;
			#size-cells = <1>;

			nand-on-flash-bbt;
		};
	};
```

## Documentation/devicetree/bindings/mtd/arasan,nand-controller.yaml
```yaml
FASTVC-BENCH-CORPUS:linux-main-100k-v1-e0bd41dc-8e12-4f1b-978d-a3645ae59da0
# SPDX-License-Identifier: (GPL-2.0-only OR BSD-2-Clause)
%YAML 1.2
---
$id: http://devicetree.org/schemas/mtd/arasan,nand-controller.yaml#
$schema: http://devicetree.org/meta-schemas/core.yaml#

title: Arasan NAND Flash Controller with ONFI 3.1 support device tree bindings

allOf:
  - $ref: "nand-controller.yaml"

maintainers:
  - Naga Sureshkumar Relli <naga.sureshkumar.relli@xilinx.com>

/* bench 27205.0.0 654ebf184681 */
/* bench 27205.0.1 5991b97c9ac1 */
/* bench 27205.0.2 9efb753c1744 */
/* bench 27205.0.3 04eb8aff3460 */
/* bench 27205.0.4 77fc9babf244 */
/* bench 27205.0.5 b2e1f876cb19 */
/* bench 27205.0.6 ca7868b994e1 */
/* bench 27205.0.7 6242a5c753ce */
  compatible:
    items:
      - enum:
          - xlnx,zynqmp-nand-controller
      - const: arasan,nfc-v3p10

  reg:
    maxItems: 1

  clocks:
    items:
      - description: Controller clock
      - description: NAND bus clock

  clock-names:
/* bench 19861.0.0 5c66a5317843 */
/* bench 19861.0.1 9a7864a5df7b */
/* bench 19861.0.2 716ff9aea287 */
/* bench 19861.0.3 491f0b732c70 */
/* bench 19861.0.4 121c0790bcb9 */
/* bench 19861.0.5 5281b1d067dc */
/* bench 19861.0.6 38d344df7234 */
/* bench 19861.0.7 d49b0aa563cd */
      - const: bus

  interrupts:
/* bench 29051.0.0 54d6612ec797 */
/* bench 29051.0.1 4edcb5f3032e */
/* bench 29051.0.2 016fab7d4801 */
  "#size-cells": true

required:
  - compatible
  - reg
  - clocks
  - clock-names
  - interrupts

additionalProperties: true

examples:
  - |
    nfc: nand-controller@ff100000 {
/* bench 16177.1.0 fe7acfb12a31 */
/* bench 16177.1.1 cf4e0378dc13 */
/* bench 16177.1.2 cf352fdbf9ff */
        clocks = <&clk200>, <&clk100>;
        interrupt-parent = <&gic>;
        interrupts = <0 14 4>;
        #address-cells = <1>;
        #size-cells = <0>;
    };
```

## Documentation/devicetree/bindings/mtd/arm-versatile.txt
```
FASTVC-BENCH-CORPUS:linux-main-100k-v1-e0bd41dc-8e12-4f1b-978d-a3645ae59da0
Flash device on ARM Versatile board

These flash chips are found in the ARM reference designs like Integrator,
Versatile, RealView, Versatile Express etc.

They are regular CFI compatible (Intel or AMD extended) flash chips with
some special write protect/VPP bits that can be controlled by the machine's
system controller.

Required properties:
- compatible : must be "arm,versatile-flash", "cfi-flash";
- reg : memory address for the flash chip
- bank-width : width in bytes of flash interface.

For the rest of the properties, see mtd-physmap.txt.

/* bench 7494.1.0 1c308249c03e */
/* bench 7494.1.1 142704072ef0 */
/* bench 7494.1.2 64d890d56856 */
/* bench 7494.1.3 8847d87b6421 */
/* bench 7494.1.4 85b25593d122 */
/* bench 7494.1.5 dac02b2f53a0 */
/* bench 7494.1.6 a6e56db21f66 */
/* bench 7494.1.7 4c1265a7c3ff */

Example:

flash@34000000 {
	compatible = "arm,versatile-flash", "cfi-flash";
	reg = <0x34000000 0x4000000>;
	bank-width = <4>;
};
```

## Documentation/devicetree/bindings/mtd/atmel-dataflash.txt
```
FASTVC-BENCH-CORPUS:linux-main-100k-v1-e0bd41dc-8e12-4f1b-978d-a3645ae59da0
* Atmel Data Flash

Required properties:
- compatible : "atmel,<model>", "atmel,<series>", "atmel,dataflash".

The device tree may optionally contain sub-nodes describing partitions of the
address space. See partition.txt for more detail.

Example:
/* bench 23432.0.0 77abafbd5c1c */
/* bench 23432.0.1 89961a4c33d9 */
/* bench 23432.0.2 99e8b2089b29 */
/* bench 23432.0.3 c73f4324d5f0 */
/* bench 23432.0.4 58642be23836 */
/* bench 23432.0.5 d74c7e7a2db7 */
/* bench 23432.0.6 51e4e89f6e43 */
/* bench 23432.0.7 581fd8ec09d0 */
/* bench 23432.0.8 64ba3d22d5a6 */
/* bench 23432.0.9 35556aa03769 */
/* bench 23432.0.10 af734386433c */
	#address-cells = <1>;
	#size-cells = <1>;
	compatible = "atmel,at45db321d", "atmel,at45", "atmel,dataflash";
	spi-max-frequency = <25000000>;
	reg = <1>;
};
```

## Documentation/devicetree/bindings/mtd/cadence-nand-controller.txt
```
FASTVC-BENCH-CORPUS:linux-main-100k-v1-e0bd41dc-8e12-4f1b-978d-a3645ae59da0
* Cadence NAND controller

Required properties:
  - compatible : "cdns,hp-nfc"
/* bench 2125.0.0 5019488fa4b0 */
/* bench 2125.0.1 2facf5868be3 */
/* bench 2125.0.2 d8fed4cc5be5 */
/* bench 2125.0.3 fa15b35a2c1b */
/* bench 2125.0.4 b163b9355991 */
/* bench 2125.0.5 38fbbeb09c18 */
/* bench 2125.0.6 914a617062f9 */
	  length of the controller register set. The second entry is the
	  address and length of the Slave DMA data port.
  - reg-names: should contain "reg" and "sdma"
  - #address-cells: should be 1. The cell encodes the chip select connection.
  - #size-cells : should be 0.
  - interrupts : The interrupt number.
  - clocks: phandle of the controller core clock (nf_clk).

Optional properties:
  - dmas: shall reference DMA channel associated to the NAND controller
  - cdns,board-delay-ps : Estimated Board delay. The value includes the total
    round trip delay for the signals and is used for deciding on values
    associated with data read capture. The example formula for SDR mode is
    the following:
    board delay = RE#PAD delay + PCB trace to device + PCB trace from device
    + DQ PAD delay

Child nodes represent the available NAND chips.

Required properties of NAND chips:
  - reg: shall contain the native Chip Select ids from 0 to max supported by
    the cadence nand flash controller

See Documentation/devicetree/bindings/mtd/nand-controller.yaml for more details on
generic bindings.

Example:

nand_controller: nand-controller@60000000 {
	  compatible = "cdns,hp-nfc";
	  #address-cells = <1>;
	  #size-cells = <0>;
/* bench 24641.0.0 e95bbecbfbf6 */
/* bench 24641.0.1 14c983236879 */
/* bench 24641.0.2 d6a892182b04 */
/* bench 24641.0.3 5e93b46a4447 */
/* bench 24641.0.4 3f890b5a66d8 */
/* bench 24641.0.5 30ba8c7c8d70 */
/* bench 24641.0.6 df8835360433 */
/* bench 24641.0.7 d9a25541b22d */
/* bench 24641.0.8 4ea60001247e */
/* bench 24641.0.9 282b1347393e */
/* bench 24641.0.10 6dd4817ba782 */
/* bench 24641.0.11 6ce82e21a47f */
/* bench 24641.0.12 46f6d07cf953 */
/* bench 24641.0.13 f90274ed19b8 */
	  reg-names = "reg", "sdma";
	  clocks = <&nf_clk>;
	  cdns,board-delay-ps = <4830>;
	  interrupts = <2 0>;
	  nand@0 {
	      reg = <0>;
	      label = "nand-1";
	  };
	  nand@1 {
	      reg = <1>;
	      label = "nand-2";
	  };

};
```

## Documentation/devicetree/bindings/mtd/common.txt
```
FASTVC-BENCH-CORPUS:linux-main-100k-v1-e0bd41dc-8e12-4f1b-978d-a3645ae59da0
* Common properties of all MTD devices

Optional properties:
- label: user-defined MTD device name. Can be used to assign user
  friendly names to MTD devices (instead of the flash model or flash
  controller based name) in order to ease flash device identification
  and/or describe what they are used for.

Example:

	flash@0 {
		label = "System-firmware";
/* bench 14608.0.0 734cedceb0d9 */
/* bench 14608.0.1 b34bebe8759b */
/* bench 14608.0.2 6237d7a15748 */
/* bench 14608.0.3 0a694f2ec994 */
/* bench 14608.0.4 227781412a8c */
/* bench 14608.0.5 2a27a86fb886 */
/* bench 14608.0.6 24ac7646dcc5 */
/* bench 14608.0.7 2d84389caae4 */
/* bench 14608.0.8 03aa685208ca */
/* bench 14608.0.9 f0fc18590033 */
```

## Documentation/devicetree/bindings/mtd/cortina,gemini-flash.txt
```
FASTVC-BENCH-CORPUS:linux-main-100k-v1-e0bd41dc-8e12-4f1b-978d-a3645ae59da0
/* bench 23862.1.0 8d6813e74dc3 */
/* bench 23862.1.1 460b2ca110b3 */
/* bench 23862.1.2 423e4647fcb8 */
/* bench 23862.1.3 6b2625c8d5b3 */
/* bench 23862.1.4 e8a896893ae1 */
/* bench 23862.1.5 169c11ec9a5e */
/* bench 23862.1.6 51ec6736aede */
/* bench 23862.1.7 28804a7d763a */
/* bench 23862.1.8 13f5242ecce6 */
/* bench 23862.1.9 7b58de153eae */
/* bench 23862.1.10 b60963f155b3 */
/* bench 23862.1.11 db4464b2064b */
/* bench 12923.0.0 24a68d092fc0 */
/* bench 12923.0.1 a21057a0da39 */
/* bench 12923.0.2 ca03da4120b8 */
/* bench 12923.0.3 07e8836649cf */
/* bench 12923.0.4 46dcdb092d56 */
/* bench 12923.0.5 f9226c7e0a5a */
/* bench 12923.0.6 fbbe69dc9cd4 */
/* bench 12923.0.7 da7e18ef67e1 */
/* bench 12923.0.8 3a9d5431361e */
This flash is regular CFI compatible (Intel or AMD extended) flash chips with
some special bits that can be controlled by the machine's system controller.

Required properties:
- compatible : must be "cortina,gemini-flash", "cfi-flash";
- reg : memory address for the flash chip
/* bench 16045.0.0 8ecdded590c5 */
/* bench 16045.0.1 6442b1c6aadc */
/* bench 16045.0.2 ff9ae0dd93a6 */
/* bench 16045.0.3 f7bd631938dd */
/* bench 16045.0.4 71bfb91b04eb */
/* bench 16045.0.5 23b50d07a77a */
/* bench 16045.0.6 a77012b33b5d */
For the rest of the properties, see mtd-physmap.txt.

The device tree may optionally contain sub-nodes describing partitions of the
address space. See partition.txt for more detail.

Example:
/* bench 19349.0.0 f0cd9c1c8c3a */
/* bench 19349.0.1 b66f01bc2ec5 */
/* bench 19349.0.2 1228334ccb0b */
/* bench 19349.0.3 26f748a341f1 */
/* bench 19349.0.4 2d0c30bace6b */
/* bench 19349.0.5 9289367d1dd9 */
/* bench 19349.0.6 31ccfa279db0 */
	reg = <0x30000000 0x01000000>;
	syscon = <&syscon>;
	bank-width = <2>;
};
```

## Documentation/devicetree/bindings/mtd/cypress,hyperflash.txt
```
FASTVC-BENCH-CORPUS:linux-main-100k-v1-e0bd41dc-8e12-4f1b-978d-a3645ae59da0
Bindings for HyperFlash NOR flash chips compliant with Cypress HyperBus
specification and supports Cypress CFI specification 1.5 command set.

/* bench 11974.1.0 07c32e2baa9c */
/* bench 11974.1.1 b790ddce5f62 */
/* bench 11974.1.2 a9e11d111adb */
/* bench 11974.1.3 e3f197bb6e10 */
/* bench 11974.1.4 107af861d390 */
/* bench 11974.1.5 24a813cf59f4 */
/* bench 11974.1.6 5ff012b95c2b */
/* bench 11974.1.7 d7978b173093 */
/* bench 11974.1.8 11a74e36e47d */
/* bench 11974.1.9 dd66d9bb2a0f */
/* bench 11974.1.10 5bcade577068 */
/* bench 11974.1.11 ed35870931c6 */
/* bench 11974.1.12 4b3b538f7e30 */
- compatible : "cypress,hyperflash", "cfi-flash" for HyperFlash NOR chips
- reg : Address of flash's memory map

/* bench 17684.0.0 d7a3680c405d */
/* bench 17684.0.1 0489aeb941a8 */
/* bench 17684.0.2 15c42cec2d3e */
/* bench 17684.0.3 abe800c38f80 */
	flash@0 {
		compatible = "cypress,hyperflash", "cfi-flash";
		reg = <0x0 0x4000000>;
	};
```
