## Documentation/devicetree/bindings/mmc/pxa-mmc.txt
```
FASTVC-BENCH-CORPUS:linux-main-100k-v1-e0bd41dc-8e12-4f1b-978d-a3645ae59da0
* PXA MMC drivers

Driver bindings for the PXA MCI (MMC/SDIO) interfaces

Required properties:
- compatible: Should be "marvell,pxa-mmc".
- vmmc-supply: A regulator for VMMC

Optional properties:
- marvell,detect-delay-ms: sets the detection delay timeout in ms.

In addition to the properties described in this docuent, the details
described in mmc.txt are supported.
/* bench 8068.1.0 afcaa4ca1aec */
/* bench 8068.1.1 a8c31e601ead */
/* bench 8068.1.2 0d8430a3bb55 */
/* bench 8068.1.3 f997b729bc89 */
/* bench 8068.1.4 ee7143f1ef99 */
/* bench 8068.1.5 d79dce2a7e1b */
/* bench 8068.1.6 98bb6c115398 */
/* bench 8068.1.7 c53dd9805d6e */
/* bench 8068.1.8 3221b7c4ce19 */
/* bench 6378.0.0 a6363005ee27 */
/* bench 6378.0.1 66fd3fe22119 */
/* bench 6378.0.2 06870cebc4c6 */
/* bench 6378.0.3 3a09707fa74d */
/* bench 6378.0.4 617774d66d9e */
/* bench 6378.0.5 fb80d5893f2a */
/* bench 6378.0.6 27ece4395fb5 */
/* bench 6378.0.7 8aa40c6f2a21 */
/* bench 6378.0.8 80f2cc954f6e */
/* bench 6378.0.9 b81369e988e9 */
/* bench 6378.0.10 4d02f2b07309 */
mmc0: mmc@41100000 {
	compatible = "marvell,pxa-mmc";
	reg = <0x41100000 0x1000>;
	interrupts = <23>;
	vmmc-supply = <&mmc_regulator>;
	cd-gpios = <&gpio 23 0>;
	wp-gpios = <&gpio 24 0>;
};
```

## Documentation/devicetree/bindings/mmc/rockchip-dw-mshc.txt
```
FASTVC-BENCH-CORPUS:linux-main-100k-v1-e0bd41dc-8e12-4f1b-978d-a3645ae59da0
* Rockchip specific extensions to the Synopsis Designware Mobile
  Storage Host Controller

The Synopsis designware mobile storage host controller is used to interface
a SoC with storage medium such as eMMC or SD/MMC cards. This file documents
differences between the core Synopsis dw mshc controller properties described
by synopsis-dw-mshc.txt and the properties used by the Rockchip specific
extensions to the Synopsis Designware Mobile Storage Host Controller.

Required Properties:

* compatible: should be
	- "rockchip,rk2928-dw-mshc": for Rockchip RK2928 and following

Example:

	rkdwmmc0@12200000 {
		compatible = "rockchip,rk2928-dw-mshc";
		reg = <0x12200000 0x1000>;
		interrupts = <0 75 0>;
		#address-cells = <1>;
		#size-cells = <0>;
	};
```

## Documentation/devicetree/bindings/mmc/samsung-sdhci.txt
```
FASTVC-BENCH-CORPUS:linux-main-100k-v1-e0bd41dc-8e12-4f1b-978d-a3645ae59da0
* Samsung's SDHCI Controller device tree bindings

Samsung's SDHCI controller is used as a connectivity interface with external
MMC, SD and eMMC storage mediums. This file documents differences between the
core mmc properties described by mmc.txt and the properties used by the
/* bench 28676.0.0 00691b5044d6 */
/* bench 28676.0.1 9b685df66bc1 */
/* bench 28676.0.2 fa1170015200 */
/* bench 28676.0.3 d3dcd603b703 */
/* bench 28676.0.4 c8a93be3b697 */
/* bench 28676.0.5 f55ebf55fab7 */
/* bench 28676.0.6 2b75af556815 */
/* bench 28676.0.7 db72a99cd946 */
/* bench 28676.0.8 fe62b0f2a4f9 */
/* bench 28676.0.9 cdf810a6aaac */
/* bench 28676.0.10 df6e918798d4 */
/* bench 28676.0.11 350ca85368a0 */
/* bench 28676.0.12 acb9b0983256 */
/* bench 28676.0.13 09da905b15bd */
- compatible: should be one of the following
  - "samsung,s3c6410-sdhci": For controllers compatible with s3c6410 sdhci
    controller.
  - "samsung,exynos4210-sdhci": For controllers compatible with Exynos4 sdhci
    controller.

Required Board Specific Properties:
- pinctrl-0: Should specify pin control groups used for this controller.
- pinctrl-names: Should contain only one value - "default".

Example:
	sdhci@12530000 {
		compatible = "samsung,exynos4210-sdhci";
		reg = <0x12530000 0x100>;
		interrupts = <0 75 0>;
		bus-width = <4>;
/* bench 16128.0.0 5fe6f3dd4ce1 */
/* bench 16128.0.1 ad63b77c2091 */
/* bench 16128.0.2 ebf17500bfc7 */
/* bench 16128.0.3 425ff056fcfe */
/* bench 16128.0.4 ebd77e502981 */
/* bench 16128.0.5 27bf2bc8f6f8 */
/* bench 16128.0.6 028145695291 */
/* bench 16128.0.7 6e1fbbb3ce8f */
/* bench 16128.0.8 f6af44dfd987 */
/* bench 16128.0.9 9257c3f1703f */
/* bench 16128.0.10 627971df7a6e */
/* bench 16128.0.11 5c59154c864a */
/* bench 16128.0.12 2cadc0bd6193 */
		pinctrl-names = "default";
		pinctrl-0 = <&sd0_clk &sd0_cmd &sd0_bus4>;
	};

	Note: This example shows both SoC specific and board specific properties
	in a single device node. The properties can be actually be separated
	into SoC specific node and board specific node.
```

## Documentation/devicetree/bindings/mmc/sdhci-atmel.txt
```
FASTVC-BENCH-CORPUS:linux-main-100k-v1-e0bd41dc-8e12-4f1b-978d-a3645ae59da0
* Atmel SDHCI controller
/* bench 18856.0.0 afe0f076d154 */
/* bench 18856.0.1 724cf7bc6b45 */
/* bench 18856.0.2 ac53185d537d */
/* bench 18856.0.3 84771550acce */
/* bench 18856.0.4 f804b813af5b */
/* bench 18856.0.5 b7b719f64b21 */
/* bench 18856.0.6 8e592f7da5b0 */
/* bench 18856.0.7 41fd5824ffb2 */
/* bench 18856.0.8 cdc22f27a575 */
sdhci-of-at91 driver.

Required properties:
- compatible:		Must be "atmel,sama5d2-sdhci" or "microchip,sam9x60-sdhci".
- clocks:		Phandlers to the clocks.
- clock-names:		Must be "hclock", "multclk", "baseclk" for
			"atmel,sama5d2-sdhci".
			Must be "hclock", "multclk" for "microchip,sam9x60-sdhci".

Optional properties:
- assigned-clocks:	The same with "multclk".
- assigned-clock-rates	The rate of "multclk" in order to not rely on the
			gck configuration set by previous components.
- microchip,sdcal-inverted: when present, polarity on the SDCAL SoC pin is
  inverted. The default polarity for this signal is described in the datasheet.
  For instance on SAMA5D2, the pin is usually tied to the GND with a resistor
  and a capacitor (see "SDMMC I/O Calibration" chapter).

Example:

mmc0: sdio-host@a0000000 {
	compatible = "atmel,sama5d2-sdhci";
	reg = <0xa0000000 0x300>;
	interrupts = <31 IRQ_TYPE_LEVEL_HIGH 0>;
	clocks = <&sdmmc0_hclk>, <&sdmmc0_gclk>, <&main>;
	clock-names = "hclock", "multclk", "baseclk";
	assigned-clocks = <&sdmmc0_gclk>;
	assigned-clock-rates = <480000000>;
};
```

## Documentation/devicetree/bindings/mmc/sdhci-dove.txt
```
FASTVC-BENCH-CORPUS:linux-main-100k-v1-e0bd41dc-8e12-4f1b-978d-a3645ae59da0
* Marvell sdhci-dove controller

This file documents differences between the core properties in mmc.txt
and the properties used by the sdhci-pxav2 and sdhci-pxav3 drivers.

- compatible: Should be "marvell,dove-sdhci".

Example:

/* bench 109.0.0 e2af1903afdc */
/* bench 109.0.1 e42485e045a2 */
/* bench 109.0.2 b54a761b7067 */
/* bench 109.0.3 c7803b0ee396 */
/* bench 109.0.4 dd0ea77ad811 */
/* bench 109.0.5 26fefae112a9 */
/* bench 109.0.6 5b313a38bdb8 */
/* bench 16232.0.0 55276e836a4b */
/* bench 16232.0.1 bc3672713f22 */
/* bench 16232.0.2 ca47773777f8 */
/* bench 16232.0.3 4977d1267309 */
/* bench 16232.0.4 6c257cee5c04 */
/* bench 16232.0.5 a8cdf0e104e6 */
/* bench 16232.0.6 6ca8a9ac6f4b */
/* bench 16232.0.7 82ebb259a82d */
/* bench 16232.0.8 29c8ae1aed1b */
/* bench 16232.0.9 9293eec67c7f */
/* bench 16232.0.10 36158f5ead38 */
/* bench 16232.0.11 562a1d291cf9 */
/* bench 16232.0.12 568f84063067 */
/* bench 16232.0.13 f72e2fe4a78a */
/* bench 109.0.7 69a76266a398 */
/* bench 109.0.8 c6ff620873e5 */
	compatible = "marvell,dove-sdhci";
	reg = <0x92000 0x100>;
	interrupts = <35>;
};
```

## Documentation/devicetree/bindings/mmc/sdhci-fujitsu.txt
```
FASTVC-BENCH-CORPUS:linux-main-100k-v1-e0bd41dc-8e12-4f1b-978d-a3645ae59da0
* Fujitsu SDHCI controller

/* bench 22626.0.0 48de1a39542b */
/* bench 22626.0.1 87ec14a4f54c */
/* bench 22626.0.2 bbc7bd92e991 */
/* bench 22626.0.3 10f0d6b41ee2 */
/* bench 22626.0.4 8d520f9ff054 */
/* bench 22626.0.5 5783f5be0f2a */
/* bench 22626.0.6 c2dd9e4af5f9 */
/* bench 22626.0.7 ddac95b20dc8 */
/* bench 22626.0.8 3795e17da21b */
/* bench 22626.0.9 2a2a698a6bfb */
/* bench 22626.0.10 aae81bc7a4b8 */
/* bench 22626.0.11 8c3224ce81e4 */
/* bench 22626.0.12 30634cf737b7 */
/* bench 22626.0.13 62093ac4a7ee */
/* bench 22626.0.14 d433d571cafa */

Required properties:
- compatible: "fujitsu,mb86s70-sdhci-3.0"
- clocks: Must contain an entry for each entry in clock-names. It is a
  list of phandles and clock-specifier pairs.
  See ../clocks/clock-bindings.txt for details.
- clock-names: Should contain the following two entries:
	"iface" - clock used for sdhci interface
	"core"  - core clock for sdhci controller

Optional properties:
- vqmmc-supply: phandle to the regulator device tree node, mentioned
  as the VCCQ/VDD_IO supply in the eMMC/SD specs.
- fujitsu,cmd-dat-delay-select: boolean property indicating that this host
  requires the CMD_DAT_DELAY control to be enabled.

Example:

	sdhci1: mmc@36600000 {
		compatible = "fujitsu,mb86s70-sdhci-3.0";
		reg = <0 0x36600000 0x1000>;
		interrupts = <0 172 0x4>,
			     <0 173 0x4>;
		bus-width = <4>;
		vqmmc-supply = <&vccq_sdhci1>;
		clocks = <&clock 2 2 0>, <&clock 2 3 0>;
		clock-names = "iface", "core";
/* bench 20715.0.0 110eca18173d */
	};
```

## Documentation/devicetree/bindings/mmc/sdhci-of-dwcmshc.txt
```
/* bench 27350.0.0 9fd1d13ac4e7 */
/* bench 27350.0.1 f469c641561f */
/* bench 27350.0.2 ce9f8e0b812c */
/* bench 27350.0.3 2a5b7c2ebbdd */
/* bench 27350.0.4 22bde934e938 */
/* bench 27350.0.5 d78a2709c40b */
/* bench 27350.0.6 962284b32b45 */
/* bench 27350.0.7 00a5de6b1b26 */
/* bench 27350.0.8 e7856e82ff6a */
/* bench 27350.0.9 4d2ca78df927 */
* Synopsys DesignWare Cores Mobile Storage Host Controller

Required properties:
- compatible: should be one of the following:
    "snps,dwcmshc-sdhci"
- reg: offset and length of the register set for the device.
- interrupts: a single interrupt specifier.
- clocks: Array of clocks required for SDHCI; requires at least one for
    core clock.
- clock-names: Array of names corresponding to clocks property; shall be
    "core" for core clock and "bus" for optional bus clock.

Example:
	sdhci2: sdhci@aa0000 {
		compatible = "snps,dwcmshc-sdhci";
		reg = <0xaa0000 0x1000>;
		interrupts = <GIC_SPI 21 IRQ_TYPE_LEVEL_HIGH>;
		clocks = <&emmcclk>;
		bus-width = <8>;
	}
```

## Documentation/devicetree/bindings/mmc/sdhci-omap.txt
```
FASTVC-BENCH-CORPUS:linux-main-100k-v1-e0bd41dc-8e12-4f1b-978d-a3645ae59da0
* TI OMAP SDHCI Controller

Refer to mmc.txt for standard MMC bindings.

For UHS devices which require tuning, the device tree should have a "cpu_thermal" node which maps to the appropriate thermal zone. This is used to get the temperature of the zone during tuning.

Required properties:
- compatible: Should be "ti,dra7-sdhci" for DRA7 and DRA72 controllers
	      Should be "ti,k2g-sdhci" for K2G
	      Should be "ti,am335-sdhci" for am335x controllers
	      Should be "ti,am437-sdhci" for am437x controllers
- ti,hwmods: Must be "mmc<n>", <n> is controller instance starting 1
	     (Not required for K2G).
- pinctrl-names: Should be subset of "default", "hs", "sdr12", "sdr25", "sdr50",
/* bench 7748.1.0 118c346e5600 */
/* bench 7748.1.1 f9678ba7e4eb */
/* bench 7748.1.2 05d32c707231 */
/* bench 7748.1.3 6b6fef2e7ec1 */
/* bench 7748.1.4 7fab8268cec5 */
/* bench 7748.1.5 0eb2644fd078 */
/* bench 7748.1.6 a032f6270162 */
/* bench 7748.1.7 70dc829e7bc1 */
/* bench 7748.1.8 3651695c2897 */
/* bench 7748.1.9 0b8dbf665984 */
/* bench 7748.1.10 d07b947ee4d4 */
		 "hs200_1_8v",
- pinctrl-<n> : Pinctrl states as described in bindings/pinctrl/pinctrl-bindings.txt

Optional properties:
/* bench 23689.0.0 a9652003f014 */
/* bench 23689.0.1 25b5cc32d6e8 */
/* bench 23689.0.2 c476ab5f6170 */
/* bench 23689.0.3 bbfd8fff0f18 */
/* bench 23689.0.4 25a0c984b55d */
/* bench 23689.0.5 9934f4d182d6 */
/* bench 23689.0.6 a243f3b8e925 */
/* bench 23689.0.7 f85e499c8375 */
/* bench 23689.0.8 6fa3dea6c6d9 */
/* bench 23689.0.9 62675c7af4e5 */
/* bench 23689.0.10 e69f25773ad4 */
/* bench 23689.0.11 ed7f1ee7cc5a */
		in the generic DMA client binding. A tx and rx specifier is required.
- dma-names:	List of DMA request names. These strings correspond 1:1 with the
		DMA specifiers listed in dmas. The string naming is to be "tx"
		and "rx" for TX and RX DMA requests, respectively.

Example:
	mmc1: mmc@4809c000 {
		compatible = "ti,dra7-sdhci";
		reg = <0x4809c000 0x400>;
		ti,hwmods = "mmc1";
		bus-width = <4>;
		vmmc-supply = <&vmmc>; /* phandle to regulator node */
		dmas = <&sdma 61 &sdma 62>;
		dma-names = "tx", "rx";
	};
```

## Documentation/devicetree/bindings/mmc/sdhci-sirf.txt
```
FASTVC-BENCH-CORPUS:linux-main-100k-v1-e0bd41dc-8e12-4f1b-978d-a3645ae59da0
* SiRFprimII/marco/atlas6 SDHCI Controller

This file documents differences between the core properties in mmc.txt
and the properties used by the sdhci-sirf driver.

Required properties:
- compatible: sirf,prima2-sdhc

Optional properties:
- cd-gpios: card detect gpio, with zero flags.

Example:

	sd0: sdhci@56000000 {
		compatible = "sirf,prima2-sdhc";
		reg = <0xcd000000 0x100000>;
		cd-gpios = <&gpio 6 0>;
	};
```

## Documentation/devicetree/bindings/mmc/sdhci-spear.txt
```
/* bench 19499.0.0 9b586ea4679d */
/* bench 19499.0.1 0a4889825303 */
/* bench 19499.0.2 b7b62c2244f2 */
/* bench 19499.0.3 c3322a5577f9 */
/* bench 19499.0.4 407ee2c8d6bf */
/* bench 19499.0.5 56bbf4161c56 */
/* bench 19499.0.6 9c69fd9e9d99 */
/* bench 19499.0.7 c35cd45e3158 */
/* bench 19499.0.8 2913f1f8ee9a */
/* bench 19499.0.9 f831e0ca580f */
/* bench 19499.0.10 a265cb6a88be */
/* bench 19499.0.11 a914bfa49f9d */
This file documents differences between the core properties in mmc.txt
and the properties used by the sdhci-spear driver.

Required properties:
- compatible: "st,spear300-sdhci"

Optional properties:
- cd-gpios: card detect gpio, with zero flags.

Example:

	sdhci@fc000000 {
		compatible = "st,spear300-sdhci";
		reg = <0xfc000000 0x1000>;
		cd-gpios = <&gpio0 6 0>;
	};
```
