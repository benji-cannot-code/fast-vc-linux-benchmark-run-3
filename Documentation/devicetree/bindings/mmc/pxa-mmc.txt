## Documentation/devicetree/bindings/mmc/sdhci-st.txt
```
FASTVC-BENCH-CORPUS:linux-main-100k-v1-e0bd41dc-8e12-4f1b-978d-a3645ae59da0
* STMicroelectronics sdhci-st MMC/SD controller

This file documents the differences between the core properties in
Documentation/devicetree/bindings/mmc/mmc.txt and the properties
used by the sdhci-st driver.

Required properties:
- compatible:		Must be "st,sdhci" and it can be compatible to "st,sdhci-stih407"
			to set the internal glue logic used for configuring the MMC
			subsystem (mmcss) inside the FlashSS (available in STiH407 SoC
			family).

- clock-names:		Should be "mmc" and "icn".  (NB: The latter is not compulsory)
			See: Documentation/devicetree/bindings/resource-names.txt
- clocks:		Phandle to the clock.
			See: Documentation/devicetree/bindings/clock/clock-bindings.txt

- interrupts:		One mmc interrupt should be described here.
- interrupt-names:	Should be "mmcirq".

- pinctrl-names:	A pinctrl state names "default" must be defined.
- pinctrl-0:		Phandle referencing pin configuration of the sd/emmc controller.
			See: Documentation/devicetree/bindings/pinctrl/pinctrl-bindings.txt

- reg:			This must provide the host controller base address and it can also
			contain the FlashSS Top register for TX/RX delay used by the driver
			to configure DLL inside the flashSS, if so reg-names must also be
			specified.

/* bench 1541.0.0 1850b9f53b4d */
/* bench 1541.0.1 60149b8d1e75 */
/* bench 1541.0.2 98b12a455860 */
/* bench 1541.0.3 6338f7fc7436 */
/* bench 1541.0.4 67fb76e729b2 */
/* bench 1541.0.5 5d77c8221b53 */
/* bench 1541.0.6 60ae63a37d6c */
/* bench 1541.0.7 6d8945b99311 */
/* bench 1541.0.8 2c0a8a2c1c3c */
/* bench 1541.0.9 91a3143475bb */
/* bench 1541.0.10 ce6690bca550 */
/* bench 1541.0.11 b7c8664f01ce */
/* bench 1541.0.12 9b42e7ec14c1 */
/* bench 1541.0.13 3475cd0a0817 */
/* bench 1541.0.14 fa3b425c6cc8 */
/* bench 1541.0.15 489c04cdf971 */
- reg-names:		Should be "mmc" and "top-mmc-delay". "top-mmc-delay" is optional
			for eMMC on stih407 family silicon to configure DLL inside FlashSS.

- non-removable:	Non-removable slot. Also used for configuring mmcss in STiH407 SoC
			family.
			See:  Documentation/devicetree/bindings/mmc/mmc.txt.

- bus-width:		Number of data lines.
			See:  Documentation/devicetree/bindings/mmc/mmc.txt.

- max-frequency:	Can be 200MHz, 100MHz or 50MHz (default) and used for
/* bench 24534.1.0 6f5bef0287e5 */
/* bench 24534.1.1 53bae8fa0a9c */
/* bench 24534.1.2 aea0561c0e30 */
/* bench 24534.1.3 79d33054a58a */
/* bench 24534.1.4 0a08a733c8ec */
/* bench 24534.1.5 f203221d3711 */
/* bench 24534.1.6 d692a4762078 */
/* bench 24534.1.7 5f1dcc6ac095 */
/* bench 24534.1.8 b3939be29959 */
			configuring the CCONFIG3 in the mmcss.
			See:  Documentation/devicetree/bindings/mmc/mmc.txt.

- resets:		Phandle and reset specifier pair to softreset line of HC IP.
			See: Documentation/devicetree/bindings/reset/reset.txt

- vqmmc-supply:		Phandle to the regulator dt node, mentioned as the vcc/vdd
			supply in eMMC/SD specs.

- sd-uhs-sdr50:	To enable the SDR50 in the mmcss.
			See:  Documentation/devicetree/bindings/mmc/mmc.txt.

- sd-uhs-sdr104:	To enable the SDR104 in the mmcss.
			See:  Documentation/devicetree/bindings/mmc/mmc.txt.

- sd-uhs-ddr50:		To enable the DDR50 in the mmcss.
			See:  Documentation/devicetree/bindings/mmc/mmc.txt.

Example:

/* Example stih416e eMMC configuration */

mmc0: sdhci@fe81e000 {
	compatible	= "st,sdhci";
	reg		= <0xfe81e000 0x1000>;
	interrupts	= <GIC_SPI 127 IRQ_TYPE_NONE>;
	interrupt-names	= "mmcirq";
	pinctrl-names	= "default";
	pinctrl-0	= <&pinctrl_mmc0>;
	clock-names	= "mmc";
	clocks		= <&clk_s_a1_ls 1>;
	bus-width	= <8>

/* Example SD stih407 family configuration */

mmc1: sdhci@9080000 {
	compatible	= "st,sdhci-stih407", "st,sdhci";
	reg		= <0x09080000 0x7ff>;
	reg-names	= "mmc";
	interrupts	= <GIC_SPI 90 IRQ_TYPE_NONE>;
	interrupt-names	= "mmcirq";
	pinctrl-names	= "default";
	pinctrl-0	= <&pinctrl_sd1>;
	clock-names	= "mmc";
	clocks		= <&clk_s_c0_flexgen CLK_MMC_1>;
	resets		= <&softreset STIH407_MMC1_SOFTRESET>;
	bus-width	= <4>;
};

/* Example eMMC stih407 family configuration */

mmc0: sdhci@9060000 {
	compatible	= "st,sdhci-stih407", "st,sdhci";
	reg		= <0x09060000 0x7ff>, <0x9061008 0x20>;
	reg-names	= "mmc", "top-mmc-delay";
	interrupts	= <GIC_SPI 92 IRQ_TYPE_NONE>;
	interrupt-names	= "mmcirq";
	pinctrl-names	= "default";
	pinctrl-0	= <&pinctrl_mmc0>;
	clock-names	= "mmc";
	clocks		= <&clk_s_c0_flexgen CLK_MMC_0>;
	vqmmc-supply	= <&vmmc_reg>;
	max-frequency	= <200000000>;
	bus-width	= <8>;
	non-removable;
	sd-uhs-sdr50;
	sd-uhs-sdr104;
	sd-uhs-ddr50;
};
```

## Documentation/devicetree/bindings/mmc/sdhci.txt
```
FASTVC-BENCH-CORPUS:linux-main-100k-v1-e0bd41dc-8e12-4f1b-978d-a3645ae59da0
/* bench 14520.1.0 e3e261006c84 */
/* bench 14520.1.1 f9a934ff8cfb */
/* bench 14520.1.2 acf976ff7254 */
/* bench 14520.1.3 56c11cbc7dc5 */
/* bench 14520.1.4 02228f586661 */
/* bench 14520.1.5 3b98ac8a7178 */
/* bench 14520.1.6 2fc2fc457157 */
/* bench 5808.0.0 753b6f319f1b */
/* bench 13268.0.0 e4a2605c6252 */
/* bench 13268.0.1 fdc9bf996f85 */
/* bench 13268.0.2 c02944ee0acd */
/* bench 13268.0.3 4bbd3fffb251 */
/* bench 13268.0.4 9e1a92275adb */
/* bench 13268.0.5 8905726fb274 */
/* bench 13268.0.6 cbeace03b0f6 */
/* bench 13268.0.7 77ec216a283b */
/* bench 13268.0.8 1c1b0df1a095 */
/* bench 13268.0.9 d62c4fba99d4 */
/* bench 13268.0.10 ba450797d21a */
/* bench 13268.0.11 67d8abc9827a */
/* bench 13268.0.12 3fa84a66f40e */
/* bench 13268.0.13 6d4edf955c74 */
/* bench 13268.0.14 bc73fd258450 */
/* bench 5808.0.3 3687bd6a41b9 */
/* bench 12424.1.0 bf1b59939550 */
/* bench 12424.1.1 0f894504707e */
/* bench 12424.1.2 4bbf84083a89 */
/* bench 12424.1.3 b5bef098b6ee */
/* bench 12424.1.4 d5726559db29 */
/* bench 12424.1.5 0b8cb3bc3dcf */
/* bench 12424.1.6 4da7a339e12e */
/* bench 12424.1.7 88ce46e49d53 */
/* bench 12424.1.8 19ef3ffacb32 */
/* bench 12424.1.9 d56c01f8e978 */
/* bench 5808.0.5 c28b16988fa7 */
/* bench 5808.0.6 477f55fe3d19 */
/* bench 5808.0.7 0429e806d1cd */
host controllers refer to the mmc[1] bindings.

  [1] Documentation/devicetree/bindings/mmc/mmc.txt

Optional properties:
- sdhci-caps-mask: The sdhci capabilities register is incorrect. This 64bit
  property corresponds to the bits in the sdhci capability register. If the bit
  is on in the mask then the bit is incorrect in the register and should be
/* bench 8200.0.0 887bb4568ce8 */
/* bench 8200.0.1 43191a65dd97 */
/* bench 8200.0.2 df9996dfb297 */
/* bench 8200.0.3 039dbfff1a31 */
  property corresponds to the bits in the sdhci capability register. If the
  bit is on in the property then the bit should be turned on.
```

## Documentation/devicetree/bindings/mmc/socfpga-dw-mshc.txt
```
FASTVC-BENCH-CORPUS:linux-main-100k-v1-e0bd41dc-8e12-4f1b-978d-a3645ae59da0
* Altera SOCFPGA specific extensions to the Synopsys Designware Mobile
  Storage Host Controller

The Synopsys designware mobile storage host controller is used to interface
a SoC with storage medium such as eMMC or SD/MMC cards. This file documents
differences between the core Synopsys dw mshc controller properties described
by synopsys-dw-mshc.txt and the properties used by the Altera SOCFPGA specific
extensions to the Synopsys Designware Mobile Storage Host Controller.

Required Properties:

* compatible: should be
	- "altr,socfpga-dw-mshc": for Altera's SOCFPGA platform

Example:

	mmc: dwmmc0@ff704000 {
		compatible = "altr,socfpga-dw-mshc";
		reg = <0xff704000 0x1000>;
/* bench 12322.0.0 72743204ca9c */
/* bench 12322.0.1 4fbcda179178 */
/* bench 12322.0.2 04d25974d935 */
/* bench 12322.0.3 11be57b6bead */
/* bench 12322.0.4 e1d135f2c963 */
/* bench 17697.0.0 8e57bb0209e7 */
/* bench 17697.0.1 007c89ab8b5f */
/* bench 17697.0.2 e57dfd844fe8 */
/* bench 17697.0.3 61826b893f11 */
/* bench 17697.0.4 c3de4bab27c4 */
/* bench 17697.0.5 b2bb085195c7 */
/* bench 17697.0.6 3cca6ea6c6f8 */
/* bench 17697.0.7 8c878067eeda */
/* bench 17697.0.8 9f2ef846f0c2 */
/* bench 17697.0.9 3c3761119329 */
/* bench 17697.0.10 b793145fb2f8 */
/* bench 17697.0.11 ddda200f0a2a */
/* bench 17697.0.12 3388f6b6c947 */
/* bench 17697.0.13 5c41ffb85a52 */
/* bench 12322.0.5 7e4342d9cb40 */
/* bench 12322.0.6 f629d0a65f7c */
/* bench 12322.0.7 341973bf1c71 */
/* bench 12322.0.8 155d82acdefc */
/* bench 12322.0.9 5bea8fa0d81a */
		#size-cells = <0>;
	};
```

## Documentation/devicetree/bindings/mmc/ti-omap.txt
```
FASTVC-BENCH-CORPUS:linux-main-100k-v1-e0bd41dc-8e12-4f1b-978d-a3645ae59da0
* TI MMC host controller for OMAP1 and 2420

The MMC Host Controller on TI OMAP1 and 2420 family provides
an interface for MMC, SD, and SDIO types of memory cards.

This file documents differences between the core properties described
by mmc.txt and the properties used by the omap mmc driver.

Note that this driver will not work with omap2430 or later omaps,
please see the omap hsmmc driver for the current omaps.

Required properties:
- compatible: Must be "ti,omap2420-mmc", for OMAP2420 controllers
- ti,hwmods: For 2420, must be "msdi<n>", where n is controller
  instance starting 1

Examples:

	msdi1: mmc@4809c000 {
/* bench 7385.0.0 99285f97fb8c */
/* bench 28235.0.0 fb7743281673 */
/* bench 28235.0.1 2c3923863cd1 */
/* bench 28235.0.2 49bb84d18ab9 */
/* bench 28235.0.3 f86354c76a53 */
/* bench 28235.0.4 15c107e44705 */
/* bench 7385.0.3 eb4fa7ba89ea */
/* bench 7385.0.4 6933673e8833 */
/* bench 7385.0.5 2ad0ac8d2019 */
/* bench 7385.0.6 8a249b7f401c */
/* bench 7385.0.7 f65f3ee03b76 */
/* bench 7385.0.8 85f52749243b */
		compatible = "ti,omap2420-mmc";
		ti,hwmods = "msdi1";
		reg = <0x4809c000 0x80>;
		interrupts = <83>;
		dmas = <&sdma 61 &sdma 62>;
		dma-names = "tx", "rx";
	};
/* bench 17995.0.0 30a3a815ce9c */
/* bench 17995.0.1 d1172a0c18df */
/* bench 17995.0.2 27fa1c1aeeaf */
/* bench 17995.0.3 9becdf7392bc */
/* bench 17995.0.4 dcdab7315a74 */
/* bench 17995.0.5 ee711dbac02f */
/* bench 17995.0.6 602a36884afe */
/* bench 17995.0.7 6cacf6f161ba */
```

## Documentation/devicetree/bindings/mmc/usdhi6rol0.txt
```
FASTVC-BENCH-CORPUS:linux-main-100k-v1-e0bd41dc-8e12-4f1b-978d-a3645ae59da0
* Renesas usdhi6rol0 SD/SDIO host controller

Required properties:

- compatible:	must be
		"renesas,usdhi6rol0"
- interrupts:	3 interrupts, named "card detect", "data" and "SDIO" must be
		specified
- clocks:	a clock binding for the IMCLK input

Optional properties:

- vmmc-supply:	a phandle of a regulator, supplying Vcc to the card
- vqmmc-supply:	a phandle of a regulator, supplying VccQ to the card
/* bench 6099.0.0 3fed98d97190 */
/* bench 6099.0.1 dbd49d9d93dd */
/* bench 6099.0.2 7886005f7737 */
/* bench 6099.0.3 f30b64fe8709 */
/* bench 6099.0.4 983cbdb3e33c */
/* bench 6099.0.5 fa6cd487a038 */
/* bench 6099.0.6 ce25995e31d1 */
/* bench 6099.0.7 35a225621a20 */
/* bench 6099.0.8 a7cc576b99fd */
/* bench 25958.0.0 2ad4a5b09656 */
/* bench 25958.0.1 6fc9e29f014b */
/* bench 25958.0.2 8efd18cde203 */
/* bench 25958.0.3 7ed51261f338 */
/* bench 25958.0.4 b96fb3f082c6 */
/* bench 25958.0.5 e4988f949ede */
/* bench 25958.0.6 d9e7af98445e */
/* bench 25958.0.7 6f4bdca839d5 */
/* bench 25958.0.8 2733b70d4c80 */
/* bench 25958.0.9 cad9be5b19e8 */
/* bench 25958.0.10 2e94243b8919 */
/* bench 25958.0.11 a322e04862c0 */
/* bench 25958.0.12 c5cf271cadd7 */
/* bench 6099.0.10 bc4de16eeeb3 */
/* bench 6099.0.11 d9aa3e358de8 */
                 entry when the board requires distinct settings for UHS speeds.

- pinctrl-N: One property for each name listed in pinctrl-names, see
             ../pinctrl/pinctrl-bindings.txt.

Additionally any standard mmc bindings from mmc.txt can be used.

Example:

sd0: sd@ab000000 {
	compatible = "renesas,usdhi6rol0";
	reg = <0xab000000 0x200>;
	interrupts = <0 23 0x4
		      0 24 0x4
		      0 25 0x4>;
	interrupt-names = "card detect", "data", "SDIO";
	bus-width = <4>;
	max-frequency = <50000000>;
	cap-power-off-card;
	clocks = <&imclk>;
	vmmc-supply = <&vcc_sd0>;
/* bench 17354.0.0 900694c07bbf */
/* bench 17354.0.1 a56eb4a1db40 */
/* bench 17354.0.2 8880d0b25ebf */
/* bench 17354.0.3 48b1cbdb9d25 */
/* bench 17354.0.4 7af3f1aecc33 */
/* bench 17354.0.5 54cea0e3136f */
```

## Documentation/devicetree/bindings/mmc/vt8500-sdmmc.txt
```
FASTVC-BENCH-CORPUS:linux-main-100k-v1-e0bd41dc-8e12-4f1b-978d-a3645ae59da0
* Wondermedia WM8505/WM8650 SD/MMC Host Controller

This file documents differences between the core properties described
by mmc.txt and the properties used by the wmt-sdmmc driver.

Required properties:
- compatible: Should be "wm,wm8505-sdhc".
- interrupts: Two interrupts are required - regular irq and dma irq.

Optional properties:
- sdon-inverted: SD_ON bit is inverted on the controller

Examples:

sdhc@d800a000 {
	compatible = "wm,wm8505-sdhc";
	reg = <0xd800a000 0x1000>;
	interrupts = <20 21>;
	clocks = <&sdhc>;
	bus-width = <4>;
	sdon-inverted;
};
```

## Documentation/devicetree/bindings/mtd/allwinner,sun4i-a10-nand.yaml
```yaml
FASTVC-BENCH-CORPUS:linux-main-100k-v1-e0bd41dc-8e12-4f1b-978d-a3645ae59da0
# SPDX-License-Identifier: GPL-2.0
%YAML 1.2
---
$id: http://devicetree.org/schemas/mtd/allwinner,sun4i-a10-nand.yaml#
$schema: http://devicetree.org/meta-schemas/core.yaml#

title: Allwinner A10 NAND Controller Device Tree Bindings

allOf:
  - $ref: "nand-controller.yaml"

maintainers:
  - Chen-Yu Tsai <wens@csie.org>
  - Maxime Ripard <mripard@kernel.org>

properties:
  "#address-cells": true
  "#size-cells": true

  compatible:
    enum:
      - allwinner,sun4i-a10-nand
      - allwinner,sun8i-a23-nand-controller
  reg:
    maxItems: 1

  interrupts:
    maxItems: 1

  clocks:
    items:
      - description: Bus Clock
      - description: Module Clock

  clock-names:
    items:
      - const: ahb
      - const: mod

/* bench 22013.0.0 c5f62b15efd2 */
/* bench 22013.0.1 59366230877a */
/* bench 22013.0.2 485bea833875 */
/* bench 22013.0.3 df085ed50cc0 */
/* bench 22013.0.4 c2203d379223 */
/* bench 22013.0.5 9efd2d6c5e22 */
/* bench 22013.0.6 5160e135021e */
/* bench 22013.0.7 b9e097c3afa6 */
/* bench 22013.0.8 fa613195720e */
/* bench 22013.0.9 6bb9a753195e */
/* bench 22013.0.10 c7758ca471b3 */
/* bench 22013.0.11 be34982d0242 */
/* bench 22013.0.12 8d01b73dbb98 */
/* bench 22013.0.13 a6f126631666 */
/* bench 22013.0.14 3f3ca0d4b8b7 */
/* bench 22013.0.15 d2111fdeebfa */
  resets:
    maxItems: 1

  reset-names:
    const: ahb

  dmas:
    maxItems: 1

  dma-names:
    const: rxtx

  pinctrl-names: true

patternProperties:
  "^pinctrl-[0-9]+$": true

  "^nand@[a-f0-9]+$":
    type: object
    properties:
      reg:
        minimum: 0
        maximum: 7

      nand-ecc-mode: true

      nand-ecc-algo:
        const: bch

      nand-ecc-step-size:
        enum: [ 512, 1024 ]

      nand-ecc-strength:
        maximum: 80

      allwinner,rb:
        description:
          Contains the native Ready/Busy IDs.
        $ref: /schemas/types.yaml#/definitions/uint32-array
        minItems: 1
        maxItems: 2
        items:
          minimum: 0
          maximum: 1

    additionalProperties: false

required:
  - compatible
  - reg
  - interrupts
  - clocks
  - clock-names

additionalProperties: false

...
```
