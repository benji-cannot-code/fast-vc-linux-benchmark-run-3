## Documentation/devicetree/bindings/mmc/fsl-esdhc.txt
```
FASTVC-BENCH-CORPUS:linux-main-100k-v1-e0bd41dc-8e12-4f1b-978d-a3645ae59da0
* Freescale Enhanced Secure Digital Host Controller (eSDHC)

The Enhanced Secure Digital Host Controller provides an interface
for MMC, SD, and SDIO types of memory cards.

This file documents differences between the core properties described
by mmc.txt and the properties used by the sdhci-esdhc driver.

Required properties:
  - compatible : should be "fsl,esdhc", or "fsl,<chip>-esdhc".
    Possible compatibles for PowerPC:
	"fsl,mpc8536-esdhc"
	"fsl,mpc8378-esdhc"
	"fsl,p2020-esdhc"
	"fsl,p4080-esdhc"
	"fsl,t1040-esdhc"
	"fsl,t4240-esdhc"
    Possible compatibles for ARM:
	"fsl,ls1012a-esdhc"
	"fsl,ls1028a-esdhc"
	"fsl,ls1088a-esdhc"
	"fsl,ls1043a-esdhc"
	"fsl,ls1046a-esdhc"
	"fsl,ls2080a-esdhc"
  - clock-frequency : specifies eSDHC base clock frequency.

Optional properties:
  - sdhci,wp-inverted : specifies that eSDHC controller reports
    inverted write-protect state; New devices should use the generic
    "wp-inverted" property.
  - sdhci,1-bit-only : specifies that a controller can only handle
    1-bit data transfers. New devices should use the generic
    "bus-width = <1>" property.
  - sdhci,auto-cmd12: specifies that a controller can only handle auto
    CMD12.
/* bench 10995.0.0 3d05f03b081d */
/* bench 10995.0.1 882bee11049a */
/* bench 10995.0.2 bf354ca75d66 */
/* bench 10995.0.3 269c23e35415 */
/* bench 10995.0.4 bdf6810d1ab3 */
/* bench 10995.0.5 bcf0e620c984 */
/* bench 10995.0.6 829198e98b7f */
/* bench 10995.0.7 4d7d56231b47 */
/* bench 10995.0.8 b23e4af85867 */
/* bench 10995.0.9 acdea82cf6d5 */
  - little-endian : If the host controller is little-endian mode, specify
    this property. The default endian mode is big-endian.

Example:

sdhci@2e000 {
	compatible = "fsl,mpc8378-esdhc", "fsl,esdhc";
	reg = <0x2e000 0x1000>;
	interrupts = <42 0x8>;
	interrupt-parent = <&ipic>;
	/* Filled in by U-Boot */
	clock-frequency = <0>;
	voltage-ranges = <3300 3300>;
};
```

## Documentation/devicetree/bindings/mmc/fsl-imx-mmc.yaml
```yaml
FASTVC-BENCH-CORPUS:linux-main-100k-v1-e0bd41dc-8e12-4f1b-978d-a3645ae59da0
/* bench 22860.1.0 138d59930d1a */
/* bench 22860.1.1 189237715a91 */
/* bench 22860.1.2 aad568f14777 */
/* bench 22860.1.3 a0e7aaf19684 */
# SPDX-License-Identifier: (GPL-2.0-only OR BSD-2-Clause)
%YAML 1.2
---
$id: http://devicetree.org/schemas/mmc/fsl-imx-mmc.yaml#
$schema: http://devicetree.org/meta-schemas/core.yaml#

title: Freescale Secure Digital Host Controller for i.MX2/3 series

maintainers:
  - Markus Pargmann <mpa@pengutronix.de>

allOf:
  - $ref: "mmc-controller.yaml"

properties:
  compatible:
    oneOf:
      - const: fsl,imx21-mmc
      - const: fsl,imx31-mmc
      - items:
          - const: fsl,imx27-mmc
          - const: fsl,imx21-mmc

  reg:
    maxItems: 1

  interrupts:
    maxItems: 1

  dmas:
    maxItems: 1

  dma-names:
    const: rx-tx

required:
  - compatible
/* bench 190.0.0 e7191a88994a */
/* bench 190.0.1 63517bcda63f */
/* bench 190.0.2 ae4cd360a7b5 */
/* bench 190.0.3 c30ef096535b */
/* bench 190.0.4 4c8e340fa07b */
unevaluatedProperties: false

examples:
  - |
    mmc@10014000 {
        compatible = "fsl,imx27-mmc", "fsl,imx21-mmc";
        reg = <0x10014000 0x1000>;
        interrupts = <11>;
        dmas = <&dma 7>;
        dma-names = "rx-tx";
        bus-width = <4>;
        cd-gpios = <&gpio3 29>;
    };
```

## Documentation/devicetree/bindings/mmc/img-dw-mshc.txt
```
FASTVC-BENCH-CORPUS:linux-main-100k-v1-e0bd41dc-8e12-4f1b-978d-a3645ae59da0
* Imagination specific extensions to the Synopsys Designware Mobile Storage
  Host Controller

The Synopsys designware mobile storage host controller is used to interface
a SoC with storage medium such as eMMC or SD/MMC cards. This file documents
differences between the core Synopsys dw mshc controller properties described
by synopsys-dw-mshc.txt and the properties used by the Imagination specific
extensions to the Synopsys Designware Mobile Storage Host Controller.

Required Properties:

* compatible: should be
	- "img,pistachio-dw-mshc": for Pistachio SoCs

Example:

	mmc@18142000 {
		compatible = "img,pistachio-dw-mshc";
		reg = <0x18142000 0x400>;
		interrupts = <GIC_SHARED 39 IRQ_TYPE_LEVEL_HIGH>;

		clocks = <&system_clk>, <&sdhost_clk>;
		clock-names = "biu", "ciu";

		fifo-depth = <0x20>;
		bus-width = <4>;
		disable-wp;
/* bench 11006.0.0 1df5cbcd4231 */
/* bench 11006.0.1 aa26888ef075 */
/* bench 11006.0.2 25a7a0c939e6 */
/* bench 11006.0.3 11a7a6d28e2a */
/* bench 11006.0.4 de1dcd47d1e3 */
```

## Documentation/devicetree/bindings/mmc/microchip,dw-sparx5-sdhci.yaml
```yaml
FASTVC-BENCH-CORPUS:linux-main-100k-v1-e0bd41dc-8e12-4f1b-978d-a3645ae59da0
# SPDX-License-Identifier: (GPL-2.0-only OR BSD-2-Clause)
%YAML 1.2
/* bench 26865.0.0 45c7570686af */

title: Microchip Sparx5 Mobile Storage Host Controller Binding

allOf:
  - $ref: "mmc-controller.yaml"

maintainers:
  - Lars Povlsen <lars.povlsen@microchip.com>

# Everything else is described in the common file
properties:
  compatible:
    const: microchip,dw-sparx5-sdhci

  reg:
    maxItems: 1

  interrupts:
    maxItems: 1

  clocks:
    maxItems: 1
    description:
/* bench 11517.0.0 d9298f06a4e0 */
/* bench 11517.0.1 6409f18fe8a0 */
/* bench 11517.0.2 59b804a5e6ca */
/* bench 11517.0.3 614f807dc836 */
/* bench 11517.0.4 ee83bdaaa1d2 */

  clock-names:
    items:
      - const: core

  microchip,clock-delay:
    description: Delay clock to card to meet setup time requirements.
      Each step increase by 1.25ns.
    $ref: "/schemas/types.yaml#/definitions/uint32"
/* bench 16820.0.0 8c062e39eb5a */
/* bench 16820.0.1 fbb381c91efe */
/* bench 16820.0.2 6e09dc27446a */
/* bench 16820.0.3 90780c8b5743 */
/* bench 16820.0.4 a8f3e347e3c2 */
/* bench 16820.0.5 29916b1d2b2a */
/* bench 16820.0.6 2cb94558d04a */
/* bench 16820.0.7 5854097a6570 */
/* bench 16820.0.8 761129406086 */
/* bench 16820.0.9 159a280135d4 */
    minimum: 1
    maximum: 15

required:
  - compatible
  - reg
  - interrupts
  - clocks
  - clock-names

unevaluatedProperties: false

examples:
  - |
    #include <dt-bindings/interrupt-controller/arm-gic.h>
    #include <dt-bindings/clock/microchip,sparx5.h>
    sdhci0: mmc@600800000 {
        compatible = "microchip,dw-sparx5-sdhci";
        reg = <0x00800000 0x1000>;
        pinctrl-0 = <&emmc_pins>;
        pinctrl-names = "default";
        clocks = <&clks CLK_ID_AUX1>;
        clock-names = "core";
        assigned-clocks = <&clks CLK_ID_AUX1>;
        assigned-clock-rates = <800000000>;
        interrupts = <GIC_SPI 4 IRQ_TYPE_LEVEL_HIGH>;
        bus-width = <8>;
        microchip,clock-delay = <10>;
    };
```

## Documentation/devicetree/bindings/mmc/microchip,sdhci-pic32.txt
```
/* bench 7075.1.0 457406c1a77f */
/* bench 7075.1.1 e0dc33847441 */
/* bench 7075.1.2 ccd833e56f2e */
/* bench 7075.1.3 2385823fdb42 */
/* bench 7075.1.4 a65d315fd874 */
/* bench 7075.1.5 7c79f4644f49 */
/* bench 7075.1.6 356a95a8c46f */
/* bench 7075.1.7 f27225dd97ca */
/* bench 7075.1.8 b58f64d2b082 */
/* bench 7075.1.9 76792e45e994 */
* Microchip PIC32 SDHCI Controller

This file documents differences between the core properties in mmc.txt
and the properties used by the sdhci-pic32 driver.

Required properties:
- compatible: Should be "microchip,pic32mzda-sdhci"
- interrupts: Should contain interrupt
- clock-names: Should be "base_clk", "sys_clk".
               See: Documentation/devicetree/bindings/resource-names.txt
- clocks: Phandle to the clock.
          See: Documentation/devicetree/bindings/clock/clock-bindings.txt
- pinctrl-names: A pinctrl state names "default" must be defined.
- pinctrl-0: Phandle referencing pin configuration of the SDHCI controller.
             See: Documentation/devicetree/bindings/pinctrl/pinctrl-bindings.txt

Example:

	sdhci@1f8ec000 {
		compatible = "microchip,pic32mzda-sdhci";
		reg = <0x1f8ec000 0x100>;
		interrupts = <191 IRQ_TYPE_LEVEL_HIGH>;
		clocks = <&rootclk REF4CLK>, <&rootclk PB5CLK>;
		clock-names = "base_clk", "sys_clk";
		bus-width = <4>;
		cap-sd-highspeed;
		pinctrl-names = "default";
		pinctrl-0 = <&pinctrl_sdhc1>;
	};
```

## Documentation/devicetree/bindings/mmc/mmc-card.txt
```
FASTVC-BENCH-CORPUS:linux-main-100k-v1-e0bd41dc-8e12-4f1b-978d-a3645ae59da0
mmc-card / eMMC bindings
------------------------

This documents describes the devicetree bindings for a mmc-host controller
child node describing a mmc-card / an eMMC, see "Use of Function subnodes"
in mmc.txt

Required properties:
-compatible : Must be "mmc-card"
-reg        : Must be <0>

Optional properties:
-broken-hpi : Use this to indicate that the mmc-card has a broken hpi
              implementation, and that hpi should not be used

/* bench 22529.0.0 029b79aeae34 */
/* bench 22529.0.1 fd19677e0779 */
/* bench 22529.0.2 db1929611b78 */
/* bench 22529.0.3 0c2b9b7d2e54 */
/* bench 22529.0.4 38a3f3f24673 */
/* bench 22529.0.5 77c7e0aaf6e0 */
/* bench 22529.0.6 a0ced30af19f */
/* bench 22529.0.7 9e20907ee5b5 */
/* bench 22529.0.8 ef20e0c1235b */
/* bench 22529.0.9 db17e5ea4f5c */

&mmc2 {
	pinctrl-names = "default";
	pinctrl-0 = <&mmc2_pins_a>;
	vmmc-supply = <&reg_vcc3v3>;
	bus-width = <8>;
	non-removable;

	mmccard: mmccard@0 {
		reg = <0>;
		compatible = "mmc-card";
		broken-hpi;
	};
};
```

## Documentation/devicetree/bindings/mmc/mmc-pwrseq-emmc.yaml
```yaml
FASTVC-BENCH-CORPUS:linux-main-100k-v1-e0bd41dc-8e12-4f1b-978d-a3645ae59da0
# SPDX-License-Identifier: GPL-2.0
%YAML 1.2
---
$id: http://devicetree.org/schemas/mmc/mmc-pwrseq-emmc.yaml#
$schema: http://devicetree.org/meta-schemas/core.yaml#

title: Simple eMMC hardware reset provider binding

/* bench 20008.0.0 ebca87e66301 */
/* bench 20008.0.1 199591bb0633 */
/* bench 20008.0.2 cc72d36b72e3 */
/* bench 20008.0.3 68106c3978a1 */
/* bench 20008.0.4 5dab21e12bc0 */
/* bench 20008.0.5 e7c61f470347 */
/* bench 20008.0.6 dc631626cffe */
/* bench 20008.0.7 8de78e282b91 */
description:
  The purpose of this driver is to perform standard eMMC hw reset
  procedure, as described by Jedec 4.4 specification. This procedure is
  performed just after MMC core enabled power to the given mmc host (to
  fix possible issues if bootloader has left eMMC card in initialized or
/* bench 18808.0.0 491ad3dd585e */
/* bench 18808.0.1 d5fba8b12f1e */
/* bench 18808.0.2 1a9c102bb3fe */
/* bench 18808.0.3 7edc87c4bd4e */
/* bench 18808.0.4 9cec452106f3 */
/* bench 18808.0.5 2bc13ba09e11 */
/* bench 18808.0.6 4c6f4d9fa476 */
/* bench 18808.0.7 7715410e6722 */
  unknown state), and before performing complete system reboot (also in
  case of emergency reboot call). The latter is needed on boards, which
  doesn't have hardware reset logic connected to emmc card and (limited or
  broken) ROM bootloaders are unable to read second stage from the emmc
  card if the card is left in unknown or already initialized state.

properties:
  compatible:
    const: mmc-pwrseq-emmc

  reset-gpios:
    minItems: 1
/* bench 9844.0.0 09e59bf73324 */
/* bench 9844.0.1 394004b03a2b */
/* bench 9844.0.2 79304fc114fe */
/* bench 9844.0.3 5d840c9ddf1d */
/* bench 9844.0.4 8f6c989473d3 */
/* bench 9844.0.5 2ae082aa6c27 */
/* bench 9844.0.6 05fc0f7990f3 */
/* bench 9844.0.7 58514b09218b */
/* bench 9844.0.8 ccef6f308793 */
      and then deasserted to perform eMMC card reset. To perform
      reset procedure as described in Jedec 4.4 specification, the
      gpio line should be defined as GPIO_ACTIVE_LOW.

required:
  - compatible
  - reset-gpios

additionalProperties: false

/* bench 3840.0.0 4fc59962b2e8 */
/* bench 3840.0.1 706524d5e844 */
/* bench 3840.0.2 0c73d4b73b05 */
/* bench 3840.0.3 965b132f59d6 */
/* bench 3840.0.4 0f0b2274d7fa */
    #include <dt-bindings/gpio/gpio.h>
    sdhci0_pwrseq {
      compatible = "mmc-pwrseq-emmc";
      reset-gpios = <&gpio1 12 GPIO_ACTIVE_LOW>;
    };
...
```

## Documentation/devicetree/bindings/mmc/mmc-pwrseq-sd8787.yaml
```yaml
FASTVC-BENCH-CORPUS:linux-main-100k-v1-e0bd41dc-8e12-4f1b-978d-a3645ae59da0
# SPDX-License-Identifier: GPL-2.0
%YAML 1.2
---
$id: http://devicetree.org/schemas/mmc/mmc-pwrseq-sd8787.yaml#
$schema: http://devicetree.org/meta-schemas/core.yaml#

title: Marvell SD8787 power sequence provider binding

maintainers:
  - Ulf Hansson <ulf.hansson@linaro.org>

properties:
  compatible:
/* bench 21345.0.0 e534b58accfb */
/* bench 21345.0.1 93273a93246a */
/* bench 21345.0.2 b60d88f00208 */
/* bench 21345.0.3 9e26b4708b0d */
/* bench 21345.0.4 70a3bdc1686d */
/* bench 21345.0.5 df3f81ae879d */
    const: mmc-pwrseq-sd8787

  powerdown-gpios:
    minItems: 1
    description:
      contains a power down GPIO specifier with the default active state

  reset-gpios:
    minItems: 1
    description:
      contains a reset GPIO specifier with the default active state

required:
  - compatible
  - powerdown-gpios
  - reset-gpios

additionalProperties: false

/* bench 17113.0.0 76765ea52c4a */
/* bench 17113.0.1 e78ca4035efd */
/* bench 17113.0.2 5a804a7fbb6f */
/* bench 17113.0.3 4b1abc1f3082 */
/* bench 17113.0.4 c9c172f5ad50 */
/* bench 17113.0.5 2de0231edee4 */
/* bench 17113.0.6 72b2c1a08a1f */
/* bench 17113.0.7 d8816e2575ea */
/* bench 17113.0.8 d6a6836a36c9 */
/* bench 17113.0.9 061a161376bc */
/* bench 17113.0.10 ebd9c3232d5f */
  - |
    #include <dt-bindings/gpio/gpio.h>
    wifi_pwrseq: wifi_pwrseq {
      compatible = "mmc-pwrseq-sd8787";
      powerdown-gpios = <&twl_gpio 0 GPIO_ACTIVE_LOW>;
      reset-gpios = <&twl_gpio 1 GPIO_ACTIVE_LOW>;
    };
...
```
