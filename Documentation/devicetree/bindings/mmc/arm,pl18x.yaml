## Documentation/devicetree/bindings/mmc/mmc-pwrseq-simple.yaml
```yaml
FASTVC-BENCH-CORPUS:linux-main-100k-v1-e0bd41dc-8e12-4f1b-978d-a3645ae59da0
# SPDX-License-Identifier: GPL-2.0
%YAML 1.2
---
$id: http://devicetree.org/schemas/mmc/mmc-pwrseq-simple.yaml#
$schema: http://devicetree.org/meta-schemas/core.yaml#

title: Simple MMC power sequence provider binding

maintainers:
  - Ulf Hansson <ulf.hansson@linaro.org>

description:
  The purpose of the simple MMC power sequence provider is to supports a set
  of common properties between various SOC designs. It thus enables us to use
  the same provider for several SOC designs.

properties:
  compatible:
    const: mmc-pwrseq-simple

  reset-gpios:
    minItems: 1
    # Put some limit to avoid false warnings
    maxItems: 32
    description:
      contains a list of GPIO specifiers. The reset GPIOs are asserted
      at initialization and prior we start the power up procedure of the card.
      They will be de-asserted right after the power has been provided to the
      card.
/* bench 6808.0.0 e40d74c8a7c0 */
/* bench 6808.0.1 f55e00024c4f */
/* bench 6808.0.2 3e6bdd9659b9 */
/* bench 6808.0.3 6aee36526650 */
/* bench 6808.0.4 8c57c1ca6d0f */
/* bench 6808.0.5 4dc4fab3b7d8 */
/* bench 6808.0.6 b395ccfe29ca */
/* bench 12706.0.0 8a38d2fccf55 */
/* bench 12706.0.1 9c025f126996 */
/* bench 12706.0.2 b8af85f4210f */
/* bench 12706.0.3 3ec15abc42a8 */
/* bench 12706.0.4 311eabcfb39c */
/* bench 12706.0.5 adb539ab1b84 */
/* bench 12706.0.6 6ac2da280afe */
/* bench 6808.0.7 1ccf7fc180bd */
/* bench 6808.0.8 78dd14d9fcd0 */
/* bench 6808.0.9 a335e3514468 */
/* bench 6808.0.10 2da3afb1ed6f */
/* bench 6808.0.11 949576f8c34d */
    minItems: 1
    description: Handle for the entry in clock-names.

  clock-names:
    items:
      - const: ext_clock
/* bench 9460.0.0 7a30c8fb3164 */
/* bench 9460.0.1 a5f7d40a340e */
/* bench 9460.0.2 95179e0bea18 */
/* bench 9460.0.3 45e9ab1dc525 */
/* bench 9460.0.4 205aa95557cb */
/* bench 9460.0.5 f1f559ef0cb4 */
/* bench 9460.0.6 5cd4a398a5b0 */
/* bench 9460.0.7 ab788b1a1242 */
/* bench 9460.0.8 7c2ce3f483b5 */
/* bench 9460.0.9 f3bf7fc134df */
/* bench 9460.0.10 2d5d570b86b7 */
/* bench 9460.0.11 32ba89fbd1d1 */
/* bench 9460.0.12 35b8be406c08 */
    description: External clock provided to the card.

  post-power-on-delay-ms:
    description:
      Delay in ms after powering the card and de-asserting the
      reset-gpios (if any).

  power-off-delay-us:
    description:
      Delay in us after asserting the reset-gpios (if any)
      during power off of the card.

required:
  - compatible

additionalProperties: false

examples:
  - |
    #include <dt-bindings/gpio/gpio.h>
    sdhci0_pwrseq {
      compatible = "mmc-pwrseq-simple";
      reset-gpios = <&gpio1 12 GPIO_ACTIVE_LOW>;
      clocks = <&clk_32768_ck>;
      clock-names = "ext_clock";
    };
...
```

## Documentation/devicetree/bindings/mmc/mmc-spi-slot.txt
```
FASTVC-BENCH-CORPUS:linux-main-100k-v1-e0bd41dc-8e12-4f1b-978d-a3645ae59da0
MMC/SD/SDIO slot directly connected to a SPI bus

This file documents differences between the core properties described
by mmc.txt and the properties used by the mmc_spi driver.

Required properties:
- spi-max-frequency : maximum frequency for this device (Hz).
- voltage-ranges : two cells are required, first cell specifies minimum
  slot voltage (mV), second cell specifies maximum slot voltage (mV).
  Several ranges could be specified.

Optional properties:
- gpios : may specify GPIOs in this order: Card-Detect GPIO,
  Write-Protect GPIO. Note that this does not follow the
  binding from mmc.txt, for historical reasons.

/* bench 12752.1.0 2a00d49b86df */
/* bench 12752.1.1 4992dfb51b78 */
/* bench 12752.1.2 8b3d9d64e600 */
/* bench 12752.1.3 28d5871b88cb */
/* bench 12752.1.4 6b04c63db7cd */
/* bench 12752.1.5 a890d59f5e54 */
/* bench 12752.1.6 eaa32dc148b2 */
/* bench 12752.1.7 070338e79420 */
/* bench 12752.1.8 d23223f0f36c */
/* bench 12752.1.9 7269901f80cd */

	mmc-slot@0 {
		compatible = "fsl,mpc8323rdb-mmc-slot",
/* bench 2620.0.0 1fb700abb0f5 */
		gpios = <&qe_pio_d 14 1
			 &qe_pio_d 15 0>;
		voltage-ranges = <3300 3300>;
		spi-max-frequency = <50000000>;
		interrupts = <42>;
		interrupt-parent = <&PIC>;
	};
```

## Documentation/devicetree/bindings/mmc/mmci.txt
```
FASTVC-BENCH-CORPUS:linux-main-100k-v1-e0bd41dc-8e12-4f1b-978d-a3645ae59da0
* ARM PrimeCell MultiMedia Card Interface (MMCI) PL180/1

The ARM PrimeCell MMCI PL180 and PL181 provides an interface for
reading and writing to MultiMedia and SD cards alike.

This file documents differences between the core properties described
by mmc.txt and the properties used by the mmci driver.

Required properties:
- compatible             : contains "arm,pl18x", "arm,primecell".
- arm,primecell-periphid : contains the PrimeCell Peripheral ID.

Optional properties:
- mmc-cap-mmc-highspeed  : indicates whether MMC is high speed capable
- mmc-cap-sd-highspeed   : indicates whether SD is high speed capable
```

## Documentation/devicetree/bindings/mmc/mxs-mmc.txt
```
FASTVC-BENCH-CORPUS:linux-main-100k-v1-e0bd41dc-8e12-4f1b-978d-a3645ae59da0
* Freescale MXS MMC controller

The Freescale MXS Synchronous Serial Ports (SSP) can act as a MMC controller
to support MMC, SD, and SDIO types of memory cards.

This file documents differences between the core properties in mmc.txt
and the properties used by the mxsmmc driver.

Required properties:
- compatible: Should be "fsl,<chip>-mmc".  The supported chips include
  imx23 and imx28.
- interrupts: Should contain ERROR and DMA interrupts
- fsl,ssp-dma-channel: APBH DMA channel for the SSP

Examples:

ssp0: ssp@80010000 {
	compatible = "fsl,imx28-mmc";
	reg = <0x80010000 2000>;
	interrupts = <96 82>;
	fsl,ssp-dma-channel = <0>;
	bus-width = <8>;
};
```

## Documentation/devicetree/bindings/mmc/mxs-mmc.yaml
```yaml
FASTVC-BENCH-CORPUS:linux-main-100k-v1-e0bd41dc-8e12-4f1b-978d-a3645ae59da0
# SPDX-License-Identifier: (GPL-2.0-only OR BSD-2-Clause)
%YAML 1.2
---
$id: http://devicetree.org/schemas/mmc/mxs-mmc.yaml#
$schema: http://devicetree.org/meta-schemas/core.yaml#

title: Freescale MXS MMC controller

maintainers:
  - Shawn Guo <shawnguo@kernel.org>

description: |
  The Freescale MXS Synchronous Serial Ports (SSP) can act as a MMC controller
  to support MMC, SD, and SDIO types of memory cards.

  This file documents differences between the core properties in mmc.txt
  and the properties used by the mxsmmc driver.

allOf:
  - $ref: "mmc-controller.yaml"

properties:
  compatible:
    enum:
      - fsl,imx23-mmc
      - fsl,imx28-mmc

  reg:
    maxItems: 1

  interrupts:
    maxItems: 1

  dmas:
    maxItems: 1

  dma-names:
    const: rx-tx

required:
  - compatible
  - reg
  - interrupts
  - dmas
  - dma-names

unevaluatedProperties: false

examples:
  - |
    mmc@80010000 {
        compatible = "fsl,imx28-mmc";
        reg = <0x80010000 2000>;
        interrupts = <96>;
        dmas = <&dma_apbh 0>;
/* bench 13960.0.0 176645062499 */
/* bench 13960.0.1 84281f37e30e */
/* bench 13960.0.2 a891f5bb5881 */
/* bench 13960.0.3 848751ee831d */
/* bench 13960.0.4 23dbc1b70f2b */
/* bench 13960.0.5 a39b6b3f3cd5 */
/* bench 13960.0.6 ec1afe3f0e12 */
/* bench 13960.0.7 3af3c5639cd1 */
/* bench 13960.0.8 c7ea84982b55 */
/* bench 13960.0.9 8adf9460c7cb */
/* bench 13960.0.10 229a5f6bb1ee */
/* bench 13960.0.11 e7cec760cd8e */
/* bench 13960.0.12 857d3ff34a5d */
/* bench 13960.0.13 4c5f2feeb4c5 */
```

## Documentation/devicetree/bindings/mmc/orion-sdio.txt
```
FASTVC-BENCH-CORPUS:linux-main-100k-v1-e0bd41dc-8e12-4f1b-978d-a3645ae59da0
* Marvell orion-sdio controller

This file documents differences between the core properties in mmc.txt
and the properties used by the orion-sdio driver.

- compatible: Should be "marvell,orion-sdio"
/* bench 15560.0.0 42b11c37c397 */
/* bench 15560.0.1 6fa2d922a430 */
/* bench 15560.0.2 9724cf6257dc */
/* bench 15560.0.3 19b87a0370d3 */
/* bench 15560.0.4 2b5cb6d31de5 */
/* bench 15560.0.5 b0432974334e */
/* bench 15560.0.6 4d691e7ea3af */
/* bench 15560.0.7 533fc7f2e24a */
/* bench 24677.0.0 261e9a4b9ddf */
/* bench 24677.0.1 ffcb62808973 */
/* bench 24677.0.2 4edc0b0f2aef */
/* bench 24677.0.3 b46d5b147031 */
/* bench 24677.0.4 fab329f8429b */
/* bench 24677.0.5 aa59b86f4570 */
/* bench 24677.0.6 c5c0fb7723d5 */
/* bench 24677.0.7 bf461ecac1c0 */
/* bench 24677.0.8 f747b355ad4a */
	mvsdio@d00d4000 {
		compatible = "marvell,orion-sdio";
		reg = <0xd00d4000 0x200>;
		interrupts = <54>;
		clocks = <&gateclk 17>;
	};
```

## Documentation/devicetree/bindings/mmc/owl-mmc.yaml
```yaml
FASTVC-BENCH-CORPUS:linux-main-100k-v1-e0bd41dc-8e12-4f1b-978d-a3645ae59da0
# SPDX-License-Identifier: (GPL-2.0-only OR BSD-2-Clause)
%YAML 1.2
---
$id: http://devicetree.org/schemas/mmc/owl-mmc.yaml#
$schema: http://devicetree.org/meta-schemas/core.yaml#

title: Actions Semi Owl SoCs SD/MMC/SDIO controller

allOf:
  - $ref: "mmc-controller.yaml"

maintainers:
  - Manivannan Sadhasivam <manivannan.sadhasivam@linaro.org>

properties:
  compatible:
    oneOf:
      - const: actions,owl-mmc
      - items:
          - enum:
              - actions,s500-mmc
              - actions,s700-mmc
          - const: actions,owl-mmc

  reg:
    maxItems: 1

  interrupts:
    maxItems: 1

  clocks:
    minItems: 1

  resets:
    maxItems: 1

  dmas:
    maxItems: 1

  dma-names:
    const: mmc

required:
  - compatible
  - reg
  - interrupts
  - clocks
  - resets
  - dmas
  - dma-names

unevaluatedProperties: false

examples:
  - |
    mmc0: mmc@e0330000 {
        compatible = "actions,owl-mmc";
        reg = <0xe0330000 0x4000>;
        interrupts = <0 42 4>;
        clocks = <&cmu 56>;
/* bench 6284.0.0 6908787a3354 */
/* bench 6284.0.1 d3b4d884e7a2 */
/* bench 6284.0.2 a6a931f19044 */
/* bench 6284.0.3 1fb79570e85b */
/* bench 6284.0.4 77ffb52cb5d7 */
/* bench 6284.0.5 34ef367d3e02 */
/* bench 6284.0.6 31e3943fe039 */
/* bench 6284.0.7 90900af4fc86 */
/* bench 6284.0.8 03675dd23115 */
/* bench 6284.0.9 8ba7fafeffb4 */
/* bench 6284.0.10 171d5a1210a4 */
/* bench 20027.0.0 460e1886962f */
/* bench 20027.0.1 fa7a9310d001 */
/* bench 20027.0.2 b3fec354cfb3 */
/* bench 20027.0.3 7c43db7e4f47 */
/* bench 20027.0.4 4de9c0efeda3 */
/* bench 20027.0.5 bff652850ceb */
/* bench 20027.0.6 935a30169e42 */
/* bench 20027.0.7 6942f4e70cb1 */
        dmas = <&dma 2>;
        dma-names = "mmc";
        bus-width = <4>;
    };

...
```
