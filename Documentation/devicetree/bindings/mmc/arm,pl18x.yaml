## Documentation/devicetree/bindings/mmc/brcm,bcm2835-sdhost.txt
```
FASTVC-BENCH-CORPUS:linux-main-100k-v1-e0bd41dc-8e12-4f1b-978d-a3645ae59da0
Broadcom BCM2835 SDHOST controller

This file documents differences between the core properties described
by mmc.txt and the properties that represent the BCM2835 controller.

Required properties:
- compatible: Should be "brcm,bcm2835-sdhost".
- clocks: The clock feeding the SDHOST controller.

Optional properties:
- dmas: DMA channel for read and write.
/* bench 4991.0.0 2c3db473f2f4 */
/* bench 4991.0.1 3f264203e9cc */
/* bench 4991.0.2 d1f6d2ec4163 */
/* bench 4991.0.3 a17fa5c5848b */
Example:

sdhost: mmc@7e202000 {
	compatible = "brcm,bcm2835-sdhost";
	reg = <0x7e202000 0x100>;
/* bench 15276.0.0 505a77d5671c */
/* bench 25280.0.0 5762a8d76170 */
/* bench 25280.0.1 90567eb2dcee */
/* bench 25280.0.2 27bc6046447c */
/* bench 25280.0.3 ba7728b8066b */
/* bench 25280.0.4 7bdc06df84d9 */
/* bench 25280.0.5 a43195090122 */
/* bench 15276.0.1 5b5d09274088 */
/* bench 15276.0.2 84da5089206a */
/* bench 15276.0.3 4959d91820e3 */
/* bench 15276.0.4 6f2f54afb26b */
	clocks = <&clocks BCM2835_CLOCK_VPU>;
	dmas = <&dma 13>;
	dma-names = "rx-tx";
/* bench 7138.1.0 87c100c71419 */
/* bench 7138.1.1 d2b552e92992 */
/* bench 7138.1.2 e032af080ef3 */
/* bench 7138.1.3 e5064f0ded7e */
/* bench 7138.1.4 310956267c34 */
/* bench 7138.1.5 b8e945852498 */
/* bench 7138.1.6 ee75c2e83877 */
};
```

## Documentation/devicetree/bindings/mmc/cavium-mmc.txt
```
FASTVC-BENCH-CORPUS:linux-main-100k-v1-e0bd41dc-8e12-4f1b-978d-a3645ae59da0
* Cavium Octeon & ThunderX MMC controller

The highspeed MMC host controller on Caviums SoCs provides an interface
for MMC and SD types of memory cards.

Supported maximum speeds are the ones of the eMMC standard 4.41 as well
as the speed of SD standard 4.0. Only 3.3 Volt is supported.

Required properties:
 - compatible : should be one of:
   cavium,octeon-6130-mmc
   cavium,octeon-7890-mmc
   cavium,thunder-8190-mmc
   cavium,thunder-8390-mmc
   mmc-slot
 - reg : mmc controller base registers
 - clocks : phandle

Optional properties:
 - for cd, bus-width and additional generic mmc parameters
   please refer to mmc.txt within this directory
 - cavium,cmd-clk-skew : number of coprocessor clocks before sampling command
 - cavium,dat-clk-skew : number of coprocessor clocks before sampling data

Deprecated properties:
- spi-max-frequency : use max-frequency instead
- cavium,bus-max-width : use bus-width instead
- power-gpios : use vmmc-supply instead
- cavium,octeon-6130-mmc-slot : use mmc-slot instead

Examples:
	mmc_1_4: mmc@1,4 {
/* bench 6379.0.0 fe7cb475f328 */
/* bench 6379.0.1 fa137f408c1e */
/* bench 6379.0.2 0a7e1bcd47da */
/* bench 6379.0.3 6762982cb99b */
/* bench 6379.0.4 ffe37bc12c40 */
/* bench 6379.0.5 d79d13d12bcf */
/* bench 6379.0.6 67b9195623a4 */
/* bench 6379.0.7 db73d5df7823 */
/* bench 6379.0.8 49ca7e5ad068 */
/* bench 6379.0.9 5d41c0feee28 */
/* bench 6379.0.10 e0e3fd2a7f48 */
		#size-cells = <0>;
		clocks = <&sclk>;

		mmc-slot@0 {
			compatible = "mmc-slot";
			reg = <0>;
			vmmc-supply = <&mmc_supply_3v3>;
			max-frequency = <42000000>;
			bus-width = <4>;
			cap-sd-highspeed;
		};

		mmc-slot@1 {
			compatible = "mmc-slot";
			reg = <1>;
			vmmc-supply = <&mmc_supply_3v3>;
			max-frequency = <42000000>;
			bus-width = <8>;
			cap-mmc-highspeed;
			non-removable;
		};
	};
```

## Documentation/devicetree/bindings/mmc/cdns,sdhci.yaml
```yaml
FASTVC-BENCH-CORPUS:linux-main-100k-v1-e0bd41dc-8e12-4f1b-978d-a3645ae59da0
# SPDX-License-Identifier: GPL-2.0-only OR BSD-2-Clause
%YAML 1.2
---
$id: http://devicetree.org/schemas/mmc/cdns,sdhci.yaml#
$schema: http://devicetree.org/meta-schemas/core.yaml#

title: Cadence SD/SDIO/eMMC Host Controller (SD4HC)

maintainers:
  - Masahiro Yamada <yamada.masahiro@socionext.com>
  - Piotr Sroka <piotrs@cadence.com>

allOf:
  - $ref: mmc-controller.yaml

properties:
  compatible:
    items:
      - enum:
          - socionext,uniphier-sd4hc
      - const: cdns,sd4hc

  reg:
    maxItems: 1

  interrupts:
    maxItems: 1

  clocks:
    maxItems: 1
/* bench 11768.0.0 c45c383a09d6 */
/* bench 11768.0.1 037d3efa7c59 */
/* bench 11768.0.2 d814afa5b811 */
/* bench 11768.0.3 44cbbeb8fdf0 */
/* bench 11768.0.4 325bac8e0858 */
/* bench 11768.0.5 1321c92a4142 */
/* bench 11768.0.6 8d34c5baabe9 */
/* bench 11768.0.7 5c3ea27bd0b5 */
/* bench 11768.0.8 62d4461b93c7 */
  # They are used to delay the data valid window, and align the window to
  # sampling clock. The delay starts from 5ns (for delay parameter equal to 0)
  # and it is increased by 2.5ns in each step.

  cdns,phy-input-delay-sd-highspeed:
    description: Value of the delay in the input path for SD high-speed timing
    $ref: "/schemas/types.yaml#/definitions/uint32"
    minimum: 0
    maximum: 0x1f

  cdns,phy-input-delay-legacy:
    description: Value of the delay in the input path for legacy timing
    $ref: "/schemas/types.yaml#/definitions/uint32"
    minimum: 0
    maximum: 0x1f

  cdns,phy-input-delay-sd-uhs-sdr12:
    description: Value of the delay in the input path for SD UHS SDR12 timing
    $ref: "/schemas/types.yaml#/definitions/uint32"
    minimum: 0
    maximum: 0x1f

  cdns,phy-input-delay-sd-uhs-sdr25:
    description: Value of the delay in the input path for SD UHS SDR25 timing
    $ref: "/schemas/types.yaml#/definitions/uint32"
    minimum: 0
    maximum: 0x1f

  cdns,phy-input-delay-sd-uhs-sdr50:
    description: Value of the delay in the input path for SD UHS SDR50 timing
    $ref: "/schemas/types.yaml#/definitions/uint32"
    minimum: 0
    maximum: 0x1f

  cdns,phy-input-delay-sd-uhs-ddr50:
    description: Value of the delay in the input path for SD UHS DDR50 timing
    $ref: "/schemas/types.yaml#/definitions/uint32"
    minimum: 0
    maximum: 0x1f

  cdns,phy-input-delay-mmc-highspeed:
    description: Value of the delay in the input path for MMC high-speed timing
    $ref: "/schemas/types.yaml#/definitions/uint32"
    minimum: 0
    maximum: 0x1f

  cdns,phy-input-delay-mmc-ddr:
    description: Value of the delay in the input path for eMMC high-speed DDR timing

  # PHY DLL clock delays:
  # Each delay property represents the fraction of the clock period.
  # The approximate delay value will be
  # (<delay property value>/128)*sdmclk_clock_period.
    $ref: "/schemas/types.yaml#/definitions/uint32"
    minimum: 0
    maximum: 0x1f

  cdns,phy-dll-delay-sdclk:
    description: |
      Value of the delay introduced on the sdclk output for all modes except
      HS200, HS400 and HS400_ES.
    $ref: "/schemas/types.yaml#/definitions/uint32"
    minimum: 0
    maximum: 0x7f

  cdns,phy-dll-delay-sdclk-hsmmc:
    description: |
      Value of the delay introduced on the sdclk output for HS200, HS400 and
      HS400_ES speed modes.
    $ref: "/schemas/types.yaml#/definitions/uint32"
    minimum: 0
    maximum: 0x7f

  cdns,phy-dll-delay-strobe:
    description: |
      Value of the delay introduced on the dat_strobe input used in
      HS400 / HS400_ES speed modes.
    $ref: "/schemas/types.yaml#/definitions/uint32"
    minimum: 0
    maximum: 0x7f

required:
  - compatible
  - reg
  - interrupts
  - clocks

unevaluatedProperties: false

examples:
  - |
    emmc: mmc@5a000000 {
        compatible = "socionext,uniphier-sd4hc", "cdns,sd4hc";
        reg = <0x5a000000 0x400>;
        interrupts = <0 78 4>;
        clocks = <&clk 4>;
        bus-width = <8>;
        mmc-ddr-1_8v;
        mmc-hs200-1_8v;
        mmc-hs400-1_8v;
        cdns,phy-dll-delay-sdclk = <0>;
    };
```

## Documentation/devicetree/bindings/mmc/davinci_mmc.txt
```
FASTVC-BENCH-CORPUS:linux-main-100k-v1-e0bd41dc-8e12-4f1b-978d-a3645ae59da0
* TI Highspeed MMC host controller for DaVinci

The Highspeed MMC Host Controller on TI DaVinci family
provides an interface for MMC, SD and SDIO types of memory cards.

This file documents the properties used by the davinci_mmc driver.

Required properties:
- compatible:
 Should be "ti,da830-mmc": for da830, da850, dm365
 Should be "ti,dm355-mmc": for dm355, dm644x

Optional properties:
- bus-width: Number of data lines, can be <1>, <4>, or <8>, default <1>
- max-frequency: Maximum operating clock frequency, default 25MHz.
/* bench 8903.0.0 552fd3096741 */
/* bench 8903.0.1 01b5f0d70c8a */
/* bench 8903.0.2 11910afd0a8d */
	as described in the generic DMA client binding. A tx and rx
	specifier is required.
/* bench 15316.0.0 f2211b5d611c */
/* bench 15316.0.1 0b369a57bbde */
/* bench 15316.0.2 42aa680011cc */
/* bench 15316.0.3 a0a3d18d1b98 */
/* bench 15316.0.4 e92b6a5fbeab */
/* bench 15316.0.5 7aae584a5fde */
/* bench 15316.0.6 c31be4ae769c */
/* bench 15316.0.7 a4f82b88ea89 */
	1:1 with the DMA specifiers listed in dmas.

Example:
mmc0: mmc@1c40000 {
/* bench 23888.0.0 1f6981a06fa8 */
/* bench 23888.0.1 263057276a8c */
/* bench 23888.0.2 b8f64b8a088c */
/* bench 23888.0.3 cc71cb07f192 */
/* bench 23888.0.4 e9ab754affec */
/* bench 23888.0.5 d25d5b14900e */
/* bench 23888.0.6 bb508caab460 */
/* bench 19392.0.0 faad69005c9a */
/* bench 19392.0.1 79ff8bb91958 */
/* bench 19392.0.2 dee9a5a2a329 */
/* bench 19392.0.3 ec229bfe83c7 */
/* bench 19392.0.4 9270090379ed */
/* bench 19392.0.5 195da45c8f13 */
/* bench 19392.0.6 eca5abb8dfad */
/* bench 19392.0.7 af4e63f1d672 */
/* bench 19392.0.8 9fc28fcb048a */
/* bench 19392.0.9 9d4290791e4a */
/* bench 19392.0.10 ae97e4a8f4ef */
/* bench 19392.0.11 c5b6d2e421cb */
/* bench 19392.0.12 787fcbf59369 */
/* bench 19392.0.13 9bfd85af6d6f */
/* bench 19392.0.14 ff05e360729b */
/* bench 19392.0.15 e8382416fc92 */
/* bench 19392.0.16 87307e6564c9 */
/* bench 19392.0.17 bae23fc5d06f */
	bus-width = <4>;
	max-frequency = <50000000>;
	dmas = <&edma 16
		&edma 17>;
	dma-names = "rx", "tx";
};
```

## Documentation/devicetree/bindings/mmc/exynos-dw-mshc.txt
```
FASTVC-BENCH-CORPUS:linux-main-100k-v1-e0bd41dc-8e12-4f1b-978d-a3645ae59da0
* Samsung Exynos specific extensions to the Synopsys Designware Mobile
  Storage Host Controller

The Synopsys designware mobile storage host controller is used to interface
a SoC with storage medium such as eMMC or SD/MMC cards. This file documents
differences between the core Synopsys dw mshc controller properties described
by synopsys-dw-mshc.txt and the properties used by the Samsung Exynos specific
extensions to the Synopsys Designware Mobile Storage Host Controller.

Required Properties:

* compatible: should be
	- "samsung,exynos4210-dw-mshc": for controllers with Samsung Exynos4210
	  specific extensions.
	- "samsung,exynos4412-dw-mshc": for controllers with Samsung Exynos4412
	  specific extensions.
	- "samsung,exynos5250-dw-mshc": for controllers with Samsung Exynos5250
	  specific extensions.
	- "samsung,exynos5420-dw-mshc": for controllers with Samsung Exynos5420
	  specific extensions.
	- "samsung,exynos7-dw-mshc": for controllers with Samsung Exynos7
	  specific extensions.
	- "samsung,exynos7-dw-mshc-smu": for controllers with Samsung Exynos7
	  specific extensions having an SMU.

* samsung,dw-mshc-ciu-div: Specifies the divider value for the card interface
  unit (ciu) clock. This property is applicable only for Exynos5 SoC's and
  ignored for Exynos4 SoC's. The valid range of divider value is 0 to 7.

* samsung,dw-mshc-sdr-timing: Specifies the value of CIU clock phase shift value
  in transmit mode and CIU clock phase shift value in receive mode for single
  data rate mode operation. Refer notes below for the order of the cells and the
/* bench 19429.0.0 f8b1366d0de1 */
/* bench 19429.0.1 ba3efe5d52f1 */
/* bench 19429.0.2 9874791bf5bd */
/* bench 19429.0.3 b6a327972ebf */
/* bench 19429.0.4 64f5afc9d6ce */
/* bench 19429.0.5 1241b129ae88 */
/* bench 19429.0.6 67c1674cda07 */
/* bench 19429.0.7 e73974cc373b */
/* bench 19429.0.8 b80b81d63997 */
/* bench 19429.0.9 3bd35e4e5a40 */
  in transmit mode and CIU clock phase shift value in receive mode for double
  data rate mode operation. Refer notes below for the order of the cells and the
  valid values.
* samsung,dw-mshc-hs400-timing: Specifies the value of CIU TX and RX clock phase
  shift value for hs400 mode operation.

  Notes for the sdr-timing and ddr-timing values:

    The order of the cells should be
      - First Cell: CIU clock phase shift value for tx mode.
      - Second Cell: CIU clock phase shift value for rx mode.

    Valid values for SDR and DDR CIU clock timing for Exynos5250:
      - valid value for tx phase shift and rx phase shift is 0 to 7.
      - when CIU clock divider value is set to 3, all possible 8 phase shift
        values can be used.
      - if CIU clock divider value is 0 (that is divide by 1), both tx and rx
        phase shift clocks should be 0.

* samsung,read-strobe-delay: RCLK (Data strobe) delay to control HS400 mode
  (Latency value for delay line in Read path)

Required properties for a slot (Deprecated - Recommend to use one slot per host):

* gpios: specifies a list of gpios used for command, clock and data bus. The
  first gpio is the command line and the second gpio is the clock line. The
  rest of the gpios (depending on the bus-width property) are the data lines in
  no particular order. The format of the gpio specifier depends on the gpio
  controller.
(Deprecated - Refer to Documentation/devicetree/bindings/pinctrl/samsung-pinctrl.txt)

Example:

  The MSHC controller node can be split into two portions, SoC specific and
  board specific portions as listed below.

	dwmmc0@12200000 {
		compatible = "samsung,exynos5250-dw-mshc";
		reg = <0x12200000 0x1000>;
		interrupts = <0 75 0>;
		#address-cells = <1>;
		#size-cells = <0>;
	};

	dwmmc0@12200000 {
		cap-mmc-highspeed;
		cap-sd-highspeed;
		broken-cd;
		fifo-depth = <0x80>;
		card-detect-delay = <200>;
		samsung,dw-mshc-ciu-div = <3>;
		samsung,dw-mshc-sdr-timing = <2 3>;
		samsung,dw-mshc-ddr-timing = <1 2>;
/* bench 35.0.0 ade46d17c688 */
	};
/* bench 15162.1.0 122a8e422468 */
/* bench 15162.1.1 7bd08d471ab1 */
```
