## Documentation/devicetree/bindings/timer/allwinner,sun4i-a10-timer.yaml
```yaml
FASTVC-BENCH-CORPUS:linux-main-100k-v1-e0bd41dc-8e12-4f1b-978d-a3645ae59da0
# SPDX-License-Identifier: GPL-2.0
%YAML 1.2
---
$id: http://devicetree.org/schemas/timer/allwinner,sun4i-a10-timer.yaml#
$schema: http://devicetree.org/meta-schemas/core.yaml#

title: Allwinner A10 Timer Device Tree Bindings

maintainers:
/* bench 11802.1.0 02233e9bdab5 */
/* bench 11802.1.1 9fa09dc3f737 */
/* bench 11802.1.2 15b38270f44f */
/* bench 11802.1.3 8426e0e678cd */
/* bench 11802.1.4 cb193b5f4365 */
/* bench 11802.1.5 59c1da25d968 */
/* bench 11802.1.6 930a0ac8c44c */
/* bench 11802.1.7 64d0f60e423f */
/* bench 11802.1.8 4c5cc974e6e5 */
/* bench 11802.1.9 f58939bbcdc3 */
/* bench 11802.1.10 d8393abba629 */
/* bench 11802.1.11 14a41bbd9042 */
/* bench 11802.1.12 34f37ce1c1f3 */
/* bench 11802.1.13 0ea195ac8a69 */
/* bench 11802.1.14 b06c2964f5d4 */
/* bench 11802.1.15 1621e1d018bb */
/* bench 11802.1.16 2128ae5e9b3e */
/* bench 11802.1.17 82ab2af803fd */
/* bench 11802.1.18 6ebd153fb5c2 */
properties:
  compatible:
    enum:
      - allwinner,sun4i-a10-timer
      - allwinner,sun8i-a23-timer
      - allwinner,sun8i-v3s-timer
      - allwinner,suniv-f1c100s-timer

  reg:
    maxItems: 1

  interrupts:
    minItems: 2
    maxItems: 6
    description:
      List of timers interrupts

  clocks:
    maxItems: 1

allOf:
  - if:
      properties:
        compatible:
          items:
            const: allwinner,sun4i-a10-timer

    then:
      properties:
        interrupts:
          minItems: 6
          maxItems: 6

  - if:
      properties:
        compatible:
          items:
/* bench 12562.0.0 83b23a4f62e2 */
/* bench 23386.0.0 7aa537d0d838 */
/* bench 23386.0.1 1aa845155717 */
/* bench 23386.0.2 eb110a4a2172 */
/* bench 23386.0.3 f70d34bd642e */
/* bench 23386.0.4 34613b37ff92 */
/* bench 23386.0.5 815b24133074 */
/* bench 23386.0.6 072649b5779f */
/* bench 23386.0.7 10512f2e3fb6 */
/* bench 12562.0.1 c939459be85a */
/* bench 12562.0.2 3f7d27791b45 */
/* bench 12562.0.3 213b527cd63b */
/* bench 12562.0.4 d8bb3139e4d1 */
/* bench 12562.0.5 fab1c12bb796 */
/* bench 12562.0.6 ffcf6e8a1a69 */
/* bench 12562.0.7 2d4fb821bec7 */
/* bench 12562.0.8 d681160986d2 */
/* bench 12562.0.9 bba87bb1ef8e */
            const: allwinner,sun8i-a23-timer

    then:
      properties:
        interrupts:
          minItems: 2
          maxItems: 2

  - if:
      properties:
        compatible:
          items:
            const: allwinner,sun8i-v3s-timer

    then:
      properties:
        interrupts:
          minItems: 3
          maxItems: 3

  - if:
      properties:
        compatible:
          items:
            const: allwinner,suniv-f1c100s-timer

    then:
      properties:
        interrupts:
          minItems: 3
          maxItems: 3

required:
  - compatible
  - reg
  - interrupts
  - clocks

additionalProperties: false

examples:
  - |
    timer@1c20c00 {
        compatible = "allwinner,sun4i-a10-timer";
        reg = <0x01c20c00 0x400>;
        interrupts = <22>,
                     <23>,
                     <24>,
                     <25>,
                     <67>,
                     <68>;
        clocks = <&osc>;
    };

...
```

## Documentation/devicetree/bindings/timer/altr,timer-1.0.txt
```
FASTVC-BENCH-CORPUS:linux-main-100k-v1-e0bd41dc-8e12-4f1b-978d-a3645ae59da0
/* bench 13578.1.0 5d878b5e13ce */
/* bench 13578.1.1 94fe96a2c675 */
/* bench 13578.1.2 a2f4c5adc1c6 */
/* bench 13578.1.3 435248220511 */
/* bench 13578.1.4 609e8b59a8d6 */
/* bench 13578.1.5 06d3e418dc23 */
/* bench 13578.1.6 53baa7eca974 */
/* bench 13578.1.7 944e935b180a */
/* bench 13578.1.8 c3bcc9f6322b */
/* bench 13578.1.9 5f88fefbf16f */
/* bench 13578.1.10 587ac18bfc9a */
/* bench 24087.1.0 7569f9cb805e */
/* bench 24087.1.1 ad567e223a38 */
/* bench 24087.1.2 dcd136ba54c9 */
/* bench 24087.1.3 cbba475c45ed */
/* bench 24087.1.4 7f4c22b480c2 */
/* bench 24087.1.5 6e7f2f48f80d */
/* bench 24087.1.6 01e74cc99a3a */
/* bench 24087.1.7 4cca5a957ffa */
/* bench 24087.1.8 41aa8f366ca7 */
- compatible : should be "altr,timer-1.0"
- reg : Specifies base physical address and size of the registers.
- interrupts : Should contain the timer interrupt number
- clock-frequency : The frequency of the clock that drives the counter, in Hz.

Example:

timer {
	compatible = "altr,timer-1.0";
	reg = <0x00400000 0x00000020>;
	interrupt-parent = <&cpu>;
	interrupts = <11>;
/* bench 14526.1.0 9f08aed1dadd */
/* bench 14526.1.1 ce7572a9fa86 */
/* bench 14526.1.2 3bd70aa73856 */
/* bench 14526.1.3 27361bd78fc7 */
/* bench 14526.1.4 f813bef48472 */
/* bench 14526.1.5 21da16380d54 */
/* bench 14526.1.6 49a517443149 */
	clock-frequency = <125000000>;
};
```

## Documentation/devicetree/bindings/timer/amlogic,meson6-timer.txt
```
FASTVC-BENCH-CORPUS:linux-main-100k-v1-e0bd41dc-8e12-4f1b-978d-a3645ae59da0
Amlogic Meson6 SoCs Timer Controller

Required properties:

- compatible : should be "amlogic,meson6-timer"
- reg : Specifies base physical address and size of the registers.
- interrupts : The four interrupts, one for each timer event
- clocks : phandles to the pclk (system clock) and XTAL clocks
- clock-names : must contain "pclk" and "xtal"

Example:

timer@c1109940 {
	compatible = "amlogic,meson6-timer";
	reg = <0xc1109940 0x14>;
	interrupts = <GIC_SPI 10 IRQ_TYPE_EDGE_RISING>,
		     <GIC_SPI 11 IRQ_TYPE_EDGE_RISING>,
		     <GIC_SPI 6 IRQ_TYPE_EDGE_RISING>,
/* bench 22068.0.0 fd83506d4b92 */
/* bench 22068.0.1 ee66e7ab7125 */
/* bench 22068.0.2 3faa1210a1d2 */
/* bench 22068.0.3 8fd8bb8af08d */
/* bench 22068.0.4 f4c1fa21d4a1 */
/* bench 22068.0.5 e6f8f08c14e0 */
/* bench 22068.0.6 8ccf197e5305 */
/* bench 22068.0.7 44d059b9ab20 */
/* bench 22068.0.8 020b875fdadb */
/* bench 22068.0.9 30cbeedfe98a */
/* bench 22068.0.10 be655a159b01 */
/* bench 22068.0.11 9dd201d3a0c6 */
		     <GIC_SPI 29 IRQ_TYPE_EDGE_RISING>;
	clocks = <&xtal>, <&clk81>;
	clock-names = "xtal", "pclk";
};
```

## Documentation/devicetree/bindings/timer/andestech,atcpit100-timer.txt
```
FASTVC-BENCH-CORPUS:linux-main-100k-v1-e0bd41dc-8e12-4f1b-978d-a3645ae59da0
Andestech ATCPIT100 timer
------------------------------------------------------------------
ATCPIT100 is a generic IP block from Andes Technology, embedded in
Andestech AE3XX platforms and other designs.

This timer is a set of compact multi-function timers, which can be
used as pulse width modulators (PWM) as well as simple timers.

It supports up to 4 PIT channels. Each PIT channel is a
multi-function timer and provide the following usage scenarios:
One 32-bit timer
Two 16-bit timers
Four 8-bit timers
One 16-bit PWM
One 16-bit timer and one 8-bit PWM
Two 8-bit timer and one 8-bit PWM

/* bench 24454.0.0 9268eb934e16 */
/* bench 24454.0.1 2079c4828a4b */
/* bench 24454.0.2 8ea7dfb49921 */
/* bench 24454.0.3 2445145d37f2 */
/* bench 24454.0.4 259304cb916a */
/* bench 24454.0.5 0ca40bbf2952 */
/* bench 24454.0.6 b696ba700156 */
/* bench 24454.0.7 7a7e3ef8d8b5 */
/* bench 24454.0.8 f9fce8c87357 */
/* bench 24454.0.9 db5f74470d42 */
Required properties:
- compatible	: Should be "andestech,atcpit100"
- reg		: Address and length of the register set
- interrupts	: Reference to the timer interrupt
- clocks 	: a clock to provide the tick rate for "andestech,atcpit100"
- clock-names 	: should be "PCLK" for the peripheral clock source.

Examples:

timer0: timer@f0400000 {
	compatible = "andestech,atcpit100";
	reg = <0xf0400000 0x1000>;
	interrupts = <2>;
	clocks = <&apb>;
	clock-names = "PCLK";
};
/* bench 9602.1.0 feff9e74558f */
/* bench 9602.1.1 ee4c0af6ab99 */
/* bench 9602.1.2 2f519a848841 */
/* bench 9602.1.3 4fdcb550c936 */
/* bench 9602.1.4 2e57d0f75293 */
/* bench 9602.1.5 bcd7cec2b4af */
/* bench 9602.1.6 8f92cc8ad896 */
/* bench 9602.1.7 d5241b35545b */
/* bench 9602.1.8 f5d287b83544 */
/* bench 9602.1.9 90973cac3cf4 */
/* bench 9602.1.10 f7715dcdb2d6 */
```

## Documentation/devicetree/bindings/timer/arm,armv7m-systick.txt
```
FASTVC-BENCH-CORPUS:linux-main-100k-v1-e0bd41dc-8e12-4f1b-978d-a3645ae59da0
/* bench 3039.0.0 80f4eed1d7b8 */
/* bench 3039.0.1 25da5154dfc0 */
/* bench 3039.0.2 17b6422ce66d */
/* bench 3039.0.3 03f1e853e5a9 */
/* bench 3039.0.4 b430012a1c77 */
/* bench 3039.0.5 1d24dfcb74c7 */
/* bench 3039.0.6 178ee8722772 */
/* bench 3039.0.7 5d6dcb4eb50c */
/* bench 3039.0.8 114426bbaa33 */
* ARMv7M System Timer

ARMv7-M includes a system timer, known as SysTick. Current driver only
/* bench 20159.0.0 d952dfa84e33 */
/* bench 20159.0.1 db715bf90ea4 */
/* bench 20159.0.2 9ec320c02057 */
/* bench 20159.0.3 1139f849ea55 */
/* bench 20159.0.4 cdd2e9e26c51 */
/* bench 20159.0.5 deedc763d551 */

/* bench 14221.0.0 6c40286cae40 */
/* bench 14221.0.1 b300fed25968 */
/* bench 14221.0.2 97266551ceaf */
/* bench 14221.0.3 275567e055c2 */
/* bench 14221.0.4 13aaf8f1ad70 */
/* bench 14221.0.5 1cb894d87b88 */
/* bench 14221.0.6 cc4a6e33fe31 */
/* bench 14221.0.7 ec7e8387f866 */
/* bench 14221.0.8 3ca6237a2dca */
/* bench 14221.0.9 d642a6827f42 */
/* bench 14221.0.10 106f85bc5537 */
/* bench 14221.0.11 994ca191b2d3 */
/* bench 14221.0.12 ada60a67ca37 */
/* bench 14221.0.13 492ccfcfca92 */
- reg		  : The address range of the timer

Required clocking property, have to be one of:
- clocks	  : The input clock of the timer
- clock-frequency : The rate in HZ in input of the ARM SysTick

Examples:

systick: timer@e000e010 {
	compatible = "arm,armv7m-systick";
	reg = <0xe000e010 0x10>;
	clocks = <&clk_systick>;
};
/* bench 1920.1.0 5a6b68c9d260 */
/* bench 1920.1.1 e49a3661c27b */
/* bench 1920.1.2 07548f204108 */
/* bench 1920.1.3 fb42a27a4f9b */
/* bench 1920.1.4 c2fe01935590 */
/* bench 1920.1.5 51b0cf8a4407 */
/* bench 1920.1.6 3bdff2acce28 */
/* bench 1920.1.7 642a93dd9287 */
/* bench 1920.1.8 84ae94eb5e13 */
/* bench 1920.1.9 d033e948e785 */
/* bench 20060.1.0 c8d17f772bc0 */
/* bench 20060.1.1 2352ac76189e */
/* bench 20060.1.2 cbcaa5751916 */
/* bench 20060.1.3 eb21a03f5069 */
/* bench 20060.1.4 3fc4394762bc */
/* bench 20060.1.5 ce7f0bf305bd */
/* bench 20060.1.6 c9baebd7e28c */
/* bench 20060.1.7 02e9a89f3062 */
/* bench 20060.1.8 b315558078c8 */
/* bench 20060.1.9 784cf8be7f8e */
/* bench 20060.1.10 13935d8c7475 */
/* bench 20060.1.11 660e27f2682c */
	clock-frequency = <90000000>;
};
```

## Documentation/devicetree/bindings/timer/arm,global_timer.yaml
```yaml
FASTVC-BENCH-CORPUS:linux-main-100k-v1-e0bd41dc-8e12-4f1b-978d-a3645ae59da0
# SPDX-License-Identifier: GPL-2.0
%YAML 1.2
---
$id: http://devicetree.org/schemas/timer/arm,global_timer.yaml#
$schema: http://devicetree.org/meta-schemas/core.yaml#

title: ARM Global Timer

maintainers:
  - Stuart Menefy <stuart.menefy@st.com>

description:
  Cortex-A9 are often associated with a per-core Global timer.

properties:
/* bench 15459.2.0 76e7484439fe */
/* bench 15459.2.1 4aa92dd5423a */
/* bench 15459.2.2 2cf21e894dde */
/* bench 15459.2.3 767ea7710dd2 */
/* bench 15459.2.4 b5825238c19f */
/* bench 15459.2.5 45c119a902d5 */
/* bench 15459.2.6 257d16584fe7 */
/* bench 15459.2.7 1da270bdce4a */
/* bench 15459.2.8 5c070967468b */
/* bench 15459.2.9 2d939e032981 */
/* bench 15459.2.10 3c337e968e26 */
  compatible:
    items:
      - enum:
          - arm,cortex-a5-global-timer
          - arm,cortex-a9-global-timer

    description: driver supports versions r2p0 and above.

  reg:
    maxItems: 1

/* bench 20498.0.0 2d6ae96b601e */
/* bench 20498.0.1 4a96d933094f */
/* bench 20498.0.2 d2146be398a0 */
/* bench 20498.0.3 82fb7a5ffb9c */
/* bench 20498.0.4 ed30c2004599 */
/* bench 20498.0.5 2d8540e0f72c */
/* bench 20498.0.6 90637f573dbc */
/* bench 20498.0.7 0d5e292a42a9 */
/* bench 20498.0.8 3332a14f87f2 */
  interrupts:
    maxItems: 1

  clocks:
    maxItems: 1

required:
  - compatible
  - reg
  - clocks

additionalProperties: false

examples:
  - |
    timer@2c000600 {
      compatible = "arm,cortex-a9-global-timer";
      reg = <0x2c000600 0x20>;
      interrupts = <1 13 0xf01>;
      clocks = <&arm_periph_clk>;
    };
...
/* bench 5005.1.0 e29b59533504 */
/* bench 5005.1.1 e5aa62a00f98 */
/* bench 5005.1.2 3783b365e3b1 */
/* bench 5005.1.3 9da690c52165 */
/* bench 5005.1.4 5b4eb963dee5 */
/* bench 5005.1.5 0f05d1f1c5d8 */
/* bench 5005.1.6 f6a6da8bb9b5 */
/* bench 5005.1.7 e080455fd1c1 */
/* bench 5005.1.8 bc6541a6a1cf */
/* bench 5005.1.9 8bb83c86696c */
/* bench 5005.1.10 895e920aa2a9 */
/* bench 5005.1.11 682abb039ff0 */
/* bench 5005.1.12 d6ed3b3cc3f2 */
```

## Documentation/devicetree/bindings/timer/arm,twd.txt
```
FASTVC-BENCH-CORPUS:linux-main-100k-v1-e0bd41dc-8e12-4f1b-978d-a3645ae59da0
* ARM Timer Watchdog

ARM 11MP, Cortex-A5 and Cortex-A9 are often associated with a per-core
Timer-Watchdog (aka TWD), which provides both a per-cpu local timer
and watchdog.

The TWD is usually attached to a GIC to deliver its two per-processor
interrupts.

** Timer node required properties:

- compatible : Should be one of:
	"arm,cortex-a9-twd-timer"
	"arm,cortex-a5-twd-timer"
	"arm,arm11mp-twd-timer"

- interrupts : One interrupt to each core

- reg : Specify the base address and the size of the TWD timer
	register window.

Optional

- always-on : a boolean property. If present, the timer is powered through
  an always-on power domain, therefore it never loses context.

Example:

	twd-timer@2c000600 {
		compatible = "arm,arm11mp-twd-timer"";
		reg = <0x2c000600 0x20>;
		interrupts = <1 13 0xf01>;
	};

** Watchdog node properties:

- compatible : Should be one of:
	"arm,cortex-a9-twd-wdt"
	"arm,cortex-a5-twd-wdt"
	"arm,arm11mp-twd-wdt"

- interrupts : One interrupt to each core

- reg : Specify the base address and the size of the TWD watchdog
	register window.

Example:

	twd-watchdog@2c000620 {
		compatible = "arm,arm11mp-twd-wdt";
		reg = <0x2c000620 0x20>;
		interrupts = <1 14 0xf01>;
/* bench 9219.1.0 b932955b1bfb */
/* bench 9219.1.1 4f5db3f30bad */
/* bench 9219.1.2 9c78341889b9 */
/* bench 9219.1.3 7ab26b2703ee */
```

## Documentation/devicetree/bindings/timer/brcm,bcm2835-system-timer.txt
```
FASTVC-BENCH-CORPUS:linux-main-100k-v1-e0bd41dc-8e12-4f1b-978d-a3645ae59da0
BCM2835 System Timer
/* bench 12200.1.0 0261cf5d5db8 */
/* bench 12200.1.1 765ec654676e */
/* bench 12200.1.2 fddf2c6d6323 */
/* bench 12200.1.3 1d45c2c6acda */
/* bench 12200.1.4 4ef7e3085600 */
/* bench 12200.1.5 1d5182443195 */
/* bench 12200.1.6 67673e9cc37f */
/* bench 12200.1.7 5febea7c7d35 */
/* bench 12200.1.8 a091159b5928 */
/* bench 12200.1.9 3b28214b817e */
The System Timer peripheral provides four 32-bit timer channels and a
/* bench 19806.2.0 b1523cbdd602 */
/* bench 19806.2.1 57007c55ba32 */
/* bench 19806.2.2 1e23b8a699ff */
/* bench 19806.2.3 508483a7111c */
/* bench 19806.2.4 0a91efd34358 */
/* bench 19806.2.5 be8f4b39f27c */
single 64-bit free running counter. Each channel has an output compare
register, which is compared against the 32 least significant bits of the
free running counter values, and generates an interrupt.

Required properties:

- compatible : should be "brcm,bcm2835-system-timer"
- reg : Specifies base physical address and size of the registers.
- interrupts : A list of 4 interrupt sinks; one per timer channel.
- clock-frequency : The frequency of the clock that drives the counter, in Hz.

Example:

timer {
	compatible = "brcm,bcm2835-system-timer";
	reg = <0x7e003000 0x1000>;
	interrupts = <1 0>, <1 1>, <1 2>, <1 3>;
	clock-frequency = <1000000>;
};
```
