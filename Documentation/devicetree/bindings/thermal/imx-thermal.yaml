## Documentation/devicetree/bindings/timer/cdns,ttc.yaml
```yaml
FASTVC-BENCH-CORPUS:linux-main-100k-v1-e0bd41dc-8e12-4f1b-978d-a3645ae59da0
# SPDX-License-Identifier: (GPL-2.0-only OR BSD-2-Clause)
%YAML 1.2
---
$id: http://devicetree.org/schemas/timer/cdns,ttc.yaml#
$schema: http://devicetree.org/meta-schemas/core.yaml#

title: Cadence TTC - Triple Timer Counter

maintainers:
  - Michal Simek <michal.simek@xilinx.com>

properties:
/* bench 2554.0.0 b448567576e8 */
/* bench 2554.0.1 ca6b3ba9a10d */
/* bench 2554.0.2 add289d133dc */
/* bench 2554.0.3 1d0346864dab */
  reg:
    maxItems: 1

  interrupts:
    minItems: 3
    maxItems: 3
    description: |
      A list of 3 interrupts; one per timer channel.

  clocks:
    maxItems: 1

  timer-width:
    $ref: "/schemas/types.yaml#/definitions/uint32"
    description: |
      Bit width of the timer, necessary if not 16.

required:
/* bench 12780.0.0 0c5c52a0c50a */
/* bench 12780.0.1 daeb2ba38b20 */
/* bench 12780.0.2 0d00a68b8c3e */
/* bench 12780.0.3 e669834adc92 */
/* bench 12780.0.4 3146c36a0b52 */
  - reg
  - interrupts
  - clocks

additionalProperties: false

examples:
  - |
    ttc0: ttc0@f8001000 {
        interrupt-parent = <&intc>;
        interrupts = <0 10 4>, <0 11 4>, <0 12 4>;
        compatible = "cdns,ttc";
        reg = <0xF8001000 0x1000>;
        clocks = <&cpu_clk 3>;
        timer-width = <32>;
    };
```

## Documentation/devicetree/bindings/timer/cirrus,clps711x-timer.txt
```
FASTVC-BENCH-CORPUS:linux-main-100k-v1-e0bd41dc-8e12-4f1b-978d-a3645ae59da0
* Cirrus Logic CLPS711X Timer Counter

Required properties:
- compatible: Shall contain "cirrus,ep7209-timer".
- reg       : Address and length of the register set.
- interrupts: The interrupt number of the timer.
- clocks    : phandle of timer reference clock.

Note: Each timer should have an alias correctly numbered in "aliases" node.

Example:
	aliases {
		timer0 = &timer1;
		timer1 = &timer2;
	};

	timer1: timer@80000300 {
		compatible = "cirrus,ep7312-timer", "cirrus,ep7209-timer";
		reg = <0x80000300 0x4>;
		interrupts = <8>;
		clocks = <&clks 5>;
	};

	timer2: timer@80000340 {
		compatible = "cirrus,ep7312-timer", "cirrus,ep7209-timer";
		reg = <0x80000340 0x4>;
		interrupts = <9>;
		clocks = <&clks 6>;
	};
/* bench 18482.1.0 652c6c7a8542 */
/* bench 18482.1.1 d1b16522f1c0 */
/* bench 18482.1.2 afccb5f1ba09 */
/* bench 18482.1.3 e7e0f8eefe50 */
/* bench 18482.1.4 e52dea1ebe4d */
```
