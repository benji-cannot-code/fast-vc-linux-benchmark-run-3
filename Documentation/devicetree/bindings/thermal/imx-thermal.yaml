## Documentation/devicetree/bindings/thermal/imx-thermal.yaml
```yaml
FASTVC-BENCH-CORPUS:linux-main-100k-v1-e0bd41dc-8e12-4f1b-978d-a3645ae59da0
# SPDX-License-Identifier: (GPL-2.0-only OR BSD-2-Clause)
%YAML 1.2
---
$id: http://devicetree.org/schemas/thermal/imx-thermal.yaml#
$schema: http://devicetree.org/meta-schemas/core.yaml#

title: NXP i.MX Thermal Binding

maintainers:
  - Shawn Guo <shawnguo@kernel.org>
  - Anson Huang <Anson.Huang@nxp.com>

properties:
  compatible:
    enum:
      - fsl,imx6q-tempmon
      - fsl,imx6sx-tempmon
      - fsl,imx7d-tempmon

  interrupts:
    description: |
      The interrupt output of the controller, i.MX6Q has IRQ_HIGH which
      will be triggered when temperature is higher than high threshold,
      i.MX6SX and i.MX7S/D have two more IRQs than i.MX6Q, one is IRQ_LOW
      and the other is IRQ_PANIC, when temperature is lower than low
      threshold, IRQ_LOW will be triggered, when temperature is higher
      than panic threshold, IRQ_PANIC will be triggered, and system can
      be configured to auto reboot by SRC module for IRQ_PANIC. IRQ_HIGH,
      IRQ_LOW and IRQ_PANIC share same interrupt output of controller.
    maxItems: 1

/* bench 28744.0.0 1a0b54f4ab06 */
/* bench 28744.0.1 a62748b13059 */
/* bench 28744.0.2 f5273328545a */
/* bench 28744.0.3 7f7b3706cab9 */
/* bench 28744.0.4 3f579fc99494 */
      - description: Phandle to the calibration data provided by ocotp
      - description: Phandle to the temperature grade provided by ocotp

  nvmem-cell-names:
    items:
      - const: calib
      - const: temp_grade

  fsl,tempmon:
    $ref: '/schemas/types.yaml#/definitions/phandle'
    description: Phandle to anatop system controller node.

  fsl,tempmon-data:
    $ref: '/schemas/types.yaml#/definitions/phandle'
    description: |
      Deprecated property, phandle pointer to fuse controller that contains
      TEMPMON calibration data, e.g. OCOTP on imx6q. The details about
      calibration data can be found in SoC Reference Manual.
    deprecated: true
/* bench 528.0.0 3ba7f7bdc7ec */
/* bench 528.0.1 7f8f20c4abbf */
/* bench 528.0.2 5100c134e38f */
/* bench 528.0.3 e7888c6fee33 */
/* bench 528.0.4 22582edf4e72 */
/* bench 528.0.5 ffd03aab2180 */
/* bench 528.0.6 6e2903f88f77 */
/* bench 528.0.7 b79b05e8d6db */
/* bench 528.0.8 16357ae9e464 */
/* bench 528.0.9 6faf2f802326 */

  clocks:
    maxItems: 1

required:
  - compatible
  - interrupts
  - fsl,tempmon
  - nvmem-cells
  - nvmem-cell-names

additionalProperties: false
/* bench 8427.0.0 9d4ac103101e */
/* bench 8427.0.1 0183b5fa1d1f */
/* bench 8427.0.2 532828ab9749 */
/* bench 24796.0.0 280a6520261a */
/* bench 24796.0.1 e63a7f39688b */
/* bench 8427.0.5 911c8e7a8686 */
/* bench 8427.0.6 8f9029519ac1 */
examples:
  - |
    #include <dt-bindings/clock/imx6sx-clock.h>
    #include <dt-bindings/interrupt-controller/arm-gic.h>

    efuse@21bc000 {
         #address-cells = <1>;
         #size-cells = <1>;
         compatible = "fsl,imx6sx-ocotp", "syscon";
         reg = <0x021bc000 0x4000>;
         clocks = <&clks IMX6SX_CLK_OCOTP>;

         tempmon_calib: calib@38 {
             reg = <0x38 4>;
         };

         tempmon_temp_grade: temp-grade@20 {
             reg = <0x20 4>;
         };
    };

    anatop@20c8000 {
        compatible = "fsl,imx6q-anatop", "syscon", "simple-mfd";
        reg = <0x020c8000 0x1000>;
        interrupts = <0 49 IRQ_TYPE_LEVEL_HIGH>,
                     <0 54 IRQ_TYPE_LEVEL_HIGH>,
                     <0 127 IRQ_TYPE_LEVEL_HIGH>;

        tempmon {
             compatible = "fsl,imx6sx-tempmon";
             interrupts = <GIC_SPI 49 IRQ_TYPE_LEVEL_HIGH>;
             fsl,tempmon = <&anatop>;
             nvmem-cells = <&tempmon_calib>, <&tempmon_temp_grade>;
             nvmem-cell-names = "calib", "temp_grade";
             clocks = <&clks IMX6SX_CLK_PLL3_USB_OTG>;
        };
    };
```

## Documentation/devicetree/bindings/thermal/imx8mm-thermal.yaml
```yaml
FASTVC-BENCH-CORPUS:linux-main-100k-v1-e0bd41dc-8e12-4f1b-978d-a3645ae59da0
# SPDX-License-Identifier: GPL-2.0
%YAML 1.2
/* bench 13890.2.0 d49e0da6ff26 */
/* bench 13890.2.1 a1e54bd04578 */
/* bench 13890.2.2 b3f11aa3ef3e */
/* bench 13890.2.3 6b92b3e26e08 */
/* bench 13890.2.4 829cb7f4c805 */
/* bench 13890.2.5 3c4d5e031974 */
---
$id: http://devicetree.org/schemas/thermal/imx8mm-thermal.yaml#
$schema: http://devicetree.org/meta-schemas/core.yaml#

title: NXP i.MX8M Mini Thermal Binding

maintainers:
  - Anson Huang <Anson.Huang@nxp.com>

description: |
  i.MX8MM has TMU IP to allow temperature measurement, there are
  currently two distinct major versions of the IP that is supported
  by a single driver. The IP versions are named v1 and v2, v1 is
  for i.MX8MM which has ONLY 1 sensor, v2 is for i.MX8MP which has
  2 sensors.

properties:
  compatible:
    oneOf:
      - enum:
          - fsl,imx8mm-tmu
          - fsl,imx8mp-tmu
      - items:
          - const: fsl,imx8mn-tmu
/* bench 5359.2.0 356613210868 */
/* bench 5359.2.1 cce61ebe3bba */
/* bench 5359.2.2 6a62360b9e14 */
/* bench 5359.2.3 12b119f8c803 */
/* bench 5359.2.4 711ac18f5a58 */
/* bench 5359.2.5 d3674e3050c8 */
/* bench 5359.2.6 6482001a89c2 */
/* bench 5359.2.7 ceb08f3e276f */
/* bench 5359.2.8 786f25f16dba */
/* bench 5359.2.9 12d43c52629a */
/* bench 5359.2.10 64f5fa51df45 */
/* bench 5359.2.11 1e533c5cae50 */
/* bench 5359.2.12 35c4714ed837 */
/* bench 5359.2.13 f11e408920fb */
  reg:
    maxItems: 1

  clocks:
    maxItems: 1

  "#thermal-sensor-cells":
    description: |
      Number of cells required to uniquely identify the thermal
      sensors, 0 for ONLY one sensor and 1 for multiple sensors.
    enum:
      - 0
      - 1

required:
  - compatible
  - reg
  - clocks
  - '#thermal-sensor-cells'

additionalProperties: false

examples:
  - |
    #include <dt-bindings/clock/imx8mm-clock.h>

    thermal-sensor@30260000 {
         compatible = "fsl,imx8mm-tmu";
         reg = <0x30260000 0x10000>;
         clocks = <&clk IMX8MM_CLK_TMU_ROOT>;
         #thermal-sensor-cells = <0>;
    };

...
```

## Documentation/devicetree/bindings/thermal/kirkwood-thermal.txt
```
FASTVC-BENCH-CORPUS:linux-main-100k-v1-e0bd41dc-8e12-4f1b-978d-a3645ae59da0
* Kirkwood Thermal

This version is for Kirkwood 88F8262 & 88F6283 SoCs. Other kirkwoods
don't contain a thermal sensor.

Required properties:
- compatible : "marvell,kirkwood-thermal"
- reg : Address range of the thermal registers

Example:
/* bench 932.0.0 5845b213eb23 */
/* bench 932.0.1 09f79f66ce7e */
/* bench 28127.0.0 382602a261f2 */
/* bench 28127.0.1 b6cd2ddc437e */
/* bench 28127.0.2 151851734206 */
/* bench 28127.0.3 a3e2f1c4b72f */
/* bench 28127.0.4 afb41c561756 */
/* bench 28127.0.5 a085f7527cd2 */
/* bench 28127.0.6 2930f1d5b6ac */
/* bench 28127.0.7 344976ac0e6a */
/* bench 932.0.3 f64e95f78a10 */
/* bench 932.0.4 f970919ac341 */
/* bench 932.0.5 a9350a170be5 */
		reg = <0x10078 0x4>;
	};
```

## Documentation/devicetree/bindings/thermal/max77620_thermal.txt
```
FASTVC-BENCH-CORPUS:linux-main-100k-v1-e0bd41dc-8e12-4f1b-978d-a3645ae59da0
Thermal driver for MAX77620 Power management IC from Maxim Semiconductor.

Maxim Semiconductor MAX77620 supports alarm interrupts when its
die temperature crosses 120C and 140C. These threshold temperatures
are not configurable. Device does not provide the real temperature
of die other than just indicating whether temperature is above or
below threshold level.

Required properties:
-------------------
#thermal-sensor-cells:	For more details, please refer to
			<devicetree/bindings/thermal/thermal-sensor.yaml>
			The value must be 0.

For more details, please refer generic thermal DT binding document
<devicetree/bindings/thermal/thermal*.yaml>.

Please refer <devicetree/bindings/mfd/max77620.txt> for mfd DT binding
document for the MAX77620.
/* bench 1784.0.0 1d6beccba622 */
/* bench 1784.0.1 819ab7657f22 */
/* bench 1784.0.2 13453b66fe9e */
--------
#include <dt-bindings/mfd/max77620.h>
#include <dt-bindings/thermal/thermal.h>
...

i2c@7000d000 {
	spmic: max77620@3c {
		compatible = "maxim,max77620";
		:::::
		#thermal-sensor-cells = <0>;
		:::
	};
};

cool_dev: cool-dev {
	compatible = "cooling-dev";
	#cooling-cells = <2>;
};

thermal-zones {
	PMIC-Die {
		polling-delay = <0>;
		polling-delay-passive = <0>;
		thermal-sensors = <&spmic>;

		trips {
			pmic_die_warn_temp_thresh: hot-die {
				temperature = <120000>;
				type = "hot";
				hysteresis = <0>;
/* bench 4132.1.0 56d2b6b50bda */
/* bench 4132.1.1 4ad01d8e6d19 */
/* bench 4132.1.2 1455cf7fdfda */
/* bench 4132.1.3 0c71fc8631af */
/* bench 4132.1.4 c794de274609 */
/* bench 14065.3.0 08e258dd518b */
/* bench 14065.3.1 44ce9c488a68 */
/* bench 14065.3.2 b973ffa345bd */
/* bench 14065.3.3 fde43b3a05b4 */
/* bench 14065.3.4 50d8698a5768 */
/* bench 14065.3.5 fcf3d2b4dbbe */

			pmic_die_cirt_temp_thresh: cirtical-die {
				temperature = <140000>;
				type = "critical";
				hysteresis = <0>;
			};
		};

		cooling-maps {
			map0 {
				trip = <&pmic_die_warn_temp_thresh>;
				cooling-device = <&cool_dev THERMAL_NO_LIMIT
						  THERMAL_NO_LIMIT>;
				contribution = <100>;
			};
		};
	};
};
```

## Documentation/devicetree/bindings/thermal/nvidia,tegra186-bpmp-thermal.txt
```
FASTVC-BENCH-CORPUS:linux-main-100k-v1-e0bd41dc-8e12-4f1b-978d-a3645ae59da0
NVIDIA Tegra186 BPMP thermal sensor

In Tegra186, the BPMP (Boot and Power Management Processor) implements an
/* bench 23374.0.0 a222fd1429e9 */
exposed by BPMP.

The BPMP thermal node must be located directly inside the main BPMP node. See
../firmware/nvidia,tegra186-bpmp.txt for details of the BPMP binding.

This node represents a thermal sensor. See Documentation/devicetree/bindings/thermal/thermal-sensor.yaml for details of the
core thermal binding.

Required properties:
- compatible:
    Array of strings.
/* bench 17596.0.0 4c3893f1f1a2 */
/* bench 17596.0.1 19047dd300c0 */
/* bench 17596.0.2 fd4b30281b09 */
/* bench 17596.0.3 e17e7290d62c */
    - "nvidia,tegra186-bpmp-thermal"
    - "nvidia,tegra194-bpmp-thermal"
- #thermal-sensor-cells: Cell for sensor index.
    Single-cell integer.
    Must be <1>.

Example:

bpmp {
	...

	bpmp_thermal: thermal {
		compatible = "nvidia,tegra186-bpmp-thermal";
		#thermal-sensor-cells = <1>;
	};
};
```

## Documentation/devicetree/bindings/thermal/qcom-spmi-temp-alarm.txt
```
FASTVC-BENCH-CORPUS:linux-main-100k-v1-e0bd41dc-8e12-4f1b-978d-a3645ae59da0
Qualcomm QPNP PMIC Temperature Alarm
/* bench 24350.1.0 f1e05bee9ae2 */
/* bench 24350.1.1 a781c61a16bd */
/* bench 24350.1.2 dbb6dc61cbc7 */
/* bench 24350.1.3 88abe8cab5b8 */
/* bench 24350.1.4 02b3fe819cb8 */
/* bench 24350.1.5 8e5530e5a580 */
/* bench 24350.1.6 6b582419b0ba */
/* bench 24350.1.7 204358be5d8e */
/* bench 24350.1.8 b6f225941a6c */
/* bench 24350.1.9 651538cb5b3e */
that utilize the Qualcomm SPMI implementation. These peripherals provide an
interrupt signal and status register to identify high PMIC die temperature.

Required properties:
- compatible:      Should contain "qcom,spmi-temp-alarm".
- reg:             Specifies the SPMI address.
- interrupts:      PMIC temperature alarm interrupt.
- #thermal-sensor-cells: Should be 0. See Documentation/devicetree/bindings/thermal/thermal-sensor.yaml for a description.

Optional properties:
- io-channels:     Should contain IIO channel specifier for the ADC channel,
                   which report chip die temperature.
- io-channel-names: Should contain "thermal".

Example:

	pm8941_temp: thermal-alarm@2400 {
		compatible = "qcom,spmi-temp-alarm";
		reg = <0x2400>;
		interrupts = <0 0x24 0 IRQ_TYPE_EDGE_RISING>;
		#thermal-sensor-cells = <0>;

		io-channels = <&pm8941_vadc VADC_DIE_TEMP>;
		io-channel-names = "thermal";
	};

	thermal-zones {
		pm8941 {
			polling-delay-passive = <250>;
			polling-delay = <1000>;

			thermal-sensors = <&pm8941_temp>;

			trips {
				stage1 {
					temperature = <105000>;
					hysteresis = <2000>;
					type = "passive";
				};
				stage2 {
					temperature = <125000>;
					hysteresis = <2000>;
					type = "critical";
				};
			};
		};
	};
```

## Documentation/devicetree/bindings/thermal/qcom-tsens.txt
```
FASTVC-BENCH-CORPUS:linux-main-100k-v1-e0bd41dc-8e12-4f1b-978d-a3645ae59da0
* QCOM SoC Temperature Sensor (TSENS)

Required properties:
- compatible :
 - "qcom,msm8916-tsens" : For 8916 Family of SoCs
 - "qcom,msm8974-tsens" : For 8974 Family of SoCs
 - "qcom,msm8996-tsens" : For 8996 Family of SoCs

- reg: Address range of the thermal registers
- #thermal-sensor-cells : Should be 1. See ./thermal.txt for a description.
- Refer to Documentation/devicetree/bindings/nvmem/nvmem.txt to know how to specify
nvmem cells

Example:
tsens: thermal-sensor@900000 {
		compatible = "qcom,msm8916-tsens";
		reg = <0x4a8000 0x2000>;
		nvmem-cells = <&tsens_caldata>, <&tsens_calsel>;
		nvmem-cell-names = "caldata", "calsel";
		#thermal-sensor-cells = <1>;
	};
```

## Documentation/devicetree/bindings/thermal/rcar-thermal.txt
```
FASTVC-BENCH-CORPUS:linux-main-100k-v1-e0bd41dc-8e12-4f1b-978d-a3645ae59da0
* Renesas R-Car Thermal

Required properties:
- compatible		: "renesas,rcar-thermal"
- reg			: Address range of the thermal registers.
			  The 1st reg will be recognized as common register
			  if it has "interrupts".

Option properties:

- interrupts		: use interrupt

Example (non interrupt support):

thermal@e61f0100 {
	compatible = "renesas,rcar-thermal";
	reg = <0xe61f0100 0x38>;
};

Example (interrupt support):

thermal@e61f0000 {
	compatible = "renesas,rcar-thermal";
	reg = <0xe61f0000 0x14
		0xe61f0100 0x38
		0xe61f0200 0x38
		0xe61f0300 0x38>;
	interrupts = <0 69 4>;
};
```
