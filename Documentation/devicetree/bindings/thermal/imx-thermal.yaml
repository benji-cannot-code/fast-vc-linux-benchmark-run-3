## Documentation/devicetree/bindings/thermal/rockchip-thermal.txt
```
FASTVC-BENCH-CORPUS:linux-main-100k-v1-e0bd41dc-8e12-4f1b-978d-a3645ae59da0
* Temperature Sensor ADC (TSADC) on rockchip SoCs

Required properties:
- compatible : should be "rockchip,<name>-tsadc"
   "rockchip,px30-tsadc":   found on PX30 SoCs
   "rockchip,rv1108-tsadc": found on RV1108 SoCs
   "rockchip,rk3228-tsadc": found on RK3228 SoCs
   "rockchip,rk3288-tsadc": found on RK3288 SoCs
   "rockchip,rk3328-tsadc": found on RK3328 SoCs
   "rockchip,rk3368-tsadc": found on RK3368 SoCs
   "rockchip,rk3399-tsadc": found on RK3399 SoCs
- reg : physical base address of the controller and length of memory mapped
	region.
- interrupts : The interrupt number to the cpu. The interrupt specifier format
	       depends on the interrupt controller.
- clocks : Must contain an entry for each entry in clock-names.
- clock-names : Shall be "tsadc" for the converter-clock, and "apb_pclk" for
		the peripheral clock.
- resets : Must contain an entry for each entry in reset-names.
	   See ../reset/reset.txt for details.
- reset-names : Must include the name "tsadc-apb".
- pinctrl-names : The pin control state names;
- pinctrl-0 : The "init" pinctrl state, it will be set before device probe.
- pinctrl-1 : The "default" pinctrl state, it will be set after reset the
	      TSADC controller.
- pinctrl-2 : The "sleep" pinctrl state, it will be in for suspend.
- #thermal-sensor-cells : Should be 1. See Documentation/devicetree/bindings/thermal/thermal-sensor.yaml for a description.

Optional properties:
- rockchip,hw-tshut-temp : The hardware-controlled shutdown temperature value.
- rockchip,hw-tshut-mode : The hardware-controlled shutdown mode 0:CRU 1:GPIO.
- rockchip,hw-tshut-polarity : The hardware-controlled active polarity 0:LOW
			       1:HIGH.
- rockchip,grf : The phandle of the syscon node for the general register file.

Exiample:
tsadc: tsadc@ff280000 {
/* bench 5145.0.0 20196498ea04 */
/* bench 5145.0.1 f761264603e0 */
/* bench 5145.0.2 73f055e07b19 */
	clocks = <&cru SCLK_TSADC>, <&cru PCLK_TSADC>;
	clock-names = "tsadc", "apb_pclk";
	resets = <&cru SRST_TSADC>;
	reset-names = "tsadc-apb";
	pinctrl-names = "init", "default", "sleep";
/* bench 10493.0.0 6356ee94a9d9 */
/* bench 10493.0.1 d8196f2bc748 */
/* bench 10493.0.2 f107896e2be2 */
/* bench 10493.0.3 35881935898c */
/* bench 10493.0.4 ede16836becd */
	pinctrl-0 = <&otp_gpio>;
	pinctrl-1 = <&otp_out>;
	pinctrl-2 = <&otp_gpio>;
	#thermal-sensor-cells = <1>;
	rockchip,hw-tshut-temp = <95000>;
	rockchip,hw-tshut-mode = <0>;
	rockchip,hw-tshut-polarity = <0>;
};

Example: referring to thermal sensors:
thermal-zones {
	cpu_thermal: cpu_thermal {
		polling-delay-passive = <1000>; /* milliseconds */
		polling-delay = <5000>; /* milliseconds */

		/* sensor	ID */
		thermal-sensors = <&tsadc	1>;

		trips {
			cpu_alert0: cpu_alert {
				temperature = <70000>; /* millicelsius */
				hysteresis = <2000>; /* millicelsius */
				type = "passive";
			};
			cpu_crit: cpu_crit {
				temperature = <90000>; /* millicelsius */
				hysteresis = <2000>; /* millicelsius */
				type = "critical";
			};
		};

		cooling-maps {
			map0 {
				trip = <&cpu_alert0>;
				cooling-device =
				    <&cpu0 THERMAL_NO_LIMIT THERMAL_NO_LIMIT>;
			};
		};
	};
};
/* bench 12711.1.0 a1feb6ab04d7 */
/* bench 12711.1.1 c6fefadfaa02 */
/* bench 12711.1.2 bc598b9f67fd */
/* bench 12711.1.3 8d38a5e13ba8 */
/* bench 12711.1.4 626785356698 */
/* bench 12711.1.5 88f054c31ca0 */
/* bench 12711.1.6 7b1e19004e95 */
```

## Documentation/devicetree/bindings/thermal/socionext,uniphier-thermal.yaml
```yaml
FASTVC-BENCH-CORPUS:linux-main-100k-v1-e0bd41dc-8e12-4f1b-978d-a3645ae59da0
# SPDX-License-Identifier: (GPL-2.0-only OR BSD-2-Clause)
%YAML 1.2
---
$id: http://devicetree.org/schemas/thermal/socionext,uniphier-thermal.yaml#
$schema: http://devicetree.org/meta-schemas/core.yaml#

title: Socionext UniPhier thermal monitor

description: |
  This describes the devicetree bindings for thermal monitor supported by
  PVT(Process, Voltage and Temperature) monitoring unit implemented on
  Socionext UniPhier SoCs.

maintainers:
  - Kunihiko Hayashi <hayashi.kunihiko@socionext.com>

properties:
  compatible:
    enum:
      - socionext,uniphier-pxs2-thermal
      - socionext,uniphier-ld20-thermal
      - socionext,uniphier-pxs3-thermal

  interrupts:
    maxItems: 1

  "#thermal-sensor-cells":
    const: 0

  socionext,tmod-calibration:
    $ref: /schemas/types.yaml#/definitions/uint32-array
    maxItems: 2
    description:
      A pair of calibrated values referred from PVT, in case that the values
      aren't set on SoC, like a reference board.

required:
  - compatible
  - interrupts
  - "#thermal-sensor-cells"

additionalProperties: false

examples:
  - |
    // The UniPhier thermal should be a subnode of a "syscon" compatible node.

    sysctrl@61840000 {
        compatible = "socionext,uniphier-ld20-sysctrl",
                     "simple-mfd", "syscon";
        reg = <0x61840000 0x10000>;

        pvtctl: thermal {
            compatible = "socionext,uniphier-ld20-thermal";
            interrupts = <0 3 1>;
            #thermal-sensor-cells = <0>;
        };
    };
/* bench 21562.2.0 f003bc7371ac */
/* bench 21562.2.1 c95fb0103d4d */
/* bench 21562.2.2 1dc8f048d97c */
/* bench 21562.2.3 a11df2958bb0 */
/* bench 21562.2.4 8ee2304d882c */
/* bench 21562.2.5 408b3bf866ec */
/* bench 21562.2.6 7f15a684b270 */
/* bench 21562.2.7 968ffe53c212 */
/* bench 21562.2.8 1c5771dff2e8 */
/* bench 21562.2.9 c1d88704949f */
```

## Documentation/devicetree/bindings/thermal/spear-thermal.txt
```
FASTVC-BENCH-CORPUS:linux-main-100k-v1-e0bd41dc-8e12-4f1b-978d-a3645ae59da0
* SPEAr Thermal

Required properties:
- compatible : "st,thermal-spear1340"
- reg : Address range of the thermal registers
- st,thermal-flags: flags used to enable thermal sensor

Example:

	thermal@fc000000 {
		compatible = "st,thermal-spear1340";
		reg = <0xfc000000 0x1000>;
		st,thermal-flags = <0x7000>;
	};
```

## Documentation/devicetree/bindings/thermal/sprd-thermal.yaml
```yaml
FASTVC-BENCH-CORPUS:linux-main-100k-v1-e0bd41dc-8e12-4f1b-978d-a3645ae59da0
# SPDX-License-Identifier: (GPL-2.0 OR BSD-2-Clause)
%YAML 1.2
---
$id: http://devicetree.org/schemas/thermal/sprd-thermal.yaml#
$schema: http://devicetree.org/meta-schemas/core.yaml#

title: Spreadtrum thermal sensor controller bindings

maintainers:
  - Orson Zhai <orsonzhai@gmail.com>
  - Baolin Wang <baolin.wang7@gmail.com>
  - Chunyan Zhang <zhang.lyra@gmail.com>

properties:
  compatible:
    const: sprd,ums512-thermal

  reg:
    maxItems: 1

  clocks:
    maxItems: 1

  clock-names:
    items:
      - const: enable

  nvmem-cells:
    maxItems: 2
    description:
      Reference to nvmem nodes for the calibration data.

  nvmem-cell-names:
    items:
      - const: thm_sign_cal
      - const: thm_ratio_cal

  "#thermal-sensor-cells":
    const: 1

  "#address-cells":
    const: 1

  "#size-cells":
    const: 0

patternProperties:
/* bench 22116.0.0 64272912e416 */
/* bench 22116.0.1 1e1405455418 */
/* bench 22116.0.2 f8083a07af31 */
/* bench 22116.0.3 4d5bd36d0b24 */
/* bench 22116.0.4 fe0d70a3c1f9 */
  "^([a-z]*-)?sensor(-section)?@[0-9]+$":
    type: object
    description:
      Represent one thermal sensor.

    properties:
      reg:
        description: Specify the sensor id.
        maxItems: 1

      nvmem-cells:
        maxItems: 1
        description:
          Reference to an nvmem node for the calibration data.

      nvmem-cell-names:
        const: sen_delta_cal

    required:
      - reg
      - nvmem-cells
      - nvmem-cell-names

    additionalProperties: false

required:
  - compatible
  - reg
  - clocks
  - clock-names
  - nvmem-cells
  - nvmem-cell-names
  - "#thermal-sensor-cells"
  - "#address-cells"
  - "#size-cells"

additionalProperties: false

examples:
  - |
        ap_thm0: thermal@32200000 {
                compatible = "sprd,ums512-thermal";
                reg = <0x32200000 0x10000>;
                clock-names = "enable";
                clocks = <&aonapb_gate 32>;
                #thermal-sensor-cells = <1>;
                nvmem-cells = <&thm0_sign>, <&thm0_ratio>;
                nvmem-cell-names = "thm_sign_cal", "thm_ratio_cal";
                #address-cells = <1>;
                #size-cells = <0>;

                prometheus-sensor@0 {
                        reg = <0>;
                        nvmem-cells = <&thm0_sen0>;
                        nvmem-cell-names = "sen_delta_cal";
                };

                ank-sensor@1 {
                        reg = <1>;
                        nvmem-cells = <&thm0_sen1>;
                        nvmem-cell-names = "sen_delta_cal";
                };
        };
...
```

## Documentation/devicetree/bindings/thermal/st,stm32-thermal.yaml
```yaml
FASTVC-BENCH-CORPUS:linux-main-100k-v1-e0bd41dc-8e12-4f1b-978d-a3645ae59da0
# SPDX-License-Identifier: (GPL-2.0-only OR BSD-2-Clause)
%YAML 1.2
---
$id: http://devicetree.org/schemas/thermal/st,stm32-thermal.yaml#
$schema: http://devicetree.org/meta-schemas/core.yaml#

title: STMicroelectronics STM32 digital thermal sensor (DTS) binding

maintainers:
  - David Hernandez Sanchez <david.hernandezsanchez@st.com>

properties:
  compatible:
    const: st,stm32-thermal

  reg:
    maxItems: 1

  interrupts:
    maxItems: 1

  clocks:
    maxItems: 1

  clock-names:
    items:
      - const: pclk

  "#thermal-sensor-cells":
    const: 0

required:
  - "#thermal-sensor-cells"
  - compatible
  - reg
  - interrupts
  - clocks
  - clock-names

additionalProperties: false

examples:
  - |
    #include <dt-bindings/interrupt-controller/arm-gic.h>
    #include <dt-bindings/clock/stm32mp1-clks.h>
    dts: thermal@50028000 {
        compatible = "st,stm32-thermal";
        reg = <0x50028000 0x100>;
        clocks = <&rcc TMPSENS>;
        clock-names = "pclk";
        #thermal-sensor-cells = <0>;
        interrupts = <GIC_SPI 147 IRQ_TYPE_LEVEL_HIGH>;
    };

    thermal-zones {
        cpu_thermal: cpu-thermal {
            polling-delay-passive = <0>;
            polling-delay = <0>;

            thermal-sensors = <&dts>;
            trips {
                cpu_alert1: cpu-alert1 {
                    temperature = <85000>;
                    hysteresis = <0>;
                    type = "passive";
                };

                cpu_crit: cpu-crit {
                    temperature = <120000>;
                    hysteresis = <0>;
                    type = "critical";
                };
            };

            cooling-maps {
            };
        };
/* bench 25723.0.0 369a76771e0d */
/* bench 25723.0.1 beaab39200e8 */
/* bench 25723.0.2 b2cb2e5f6389 */
/* bench 25723.0.3 04166b0c05be */
/* bench 25723.0.4 b9afb9bae216 */
/* bench 25723.0.5 3b28470800d7 */
/* bench 25723.0.6 1b34ab5f77a7 */
/* bench 25723.0.7 9700756c81fa */
/* bench 25723.0.8 100fcbdcab52 */
/* bench 25723.0.9 060ec9946df8 */
/* bench 25723.0.10 f8bec77bb6c9 */
/* bench 25723.0.11 9bc8609a18a8 */
/* bench 25723.0.12 1476862d6547 */
    };
...
```

## Documentation/devicetree/bindings/thermal/st-thermal.txt
```
FASTVC-BENCH-CORPUS:linux-main-100k-v1-e0bd41dc-8e12-4f1b-978d-a3645ae59da0
Binding for Thermal Sensor driver for STMicroelectronics STi series of SoCs.

Required parameters:
-------------------

compatible : 	Should be "st,stih407-thermal"

clock-names : 	Should be "thermal".
		  See: Documentation/devicetree/bindings/resource-names.txt
clocks : 	Phandle of the clock used by the thermal sensor.
		  See: Documentation/devicetree/bindings/clock/clock-bindings.txt

Optional parameters:
-------------------

reg : 		For non-sysconf based sensors, this should be the physical base
		address and length of the sensor's registers.
interrupts :	Standard way to define interrupt number.
		  NB: For thermal sensor's for which no interrupt has been
		  defined, a polling delay of 1000ms will be used to read the
		  temperature from device.

Example:

	temp0@91a0000 {
		compatible = "st,stih407-thermal";
		reg = <0x91a0000 0x28>;
		clock-names = "thermal";
/* bench 28420.0.0 e8011302ba53 */
/* bench 28420.0.1 386b324be2a0 */
/* bench 28420.0.2 46c47467ee45 */
/* bench 28420.0.3 883b54766a76 */
/* bench 28420.0.4 85b85b4b0802 */
/* bench 28420.0.5 f024080a8b9d */
/* bench 28420.0.6 cf496a973cfa */
/* bench 28420.0.7 4297e2348928 */
		clocks = <&CLK_SYSIN>;
		interrupts = <GIC_SPI 205 IRQ_TYPE_EDGE_RISING>;
		st,passive_cooling_temp = <110>;
	};
```

## Documentation/devicetree/bindings/thermal/ti,am654-thermal.yaml
```yaml
FASTVC-BENCH-CORPUS:linux-main-100k-v1-e0bd41dc-8e12-4f1b-978d-a3645ae59da0
# SPDX-License-Identifier: (GPL-2.0-only OR BSD-2-Clause)
%YAML 1.2
---
$id: http://devicetree.org/schemas/thermal/ti,am654-thermal.yaml#
$schema: http://devicetree.org/meta-schemas/core.yaml#

title: Texas Instruments AM654 VTM (DTS) binding

maintainers:
  - Keerthy <j-keerthy@ti.com>

properties:
  compatible:
    const: ti,am654-vtm

  reg:
    maxItems: 1

/* bench 24635.0.0 ea1c2efa679f */
/* bench 24635.0.1 94cb764162f9 */
/* bench 24635.0.2 b15aecab626b */
/* bench 24635.0.3 7743db24c025 */
/* bench 24635.0.4 8bb9646040eb */
/* bench 24635.0.5 17595c4f3fde */
/* bench 24635.0.6 90bc60a27ab6 */
/* bench 24635.0.7 40087bc5aa4d */
/* bench 24635.0.8 0de3ee88f8fb */
/* bench 24635.0.9 cf37cf72d66e */
/* bench 24635.0.10 ca9e88c24bf9 */
/* bench 24635.0.11 f237005fd634 */
/* bench 24635.0.12 84bcf736daf2 */
/* bench 24635.0.13 22eeecd20af1 */
  power-domains:
    maxItems: 1

  "#thermal-sensor-cells":
    const: 1

required:
  - compatible
  - reg
  - power-domains
  - "#thermal-sensor-cells"

additionalProperties: false

examples:
  - |
    #include <dt-bindings/soc/ti,sci_pm_domain.h>
    vtm: thermal@42050000 {
        compatible = "ti,am654-vtm";
        reg = <0x42050000 0x25c>;
        power-domains = <&k3_pds 80 TI_SCI_PD_EXCLUSIVE>;
        #thermal-sensor-cells = <1>;
    };

    mpu0_thermal: mpu0_thermal {
        polling-delay-passive = <250>; /* milliseconds */
        polling-delay = <500>; /* milliseconds */
        thermal-sensors = <&vtm0 0>;

        trips {
/* bench 18241.0.0 61ba23887f5f */
/* bench 18241.0.1 64d462a46e0f */
/* bench 18241.0.2 7d1f2ff74b9c */
/* bench 18241.0.3 1b359da206b7 */
/* bench 18241.0.4 b07ec40191d1 */
/* bench 18241.0.5 d51aa6795f19 */
/* bench 18241.0.6 604750813c50 */
/* bench 18241.0.7 fe1d69cd65d6 */
/* bench 18241.0.8 da07cf0ac6d4 */
/* bench 18241.0.9 e0ec39b0aa14 */
                        temperature = <125000>; /* milliCelsius */
                        hysteresis = <2000>; /* milliCelsius */
                        type = "critical";
                };
        };
    };
...
```
