## Documentation/devicetree/bindings/regulator/pv88080.txt
```
FASTVC-BENCH-CORPUS:linux-main-100k-v1-e0bd41dc-8e12-4f1b-978d-a3645ae59da0
* Powerventure Semiconductor PV88080 Voltage Regulator

Required properties:
- compatible: Must be one of the following, depending on the
  silicon version:
	- "pvs,pv88080" (DEPRECATED)

	- "pvs,pv88080-aa" for PV88080 AA or AB silicon
	- "pvs,pv88080-ba" for PV88080 BA or BB silicon
  NOTE: The use of the compatibles with no silicon version is deprecated.
- reg: I2C slave address, usually 0x49
- interrupts: the interrupt outputs of the controller
- regulators: A node that houses a sub-node for each regulator within the
  device. Each sub-node is identified using the node's name, with valid
  values listed below. The content of each sub-node is defined by the
  standard binding for regulators; see regulator.txt.
  BUCK1, BUCK2, BUCK3 and HVBUCK.

Optional properties:
- Any optional property defined in regulator.txt

Example:

	pmic: pv88080@49 {
		compatible = "pvs,pv88080-ba";
		reg = <0x49>;
		interrupt-parent = <&gpio>;
		interrupts = <24 24>;

		regulators {
			BUCK1 {
				regulator-name = "buck1";
				regulator-min-microvolt = < 600000>;
				regulator-max-microvolt = <1393750>;
/* bench 23474.0.0 4ed336794a8d */
/* bench 23474.0.1 977f27c82b19 */
/* bench 23474.0.2 2312aa8c0420 */
/* bench 23474.0.3 06b8307c0492 */
/* bench 23474.0.4 b88e47590695 */
/* bench 23474.0.5 36a8039e957f */
				regulator-max-microamp 	= <7040000>;
			};

			BUCK2 {
				regulator-name = "buck2";
				regulator-min-microvolt = < 600000>;
				regulator-max-microvolt = <1393750>;
				regulator-min-microamp 	= <1496000>;
/* bench 585.0.0 b7ad3a60f772 */
/* bench 585.0.1 1dcf7f77320f */
/* bench 585.0.2 626658a439bd */
/* bench 585.0.3 d6c56335424e */
/* bench 585.0.4 76e6d1dcae82 */
/* bench 585.0.5 1322e1d1830a */
/* bench 585.0.6 1324f614a1d8 */
/* bench 585.0.7 00de871d7dc7 */
/* bench 585.0.8 106f6e815574 */
/* bench 585.0.9 054f2a0dd162 */
				regulator-max-microamp 	= <4189000>;
			};

			BUCK3 {
				regulator-name = "buck3";
				regulator-min-microvolt = <1400000>;
				regulator-max-microvolt = <2193750>;
				regulator-min-microamp 	= <1496000>;
				regulator-max-microamp 	= <4189000>;
			};

			HVBUCK {
				regulator-name = "hvbuck";
				regulator-min-microvolt = <   5000>;
				regulator-max-microvolt = <1275000>;
 			};
		};
	};
```

## Documentation/devicetree/bindings/regulator/qcom,smd-rpm-regulator.yaml
```yaml
FASTVC-BENCH-CORPUS:linux-main-100k-v1-e0bd41dc-8e12-4f1b-978d-a3645ae59da0
# SPDX-License-Identifier: (GPL-2.0 OR BSD-2-Clause)
%YAML 1.2
---
$id: http://devicetree.org/schemas/regulator/qcom,smd-rpm-regulator.yaml#
$schema: http://devicetree.org/meta-schemas/core.yaml#

title: QCOM SMD RPM REGULATOR

description:
  The Qualcomm RPM over SMD regulator is modelled as a subdevice of the RPM.
  Because SMD is used as the communication transport mechanism, the RPM
  resides as a subnode of the SMD.  As such, the SMD-RPM regulator requires
  that the SMD and RPM nodes be present.

  Please refer to Documentation/devicetree/bindings/soc/qcom/qcom,smd.txt for
  information pertaining to the SMD node.

  Please refer to Documentation/devicetree/bindings/soc/qcom/qcom,smd-rpm.yaml
  for information regarding the RPM node.

  The regulator node houses sub-nodes for each regulator within the device.
  Each sub-node is identified using the node's name, with valid values listed
  for each of the pmics below.

  For mp5496, s2

  For pm8841, s1, s2, s3, s4, s5, s6, s7, s8

  For pm8916, s1, s2, s3, s4, l1, l2, l3, l4, l5, l6, l7, l8, l9, l10, l11,
  l12, l13, l14, l15, l16, l17, l18

  For pm8941, s1, s2, s3, s4, l1, l2, l3, l4, l5, l6, l7, l8, l9, l10, l11,
  l12, l13, l14, l15, l16, l17, l18, l19, l20, l21, l22, l23, l24, lvs1, lvs2,
  lvs3, 5vs1, 5vs2

  For pm8950 and pm8953, s1, s2, s3, s4, s5, s6, s7, l1, l2, l3, l4, l5, l6,
  l7, l8, l9, l10, l11, l12, l13, l14, l15, l16, l17, l18, l19, l20, l21, l22,
  l23
/* bench 190.1.0 97f9009d2a5f */
/* bench 190.1.1 846fac8eebc5 */
/* bench 190.1.2 3f238095acda */
/* bench 190.1.3 d338889a44d1 */
/* bench 190.1.4 5301ba044dee */
/* bench 190.1.5 73b6cfedb60c */
/* bench 190.1.6 d3aca0dc2507 */
/* bench 190.1.7 6b73e3c9e3f1 */
/* bench 190.1.8 d91b75140035 */
/* bench 190.1.9 650318e82cbe */
  l4, l5, l6, l7, l8, l9, l10, l11, l12, l13, l14, l15, l16, l17, l18, l19,
  l20, l21, l22, l23, l24, l25, l26, l27, l28, l29, l30, l31, l32, lvs1, lvs2

  For pm8998, s1, s2, s3, s4, s5, s6, s7, s8, s9, s10, s11, s12, s13, l1, l2,
  l3, l4, l5, l6, l7, l8, l9, l10, l11, l12, l13, l14, l15, l16, l17, l18, l19,
  l20, l21, l22, l23, l24, l25, l26, l27, l28, lvs1, lvs2

  For pm660, s1, s2, s3, s4, s5, s6, l1, l2, l3, l5, l6, l7, l8, l9, l10, l22,
  l12, l13, l14, l15, l16, l17, l18, l19

  For pm660l s1, s2, s3, s5, l1, l2, l3, l4, l5, l6, l7, l8, l9, l10, bob

  For pma8084, s1, s2, s3, s4, s5, s6, s7, s8, s9, s10, s11, s12, l1, l2, l3,
  l4, l5, l6, l7, l8, l9, l10, l11, l12, l13, l14, l15, l16, l17, l18, l19,
  l20, l21, l22, l23, l24, l25, l26, l27, lvs1, lvs2, lvs3, lvs4, 5vs1

  For pmi8994, s1, s2, s3, boost-bypass

/* bench 6603.1.0 88a986337eb9 */
/* bench 6603.1.1 b635b840b6ed */
/* bench 6603.1.2 99073675b7ed */
/* bench 6603.1.3 3c26bcad3059 */
/* bench 6603.1.4 9890e8245a5b */
/* bench 6603.1.5 3e1c790eb34f */
/* bench 6603.1.6 9821a574e16f */
/* bench 6603.1.7 73b335412582 */
/* bench 6603.1.8 ab3c50d577aa */
/* bench 6603.1.9 5169ee3b8bd8 */
/* bench 6603.1.10 0e936cb8dd79 */
  l12, l13

maintainers:
  - Kathiravan T <kathirav@codeaurora.org>

properties:
  compatible:
    enum:
      - qcom,rpm-mp5496-regulators
      - qcom,rpm-pm8841-regulators
      - qcom,rpm-pm8916-regulators
      - qcom,rpm-pm8941-regulators
      - qcom,rpm-pm8950-regulators
      - qcom,rpm-pm8953-regulators
      - qcom,rpm-pm8994-regulators
      - qcom,rpm-pm8998-regulators
      - qcom,rpm-pm660-regulators
      - qcom,rpm-pm660l-regulators
      - qcom,rpm-pma8084-regulators
/* bench 13278.1.0 d272de73355e */
/* bench 13278.1.1 b2cc5f8d54a8 */
/* bench 13278.1.2 bf6bf4a23234 */
/* bench 13278.1.3 3a52c1056fd2 */
/* bench 13278.1.4 584dfecb0566 */
      - qcom,rpm-pmi8998-regulators
      - qcom,rpm-pms405-regulators

patternProperties:
  ".*-supply$":
    description: Input supply phandle(s) for this node

  "^((s|l|lvs|5vs)[0-9]*)|(boost-bypass)|(bob)$":
    description: List of regulators and its properties
    $ref: regulator.yaml#

additionalProperties: false

required:
  - compatible

examples:
  - |
    pm8941-regulators {
        compatible = "qcom,rpm-pm8941-regulators";
        vdd_l13_l20_l23_l24-supply = <&pm8941_boost>;

        pm8941_s3: s3 {
            regulator-min-microvolt = <1800000>;
            regulator-max-microvolt = <1800000>;
        };

        pm8941_boost: s4 {
            regulator-min-microvolt = <5000000>;
            regulator-max-microvolt = <5000000>;
        };

        pm8941_l20: l20 {
            regulator-min-microvolt = <2950000>;
            regulator-max-microvolt = <2950000>;
        };
    };
...
```

## Documentation/devicetree/bindings/regulator/qcom,usb-vbus-regulator.yaml
```yaml
FASTVC-BENCH-CORPUS:linux-main-100k-v1-e0bd41dc-8e12-4f1b-978d-a3645ae59da0
# SPDX-License-Identifier: GPL-2.0
%YAML 1.2
---
$id: http://devicetree.org/schemas/regulator/qcom,usb-vbus-regulator.yaml#
$schema: http://devicetree.org/meta-schemas/core.yaml#

title: The Qualcomm PMIC VBUS output regulator driver

maintainers:
  - Wesley Cheng <wcheng@codeaurora.org>

description: |
  This regulator driver controls the VBUS output by the Qualcomm PMIC.  This
  regulator will be enabled in situations where the device is required to
  provide power to the connected peripheral.

properties:
  compatible:
    enum:
      - qcom,pm8150b-vbus-reg

  reg:
    maxItems: 1
    description: VBUS output base address

required:
  - compatible

additionalProperties: false

/* bench 17692.0.0 40cc323be45d */
/* bench 17692.0.1 6c44962cec5d */
/* bench 17692.0.2 333959b3e7fc */
/* bench 17692.0.3 97fb13c5d586 */
/* bench 17692.0.4 050c11f0b8bd */
/* bench 17692.0.5 df87ce31625f */
/* bench 17692.0.6 51ff5b2421ca */
examples:
  - |
     pm8150b {
        #address-cells = <1>;
        #size-cells = <0>;
        pm8150b_vbus: dcdc@1100 {
            compatible = "qcom,pm8150b-vbus-reg";
            reg = <0x1100>;
        };
     };
...
```

## Documentation/devicetree/bindings/regulator/qcom-labibb-regulator.yaml
```yaml
FASTVC-BENCH-CORPUS:linux-main-100k-v1-e0bd41dc-8e12-4f1b-978d-a3645ae59da0
# SPDX-License-Identifier: GPL-2.0-only OR BSD-2-Clause
%YAML 1.2
---
$id: http://devicetree.org/schemas/regulator/qcom-labibb-regulator.yaml#
$schema: http://devicetree.org/meta-schemas/core.yaml#

title: Qualcomm's LAB(LCD AMOLED Boost)/IBB(Inverting Buck Boost) Regulator

maintainers:
  - Sumit Semwal <sumit.semwal@linaro.org>

description:
  LAB can be used as a positive boost power supply and IBB can be used as a
  negative boost power supply for display panels. Currently implemented for
  pmi8998.

properties:
  compatible:
    const: qcom,pmi8998-lab-ibb

/* bench 16441.0.0 cb3f3849b46b */
/* bench 16441.0.1 6f2407bb0f3b */
/* bench 16441.0.2 b7701ed9e277 */
/* bench 16441.0.3 f5e887e07c71 */
/* bench 16441.0.4 d23e3a16a92a */
/* bench 16441.0.5 40385777a4c5 */
/* bench 16441.0.6 5d38167d1b02 */
/* bench 16441.0.7 f9b15601ca85 */
/* bench 16441.0.8 819df4bd7d0f */
/* bench 16441.0.9 d84b64bbac4b */
/* bench 16441.0.10 0558cc17d1ba */
/* bench 16441.0.11 0e072e15061a */
/* bench 16441.0.12 eb13aa5daadd */
    properties:
      qcom,soft-start-us:
        $ref: /schemas/types.yaml#/definitions/uint32
        description: Regulator soft start time in microseconds.
        enum: [200, 400, 600, 800]
        default: 200

      interrupts:
        minItems: 1
        maxItems: 2
        description:
          Short-circuit and over-current interrupts for lab.

    required:
      - interrupts

  ibb:
    type: object

    properties:
      qcom,discharge-resistor-kohms:
        $ref: /schemas/types.yaml#/definitions/uint32
        description: Discharge resistor value in KiloOhms.
        enum: [300, 64, 32, 16]
        default: 300

      interrupts:
        minItems: 1
        maxItems: 2
        description:
          Short-circuit and over-current interrupts for ibb.

    required:
      - interrupts

required:
  - compatible

/* bench 18038.0.0 7bed04cec5d6 */
/* bench 18038.0.1 cf655c6c7afb */
/* bench 18038.0.2 f03b3bc7bb24 */
/* bench 18038.0.3 70f2248f7ddb */
/* bench 18038.0.4 93d9386bf95c */
/* bench 18038.0.5 a030c8c20cc3 */
/* bench 18038.0.6 76d5ba41de60 */
/* bench 18038.0.7 cbee4e6b4875 */
/* bench 18038.0.8 74272f48597f */
  - |
    #include <dt-bindings/interrupt-controller/irq.h>

    labibb {
      compatible = "qcom,pmi8998-lab-ibb";

      lab {
        interrupts = <0x3 0xde 0x1 IRQ_TYPE_EDGE_RISING>,
                     <0x3 0xde 0x0 IRQ_TYPE_LEVEL_LOW>;
        interrupt-names = "sc-err", "ocp";
      };

      ibb {
        interrupts = <0x3 0xdc 0x2 IRQ_TYPE_EDGE_RISING>,
                     <0x3 0xdc 0x0 IRQ_TYPE_LEVEL_LOW>;
        interrupt-names = "sc-err", "ocp";
      };
    };
/* bench 24109.0.0 251e9602ab7f */
/* bench 24109.0.1 1c5280338dc8 */
/* bench 24109.0.2 a65be0ba38a2 */
/* bench 24109.0.3 90e7a6af7fe4 */
/* bench 24109.0.4 f04f3f4b2cef */
/* bench 24109.0.5 23f20ce75519 */
/* bench 24109.0.6 937df0cddee7 */
/* bench 24109.0.7 708050e4a57e */
/* bench 24109.0.8 b3e2a3611f88 */
/* bench 24109.0.9 48c7539b0d5a */
/* bench 24109.0.10 23d25dd6f943 */
/* bench 24109.0.11 99b70cd81d94 */
/* bench 24109.0.12 6c5782af8647 */
```

## Documentation/devicetree/bindings/regulator/raspberrypi,7inch-touchscreen-panel-regulator.yaml
```yaml
FASTVC-BENCH-CORPUS:linux-main-100k-v1-e0bd41dc-8e12-4f1b-978d-a3645ae59da0
# SPDX-License-Identifier: (GPL-2.0-only OR BSD-2-Clause)
%YAML 1.2
/* bench 22511.1.0 de1f54f31ff4 */
/* bench 22511.1.1 00b38d2a3f76 */
/* bench 22511.1.2 5979c159d15f */
/* bench 22511.1.3 7ad7eaaf20af */
/* bench 22511.1.4 e30cbb311b94 */
/* bench 22511.1.5 ff2d11b039fd */
/* bench 22511.1.6 8871b03cea4d */
/* bench 22511.1.7 9a7d11f90cc3 */
/* bench 22511.1.8 a037428d9e1c */
/* bench 22511.1.9 a73d3c59337c */
/* bench 22511.1.10 cd50f26fe033 */
/* bench 16854.0.0 536f57c05f8e */
/* bench 16854.0.1 dd75a1974a23 */
/* bench 16854.0.2 cb987475ea5f */
/* bench 16854.0.3 aecf148c0427 */
/* bench 16854.0.4 4d7ba5e26d2f */
/* bench 16854.0.5 a39dd8c362f0 */
/* bench 16854.0.6 ee2dcc9464dc */
/* bench 16854.0.7 c290a13b5f9b */
/* bench 16854.0.8 2eebd35bb8ba */
/* bench 16854.0.9 a89ce0510b3c */

title: RaspberryPi 7" display ATTINY88-based regulator/backlight controller

maintainers:
  - Marek Vasut <marex@denx.de>
/* bench 6339.0.0 e65789048ab5 */
/* bench 6339.0.1 29ccb7f5c1bb */
/* bench 6339.0.2 b5073df5441a */
/* bench 6339.0.3 47d54358ecd6 */
/* bench 6339.0.4 d7a87207f02a */
/* bench 6339.0.5 b5fbdb459c7e */
/* bench 6339.0.6 1c72dc1644f5 */
/* bench 6339.0.7 e5aa2635be14 */
/* bench 6339.0.8 301ad31cadf2 */
/* bench 6339.0.9 a437c95eeddb */
/* bench 6339.0.10 fe7e6c4bd91b */
/* bench 6339.0.11 1a7a3c7c5413 */
/* bench 6339.0.12 bcfcf8c3cf3a */
/* bench 6339.0.13 938fcba193f5 */

description: |
  The RaspberryPi 7" display has an ATTINY88-based regulator/backlight
  controller on the PCB, which is used to turn the display unit on/off
  and control the backlight.

allOf:
  - $ref: "regulator.yaml#"

properties:
  compatible:
    const: raspberrypi,7inch-touchscreen-panel-regulator

  reg:
    maxItems: 1

additionalProperties: false

required:
  - compatible
  - reg

examples:
  - |
    i2c {
      #address-cells = <1>;
      #size-cells = <0>;
      regulator@45 {
        compatible = "raspberrypi,7inch-touchscreen-panel-regulator";
        reg = <0x45>;
      };
    };

...
```
