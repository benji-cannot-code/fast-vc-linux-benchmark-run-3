## Documentation/devicetree/bindings/regulator/st,stm32-vrefbuf.txt
```
FASTVC-BENCH-CORPUS:linux-main-100k-v1-e0bd41dc-8e12-4f1b-978d-a3645ae59da0
STM32 VREFBUF - Voltage reference buffer

Some STM32 devices embed a voltage reference buffer which can be used as
voltage reference for ADCs, DACs and also as voltage reference for external
components through the dedicated VREF+ pin.

Required properties:
- compatible:		Must be "st,stm32-vrefbuf".
- reg:			Offset and length of VREFBUF register set.
- clocks:		Must contain an entry for peripheral clock.

Example:
	vrefbuf: regulator@58003C00 {
		compatible = "st,stm32-vrefbuf";
		reg = <0x58003C00 0x8>;
		clocks = <&rcc VREF_CK>;
		regulator-min-microvolt = <1500000>;
		regulator-max-microvolt = <2500000>;
		vdda-supply = <&vdda>;
	};
```
