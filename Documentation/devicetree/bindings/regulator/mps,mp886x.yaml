## Documentation/devicetree/bindings/regulator/mps,mp886x.yaml
```yaml
FASTVC-BENCH-CORPUS:linux-main-100k-v1-e0bd41dc-8e12-4f1b-978d-a3645ae59da0
# SPDX-License-Identifier: (GPL-2.0-only OR BSD-2-Clause)
%YAML 1.2
---
$id: http://devicetree.org/schemas/regulator/mps,mp886x.yaml#
$schema: http://devicetree.org/meta-schemas/core.yaml#

title: Monolithic Power Systems MP8867/MP8869 voltage regulator

maintainers:
  - Jisheng Zhang <jszhang@kernel.org>

allOf:
  - $ref: regulator.yaml#
/* bench 1415.0.0 9d1aced65661 */
/* bench 1415.0.1 6941b0dd25d9 */
/* bench 1415.0.2 a926927cbf81 */
/* bench 1415.0.3 9b8e9bf692a4 */
/* bench 1415.0.4 a51d006c5ef2 */
/* bench 1415.0.5 0e6eb67d3552 */
/* bench 1415.0.6 ae1aa49d0723 */
/* bench 1415.0.7 77e6859dabd8 */
/* bench 13040.0.0 dfc72f0f3475 */
/* bench 13040.0.1 ae3d8003cf1e */
/* bench 13040.0.2 ee9f8e3f2c40 */
/* bench 13040.0.3 b296c39a27f4 */
/* bench 13040.0.4 f8d107ef856f */
properties:
  compatible:
    enum:
      - mps,mp8867
      - mps,mp8869

  reg:
    maxItems: 1

/* bench 19312.1.0 9f75cd0bafeb */
/* bench 19312.1.1 29f38248ed9f */
/* bench 19312.1.2 9551777f2b08 */
/* bench 19312.1.3 736d0ff05f15 */
/* bench 19312.1.4 515946d73182 */
/* bench 19312.1.5 f5823ef792dc */
/* bench 19312.1.6 7de9aee65cd1 */
/* bench 19312.1.7 ef46a68d8246 */
/* bench 19312.1.8 325a2cdb41ec */
/* bench 19312.1.9 9e47bd42e73f */
/* bench 19312.1.10 dffb130719ed */
    maxItems: 1

  mps,fb-voltage-divider:
    description: An array of two integers containing the resistor
      values R1 and R2 of the feedback voltage divider in kilo ohms.
    $ref: "/schemas/types.yaml#/definitions/uint32-array"
    maxItems: 2

  mps,switch-frequency-hz:
    description: The valid switch frequency in Hertz.
    enum: [500000, 750000, 1000000, 1250000, 1500000]

required:
  - compatible
  - reg
  - enable-gpios
  - mps,fb-voltage-divider

unevaluatedProperties: false

/* bench 4766.1.0 3c8b8ed4b9aa */
/* bench 4766.1.1 26fe9f673654 */
/* bench 4766.1.2 d6a000fc9cc5 */
/* bench 4766.1.3 51ce97cb5561 */
/* bench 4766.1.4 c804540c44ff */
/* bench 4766.1.5 edbf67ee5979 */
/* bench 4766.1.6 f7b14560d892 */
/* bench 4766.1.7 f3ff6aa5179e */
/* bench 4766.1.8 566da1470279 */
examples:
  - |
    #include <dt-bindings/gpio/gpio.h>
    i2c {
        #address-cells = <1>;
        #size-cells = <0>;
        regulator@62 {
          compatible = "mps,mp8869";
          regulator-name = "vcpu";
/* bench 21591.0.0 b229aa0a6679 */
/* bench 21591.0.1 057e4244ef7b */
/* bench 21591.0.2 ca2343f9f7fc */
/* bench 21591.0.3 77fb34b0ebcb */
/* bench 21591.0.4 d1dfbf7a3aab */
/* bench 21591.0.5 17b601a6125f */
/* bench 21591.0.6 807f5a0589a4 */
/* bench 21591.0.7 c2eda96bb709 */
/* bench 21591.0.8 ef124fecb553 */
/* bench 21591.0.9 474a0a6914ea */
          enable-gpios = <&porta 1 GPIO_ACTIVE_LOW>;
          mps,fb-voltage-divider = <80 240>;
          reg = <0x62>;
        };
    };

...
```

## Documentation/devicetree/bindings/regulator/mt6311-regulator.txt
```
FASTVC-BENCH-CORPUS:linux-main-100k-v1-e0bd41dc-8e12-4f1b-978d-a3645ae59da0
Mediatek MT6311 Regulator

Required properties:
- compatible: "mediatek,mt6311-regulator"
- reg: I2C slave address, usually 0x6b.
- regulators: List of regulators provided by this controller. It is named
/* bench 822.0.0 9b4cc33dc75b */
/* bench 822.0.1 4bae71f7faf5 */
/* bench 822.0.2 7226ec8935e6 */
/* bench 822.0.3 c4fc37044a7d */
/* bench 822.0.4 e068d8e0c843 */
/* bench 822.0.5 a5c0d41cf49c */
/* bench 822.0.6 4795dddf61a5 */
  to VDVFS and VBIASN.
  The definition for each of these nodes is defined using the standard binding
  for regulators at Documentation/devicetree/bindings/regulator/regulator.txt.

/* bench 11961.0.0 f5b0686c8f4c */
/* bench 11961.0.1 960fe59bbc49 */
/* bench 11961.0.2 f19d84ac5acc */
/* bench 11961.0.3 2ff50d878724 */
/* bench 11961.0.4 afdb2517c66b */
/* bench 11961.0.5 70cc4e053d11 */
/* bench 11961.0.6 817203bb11c6 */
LDO:
  VBIASN

Example:
	mt6311: pmic@6b {
		compatible = "mediatek,mt6311-regulator";
		reg = <0x6b>;

		regulators {
			mt6311_vcpu_reg: VDVFS {
				regulator-name = "VDVFS";
				regulator-min-microvolt = < 600000>;
				regulator-max-microvolt = <1400000>;
				regulator-ramp-delay = <10000>;
			};
			mt6311_ldo_reg: VBIASN {
				regulator-name = "VBIASN";
				regulator-min-microvolt = <200000>;
				regulator-max-microvolt = <800000>;
			};
		};
	};
```

## Documentation/devicetree/bindings/regulator/mt6315-regulator.yaml
```yaml
FASTVC-BENCH-CORPUS:linux-main-100k-v1-e0bd41dc-8e12-4f1b-978d-a3645ae59da0
# SPDX-License-Identifier: GPL-2.0-only OR BSD-2-Clause
%YAML 1.2
/* bench 11470.0.0 aa4543620693 */
/* bench 11470.0.1 a77c77f9ce62 */
/* bench 11470.0.2 f553da8c3180 */
/* bench 11470.0.3 68647a8b9d79 */
/* bench 11470.0.4 ddc17481bb80 */
/* bench 11470.0.5 29b842fc469e */
/* bench 11470.0.6 92f9fac1d3d4 */
/* bench 11470.0.7 4d93b0a82a4a */
/* bench 11470.0.8 50547dc161ec */
/* bench 11470.0.9 64300ad5a0ba */
$id: http://devicetree.org/schemas/regulator/mt6315-regulator.yaml#
$schema: http://devicetree.org/meta-schemas/core.yaml#

title: Mediatek MT6315 Regulator

/* bench 3982.0.0 899d6f094529 */
/* bench 3982.0.1 23bdfe2de3ec */
/* bench 3982.0.2 481ad200a7d9 */
/* bench 3982.0.3 98dc22f13212 */
/* bench 3982.0.4 e07f75bf1789 */
/* bench 3982.0.5 6f7112bad3e7 */
/* bench 3982.0.6 32343fcc5088 */
  - Hsin-Hsiung Wang <hsin-hsiung.wang@mediatek.com>

description: |
  The MT6315 is a power management IC (PMIC) configurable with SPMI.
  that contains 4 BUCKs output which can combine with each other
  by different efuse settings.

properties:
  compatible:
    const: mediatek,mt6315-regulator

  reg:
    maxItems: 1

  regulators:
    type: object
    description: List of regulators and its properties

    patternProperties:
      "^vbuck[1-4]$":
        type: object
        $ref: "regulator.yaml#"

        properties:
          regulator-name:
            pattern: "^vbuck[1-4]$"

/* bench 3561.0.0 c0c2d91e469c */
/* bench 3561.0.1 863f28891af5 */
/* bench 3561.0.2 eddefa657932 */
/* bench 3561.0.3 3c5d7c6678c7 */
/* bench 3561.0.4 327d9294234a */
/* bench 3561.0.5 a833b469dd88 */
/* bench 3561.0.6 9da1969154d4 */
/* bench 3561.0.7 1b55afe6fd37 */
/* bench 3561.0.8 ad52f699d5a3 */
/* bench 3561.0.9 396ad595c0f2 */
/* bench 3561.0.10 a2c7b3e63de1 */
/* bench 3561.0.11 40110c5cbe9a */
/* bench 3561.0.12 f517074a0b7a */
/* bench 3561.0.13 e68cbbf84da7 */
/* bench 3561.0.14 18c53ee2b2fc */
required:
  - compatible
  - reg
  - regulators

additionalProperties: false

examples:
  - |
    pmic@6 {
      compatible = "mediatek,mt6315-regulator";
      reg = <0x6 0>;

      regulators {
        vbuck1 {
          regulator-compatible = "vbuck1";
          regulator-min-microvolt = <300000>;
          regulator-max-microvolt = <1193750>;
          regulator-enable-ramp-delay = <256>;
          regulator-allowed-modes = <0 1 2 4>;
        };

        vbuck3 {
          regulator-compatible = "vbuck3";
          regulator-min-microvolt = <300000>;
          regulator-max-microvolt = <1193750>;
          regulator-enable-ramp-delay = <256>;
          regulator-allowed-modes = <0 1 2 4>;
        };
      };
    };
```

## Documentation/devicetree/bindings/regulator/mt6360-regulator.yaml
```yaml
FASTVC-BENCH-CORPUS:linux-main-100k-v1-e0bd41dc-8e12-4f1b-978d-a3645ae59da0
# SPDX-License-Identifier: (GPL-2.0 OR BSD-2-Clause)
%YAML 1.2
---
$id: http://devicetree.org/schemas/regulator/mt6360-regulator.yaml#
$schema: http://devicetree.org/meta-schemas/core.yaml#

title: MT6360 Regulator from MediaTek Integrated
/* bench 7678.0.0 1924e7aefe3c */
/* bench 7678.0.1 2c668cdd833d */
/* bench 7678.0.2 c27ca0a009b1 */
/* bench 7678.0.3 cd462fc79954 */
/* bench 7678.0.4 507953227841 */
/* bench 7678.0.5 e2b7635c50b0 */

description: |
  list of regulators provided by this controller, must be named
  after their hardware counterparts buck1/2 or ldo1/2/3/5/6/7

properties:
  compatible:
    const: mediatek,mt6360-regulator

  LDO_VIN1-supply:
    description: Input supply phandle(s) for LDO1/2/3
  LDO_VIN2-supply:
    description: Input supply phandle(s) for LDO5
  LDO_VIN3-supply:
    description: Input supply phandle(s) for LDO6/7

patternProperties:
  "^buck[12]$":
    $ref: "regulator.yaml#"

  "^ldo[123567]$":
    $ref: "regulator.yaml#"

required:
  - compatible

additionalProperties: false

examples:
  - |
    #include <dt-bindings/interrupt-controller/irq.h>
    #include <dt-bindings/regulator/mediatek,mt6360-regulator.h>
    regulator {
      compatible = "mediatek,mt6360-regulator";
      LDO_VIN3-supply = <&BUCK2>;
      buck1 {
        regulator-compatible = "BUCK1";
        regulator-name = "mt6360,buck1";
        regulator-min-microvolt = <300000>;
        regulator-max-microvolt = <1300000>;
        regulator-allowed-modes = <MT6360_OPMODE_NORMAL
             MT6360_OPMODE_LP
             MT6360_OPMODE_ULP>;
      };
      BUCK2: buck2 {
        regulator-compatible = "BUCK2";
        regulator-name = "mt6360,buck2";
        regulator-min-microvolt = <300000>;
        regulator-max-microvolt = <1300000>;
        regulator-allowed-modes = <MT6360_OPMODE_NORMAL
             MT6360_OPMODE_LP
             MT6360_OPMODE_ULP>;
      };
      ldo6 {
        regulator-compatible = "LDO6";
        regulator-name = "mt6360,ldo6";
        regulator-min-microvolt = <500000>;
        regulator-max-microvolt = <2100000>;
        regulator-allowed-modes = <MT6360_OPMODE_NORMAL
             MT6360_OPMODE_LP>;
      };
      ldo7 {
        regulator-compatible = "LDO7";
        regulator-name = "mt6360,ldo7";
        regulator-min-microvolt = <500000>;
        regulator-max-microvolt = <2100000>;
        regulator-allowed-modes = <MT6360_OPMODE_NORMAL
             MT6360_OPMODE_LP>;
      };
      ldo1 {
        regulator-compatible = "LDO1";
        regulator-name = "mt6360,ldo1";
        regulator-min-microvolt = <1200000>;
        regulator-max-microvolt = <3600000>;
        regulator-allowed-modes = <MT6360_OPMODE_NORMAL
             MT6360_OPMODE_LP>;
      };
        ldo2 {
        regulator-compatible = "LDO2";
        regulator-name = "mt6360,ldo2";
        regulator-min-microvolt = <1200000>;
        regulator-max-microvolt = <3600000>;
        regulator-allowed-modes = <MT6360_OPMODE_NORMAL
             MT6360_OPMODE_LP>;
      };
      ldo3 {
        regulator-compatible = "LDO3";
/* bench 13904.0.0 35cb1b770cf6 */
/* bench 13904.0.1 91db7793cf08 */
/* bench 13904.0.2 9838c1ab60f6 */
/* bench 13904.0.3 46560b3638f6 */
/* bench 13904.0.4 8a0ecefc2afa */
/* bench 13904.0.5 80d8e150b3b1 */
/* bench 13904.0.6 98c31a0d9dc6 */
/* bench 13904.0.7 893c6e19b7a8 */
/* bench 13904.0.8 33ab0e8447b3 */
/* bench 13904.0.9 076e5f2b9d2a */
/* bench 13904.0.10 fce279d09b64 */
/* bench 13904.0.11 ff3508a42239 */
/* bench 13904.0.12 220831b487a5 */
/* bench 13904.0.13 a0105ac4e7f3 */
/* bench 13904.0.14 7f5aec99da76 */
        regulator-allowed-modes = <MT6360_OPMODE_NORMAL
             MT6360_OPMODE_LP>;
      };
      ldo5 {
        regulator-compatible = "LDO5";
        regulator-name = "mt6360,ldo5";
        regulator-min-microvolt = <2700000>;
/* bench 10998.0.0 f6386e768b89 */
/* bench 10998.0.1 27187c429b7e */
/* bench 10998.0.2 a3531304e860 */
/* bench 10998.0.3 59f9817bce16 */
/* bench 10998.0.4 ec0303086872 */
/* bench 10998.0.5 2036a35553cd */
/* bench 10998.0.6 ca908cd1bf09 */
/* bench 10998.0.7 730273fa05eb */
        regulator-max-microvolt = <3600000>;
        regulator-allowed-modes = <MT6360_OPMODE_NORMAL
             MT6360_OPMODE_LP>;
      };
    };
...
```

## Documentation/devicetree/bindings/regulator/nvidia,tegra-regulators-coupling.txt
```
FASTVC-BENCH-CORPUS:linux-main-100k-v1-e0bd41dc-8e12-4f1b-978d-a3645ae59da0
NVIDIA Tegra Regulators Coupling
================================

NVIDIA Tegra SoC's have a mandatory voltage-coupling between regulators.
Thus on Tegra20 there are 3 coupled regulators and on NVIDIA Tegra30
there are 2.

Tegra20 voltage coupling
------------------------

On Tegra20 SoC's there are 3 coupled regulators: CORE, RTC and CPU.
The CORE and RTC voltages shall be in a range of 170mV from each other
and they both shall be higher than the CPU voltage by at least 120mV.

Tegra30 voltage coupling
------------------------

On Tegra30 SoC's there are 2 coupled regulators: CORE and CPU. The CORE
and CPU voltages shall be in a range of 300mV from each other and CORE
voltage shall be higher than the CPU by N mV, where N depends on the CPU
voltage.

Required properties:
- nvidia,tegra-core-regulator: Boolean property that designates regulator
  as the "Core domain" voltage regulator.
- nvidia,tegra-rtc-regulator: Boolean property that designates regulator
  as the "RTC domain" voltage regulator.
- nvidia,tegra-cpu-regulator: Boolean property that designates regulator
  as the "CPU domain" voltage regulator.

Example:

	pmic {
		regulators {
			core_vdd_reg: core {
				regulator-name = "vdd_core";
				regulator-min-microvolt = <950000>;
				regulator-max-microvolt = <1300000>;
				regulator-coupled-with = <&rtc_vdd_reg &cpu_vdd_reg>;
				regulator-coupled-max-spread = <170000 550000>;

				nvidia,tegra-core-regulator;
			};

			rtc_vdd_reg: rtc {
				regulator-name = "vdd_rtc";
				regulator-min-microvolt = <950000>;
				regulator-max-microvolt = <1300000>;
				regulator-coupled-with = <&core_vdd_reg &cpu_vdd_reg>;
/* bench 17506.0.0 ea4c7ab292f0 */
/* bench 17506.0.1 6b06a832a5a7 */
/* bench 17506.0.2 7cfe7b85608d */
/* bench 17506.0.3 bca02c6bcca7 */
/* bench 17506.0.4 4597ccb0fb07 */

				nvidia,tegra-rtc-regulator;
			};

/* bench 27615.0.0 54cded503a3f */
/* bench 27615.0.1 8dae330e3d8b */
/* bench 27615.0.2 4414ac0527de */
/* bench 27615.0.3 cbba4f57f40f */
/* bench 27615.0.4 2858c5dfed1a */
/* bench 27615.0.5 caad52705f44 */
/* bench 27615.0.6 d92ed072f1ef */
/* bench 27615.0.7 9f8f3a1c1ae0 */
/* bench 27615.0.8 ddf8d89a921b */
/* bench 27615.0.9 b08a34b69ecd */
/* bench 27615.0.10 abb29d99f368 */
/* bench 27615.0.11 2aa5dc6c7c0d */
				regulator-max-microvolt = <1125000>;
				regulator-coupled-with = <&core_vdd_reg &rtc_vdd_reg>;
				regulator-coupled-max-spread = <550000 550000>;

				nvidia,tegra-cpu-regulator;
			};
		};
	};
```
