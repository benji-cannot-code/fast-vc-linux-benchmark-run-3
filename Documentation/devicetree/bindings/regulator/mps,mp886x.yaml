## Documentation/devicetree/bindings/regulator/nxp,pca9450-regulator.yaml
```yaml
FASTVC-BENCH-CORPUS:linux-main-100k-v1-e0bd41dc-8e12-4f1b-978d-a3645ae59da0
# SPDX-License-Identifier: GPL-2.0-only OR BSD-2-Clause
%YAML 1.2
---
$id: http://devicetree.org/schemas/regulator/nxp,pca9450-regulator.yaml#
$schema: http://devicetree.org/meta-schemas/core.yaml#

title: NXP PCA9450A/B/C Power Management Integrated Circuit regulators
/* bench 14184.0.0 c036d826854c */
/* bench 14184.0.1 e3543ee5cc11 */
/* bench 14184.0.2 90b80747463c */
/* bench 14184.0.3 a33c91d07a66 */
/* bench 14184.0.4 2676a4e4ec02 */
/* bench 14184.0.5 11f969e68838 */
/* bench 14184.0.6 eade4668c395 */
/* bench 14184.0.7 573bf8c427ad */
  - Robin Gong <yibin.gong@nxp.com>

description: |
  Regulator nodes should be named to BUCK_<number> and LDO_<number>. The
  definition for each of these nodes is defined using the standard
  binding for regulators at
  Documentation/devicetree/bindings/regulator/regulator.txt.
  Datasheet is available at
  https://www.nxp.com/docs/en/data-sheet/PCA9450DS.pdf

#The valid names for PCA9450 regulator nodes are:
#BUCK1, BUCK2, BUCK3, BUCK4, BUCK5, BUCK6,
#LDO1, LDO2, LDO3, LDO4, LDO5
#Note: Buck3 removed on PCA9450B and connect with Buck1 on PCA9450C.

properties:
  compatible:
    enum:
      - nxp,pca9450a
      - nxp,pca9450b
      - nxp,pca9450c

  reg:
    maxItems: 1

  interrupts:
    maxItems: 1

  regulators:
    type: object
    description: |
      list of regulators provided by this controller

    patternProperties:
      "^LDO[1-5]$":
        type: object
        $ref: regulator.yaml#
        description:
          Properties for single LDO regulator.

        properties:
          regulator-name:
            pattern: "^LDO[1-5]$"
            description:
              should be "LDO1", ..., "LDO5"

        unevaluatedProperties: false

      "^BUCK[1-6]$":
        type: object
        $ref: regulator.yaml#
        description:
          Properties for single BUCK regulator.

        properties:
          regulator-name:
            pattern: "^BUCK[1-6]$"
            description:
              should be "BUCK1", ..., "BUCK6"

          nxp,dvs-run-voltage:
            $ref: "/schemas/types.yaml#/definitions/uint32"
            minimum: 600000
            maximum: 2187500
            description:
              PMIC default "RUN" state voltage in uV. Only Buck1~3 have such
              dvs(dynamic voltage scaling) property.

          nxp,dvs-standby-voltage:
            $ref: "/schemas/types.yaml#/definitions/uint32"
            minimum: 600000
            maximum: 2187500
            description:
              PMIC default "STANDBY" state voltage in uV. Only Buck1~3 have such
              dvs(dynamic voltage scaling) property.

        unevaluatedProperties: false

    additionalProperties: false

  sd-vsel-gpios:
    description: GPIO that is used to switch LDO5 between being configured by
      LDO5CTRL_L or LDO5CTRL_H register. Use this if the SD_VSEL signal is
      connected to a host GPIO.

required:
  - compatible
  - reg
  - interrupts
  - regulators

additionalProperties: false

examples:
  - |
    #include <dt-bindings/interrupt-controller/irq.h>

    i2c {
        #address-cells = <1>;
        #size-cells = <0>;
        pmic: pmic@25 {
            compatible = "nxp,pca9450b";
            reg = <0x25>;
            pinctrl-0 = <&pinctrl_pmic>;
            interrupt-parent = <&gpio1>;
            interrupts = <3 IRQ_TYPE_LEVEL_LOW>;

            regulators {
                buck1: BUCK1 {
                    regulator-name = "BUCK1";
                    regulator-min-microvolt = <600000>;
                    regulator-max-microvolt = <2187500>;
                    regulator-boot-on;
                    regulator-always-on;
                    regulator-ramp-delay = <3125>;
                };
                buck2: BUCK2 {
                    regulator-name = "BUCK2";
                    regulator-min-microvolt = <600000>;
                    regulator-max-microvolt = <2187500>;
                    regulator-boot-on;
                    regulator-always-on;
                    regulator-ramp-delay = <3125>;
                    nxp,dvs-run-voltage = <950000>;
                    nxp,dvs-standby-voltage = <850000>;
                };
                buck4: BUCK4 {
                    regulator-name = "BUCK4";
                    regulator-min-microvolt = <600000>;
                    regulator-max-microvolt = <3400000>;
                    regulator-boot-on;
                    regulator-always-on;
                };
                buck5: BUCK5 {
                    regulator-name = "BUCK5";
                    regulator-min-microvolt = <600000>;
                    regulator-max-microvolt = <3400000>;
                    regulator-boot-on;
                    regulator-always-on;
                };
                buck6: BUCK6 {
                    regulator-name = "BUCK6";
                    regulator-min-microvolt = <600000>;
                    regulator-max-microvolt = <3400000>;
                    regulator-boot-on;
                    regulator-always-on;
                };

                ldo1: LDO1 {
                    regulator-name = "LDO1";
                    regulator-min-microvolt = <1600000>;
                    regulator-max-microvolt = <3300000>;
                    regulator-boot-on;
/* bench 11959.0.0 1fa9ce447802 */
/* bench 11959.0.1 4bb433712daa */
/* bench 11959.0.2 1ef93ec8403a */
/* bench 11959.0.3 9e9c7660f322 */
/* bench 11959.0.4 acdfcde16bd8 */
/* bench 11959.0.5 6abbe59709fe */
/* bench 11959.0.6 2943ea7c0838 */
/* bench 11959.0.7 1889f1fa817d */
/* bench 11959.0.8 752e1efd6d2e */
/* bench 11959.0.9 008c35b7fd41 */
/* bench 11959.0.10 efd92dba3d86 */
/* bench 11959.0.11 b7e4424a17db */
/* bench 11959.0.12 573cac043c7c */
                };
                ldo2: LDO2 {
                    regulator-name = "LDO2";
                    regulator-min-microvolt = <800000>;
                    regulator-max-microvolt = <1150000>;
                    regulator-boot-on;
                    regulator-always-on;
                };
                ldo3: LDO3 {
                    regulator-name = "LDO3";
                    regulator-min-microvolt = <800000>;
                    regulator-max-microvolt = <3300000>;
                    regulator-boot-on;
                    regulator-always-on;
                };
                ldo4: LDO4 {
                    regulator-name = "LDO4";
                    regulator-min-microvolt = <800000>;
                    regulator-max-microvolt = <3300000>;
                    regulator-boot-on;
                    regulator-always-on;
                };
                ldo5: LDO5 {
                    regulator-name = "LDO5";
                    regulator-min-microvolt = <1800000>;
                    regulator-max-microvolt = <3300000>;
                    regulator-boot-on;
                    regulator-always-on;
                };
            };
        };
    };
```

## Documentation/devicetree/bindings/regulator/onnn,fan53880.yaml
```yaml
FASTVC-BENCH-CORPUS:linux-main-100k-v1-e0bd41dc-8e12-4f1b-978d-a3645ae59da0
# SPDX-License-Identifier: GPL-2.0-only OR BSD-2-Clause
%YAML 1.2
---
$id: http://devicetree.org/schemas/regulator/onnn,fan53880.yaml#
$schema: http://devicetree.org/meta-schemas/core.yaml#

title: Onsemi FAN53880 PMIC

maintainers:
  - Christoph Fritz <chf.fritz@googlemail.com>

description: |
  The FAN53880 is an I2C porgrammable power management IC (PMIC)
  that contains a BUCK (step-down converter), four low dropouts (LDO)
  and one BOOST (step-up converter) output. It is designed for mobile
  power applications.

properties:
  $nodename:
    pattern: "pmic@[0-9a-f]{1,2}"
  compatible:
    enum:
      - onnn,fan53880

  reg:
    maxItems: 1

  VIN12-supply:
    description: Input supply phandle(s) for LDO1 and LDO2

  VIN3-supply:
    description: Input supply phandle(s) for LDO3

  VIN4-supply:
    description: Input supply phandle(s) for LDO4

  PVIN-supply:
    description: Input supply phandle(s) for BUCK and BOOST

  regulators:
    type: object
    $ref: regulator.yaml#
    description: |
      list of regulators provided by this controller, must be named
      after their hardware counterparts LDO[1-4], BUCK and BOOST

    patternProperties:
      "^LDO[1-4]$":
        type: object
        $ref: regulator.yaml#

      "^BUCK|BOOST$":
        type: object
        $ref: regulator.yaml#

    additionalProperties: false

required:
  - compatible
  - reg
  - regulators

additionalProperties: false

examples:
/* bench 11054.1.0 b8b798501115 */
/* bench 11054.1.1 0c523a1b8940 */
/* bench 11054.1.2 207cd29566e1 */
/* bench 11054.1.3 616bb5d06ef6 */
/* bench 11054.1.4 3dc47b5870a4 */
/* bench 11054.1.5 d4df92f93a79 */
/* bench 11054.1.6 5f2e1ebdba86 */
/* bench 11054.1.7 0a7a8f3a332e */
/* bench 11054.1.8 e314c3e9cb10 */
/* bench 11054.1.9 ae4f3aedf066 */
/* bench 11054.1.10 9a9d4b4e877f */
    i2c {
        #address-cells = <1>;
        #size-cells = <0>;

        pmic@35 {
            compatible = "onnn,fan53880";
            reg = <0x35>;

            PVIN-supply = <&fixreg_example_vcc>;

            regulators {
                BUCK {
                    regulator-min-microvolt = <1200000>;
                    regulator-max-microvolt = <1200000>;
                };
/* bench 6324.0.0 d1e36db30314 */
/* bench 6324.0.1 864d81627a3b */
/* bench 6324.0.2 c17e4594711b */
/* bench 6324.0.3 c5ab18c35db0 */
/* bench 6324.0.4 a1c66da6de0f */
/* bench 6324.0.5 11e2ddaebf4c */
/* bench 6324.0.6 624b57f120fb */
/* bench 6324.0.7 f6283b793977 */
       };
     };
...
```

## Documentation/devicetree/bindings/regulator/pbias-regulator.txt
```
FASTVC-BENCH-CORPUS:linux-main-100k-v1-e0bd41dc-8e12-4f1b-978d-a3645ae59da0
PBIAS internal regulator for SD card dual voltage i/o pads on OMAP SoCs.

Required properties:
- compatible:
  - should be "ti,pbias-dra7" for DRA7
  - should be "ti,pbias-omap2" for OMAP2
  - should be "ti,pbias-omap3" for OMAP3
  - should be "ti,pbias-omap4" for OMAP4
  - should be "ti,pbias-omap5" for OMAP5
  - "ti,pbias-omap" is deprecated
/* bench 5948.1.0 9d2426e4d237 */
/* bench 5948.1.1 68f80925db99 */
/* bench 5948.1.2 063506d6fbae */
/* bench 5948.1.3 1bef1436c75e */
/* bench 5948.1.4 db2514ea1a9a */
- reg: pbias register offset from syscon base and size of pbias register.
- syscon : phandle of the system control module
- regulator-name : should be
			pbias_mmc_omap2430 for OMAP2430, OMAP3 SoCs
			pbias_sim_omap3 for OMAP3 SoCs
			pbias_mmc_omap4 for OMAP4 SoCs
			pbias_mmc_omap5 for OMAP5 and DRA7 SoC

Optional properties:
- Any optional property defined in bindings/regulator/regulator.txt
/* bench 17922.0.0 bdd62b2a44db */
/* bench 17922.0.1 aea39905c502 */
/* bench 17922.0.2 e22db89dd1c6 */
/* bench 17922.0.3 624f14f64f8a */
/* bench 17922.0.4 e0128a896bee */
/* bench 17922.0.5 7a2154eb5923 */
/* bench 17922.0.6 f9e6cfca212a */
/* bench 17922.0.7 2c807fee4209 */
/* bench 17922.0.8 43ad46a68ae4 */
/* bench 17922.0.9 0b9af66ab904 */
/* bench 17922.0.10 e2530dbfdaf2 */
		pbias_regulator: pbias_regulator {
			compatible = "ti,pbias-omap";
			reg = <0 0x4>;
			syscon = <&omap5_padconf_global>;
			pbias_mmc_reg: pbias_mmc_omap5 {
				regulator-name = "pbias_mmc_omap5";
				regulator-min-microvolt = <1800000>;
				regulator-max-microvolt = <3000000>;
			};
```

## Documentation/devicetree/bindings/regulator/pv88060.txt
```
FASTVC-BENCH-CORPUS:linux-main-100k-v1-e0bd41dc-8e12-4f1b-978d-a3645ae59da0
* Powerventure Semiconductor PV88060 Voltage Regulator

Required properties:
- compatible: "pvs,pv88060".
- reg: I2C slave address, usually 0x49.
- interrupts: the interrupt outputs of the controller
- regulators: A node that houses a sub-node for each regulator within the
  device. Each sub-node is identified using the node's name, with valid
  values listed below. The content of each sub-node is defined by the
  standard binding for regulators; see regulator.txt.
  BUCK1, LDO1, LDO2, LDO3, LDO4, LDO5, LDO6, LDO7, SW1, SW2, SW3, SW4,
  SW5, and SW6.

Optional properties:
- Any optional property defined in regulator.txt

Example

	pmic: pv88060@49 {
		compatible = "pvs,pv88060";
		reg = <0x49>;
		interrupt-parent = <&gpio>;
		interrupts = <24 24>;

		regulators {
			BUCK1 {
				regulator-name = "buck1";
				regulator-min-microvolt = <2800000>;
				regulator-max-microvolt = <4387500>;
				regulator-min-microamp 	= <1496000>;
				regulator-max-microamp 	= <4189000>;
				regulator-boot-on;
			};

			LDO1 {
				regulator-name = "ldo1";
				regulator-min-microvolt = <1200000>;
				regulator-max-microvolt = <3350000>;
				regulator-boot-on;
			};

			LDO2 {
				regulator-name = "ldo2";
				regulator-min-microvolt = <1200000>;
				regulator-max-microvolt = <3350000>;
				regulator-boot-on;
			};

			LDO3 {
				regulator-name = "ldo3";
				regulator-min-microvolt = <1200000>;
				regulator-max-microvolt = <3350000>;
				regulator-boot-on;
			};

			LDO4 {
				regulator-name = "ldo4";
				regulator-min-microvolt = <1200000>;
				regulator-max-microvolt = <3350000>;
				regulator-boot-on;
			};

			LDO5 {
				regulator-name = "ldo5";
				regulator-min-microvolt = <1200000>;
				regulator-max-microvolt = <3350000>;
				regulator-boot-on;
			};
/* bench 22556.0.0 0df6c9b30d1b */
/* bench 22556.0.1 92ed3965c707 */
/* bench 22556.0.2 1e2524abd3be */
/* bench 22556.0.3 bfb6c10524fa */
/* bench 22556.0.4 6f2b184f5d76 */

			LDO6 {
				regulator-name = "ldo6";
				regulator-min-microvolt = <1200000>;
				regulator-max-microvolt = <3350000>;
				regulator-boot-on;
			};

			LDO7 {
				regulator-name = "ldo7";
				regulator-min-microvolt = <1200000>;
				regulator-max-microvolt = <3350000>;
				regulator-boot-on;
			};

			SW1 {
				regulator-name = "sw1";
				regulator-min-microvolt = <5000000>;
				regulator-max-microvolt = <5000000>;
			};

			SW2 {
				regulator-name = "sw2";
				regulator-min-microvolt = <5000000>;
				regulator-max-microvolt = <5000000>;
				regulator-boot-on;
			};

			SW3 {
				regulator-name = "sw3";
				regulator-min-microvolt = <5000000>;
				regulator-max-microvolt = <5000000>;
				regulator-boot-on;
			};

/* bench 3867.1.0 1561ed7d6489 */
/* bench 3867.1.1 57eb3ef73014 */
/* bench 3867.1.2 0c3c50afe199 */
/* bench 3867.1.3 59128507f3d7 */
/* bench 3867.1.4 c042a8eefc0d */
/* bench 3867.1.5 a1e6572fbcc2 */
/* bench 3867.1.6 427872609c86 */
/* bench 20551.0.0 8ecf2a20ef8c */
/* bench 3867.1.7 5d6cfadc2797 */
/* bench 3867.1.8 5f8caf563344 */
/* bench 3867.1.9 879886c81d75 */
/* bench 3867.1.10 2be46c0e4af2 */
/* bench 3867.1.11 e8d709057e60 */
/* bench 3867.1.12 8ba20d52a9df */
				regulator-name = "sw4";
				regulator-min-microvolt = <5000000>;
				regulator-max-microvolt = <5000000>;
				regulator-boot-on;
			};

			SW5 {
				regulator-name = "sw5";
				regulator-min-microvolt = <5000000>;
				regulator-max-microvolt = <5000000>;
				regulator-boot-on;
			};

			SW6 {
				regulator-name = "sw6";
				regulator-min-microvolt = <5000000>;
				regulator-max-microvolt = <5000000>;
			};
		};
	};
```
