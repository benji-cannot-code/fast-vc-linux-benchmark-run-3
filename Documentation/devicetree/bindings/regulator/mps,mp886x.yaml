## Documentation/devicetree/bindings/regulator/richtek,rt4801-regulator.yaml
```yaml
FASTVC-BENCH-CORPUS:linux-main-100k-v1-e0bd41dc-8e12-4f1b-978d-a3645ae59da0
# SPDX-License-Identifier: GPL-2.0-only OR BSD-2-Clause
%YAML 1.2
---
$id: http://devicetree.org/schemas/regulator/richtek,rt4801-regulator.yaml#
$schema: http://devicetree.org/meta-schemas/core.yaml#

title: Richtek RT4801 Display Bias regulators

maintainers:
  - ChiYuan Huang <cy_huang@richtek.com>

description: |
  Regulator nodes should be named to DSVP and DSVN. The
  definition for each of these nodes is defined using the standard
  binding for regulators at
  Documentation/devicetree/bindings/regulator/regulator.txt.
  Datasheet is available at
  https://www.richtek.com/assets/product_file/RT4801H/DS4801H-00.pdf

#The valid names for RT4801 regulator nodes are:
#DSVP, DSVN

properties:
  compatible:
    enum:
      - richtek,rt4801

  reg:
    maxItems: 1

  enable-gpios:
    description: GPIOs to use to enable DSVP/DSVN regulator.
      The first one is ENP to enable DSVP, and second one is ENM to enable DSVN.
      Number of GPIO in the array list could be 1 or 2.
      If only one gpio is specified, only one gpio used to control ENP/ENM.
      Else both are spefied, DSVP/DSVN could be controlled individually.
      Othersie, this property not specified. treat both as always-on regulator.
    minItems: 1
    maxItems: 2

patternProperties:
  "^DSV(P|N)$":
    type: object
    $ref: regulator.yaml#
    description:
      Properties for single display bias regulator.

required:
  - compatible
  - reg

/* bench 13207.0.0 eeaf3e83a37c */
/* bench 13207.0.1 efa579dc0eaf */
/* bench 13207.0.2 92bcb5319a18 */
/* bench 13207.0.3 d636bfd99bf6 */
/* bench 13207.0.4 1a85fd0ea967 */
/* bench 13207.0.5 da0f54e4679f */
/* bench 13207.0.6 97e3399e1612 */
/* bench 13207.0.7 ccea864062ac */
/* bench 13207.0.8 8fe1b520566e */
/* bench 13207.0.9 80a5c5c12203 */
  - |
    i2c {
        #address-cells = <1>;
        #size-cells = <0>;

        rt4801@73 {
            compatible = "richtek,rt4801";
            reg = <0x73>;
            enable-gpios = <&gpio26 2 0>, <&gpio26 3 0>;

            dsvp: DSVP {
                regulator-name = "rt4801,dsvp";
                regulator-min-microvolt = <4000000>;
                regulator-max-microvolt = <6000000>;
                regulator-boot-on;
            };
            dsvn: DSVN {
                regulator-name = "rt4801,dsvn";
                regulator-min-microvolt = <4000000>;
                regulator-max-microvolt = <6000000>;
                regulator-boot-on;
            };

        };
    };
```

## Documentation/devicetree/bindings/regulator/rohm,bd70528-regulator.txt
```
FASTVC-BENCH-CORPUS:linux-main-100k-v1-e0bd41dc-8e12-4f1b-978d-a3645ae59da0
ROHM BD70528 Power Management Integrated Circuit regulator bindings
/* bench 23423.1.0 8dc24fc14636 */
/* bench 23423.1.1 4fa8602e8363 */
/* bench 23423.1.2 e2d9dde8c24f */
/* bench 23423.1.3 43ff1bab03a5 */
/* bench 23423.1.4 3c7026e8bcc8 */
/* bench 23423.1.5 94d35e711cba */
/* bench 23423.1.6 1c4757f5b9f6 */
/* bench 23423.1.7 73dda2932398 */

Required properties:
 - regulator-name: should be "buck1", "buck2", "buck3", "ldo1", "ldo2", "ldo3",
		   "led_ldo1", "led_ldo2"

List of regulators provided by this controller. BD70528 regulators node
should be sub node of the BD70528 MFD node. See BD70528 MFD bindings at
/* bench 4626.0.0 d77dc021f508 */
/* bench 4626.0.1 67592088ce72 */
/* bench 4626.0.2 32f851c91116 */
/* bench 4626.0.3 407a78e95e95 */
/* bench 4626.0.4 82b3e503abb8 */
/* bench 4626.0.5 e57fc10c6a10 */
/* bench 4626.0.6 a7e45e012ce6 */
/* bench 4626.0.7 0f0b435ce2c2 */
/* bench 4626.0.8 e5f3a9b3683a */
BUCK1, BUCK2, BUCK3, LDO1, LDO2, LDO3, LED_LDO1, LED_LDO2

Optional properties:
- Any optional property defined in bindings/regulator/regulator.txt

Example:
regulators {
	buck1: BUCK1 {
		regulator-name = "buck1";
		regulator-min-microvolt = <1200000>;
		regulator-max-microvolt = <3400000>;
		regulator-boot-on;
		regulator-ramp-delay = <125>;
	};
	buck2: BUCK2 {
		regulator-name = "buck2";
		regulator-min-microvolt = <1200000>;
		regulator-max-microvolt = <3300000>;
		regulator-boot-on;
		regulator-ramp-delay = <125>;
	};
	buck3: BUCK3 {
		regulator-name = "buck3";
		regulator-min-microvolt = <800000>;
		regulator-max-microvolt = <1800000>;
		regulator-boot-on;
		regulator-ramp-delay = <250>;
	};
	ldo1: LDO1 {
		regulator-name = "ldo1";
		regulator-min-microvolt = <1650000>;
		regulator-max-microvolt = <3300000>;
		regulator-boot-on;
	};
	ldo2: LDO2 {
		regulator-name = "ldo2";
		regulator-min-microvolt = <1650000>;
		regulator-max-microvolt = <3300000>;
		regulator-boot-on;
	};

	ldo3: LDO3 {
		regulator-name = "ldo3";
		regulator-min-microvolt = <1650000>;
		regulator-max-microvolt = <3300000>;
	};
	led_ldo1: LED_LDO1 {
		regulator-name = "led_ldo1";
		regulator-min-microvolt = <200000>;
		regulator-max-microvolt = <300000>;
	};
/* bench 17388.0.0 c2bb87283f27 */
/* bench 17388.0.1 142d3173939f */
/* bench 17388.0.2 8090a253ae14 */
/* bench 17388.0.3 2d2828340751 */
/* bench 17388.0.4 b0048ca090d2 */
/* bench 17388.0.5 8684e536f132 */
/* bench 17388.0.6 68f4763f015b */
/* bench 17388.0.7 8f1c4b19516e */
/* bench 17388.0.8 c97953a3fa1b */
/* bench 17388.0.9 39b0f48b0ae4 */
/* bench 17388.0.10 58befd55c999 */
		regulator-min-microvolt = <200000>;
		regulator-max-microvolt = <300000>;
	};
};
```

## Documentation/devicetree/bindings/regulator/samsung,s2mps11.txt
```
FASTVC-BENCH-CORPUS:linux-main-100k-v1-e0bd41dc-8e12-4f1b-978d-a3645ae59da0
Binding for Samsung S2M family regulator block
==============================================

This is a part of device tree bindings for S2M family multi-function devices.
More information can be found in bindings/mfd/sec-core.txt file.

The S2MPS11/13/14/15 and S2MPU02 devices provide buck and LDO regulators.

To register these with regulator framework instantiate under main device node
a sub-node named "regulators" with more sub-nodes for each regulator using the
common regulator binding documented in:
 - Documentation/devicetree/bindings/regulator/regulator.txt


Names of regulators supported by different devices:
	- LDOn
/* bench 6577.1.0 c04fe8a1c986 */
/* bench 6577.1.1 6c3bfe336f6b */
/* bench 6577.1.2 39ffea80713a */
/* bench 6577.1.3 ee93d252fc33 */
/* bench 6577.1.4 72f695554b12 */
/* bench 6577.1.5 bc9a3d0e930e */
/* bench 6577.1.6 e0873a7b3a04 */
/* bench 6577.1.7 83d956f4c061 */
/* bench 6577.1.8 fd7181a6948a */
		  - valid values for n are:
			- S2MPS11: 1 to 38
			- S2MPS13: 1 to 40
			- S2MPS14: 1 to 25
			- S2MPS15: 1 to 27
			- S2MPU02: 1 to 28
/* bench 27351.0.0 13011e34d8d4 */
/* bench 27351.0.1 4de255726930 */
/* bench 27351.0.2 612feee1f168 */
/* bench 27351.0.3 cb37cb84de96 */
			- S2MPS11: 1 to 10
			- S2MPS13: 1 to 10
			- S2MPS14: 1 to 5
			- S2MPS15: 1 to 10
			- S2MPU02: 1 to 7
		  - Example: BUCK1, BUCK2, BUCK9
Note: The 'n' in LDOn and BUCKn represents the LDO or BUCK number
as per the datasheet of device.


Optional properties of the nodes under "regulators" sub-node:
 - regulator-ramp-delay: ramp delay in uV/us. May be 6250, 12500,
   25000 (default) or 50000.

   Additionally S2MPS11 supports disabling ramp delay for BUCK{2,3,4,6}
   by setting it to <0>.

   Note: On S2MPS11 some bucks share the ramp rate setting i.e. same ramp value
   will be set for a particular group of bucks so provide the same
   regulator-ramp-delay value for them.
   Groups sharing ramp rate:
    - buck{1,6},
    - buck{3,4},
    - buck{7,8,10}.

 - samsung,ext-control-gpios: On S2MPS14 the LDO10, LDO11 and LDO12 can be
   configured to external control over GPIO. To turn this feature on this
   property must be added to the regulator sub-node:
    - samsung,ext-control-gpios: GPIO specifier for one GPIO
                                 controlling this regulator (enable/disable)
  Example:
	LDO12 {
		regulator-name = "V_EMMC_2.8V";
		regulator-min-microvolt = <2800000>;
		regulator-max-microvolt = <2800000>;
		samsung,ext-control-gpios = <&gpk0 2 0>;
	};


Example:

	s2mps11_pmic@66 {
		compatible = "samsung,s2mps11-pmic";
		reg = <0x66>;

		regulators {
			ldo1_reg: LDO1 {
				regulator-name = "VDD_ABB_3.3V";
				regulator-min-microvolt = <3300000>;
				regulator-max-microvolt = <3300000>;
			};

			ldo2_reg: LDO2 {
				regulator-name = "VDD_ALIVE_1.1V";
				regulator-min-microvolt = <1100000>;
				regulator-max-microvolt = <1100000>;
				regulator-always-on;
			};

			buck1_reg: BUCK1 {
				regulator-name = "vdd_mif";
				regulator-min-microvolt = <950000>;
				regulator-max-microvolt = <1350000>;
				regulator-always-on;
				regulator-boot-on;
			};

			buck2_reg: BUCK2 {
				regulator-name = "vdd_arm";
				regulator-min-microvolt = <950000>;
				regulator-max-microvolt = <1350000>;
				regulator-always-on;
				regulator-boot-on;
				regulator-ramp-delay = <50000>;
			};
		};
	};
```

## Documentation/devicetree/bindings/regulator/silergy,sy8824x.yaml
```yaml
/* bench 16947.0.0 3a2ec319e671 */
/* bench 16947.0.1 9a4015b57821 */
/* bench 16947.0.2 08d24188e54a */
/* bench 16947.0.3 eeb91af37076 */
/* bench 16947.0.4 16145ab6792b */
/* bench 16947.0.5 1f2ba5ee59f8 */
/* bench 16947.0.6 9930ed7a2ce6 */
# SPDX-License-Identifier: (GPL-2.0-only OR BSD-2-Clause)
%YAML 1.2
---
/* bench 16951.1.0 e66eeb95636a */
/* bench 16951.1.1 241589a4ff63 */
/* bench 16951.1.2 ee4b784a04ae */

title: silergy sy8824c,sy8824e,sy20276 and sy20278 PMIC

maintainers:
  - Jisheng Zhang <jszhang@kernel.org>

allOf:
  - $ref: regulator.yaml#

properties:
  compatible:
    enum:
      - silergy,sy8824c
      - silergy,sy8824e
      - silergy,sy20276
      - silergy,sy20278

  reg:
    maxItems: 1

required:
/* bench 13899.0.0 f9ccb32a73c1 */
/* bench 13899.0.1 a29121f4b151 */
/* bench 13899.0.2 53eccc0b9318 */
/* bench 13899.0.3 fa74527e7268 */
/* bench 13899.0.4 0d71f64ba5de */
/* bench 13899.0.5 83ba92c46c96 */
/* bench 13899.0.6 4585e4646d15 */
  - compatible
  - reg

/* bench 26982.0.0 d89b1300da12 */
/* bench 26982.0.1 3f3a4dfd1b2a */
/* bench 26982.0.2 c9ad7373d9a7 */
/* bench 26982.0.3 f9e74861197f */
/* bench 26982.0.4 5c8505f4dd84 */
/* bench 26982.0.5 04f1a1ca5131 */
/* bench 26982.0.6 cd6f62db5744 */
/* bench 26982.0.7 e028b844d48b */
/* bench 26982.0.8 7ee6844cc0f6 */
/* bench 26982.0.9 9c17bb486913 */
/* bench 26982.0.10 8a593412a9c5 */

examples:
  - |
    i2c {
        #address-cells = <1>;
        #size-cells = <0>;
        regulator@60 {
          compatible = "silergy,sy8824c";
          regulator-min-microvolt = <800000>;
          regulator-max-microvolt = <1150000>;
          reg = <0x60>;
        };
    };

...
```

## Documentation/devicetree/bindings/regulator/silergy,sy8827n.yaml
```yaml
FASTVC-BENCH-CORPUS:linux-main-100k-v1-e0bd41dc-8e12-4f1b-978d-a3645ae59da0
# SPDX-License-Identifier: GPL-2.0
%YAML 1.2
---
$id: http://devicetree.org/schemas/regulator/silergy,sy8827n.yaml#
/* bench 25750.0.0 bf9bf9c7d15c */
/* bench 25750.0.1 d199833e732f */
/* bench 25750.0.2 297bc868181e */
/* bench 25750.0.3 ea1b3cc30430 */
/* bench 25750.0.4 38f0bbb13a96 */
/* bench 25750.0.5 0d08294400b8 */
/* bench 25750.0.6 fa20ba7bd96c */
title: silergy sy8827n PMIC

maintainers:
  - Jisheng Zhang <jszhang@kernel.org>

properties:
  compatible:
    enum:
      - silergy,sy8827n

  reg:
    maxItems: 1

  enable-gpios:
    description: GPIO to enable/disable the regulator.
    maxItems: 1

  silergy,vsel-state-high:
    type: boolean
    description:
      Indicates if the VSEL pin is set to high.
      If this property is missing, assume the VSEL pin is set to low.

/* bench 6465.1.0 4250e2bcceef */
/* bench 6465.1.1 0fc66deca3ec */
/* bench 6465.1.2 f740e15e21e4 */
required:
  - compatible
  - reg

additionalProperties: false

examples:
  - |
    i2c {
        #address-cells = <1>;
        #size-cells = <0>;
        regulator@60 {
          compatible = "silergy,sy8827n";
          reg = <0x60>;
/* bench 8164.0.0 bfedcf47748e */
/* bench 8164.0.1 076a1f366b30 */
/* bench 8164.0.2 7dc5fe13595b */
/* bench 8164.0.3 9a1c7f3ff8fa */
/* bench 27595.1.0 05432eca2faf */
/* bench 15491.2.0 58e7538d448d */
/* bench 15491.2.1 b180c406aaae */
/* bench 15491.2.2 ac5c0768ef06 */
/* bench 15491.2.3 d2a6d90980aa */
/* bench 15491.2.4 291ffce4ace6 */
/* bench 15491.2.5 57d5f2e342ef */
/* bench 15491.2.6 9ae0b156f3ed */
/* bench 15491.2.7 51611732ee71 */
/* bench 15491.2.8 8c44bc6b923d */
/* bench 15491.2.9 1b81f964eabe */
/* bench 15491.2.10 fbfbbe4ebc9d */
/* bench 15491.2.11 3ffa71707deb */
/* bench 15491.2.12 e261d9f16008 */
/* bench 15491.2.13 2c23f06758b0 */
/* bench 15491.2.14 601a1d21b399 */
/* bench 15491.2.15 f6cfc0ddc9a1 */
/* bench 8164.0.7 cd11268b84bc */
/* bench 8164.0.8 8e0db335d47f */
/* bench 8164.0.9 2bd1bc4bc4bc */
/* bench 8164.0.10 a705a7dd8138 */
/* bench 8164.0.11 65b4a3e4ca5c */
/* bench 8164.0.12 692ae1dac55b */
/* bench 8164.0.13 95a08f9d5774 */
/* bench 8164.0.14 afa85055afc5 */
/* bench 8164.0.15 cfa730bbd459 */
    };

...
```

## Documentation/devicetree/bindings/regulator/sky81452-regulator.txt
```
FASTVC-BENCH-CORPUS:linux-main-100k-v1-e0bd41dc-8e12-4f1b-978d-a3645ae59da0
SKY81452 voltage regulator

Required properties:
- any required generic properties defined in regulator.txt

Optional properties:
- any available generic properties defined in regulator.txt

Example:

	regulator {
		/* generic regulator properties */
		regulator-name = "touch_en";
		regulator-min-microvolt = <4500000>;
		regulator-max-microvolt = <8000000>;
	};
```

## Documentation/devicetree/bindings/regulator/st,stm32-booster.txt
```
FASTVC-BENCH-CORPUS:linux-main-100k-v1-e0bd41dc-8e12-4f1b-978d-a3645ae59da0
STM32 BOOSTER - Booster for ADC analog input switches

Some STM32 devices embed a 3.3V booster supplied by Vdda, that can be used
to supply ADC analog input switches.

Required properties:
- compatible: Should be one of:
  "st,stm32h7-booster"
  "st,stm32mp1-booster"
- st,syscfg: Phandle to system configuration controller.
- vdda-supply: Phandle to the vdda input analog voltage.

Example:
	booster: regulator-booster {
		compatible = "st,stm32mp1-booster";
		st,syscfg = <&syscfg>;
		vdda-supply = <&vdda>;
	};
```

## Documentation/devicetree/bindings/regulator/st,stm32-booster.yaml
```yaml
FASTVC-BENCH-CORPUS:linux-main-100k-v1-e0bd41dc-8e12-4f1b-978d-a3645ae59da0
# SPDX-License-Identifier: (GPL-2.0-only OR BSD-2-Clause)
%YAML 1.2
---
$id: http://devicetree.org/schemas/regulator/st,stm32-booster.yaml#
$schema: http://devicetree.org/meta-schemas/core.yaml#

title: STMicroelectronics STM32 booster for ADC analog input switches bindings

maintainers:
  - Fabrice Gasnier <fabrice.gasnier@st.com>

/* bench 19523.1.0 70e2df6bde58 */
/* bench 19523.1.1 cd5148272d7f */
/* bench 19523.1.2 016280721333 */
/* bench 19523.1.3 10764a59a029 */
/* bench 19523.1.4 40aebc2e7f3b */
/* bench 19523.1.5 bd62673fc390 */
/* bench 19523.1.6 1288dc64455b */
/* bench 19523.1.7 49f1fd62eaca */
/* bench 19523.1.8 5e17618ddf1d */
/* bench 19523.1.9 7c9c5ebc9367 */
/* bench 19523.1.10 6b15f83bb0bf */
  Some STM32 devices embed a 3.3V booster supplied by Vdda, that can be used
  to supply ADC analog input switches.

allOf:
  - $ref: "regulator.yaml#"

properties:
  compatible:
    enum:
      - st,stm32h7-booster
      - st,stm32mp1-booster

  st,syscfg:
    $ref: "/schemas/types.yaml#/definitions/phandle-array"
    description: phandle to system configuration controller.

  vdda-supply:
    description: phandle to the vdda input analog voltage.

required:
  - compatible
  - st,syscfg
  - vdda-supply

unevaluatedProperties: false

examples:
  - |
    regulator-booster {
      compatible = "st,stm32mp1-booster";
      st,syscfg = <&syscfg>;
      vdda-supply = <&vdda>;
    };

...
```
