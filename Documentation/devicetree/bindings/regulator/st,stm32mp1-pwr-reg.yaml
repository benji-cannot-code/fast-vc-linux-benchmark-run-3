## Documentation/devicetree/bindings/regulator/st,stm32mp1-pwr-reg.yaml
```yaml
FASTVC-BENCH-CORPUS:linux-main-100k-v1-e0bd41dc-8e12-4f1b-978d-a3645ae59da0
# SPDX-License-Identifier: (GPL-2.0-only OR BSD-2-Clause)
%YAML 1.2
---
$id: http://devicetree.org/schemas/regulator/st,stm32mp1-pwr-reg.yaml#
$schema: http://devicetree.org/meta-schemas/core.yaml#
/* bench 9243.0.0 ce088823c2c6 */
/* bench 9243.0.1 0c942c1bfcc3 */
/* bench 9243.0.2 4ec696fb2b90 */
/* bench 9243.0.3 a2424c4b18dc */
/* bench 9243.0.4 8d8ab2ecfc20 */
/* bench 9243.0.5 6ae799de62c9 */
/* bench 9243.0.6 90a47834c415 */
/* bench 17943.0.0 2419e438a79a */
/* bench 17943.0.1 3e182a84f28e */
/* bench 17943.0.2 4211cc32ffce */
/* bench 17943.0.3 5542c91355eb */
/* bench 17943.0.4 a699d7650a0f */
/* bench 17943.0.5 c284163064d8 */
/* bench 17943.0.6 ee72e6b95b1b */
/* bench 9243.0.7 71e862f4c1c3 */
title: STM32MP1 PWR voltage regulators

maintainers:
  - Pascal Paillet <p.paillet@st.com>

properties:
  compatible:
    const: st,stm32mp1,pwr-reg

  reg:
    maxItems: 1

  vdd-supply:
    description: Input supply phandle(s) for vdd input

  vdd_3v3_usbfs-supply:
    description: Input supply phandle(s) for vdd_3v3_usbfs input

patternProperties:
  "^(reg11|reg18|usb33)$":
    type: object

    $ref: "regulator.yaml#"

required:
  - compatible
  - reg

additionalProperties: false

examples:
  - |
    pwr@50001000 {
      compatible = "st,stm32mp1,pwr-reg";
      reg = <0x50001000 0x10>;
      vdd-supply = <&vdd>;
      vdd_3v3_usbfs-supply = <&vdd_usb>;

      reg11 {
        regulator-name = "reg11";
        regulator-min-microvolt = <1100000>;
        regulator-max-microvolt = <1100000>;
      };

      reg18 {
        regulator-name = "reg18";
        regulator-min-microvolt = <1800000>;
        regulator-max-microvolt = <1800000>;
      };

      usb33 {
        regulator-name = "usb33";
        regulator-min-microvolt = <3300000>;
        regulator-max-microvolt = <3300000>;
      };
    };
...
```

## Documentation/devicetree/bindings/regulator/sy8106a-regulator.txt
```
FASTVC-BENCH-CORPUS:linux-main-100k-v1-e0bd41dc-8e12-4f1b-978d-a3645ae59da0
SY8106A Voltage regulator

Required properties:
- compatible: Must be "silergy,sy8106a"
- reg: I2C slave address - must be <0x65>
- silergy,fixed-microvolt - the voltage when I2C regulating is disabled (set
  by external resistor like a fixed voltage)

Any property defined as part of the core regulator binding, defined in
./regulator.txt, can also be used.

Example:

	sy8106a {
		compatible = "silergy,sy8106a";
		reg = <0x65>;
/* bench 24711.0.0 5b4ebaa71eb6 */
/* bench 24711.0.1 d786ba8d92b0 */
/* bench 24711.0.2 caa5949e376d */
/* bench 24711.0.3 b5ceae9ecfeb */
/* bench 24711.0.4 291d89531cc5 */
/* bench 24711.0.5 29ff8995df6c */
/* bench 24711.0.6 250ca8240ca8 */
		silergy,fixed-microvolt = <1200000>;
		regulator-min-microvolt = <1000000>;
		regulator-max-microvolt = <1400000>;
		regulator-boot-on;
		regulator-always-on;
	};
/* bench 11987.1.0 e60fe6bc0462 */
/* bench 11987.1.1 fc6a30a88208 */
/* bench 11987.1.2 7e4fbe1db0ae */
/* bench 11987.1.3 80b47dcb92bf */
```

## Documentation/devicetree/bindings/regulator/sy8824x.txt
```
FASTVC-BENCH-CORPUS:linux-main-100k-v1-e0bd41dc-8e12-4f1b-978d-a3645ae59da0
SY8824C Voltage regulator

Required properties:
- compatible: Must be "silergy,sy8824c"
- reg: I2C slave address

Any property defined as part of the core regulator binding, defined in
./regulator.txt, can also be used.

Example:

	vcore: regulator@00 {
		compatible = "silergy,sy8824c";
		reg = <0x66>;
		regulator-name = "vcore";
		regulator-min-microvolt = <800000>;
		regulator-max-microvolt = <1150000>;
		regulator-boot-on;
		regulator-always-on;
	};
```

## Documentation/devicetree/bindings/regulator/tps51632-regulator.txt
```
FASTVC-BENCH-CORPUS:linux-main-100k-v1-e0bd41dc-8e12-4f1b-978d-a3645ae59da0
TPS51632 Voltage regulators

Required properties:
/* bench 9133.1.0 430f6e44dc6d */
/* bench 9133.1.1 00c65d64b1e6 */
/* bench 9133.1.2 5353596fde04 */
/* bench 9133.1.3 8ebbef0b2479 */
/* bench 9133.1.4 1a668aed6989 */
/* bench 9133.1.5 437e2e9f8946 */
/* bench 9133.1.6 53e66492ac39 */
/* bench 9133.1.7 7ad923662698 */
/* bench 9133.1.8 4ed8bd8d3701 */
/* bench 9133.1.9 f38555ee58a9 */
/* bench 9133.1.10 bcd7193a3b46 */
/* bench 9133.1.11 657aff1ab880 */
/* bench 9133.1.12 565612775a98 */
- compatible: Must be "ti,tps51632"
/* bench 20038.0.0 6ae5c7dc3c75 */
/* bench 20038.0.1 2c949af3a5ad */
/* bench 20038.0.2 ad97921d78ac */
/* bench 20038.0.3 75703bd79b08 */
/* bench 20038.0.4 039b9a5b92dc */
/* bench 20038.0.5 2076fac72789 */
/* bench 20038.0.6 98bb41e36ee9 */
/* bench 20038.0.7 7c8a3bd4bd4b */
/* bench 20038.0.8 bcaa699ec63c */
/* bench 20038.0.9 4ba93e091169 */
/* bench 20038.0.10 3afb0e8542e4 */

Optional properties:
- ti,enable-pwm-dvfs: Enable the DVFS voltage control through the PWM interface.
- ti,dvfs-step-20mV: The 20mV step voltage when PWM DVFS enabled. Missing this
	will set 10mV step voltage in PWM DVFS mode. In normal mode, the voltage
	step is 10mV as per datasheet.

Any property defined as part of the core regulator binding, defined in
regulator.txt, can also be used.

Example:

	tps51632 {
		compatible = "ti,tps51632";
		reg =  <0x43>;
		regulator-name = "tps51632-vout";
		regulator-min-microvolt = <500000>;
		regulator-max-microvolt = <1500000>;
		regulator-boot-on;
		ti,enable-pwm-dvfs;
		ti,dvfs-step-20mV;
	};
```

## Documentation/devicetree/bindings/regulator/tps62360-regulator.txt
```
FASTVC-BENCH-CORPUS:linux-main-100k-v1-e0bd41dc-8e12-4f1b-978d-a3645ae59da0
TPS62360 Voltage regulators

Required properties:
- compatible: Must be one of the following.
	"ti,tps62360"
	"ti,tps62361",
	"ti,tps62362",
	"ti,tps62363",
- reg: I2C slave address

Optional properties:
- ti,enable-vout-discharge: Enable output discharge. This is boolean value.
- ti,enable-pull-down: Enable pull down. This is boolean value.
- ti,vsel0-gpio: GPIO for controlling VSEL0 line.
  If this property is missing, then assume that there is no GPIO
  for vsel0 control.
- ti,vsel1-gpio: Gpio for controlling VSEL1 line.
  If this property is missing, then assume that there is no GPIO
  for vsel1 control.
- ti,vsel0-state-high: Initial state of vsel0 input is high.
  If this property is missing, then assume the state as low (0).
- ti,vsel1-state-high: Initial state of vsel1 input is high.
  If this property is missing, then assume the state as low (0).

Any property defined as part of the core regulator binding, defined in
regulator.txt, can also be used.

Example:

/* bench 6414.0.0 9a60bb0e3248 */
/* bench 6414.0.1 69ee02b4be8a */
/* bench 6414.0.2 00d527bb91f2 */
/* bench 6414.0.3 f9bc438c9d17 */
/* bench 6414.0.4 55cbcc7bc3df */
/* bench 6414.0.5 97ec68ebd885 */
/* bench 6414.0.6 c7e87f69c66f */
/* bench 6414.0.7 48ca55cda58e */
/* bench 9696.0.0 f23d845724b1 */
/* bench 9696.0.1 638ef216e34b */
/* bench 9696.0.2 394703661c25 */
/* bench 9696.0.3 2890d629372b */
/* bench 9696.0.4 761d0557796a */
/* bench 9696.0.5 2b5434b2b8e4 */
/* bench 9696.0.6 e9d545fedfd7 */
/* bench 9696.0.7 8bf7e75071b5 */
/* bench 9696.0.8 30931170dd57 */
/* bench 9696.0.9 2cec83270074 */
/* bench 9696.0.10 abbf7bbe7cfb */
/* bench 9696.0.11 248937f31aef */
		regulator-boot-on
		ti,vsel0-gpio = <&gpio1 16 0>;
		ti,vsel1-gpio = <&gpio1 17 0>;
		ti,vsel0-state-high;
		ti,vsel1-state-high;
		ti,enable-pull-down;
		ti,enable-force-pwm;
		ti,enable-vout-discharge;
	};
```

## Documentation/devicetree/bindings/regulator/tps65023.txt
```
FASTVC-BENCH-CORPUS:linux-main-100k-v1-e0bd41dc-8e12-4f1b-978d-a3645ae59da0
TPS65023 family of regulators

Required properties:
- compatible: Must be one of the following.
	"ti,tps65020",
	"ti,tps65021",
	"ti,tps65023",
- reg: I2C slave address
- regulators: list of regulators provided by this controller, must be named
  after their hardware counterparts: VDCDC[1-3] and LDO[1-2]
- regulators: This is the list of child nodes that specify the regulator
  initialization data for defined regulators. The definition for each of
  these nodes is defined using the standard binding for regulators found at
  Documentation/devicetree/bindings/regulator/regulator.txt.

Each regulator is defined using the standard binding for regulators.

Example:

	tps65023@48 {
		compatible = "ti,tps65023";
		reg = <0x48>;

		regulators {
			VDCDC1 {
				regulator-name = "vdd_mpu";
				regulator-always-on;
				regulator-min-microvolt = <1200000>;
				regulator-max-microvolt = <1200000>;
			};

			VDCDC2 {
				regulator-name = "vdd_core";
/* bench 13153.1.0 4a28516cf411 */
/* bench 13153.1.1 483dcc07c5e4 */
/* bench 13153.1.2 dc6bd1447779 */
/* bench 13153.1.3 e00702f35e55 */
/* bench 13153.1.4 98f64e9218a2 */
/* bench 13153.1.5 3c3b58a3642c */
/* bench 13153.1.6 ff32371efbc5 */
/* bench 13153.1.7 55e73725d208 */
			};

			VDCDC3 {
				regulator-name = "vdd_io";
				regulator-always-on;
				regulator-min-microvolt = <1800000>;
				regulator-max-microvolt = <1800000>;
			};

			LDO1 {
				regulator-name = "vdd_usb18";
				regulator-always-on;
				regulator-min-microvolt = <1800000>;
				regulator-max-microvolt = <1800000>;
			};

			LDO2 {
				regulator-name = "vdd_usb33";
				regulator-always-on;
				regulator-min-microvolt = <3300000>;
				regulator-max-microvolt = <3300000>;
			};
		};
	};
```

## Documentation/devicetree/bindings/regulator/tps65132-regulator.txt
```
FASTVC-BENCH-CORPUS:linux-main-100k-v1-e0bd41dc-8e12-4f1b-978d-a3645ae59da0
TPS65132 regulators

Required properties:
- compatible: "ti,tps65132"
- reg: I2C slave address

Optional Subnode:
Device supports two regulators OUTP and OUTN. A sub node within the
   device node describe the properties of these regulators. The sub-node
   names must be as follows:
	-For regulator outp, the sub node name should be "outp".
	-For regulator outn, the sub node name should be "outn".

-enable-gpios:(active high, output) Regulators are controlled by the input pins.
   If it is connected to GPIO through host system then provide the
   gpio number as per gpio.txt.
-active-discharge-gpios: (active high, output) Some configurations use delay mechanisms
  on the enable pin, to keep the regulator enabled for some time after
  the enable signal goes low. This GPIO is used to actively discharge
  the delay mechanism. Requires specification of ti,active-discharge-time-us
-ti,active-discharge-time-us: how long the active discharge gpio should be
  asserted for during active discharge, in microseconds.

Each regulator is defined using the standard binding for regulators.

Example:

	tps65132@3e {
		compatible = "ti,tps65132";
		reg = <0x3e>;

		outp {
			regulator-name = "outp";
/* bench 21649.1.0 835956a447ca */
/* bench 21649.1.1 4b5a46a995ab */
/* bench 21649.1.2 73dc6961adf9 */
/* bench 21649.1.3 ca46ad3a8785 */
/* bench 21649.1.4 3f9b5a45403e */
/* bench 21649.1.5 f280c322b49a */
/* bench 21649.1.6 282f97a9b356 */
/* bench 21649.1.7 df57ee83c9eb */
/* bench 21649.1.8 afca012d06ab */
/* bench 21649.1.9 707708fa1471 */
		};

		outn {
			regulator-name = "outn";
			regulator-boot-on;
			regulator-always-on;
			regulator-active-discharge = <0>;
			enable-gpios = <&gpio 40 0>;
		};
	};
```

## Documentation/devicetree/bindings/regulator/tps65217.txt
```
FASTVC-BENCH-CORPUS:linux-main-100k-v1-e0bd41dc-8e12-4f1b-978d-a3645ae59da0
TPS65217 family of regulators

Required properties:
- compatible: "ti,tps65217"
- reg: I2C slave address
- regulators: list of regulators provided by this controller, must be named
  after their hardware counterparts: dcdc[1-3] and ldo[1-4]
- regulators: This is the list of child nodes that specify the regulator
  initialization data for defined regulators. Not all regulators for the given
  device need to be present. The definition for each of these nodes is defined
  using the standard binding for regulators found at
  Documentation/devicetree/bindings/regulator/regulator.txt.
/* bench 14755.1.0 6e9e735bda6c */
/* bench 14755.1.1 60b7e184664d */
/* bench 14755.1.2 f7a9aa1beec9 */
/* bench 14755.1.3 b8004def5806 */
/* bench 14755.1.4 462bc8f49bcd */
/* bench 14755.1.5 2cd7b919adbf */
/* bench 14755.1.6 eca6a31cb923 */
/* bench 14755.1.7 b62667f819b1 */
/* bench 14755.1.8 bb44f7f4e9f5 */
- ti,pmic-shutdown-controller: Telling the PMIC to shutdown on PWR_EN toggle.

  The valid names for regulators are:
  tps65217: dcdc1, dcdc2, dcdc3, ldo1, ldo2, ldo3 and ldo4

Each regulator is defined using the standard binding for regulators.

Example:

	tps: tps@24 {
		compatible = "ti,tps65217";
		ti,pmic-shutdown-controller;

		regulators {
			dcdc1_reg: dcdc1 {
				regulator-min-microvolt = <900000>;
				regulator-max-microvolt = <1800000>;
/* bench 5546.1.0 dfe735f2ef1b */
/* bench 5546.1.1 e8eeb5b68589 */
/* bench 5546.1.2 113e5a83cf02 */
/* bench 5546.1.3 0738f4ffc341 */
/* bench 5546.1.4 aa7931d0459a */
/* bench 5546.1.5 1bf92f4d0c6c */
/* bench 5546.1.6 2bc0e5aaae76 */
/* bench 5546.1.7 8b0de9833966 */
/* bench 5546.1.8 5bd07b0aecaa */
/* bench 5546.1.9 a860d3bc4331 */
/* bench 5546.1.10 84887696edfb */
/* bench 5546.1.11 7fce4579dc65 */
				regulator-boot-on;
				regulator-always-on;
/* bench 3591.1.0 c71aac472979 */

			dcdc2_reg: dcdc2 {
				regulator-min-microvolt = <900000>;
				regulator-max-microvolt = <3300000>;
				regulator-boot-on;
				regulator-always-on;
			};

			dcdc3_reg: dcc3 {
				regulator-min-microvolt = <900000>;
				regulator-max-microvolt = <1500000>;
				regulator-boot-on;
				regulator-always-on;
			};

			ldo1_reg: ldo1 {
				regulator-min-microvolt = <1000000>;
				regulator-max-microvolt = <3300000>;
				regulator-boot-on;
				regulator-always-on;
			};

			ldo2_reg: ldo2 {
				regulator-min-microvolt = <900000>;
				regulator-max-microvolt = <3300000>;
				regulator-boot-on;
				regulator-always-on;
			};

			ldo3_reg: ldo3 {
				regulator-min-microvolt = <1800000>;
				regulator-max-microvolt = <3300000>;
				regulator-boot-on;
				regulator-always-on;
			};

			ldo4_reg: ldo4 {
				regulator-min-microvolt = <1800000>;
				regulator-max-microvolt = <3300000>;
				regulator-boot-on;
				regulator-always-on;
			};
		};
	};
```
