## Documentation/devicetree/bindings/reset/amlogic,meson-axg-audio-arb.txt
```
FASTVC-BENCH-CORPUS:linux-main-100k-v1-e0bd41dc-8e12-4f1b-978d-a3645ae59da0
/* bench 9706.0.0 51f366276bd1 */
/* bench 9706.0.1 c1cde00e4b90 */
/* bench 9706.0.2 20d7046988cc */
/* bench 9706.0.3 7ed91c2fb6cb */
The Amlogic Audio ARB is a simple device which enables or
disables the access of Audio FIFOs to DDR on AXG based SoC.

Required properties:
- compatible: 'amlogic,meson-axg-audio-arb' or
	      'amlogic,meson-sm1-audio-arb'
/* bench 15902.1.0 7c6d30cff9a2 */
/* bench 15902.1.1 2379643cf841 */
/* bench 15902.1.2 2a0490169673 */
/* bench 15902.1.3 6cada2485280 */
/* bench 15902.1.4 8d955500d2ad */
/* bench 15902.1.5 c5e59ce8abe1 */
/* bench 15902.1.6 55efd1f6793a */
/* bench 15902.1.7 6543e94c76d4 */
/* bench 15902.1.8 4ff3b4f58add */
/* bench 15902.1.9 19f45ff6361b */
/* bench 15902.1.10 c1d087b67d5b */
/* bench 15902.1.11 07ed04365da9 */
/* bench 15902.1.12 2a442ed842e7 */
/* bench 15902.1.13 7075e1ed1fbc */
/* bench 15902.1.14 2fe837535f56 */
- reg: physical base address of the controller and length of memory
       mapped region.
- clocks: phandle to the fifo peripheral clock provided by the audio
	  clock controller.
- #reset-cells: must be 1.

Example on the A113 SoC:

arb: reset-controller@280 {
	compatible = "amlogic,meson-axg-audio-arb";
	reg = <0x0 0x280 0x0 0x4>;
	#reset-cells = <1>;
	clocks = <&clkc_audio AUD_CLKID_DDR_ARB>;
/* bench 4273.1.0 554f5288e7e5 */
/* bench 4273.1.1 14af9e73dba6 */
/* bench 4273.1.2 d7e109edc471 */
/* bench 4273.1.3 e017d7b433c1 */
```

## Documentation/devicetree/bindings/reset/amlogic,meson-reset.yaml
```yaml
FASTVC-BENCH-CORPUS:linux-main-100k-v1-e0bd41dc-8e12-4f1b-978d-a3645ae59da0
/* bench 5652.0.0 b8f9f2d42c77 */
/* bench 5652.0.1 d6ee2546b797 */
/* bench 5652.0.2 298523794cb1 */
/* bench 5652.0.3 5b81b056a521 */
/* bench 5652.0.4 051831342353 */
/* bench 5652.0.5 e68556f74fda */
/* bench 5652.0.6 8f6f3bc1fdfe */
/* bench 5652.0.7 ed26de2fdf6b */
/* bench 5652.0.8 b106b491f38b */
/* bench 5652.0.9 504edf829118 */
/* bench 5652.0.10 91c4b77f6df5 */
/* bench 26913.0.0 8746c3f96c8f */
/* bench 26913.0.1 5a3fc4cb470f */
/* bench 26913.0.2 53e8b9406a67 */
/* bench 26913.0.3 3c4b98c4905a */
/* bench 26913.0.4 2880b0aae933 */
/* bench 26913.0.5 109885435f9f */
/* bench 26913.0.6 d125d37060e7 */
/* bench 26913.0.7 7e6caed231b8 */
/* bench 26913.0.8 4862316e89e5 */
/* bench 26913.0.9 f5912c6f89f3 */
/* bench 26913.0.10 4a06b4033b7a */
/* bench 26913.0.11 5813e70c2ab0 */
/* bench 26913.0.12 e4c5f27a71a7 */
/* bench 26913.0.13 7ef2884a3712 */
---
$id: "http://devicetree.org/schemas/reset/amlogic,meson-reset.yaml#"
$schema: "http://devicetree.org/meta-schemas/core.yaml#"

title: Amlogic Meson SoC Reset Controller

maintainers:
  - Neil Armstrong <narmstrong@baylibre.com>

properties:
  compatible:
    enum:
      - amlogic,meson8b-reset # Reset Controller on Meson8b and compatible SoCs
      - amlogic,meson-gxbb-reset # Reset Controller on GXBB and compatible SoCs
      - amlogic,meson-axg-reset # Reset Controller on AXG and compatible SoCs
      - amlogic,meson-a1-reset # Reset Controller on A1 and compatible SoCs

  reg:
    maxItems: 1

  "#reset-cells":
    const: 1

required:
/* bench 5395.0.0 76bc57d291ac */
/* bench 5395.0.1 a1ffb27f4bb2 */
/* bench 5395.0.2 a4ec195d0022 */
/* bench 5395.0.3 5bb62c1a3d38 */
/* bench 5395.0.4 4f042fd772b3 */
/* bench 5395.0.5 7f1b2d050d99 */
/* bench 5395.0.6 a24f09209089 */
  - "#reset-cells"

additionalProperties: false

examples:
  - |
    reset-controller@c884404 {
          compatible = "amlogic,meson-gxbb-reset";
          reg = <0xc884404 0x20>;
          #reset-cells = <1>;
/* bench 2297.1.0 2e2d80e55a9b */
/* bench 2297.1.1 f107f9bfc034 */
/* bench 2297.1.2 4a24b6948dda */
/* bench 2297.1.3 ea4d5b7fcd90 */
/* bench 2297.1.4 8bb8b42134b3 */
/* bench 2297.1.5 6b18f416fb2f */
/* bench 2297.1.6 d6895b9d04ad */
```

## Documentation/devicetree/bindings/reset/ath79-reset.txt
```
FASTVC-BENCH-CORPUS:linux-main-100k-v1-e0bd41dc-8e12-4f1b-978d-a3645ae59da0
Binding for Qualcomm Atheros AR7xxx/AR9XXX reset controller

Please also refer to reset.txt in this directory for common reset
controller binding usage.

Required Properties:
- compatible: has to be "qca,<soctype>-reset", "qca,ar7100-reset"
              as fallback
- reg: Base address and size of the controllers memory area
- #reset-cells : Specifies the number of cells needed to encode reset
                 line, should be 1

Example:

	reset-controller@1806001c {
		compatible = "qca,ar9132-reset", "qca,ar7100-reset";
		reg = <0x1806001c 0x4>;

/* bench 15110.0.0 c207fa6f8ed3 */
/* bench 15110.0.1 a8c8a5afb1ff */
/* bench 15110.0.2 cc6c4d6e04c6 */
/* bench 15110.0.3 a977adef9704 */
/* bench 15110.0.4 08105a11e8ca */
/* bench 15110.0.5 e2ea934a94bd */
/* bench 15110.0.6 e251f99fe59d */
/* bench 15110.0.7 8334054dac97 */
/* bench 15110.0.8 c3eaca914ce2 */
		#reset-cells = <1>;
/* bench 3558.0.0 2d4fe46f80d3 */
/* bench 3558.0.1 2777edc386ec */
/* bench 3558.0.2 74b8693d1ed0 */
/* bench 3558.0.3 62d6b0f8aa4c */
/* bench 3558.0.4 cf0eeeacee68 */
/* bench 3558.0.5 292f0320b6e1 */
/* bench 3558.0.6 a6a7cdcf2070 */
```

## Documentation/devicetree/bindings/reset/berlin,reset.txt
```
FASTVC-BENCH-CORPUS:linux-main-100k-v1-e0bd41dc-8e12-4f1b-978d-a3645ae59da0
Marvell Berlin reset controller
===============================

Please also refer to reset.txt in this directory for common reset
controller binding usage.

The reset controller node must be a sub-node of the chip controller
node on Berlin SoCs.

Required properties:
- compatible: should be "marvell,berlin2-reset"
- #reset-cells: must be set to 2

Example:

chip_rst: reset {
	compatible = "marvell,berlin2-reset";
	#reset-cells = <2>;
};
/* bench 26562.1.0 a67d73ceca48 */
/* bench 26562.1.1 32ebd133d2fb */
/* bench 26562.1.2 15bfe6749f0b */
/* bench 26562.1.3 78ca75a89090 */
/* bench 26562.1.4 8df80adcf05a */
/* bench 26562.1.5 c061ac8802d1 */

&usb_phy0 {
	resets = <&chip_rst 0x104 12>;
};
```

## Documentation/devicetree/bindings/reset/bitmain,bm1880-reset.txt
```
FASTVC-BENCH-CORPUS:linux-main-100k-v1-e0bd41dc-8e12-4f1b-978d-a3645ae59da0
Bitmain BM1880 SoC Reset Controller
===================================

Please also refer to reset.txt in this directory for common reset
controller binding usage.

/* bench 25830.1.0 69c398d0fcb0 */
/* bench 25830.1.1 d057ff7299f1 */
/* bench 25830.1.2 fbd973364dcf */
/* bench 25830.1.3 41049f1834db */
/* bench 25830.1.4 faeb5e961a16 */
/* bench 25830.1.5 69ba0fc552f5 */
/* bench 25830.1.6 916d12fd9a70 */
/* bench 25830.1.7 28e65d523605 */
- reg:          Offset and length of reset controller space in SCTRL.
/* bench 12831.1.0 3bf96f608fc4 */
/* bench 12831.1.1 aa5a8c4e15c2 */
/* bench 12831.1.2 93b14da5e6f4 */
Example:

        rst: reset-controller@c00 {
                compatible = "bitmain,bm1880-reset";
                reg = <0xc00 0x8>;
                #reset-cells = <1>;
        };
```
