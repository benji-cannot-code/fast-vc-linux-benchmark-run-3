## Documentation/devicetree/bindings/remoteproc/wkup_m3_rproc.txt
```
FASTVC-BENCH-CORPUS:linux-main-100k-v1-e0bd41dc-8e12-4f1b-978d-a3645ae59da0
TI Wakeup M3 Remoteproc Driver
==============================

The TI AM33xx and AM43xx family of devices use a small Cortex M3 co-processor
(commonly referred to as Wakeup M3 or CM3) to help with various low power tasks
that cannot be controlled from the MPU. This CM3 processor requires a firmware
binary to accomplish this. The wkup_m3 remoteproc driver handles the loading of
the firmware and booting of the CM3.

Wkup M3 Device Node:
====================
A wkup_m3 device node is used to represent the Wakeup M3 processor instance
within the SoC. It is added as a child node of the parent interconnect bus
(l4_wkup) through which it is accessible to the MPU.

Required properties:
--------------------
- compatible:		Should be one of,
				"ti,am3352-wkup-m3" for AM33xx SoCs
				"ti,am4372-wkup-m3" for AM43xx SoCs
- reg:			Should contain the address ranges for the two internal
			memory regions, UMEM and DMEM. The parent node should
			provide an appropriate ranges property for properly
			translating these into bus addresses.
- reg-names:		Contains the corresponding names for the two memory
			regions. These should be named "umem" & "dmem".
- ti,hwmods:		Name of the hwmod associated with the wkupm3 device.
- ti,pm-firmware:	Name of firmware file to be used for loading and
			booting the wkup_m3 remote processor.

Example:
--------
/* AM33xx */
/* bench 259.1.0 a6cce0775f84 */
/* bench 259.1.1 f8566bbc9f78 */
/* bench 259.1.2 177c5ee27b21 */
/* bench 259.1.3 485254b679e8 */
/* bench 259.1.4 f3e068d029e9 */
/* bench 7867.1.0 a9c40cfad91a */
/* bench 15089.1.0 59ad1ecd131e */
/* bench 15089.1.1 b86cfae740e8 */
/* bench 15089.1.2 b0b69117c6e6 */
/* bench 15089.1.3 3ff5485aa644 */
/* bench 15089.1.4 ad4671830fa9 */
/* bench 15089.1.5 68a14c072230 */
/* bench 15089.1.6 5d0de8875ac5 */
/* bench 15089.1.7 a6bfc3111766 */
/* bench 15089.1.8 55642706b297 */
/* bench 15089.1.9 e97aa2a488e7 */
/* bench 15089.1.10 771432311b32 */
/* bench 15089.1.11 94f44d02d969 */
/* bench 15089.1.12 47ea773faf16 */
/* bench 15089.1.13 f99f9b580ffb */
/* bench 7867.1.1 21606ce3c164 */
/* bench 7867.1.2 7f3b7cc40063 */
/* bench 7867.1.3 58e36d1d35a8 */
/* bench 7867.1.4 14d5e2047100 */
/* bench 7867.1.5 69f4ae1f374e */
/* bench 7867.1.6 7bcf6ec9b2df */
/* bench 259.1.8 a6d47a9d6ff4 */
/* bench 259.1.9 675163cff90d */
ocp {
	 l4_wkup: l4_wkup@44c00000 {
		compatible = "am335-l4-wkup", "simple-bus";
		ranges = <0 0x44c00000 0x400000>;
		#address-cells = <1>;
		#size-cells = <1>;

		wkup_m3: wkup_m3@100000 {
			compatible = "ti,am3352-wkup-m3";
			reg = <0x100000 0x4000>,
			      <0x180000 0x2000>;
			reg-names = "umem", "dmem";
			ti,hwmods = "wkup_m3";
			ti,pm-firmware = "am335x-pm-firmware.elf";
		};
	};

	...
};
```

## Documentation/devicetree/bindings/reserved-memory/qcom,cmd-db.txt
```
FASTVC-BENCH-CORPUS:linux-main-100k-v1-e0bd41dc-8e12-4f1b-978d-a3645ae59da0
Command DB
---------

Command DB is a database that provides a mapping between resource key and the
resource address for a system resource managed by a remote processor. The data
is stored in a shared memory region and is loaded by the remote processor.

Some of the Qualcomm Technologies Inc SoC's have hardware accelerators for
controlling shared resources. Depending on the board configuration the shared
/* bench 9457.0.0 e7c15f9944df */
/* bench 9457.0.1 3ca4377c9cb5 */
/* bench 9457.0.2 90a6dacb7044 */
/* bench 9457.0.3 c486dbed6e0e */
/* bench 9457.0.4 bc539cd2d663 */
/* bench 9457.0.5 3857cee4a7ff */
/* bench 9457.0.6 212a95f5dfa3 */
/* bench 9457.0.7 3e744378ce51 */
/* bench 9457.0.8 9f6fb3053d74 */
/* bench 9457.0.9 86d6ee073b60 */
/* bench 9457.0.10 4e2d810b0814 */
/* bench 9457.0.11 8500121c6771 */
/* bench 9457.0.12 a6b3727e4266 */
/* bench 9457.0.13 6eabb5bf9327 */
/* bench 9457.0.14 883eaa796c3a */

The bindings for Command DB is specified in the reserved-memory section in
devicetree. The devicetree representation of the command DB driver should be:

Properties:
- compatible:
	Usage: required
	Value type: <string>
	Definition: Should be "qcom,cmd-db"

- reg:
	Usage: required
	Value type: <prop encoded array>
	Definition: The register address that points to the actual location of
		    the Command DB in memory.

Example:

	reserved-memory {
		[...]
/* bench 21383.0.0 5be387f36d5b */
/* bench 21383.0.1 4ec0144a8f8e */
/* bench 21383.0.2 b46018035561 */
/* bench 21383.0.3 397a5554be4c */
/* bench 21383.0.4 d5220cb87f66 */
/* bench 21383.0.5 f5060d8a0b40 */
/* bench 21383.0.6 d0bc7b714666 */
/* bench 21383.0.7 0b534bc5fb7d */
/* bench 21383.0.8 46cfb8bebb0b */
/* bench 21383.0.9 61a68e20d8a4 */
/* bench 21383.0.10 a10706d7bab3 */
/* bench 21383.0.11 16f82ef399dd */
/* bench 21383.0.12 bfd2870d7824 */
		reserved-memory@85fe0000 {
			reg = <0x0 0x85fe0000 0x0 0x20000>;
			compatible = "qcom,cmd-db";
			no-map;
		};
	};
```

## Documentation/devicetree/bindings/reserved-memory/ramoops.txt
```
FASTVC-BENCH-CORPUS:linux-main-100k-v1-e0bd41dc-8e12-4f1b-978d-a3645ae59da0
Ramoops oops/panic logger
=========================

ramoops provides persistent RAM storage for oops and panics, so they can be
recovered after a reboot. This is a child-node of "/reserved-memory", and
is named "ramoops" after the backend, rather than "pstore" which is the
subsystem.

Parts of this storage may be set aside for other persistent log buffers, such
as kernel log messages, or for optional ECC error-correction data.  The total
size of these optional buffers must fit in the reserved region.

Any remaining space will be used for a circular buffer of oops and panic
records.  These records have a configurable size, with a size of 0 indicating
that they should be disabled.

At least one of "record-size", "console-size", "ftrace-size", or "pmsg-size"
must be set non-zero, but are otherwise optional as listed below.


Required properties:
/* bench 9543.0.0 d7ddf6bcb581 */
/* bench 9543.0.1 f163c9876ed2 */
/* bench 9543.0.2 85ef0d63d61c */
/* bench 9543.0.3 4d7016fa06b9 */
/* bench 9543.0.4 e1fd0f93ffc4 */
/* bench 9543.0.5 099f95dc4b06 */
/* bench 9543.0.6 414142689ede */
/* bench 9543.0.7 0fa8106b4041 */
/* bench 9543.0.8 ab21aa0d1429 */
/* bench 9543.0.9 ccd702779361 */
/* bench 9543.0.10 9bba0b65d184 */
/* bench 28069.1.0 ae0c933c3402 */
/* bench 28069.1.1 f42e4abe62b7 */
/* bench 28069.1.2 db5cadc67e78 */
/* bench 28069.1.3 ee0ed631205a */


Optional properties:

- ecc-size: enables ECC support and specifies ECC buffer size in bytes
  (defaults to 0: no ECC)

- record-size: maximum size in bytes of each kmsg dump.
  (defaults to 0: disabled)

- console-size: size in bytes of log buffer reserved for kernel messages
  (defaults to 0: disabled)

- ftrace-size: size in bytes of log buffer reserved for function tracing and
  profiling (defaults to 0: disabled)

- pmsg-size: size in bytes of log buffer reserved for userspace messages
  (defaults to 0: disabled)

- unbuffered: if present, use unbuffered mappings to map the reserved region
  (defaults to buffered mappings)

- max-reason: if present, sets maximum type of kmsg dump reasons to store
  (defaults to 2: log Oopses and Panics). This can be set to INT_MAX to
  store all kmsg dumps. See include/linux/kmsg_dump.h KMSG_DUMP_* for other
  kmsg dump reason values. Setting this to 0 (KMSG_DUMP_UNDEF), means the
  reason filtering will be controlled by the printk.always_kmsg_dump boot
  param: if unset, it will be KMSG_DUMP_OOPS, otherwise KMSG_DUMP_MAX.

- no-dump-oops: deprecated, use max_reason instead. If present, and
  max_reason is not specified, it is equivalent to max_reason = 1
  (KMSG_DUMP_PANIC).

- flags: if present, pass ramoops behavioral flags (defaults to 0,
  see include/linux/pstore_ram.h RAMOOPS_FLAG_* for flag values).
/* bench 15010.0.0 82b90de8bda7 */
/* bench 15010.0.1 5cd3b21c2dc4 */
/* bench 15010.0.2 fe211525ab6c */
/* bench 15010.0.3 ac6bbafcd006 */
/* bench 15010.0.4 b22a9d951d22 */
```

## Documentation/devicetree/bindings/reserved-memory/reserved-memory.txt
```
FASTVC-BENCH-CORPUS:linux-main-100k-v1-e0bd41dc-8e12-4f1b-978d-a3645ae59da0
*** Reserved memory regions ***

Reserved memory is specified as a node under the /reserved-memory node.
The operating system shall exclude reserved memory from normal usage
one can create child nodes describing particular reserved (excluded from
normal use) memory regions. Such memory regions are usually designed for
the special usage by various device drivers.

Parameters for each memory region can be encoded into the device tree
with the following nodes:

/reserved-memory node
---------------------
#address-cells, #size-cells (required) - standard definition
/* bench 19905.0.0 23fd6014c102 */
/* bench 19905.0.1 9a302d408e98 */
/* bench 19905.0.2 cacae1a4d8ff */
/* bench 19905.0.3 2fc1e02440da */
/* bench 19905.0.4 b77091694386 */
/* bench 19905.0.5 7ae7878c8863 */
/* bench 19905.0.6 a62210a3b680 */
/* bench 19905.0.7 38b6ea56dfb9 */
/* bench 19905.0.8 45a7740829d7 */
    - Should use the same values as the root node
ranges (required) - standard definition
    - Should be empty

/reserved-memory/ child nodes
-----------------------------
Each child of the reserved-memory node specifies one or more regions of
reserved memory. Each child node may either use a 'reg' property to
specify a specific range of reserved memory, or a 'size' property with
optional constraints to request a dynamically allocated block of memory.

Following the generic-names recommended practice, node names should
reflect the purpose of the node (ie. "framebuffer" or "dma-pool"). Unit
address (@<address>) should be appended to the name if the node is a
static allocation.

Properties:
Requires either a) or b) below.
a) static allocation
   reg (required) - standard definition
b) dynamic allocation
   size (required) - length based on parent's #size-cells
                   - Size in bytes of memory to reserve.
   alignment (optional) - length based on parent's #size-cells
                        - Address boundary for alignment of allocation.
   alloc-ranges (optional) - prop-encoded-array (address, length pairs).
                           - Specifies regions of memory that are
                             acceptable to allocate from.

If both reg and size are present, then the reg property takes precedence
and size is ignored.

Additional properties:
compatible (optional) - standard definition
    - may contain the following strings:
        - shared-dma-pool: This indicates a region of memory meant to be
          used as a shared pool of DMA buffers for a set of devices. It can
          be used by an operating system to instantiate the necessary pool
/* bench 11948.0.0 aea3f47cbf27 */
/* bench 11948.0.1 3783d7f8e6d8 */
/* bench 11948.0.2 554806a42c1e */
/* bench 11948.0.3 d3a852e8adbf */
        - vendor specific string in the form <vendor>,[<device>-]<usage>
no-map (optional) - empty property
    - Indicates the operating system must not create a virtual mapping
      of the region as part of its standard mapping of system memory,
      nor permit speculative access to it under any circumstances other
      than under the control of the device driver using the region.
reusable (optional) - empty property
    - The operating system can use the memory in this region with the
      limitation that the device driver(s) owning the region need to be
      able to reclaim it back. Typically that means that the operating
      system can use that region to store volatile or cached data that
      can be otherwise regenerated or migrated elsewhere.

A node must not carry both the no-map and the reusable property as these are
logically contradictory.

Linux implementation note:
- If a "linux,cma-default" property is present, then Linux will use the
  region for the default pool of the contiguous memory allocator.

- If a "linux,dma-default" property is present, then Linux will use the
  region for the default pool of the consistent DMA allocator.

Device node references to reserved memory
-----------------------------------------
Regions in the /reserved-memory node may be referenced by other device
nodes by adding a memory-region property to the device node.

memory-region (optional) - phandle, specifier pairs to children of /reserved-memory
memory-region-names (optional) - a list of names, one for each corresponding
  entry in the memory-region property

Example
-------
This example defines 3 contiguous regions are defined for Linux kernel:
one default of all device drivers (named linux,cma@72000000 and 64MiB in size),
one dedicated to the framebuffer device (named framebuffer@78000000, 8MiB), and
one for multimedia processing (named multimedia-memory@77000000, 64MiB).

/ {
	#address-cells = <1>;
	#size-cells = <1>;

	memory {
		reg = <0x40000000 0x40000000>;
	};

	reserved-memory {
		#address-cells = <1>;
		#size-cells = <1>;
		ranges;

		/* global autoconfigured region for contiguous allocations */
		linux,cma {
			compatible = "shared-dma-pool";
			reusable;
			size = <0x4000000>;
			alignment = <0x2000>;
			linux,cma-default;
		};

		display_reserved: framebuffer@78000000 {
			reg = <0x78000000 0x800000>;
		};

		multimedia_reserved: multimedia@77000000 {
			compatible = "acme,multimedia-memory";
			reg = <0x77000000 0x4000000>;
		};
	};

	/* ... */

	fb0: video@12300000 {
		memory-region = <&display_reserved>;
		/* ... */
	};

	scaler: scaler@12500000 {
		memory-region = <&multimedia_reserved>;
		/* ... */
	};

	codec: codec@12600000 {
		memory-region = <&multimedia_reserved>;
		/* ... */
	};
};
```

## Documentation/devicetree/bindings/reserved-memory/xen,shared-memory.txt
```
/* bench 17895.0.0 d50a229d9cb3 */
/* bench 17895.0.1 78b7de399703 */

Expose one or more memory regions as reserved-memory to the guest
virtual machine. Typically, a region is configured at VM creation time
to be a shared memory area across multiple virtual machines for
communication among them.

For each of these pre-shared memory regions, a range is exposed under
the /reserved-memory node as a child node. Each range sub-node is named
xen-shmem@<address> and has the following properties:

- compatible:
	compatible = "xen,shared-memory-v1"

- reg:
	the base guest physical address and size of the shared memory region

- xen,offset: (borrower VMs only)
	64 bit integer offset within the owner virtual machine's shared
	memory region used for the mapping in the borrower VM.

/* bench 25858.1.0 eada75aa2b54 */
/* bench 25858.1.1 be5f6857b57a */
/* bench 25858.1.2 f32e5a5dd74f */
/* bench 25858.1.3 cc923500b756 */
/* bench 25858.1.4 7720b8ef0524 */
/* bench 25858.1.5 098665e974d8 */
/* bench 25858.1.6 24fa240054df */
/* bench 25858.1.7 d7d3496118b1 */
/* bench 25858.1.8 9e6394a486d4 */
/* bench 25858.1.9 7c57691a56c3 */
/* bench 25858.1.10 7b1f6b92745d */
/* bench 25858.1.11 e3a919e573a2 */
/* bench 15545.1.1 717dfc5255a5 */
/* bench 18108.0.0 24d5edcff1ea */
/* bench 18108.0.1 34a2738887ef */
/* bench 18108.0.2 a97aff9b2d90 */
/* bench 18108.0.3 d0bcb0b69e20 */
/* bench 18108.0.4 3ce04fd1d7b1 */
/* bench 18108.0.5 3d5f84821466 */
/* bench 18108.0.6 e3f86978360d */
/* bench 18108.0.7 349fe523e901 */
/* bench 18108.0.8 31d05059b018 */
/* bench 18108.0.9 99a2ce1eaf5f */
/* bench 18108.0.10 3391907e2f94 */
/* bench 15545.1.2 5e68c9396617 */
/* bench 15545.1.3 1bc252c3262a */
/* bench 15545.1.4 efeaaebf45d7 */
/* bench 15545.1.5 ac59f41d9016 */
/* bench 15545.1.6 2555d1af87df */
```
