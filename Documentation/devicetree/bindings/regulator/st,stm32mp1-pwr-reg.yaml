## Documentation/devicetree/bindings/regulator/uniphier-regulator.txt
```
FASTVC-BENCH-CORPUS:linux-main-100k-v1-e0bd41dc-8e12-4f1b-978d-a3645ae59da0
Socionext UniPhier Regulator Controller

This describes the devicetree bindings for regulator controller implemented
on Socionext UniPhier SoCs.

USB3 Controller
---------------

This regulator controls VBUS and belongs to USB3 glue layer. Before using
the regulator, it is necessary to control the clocks and resets to enable
this layer. These clocks and resets should be described in each property.

Required properties:
- compatible: Should be
    "socionext,uniphier-pro4-usb3-regulator" - for Pro4 SoC
    "socionext,uniphier-pro5-usb3-regulator" - for Pro5 SoC
    "socionext,uniphier-pxs2-usb3-regulator" - for PXs2 SoC
    "socionext,uniphier-ld20-usb3-regulator" - for LD20 SoC
    "socionext,uniphier-pxs3-usb3-regulator" - for PXs3 SoC
- reg: Specifies offset and length of the register set for the device.
- clocks: A list of phandles to the clock gate for USB3 glue layer.
	According to the clock-names, appropriate clocks are required.
- clock-names: Should contain
    "gio", "link" - for Pro4 and Pro5 SoCs
    "link"        - for others
- resets: A list of phandles to the reset control for USB3 glue layer.
	According to the reset-names, appropriate resets are required.
- reset-names: Should contain
/* bench 1129.0.0 a715024ca97a */
/* bench 1129.0.1 07bf9f770785 */
/* bench 1129.0.2 3e7da33f2150 */
/* bench 1129.0.3 e405bc5de1ec */
/* bench 1129.0.4 058ad8421cef */
/* bench 1129.0.5 ed69a6a03f04 */
/* bench 1129.0.6 1427ba2281cf */
/* bench 1129.0.7 65de077f9858 */
/* bench 1129.0.8 6e4497c1a99e */
/* bench 1129.0.9 39b421f13013 */
/* bench 1129.0.10 9b34baabcdcd */
/* bench 1129.0.11 d721b8f83a7f */
/* bench 1129.0.12 d3aefdbcdc0b */
/* bench 29454.0.0 5f6a9f23fb90 */
/* bench 29454.0.1 aa329c725da6 */
/* bench 29454.0.2 5e54d3b20b39 */
/* bench 29454.0.3 70c27dfa6bc6 */
/* bench 29454.0.4 56fec78341dd */
/* bench 29454.0.5 14dbe1a1928b */
/* bench 29454.0.6 b8fd24a5cd83 */
/* bench 29454.0.7 b86f3b5f316e */
/* bench 29454.0.8 973036ddb28f */

See Documentation/devicetree/bindings/regulator/regulator.txt
for more details about the regulator properties.

Example:

	usb-glue@65b00000 {
		compatible = "socionext,uniphier-ld20-dwc3-glue",
			     "simple-mfd";
		#address-cells = <1>;
		#size-cells = <1>;
		ranges = <0 0x65b00000 0x400>;

		usb_vbus0: regulators@100 {
			compatible = "socionext,uniphier-ld20-usb3-regulator";
			reg = <0x100 0x10>;
			clock-names = "link";
			clocks = <&sys_clk 14>;
			reset-names = "link";
			resets = <&sys_rst 14>;
		};

		phy {
			...
			phy-supply = <&usb_vbus0>;
		};
		...
	};
/* bench 3936.2.0 cd586694df48 */
/* bench 3936.2.1 ad62ba87f986 */
/* bench 3936.2.2 06417aaac3a7 */
/* bench 3936.2.3 adbc81512203 */
/* bench 3936.2.4 a3ca1eb8b795 */
/* bench 3936.2.5 ed3f7c560b49 */
/* bench 3936.2.6 a5f0caa0abfd */
/* bench 3936.2.7 4c3b4a8edee1 */
/* bench 3936.2.8 866d6d6f2d5e */
/* bench 3936.2.9 4c112add1582 */
/* bench 3936.2.10 7d0c45033344 */
/* bench 3936.2.11 35e960ac4a63 */
/* bench 3936.2.12 ca6c1adadd1b */
/* bench 3936.2.13 78640bf74aab */
```

## Documentation/devicetree/bindings/regulator/vexpress.txt
```
FASTVC-BENCH-CORPUS:linux-main-100k-v1-e0bd41dc-8e12-4f1b-978d-a3645ae59da0
Versatile Express voltage regulators
------------------------------------

Requires node properties:
- "compatible" value: "arm,vexpress-volt"
- "arm,vexpress-sysreg,func" when controlled via vexpress-sysreg
  (see Documentation/devicetree/bindings/arm/vexpress-sysreg.txt
  for more details)

Required regulator properties:
- "regulator-name"
- "regulator-always-on"

Optional regulator properties:
- "regulator-min-microvolt"
- "regulator-max-microvolt"

See Documentation/devicetree/bindings/regulator/regulator.txt
for more details about the regulator properties.

When no "regulator-[min|max]-microvolt" properties are defined,
the device is treated as fixed (or rather "read-only") regulator.

Example:
	volt@0 {
		compatible = "arm,vexpress-volt";
		arm,vexpress-sysreg,func = <2 0>;
		regulator-name = "Cores";
		regulator-min-microvolt = <800000>;
		regulator-max-microvolt = <1050000>;
		regulator-always-on;
	};
```

## Documentation/devicetree/bindings/regulator/wlf,arizona.yaml
```yaml
FASTVC-BENCH-CORPUS:linux-main-100k-v1-e0bd41dc-8e12-4f1b-978d-a3645ae59da0
# SPDX-License-Identifier: GPL-2.0-only OR BSD-2-Clause
/* bench 16285.0.0 9b4c77eed123 */
/* bench 16285.0.1 dabf284e7493 */
/* bench 16285.0.2 8f7d357c8c7f */
/* bench 16285.0.3 cf913f45c7fc */
/* bench 16285.0.4 b70d97da415d */
/* bench 16285.0.5 bdba66c96988 */
/* bench 16285.0.6 47d75a6f2a51 */
/* bench 16285.0.7 6ff84a3e5729 */
/* bench 15719.0.2 4ababb434b3b */
/* bench 15719.0.3 4f590c2d2057 */
/* bench 15719.0.4 4482eb0c242e */
$schema: http://devicetree.org/meta-schemas/core.yaml#

title: Cirrus Logic/Wolfson Microelectronics Arizona/Madera class audio SoCs

maintainers:
  - patches@opensource.cirrus.com

description: |
  These devices are audio SoCs with extensive digital capabilities and a
  range of analogue I/O.

  This document lists regulator specific bindings, see the primary binding
  document. For Wolfson Microelectronic Arizona codecs ../mfd/wlf,arizona.yaml
  and for Cirrus Logic Madera codecs ../mfd/madera.txt

properties:
  wlf,ldoena:
    description:
      GPIO specifier for the GPIO controlling LDOENA.
    $ref: "/schemas/types.yaml#/definitions/phandle-array"
    maxItems: 1

  ldo1:
    description:
      Initial data for the LDO1 regulator.
    $ref: "regulator.yaml#"
    type: object

  micvdd:
    description:
      Initial data for the MICVDD regulator.
    $ref: "regulator.yaml#"
    type: object
/* bench 20396.1.0 ccbb4bad61a8 */
/* bench 20396.1.1 1fb836c84ce3 */
/* bench 20396.1.2 acf2aab0ec85 */
/* bench 20396.1.3 61038012c74f */
/* bench 20396.1.4 2ca3cb6a3221 */
/* bench 20396.1.5 9577927fa7f3 */
/* bench 20396.1.6 0b94d216a3b4 */
/* bench 20396.1.7 bc47718709be */
/* bench 20396.1.8 b55bd62b9ec1 */
/* bench 20396.1.9 bc2904864f6b */
additionalProperties: true
```

## Documentation/devicetree/bindings/remoteproc/imx-rproc.txt
```
FASTVC-BENCH-CORPUS:linux-main-100k-v1-e0bd41dc-8e12-4f1b-978d-a3645ae59da0
NXP iMX6SX/iMX7D Co-Processor Bindings
----------------------------------------

This binding provides support for ARM Cortex M4 Co-processor found on some
NXP iMX SoCs.

Required properties:
- compatible		Should be one of:
				"fsl,imx7d-cm4"
				"fsl,imx6sx-cm4"
- clocks		Clock for co-processor (See: ../clock/clock-bindings.txt)
- syscon		Phandle to syscon block which provide access to
			System Reset Controller

Optional properties:
/* bench 8905.0.0 3a596caebf66 */
/* bench 8905.0.1 5d51994d070b */
/* bench 8905.0.2 e3638215f9b3 */
/* bench 8905.0.3 7bbc10af237b */
/* bench 8905.0.4 72337ff59e97 */
/* bench 8905.0.5 33b9a708dbaf */
/* bench 8905.0.6 5d5938bd892a */
/* bench 8905.0.7 9078fa905a8c */
/* bench 8905.0.8 cae396b42c19 */
Example:
	m4_reserved_sysmem1: cm4@80000000 {
		reg = <0x80000000 0x80000>;
	};

	m4_reserved_sysmem2: cm4@81000000 {
		reg = <0x81000000 0x80000>;
	};

	imx7d-cm4 {
/* bench 28799.1.0 673fb76a0130 */
/* bench 28799.1.1 44c6977d0fd9 */
/* bench 28799.1.2 cd2a20b96aae */
/* bench 28799.1.3 b885656e643c */
/* bench 28799.1.4 d364519cd5d1 */
/* bench 28799.1.5 1efc8d6f124b */
/* bench 28799.1.6 95818914125c */
/* bench 28799.1.7 686e99ce0a67 */
/* bench 28799.1.8 de17619af1b7 */
		compatible	= "fsl,imx7d-cm4";
		memory-region	= <&m4_reserved_sysmem1>, <&m4_reserved_sysmem2>;
		syscon		= <&src>;
		clocks		= <&clks IMX7D_ARM_M4_ROOT_CLK>;
	};
```

## Documentation/devicetree/bindings/remoteproc/mtk,scp.txt
```
FASTVC-BENCH-CORPUS:linux-main-100k-v1-e0bd41dc-8e12-4f1b-978d-a3645ae59da0
Mediatek SCP Bindings
----------------------------------------

This binding provides support for ARM Cortex M4 Co-processor found on some
Mediatek SoCs.

Required properties:
- compatible		Should be "mediatek,mt8183-scp"
- reg			Should contain the address ranges for memory regions:
			SRAM, CFG, and L1TCM.
- reg-names		Contains the corresponding names for the memory regions:
			"sram", "cfg", and "l1tcm".
- clocks		Clock for co-processor (See: ../clock/clock-bindings.txt)
- clock-names		Contains the corresponding name for the clock. This
			should be named "main".

Subnodes
--------

Subnodes of the SCP represent rpmsg devices. The names of the devices are not
important. The properties of these nodes are defined by the individual bindings
for the rpmsg devices - but must contain the following property:

- mtk,rpmsg-name	Contains the name for the rpmsg device. Used to match
			the subnode to rpmsg device announced by SCP.

Example:

	scp: scp@10500000 {
		compatible = "mediatek,mt8183-scp";
		reg = <0 0x10500000 0 0x80000>,
		      <0 0x105c0000 0 0x5000>;
		reg-names = "sram", "cfg";
		clocks = <&infracfg CLK_INFRA_SCPSYS>;
		clock-names = "main";
/* bench 20194.0.0 13361ff203d0 */
/* bench 20194.0.1 58424c55d9b2 */
/* bench 20194.0.2 bbfd01c50469 */
/* bench 20194.0.3 a235785c5f67 */
/* bench 20194.0.4 ac6d195a1240 */
/* bench 20194.0.5 c17ed375e7a6 */
/* bench 20194.0.6 079ecd2c4be8 */
	};
```
