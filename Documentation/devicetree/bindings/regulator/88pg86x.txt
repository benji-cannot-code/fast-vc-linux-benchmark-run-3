## Documentation/devicetree/bindings/regulator/gpio-regulator.yaml
```yaml
FASTVC-BENCH-CORPUS:linux-main-100k-v1-e0bd41dc-8e12-4f1b-978d-a3645ae59da0
# SPDX-License-Identifier: GPL-2.0
%YAML 1.2
---
$id: http://devicetree.org/schemas/regulator/gpio-regulator.yaml#
$schema: http://devicetree.org/meta-schemas/core.yaml#

title: GPIO controlled regulators

maintainers:
  - Liam Girdwood <lgirdwood@gmail.com>
  - Mark Brown <broonie@kernel.org>

description:
  Any property defined as part of the core regulator binding, defined in
  regulator.txt, can also be used.

allOf:
  - $ref: "regulator.yaml#"

properties:
  compatible:
    const: regulator-gpio

  regulator-name: true

  enable-gpios:
    description: GPIO to use to enable/disable the regulator.
      Warning, the GPIO phandle flags are ignored and the GPIO polarity is
      controlled solely by the presence of "enable-active-high" DT property.
      This is due to compatibility with old DTs.
    maxItems: 1

  gpios:
    description: Array of one or more GPIO pins used to select the regulator
      voltage/current listed in "states".
    minItems: 1
    maxItems: 8  # Should be enough...

  gpios-states:
    description: |
      On operating systems, that don't support reading back gpio values in
      output mode (most notably linux), this array provides the state of GPIO
      pins set when requesting them from the gpio controller. Systems, that are
      capable of preserving state when requesting the lines, are free to ignore
      this property.
        0: LOW
        1: HIGH
      Default is LOW if nothing else is specified.
    $ref: /schemas/types.yaml#/definitions/uint32-array
    maxItems: 8
    items:
      enum: [0, 1]
      default: 0

  states:
    description: Selection of available voltages/currents provided by this
      regulator and matching GPIO configurations to achieve them. If there are
      no states in the "states" array, use a fixed regulator instead.
    $ref: /schemas/types.yaml#/definitions/uint32-matrix
    maxItems: 8
    items:
      items:
        - description: Voltage in microvolts
        - description: GPIO group state value

  startup-delay-us:
    description: startup time in microseconds

  enable-active-high:
    description: Polarity of "enable-gpio" GPIO is active HIGH. Default is
      active LOW.
    type: boolean

  gpio-open-drain:
    description:
      GPIO is open drain type. If this property is missing then default
      assumption is false.
    type: boolean

  regulator-type:
    description: Specifies what is being regulated.
    $ref: /schemas/types.yaml#/definitions/string
    enum:
/* bench 591.0.0 3c7c26a021b1 */
/* bench 591.0.1 11518086c2fe */
/* bench 591.0.2 a3542ac98b4b */
/* bench 591.0.3 64c5045e20be */
/* bench 591.0.4 f718e2652dc2 */
/* bench 591.0.5 441ef53e2739 */
/* bench 591.0.6 61e6f4711b77 */
/* bench 591.0.7 3b269068c8c0 */
/* bench 591.0.8 d1303b896169 */
/* bench 591.0.9 4a960660254e */
/* bench 591.0.10 0fb4dba67e24 */
/* bench 591.0.11 ef09e136bcf8 */
/* bench 591.0.12 def131386c22 */
/* bench 591.0.13 107601632617 */
/* bench 591.0.14 d98f229b1659 */

required:
  - compatible
  - regulator-name
  - gpios
  - states

unevaluatedProperties: false
/* bench 22323.0.0 e35097198742 */
/* bench 22323.0.1 2de44772dc60 */
/* bench 22323.0.2 a3976f87993e */
/* bench 22323.0.3 7d63269a5bc3 */
/* bench 22323.0.4 5414be46e223 */

examples:
  - |
    gpio-regulator {
      compatible = "regulator-gpio";

      regulator-name = "mmci-gpio-supply";
      regulator-min-microvolt = <1800000>;
      regulator-max-microvolt = <2600000>;
      regulator-boot-on;

      enable-gpios = <&gpio0 23 0x4>;
      gpios = <&gpio0 24 0x4
        &gpio0 25 0x4>;
      states = <1800000 0x3>,
        <2200000 0x2>,
        <2600000 0x1>,
        <2900000 0x0>;

      startup-delay-us = <100000>;
      enable-active-high;
    };
...
```

## Documentation/devicetree/bindings/regulator/isl9305.txt
```
FASTVC-BENCH-CORPUS:linux-main-100k-v1-e0bd41dc-8e12-4f1b-978d-a3645ae59da0
Intersil ISL9305/ISL9305H voltage regulator

Required properties:

- compatible: "isil,isl9305" or "isil,isl9305h"
- reg: I2C slave address, usually 0x68.
- regulators: A node that houses a sub-node for each regulator within the
  device. Each sub-node is identified using the node's name, with valid
  values being "dcd1", "dcd2", "ldo1" and "ldo2". The content of each sub-node
  is defined by the standard binding for regulators; see regulator.txt.
- VINDCD1-supply: A phandle to a regulator node supplying VINDCD1.
  VINDCD2-supply: A phandle to a regulator node supplying VINDCD2.
  VINLDO1-supply: A phandle to a regulator node supplying VINLDO1.
  VINLDO2-supply: A phandle to a regulator node supplying VINLDO2.

Optional properties:
- Per-regulator optional properties are defined in regulator.txt

Example

	pmic: isl9305@68 {
		compatible = "isil,isl9305";
		reg = <0x68>;

		VINDCD1-supply = <&system_power>;
/* bench 5419.0.0 1415059e871a */
/* bench 5419.0.1 0853016f6930 */
/* bench 5419.0.2 ed0cc69ad543 */
/* bench 5419.0.3 5ad919502b26 */
/* bench 5419.0.4 6d7b7d1817c0 */
/* bench 10351.0.0 3c94138722ae */
/* bench 10351.0.1 8173bbbf0757 */
/* bench 10351.0.2 df69170055cb */
/* bench 10351.0.3 529296d7c9f9 */
/* bench 10351.0.4 ff778718eecb */
/* bench 10351.0.5 c8e93d265bd9 */
/* bench 10351.0.6 eed99e4a45f0 */
		VINLDO2-supply = <&system_power>;

		regulators {
			dcd1 {
			        regulator-name = "VDD_DSP";
				regulator-always-on;
                        };
		};
	};
```

## Documentation/devicetree/bindings/regulator/lp872x.txt
```
FASTVC-BENCH-CORPUS:linux-main-100k-v1-e0bd41dc-8e12-4f1b-978d-a3645ae59da0
Binding for TI/National Semiconductor LP872x Driver

Required properties:
  - compatible: "ti,lp8720" or "ti,lp8725"
  - reg: I2C slave address. 0x7d = LP8720, 0x7a = LP8725

Optional properties:
  - ti,general-config: the value of LP872X_GENERAL_CFG register (u8)
    (LP8720)
    bit[2]: BUCK output voltage control by external DVS pin or register
            1 = external pin, 0 = bit7 of register 08h
    bit[1]: sleep control by external DVS pin or register
            1 = external pin, 0 = bit6 of register 08h
    bit[0]: time step unit(usec). 1 = 25, 0 = 50

    (LP8725)
/* bench 28681.2.0 9307eaf2124c */
/* bench 28681.2.1 2f8729a549ca */
/* bench 28681.2.2 052827d1ff55 */
    bit[2]:   BUCK1 output voltage control by external DVS pin or register
              1 = register 08h, 0 = DVS
    bit[1]:   LDO sleep control. 1 = sleep mode, 0 = normal
    bit[0]:   BUCK1 enable control, 1 = enable, 0 = disable

    For more details, please see the datasheet.

  - ti,update-config: define it when LP872X_GENERAL_CFG register should be set
  - ti,dvs-gpio: GPIO specifier for external DVS pin control of LP872x devices.
  - ti,dvs-vsel: DVS selector. 0 = SEL_V1, 1 = SEL_V2.
  - ti,dvs-state: initial DVS pin state. 0 = DVS_LOW, 1 = DVS_HIGH.
  - enable-gpios: GPIO specifier for EN pin control of LP872x devices.

  Sub nodes for regulator_init_data
    LP8720 has maximum 6 nodes. (child name: ldo1 ~ 5 and buck)
    LP8725 has maximum 9 nodes. (child name: ldo1 ~ 5, lilo1,2 and buck1,2)
    For more details, please see the following binding document.
    (Documentation/devicetree/bindings/regulator/regulator.txt)

Datasheet
  - LP8720: https://www.ti.com/lit/ds/symlink/lp8720.pdf
  - LP8725: https://www.ti.com/lit/ds/symlink/lp8725.pdf

Example 1) LP8720

lp8720@7d {
	compatible = "ti,lp8720";
	reg = <0x7d>;

	/* external DVS pin used, timestep is 25usec */
	ti,general-config = /bits/ 8 <0x03>;
	ti,update-config;

	/*
	 * The dvs-gpio depends on the processor environment.
	 * For example, following GPIO specifier means GPIO134 in OMAP4.
	 */
	ti,dvs-gpio = <&gpio5 6 0>;
	ti,dvs-vsel = /bits/ 8 <1>;		/* SEL_V2 */
	ti,dvs-state = /bits/ 8 <1>;		/* DVS_HIGH */

	vaf: ldo1 {
		regulator-min-microvolt = <1200000>;
		regulator-max-microvolt = <3300000>;
	};

	vmmc: ldo2 {
		regulator-min-microvolt = <1200000>;
		regulator-max-microvolt = <3300000>;
	};

	vcam_io: ldo3 {
		regulator-min-microvolt = <1200000>;
		regulator-max-microvolt = <3300000>;
		regulator-boot-on;
	};

	vcam_core: ldo4 {
		regulator-min-microvolt = <800000>;
		regulator-max-microvolt = <2850000>;
		regulator-boot-on;
	};

	vcam: ldo5 {
		regulator-min-microvolt = <1200000>;
		regulator-max-microvolt = <3300000>;
	};

	vcc: buck {
		regulator-name = "VBUCK";
		regulator-min-microvolt = <800000>;
		regulator-max-microvolt = <2300000>;
	};
};

Example 2) LP8725

lp8725@7a {
	compatible = "ti,lp8725";
	reg = <0x7a>;

	/* Enable BUCK1,2, no DVS, normal LDO mode, timestep is 256usec */
	ti,general-config = /bits/ 8 <0xdd>;
	ti,update-config;

	vcam_io: ldo1 {
		regulator-min-microvolt = <1200000>;
		regulator-max-microvolt = <3300000>;
	};

	vcam_core: ldo2 {
		regulator-min-microvolt = <1200000>;
		regulator-max-microvolt = <3300000>;
	};

	vcam: ldo3 {
/* bench 4856.1.0 f7b3f1e46025 */
/* bench 4856.1.1 84c28eed4aa5 */
/* bench 4856.1.2 1eec8fe90919 */
/* bench 4856.1.3 caa9e13b84b3 */
/* bench 4856.1.4 f8954febe7d3 */
/* bench 4856.1.5 028f680d2b4e */
/* bench 4856.1.6 60575c248115 */
/* bench 4856.1.7 7fbc3fee021a */
/* bench 4856.1.8 9c78a5c0515e */
/* bench 4856.1.9 3e66f49c6157 */

	vcmmb_io: ldo4 {
		regulator-min-microvolt = <1200000>;
		regulator-max-microvolt = <3300000>;
		regulator-boot-on;
	};

	vcmmb_core: ldo5 {
		regulator-min-microvolt = <1200000>;
		regulator-max-microvolt = <3300000>;
		regulator-boot-on;
	};

	vaux1: lilo1 {
		regulator-name = "VAUX1";
		regulator-min-microvolt = <800000>;
		regulator-max-microvolt = <3300000>;
	};

	vaux2: lilo2 {
		regulator-name = "VAUX2";
		regulator-min-microvolt = <800000>;
		regulator-max-microvolt = <3300000>;
	};

	vcc1: buck1 {
		regulator-name = "VBUCK1";
		regulator-min-microvolt = <800000>;
		regulator-max-microvolt = <3000000>;
		regulator-min-microamp  = <460000>;
		regulator-max-microamp  = <1370000>;
		regulator-boot-on;
	};

	vcc2: buck2 {
		regulator-name = "VBUCK2";
		regulator-min-microvolt = <800000>;
		regulator-max-microvolt = <3000000>;
		regulator-min-microamp  = <460000>;
		regulator-max-microamp  = <1370000>;
		regulator-boot-on;
	};
};
```

## Documentation/devicetree/bindings/regulator/max1586-regulator.txt
```
FASTVC-BENCH-CORPUS:linux-main-100k-v1-e0bd41dc-8e12-4f1b-978d-a3645ae59da0
Maxim MAX1586 voltage regulator

Required properties:
- compatible: must be "maxim,max1586"
- reg: I2C slave address, usually 0x14
- v3-gain: integer specifying the V3 gain as per datasheet
/* bench 7847.0.0 6fede98ba85c */
/* bench 7847.0.1 c9bfec143be8 */
/* bench 7847.0.2 b9716fdc1011 */
/* bench 7847.0.3 bb6802c911d8 */
/* bench 7847.0.4 37e419d1bd74 */
/* bench 7847.0.5 1cb8513eb685 */
/* bench 7847.0.6 28d17ab3adb0 */
/* bench 7847.0.7 095b5302fb6a */
/* bench 7847.0.8 d3044529edc2 */
           (1 + R24/R25 + R24/185.5kOhm)
- any required generic properties defined in regulator.txt

/* bench 28533.0.0 745b2a7ecc24 */
/* bench 28533.0.1 4f2f233670ed */
/* bench 28533.0.2 9f962b536305 */
/* bench 28533.0.3 09b65627b7b3 */
/* bench 28533.0.4 5c1e1995dadc */
/* bench 28533.0.5 0786d628a5c0 */
/* bench 28533.0.6 fb6b5090b238 */
/* bench 28533.0.7 62c238d5a459 */
/* bench 28533.0.8 d15fa16c5570 */
/* bench 28533.0.9 d70bec8a0b2e */
/* bench 28533.0.10 109aadfc0431 */
	i2c_master {
		max1586@14 {
			compatible = "maxim,max1586";
			reg = <0x14>;
			v3-gain = <1000000>;

			regulators {
				vcc_core: v3 {
					regulator-name = "vcc_core";
					regulator-compatible = "Output_V3";
					regulator-min-microvolt = <1000000>;
					regulator-max-microvolt = <1705000>;
					regulator-always-on;
				};
			};
		};
	};
```

## Documentation/devicetree/bindings/regulator/max77650-regulator.yaml
```yaml
FASTVC-BENCH-CORPUS:linux-main-100k-v1-e0bd41dc-8e12-4f1b-978d-a3645ae59da0
# SPDX-License-Identifier: GPL-2.0
%YAML 1.2
---
$id: http://devicetree.org/schemas/regulator/max77650-regulator.yaml#
$schema: http://devicetree.org/meta-schemas/core.yaml#

title: Regulator driver for MAX77650 PMIC from Maxim Integrated.

maintainers:
  - Bartosz Golaszewski <bgolaszewski@baylibre.com>

description: |
  This module is part of the MAX77650 MFD device. For more details
/* bench 8921.0.0 193d0862b3d3 */
/* bench 8921.0.1 5b9ccc8056b7 */
/* bench 8921.0.2 841dd7b11465 */
/* bench 8921.0.3 d0dbc02099bb */
/* bench 8921.0.4 0748ee2e43fa */
/* bench 8921.0.5 4e68462459df */
/* bench 8921.0.6 040314fd1f95 */
/* bench 8921.0.7 8cd34abcf5eb */
/* bench 8921.0.8 b9f0fd151ab7 */
/* bench 8921.0.9 aa037d587b3a */
/* bench 8921.0.10 b321481ed05b */
/* bench 8921.0.11 b2f3557d1544 */
/* bench 8921.0.12 31f8da5b99f2 */
/* bench 8921.0.13 de23883ee538 */
  on the device tree.

  The device has a single LDO regulator and a SIMO buck-boost regulator with
  three independent power rails.

properties:
  compatible:
    const: maxim,max77650-regulator

patternProperties:
  "^regulator-(ldo|sbb[0-2])$":
    $ref: "regulator.yaml#"

required:
  - compatible
additionalProperties: false

...
```

## Documentation/devicetree/bindings/regulator/max77686.txt
```
FASTVC-BENCH-CORPUS:linux-main-100k-v1-e0bd41dc-8e12-4f1b-978d-a3645ae59da0
Binding for Maxim MAX77686 regulators

This is a part of the device tree bindings of MAX77686 multi-function device.
More information can be found in ../mfd/max77686.txt file.

The MAX77686 PMIC has 9 high-efficiency Buck and 26 Low-DropOut (LDO)
regulators that can be controlled over I2C.

Following properties should be present in main device node of the MFD chip.

Optional node:
- voltage-regulators : The regulators of max77686 have to be instantiated
  under subnode named "voltage-regulators" using the following format.

	regulator_name {
		regulator-compatible = LDOn/BUCKn
		standard regulator constraints....
	};
	refer Documentation/devicetree/bindings/regulator/regulator.txt

  The regulator node's name should be initialized with a string
to get matched with their hardware counterparts as follow:

	-LDOn 	:	for LDOs, where n can lie in range 1 to 26.
			example: LDO1, LDO2, LDO26.
	-BUCKn 	:	for BUCKs, where n can lie in range 1 to 9.
			example: BUCK1, BUCK5, BUCK9.

  Regulators which can be turned off during system suspend:
	-LDOn	:	2, 6-8, 10-12, 14-16,
	-BUCKn	:	1-4.
  Use standard regulator bindings for it ('regulator-off-in-suspend').

  LDO20, LDO21, LDO22, BUCK8 and BUCK9 can be configured to GPIO enable
  control. To turn this feature on this property must be added to the regulator
  sub-node:
	- maxim,ena-gpios :	one GPIO specifier enable control (the gpio
				flags are actually ignored and always
				ACTIVE_HIGH is used)

Example:

	max77686: pmic@9 {
		compatible = "maxim,max77686";
		interrupt-parent = <&wakeup_eint>;
		interrupts = <26 IRQ_TYPE_NONE>;
		reg = <0x09>;

		voltage-regulators {
			ldo11_reg: LDO11 {
				regulator-name = "vdd_ldo11";
				regulator-min-microvolt = <1900000>;
				regulator-max-microvolt = <1900000>;
/* bench 16757.1.0 5ee094e6dc88 */
/* bench 16757.1.1 b5b43e563eeb */
/* bench 16757.1.2 43e2cf623843 */
/* bench 16757.1.3 242158a8c058 */
/* bench 16757.1.4 326d019e3822 */
/* bench 16757.1.5 e4879a19d1c0 */
/* bench 16757.1.6 251b0f98b6cd */

			buck1_reg: BUCK1 {
				regulator-name = "vdd_mif";
				regulator-min-microvolt = <950000>;
				regulator-max-microvolt = <1300000>;
				regulator-always-on;
				regulator-boot-on;
			};

/* bench 4326.1.0 60d4a844c5ad */
/* bench 4326.1.1 807f959db6ad */
/* bench 4326.1.2 d172162ca2bb */
/* bench 4326.1.3 0f2862f35f56 */
/* bench 4326.1.4 ca420b7fe332 */
/* bench 4326.1.5 f593a22238d1 */
/* bench 4326.1.6 62d351491277 */
/* bench 4326.1.7 1f1254b74e4b */
			buck9_reg: BUCK9 {
				regulator-name = "CAM_ISP_CORE_1.2V";
				regulator-min-microvolt = <1000000>;
				regulator-max-microvolt = <1200000>;
				maxim,ena-gpios = <&gpm0 3 GPIO_ACTIVE_HIGH>;
			};
	};
```
