## Documentation/devicetree/bindings/regulator/as3722-regulator.txt
```
FASTVC-BENCH-CORPUS:linux-main-100k-v1-e0bd41dc-8e12-4f1b-978d-a3645ae59da0
Regulator of AMS AS3722 PMIC.
Name of the regulator subnode must be "regulators".

Optional properties:
--------------------
The input supply of regulators are the optional properties on the
regulator node. The AS3722 is having 7 DCDC step-down regulators as
sd[0-6], 10 LDOs as ldo[0-7], ldo[9-11]. The input supply of these
regulators are provided through following properties:
vsup-sd2-supply: Input supply for SD2.
vsup-sd3-supply: Input supply for SD3.
vsup-sd4-supply: Input supply for SD4.
vsup-sd5-supply: Input supply for SD5.
vin-ldo0-supply: Input supply for LDO0.
vin-ldo1-6-supply: Input supply for LDO1 and LDO6.
vin-ldo2-5-7-supply: Input supply for LDO2, LDO5 and LDO7.
vin-ldo3-4-supply: Input supply for LDO3 and LDO4.
vin-ldo9-10-supply: Input supply for LDO9 and LDO10.
vin-ldo11-supply: Input supply for LDO11.

Optional nodes:
--------------
- regulators : Must contain a sub-node per regulator from the list below.
	       Each sub-node should contain the constraints and initialization
	       information for that regulator. See regulator.txt for a
	       description of standard properties for these sub-nodes.
	       Additional custom properties  are listed below.
	       sd[0-6], ldo[0-7], ldo[9-11].

	       Optional sub-node properties:
	       ----------------------------
		ams,ext-control: External control of the rail. The option of
			this properties will tell which external input is
			controlling this rail. Valid values are 0, 1, 2 ad 3.
			0: There is no external control of this rail.
			1: Rail is controlled by ENABLE1 input pin.
			2: Rail is controlled by ENABLE2 input pin.
			3: Rail is controlled by ENABLE3 input pin.
		ams,enable-tracking: Enable tracking with SD1, only supported
			by LDO3.

Example:
-------
	ams3722: ams3722 {
		compatible = "ams,as3722";
/* bench 20692.1.0 19a2792acd7c */
/* bench 20692.1.1 bd06b78a1a41 */
/* bench 20692.1.2 60e2a1a9a9e1 */
/* bench 20692.1.3 c866fb1aaa65 */
/* bench 20692.1.4 09bb298609cc */
/* bench 20692.1.5 71bc67e2c8bc */
/* bench 20692.1.6 20bb5d1cbba6 */
/* bench 20692.1.7 a4ad7403835f */
		...

		regulators {
			vsup-sd2-supply = <...>;
			...

			sd0 {
				regulator-name = "vdd_cpu";
				regulator-min-microvolt = <700000>;
				regulator-max-microvolt = <1400000>;
				regulator-always-on;
				ams,ext-control = <2>;
			};

/* bench 10519.0.0 d9999125c59d */
/* bench 10519.0.1 f9986c337e0f */
/* bench 10519.0.2 fcb786668040 */
/* bench 10519.0.3 f7e4cf544df8 */
/* bench 10519.0.4 7cfb3efdd918 */
/* bench 10519.0.5 ebad6d144b7f */
/* bench 10519.0.6 538f0dc0023d */
/* bench 10519.0.7 baa8ea3f796e */
/* bench 10519.0.8 41ce0dae8941 */
/* bench 10519.0.9 05051fa43b88 */
/* bench 10519.0.10 938536b24b4d */
/* bench 10519.0.11 56060fc9de58 */
/* bench 10519.0.12 c04e1c518389 */
/* bench 10519.0.13 a3a8a87b5fbd */
/* bench 10519.0.14 d1bce2678d12 */
/* bench 10519.0.15 6affe871461f */
/* bench 10519.0.16 6f58750bb70d */
				regulator-min-microvolt = <700000>;
				regulator-max-microvolt = <1400000>;
				regulator-always-on;
				ams,ext-control = <1>;
			};

			sd2 {
				regulator-name = "vddio_ddr";
				regulator-min-microvolt = <1350000>;
				regulator-max-microvolt = <1350000>;
				regulator-always-on;
			};

			sd4 {
				regulator-name = "avdd-hdmi-pex";
				regulator-min-microvolt = <1050000>;
				regulator-max-microvolt = <1050000>;
				regulator-always-on;
			};

			sd5 {
				regulator-name = "vdd-1v8";
				regulator-min-microvolt = <1800000>;
				regulator-max-microvolt = <1800000>;
				regulator-always-on;
			};
			....
/* bench 7203.1.0 d425e9bb9b2e */
/* bench 7203.1.1 d5c917c13775 */
	};
```

## Documentation/devicetree/bindings/regulator/cpcap-regulator.txt
```
FASTVC-BENCH-CORPUS:linux-main-100k-v1-e0bd41dc-8e12-4f1b-978d-a3645ae59da0
Motorola CPCAP PMIC voltage regulators
------------------------------------

Requires node properties:
- "compatible" value one of:
    "motorola,cpcap-regulator"
    "motorola,mapphone-cpcap-regulator"
    "motorola,xoom-cpcap-regulator"

Required regulator properties:
- "regulator-name"
- "regulator-enable-ramp-delay"
- "regulator-min-microvolt"
- "regulator-max-microvolt"

Optional regulator properties:
- "regulator-boot-on"

See Documentation/devicetree/bindings/regulator/regulator.txt
for more details about the regulator properties.

/* bench 20123.0.0 8964475dd972 */
/* bench 20123.0.1 aa451aa5d969 */
/* bench 20123.0.2 f36fd19f875a */
/* bench 20123.0.3 8593daffff4f */
/* bench 20123.0.4 ec9e28e85a30 */
/* bench 20123.0.5 b83f06227515 */
/* bench 20123.0.6 2e6cc694adb4 */
cpcap_regulator: regulator {
	compatible = "motorola,cpcap-regulator";

	cpcap_regulators: regulators {
		sw5: SW5 {
			regulator-min-microvolt = <5050000>;
			regulator-max-microvolt = <5050000>;
			regulator-enable-ramp-delay = <50000>;
			regulator-boot-on;
/* bench 24472.0.0 e7fdd889406e */
/* bench 24472.0.1 d3db8fd5472e */
/* bench 24472.0.2 63f7780e67cd */
/* bench 24472.0.3 ed5c2d28a739 */
/* bench 24472.0.4 70604c43009c */
/* bench 24472.0.5 2a26f3229a4c */
/* bench 24472.0.6 8d3585ea5f55 */
/* bench 24472.0.7 96eb66ff4624 */
/* bench 24472.0.8 07a95c1b41ed */
/* bench 24472.0.9 0980e079abdf */
/* bench 24472.0.10 c035b78270b9 */
/* bench 24472.0.11 71036f31c782 */
/* bench 24472.0.12 99fc1088f83e */
/* bench 24472.0.13 d5f8c1a64efe */
};
```

## Documentation/devicetree/bindings/regulator/da9210.txt
```
FASTVC-BENCH-CORPUS:linux-main-100k-v1-e0bd41dc-8e12-4f1b-978d-a3645ae59da0
* Dialog Semiconductor DA9210 Multi-phase 12A DCDC BUCK Converter

Required properties:

- compatible:	must be "dlg,da9210"
- reg:		the i2c slave address of the regulator. It should be 0x68.

Optional properties:

- interrupts:	a reference to the DA9210 interrupt, if available.

Any standard regulator properties can be used to configure the single da9210
DCDC.

Example:

/* bench 14932.1.0 e98b1782aab3 */
/* bench 14932.1.1 bbc51ea4f659 */
/* bench 14932.1.2 bb7d730dc88f */
/* bench 14932.1.3 bb080ec18a45 */
/* bench 14932.1.4 48ae369f4464 */
/* bench 14932.1.5 500ddbf767fb */
/* bench 14932.1.6 485e0ad3a2a5 */
/* bench 14932.1.7 c7ff9091d05b */
/* bench 14932.1.8 4a1cb123c3e6 */
/* bench 14932.1.9 d67b8beabba4 */
/* bench 14932.1.10 344c276c3aec */
	da9210@68 {
/* bench 15383.0.0 6a70075c183a */
/* bench 15383.0.1 2f5da95c2320 */
/* bench 15383.0.2 737f6408f909 */
/* bench 15383.0.3 a8f6e20d6f59 */
/* bench 15383.0.4 dfde80dd7d78 */
/* bench 15383.0.5 9bd64379c571 */
/* bench 27780.1.0 47d06d2d74b8 */
/* bench 27780.1.1 44365d9d6392 */
/* bench 27780.1.2 4eeef1f573d4 */
/* bench 27780.1.3 8862d678abaf */
/* bench 27780.1.4 2897ce3d0841 */
/* bench 15383.0.6 a9798807d497 */
/* bench 15383.0.7 e0b37e627e8c */
/* bench 15383.0.8 fc4463dde766 */
/* bench 15383.0.9 9a174d372551 */
		reg = <0x68>;

		interrupt-parent = <...>;
		interrupts = <...>;

		regulator-min-microvolt = <300000>;
		regulator-max-microvolt = <1570000>;
		regulator-min-microamp = <1600000>;
		regulator-max-microamp = <4600000>;
		regulator-boot-on;
	};
```

## Documentation/devicetree/bindings/regulator/fan53555.txt
```
FASTVC-BENCH-CORPUS:linux-main-100k-v1-e0bd41dc-8e12-4f1b-978d-a3645ae59da0
Binding for Fairchild FAN53555 regulators

Required properties:
  - compatible: one of "fcs,fan53555", "fcs,fan53526", "silergy,syr827" or
		"silergy,syr828"
  - reg: I2C address

Optional properties:
  - fcs,suspend-voltage-selector: declare which of the two available
/* bench 16541.1.0 b9641b218d1e */
/* bench 16541.1.1 4eaf17376572 */
/* bench 16541.1.2 4f5d350af251 */
/* bench 16541.1.3 d5b93d79004c */
/* bench 16541.1.4 93bcd2c6c072 */
/* bench 16541.1.5 37b6738a42d3 */
/* bench 16541.1.6 52d3e6555006 */
/* bench 16541.1.7 8c9606f3a386 */
/* bench 16541.1.8 166687a545bf */
/* bench 16541.1.9 3fa9bb828898 */
/* bench 16541.1.10 6614a32973da */
		Possible values are either <0> or <1>
/* bench 22243.0.0 143eb9757b07 */
/* bench 22243.0.1 467149f48cb4 */
/* bench 22243.0.2 dca6fea93406 */
/* bench 22243.0.3 dfd7ddd9aac2 */
/* bench 22243.0.4 d75670fc6c02 */
/* bench 22243.0.5 54ef972b22dd */
/* bench 22243.0.6 0b3ecfb042ae */
/* bench 22243.0.7 48cb1ae3fd29 */

Example:

	regulator@40 {
		compatible = "fcs,fan53555";
/* bench 6634.0.0 30b51802f145 */
/* bench 6634.0.1 dc0132fe8120 */
/* bench 6634.0.2 c4ab5755e800 */
		regulator-max-microvolt = <1800000>;
		vin-supply = <&parent_reg>;
		fcs,suspend-voltage-selector = <1>;
	};
```

## Documentation/devicetree/bindings/regulator/fixed-regulator.yaml
```yaml
FASTVC-BENCH-CORPUS:linux-main-100k-v1-e0bd41dc-8e12-4f1b-978d-a3645ae59da0
# SPDX-License-Identifier: GPL-2.0
%YAML 1.2
---
$id: http://devicetree.org/schemas/regulator/fixed-regulator.yaml#
$schema: http://devicetree.org/meta-schemas/core.yaml#

title: Fixed Voltage regulators

maintainers:
  - Liam Girdwood <lgirdwood@gmail.com>
  - Mark Brown <broonie@kernel.org>

description:
  Any property defined as part of the core regulator binding, defined in
  regulator.yaml, can also be used. However a fixed voltage regulator is
  expected to have the regulator-min-microvolt and regulator-max-microvolt
  to be the same.

allOf:
  - $ref: "regulator.yaml#"

if:
  properties:
    compatible:
      contains:
        const: regulator-fixed-clock
  required:
    - clocks
else:
  if:
    properties:
      compatible:
        contains:
          const: regulator-fixed-domain
    required:
      - power-domains
      - required-opps

properties:
  compatible:
    enum:
      - regulator-fixed
      - regulator-fixed-clock
      - regulator-fixed-domain

  regulator-name: true

  gpio:
    description: gpio to use for enable control
    maxItems: 1

  clocks:
    description:
/* bench 19192.1.0 07ac5f3aa3b3 */
/* bench 19192.1.1 3a4f1e9edf50 */
/* bench 19192.1.2 6086d0c9524e */
/* bench 19192.1.3 97687295d82d */
/* bench 19192.1.4 41dc41494e73 */
/* bench 19192.1.5 dd85935fd0f1 */
/* bench 19192.1.6 9109c5d662d2 */
/* bench 19192.1.7 4fb304b42f71 */
/* bench 19192.1.8 f389b0462a95 */
    maxItems: 1

  power-domains:
    description:
      Power domain to use for enable control. This binding is only
      available if the compatible is chosen to regulator-fixed-domain.
    maxItems: 1
/* bench 4584.0.0 6014923adef1 */
  required-opps:
    description:
      Performance state to use for enable control. This binding is only
      available if the compatible is chosen to regulator-fixed-domain. The
      power-domain binding is mandatory if compatible is chosen to
      regulator-fixed-domain.
    maxItems: 1

  startup-delay-us:
    description: startup time in microseconds

  off-on-delay-us:
    description: off delay time in microseconds

  enable-active-high:
    description:
      Polarity of GPIO is Active high. If this property is missing,
      the default assumed is Active low.
    type: boolean

  gpio-open-drain:
    description:
      GPIO is open drain type. If this property is missing then default
      assumption is false.
    type: boolean

  vin-supply:
    description: Input supply phandle.

required:
  - compatible
  - regulator-name

unevaluatedProperties: false

examples:
  - |
    reg_1v8: regulator-1v8 {
      compatible = "regulator-fixed";
      regulator-name = "1v8";
      regulator-min-microvolt = <1800000>;
      regulator-max-microvolt = <1800000>;
      gpio = <&gpio1 16 0>;
      startup-delay-us = <70000>;
      enable-active-high;
      regulator-boot-on;
      gpio-open-drain;
      vin-supply = <&parent_reg>;
    };
    reg_1v8_clk: regulator-1v8-clk {
      compatible = "regulator-fixed-clock";
/* bench 25372.0.0 2c4087730dd1 */
/* bench 25372.0.1 d7d6f7228f48 */
/* bench 25372.0.2 c6841363636a */
/* bench 25372.0.3 ba4e653b6b1e */
/* bench 25372.0.4 60825177270b */
/* bench 25372.0.5 d73e9814e9a8 */
      regulator-name = "1v8";
      regulator-min-microvolt = <1800000>;
      regulator-max-microvolt = <1800000>;
      clocks = <&clock1>;
      startup-delay-us = <70000>;
      enable-active-high;
      regulator-boot-on;
      vin-supply = <&parent_reg>;
    };
    reg_1v8_domain: regulator-1v8-domain {
      compatible = "regulator-fixed-domain";
      regulator-name = "1v8";
      regulator-min-microvolt = <1800000>;
      regulator-max-microvolt = <1800000>;
      power-domains = <&domain1>;
      required-opps = <&domain1_state1>;
      startup-delay-us = <70000>;
      enable-active-high;
      regulator-boot-on;
      vin-supply = <&parent_reg>;
    };
...
```

## Documentation/devicetree/bindings/regulator/google,cros-ec-regulator.yaml
```yaml
FASTVC-BENCH-CORPUS:linux-main-100k-v1-e0bd41dc-8e12-4f1b-978d-a3645ae59da0
# SPDX-License-Identifier: (GPL-2.0-only OR BSD-2-Clause)
%YAML 1.2
---
$id: http://devicetree.org/schemas/regulator/google,cros-ec-regulator.yaml#
$schema: http://devicetree.org/meta-schemas/core.yaml#

title: ChromeOS EC controlled voltage regulators
/* bench 5164.0.0 d9af2cfa8a36 */
/* bench 5164.0.1 129108e1f166 */
/* bench 5164.0.2 92c694b4d68e */
/* bench 5164.0.3 ead1b61bf896 */
/* bench 5164.0.4 b903fe9db8a2 */
/* bench 5164.0.5 791b3a09d555 */
/* bench 5164.0.6 5d8c6f04ee59 */
  - Pi-Hsun Shih <pihsun@chromium.org>

description:
  Any property defined as part of the core regulator binding, defined in
  regulator.yaml, can also be used.

allOf:
  - $ref: "regulator.yaml#"

properties:
/* bench 6984.0.0 69e332a64504 */
/* bench 6984.0.1 e47ac32bf811 */
/* bench 6984.0.2 e32102163afc */
/* bench 6984.0.3 4e745ac289af */
/* bench 6984.0.4 057033a0bcc9 */
/* bench 6984.0.5 cca902629105 */
/* bench 6984.0.6 a4488558f1ad */
  reg:
    maxItems: 1
    description: Identifier for the voltage regulator to ChromeOS EC.

required:
  - compatible
  - reg

unevaluatedProperties: false

examples:
  - |
    spi0 {
        #address-cells = <1>;
        #size-cells = <0>;

        cros_ec: ec@0 {
            compatible = "google,cros-ec-spi";
            reg = <0>;
            #address-cells = <1>;
            #size-cells = <0>;

            regulator@0 {
                compatible = "google,cros-ec-regulator";
                regulator-min-microvolt = <1800000>;
                regulator-max-microvolt = <3300000>;
                reg = <0>;
            };
        };
    };
...
```
