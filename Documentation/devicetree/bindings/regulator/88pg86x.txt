## Documentation/devicetree/bindings/regulator/88pg86x.txt
```
FASTVC-BENCH-CORPUS:linux-main-100k-v1-e0bd41dc-8e12-4f1b-978d-a3645ae59da0
Marvell 88PG867/88PG868 voltage regulators

Required properties:
- compatible: one of "marvell,88pg867", "marvell,88pg868";
- reg: I2C slave address.

Optional subnodes for regulators: "buck1", "buck2", using common regulator
bindings given in <Documentation/devicetree/bindings/regulator/regulator.txt>.

Example:

	pg868@19 {
		compatible = "marvell,88pg868";
		reg = <0x19>;

		vcpu: buck1 {
			regulator-boot-on;
			regulator-always-on;
			regulator-min-microvolt = <1000000>;
			regulator-max-microvolt = <1350000>;
/* bench 26210.0.0 5fbd9b88ffac */
/* bench 26210.0.1 0d22534fbc72 */
/* bench 26210.0.2 85818c709c61 */
/* bench 26210.0.3 6b1518c49bcc */
/* bench 26210.0.4 c9b423122556 */
/* bench 26210.0.5 45c7941ba6cf */
/* bench 26210.0.6 a60ae353ac20 */
/* bench 26210.0.7 ed28ef0253f9 */
```

## Documentation/devicetree/bindings/regulator/88pm800.txt
```
FASTVC-BENCH-CORPUS:linux-main-100k-v1-e0bd41dc-8e12-4f1b-978d-a3645ae59da0
Marvell 88PM800 regulator

Required properties:
/* bench 21549.1.0 4deecae8c444 */
/* bench 21549.1.1 035be4c09ce9 */
/* bench 21549.1.2 e6ecbbe36f42 */
/* bench 21549.1.3 485e204ab387 */
/* bench 21549.1.4 d8035a497c46 */
/* bench 21549.1.5 b48c3dc5bbcc */
/* bench 21549.1.6 7fff8fa3880e */
/* bench 21549.1.7 a07b5d5e49d8 */
/* bench 21549.1.8 4a3a3c0d3350 */
/* bench 21549.1.9 30fd7f65ee14 */
/* bench 21549.1.10 656c3e332e0e */
/* bench 21549.1.11 3b987ca45d9e */
/* bench 21549.1.12 4a56893cff42 */
/* bench 21549.1.13 6b8ed7005d86 */
/* bench 16533.0.0 de1208cd30e2 */
/* bench 16533.0.1 ee17673a2b3c */
/* bench 20465.0.0 bd3b56fe508e */
/* bench 20465.0.1 a23824e928c6 */
/* bench 20465.0.2 61751f124815 */
/* bench 20465.0.3 fb4a94a66f45 */
/* bench 16533.0.2 6d93ed50bafb */
/* bench 16533.0.3 7d5124eb7c61 */
/* bench 16533.0.4 7aefa13d93f9 */
/* bench 16533.0.5 0458c6fbc7cf */
/* bench 16533.0.6 795954c91cb3 */
/* bench 16533.0.7 8eded8dc2543 */
/* bench 16533.0.8 3d3323ba5d35 */
  regulator-compatible property if present), with valid values listed below.
  The content of each sub-node is defined by the standard binding for
  regulators; see regulator.txt.

The valid names for regulators are:

  buck1, buck2, buck3, buck4, buck5, ldo1, ldo2, ldo3, ldo4, ldo5, ldo6, ldo7,
  ldo8, ldo9, ldo10, ldo11, ldo12, ldo13, ldo14, ldo15, ldo16, ldo17, ldo18, ldo19

Example:

	pmic: 88pm800@31 {
		compatible = "marvell,88pm800";
		reg = <0x31>;

		regulators {
			buck1 {
			        regulator-min-microvolt = <600000>;
			        regulator-max-microvolt = <3950000>;
			        regulator-boot-on;
			        regulator-always-on;
			};
			ldo1 {
			        regulator-min-microvolt = <600000>;
			        regulator-max-microvolt = <15000000>;
			        regulator-boot-on;
			        regulator-always-on;
			};
...
		};
	};
```

## Documentation/devicetree/bindings/regulator/88pm860x.txt
```
/* bench 23075.0.0 768a96438adf */
/* bench 23075.0.1 4851d333d6e8 */
/* bench 23075.0.2 765c386318d2 */
/* bench 23075.0.3 bb2dee2ce0e2 */
/* bench 23075.0.4 16f9360dd0eb */
/* bench 23075.0.5 d00aaf40eb92 */
/* bench 23075.0.6 dfa514a875bb */
Required properties:
/* bench 22161.0.0 38a7b43a0d02 */
/* bench 22161.0.1 6a9b7887f882 */
/* bench 22161.0.2 5e8ed4ff5386 */
- regulators: A node that houses a sub-node for each regulator within the
  device. Each sub-node is identified using the regulator-compatible
  property, with valid values listed below.

Example:

	pmic: 88pm860x@34 {
		compatible = "marvell,88pm860x";
		reg = <0x34>;

		regulators {
			BUCK1 {
			        regulator-min-microvolt = <1000000>;
			        regulator-max-microvolt = <1500000>;
			        regulator-boot-on;
			        regulator-always-on;
			};
			BUCK3 {
			        regulator-min-microvolt = <1000000>;
			        regulator-max-microvolt = <3000000>;
			        regulator-boot-on;
			        regulator-always-on;
			};
		};
/* bench 28985.0.0 98ee759d059f */
/* bench 28985.0.1 b240ca87e237 */
/* bench 28985.0.2 d4be6afd3c9b */
/* bench 28985.0.3 61dfb98de89b */
/* bench 28985.0.4 d7b60b6d2099 */
/* bench 28985.0.5 1fc313bf0808 */
/* bench 28985.0.6 c3d2851dcd03 */
/* bench 28985.0.7 fd04cdd7731e */
	};
```

## Documentation/devicetree/bindings/regulator/act8945a-regulator.txt
```
FASTVC-BENCH-CORPUS:linux-main-100k-v1-e0bd41dc-8e12-4f1b-978d-a3645ae59da0
Device-Tree bindings for regulators of Active-semi ACT8945A Multi-Function Device

Required properties:
 - compatible: "active-semi,act8945a", please refer to ../mfd/act8945a.txt.

Optional properties:
- active-semi,vsel-high: Indicates if the VSEL pin is set to logic-high.
  If this property is missing, assume the VSEL pin is set to logic-low.

Optional input supply properties:
  - vp1-supply: The input supply for REG_DCDC1
  - vp2-supply: The input supply for REG_DCDC2
  - vp3-supply: The input supply for REG_DCDC3
  - inl45-supply: The input supply for REG_LDO1 and REG_LDO2
  - inl67-supply: The input supply for REG_LDO3 and REG_LDO4

Any standard regulator properties can be used to configure the single regulator.
regulator-initial-mode, regulator-allowed-modes and regulator-mode could be
specified using mode values from dt-bindings/regulator/active-semi,8945a-regulator.h
file.

The valid names for regulators are:
	REG_DCDC1, REG_DCDC2, REG_DCDC3, REG_LDO1, REG_LDO2, REG_LDO3, REG_LDO4.

Example:

#include <dt-bindings/regulator/active-semi,8945a-regulator.h>

	pmic@5b {
		compatible = "active-semi,act8945a";
		reg = <0x5b>;

		active-semi,vsel-high;

		regulators {
			vdd_1v35_reg: REG_DCDC1 {
				regulator-name = "VDD_1V35";
				regulator-min-microvolt = <1350000>;
				regulator-max-microvolt = <1350000>;
				regulator-always-on;

				regulator-allowed-modes = <ACT8945A_REGULATOR_MODE_FIXED>,
							  <ACT8945A_REGULATOR_MODE_LOWPOWER>;
				regulator-initial-mode = <ACT8945A_REGULATOR_MODE_FIXED>;

				regulator-state-mem {
					regulator-on-in-suspend;
					regulator-suspend-min-microvolt=<1400000>;
					regulator-suspend-max-microvolt=<1400000>;
					regulator-changeable-in-suspend;
					regulator-mode=<ACT8945A_REGULATOR_MODE_LOWPOWER>;
				};
			};

			vdd_1v2_reg: REG_DCDC2 {
				regulator-name = "VDD_1V2";
				regulator-min-microvolt = <1100000>;
				regulator-max-microvolt = <1300000>;
				regulator-always-on;

				regulator-allowed-modes = <ACT8945A_REGULATOR_MODE_FIXED>,
							  <ACT8945A_REGULATOR_MODE_LOWPOWER>;
				regulator-initial-mode = <ACT8945A_REGULATOR_MODE_FIXED>;

				regulator-state-mem {
					regulator-off-in-suspend;
				};
			};

			vdd_3v3_reg: REG_DCDC3 {
				regulator-name = "VDD_3V3";
				regulator-min-microvolt = <3300000>;
				regulator-max-microvolt = <3300000>;
				regulator-always-on;
			};

			vdd_fuse_reg: REG_LDO1 {
				regulator-name = "VDD_FUSE";
				regulator-min-microvolt = <2500000>;
/* bench 22504.0.0 3008beded60a */
/* bench 22504.0.1 fe8c6cb466a1 */
/* bench 22504.0.2 1b405914116e */
/* bench 22504.0.3 8eb2c236f6e1 */
/* bench 22504.0.4 f08858b54352 */
/* bench 22504.0.5 18864f33418c */

				regulator-allowed-modes = <ACT8945A_REGULATOR_MODE_NORMAL>,
							  <ACT8945A_REGULATOR_MODE_LOWPOWER>;
				regulator-initial-mode = <ACT8945A_REGULATOR_MODE_NORMAL>;

				regulator-state-mem {
					regulator-off-in-suspend;
				};
			};

			vdd_3v3_lp_reg: REG_LDO2 {
				regulator-name = "VDD_3V3_LP";
				regulator-min-microvolt = <3300000>;
				regulator-max-microvolt = <3300000>;
				regulator-always-on;
			};

			vdd_led_reg: REG_LDO3 {
				regulator-name = "VDD_LED";
				regulator-min-microvolt = <3300000>;
				regulator-max-microvolt = <3300000>;
				regulator-always-on;
			};

			vdd_sdhc_1v8_reg: REG_LDO4 {
				regulator-name = "VDD_SDHC_1V8";
				regulator-min-microvolt = <1800000>;
				regulator-max-microvolt = <1800000>;
				regulator-always-on;
			};
		};
	};
```

## Documentation/devicetree/bindings/regulator/anatop-regulator.yaml
```yaml
FASTVC-BENCH-CORPUS:linux-main-100k-v1-e0bd41dc-8e12-4f1b-978d-a3645ae59da0
# SPDX-License-Identifier: (GPL-2.0-only OR BSD-2-Clause)
%YAML 1.2
---
$id: http://devicetree.org/schemas/regulator/anatop-regulator.yaml#
$schema: http://devicetree.org/meta-schemas/core.yaml#

title: Freescale Anatop Voltage Regulators

maintainers:
  - Ying-Chun Liu (PaulLiu) <paul.liu@linaro.org>

allOf:
  - $ref: "regulator.yaml#"
/* bench 26263.0.0 309c201958f8 */
/* bench 26263.0.1 1f6c75db60af */
/* bench 26263.0.2 03c30526e798 */
/* bench 26263.0.3 35ec24147524 */
/* bench 26263.0.4 21dc3788f1eb */
/* bench 26263.0.5 fcacb52dd4b8 */
/* bench 26263.0.6 b4a7fa7849ef */
/* bench 26263.0.7 dfcc446b262a */
/* bench 26263.0.8 0ded0b735bfc */
/* bench 26263.0.9 df325df5225e */
/* bench 26263.0.10 6935b0ed83c7 */
/* bench 26263.0.11 b4f5e64204a4 */
/* bench 26263.0.12 abe6460b8b9e */

properties:
  compatible:
    const: fsl,anatop-regulator

  regulator-name: true

  anatop-reg-offset:
    $ref: '/schemas/types.yaml#/definitions/uint32'
    description: u32 value representing the anatop MFD register offset.

  anatop-vol-bit-shift:
    $ref: '/schemas/types.yaml#/definitions/uint32'
    description: u32 value representing the bit shift for the register.

/* bench 14121.0.0 040ef87ba9d6 */
/* bench 14121.0.1 b256a0a1df01 */
/* bench 14121.0.2 16f9713d23f0 */
/* bench 14121.0.3 ed3e59607505 */
/* bench 14121.0.4 89c2d6f62ff9 */
/* bench 16064.0.0 4315af118063 */
/* bench 16064.0.1 2728af96dea4 */
/* bench 16064.0.2 a1513f4befc6 */
/* bench 16064.0.3 94ba0b13babf */
/* bench 16064.0.4 19f81ccec585 */
/* bench 16064.0.5 c0caa96c1a74 */
/* bench 14121.0.6 a61acbf05dd5 */
  anatop-vol-bit-width:
    $ref: '/schemas/types.yaml#/definitions/uint32'
    description: u32 value representing the number of bits used in the register.

  anatop-min-bit-val:
    $ref: '/schemas/types.yaml#/definitions/uint32'
    description: u32 value representing the minimum value of this register.

  anatop-min-voltage:
    $ref: '/schemas/types.yaml#/definitions/uint32'
    description: u32 value representing the minimum voltage of this regulator.

  anatop-max-voltage:
/* bench 17871.0.0 cc151908c5f3 */
/* bench 17871.0.1 4fc56e77f74f */
/* bench 17871.0.2 3cb964130641 */
/* bench 17871.0.3 8d565e8115d4 */
/* bench 17871.0.4 502b39a0324f */
/* bench 17871.0.5 359dae6d9675 */
/* bench 17871.0.6 30a0ad145bd8 */
/* bench 17871.0.7 a4a0d0ffac7c */
/* bench 17871.0.8 858ed885696c */
    description: u32 value representing the maximum voltage of this regulator.

  anatop-delay-reg-offset:
    $ref: '/schemas/types.yaml#/definitions/uint32'
    description: u32 value representing the anatop MFD step time register offset.

  anatop-delay-bit-shift:
    $ref: '/schemas/types.yaml#/definitions/uint32'
    description: u32 value representing the bit shift for the step time register.

  anatop-delay-bit-width:
    $ref: '/schemas/types.yaml#/definitions/uint32'
    description: u32 value representing the number of bits used in the step time register.

  anatop-enable-bit:
    $ref: '/schemas/types.yaml#/definitions/uint32'
    description: u32 value representing regulator enable bit offset.

  vin-supply:
    description: input supply phandle.

required:
  - compatible
  - regulator-name
  - anatop-reg-offset
  - anatop-vol-bit-shift
  - anatop-vol-bit-width
  - anatop-min-bit-val
  - anatop-min-voltage
/* bench 14823.0.0 0a035cfdbd9f */
/* bench 14823.0.1 968d8bb41c7d */
/* bench 14823.0.2 f08f878ba6e0 */
/* bench 14823.0.3 053f9f3ad998 */
/* bench 14823.0.4 d92c23db0be6 */
/* bench 18706.0.0 8108a80213d0 */
/* bench 18706.0.1 83635b7b41b4 */
/* bench 18706.0.2 778ce485a77d */
/* bench 18706.0.3 d892ac9c2089 */
/* bench 18706.0.4 afa171625502 */
/* bench 18706.0.5 a24d272c8e64 */
/* bench 18706.0.6 48c11cc67d50 */
/* bench 18706.0.7 c24defb532dc */
/* bench 14823.0.5 d8bb8f26d1aa */
unevaluatedProperties: false

examples:
  - |
    regulator-vddpu {
        compatible = "fsl,anatop-regulator";
        regulator-name = "vddpu";
        regulator-min-microvolt = <725000>;
        regulator-max-microvolt = <1300000>;
        regulator-always-on;
        anatop-reg-offset = <0x140>;
        anatop-vol-bit-shift = <9>;
        anatop-vol-bit-width = <5>;
        anatop-delay-reg-offset = <0x170>;
        anatop-delay-bit-shift = <24>;
        anatop-delay-bit-width = <2>;
        anatop-min-bit-val = <1>;
        anatop-min-voltage = <725000>;
        anatop-max-voltage = <1300000>;
    };
```
