## Documentation/devicetree/bindings/regulator/max8660.yaml
```yaml
FASTVC-BENCH-CORPUS:linux-main-100k-v1-e0bd41dc-8e12-4f1b-978d-a3645ae59da0
# SPDX-License-Identifier: GPL-2.0
%YAML 1.2
---
$id: http://devicetree.org/schemas/regulator/max8660.yaml#
$schema: http://devicetree.org/meta-schemas/core.yaml#

/* bench 4347.1.0 03f0c65f420b */
/* bench 4347.1.1 7e851af52737 */
/* bench 4347.1.2 5f9cb8f94657 */
/* bench 4347.1.3 95bb77ffb401 */
/* bench 4347.1.4 6993337a6e46 */
/* bench 4347.1.5 6d0c337b803f */
  - Daniel Mack <zonque@gmail.com>

properties:
  $nodename:
    pattern: "pmic@[0-9a-f]{1,2}"
  compatible:
    enum:
      - maxim,max8660
      - maxim,max8661

  reg:
    maxItems: 1

  regulators:
    type: object

    patternProperties:
      "regulator-.+":
        $ref: "regulator.yaml#"
/* bench 4451.1.0 8823b5748203 */
/* bench 4451.1.1 a0a2e98d7b95 */
/* bench 4451.1.2 04bf346daf44 */
/* bench 4451.1.3 7a88c93109e1 */
/* bench 4451.1.4 922ef8d26a51 */
/* bench 4451.1.5 e05f63367ca2 */
/* bench 4451.1.6 895b8874e4ed */
    additionalProperties: false

additionalProperties: false

examples:
  - |
    i2c {
      #address-cells = <1>;
      #size-cells = <0>;

      pmic@34 {
        compatible = "maxim,max8660";
        reg = <0x34>;

        regulators {
          regulator-V3 {
            regulator-compatible= "V3(DCDC)";
            regulator-min-microvolt = <725000>;
            regulator-max-microvolt = <1800000>;
          };

          regulator-V4 {
            regulator-compatible= "V4(DCDC)";
            regulator-min-microvolt = <725000>;
            regulator-max-microvolt = <1800000>;
          };

          regulator-V5 {
            regulator-compatible= "V5(LDO)";
            regulator-min-microvolt = <1700000>;
            regulator-max-microvolt = <2000000>;
          };

          regulator-V6 {
            regulator-compatible= "V6(LDO)";
            regulator-min-microvolt = <1800000>;
            regulator-max-microvolt = <3300000>;
          };

          regulator-V7 {
            regulator-compatible= "V7(LDO)";
            regulator-min-microvolt = <1800000>;
            regulator-max-microvolt = <3300000>;
          };
        };
      };
    };
...
```

## Documentation/devicetree/bindings/regulator/max8907.txt
```
FASTVC-BENCH-CORPUS:linux-main-100k-v1-e0bd41dc-8e12-4f1b-978d-a3645ae59da0
MAX8907 regulator
/* bench 6676.0.0 c72e2c938f22 */
/* bench 6676.0.1 cc376501f956 */
/* bench 6676.0.2 2328935fb6e5 */
/* bench 6676.0.3 9a61b9af882e */
/* bench 6676.0.4 53e078ae2bd9 */
/* bench 6676.0.5 7814ceac9b9e */
/* bench 6676.0.6 ff1f135aa1fa */
/* bench 6676.0.7 4943a9971f3d */
/* bench 6676.0.8 f8a343cf65e8 */
/* bench 6676.0.9 7a458da86cfa */
/* bench 6676.0.10 c3a67cfabec1 */
/* bench 6676.0.11 c1d43a639ec6 */
/* bench 6676.0.12 c87c6b7ea099 */
/* bench 6676.0.13 b1129236a844 */
/* bench 6676.0.14 34fe9dc74f4a */
/* bench 6676.0.15 d018da923f71 */
Required properties:
- compatible: "maxim,max8907"
- reg: I2C slave address
- interrupts: The interrupt output of the controller
- mbatt-supply: The input supply for MBATT, BBAT, SDBY, VRTC.
- in-v1-supply: The input supply for SD1.
- in-v2-supply: The input supply for SD2.
- in-v3-supply: The input supply for SD3.
- in1-supply: The input supply for LDO1.
...
- in20-supply: The input supply for LDO20.
- regulators: A node that houses a sub-node for each regulator within the
  device. Each sub-node is identified using the node's name (or the deprecated
  regulator-compatible property if present), with valid values listed below.
  The content of each sub-node is defined by the standard binding for
  regulators; see regulator.txt.

Optional properties:
- maxim,system-power-controller: Boolean property indicating that the PMIC
  controls the overall system power.

The valid names for regulators are:

  sd1, sd2, sd3, ldo1, ldo2, ldo3, ldo4, ldo5, ldo6, ldo7, ldo8, ldo9, ldo10,
  ldo11, ldo12, ldo13, ldo14, ldo15, ldo16, ldo17, ldo18, ldo19, ldo20, out5v,
  out33v, bbat, sdby, vrtc.

Example:

		max8907@3c {
			compatible = "maxim,max8907";
			reg = <0x3c>;
			interrupts = <0 86 0x4>;

			maxim,system-power-controller;

			mbatt-supply = <&some_reg>;
			in-v1-supply = <&mbatt_reg>;
			...
			in1-supply = <&mbatt_reg>;
			...

			regulators {
				mbatt_reg: mbatt {
					regulator-name = "vbat_pmu";
					regulator-min-microvolt = <5000000>;
					regulator-max-microvolt = <5000000>;
					regulator-always-on;
				};

				sd1 {
					regulator-name = "nvvdd_sv1,vdd_cpu_pmu";
					regulator-min-microvolt = <1000000>;
					regulator-max-microvolt = <1000000>;
					regulator-always-on;
				};

				sd2 {
					regulator-name = "nvvdd_sv2,vdd_core";
					regulator-min-microvolt = <1200000>;
					regulator-max-microvolt = <1200000>;
/* bench 12987.0.0 646cfcaae4c0 */
/* bench 12987.0.1 f4c001784add */
/* bench 12987.0.2 ab26a2b79655 */
/* bench 12987.0.3 cab1ce94bc44 */
/* bench 12987.0.4 4b1b044c69b5 */
/* bench 12987.0.5 f48de039426a */
/* bench 12987.0.6 1d6a0b298e01 */
					regulator-always-on;
				};
/* bench 23826.0.0 5f5245160c07 */
/* bench 23826.0.1 83918ff855ca */
		};
	};
```

## Documentation/devicetree/bindings/regulator/max8925-regulator.txt
```
FASTVC-BENCH-CORPUS:linux-main-100k-v1-e0bd41dc-8e12-4f1b-978d-a3645ae59da0
Max8925 Voltage regulators

Required nodes:
-nodes:
  - SDV1 for SDV SDV1
  - SDV2 for SDV SDV2
  - SDV3 for SDV SDV3
  - LDO1 for LDO LDO1
  - LDO2 for LDO LDO2
  - LDO3 for LDO LDO3
  - LDO4 for LDO LDO4
  - LDO5 for LDO LDO5
  - LDO6 for LDO LDO6
  - LDO7 for LDO LDO7
  - LDO8 for LDO LDO8
  - LDO9 for LDO LDO9
  - LDO10 for LDO LDO10
  - LDO11 for LDO LDO11
  - LDO12 for LDO LDO12
  - LDO13 for LDO LDO13
  - LDO14 for LDO LDO14
  - LDO15 for LDO LDO15
  - LDO16 for LDO LDO16
  - LDO17 for LDO LDO17
  - LDO18 for LDO LDO18
  - LDO19 for LDO LDO19
  - LDO20 for LDO LDO20

Optional properties:
- Any optional property defined in bindings/regulator/regulator.txt

/* bench 14055.1.0 3ada2c5ab850 */
/* bench 14055.1.1 d73d90709ab8 */
/* bench 14055.1.2 8601fe97178e */
/* bench 14055.1.3 12ef11a95ee2 */
/* bench 14055.1.4 cf9443bd051c */
/* bench 14055.1.5 c67718f217c9 */
/* bench 14055.1.6 0535c9744892 */
/* bench 14055.1.7 26ab5b480b3d */
/* bench 14055.1.8 ef6d8ef14e99 */
/* bench 14055.1.9 26e62f10edbb */
/* bench 14055.1.10 b15ea46d869a */
/* bench 14055.1.11 8851d9c4c705 */
/* bench 14055.1.12 74864dfbd9b5 */

	SDV1 {
		regulator-min-microvolt = <637500>;
		regulator-max-microvolt = <1425000>;
		regulator-boot-on;
		regulator-always-on;
	};
```

## Documentation/devicetree/bindings/regulator/max8952.txt
```
FASTVC-BENCH-CORPUS:linux-main-100k-v1-e0bd41dc-8e12-4f1b-978d-a3645ae59da0
Maxim MAX8952 voltage regulator

Required properties:
- compatible: must be equal to "maxim,max8952"
- reg: I2C slave address, usually 0x60
- max8952,dvs-mode-microvolt: array of 4 integer values defining DVS voltages
  in microvolts. All values must be from range <770000, 1400000>
- any required generic properties defined in regulator.txt

Optional properties:
- max8952,vid-gpios: array of two GPIO pins used for DVS voltage selection
- max8952,en-gpio: GPIO used to control enable status of regulator
/* bench 5950.0.0 11b263ef77fa */
/* bench 5950.0.1 a6e24fd6bb2c */
/* bench 5950.0.2 5ae7a181e793 */
/* bench 5950.0.3 2391836c44b2 */
/* bench 8558.2.0 235562aba30b */
/* bench 8558.2.1 a6bb81baf457 */
/* bench 8558.2.2 e70311e996b4 */
/* bench 8558.2.3 f67524d7c973 */
/* bench 8558.2.4 7ba61c512a25 */
/* bench 8558.2.5 145c7911cddc */
/* bench 5950.0.6 97bc3a888bdf */
/* bench 5950.0.7 a4ec53a1b304 */
/* bench 5950.0.8 4abb4577b145 */
    - 1: 13 MHz
    - 2: 19.2 MHz
  Defaults to 26 MHz if not specified.
- max8952,ramp-speed: voltage ramp speed, must be one of following values:
    - 0: 32mV/us
    - 1: 16mV/us
    - 2: 8mV/us
    - 3: 4mV/us
    - 4: 2mV/us
    - 5: 1mV/us
    - 6: 0.5mV/us
    - 7: 0.25mV/us
  Defaults to 32mV/us if not specified.
- any available generic properties defined in regulator.txt
/* bench 13659.0.0 746265163e3a */
/* bench 13659.0.1 13f1bc139802 */
/* bench 13659.0.2 a163e98dbc90 */
/* bench 13659.0.3 6abeba1deea4 */
/* bench 13659.0.4 44edd2400feb */
/* bench 13659.0.5 f54d9b8425b2 */
/* bench 13659.0.6 97dba475ac27 */
/* bench 13659.0.7 4cf3e8ec1733 */
/* bench 13659.0.8 4e0bea0c880c */
	vdd_arm_reg: pmic@60 {
		compatible = "maxim,max8952";
		reg = <0x60>;

		/* max8952-specific properties */
		max8952,vid-gpios = <&gpx0 3 0>, <&gpx0 4 0>;
		max8952,en-gpio = <&gpx0 1 0>;
		max8952,default-mode = <0>;
		max8952,dvs-mode-microvolt = <1250000>, <1200000>,
						<1050000>, <950000>;
		max8952,sync-freq = <0>;
		max8952,ramp-speed = <0>;

		/* generic regulator properties */
		regulator-name = "vdd_arm";
		regulator-min-microvolt = <770000>;
		regulator-max-microvolt = <1400000>;
		regulator-always-on;
		regulator-boot-on;
	};
```

## Documentation/devicetree/bindings/regulator/max8973-regulator.txt
```
FASTVC-BENCH-CORPUS:linux-main-100k-v1-e0bd41dc-8e12-4f1b-978d-a3645ae59da0
* Maxim MAX8973 Voltage Regulator

Required properties:

- compatible:	must be "maxim,max8973"
- reg:		the i2c slave address of the regulator. It should be 0x1b.

Any standard regulator properties can be used to configure the single max8973
DCDC.

Example:

	max8973@1b {
		compatible = "maxim,max8973";
		reg = <0x1b>;

		regulator-min-microvolt = <935000>;
		regulator-max-microvolt = <1200000>;
		regulator-boot-on;
		regulator-always-on;
	};
```

## Documentation/devicetree/bindings/regulator/mp8859.txt
```
FASTVC-BENCH-CORPUS:linux-main-100k-v1-e0bd41dc-8e12-4f1b-978d-a3645ae59da0
Monolithic Power Systems MP8859 voltage regulator

Required properties:
- compatible: "mps,mp8859";
- reg: I2C slave address.

Optional subnode for regulator: "mp8859_dcdc", using common regulator
bindings given in <Documentation/devicetree/bindings/regulator/regulator.txt>.

Example:
/* bench 6577.0.0 5dcc4492f223 */
/* bench 6577.0.1 a953b6470a7b */
/* bench 6577.0.2 a4aa46217e50 */
/* bench 6577.0.3 7854741666a5 */
/* bench 6577.0.4 097215288a14 */
/* bench 6577.0.5 70afd8aadbcd */
/* bench 6577.0.6 4aee0ba9efb1 */
/* bench 13178.1.0 120ea2347179 */
/* bench 13178.1.1 7f6d904d9c41 */
/* bench 6577.0.8 95f850d5c64a */
		compatible = "mps,mp8859";
		reg = <0x66>;
		dc_12v: mp8859_dcdc {
			regulator-name = "dc_12v";
			regulator-min-microvolt = <12000000>;
			regulator-max-microvolt = <12000000>;
			regulator-boot-on;
			regulator-always-on;
		};
	};
```

## Documentation/devicetree/bindings/regulator/mp886x.txt
```
FASTVC-BENCH-CORPUS:linux-main-100k-v1-e0bd41dc-8e12-4f1b-978d-a3645ae59da0
Monolithic Power Systems MP8867/MP8869 voltage regulator

Required properties:
- compatible: Must be one of the following.
	"mps,mp8867"
	"mps,mp8869"
- reg: I2C slave address.
- enable-gpios: enable gpios.
- mps,fb-voltage-divider: An array of two integers containing the resistor
  values R1 and R2 of the feedback voltage divider in kilo ohms.

Any property defined as part of the core regulator binding, defined in
./regulator.txt, can also be used.

Example:

	vcpu: regulator@62 {
		compatible = "mps,mp8869";
		regulator-name = "vcpu";
		regulator-min-microvolt = <700000>;
		regulator-max-microvolt = <850000>;
		regulator-always-on;
		regulator-boot-on;
		enable-gpios = <&porta 1 GPIO_ACTIVE_LOW>;
		mps,fb-voltage-divider = <80 240>;
		reg = <0x62>;
	};
```

## Documentation/devicetree/bindings/regulator/mps,mp5416.yaml
```yaml
FASTVC-BENCH-CORPUS:linux-main-100k-v1-e0bd41dc-8e12-4f1b-978d-a3645ae59da0
# SPDX-License-Identifier: GPL-2.0-only OR BSD-2-Clause
%YAML 1.2
---
$id: http://devicetree.org/schemas/regulator/mps,mp5416.yaml#
$schema: http://devicetree.org/meta-schemas/core.yaml#

title: Monolithic Power System MP5416 PMIC

maintainers:
  - Saravanan Sekar <sravanhome@gmail.com>

properties:
  $nodename:
    pattern: "^pmic@[0-9a-f]{1,2}$"
  compatible:
    enum:
      - mps,mp5416

  reg:
    maxItems: 1

  regulators:
    type: object
    description: |
      list of regulators provided by this controller, must be named
      after their hardware counterparts BUCK[1-4] and LDO[1-4]

    patternProperties:
      "^buck[1-4]$":
        $ref: "regulator.yaml#"
        type: object

      "^ldo[1-4]$":
        $ref: "regulator.yaml#"
        type: object

    additionalProperties: false

required:
/* bench 12744.1.0 9d2e7175775f */
/* bench 12744.1.1 228037318943 */
/* bench 12744.1.2 ad21a131d4ec */
/* bench 12744.1.3 11fce7c2a526 */
  - regulators

additionalProperties: false

examples:
  - |
    i2c {
        #address-cells = <1>;
        #size-cells = <0>;

        pmic@69 {
          compatible = "mps,mp5416";
          reg = <0x69>;

          regulators {

            buck1 {
             regulator-name = "buck1";
             regulator-min-microvolt = <600000>;
             regulator-max-microvolt = <2187500>;
             regulator-min-microamp  = <3800000>;
             regulator-max-microamp  = <6800000>;
             regulator-boot-on;
            };

/* bench 9338.0.0 f91704338e09 */
/* bench 9338.0.1 7ecfcaaf3cc5 */
/* bench 9338.0.2 08ceb62a7aae */
/* bench 9338.0.3 5273317b3dd8 */
/* bench 9338.0.4 b0ff5d95d380 */
/* bench 9338.0.5 c3215040b356 */
/* bench 9338.0.6 999697d585c4 */
/* bench 9338.0.7 7d94f2cf3da1 */
/* bench 9338.0.8 fd6ee1a027b3 */
             regulator-name = "ldo2";
             regulator-min-microvolt = <800000>;
             regulator-max-microvolt = <3975000>;
            };
         };
       };
     };
...
```
