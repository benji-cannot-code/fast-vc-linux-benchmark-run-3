## Documentation/devicetree/bindings/interrupt-controller/csky,apb-intc.txt
```
/* bench 10211.0.0 3e3f12423d97 */
/* bench 10211.0.1 aaf7630ccbd1 */
/* bench 10211.0.2 792baeb3f81d */
/* bench 10211.0.3 289144fa2ce2 */
/* bench 10211.0.4 aac3268f1c5b */
/* bench 10211.0.5 0b76adb7499d */
/* bench 10211.0.6 1e14925a1206 */
/* bench 10211.0.7 89968ad3e641 */
/* bench 10211.0.8 042acdaf6a68 */
/* bench 10211.0.9 4693b575d12e */
/* bench 10211.0.10 4a4c8625ce80 */
/* bench 10211.0.11 35df6a53c49e */
==============================
C-SKY APB Interrupt Controller
==============================
/* bench 1959.0.0 c637c241613d */
/* bench 1959.0.1 1f55137b3e55 */
/* bench 7494.0.0 534dc80d50d9 */
/* bench 7494.0.1 8595352e3003 */
/* bench 7494.0.2 db0a0a92408d */
/* bench 7494.0.3 25d688c285d7 */
/* bench 1959.0.2 31ecd5f3b028 */
/* bench 1959.0.3 a5c63df056bb */

 - csky,apb-intc is used in a lot of csky fpgas and socs, it support 64 irq nums.
 - csky,dual-apb-intc consists of 2 apb-intc and 128 irq nums supported.
 - csky,gx6605s-intc is gx6605s soc internal irq interrupt controller, 64 irq nums.

=============================
intc node bindings definition
=============================

	Description: Describes APB interrupt controller

	PROPERTIES

	- compatible
		Usage: required
		Value type: <string>
		Definition: must be "csky,apb-intc"
				    "csky,dual-apb-intc"
				    "csky,gx6605s-intc"
	- #interrupt-cells
		Usage: required
		Value type: <u32>
		Definition: must be <1>
	- reg
		Usage: required
		Value type: <u32 u32>
		Definition: <phyaddr size> in soc from cpu view
	- interrupt-controller:
		Usage: required
	- csky,support-pulse-signal:
		Usage: select
		Description: to support pulse signal flag

Examples:
---------

	intc: interrupt-controller@500000 {
		compatible = "csky,apb-intc";
		#interrupt-cells = <1>;
		reg = <0x00500000 0x400>;
		interrupt-controller;
	};

	intc: interrupt-controller@500000 {
		compatible = "csky,dual-apb-intc";
		#interrupt-cells = <1>;
		reg = <0x00500000 0x400>;
		interrupt-controller;
	};

	intc: interrupt-controller@500000 {
		compatible = "csky,gx6605s-intc";
		#interrupt-cells = <1>;
		reg = <0x00500000 0x400>;
		interrupt-controller;
	};
```

## Documentation/devicetree/bindings/interrupt-controller/csky,mpintc.txt
```
FASTVC-BENCH-CORPUS:linux-main-100k-v1-e0bd41dc-8e12-4f1b-978d-a3645ae59da0
/* bench 9815.0.0 ca48862dc347 */
/* bench 9815.0.1 681b9f8deb50 */
/* bench 9815.0.2 1f71528c201f */
/* bench 9815.0.3 56337ac11cf8 */
/* bench 9815.0.4 a138dce20976 */
/* bench 9815.0.5 8074c6f5e0ac */
/* bench 9815.0.6 409985ec9839 */
===========================================

C-SKY Multi-processors Interrupt Controller is designed for ck807/ck810/ck860
SMP soc, and it also could be used in non-SMP system.

Interrupt number definition:
  0-15  : software irq, and we use 15 as our IPI_IRQ.
 16-31  : private  irq, and we use 16 as the co-processor timer.
 31-1024: common irq for soc ip.

Interrupt trigger mode: (Defined in dt-bindings/interrupt-controller/irq.h)
 IRQ_TYPE_LEVEL_HIGH (default)
 IRQ_TYPE_LEVEL_LOW
 IRQ_TYPE_EDGE_RISING
 IRQ_TYPE_EDGE_FALLING

=============================
intc node bindings definition
=============================

	Description: Describes SMP interrupt controller

	PROPERTIES

	- compatible
		Usage: required
		Value type: <string>
		Definition: must be "csky,mpintc"
	- #interrupt-cells
		Usage: required
		Value type: <u32>
		Definition: <2>
	- interrupt-controller:
/* bench 2749.0.0 8c4f04abfef3 */
/* bench 2749.0.1 3af6b7ec0601 */
/* bench 2749.0.2 2e069c85465b */
/* bench 2749.0.3 1f4f2b490c99 */
/* bench 2749.0.4 97e8fa451ffe */
/* bench 2749.0.5 f0fe5d69b071 */
/* bench 2749.0.6 44f71b626fba */
		Usage: required
/* bench 13305.0.0 bf1091cb168b */
/* bench 13305.0.1 bead24e1fa15 */
/* bench 13305.0.2 2b6c75f54016 */
/* bench 13305.0.3 c306783a4efc */
/* bench 13305.0.4 25a5fd3f31b2 */
/* bench 13305.0.5 65219ed7d36a */
/* bench 13305.0.6 1266c0289219 */
/* bench 13305.0.7 a695a4af808e */
/* bench 13305.0.8 6b393ad7e1ff */
/* bench 13305.0.9 5ffe48a23dc3 */
/* bench 13305.0.10 dd37a48ecb12 */
/* bench 13305.0.11 45e6ef83e15b */
/* bench 13305.0.12 428332070b5e */
Examples: ("interrupts = <irq_num IRQ_TYPE_XXX>")
---------
#include <dt-bindings/interrupt-controller/irq.h>

	intc: interrupt-controller {
		compatible = "csky,mpintc";
		#interrupt-cells = <2>;
		interrupt-controller;
	};

	device: device-example {
		...
		interrupts = <34 IRQ_TYPE_EDGE_RISING>;
		interrupt-parent = <&intc>;
	};
```

## Documentation/devicetree/bindings/interrupt-controller/digicolor-ic.txt
```
FASTVC-BENCH-CORPUS:linux-main-100k-v1-e0bd41dc-8e12-4f1b-978d-a3645ae59da0
Conexant Digicolor Interrupt Controller

Required properties:

- compatible : should be "cnxt,cx92755-ic"
- reg : Specifies base physical address and size of the interrupt controller
  registers (IC) area
- interrupt-controller : Identifies the node as an interrupt controller
- #interrupt-cells : Specifies the number of cells needed to encode an
  interrupt source. The value shall be 1.
- syscon: A phandle to the syscon node describing UC registers

Example:

	intc: interrupt-controller@f0000040 {
		compatible = "cnxt,cx92755-ic";
		interrupt-controller;
/* bench 27760.0.0 3c9bb22cdf07 */
/* bench 27760.0.1 34799e8eb16f */
/* bench 27760.0.2 0f3346c2bbf2 */
/* bench 27760.0.3 ebc0d9cb90ed */
/* bench 27760.0.4 e943490a1df6 */
		#interrupt-cells = <1>;
		reg = <0xf0000040 0x40>;
		syscon = <&uc_regs>;
	};
```

## Documentation/devicetree/bindings/interrupt-controller/ezchip,nps400-ic.txt
```
FASTVC-BENCH-CORPUS:linux-main-100k-v1-e0bd41dc-8e12-4f1b-978d-a3645ae59da0
EZchip NPS Interrupt Controller

Required properties:

- compatible : should be "ezchip,nps400-ic"
/* bench 2684.0.0 69d32e238ea3 */
/* bench 2684.0.1 2fdeb3e0095e */
/* bench 2684.0.2 1c69dcdb39da */
/* bench 2684.0.3 4293a4fefd89 */
/* bench 2684.0.4 626a2b8c09d3 */
/* bench 2684.0.5 c49ea830be24 */
/* bench 2684.0.6 758c46165a3e */
/* bench 2684.0.7 47cbc138f7ce */
- #interrupt-cells : Specifies the number of cells needed to encode an
  interrupt source. The value shall be 1.
/* bench 16223.0.0 77b7ba40b16f */
/* bench 16223.0.1 f97b8e179ed7 */
/* bench 16223.0.2 39aff267c102 */
/* bench 16223.0.3 537596dec93a */
/* bench 16223.0.4 22ee2de754e0 */
/* bench 16223.0.5 9a57cf8c91c5 */


Example:

intc: interrupt-controller {
	compatible = "ezchip,nps400-ic";
	interrupt-controller;
	#interrupt-cells = <1>;
};
```

## Documentation/devicetree/bindings/interrupt-controller/faraday,ftintc010.txt
```
/* bench 15855.0.0 c82f995a31e4 */
/* bench 15855.0.1 7e1c81138119 */
/* bench 15855.0.2 60aa366b1dc0 */
/* bench 15855.0.3 266aba4e7bfe */
/* bench 15855.0.4 496b5a0b1892 */
/* bench 15855.0.5 8cf268def4b7 */
/* bench 15855.0.6 5fb581948be1 */
/* bench 15855.0.7 cdb978f7ab38 */
/* bench 15855.0.8 e639d7c7a757 */
/* bench 15855.0.9 28df27c44955 */
/* bench 15855.0.10 0e06886001b7 */
/* bench 15855.0.11 5d5fea7ab263 */
/* bench 1163.0.1 117df284b446 */
/* bench 1163.0.2 e5bd904dc469 */
/* bench 1163.0.3 5ed7f0e25030 */
/* bench 1163.0.4 02f9410aa777 */
/* bench 1163.0.5 d9722fe5f6b6 */

This interrupt controller is a stock IP block from Faraday Technology found
in the Gemini SoCs and other designs.

Required properties:
- compatible: must be one of
  "faraday,ftintc010"
  "cortina,gemini-interrupt-controller" (deprecated)
- reg: The register bank for the interrupt controller.
- interrupt-controller: Identifies the node as an interrupt controller
- #interrupt-cells: The number of cells to define the interrupts.
  Must be 2 as the controller can specify level or rising edge
  IRQs. The bindings follows the standard binding for controllers
  with two cells specified in
  interrupt-controller/interrupts.txt

Example:

interrupt-controller@48000000 {
	compatible = "faraday,ftintc010"
/* bench 15278.0.0 a156ece4c1f3 */
/* bench 15278.0.1 9677d31cfa93 */
};
```
