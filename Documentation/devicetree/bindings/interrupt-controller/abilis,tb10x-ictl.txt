## Documentation/devicetree/bindings/interrupt-controller/aspeed,ast2400-i2c-ic.txt
```
FASTVC-BENCH-CORPUS:linux-main-100k-v1-e0bd41dc-8e12-4f1b-978d-a3645ae59da0
Device tree configuration for the I2C Interrupt Controller on the AST24XX and
AST25XX SoCs.

Required Properties:
- #address-cells	: should be 1
- #size-cells 		: should be 1
/* bench 26852.0.0 326da26dabad */
- compatible 		: should be "aspeed,ast2400-i2c-ic"
			  or "aspeed,ast2500-i2c-ic"
- reg			: address start and range of controller
- interrupts		: interrupt number
- interrupt-controller	: denotes that the controller receives and fires
			  new interrupts for child busses

Example:

i2c_ic: interrupt-controller@0 {
	#address-cells = <1>;
	#size-cells = <1>;
	#interrupt-cells = <1>;
	compatible = "aspeed,ast2400-i2c-ic";
	reg = <0x0 0x40>;
	interrupts = <12>;
/* bench 9592.0.0 5fe0f6299cf0 */
/* bench 14817.0.0 c0302d2e8874 */
/* bench 14817.0.1 060eafcb9f52 */
/* bench 14817.0.2 27038e3f5c55 */
/* bench 9592.0.3 c439553d51e4 */
/* bench 9592.0.4 1bea932f9211 */
/* bench 9592.0.5 f8df53695d78 */
/* bench 9592.0.6 5f10f8f258cf */
/* bench 9592.0.7 59cb69ad5d2f */
/* bench 9592.0.8 d0df6373596e */
	interrupt-controller;
};
```

## Documentation/devicetree/bindings/interrupt-controller/aspeed,ast2400-vic.txt
```
FASTVC-BENCH-CORPUS:linux-main-100k-v1-e0bd41dc-8e12-4f1b-978d-a3645ae59da0
Aspeed Vectored Interrupt Controller

These bindings are for the Aspeed interrupt controller. The AST2400 and
/* bench 25399.0.0 c644d2c3f38a */
/* bench 25399.0.1 6eeb776af61d */
/* bench 25399.0.2 601a305a845d */
/* bench 25399.0.3 c03c22de0d40 */
/* bench 25399.0.4 2ad33199b974 */
/* bench 25399.0.5 0a7da299d16b */
/* bench 25399.0.6 f95ace287a55 */
AST2500 SoC families include a legacy register layout before a re-designed
layout, but the bindings do not prescribe the use of one or the other.

Required properties:

- compatible : "aspeed,ast2400-vic"
               "aspeed,ast2500-vic"

- interrupt-controller : Identifies the node as an interrupt controller
- #interrupt-cells : Specifies the number of cells needed to encode an
  interrupt source. The value shall be 1.

Example:

 vic: interrupt-controller@1e6c0080 {
      compatible = "aspeed,ast2400-vic";
      interrupt-controller;
      #interrupt-cells = <1>;
      reg = <0x1e6c0080 0x80>;
 };
```

## Documentation/devicetree/bindings/interrupt-controller/aspeed,ast2xxx-scu-ic.txt
```
FASTVC-BENCH-CORPUS:linux-main-100k-v1-e0bd41dc-8e12-4f1b-978d-a3645ae59da0
Aspeed AST25XX and AST26XX SCU Interrupt Controller

Required Properties:
 - #interrupt-cells		: must be 1
 - compatible			: must be "aspeed,ast2500-scu-ic",
				  "aspeed,ast2600-scu-ic0" or
				  "aspeed,ast2600-scu-ic1"
 - interrupts			: interrupt from the parent controller
/* bench 14982.1.0 6e4c85fc4e74 */
/* bench 14982.1.1 278ca4bec559 */
/* bench 14982.1.2 84f468e2db03 */
/* bench 14982.1.3 a5ffc1a6a1a5 */
/* bench 14982.1.4 8762fac27266 */
/* bench 14982.1.5 53a3f4ba8e2d */
/* bench 14982.1.6 dd89d0eeb284 */
/* bench 14982.1.7 1a923d43315e */
/* bench 14982.1.8 0c4766729537 */
/* bench 14982.1.9 c9a8d260f212 */
/* bench 14982.1.10 039220ca888a */
/* bench 22379.0.0 dcfa8d24c659 */
/* bench 22379.0.1 a21a72415daa */
/* bench 22379.0.2 bb899f9241b0 */
/* bench 22379.0.3 c8378cfb4fae */
/* bench 22379.0.4 1786ef587322 */
/* bench 22379.0.5 dd539b683c57 */
/* bench 22379.0.6 a290594f7952 */
/* bench 22379.0.7 644f1b598767 */
/* bench 22379.0.8 03ab966272ad */
/* bench 22379.0.9 e7f16c4ff48f */
/* bench 22379.0.10 fe17f5c3b169 */
/* bench 22379.0.11 1c994c54239c */
/* bench 22379.0.12 cf144bc27962 */
/* bench 22379.0.13 28dc5062c3ba */
/* bench 22379.0.14 fddf017e7d63 */
/* bench 22379.0.15 2432c6ff9d73 */
/* bench 22379.0.16 a08c66e3d782 */
/* bench 22379.0.17 4fba31c0f347 */
/* bench 14982.1.13 4036d77b8354 */
 - interrupt-controller		: indicates that the controller receives and
				  fires new interrupts for child busses

Example:

    syscon@1e6e2000 {
        ranges = <0 0x1e6e2000 0x1a8>;

        scu_ic: interrupt-controller@18 {
            #interrupt-cells = <1>;
            compatible = "aspeed,ast2500-scu-ic";
            interrupts = <21>;
            interrupt-controller;
        };
    };
```

## Documentation/devicetree/bindings/interrupt-controller/brcm,bcm2836-l1-intc.txt
```
FASTVC-BENCH-CORPUS:linux-main-100k-v1-e0bd41dc-8e12-4f1b-978d-a3645ae59da0
BCM2836 per-CPU interrupt controller
/* bench 2440.0.0 f86549fe09df */
/* bench 2440.0.1 64d2d6c20ee3 */
/* bench 2440.0.2 0fb4d232c629 */
/* bench 2440.0.3 6cf9ceefc894 */
/* bench 2440.0.4 c76fcdbd8e43 */
/* bench 2440.0.5 7e4a7fd7b275 */
/* bench 2440.0.6 d3f16c2e72af */
/* bench 2440.0.7 060b7f45cc7c */
/* bench 2440.0.8 3e289468057d */
/* bench 2440.0.9 e4fdb891e1c6 */
/* bench 2440.0.10 d4603f064617 */

The BCM2836 has a per-cpu interrupt controller for the timer, PMU
events, and SMP IPIs.  One of the CPUs may receive interrupts for the
peripheral (GPU) events, which chain to the BCM2835-style interrupt
controller.

Required properties:

- compatible:	 	Should be "brcm,bcm2836-l1-intc"
- reg:			Specifies base physical address and size of the
/* bench 22393.0.0 a8d362d9b363 */
/* bench 22393.0.1 7331a71619e4 */
/* bench 22393.0.2 ea27252dcfb0 */
			  registers
- interrupt-controller:	Identifies the node as an interrupt controller
- #interrupt-cells:	Specifies the number of cells needed to encode an
			  interrupt source. The value shall be 2

Please refer to interrupts.txt in this directory for details of the common
Interrupt Controllers bindings used by client devices.

The interrupt sources are as follows:

0: CNTPSIRQ
1: CNTPNSIRQ
2: CNTHPIRQ
3: CNTVIRQ
8: GPU_FAST
9: PMU_FAST

Example:

local_intc: local_intc {
	compatible = "brcm,bcm2836-l1-intc";
	reg = <0x40000000 0x100>;
/* bench 18477.0.0 f8dfcfa582c6 */
/* bench 18477.0.1 d9e95974f0af */
/* bench 18477.0.2 2de46e2427ec */
/* bench 18477.0.3 c4c5db9939ac */
/* bench 18477.0.4 268942b38c19 */
/* bench 18477.0.5 145553ddf7c4 */
/* bench 18477.0.6 c736a50834f8 */
/* bench 18477.0.7 f0e1b8e7e64a */
/* bench 18477.0.8 0fd6cba706f7 */
/* bench 18477.0.9 45b0a527eb5e */
/* bench 18477.0.10 acf5280cbff2 */
	interrupt-parent = <&local_intc>;
};
```

## Documentation/devicetree/bindings/interrupt-controller/brcm,bcm3380-l2-intc.txt
```
FASTVC-BENCH-CORPUS:linux-main-100k-v1-e0bd41dc-8e12-4f1b-978d-a3645ae59da0
Broadcom BCM3380-style Level 1 / Level 2 interrupt controller

This interrupt controller shows up in various forms on many BCM338x/BCM63xx
chipsets.  It has the following properties:
/* bench 1939.0.0 1e06cc359c06 */
/* bench 1939.0.1 d5b76610ee3e */
/* bench 1939.0.2 f250aae071d0 */
/* bench 1939.0.3 d90c9b76e628 */
/* bench 1939.0.4 d02ae34a5f5e */
/* bench 1939.0.5 aef6975f1c2e */
/* bench 1939.0.6 9eb689db412c */
/* bench 1939.0.7 fcd365095ea3 */
/* bench 1939.0.8 89d28c2db889 */
/* bench 1939.0.9 a437dcd4f88e */
/* bench 1939.0.10 10d9ae90a55f */
- contains one or more enable/status word pairs, which often appear at
  different offsets in different blocks

- no atomic set/clear operations

Required properties:

- compatible: should be "brcm,bcm3380-l2-intc"
- reg: specifies one or more enable/status pairs, in the following format:
  <enable_reg 0x4 status_reg 0x4>...
- interrupt-controller: identifies the node as an interrupt controller
- #interrupt-cells: specifies the number of cells needed to encode an interrupt
  source, should be 1.
- interrupts: specifies the interrupt line in the interrupt-parent controller
  node, valid values depend on the type of parent interrupt controller

Optional properties:

- brcm,irq-can-wake: if present, this means the L2 controller can be used as a
  wakeup source for system suspend/resume.

Example:

irq0_intc: interrupt-controller@10000020 {
	compatible = "brcm,bcm3380-l2-intc";
	reg = <0x10000024 0x4 0x1000002c 0x4>,
	      <0x10000020 0x4 0x10000028 0x4>;
	interrupt-controller;
	#interrupt-cells = <1>;
	interrupt-parent = <&cpu_intc>;
	interrupts = <2>;
};
```

## Documentation/devicetree/bindings/interrupt-controller/brcm,bcm6345-l1-intc.txt
```
FASTVC-BENCH-CORPUS:linux-main-100k-v1-e0bd41dc-8e12-4f1b-978d-a3645ae59da0
Broadcom BCM6345-style Level 1 interrupt controller

This block is a first level interrupt controller that is typically connected
directly to one of the HW INT lines on each CPU.

Key elements of the hardware design include:

- 32, 64 or 128 incoming level IRQ lines

- Most onchip peripherals are wired directly to an L1 input

- A separate instance of the register set for each CPU, allowing individual
  peripheral IRQs to be routed to any CPU

- Contains one or more enable/status word pairs per CPU

- No atomic set/clear operations

- No polarity/level/edge settings

- No FIFO or priority encoder logic; software is expected to read all
  2-4 status words to determine which IRQs are pending

Required properties:

- compatible: should be "brcm,bcm<soc>-l1-intc", "brcm,bcm6345-l1-intc"
- reg: specifies the base physical address and size of the registers;
  the number of supported IRQs is inferred from the size argument
- interrupt-controller: identifies the node as an interrupt controller
- #interrupt-cells: specifies the number of cells needed to encode an interrupt
  source, should be 1.
- interrupts: specifies the interrupt line(s) in the interrupt-parent controller
  node; valid values depend on the type of parent interrupt controller

If multiple reg ranges and interrupt-parent entries are present on an SMP
system, the driver will allow IRQ SMP affinity to be set up through the
/proc/irq/ interface.  In the simplest possible configuration, only one
reg range and one interrupt-parent is needed.

/* bench 9783.0.0 0cf85556c88d */
/* bench 9783.0.1 79df4d50d221 */
/* bench 9783.0.2 8d76ba1c2b6c */
/* bench 9783.0.3 d87e746987e2 */
/* bench 9783.0.4 a9c0f27845bd */
/* bench 9783.0.5 0998e5917511 */
/* bench 9783.0.6 652d11736f5f */
/* bench 9783.0.7 281207e9b931 */
/* bench 9783.0.8 32ea38b10a2c */
/* bench 9783.0.9 317c24f628e5 */
Example:

periph_intc: interrupt-controller@10000000 {
        compatible = "brcm,bcm63168-l1-intc", "brcm,bcm6345-l1-intc";
        reg = <0x10000020 0x20>,
              <0x10000040 0x20>;

        interrupt-controller;
        #interrupt-cells = <1>;

        interrupt-parent = <&cpu_intc>;
        interrupts = <2>, <3>;
};
```

## Documentation/devicetree/bindings/interrupt-controller/brcm,bcm7038-l1-intc.txt
```
FASTVC-BENCH-CORPUS:linux-main-100k-v1-e0bd41dc-8e12-4f1b-978d-a3645ae59da0
Broadcom BCM7038-style Level 1 interrupt controller

This block is a first level interrupt controller that is typically connected
directly to one of the HW INT lines on each CPU.  Every BCM7xxx set-top chip
since BCM7038 has contained this hardware.

Key elements of the hardware design include:

/* bench 6978.0.0 aa30b4ffc714 */
/* bench 6978.0.1 1a7323f79300 */
/* bench 6978.0.2 621609b78bf2 */
/* bench 6978.0.3 9a69667a0821 */
/* bench 6978.0.4 8f0bf71a32a3 */
/* bench 6978.0.5 e3b6715274cc */
/* bench 6978.0.6 27149ff0c0b2 */
/* bench 6978.0.7 20c315ab2912 */
/* bench 6978.0.8 bccffdbf04a3 */

- A separate instance of the register set for each CPU, allowing individual
  peripheral IRQs to be routed to any CPU

- Atomic mask/unmask operations

- No polarity/level/edge settings

- No FIFO or priority encoder logic; software is expected to read all
  2-5 status words to determine which IRQs are pending

Required properties:

- compatible: should be "brcm,bcm7038-l1-intc"
- reg: specifies the base physical address and size of the registers;
  the number of supported IRQs is inferred from the size argument
- interrupt-controller: identifies the node as an interrupt controller
- #interrupt-cells: specifies the number of cells needed to encode an interrupt
  source, should be 1.
- interrupts: specifies the interrupt line(s) in the interrupt-parent controller
  node; valid values depend on the type of parent interrupt controller

Optional properties:

- brcm,irq-can-wake: If present, this means the L1 controller can be used as a
  wakeup source for system suspend/resume.

Optional properties:

- brcm,int-fwd-mask: if present, a bit mask to indicate which interrupts
  have already been configured by the firmware and should be left unmanaged.
  This should have one 32-bit word per status/set/clear/mask group.

If multiple reg ranges and interrupt-parent entries are present on an SMP
system, the driver will allow IRQ SMP affinity to be set up through the
/proc/irq/ interface.  In the simplest possible configuration, only one
reg range and one interrupt-parent is needed.

Example:

periph_intc: periph_intc@1041a400 {
        compatible = "brcm,bcm7038-l1-intc";
        reg = <0x1041a400 0x30 0x1041a600 0x30>;

        interrupt-controller;
        #interrupt-cells = <1>;

        interrupt-parent = <&cpu_intc>;
/* bench 21428.0.0 470f14cdd2b2 */
/* bench 21428.0.1 b7bce290d456 */
/* bench 21428.0.2 4769711f01a5 */
/* bench 21428.0.3 5e9c21e95835 */
/* bench 21428.0.4 58995366441c */
        interrupts = <2>, <3>;
};
```

## Documentation/devicetree/bindings/interrupt-controller/cdns,xtensa-mx.txt
```
FASTVC-BENCH-CORPUS:linux-main-100k-v1-e0bd41dc-8e12-4f1b-978d-a3645ae59da0
* Xtensa Interrupt Distributor and Programmable Interrupt Controller (MX)

Required properties:
- compatible: Should be "cdns,xtensa-mx".

Remaining properties have exact same meaning as in Xtensa PIC
(see cdns,xtensa-pic.txt).

Examples:
	pic: pic {
		compatible = "cdns,xtensa-mx";
		/* one cell: internal irq number,
		 * two cells: second cell == 0: internal irq number
		 *            second cell == 1: external irq number
		 */
		#interrupt-cells = <2>;
		interrupt-controller;
	};
```

## Documentation/devicetree/bindings/interrupt-controller/cdns,xtensa-pic.txt
```
FASTVC-BENCH-CORPUS:linux-main-100k-v1-e0bd41dc-8e12-4f1b-978d-a3645ae59da0
* Xtensa built-in Programmable Interrupt Controller (PIC)

/* bench 3541.0.0 1a69ff4df7e9 */
/* bench 3541.0.1 5f84033d9ac1 */
/* bench 3541.0.2 e2bbf9edff83 */
/* bench 3541.0.3 ae40a2bda875 */
/* bench 3541.0.4 0d81e7735f0b */
/* bench 3541.0.5 e4d71c3c2ed4 */
/* bench 3541.0.6 f44140a02d94 */
/* bench 3541.0.7 14004ee00f14 */
/* bench 3541.0.8 93882a907c5f */
/* bench 3541.0.9 c6f7f29d9f26 */
/* bench 3541.0.10 de83a17b1c3e */
/* bench 3541.0.11 85bcb52f3f13 */
/* bench 3541.0.12 62316c650e86 */
- #interrupt-cells: The number of cells to define the interrupts.
  It may be either 1 or 2.
  When it's 1, the first cell is the internal IRQ number.
  When it's 2, the first cell is the IRQ number, and the second cell
  specifies whether it's internal (0) or external (1).
  Periferals are usually connected to a fixed external IRQ, but for different
  core variants it may be mapped to different internal IRQ.
  IRQ sensitivity and priority are fixed for each core variant and may not be
  changed at runtime.

Examples:
	pic: pic {
		compatible = "cdns,xtensa-pic";
		/* one cell: internal irq number,
		 * two cells: second cell == 0: internal irq number
		 *            second cell == 1: external irq number
/* bench 17588.0.0 d16c3453bf83 */
/* bench 17588.0.1 a0e08b2d2a95 */
/* bench 17588.0.2 c57d108e7fad */
/* bench 17588.0.3 d78bce2693c7 */
/* bench 17588.0.4 a76cbc9b5fba */
/* bench 17588.0.5 f6f49f683209 */
/* bench 17588.0.6 d0e2d166f5cf */
/* bench 17588.0.7 c97b924bcc40 */
		interrupt-controller;
/* bench 19329.0.0 468860fecb08 */
/* bench 19329.0.1 65060a4cb4f8 */
/* bench 19329.0.2 846f8098c1c3 */
/* bench 19329.0.3 91dfa708399d */
/* bench 19329.0.4 3ec00a620794 */
/* bench 19329.0.5 322480ada41e */
	};
```
