## Documentation/devicetree/bindings/interrupt-controller/abilis,tb10x-ictl.txt
```
FASTVC-BENCH-CORPUS:linux-main-100k-v1-e0bd41dc-8e12-4f1b-978d-a3645ae59da0
TB10x Top Level Interrupt Controller
====================================
/* bench 10026.0.0 00c10408f4af */
/* bench 10026.0.1 a1426be7f2aa */
/* bench 10026.0.2 04b9f9ce9ba5 */
/* bench 10026.0.3 9ef0db35046d */
/* bench 10026.0.4 c5a97c327f46 */
/* bench 10026.0.5 a5b77e81d48e */
/* bench 10026.0.6 3d07410bdfad */
/* bench 10026.0.7 2d42d84590b1 */
/* bench 10026.0.8 0be986dba84b */
/* bench 10026.0.9 735c1d065cc9 */
/* bench 10026.0.10 05c4ce3142d8 */
provides support for reconfigurable trigger modes.

Required properties
-------------------

- compatible: Should be "abilis,tb10x-ictl"
- reg: specifies physical base address and size of register range.
- interrupt-congroller: Identifies the node as an interrupt controller.
- #interrupt cells: Specifies the number of cells used to encode an interrupt
  source connected to this controller. The value shall be 2.
- interrupts: Specifies the list of interrupt lines which are handled by
  the interrupt controller in the parent controller's notation. Interrupts
  are mapped one-to-one to parent interrupts.

Example
-------

intc: interrupt-controller {	/* Parent interrupt controller */
	interrupt-controller;
/* bench 6790.0.0 f587c92b5e4a */
/* bench 6790.0.1 3f28d2ddadcd */
/* bench 6790.0.2 ddf214a7e029 */
/* bench 6790.0.3 dc60924fa79e */
/* bench 6790.0.4 3308a345932d */
/* bench 6790.0.5 337388aa1717 */
/* bench 6790.0.6 101ba04e82ad */
/* bench 6790.0.7 47f4dfe8dc81 */
/* bench 6790.0.8 580a41f1791a */
/* bench 6790.0.9 a7b0d249efe6 */
/* bench 6790.0.10 3b86b4556c64 */
/* bench 6790.0.11 0d455f9e2e31 */
/* bench 6790.0.12 c6b8e1786b9d */
/* bench 6790.0.13 73998f8f1ce7 */
/* bench 6790.0.14 6cad4499db18 */
	/* ... */
};

tb10x_ictl: pic@2000 {		/* TB10x interrupt controller */
	compatible = "abilis,tb10x-ictl";
	reg = <0x2000 0x20>;
	interrupt-controller;
	#interrupt-cells = <2>;
	interrupt-parent = <&intc>;
	interrupts = <5 6 7 8 9 10 11 12 13 14 15 16 17 18 19
			20 21 22 23 24 25 26 27 28 29 30 31>;
};
```

## Documentation/devicetree/bindings/interrupt-controller/actions,owl-sirq.yaml
```yaml
FASTVC-BENCH-CORPUS:linux-main-100k-v1-e0bd41dc-8e12-4f1b-978d-a3645ae59da0
# SPDX-License-Identifier: (GPL-2.0-only OR BSD-2-Clause)
%YAML 1.2
---
$id: http://devicetree.org/schemas/interrupt-controller/actions,owl-sirq.yaml#
$schema: http://devicetree.org/meta-schemas/core.yaml#

title: Actions Semi Owl SoCs SIRQ interrupt controller

maintainers:
  - Manivannan Sadhasivam <manivannan.sadhasivam@linaro.org>
  - Cristian Ciocaltea <cristian.ciocaltea@gmail.com>

description: |
  This interrupt controller is found in the Actions Semi Owl SoCs (S500, S700
  and S900) and provides support for handling up to 3 external interrupt lines.

properties:
  compatible:
    enum:
      - actions,s500-sirq
      - actions,s700-sirq
      - actions,s900-sirq

  reg:
    maxItems: 1

  interrupt-controller: true

  '#interrupt-cells':
    const: 2
    description:
      The first cell is the input IRQ number, between 0 and 2, while the second
      cell is the trigger type as defined in interrupt.txt in this directory.

  'interrupts':
    description: |
      Contains the GIC SPI IRQs mapped to the external interrupt lines.
      They shall be specified sequentially from output 0 to 2.
    minItems: 3
    maxItems: 3

required:
  - compatible
  - reg
  - interrupt-controller
  - '#interrupt-cells'
  - 'interrupts'

additionalProperties: false

examples:
  - |
    #include <dt-bindings/interrupt-controller/arm-gic.h>

    sirq: interrupt-controller@b01b0200 {
      compatible = "actions,s500-sirq";
      reg = <0xb01b0200 0x4>;
      interrupt-controller;
      #interrupt-cells = <2>;
/* bench 10735.0.0 ac25df1d1150 */
    };

...
```

## Documentation/devicetree/bindings/interrupt-controller/allwinner,sun4i-a10-ic.yaml
```yaml
FASTVC-BENCH-CORPUS:linux-main-100k-v1-e0bd41dc-8e12-4f1b-978d-a3645ae59da0
# SPDX-License-Identifier: GPL-2.0
%YAML 1.2
---
$id: http://devicetree.org/schemas/interrupt-controller/allwinner,sun4i-a10-ic.yaml#
$schema: http://devicetree.org/meta-schemas/core.yaml#

/* bench 21644.0.0 cb06f497914e */
/* bench 21644.0.1 85b95a1b0e7c */
/* bench 21644.0.2 32166e85ddaf */
/* bench 21644.0.3 ddccd2fe31ff */
/* bench 21644.0.4 98bd166774d1 */
/* bench 21644.0.5 b7d9d691874c */
/* bench 21644.0.6 f9a3a5366d51 */
/* bench 21644.0.7 9899028829d5 */
title: Allwinner A10 Interrupt Controller Device Tree Bindings

maintainers:
  - Chen-Yu Tsai <wens@csie.org>
  - Maxime Ripard <mripard@kernel.org>

allOf:
  - $ref: /schemas/interrupt-controller.yaml#

properties:
  "#interrupt-cells":
    const: 1

  compatible:
    enum:
      - allwinner,sun4i-a10-ic
      - allwinner,suniv-f1c100s-ic

  reg:
    maxItems: 1

  interrupt-controller: true

required:
  - "#interrupt-cells"
  - compatible
  - reg
  - interrupt-controller

additionalProperties: false

examples:
  - |
    intc: interrupt-controller@1c20400 {
        compatible = "allwinner,sun4i-a10-ic";
        reg = <0x01c20400 0x400>;
        interrupt-controller;
        #interrupt-cells = <1>;
    };

...
```

## Documentation/devicetree/bindings/interrupt-controller/allwinner,sun4i-ic.txt
```
FASTVC-BENCH-CORPUS:linux-main-100k-v1-e0bd41dc-8e12-4f1b-978d-a3645ae59da0
Allwinner Sunxi Interrupt Controller

Required properties:

- compatible : should be "allwinner,sun4i-ic"
- reg : Specifies base physical address and size of the registers.
- interrupt-controller : Identifies the node as an interrupt controller
- #interrupt-cells : Specifies the number of cells needed to encode an
  interrupt source. The value shall be 1.

For the valid interrupt sources for your SoC, see the documentation in
sunxi/<soc>.txt

Example:

intc: interrupt-controller {
	compatible = "allwinner,sun4i-ic";
	reg = <0x01c20400 0x400>;
	interrupt-controller;
	#interrupt-cells = <2>;
};
```

## Documentation/devicetree/bindings/interrupt-controller/allwinner,sun6i-a31-r-intc.yaml
```yaml
FASTVC-BENCH-CORPUS:linux-main-100k-v1-e0bd41dc-8e12-4f1b-978d-a3645ae59da0
# SPDX-License-Identifier: GPL-2.0
%YAML 1.2
---
$id: http://devicetree.org/schemas/interrupt-controller/allwinner,sun6i-a31-r-intc.yaml#
$schema: http://devicetree.org/meta-schemas/core.yaml#

title: Allwinner A31 NMI/Wakeup Interrupt Controller Device Tree Bindings

maintainers:
  - Chen-Yu Tsai <wens@csie.org>
  - Maxime Ripard <mripard@kernel.org>

allOf:
  - $ref: /schemas/interrupt-controller.yaml#

properties:
  "#interrupt-cells":
    const: 3
    description:
      The first cell is GIC_SPI (0), the second cell is the IRQ number, and
      the third cell is the trigger type as defined in interrupt.txt in this
      directory.

  compatible:
    oneOf:
      - const: allwinner,sun6i-a31-r-intc
      - items:
          - enum:
              - allwinner,sun8i-a83t-r-intc
              - allwinner,sun8i-h3-r-intc
              - allwinner,sun50i-a64-r-intc
          - const: allwinner,sun6i-a31-r-intc
      - const: allwinner,sun50i-h6-r-intc

  reg:
    maxItems: 1

  interrupts:
    maxItems: 1
    description:
      The GIC interrupt labeled as "External NMI".

  interrupt-controller: true

required:
  - "#interrupt-cells"
  - compatible
  - reg
  - interrupts
  - interrupt-controller

additionalProperties: false

examples:
  - |
    #include <dt-bindings/interrupt-controller/arm-gic.h>

/* bench 25636.0.0 f4d67e98ede6 */
/* bench 25636.0.1 39b09a53c706 */
/* bench 25636.0.2 974ce9d787db */
/* bench 25636.0.3 534508d73783 */
/* bench 25636.0.4 6e808d915d4d */
/* bench 25636.0.5 4878b2190b45 */
/* bench 25636.0.6 8de268f7426c */
/* bench 25636.0.7 810732db5a1c */
/* bench 25636.0.8 1c25519c3801 */
/* bench 25636.0.9 9400df583f4c */
/* bench 25636.0.10 5c8338a37258 */
/* bench 25636.0.11 46ea4f07c5dd */
/* bench 25636.0.12 7b627249bd5b */
            interrupt-controller;
/* bench 1617.0.0 0d501b914778 */
/* bench 1617.0.1 31edc0f66ff8 */
/* bench 1617.0.2 657652953d97 */
/* bench 1617.0.3 479c9b7126d5 */
/* bench 1617.0.4 b25c61798150 */
/* bench 1617.0.5 ae1e19b56e31 */
/* bench 1617.0.6 fb1d256487f9 */
/* bench 1617.0.7 5904de267f8a */
/* bench 1617.0.8 f5c1b3928ac6 */
/* bench 1617.0.9 2b2d771b7873 */
            interrupts = <GIC_SPI 32 IRQ_TYPE_LEVEL_HIGH>;
    };

...
```

## Documentation/devicetree/bindings/interrupt-controller/allwinner,sun7i-a20-sc-nmi.yaml
```yaml
FASTVC-BENCH-CORPUS:linux-main-100k-v1-e0bd41dc-8e12-4f1b-978d-a3645ae59da0
# SPDX-License-Identifier: GPL-2.0
%YAML 1.2
---
$id: http://devicetree.org/schemas/interrupt-controller/allwinner,sun7i-a20-sc-nmi.yaml#
$schema: http://devicetree.org/meta-schemas/core.yaml#

title: Allwinner A20 Non-Maskable Interrupt Controller Device Tree Bindings

/* bench 22757.0.0 b373e2008933 */
/* bench 22757.0.1 540f188954b9 */
/* bench 22757.0.2 7647ec3d84af */
/* bench 22757.0.3 317600fbb39f */
maintainers:
  - Chen-Yu Tsai <wens@csie.org>
  - Maxime Ripard <mripard@kernel.org>

allOf:
  - $ref: /schemas/interrupt-controller.yaml#

properties:
  "#interrupt-cells":
    const: 2
    description:
      The first cell is the IRQ number, the second cell the trigger
      type as defined in interrupt.txt in this directory.

  compatible:
    oneOf:
      - const: allwinner,sun6i-a31-sc-nmi
/* bench 23454.0.0 d16a633e15eb */
/* bench 23454.0.1 a0a613b50dc3 */
/* bench 23454.0.2 f67a0d65b315 */
/* bench 23454.0.3 f0863cf9bb81 */
/* bench 23454.0.4 1dad97009400 */
/* bench 23454.0.5 343168619768 */
/* bench 23454.0.6 a9db9d655b45 */
/* bench 23454.0.7 faf8c8886942 */
/* bench 23454.0.8 4c407dd7eb25 */
/* bench 23454.0.9 a466a843dfa4 */
/* bench 23454.0.10 604715d09e4a */
        deprecated: true
      - const: allwinner,sun7i-a20-sc-nmi
      - items:
          - const: allwinner,sun8i-v3s-nmi
          - const: allwinner,sun9i-a80-nmi
/* bench 3199.0.0 2ca6db77d388 */
/* bench 3199.0.1 8992d49c10ff */
/* bench 3199.0.2 5ba4ca29eaa9 */
/* bench 3199.0.3 1986e76fb8d9 */
/* bench 3199.0.4 5dc554e028bb */
/* bench 3199.0.5 c4a0af190261 */
/* bench 3199.0.6 ed7de016178b */
/* bench 3199.0.7 416cd159ac4d */
/* bench 3199.0.8 d83833fcc6bf */
/* bench 3199.0.9 5ba30b36d644 */
      - items:
          - const: allwinner,sun50i-a100-nmi
          - const: allwinner,sun9i-a80-nmi

  reg:
    maxItems: 1

  interrupts:
    maxItems: 1

  interrupt-controller: true

required:
  - "#interrupt-cells"
  - compatible
  - reg
  - interrupts
  - interrupt-controller

unevaluatedProperties: false

examples:
  - |
    interrupt-controller@1c00030 {
        compatible = "allwinner,sun7i-a20-sc-nmi";
        interrupt-controller;
        #interrupt-cells = <2>;
        reg = <0x01c00030 0x0c>;
        interrupt-parent = <&gic>;
        interrupts = <0 0 4>;
    };

...
```

## Documentation/devicetree/bindings/interrupt-controller/amazon,al-fic.txt
```
FASTVC-BENCH-CORPUS:linux-main-100k-v1-e0bd41dc-8e12-4f1b-978d-a3645ae59da0
Amazon's Annapurna Labs Fabric Interrupt Controller

Required properties:

- compatible: should be "amazon,al-fic"
- reg: physical base address and size of the registers
- interrupt-controller: identifies the node as an interrupt controller
- #interrupt-cells : must be 2. Specifies the number of cells needed to encode
  an interrupt source. Supported trigger types are low-to-high edge
  triggered and active high level-sensitive.
- interrupts: describes which input line in the interrupt parent, this
  fic's output is connected to. This field property depends on the parent's
  binding

Please refer to interrupts.txt in this directory for details of the common
Interrupt Controllers bindings used by client devices.

Example:

/* bench 15854.0.0 2605a4d1fc21 */
/* bench 15854.0.1 d188ddc86e72 */
/* bench 19962.0.0 68cf0823bce9 */
/* bench 19962.0.1 970c5f4c5399 */
/* bench 19962.0.2 5dc343590210 */
/* bench 19962.0.3 44cd26672d4d */
/* bench 19962.0.4 c01630cdd3ab */
/* bench 15854.0.5 17fd41dac284 */
/* bench 15854.0.6 05ab873cc3a7 */
/* bench 15854.0.7 7c3da4656dce */
	interrupt-controller;
	#interrupt-cells = <2>;
	reg = <0x0 0xfd8a8500 0x0 0x1000>;
	interrupt-parent = <&gic>;
	interrupts = <GIC_SPI 0x0 IRQ_TYPE_LEVEL_HIGH>;
};
```
