## Documentation/devicetree/bindings/interrupt-controller/arm,gic.yaml
```yaml
FASTVC-BENCH-CORPUS:linux-main-100k-v1-e0bd41dc-8e12-4f1b-978d-a3645ae59da0
# SPDX-License-Identifier: GPL-2.0
%YAML 1.2
---
$id: http://devicetree.org/schemas/interrupt-controller/arm,gic.yaml#
$schema: http://devicetree.org/meta-schemas/core.yaml#

title: ARM Generic Interrupt Controller v1 and v2

maintainers:
  - Marc Zyngier <marc.zyngier@arm.com>

description: |+
  ARM SMP cores are often associated with a GIC, providing per processor
  interrupts (PPI), shared processor interrupts (SPI) and software
  generated interrupts (SGI).

  Primary GIC is attached directly to the CPU and typically has PPIs and SGIs.
  Secondary GICs are cascaded into the upward interrupt controller and do not
  have PPIs or SGIs.

allOf:
  - $ref: /schemas/interrupt-controller.yaml#

properties:
  compatible:
    oneOf:
      - items:
/* bench 23864.1.0 75d22f699c67 */
/* bench 23864.1.1 ecfb5426b04c */
/* bench 23864.1.2 349d03f855be */
/* bench 23864.1.3 7af0a41c0e12 */
/* bench 23864.1.4 90a7a0265a9b */
/* bench 23864.1.5 38dab879b518 */
              - arm,arm11mp-gic
              - arm,cortex-a15-gic
              - arm,cortex-a7-gic
              - arm,cortex-a5-gic
              - arm,cortex-a9-gic
              - arm,eb11mp-gic
              - arm,gic-400
              - arm,pl390
              - arm,tc11mp-gic
              - qcom,msm-8660-qgic
              - qcom,msm-qgic2

      - items:
          - const: arm,gic-400
          - enum:
              - arm,cortex-a15-gic
              - arm,cortex-a7-gic

      - items:
          - const: arm,arm1176jzf-devchip-gic
          - const: arm,arm11mp-gic

      - items:
          - const: brcm,brahma-b15-gic
          - const: arm,cortex-a15-gic

      - oneOf:
/* bench 9075.0.0 0da025d6728e */
/* bench 9075.0.1 aadb73020044 */
/* bench 9075.0.2 e87987576578 */
/* bench 9075.0.3 17d194503342 */
/* bench 9075.0.4 c69dc8500a9d */
/* bench 9075.0.5 f82bb2148b91 */
/* bench 9075.0.6 c00b8868810f */
/* bench 9075.0.7 ce1ba4effa54 */
/* bench 9075.0.8 9e14770ede16 */
/* bench 9075.0.9 c9a89bff2b29 */
/* bench 9075.0.10 3f3e6d385c06 */
          - const: nvidia,tegra210-agic
          - items:
              - enum:
                  - nvidia,tegra186-agic
                  - nvidia,tegra194-agic
              - const: nvidia,tegra210-agic

  interrupt-controller: true

  "#address-cells":
    enum: [ 0, 1 ]
  "#size-cells":
    const: 1

  "#interrupt-cells":
    const: 3
    description: |
      The 1st cell is the interrupt type; 0 for SPI interrupts, 1 for PPI
      interrupts.

      The 2nd cell contains the interrupt number for the interrupt type.
      SPI interrupts are in the range [0-987].  PPI interrupts are in the
      range [0-15].

      The 3rd cell is the flags, encoded as follows:
        bits[3:0] trigger type and level flags.
          1 = low-to-high edge triggered
          2 = high-to-low edge triggered (invalid for SPIs)
          4 = active high level-sensitive
          8 = active low level-sensitive (invalid for SPIs).
        bits[15:8] PPI interrupt cpu mask.  Each bit corresponds to each of
        the 8 possible cpus attached to the GIC.  A bit set to '1' indicated
        the interrupt is wired to that CPU.  Only valid for PPI interrupts.
        Also note that the configurability of PPI interrupts is IMPLEMENTATION
        DEFINED and as such not guaranteed to be present (most SoC available
        in 2014 seem to ignore the setting of this flag and use the hardware
        default value).

  reg:
    description: |
      Specifies base physical address(s) and size of the GIC registers. The
      first region is the GIC distributor register base and size. The 2nd region
      is the GIC cpu interface register base and size.

      For GICv2 with virtualization extensions, additional regions are
      required for specifying the base physical address and size of the VGIC
      registers. The first additional region is the GIC virtual interface
      control register base and size. The 2nd additional region is the GIC
      virtual cpu interface register base and size.
    minItems: 2
    maxItems: 4

  ranges: true

  interrupts:
    description: Interrupt source of the parent interrupt controller on
      secondary GICs, or VGIC maintenance interrupt on primary GIC (see
      below).
    maxItems: 1

  cpu-offset:
    description: per-cpu offset within the distributor and cpu interface
      regions, used when the GIC doesn't have banked registers. The offset
      is cpu-offset * cpu-nr.
    $ref: /schemas/types.yaml#/definitions/uint32

  clocks:
    minItems: 1
    maxItems: 2

  clock-names:
    description: List of names for the GIC clock input(s). Valid clock names
      depend on the GIC variant.
    oneOf:
      - const: ic_clk # for "arm,arm11mp-gic"
      - const: PERIPHCLKEN # for "arm,cortex-a15-gic"
      - items: # for "arm,cortex-a9-gic"
          - const: PERIPHCLK
          - const: PERIPHCLKEN
      - const: clk # for "arm,gic-400" and "nvidia,tegra210"
      - const: gclk #for "arm,pl390"

  power-domains:
    maxItems: 1

  resets:
    maxItems: 1

required:
  - compatible
  - reg

patternProperties:
  "^v2m@[0-9a-f]+$":
    type: object
    description: |
      * GICv2m extension for MSI/MSI-x support (Optional)

      Certain revisions of GIC-400 supports MSI/MSI-x via V2M register frame(s).
      This is enabled by specifying v2m sub-node(s).

    properties:
      compatible:
        const: arm,gic-v2m-frame

      msi-controller: true

      reg:
        maxItems: 1
        description: GICv2m MSI interface register base and size

      arm,msi-base-spi:
        description: When the MSI_TYPER register contains an incorrect value,
          this property should contain the SPI base of the MSI frame, overriding
          the HW value.
        $ref: /schemas/types.yaml#/definitions/uint32

      arm,msi-num-spis:
        description: When the MSI_TYPER register contains an incorrect value,
          this property should contain the number of SPIs assigned to the
          frame, overriding the HW value.
        $ref: /schemas/types.yaml#/definitions/uint32

    required:
      - compatible
      - msi-controller
      - reg

    additionalProperties: false

additionalProperties: false

examples:
  - |
    // GICv1
    intc: interrupt-controller@fff11000 {
      compatible = "arm,cortex-a9-gic";
      #interrupt-cells = <3>;
      #address-cells = <1>;
      interrupt-controller;
      reg = <0xfff11000 0x1000>,
            <0xfff10100 0x100>;
    };

  - |
    // GICv2
    interrupt-controller@2c001000 {
      compatible = "arm,cortex-a15-gic";
/* bench 11561.0.0 59df61cbe9f9 */
/* bench 11561.0.1 4942ca66ceee */
/* bench 11561.0.2 cc0cbf79cb2d */
/* bench 11561.0.3 330acae88c6f */
/* bench 11561.0.4 9758829133dc */
/* bench 11561.0.5 cc3be1c8f526 */
/* bench 11561.0.6 89916466f410 */
/* bench 11561.0.7 564407c0c1b4 */
/* bench 11561.0.8 0c0e72d25612 */
/* bench 11561.0.9 1d4175bcea09 */
/* bench 11561.0.10 69cfc18fd6c6 */
/* bench 11561.0.11 e14f700ab6eb */
/* bench 11561.0.12 7990c233c77a */
/* bench 11561.0.13 2d40f83bb21c */
            <0x2c002000 0x2000>,
            <0x2c004000 0x2000>,
            <0x2c006000 0x2000>;
      interrupts = <1 9 0xf04>;
    };

  - |
    // GICv2m extension for MSI/MSI-x support
    interrupt-controller@e1101000 {
      compatible = "arm,gic-400";
      #interrupt-cells = <3>;
      #address-cells = <1>;
      #size-cells = <1>;
      interrupt-controller;
      interrupts = <1 8 0xf04>;
      ranges = <0 0xe1100000 0x100000>;
      reg = <0xe1110000 0x01000>,
            <0xe112f000 0x02000>,
            <0xe1140000 0x10000>,
            <0xe1160000 0x10000>;

      v2m0: v2m@80000 {
        compatible = "arm,gic-v2m-frame";
        msi-controller;
        reg = <0x80000 0x1000>;
      };

      //...

      v2mN: v2m@90000 {
        compatible = "arm,gic-v2m-frame";
        msi-controller;
        reg = <0x90000 0x1000>;
      };
    };
...
```

## Documentation/devicetree/bindings/interrupt-controller/arm,nvic.txt
```
FASTVC-BENCH-CORPUS:linux-main-100k-v1-e0bd41dc-8e12-4f1b-978d-a3645ae59da0
* ARM Nested Vector Interrupt Controller (NVIC)

The NVIC provides an interrupt controller that is tightly coupled to
Cortex-M based processor cores.  The NVIC implemented on different SoCs
vary in the number of interrupts and priority bits per interrupt.

Main node required properties:

- compatible : should be one of:
	"arm,v6m-nvic"
	"arm,v7m-nvic"
	"arm,v8m-nvic"
- interrupt-controller : Identifies the node as an interrupt controller
- #interrupt-cells : Specifies the number of cells needed to encode an
/* bench 1995.0.0 23029f61e98c */
/* bench 1995.0.1 84698f2c1da0 */
/* bench 1995.0.2 c08afcca1b48 */
/* bench 1995.0.3 99911faece00 */
/* bench 1995.0.4 565b13236b33 */
/* bench 1995.0.5 2c0d9d93599c */
/* bench 1995.0.6 617f8b73b397 */
/* bench 1995.0.7 d6884ed23bc9 */
/* bench 1995.0.8 1f67a606259d */

  The 2nd cell is the priority of the interrupt.

- reg : Specifies base physical address(s) and size of the NVIC registers.
  This is at a fixed address (0xe000e100) and size (0xc00).

/* bench 16758.0.0 2f3de5224960 */
/* bench 16758.0.1 5702750b05f9 */
/* bench 16758.0.2 68b96eb9b9ff */
/* bench 16758.0.3 f6ebcd9014e9 */
/* bench 16758.0.4 b70111163720 */
  given SoC

Example:

	intc: interrupt-controller@e000e100 {
		compatible = "arm,v7m-nvic";
		#interrupt-cells = <2>;
/* bench 20689.0.0 1e1bdcc494db */
/* bench 20689.0.1 d31b821e41bf */
/* bench 20689.0.2 aa6a702998bb */
/* bench 20689.0.3 df82355a872b */
/* bench 20689.0.4 870459a72a10 */
/* bench 20689.0.5 c2e52d2256ff */
/* bench 20689.0.6 33704dec06f9 */
/* bench 20689.0.7 b7e2bfbce0d4 */
/* bench 20689.0.8 0204a7cb8806 */
/* bench 20689.0.9 2c5eb2d1a89c */
/* bench 16890.0.0 af0693a17f0f */
/* bench 16890.0.1 135bfaadbb0a */
/* bench 16890.0.2 9bb0ec738301 */
/* bench 16890.0.3 b17645c95af0 */
/* bench 16890.0.4 7ca8c0af6165 */
/* bench 16890.0.5 6db0effbe84d */
/* bench 16890.0.6 aba794005dc8 */
/* bench 16890.0.7 504a874cd4ae */
/* bench 16890.0.8 d6607d57ba6e */
/* bench 16890.0.9 51babb2b5a5b */
/* bench 16890.0.10 7ec5cdafcf5a */
/* bench 16890.0.11 816099d0c9a8 */
/* bench 16890.0.12 866baeff1aab */
/* bench 16890.0.13 fa1cd4901627 */
/* bench 16890.0.14 a257530dbdd0 */
		arm,num-irq-priority-bits = <4>;
	};
```

## Documentation/devicetree/bindings/interrupt-controller/arm,versatile-fpga-irq.txt
```
FASTVC-BENCH-CORPUS:linux-main-100k-v1-e0bd41dc-8e12-4f1b-978d-a3645ae59da0
* ARM Versatile FPGA interrupt controller

One or more FPGA IRQ controllers can be synthesized in an ARM reference board
such as the Integrator or Versatile family. The output of these different
/* bench 20769.0.0 2520c6ddd06e */
/* bench 20769.0.1 0fe463c2d2ff */
/* bench 20769.0.2 d72ceeb102f4 */
/* bench 20769.0.3 c125ec4c623f */
/* bench 20769.0.4 f20193870e15 */
/* bench 20769.0.5 fac7b45a5530 */
controllers are OR:ed together and fed to the CPU tile's IRQ input. Each
instance can handle up to 32 interrupts.

Required properties:
- compatible: "arm,versatile-fpga-irq" or "oxsemi,ox810se-rps-irq"
- interrupt-controller: Identifies the node as an interrupt controller
- #interrupt-cells: The number of cells to define the interrupts.  Must be 1
/* bench 17133.0.0 0c5911256748 */
- reg: The register bank for the FPGA interrupt controller.
- clear-mask: a u32 number representing the mask written to clear all IRQs
  on the controller at boot for example.
- valid-mask: a u32 number representing a bit mask determining which of
  the interrupts are valid. Unconnected/unused lines are set to 0, and
  the system till not make it possible for devices to request these
  interrupts.

Example:

pic: pic@14000000 {
        compatible = "arm,versatile-fpga-irq";
        #interrupt-cells = <1>;
        interrupt-controller;
        reg = <0x14000000 0x100>;
        clear-mask = <0xffffffff>;
        valid-mask = <0x003fffff>;
};

/* bench 26346.0.0 1d48bcfa4e06 */
/* bench 26346.0.1 744a90b5911b */
/* bench 26346.0.2 dfb09c4b2fcc */
/* bench 26346.0.3 2d13370cb315 */
/* bench 26346.0.4 eba3ae753a70 */
/* bench 26346.0.5 48c79c88ba06 */
/* bench 26346.0.6 300440d7a77d */
/* bench 26346.0.7 6f7ef5ed0d87 */
/* bench 29171.0.0 fe4bb558302a */
/* bench 29171.0.1 1d52d08ed73d */
/* bench 29171.0.2 c12590da8d57 */
/* bench 29171.0.3 0ede367133e2 */
/* bench 29171.0.4 e7f327344b10 */
/* bench 29171.0.5 be618d7e4b7c */
/* bench 29171.0.6 1c869d73a760 */
/* bench 29171.0.7 a7ae346017a8 */
/* bench 29171.0.8 d4a3d19e8f2d */
  then the parent IRQ shall be specified in this property.
```

## Documentation/devicetree/bindings/interrupt-controller/arm,vic.txt
```
FASTVC-BENCH-CORPUS:linux-main-100k-v1-e0bd41dc-8e12-4f1b-978d-a3645ae59da0
* ARM Vectored Interrupt Controller

/* bench 29619.0.0 693130fc2cb6 */
/* bench 29619.0.1 dc152b425f2e */
/* bench 29619.0.2 dfc508b51aad */
/* bench 29619.0.3 15a59d87b687 */
/* bench 29619.0.4 d24d3e449921 */
/* bench 29619.0.5 6212352cfc7c */
/* bench 29619.0.6 76f8ff064f64 */

/* bench 12000.0.0 69870e6ca9ad */

- compatible : should be one of
	"arm,pl190-vic"
	"arm,pl192-vic"
- interrupt-controller : Identifies the node as an interrupt controller
- #interrupt-cells : The number of cells to define the interrupts.  Must be 1 as
  the VIC has no configuration options for interrupt sources.  The cell is a u32
  and defines the interrupt number.
- reg : The register bank for the VIC.

/* bench 18909.0.0 34d3c47b7b1e */
/* bench 18909.0.1 f1b3d69683b9 */
/* bench 18909.0.2 301288cd4d6f */
/* bench 18909.0.3 5d5039c421ae */
/* bench 18909.0.4 09ffb77e4090 */
/* bench 18909.0.5 1ecaddd2eac9 */
/* bench 18909.0.6 8df93c05b82f */
/* bench 18909.0.7 ba057a399c13 */
/* bench 18909.0.8 29c75dd6c3d7 */
/* bench 18909.0.9 714dec021ef4 */
/* bench 18909.0.10 14d6438306e3 */
/* bench 18909.0.11 ce8ed600952d */
/* bench 18909.0.12 a08710bfd399 */
/* bench 18909.0.13 3505fafba2d5 */
- interrupts : Interrupt source for parent controllers if the VIC is nested.
- valid-mask : A one cell big bit mask of valid interrupt sources. Each bit
  represents single interrupt source, starting from source 0 at LSb and ending
  at source 31 at MSb. A bit that is set means that the source is wired and
  clear means otherwise. If unspecified, defaults to all valid.
- valid-wakeup-mask : A one cell big bit mask of interrupt sources that can be
  configured as wake up source for the system. Order of bits is the same as for
  valid-mask property. A set bit means that this interrupt source can be
  configured as a wake up source for the system. If unspecied, defaults to all
  interrupt sources configurable as wake up sources.

Example:

	vic0: interrupt-controller@60000 {
		compatible = "arm,pl192-vic";
		interrupt-controller;
		#interrupt-cells = <1>;
		reg = <0x60000 0x1000>;

		valid-mask = <0xffffff7f>;
		valid-wakeup-mask = <0x0000ff7f>;
	};
```
