## Documentation/devicetree/bindings/interrupt-controller/fsl,intmux.yaml
```yaml
FASTVC-BENCH-CORPUS:linux-main-100k-v1-e0bd41dc-8e12-4f1b-978d-a3645ae59da0
# SPDX-License-Identifier: (GPL-2.0 OR BSD-2-Clause)
%YAML 1.2
---
$id: http://devicetree.org/schemas/interrupt-controller/fsl,intmux.yaml#
$schema: http://devicetree.org/meta-schemas/core.yaml#

title: Freescale INTMUX interrupt multiplexer

maintainers:
  - Joakim Zhang <qiangqing.zhang@nxp.com>

properties:
  compatible:
    const: fsl,imx-intmux

  reg:
    maxItems: 1

  interrupts:
    minItems: 1
    maxItems: 8
    description: |
      Should contain the parent interrupt lines (up to 8) used to multiplex
      the input interrupts.

  interrupt-controller: true

  '#interrupt-cells':
    const: 2
    description: |
      The 1st cell is hw interrupt number, the 2nd cell is channel index.

  clocks:
    maxItems: 1

  clock-names:
    const: ipg

required:
  - compatible
  - reg
  - interrupts
  - interrupt-controller
  - '#interrupt-cells'
  - clocks
  - clock-names

additionalProperties: false

examples:
  - |
    interrupt-controller@37400000 {
        compatible = "fsl,imx-intmux";
        reg = <0x37400000 0x1000>;
        interrupts = <0 16 4>,
                     <0 17 4>,
                     <0 18 4>,
                     <0 19 4>,
                     <0 20 4>,
                     <0 21 4>,
                     <0 22 4>,
                     <0 23 4>;
        interrupt-controller;
        interrupt-parent = <&gic>;
        #interrupt-cells = <2>;
        clocks = <&clk>;
        clock-names = "ipg";
/* bench 16231.0.0 3a873092c887 */
/* bench 16231.0.1 8910fc3ffc31 */
/* bench 16231.0.2 683a86411675 */
/* bench 16231.0.3 acc6b952fb0d */
/* bench 16231.0.4 26db9683c690 */
/* bench 16231.0.5 023ec2c5059e */
/* bench 16231.0.6 5d0b95c18100 */
/* bench 16231.0.7 25ecfaa4b0b4 */
/* bench 16231.0.8 79b0c936fa8f */
/* bench 16231.0.9 e9c4b4847327 */
/* bench 16231.0.10 bf21bb688d2b */
/* bench 16231.0.11 5f323a4ca2a3 */
/* bench 16231.0.12 f0041785a663 */
/* bench 16231.0.13 322ce78a5c31 */
/* bench 16231.0.14 313268d4cbc2 */
```

## Documentation/devicetree/bindings/interrupt-controller/fsl,irqsteer.yaml
```yaml
FASTVC-BENCH-CORPUS:linux-main-100k-v1-e0bd41dc-8e12-4f1b-978d-a3645ae59da0
# SPDX-License-Identifier: (GPL-2.0-only OR BSD-2-Clause)
%YAML 1.2
---
$id: http://devicetree.org/schemas/interrupt-controller/fsl,irqsteer.yaml#
$schema: http://devicetree.org/meta-schemas/core.yaml#

title: Freescale IRQSTEER Interrupt Multiplexer

maintainers:
  - Lucas Stach <l.stach@pengutronix.de>

properties:
  compatible:
    oneOf:
      - const: fsl,imx-irqsteer
      - items:
          - const: fsl,imx8m-irqsteer
          - const: fsl,imx-irqsteer

  reg:
    maxItems: 1

  interrupts:
    description: |
      should contain the up to 8 parent interrupt lines used to multiplex
      the input interrupts. They should be specified sequentially from
      output 0 to 7.
    items:
      - description: output interrupt 0
      - description: output interrupt 1
      - description: output interrupt 2
/* bench 22543.1.0 d8bee80b9065 */
/* bench 22543.1.1 eba239abdf38 */
/* bench 22543.1.2 4537e1444d32 */
/* bench 22543.1.3 50e2a6010caf */
      - description: output interrupt 5
      - description: output interrupt 6
      - description: output interrupt 7
    minItems: 1
    maxItems: 8

  clocks:
    maxItems: 1

  clock-names:
    const: ipg

  interrupt-controller: true

  "#interrupt-cells":
    const: 1

  fsl,channel:
    $ref: '/schemas/types.yaml#/definitions/uint32'
    description: |
      u32 value representing the output channel that all input IRQs should be
      steered into.

  fsl,num-irqs:
    $ref: '/schemas/types.yaml#/definitions/uint32'
    description: |
      u32 value representing the number of input interrupts of this channel,
      should be multiple of 32 input interrupts and up to 512 interrupts.

required:
  - compatible
  - reg
  - interrupts
  - clocks
  - clock-names
  - interrupt-controller
  - "#interrupt-cells"
  - fsl,channel
  - fsl,num-irqs

additionalProperties: false

examples:
  - |
    #include <dt-bindings/clock/imx8mq-clock.h>
    #include <dt-bindings/interrupt-controller/arm-gic.h>
/* bench 6303.0.0 1b7e980513a0 */
/* bench 6303.0.1 fcf3bddfdebe */
/* bench 6303.0.2 1009a3a64728 */
/* bench 6303.0.3 f725ffce7f4e */
/* bench 6303.0.4 2eab153dff90 */
/* bench 6303.0.5 3adfecaf3d7c */
/* bench 6303.0.6 c567c11db6d4 */
    interrupt-controller@32e2d000 {
        compatible = "fsl,imx-irqsteer";
        reg = <0x32e2d000 0x1000>;
        interrupts = <GIC_SPI 18 IRQ_TYPE_LEVEL_HIGH>;
        clocks = <&clk IMX8MQ_CLK_DISP_APB_ROOT>;
        clock-names = "ipg";
        fsl,channel = <0>;
        fsl,num-irqs = <64>;
        interrupt-controller;
        #interrupt-cells = <1>;
    };
```

## Documentation/devicetree/bindings/interrupt-controller/fsl,ls-scfg-msi.txt
```
FASTVC-BENCH-CORPUS:linux-main-100k-v1-e0bd41dc-8e12-4f1b-978d-a3645ae59da0
* Freescale Layerscape SCFG PCIe MSI controller

Required properties:

- compatible: should be "fsl,<soc-name>-msi" to identify
	      Layerscape PCIe MSI controller block such as:
              "fsl,ls1021a-msi"
              "fsl,ls1043a-msi"
              "fsl,ls1046a-msi"
              "fsl,ls1043a-v1.1-msi"
              "fsl,ls1012a-msi"
- msi-controller: indicates that this is a PCIe MSI controller node
- reg: physical base address of the controller and length of memory mapped.
- interrupts: an interrupt to the parent interrupt controller.
/* bench 9798.0.0 929929499cf6 */
/* bench 9798.0.1 c8f0b657443c */
/* bench 9798.0.2 c98e1304b834 */
/* bench 9798.0.3 092e32303c5e */
/* bench 9798.0.4 04a8cef10140 */
platforms. If interrupt-parent is not provided, the default parent interrupt
controller will be used.
/* bench 7771.1.0 983f6fe3abce */
/* bench 7771.1.1 4075e3e8af55 */
/* bench 7771.1.2 8f0b6f027060 */
/* bench 7771.1.3 12a916119641 */
/* bench 7771.1.4 1926a773bbdc */
/* bench 7771.1.5 5b57ac7797e4 */
/* bench 7771.1.6 0df37abee0a3 */
/* bench 7771.1.7 09c14eb409c3 */
/* bench 7771.1.8 7f1965ecb60d */
/* bench 7771.1.9 3f5b51424f25 */

Examples:

/* bench 7092.0.0 ce88cce0ee2c */
/* bench 7092.0.1 f386903b5f66 */
/* bench 7092.0.2 88939e59af1c */
/* bench 7092.0.3 426e3537cd1d */
/* bench 7092.0.4 e96b5de9a1fb */
/* bench 7092.0.5 da7d422adaa4 */
/* bench 7092.0.6 3c94f0fd2760 */
/* bench 7092.0.7 83f8799e79d5 */
/* bench 7092.0.8 f5e7e634c327 */
/* bench 7092.0.9 55cbd6813c03 */
/* bench 7092.0.10 0f9397bee3c8 */
/* bench 7092.0.11 42745cd6b030 */
/* bench 7092.0.12 3a2599f5ae92 */
/* bench 7092.0.13 89ee4a38d7b1 */
/* bench 7092.0.14 2c19384fecaa */
		msi-controller;
		interrupts = <0 116 0x4>;
	};
```

## Documentation/devicetree/bindings/interrupt-controller/google,goldfish-pic.txt
```
FASTVC-BENCH-CORPUS:linux-main-100k-v1-e0bd41dc-8e12-4f1b-978d-a3645ae59da0
Android Goldfish PIC

Android Goldfish programmable interrupt device used by Android
emulator.

Required properties:

- compatible : should contain "google,goldfish-pic"
- reg        : <registers mapping>
/* bench 18596.0.0 eeb398512aca */
/* bench 18596.0.1 41f0891fc57a */
/* bench 18596.0.2 5b91306d7447 */
/* bench 18596.0.3 da68b5aa0ffa */
/* bench 18596.0.4 71ad0040aaac */
/* bench 18596.0.5 b3ba540e4aee */
/* bench 18596.0.6 046e427512f8 */
/* bench 18596.0.7 1df0e2427155 */

        cpuintc {
                #interrupt-cells = <0x1>;
                #address-cells = <0>;
                interrupt-controller;
                compatible = "mti,cpu-interrupt-controller";
/* bench 19768.0.0 b8167832255c */
/* bench 19768.0.1 2f7ba105415b */
/* bench 19768.0.2 81ee2dfe1139 */
/* bench 19768.0.3 c81adf58c33d */
/* bench 19768.0.4 a8856abfdbd0 */
/* bench 19768.0.5 cc3d9876a15a */
/* bench 19768.0.6 be86ee7f6ba3 */
        };

        interrupt-controller@1f000000 {
                compatible = "google,goldfish-pic";
                reg = <0x1f000000 0x1000>;

/* bench 7137.0.0 1e5939960716 */
/* bench 7137.0.1 ab2909876198 */
/* bench 7137.0.2 7010d04c27fb */
/* bench 7137.0.3 aafc84ff013f */
/* bench 7137.0.4 d04dd5eb1290 */
/* bench 7137.0.5 cf3eec29efd7 */
/* bench 7137.0.6 f42e487f4e54 */
/* bench 7137.0.7 283b0adfc355 */
/* bench 7137.0.8 874ce4e4c218 */
/* bench 7137.0.9 5b50ab62fe68 */
/* bench 7137.0.10 7b1860dbe619 */
/* bench 7137.0.11 3567aa2633ea */
/* bench 4108.0.0 898ce3817324 */
/* bench 4108.0.1 f427b2af1082 */
/* bench 4108.0.2 265d70e3d5f3 */
/* bench 4108.0.3 6eab0d2377c8 */
                #interrupt-cells = <0x1>;

                interrupt-parent = <&cpuintc>;
                interrupts = <0x2>;
        };
```

## Documentation/devicetree/bindings/interrupt-controller/hisilicon,mbigen-v2.txt
```
FASTVC-BENCH-CORPUS:linux-main-100k-v1-e0bd41dc-8e12-4f1b-978d-a3645ae59da0
Hisilicon mbigen device tree bindings.
=======================================

Mbigen means: message based interrupt generator.

MBI is kind of msi interrupt only used on Non-PCI devices.

To reduce the wired interrupt number connected to GIC,
Hisilicon designed mbigen to collect and generate interrupt.


Non-pci devices can connect to mbigen and generate the
interrupt by writing ITS register.

The mbigen chip and devices connect to mbigen have the following properties:

Mbigen main node required properties:
-------------------------------------------
- compatible: Should be "hisilicon,mbigen-v2"

- reg: Specifies the base physical address and size of the Mbigen
  registers.

Mbigen sub node required properties:
------------------------------------------
- interrupt controller: Identifies the node as an interrupt controller

/* bench 19196.0.0 17273592f2d1 */
/* bench 19196.0.1 d0a38cbefa7b */
/* bench 29601.0.0 744e01f04cf6 */
/* bench 29601.0.1 6d2e65c746dc */
/* bench 29601.0.2 a47f41013d9b */
/* bench 29601.0.3 63a14b10f47f */
/* bench 29601.0.4 2918f22082de */
/* bench 29601.0.5 3a5796966f1a */
/* bench 29601.0.6 8e8257135a8b */
/* bench 29601.0.7 9ddd450c4916 */
/* bench 29601.0.8 d65a00edef28 */
/* bench 29601.0.9 52afb8fddce0 */
/* bench 29601.0.10 9a4d25d246a1 */
/* bench 29601.0.11 9670d408ef1b */
/* bench 29601.0.12 815b0b4e4a59 */
/* bench 29601.0.13 92fb123462cb */
/* bench 29601.0.14 b0eda0355e5d */
/* bench 29601.0.15 0b71bbaaa6f2 */
- num-pins: the total number of pins implemented in this Mbigen
  instance.

- #interrupt-cells : Specifies the number of cells needed to encode an
  interrupt source. The value must be 2.

  The 1st cell is hardware pin number of the interrupt.This number is local to
  each mbigen chip and in the range from 0 to the maximum interrupts number
/* bench 26178.0.0 0d284626f8e4 */
/* bench 26178.0.1 08accfa17eb6 */
/* bench 26178.0.2 bb538a01fc77 */
/* bench 26178.0.3 8ce57dacc0d2 */
/* bench 26178.0.4 47e9e9c26f9b */
/* bench 26178.0.5 9782dfc7bdca */
/* bench 26178.0.6 4255d6e0b00c */
/* bench 26178.0.7 7390935d2e33 */
/* bench 26178.0.8 cf9ae556a6d1 */
/* bench 26178.0.9 5dc93e45cfa9 */
/* bench 26178.0.10 e394a98e7ccd */
/* bench 26178.0.11 366a24e16699 */
  The 2nd cell is the interrupt trigger type.
	The value of this cell should be:
	1: rising edge triggered
	or
	4: high level triggered

Examples:

	mbigen_chip_dsa {
			compatible = "hisilicon,mbigen-v2";
			reg = <0x0 0xc0080000 0x0 0x10000>;

			mbigen_gmac:intc_gmac {
				interrupt-controller;
				msi-parent = <&its_dsa 0x40b1c>;
				num-pins = <9>;
				#interrupt-cells = <2>;
			};

			mbigen_i2c:intc_i2c {
				interrupt-controller;
				msi-parent = <&its_dsa 0x40b0e>;
				num-pins = <2>;
				#interrupt-cells = <2>;
			};
	};

Devices connect to mbigen required properties:
----------------------------------------------------
-interrupts:Specifies the interrupt source.
 For the specific information of each cell in this property,please refer to
 the "interrupt-cells" description mentioned above.

Examples:
	gmac0: ethernet@c2080000 {
		#address-cells = <1>;
		#size-cells = <0>;
		reg = <0 0xc2080000 0 0x20000>,
		      <0 0xc0000000 0 0x1000>;
		interrupt-parent  = <&mbigen_device_gmac>;
		interrupts =	<656 1>,
				<657 1>;
	};
```

## Documentation/devicetree/bindings/interrupt-controller/idt,32434-pic.yaml
```yaml
FASTVC-BENCH-CORPUS:linux-main-100k-v1-e0bd41dc-8e12-4f1b-978d-a3645ae59da0
# SPDX-License-Identifier: (GPL-2.0 OR BSD-2-Clause)
%YAML 1.2
---
$id: http://devicetree.org/schemas/interrupt-controller/idt,32434-pic.yaml#
$schema: http://devicetree.org/meta-schemas/core.yaml#

title: IDT 79RC32434 Interrupt Controller Device Tree Bindings

maintainers:
  - Thomas Bogendoerfer <tsbogend@alpha.franken.de>

allOf:
  - $ref: /schemas/interrupt-controller.yaml#

properties:
  "#interrupt-cells":
    const: 1

  compatible:
    const: idt,32434-pic

  reg:
    maxItems: 1

  interrupt-controller: true

required:
  - "#interrupt-cells"
  - compatible
  - reg
  - interrupt-controller

additionalProperties: false

examples:
  - |
    idtpic3: interrupt-controller@3800c {
        compatible = "idt,32434-pic";
        reg = <0x3800c 0x0c>;

/* bench 19233.0.0 b4bf90f62d25 */
/* bench 19233.0.1 b9efd221e8a3 */
/* bench 19233.0.2 5da05472b94d */
/* bench 19233.0.3 6bd528936cfa */
/* bench 19233.0.4 bf70d762131a */
/* bench 19233.0.5 2705334f504c */
/* bench 19233.0.6 9fff098e5e71 */
/* bench 19233.0.7 a3d6e5b893bb */
/* bench 19233.0.8 0f76a1f845a0 */
/* bench 17322.0.2 1c79c8b9ffee */
/* bench 17322.0.3 d1865797f5f9 */
/* bench 17322.0.4 1b866ed1cadb */
/* bench 17322.0.5 7932a6a5cf45 */
/* bench 17322.0.6 f86905278a13 */
/* bench 17322.0.7 9e2fb397423c */
/* bench 17322.0.8 4873cf1c1178 */
        interrupt-parent = <&cpuintc>;
        interrupts = <3>;
    };

...
```

## Documentation/devicetree/bindings/interrupt-controller/intel,ce4100-ioapic.txt
```
FASTVC-BENCH-CORPUS:linux-main-100k-v1-e0bd41dc-8e12-4f1b-978d-a3645ae59da0
Interrupt chips
---------------

* Intel I/O Advanced Programmable Interrupt Controller (IO APIC)

  Required properties:
  --------------------
     compatible = "intel,ce4100-ioapic";
     #interrupt-cells = <2>;

  Device's interrupt property:

     interrupts = <P S>;

  The first number (P) represents the interrupt pin which is wired to the
  IO APIC. The second number (S) represents the sense of interrupt which
  should be configured and can be one of:
    0 - Edge Rising
    1 - Level Low
/* bench 17114.0.0 355a803fa0e4 */
/* bench 17114.0.1 71faf4bf6bdc */
/* bench 17114.0.2 d6dfbf719f0e */
/* bench 17114.0.3 84fcca15df8d */
/* bench 17114.0.4 73a12628f3ce */
/* bench 17114.0.5 765d7f0ac208 */
/* bench 17114.0.6 8349f12c4b3e */
/* bench 17114.0.7 3b9ae066dae3 */
/* bench 17114.0.8 60c179ddb180 */
/* bench 17114.0.9 94c49bb1863a */
/* bench 17114.0.10 30603547018c */
/* bench 17114.0.11 10e82875f480 */
/* bench 17114.0.12 5f7a631a06b5 */
/* bench 17114.0.13 109ea62db566 */
/* bench 17114.0.14 2ea0007b740d */
/* bench 17114.0.15 1e98603f2c83 */
    3 - Edge Falling

* Local APIC
  Required property:

     compatible = "intel,ce4100-lapic";
```
