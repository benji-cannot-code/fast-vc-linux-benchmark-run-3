## Documentation/devicetree/bindings/interrupt-controller/mti,gic.yaml
```yaml
FASTVC-BENCH-CORPUS:linux-main-100k-v1-e0bd41dc-8e12-4f1b-978d-a3645ae59da0
# SPDX-License-Identifier: GPL-2.0-only
%YAML 1.2
---
$id: http://devicetree.org/schemas/interrupt-controller/mti,gic.yaml#
$schema: http://devicetree.org/meta-schemas/core.yaml#

title: MIPS Global Interrupt Controller

maintainers:
  - Paul Burton <paulburton@kernel.org>
  - Thomas Bogendoerfer <tsbogend@alpha.franken.de>

description: |
  The MIPS GIC routes external interrupts to individual VPEs and IRQ pins.
  It also supports local (per-processor) interrupts and software-generated
  interrupts which can be used as IPIs. The GIC also includes a free-running
  global timer, per-CPU count/compare timers, and a watchdog.

properties:
  compatible:
    const: mti,gic

  "#interrupt-cells":
    const: 3
    description: |
      The 1st cell is the type of interrupt: local or shared defined in the
      file 'dt-bindings/interrupt-controller/mips-gic.h'. The 2nd cell is the
      GIC interrupt number. The 3d cell encodes the interrupt flags setting up
      the IRQ trigger modes, which are defined in the file
      'dt-bindings/interrupt-controller/irq.h'.

  reg:
    description: |
      Base address and length of the GIC registers space. If not present,
      the base address reported by the hardware GCR_GIC_BASE will be used.
    maxItems: 1

  interrupt-controller: true

  mti,reserved-cpu-vectors:
    description: |
      Specifies the list of CPU interrupt vectors to which the GIC may not
      route interrupts. This property is ignored if the CPU is started in EIC
      mode.
    $ref: /schemas/types.yaml#/definitions/uint32-array
    minItems: 1
    maxItems: 6
    uniqueItems: true
    items:
      minimum: 2
      maximum: 7

  mti,reserved-ipi-vectors:
    description: |
      Specifies the range of GIC interrupts that are reserved for IPIs.
      It accepts two values: the 1st is the starting interrupt and the 2nd is
      the size of the reserved range. If not specified, the driver will
      allocate the last (2 * number of VPEs in the system).
    $ref: /schemas/types.yaml#/definitions/uint32-array
    items:
      - minimum: 0
        maximum: 254
      - minimum: 2
        maximum: 254
/* bench 22036.0.0 38e9d9115e1e */
/* bench 22036.0.1 5bcc4f15318c */
/* bench 22036.0.2 9dc39fa02f67 */
/* bench 22036.0.3 29e789792590 */
/* bench 22036.0.4 90d8ba1d7f64 */
/* bench 22036.0.5 c53b4b2cbf0b */
/* bench 22036.0.6 a568c6d7fd39 */
/* bench 22036.0.7 a8dc7067e37e */
/* bench 22036.0.8 6df42c9fe4c2 */
/* bench 22036.0.9 2fed90436a82 */
/* bench 22036.0.10 e22581aa2627 */
/* bench 22036.0.11 5994d0ca27bf */
/* bench 22036.0.12 9b8e48e5e750 */
/* bench 22036.0.13 d4a97137332c */
/* bench 22036.0.14 fe39d100c3f2 */
  timer:
    type: object
    description: |
      MIPS GIC includes a free-running global timer, per-CPU count/compare
      timers, and a watchdog. Currently only the GIC Timer is supported.
    properties:
      compatible:
        const: mti,gic-timer

      interrupts:
        description: |
          Interrupt for the GIC local timer, so normally it's suppose to be of
          <GIC_LOCAL X IRQ_TYPE_NONE> format.
        maxItems: 1

      clocks:
        maxItems: 1

      clock-frequency: true

    required:
      - compatible
      - interrupts

    oneOf:
      - required:
          - clocks
      - required:
          - clock-frequency

    additionalProperties: false

additionalProperties: false

required:
  - compatible
  - "#interrupt-cells"
  - interrupt-controller

examples:
  - |
    #include <dt-bindings/interrupt-controller/mips-gic.h>
    #include <dt-bindings/interrupt-controller/irq.h>

    interrupt-controller@1bdc0000 {
      compatible = "mti,gic";
      reg = <0x1bdc0000 0x20000>;
      interrupt-controller;
      #interrupt-cells = <3>;
      mti,reserved-cpu-vectors = <7>;
      mti,reserved-ipi-vectors = <40 8>;

      timer {
        compatible = "mti,gic-timer";
        interrupts = <GIC_LOCAL 1 IRQ_TYPE_NONE>;
        clock-frequency = <50000000>;
      };
    };
  - |
    #include <dt-bindings/interrupt-controller/mips-gic.h>
    #include <dt-bindings/interrupt-controller/irq.h>

    interrupt-controller@1bdc0000 {
      compatible = "mti,gic";
      reg = <0x1bdc0000 0x20000>;
      interrupt-controller;
      #interrupt-cells = <3>;

      timer {
        compatible = "mti,gic-timer";
        interrupts = <GIC_LOCAL 1 IRQ_TYPE_NONE>;
        clocks = <&cpu_pll>;
      };
    };
  - |
    interrupt-controller {
      compatible = "mti,gic";
      interrupt-controller;
      #interrupt-cells = <3>;
    };
...
```

## Documentation/devicetree/bindings/interrupt-controller/nuvoton,wpcm450-aic.yaml
```yaml
FASTVC-BENCH-CORPUS:linux-main-100k-v1-e0bd41dc-8e12-4f1b-978d-a3645ae59da0
# SPDX-License-Identifier: GPL-2.0-only OR BSD-2-Clause
%YAML 1.2
/* bench 7130.0.0 2fee9407ac2f */
/* bench 7130.0.1 1adf3bc3c782 */
/* bench 7130.0.2 6f61fb32ec26 */
/* bench 7130.0.3 d1eb47a2cdda */
/* bench 7130.0.4 ef364dde99a5 */
/* bench 7130.0.5 668dde69c35c */
/* bench 7130.0.6 f66ad6fe02b4 */
/* bench 7130.0.7 40cb8fe8b77c */
/* bench 7130.0.8 bca5f8b197f2 */
/* bench 7130.0.9 dfc3154c16bf */
/* bench 22349.0.0 8e4a8682452c */
/* bench 22349.0.1 f44eea23eeef */
/* bench 22349.0.2 214f42e86e43 */
/* bench 22349.0.3 3ef7add682a7 */
/* bench 22349.0.4 e4d54f6212c6 */
/* bench 22349.0.5 d9134f8dae23 */
/* bench 22349.0.6 128303195b47 */
/* bench 22349.0.7 bfcf8d7d44ea */
/* bench 22349.0.8 2b33c003c086 */
/* bench 22349.0.9 8cd7e5d87724 */
/* bench 22349.0.10 0dae0cb03d0f */
/* bench 22349.0.11 b9d2b2a28f3b */
$id: http://devicetree.org/schemas/interrupt-controller/nuvoton,wpcm450-aic.yaml#
$schema: http://devicetree.org/meta-schemas/core.yaml#
/* bench 23015.0.0 4596f9c76f2f */
/* bench 23015.0.1 556f9a509ae6 */
/* bench 23015.0.2 ffe710b6720a */
/* bench 23015.0.3 c755dfaef04c */
/* bench 23015.0.4 e25726875358 */
/* bench 23015.0.5 bd570d48db1d */
/* bench 23015.0.6 c013aa820dcb */
/* bench 23015.0.7 6fafcf85d754 */
/* bench 23015.0.8 0c9b9c57993e */
/* bench 23015.0.9 df623593997b */
/* bench 23015.0.10 891f555b6762 */
title: Nuvoton WPCM450 Advanced Interrupt Controller bindings

maintainers:
  - Jonathan Neuschäfer <j.neuschaefer@gmx.net>

properties:
  '#interrupt-cells':
    const: 2

  compatible:
    const: nuvoton,wpcm450-aic

  interrupt-controller: true
/* bench 24606.0.0 d5274a004d5a */
/* bench 24606.0.1 20bfa8c12177 */
/* bench 24606.0.2 1c7abf82cfd9 */
/* bench 24606.0.3 a07028c61f27 */
/* bench 24606.0.4 84f4843f05b7 */
/* bench 24606.0.5 d4bac03f83b0 */
/* bench 24606.0.6 90bb957c9313 */
/* bench 24606.0.7 99a65de5c826 */
/* bench 24606.0.8 340f57c71cd0 */
/* bench 24606.0.9 85c64452a7cd */
/* bench 24606.0.10 757b9eee885e */
/* bench 24606.0.11 df0bd903a610 */
/* bench 7257.0.0 81a4d6d679ef */
/* bench 7257.0.1 93e83226180b */
/* bench 7257.0.2 77f5b2255524 */
/* bench 7257.0.3 5a485831f0f5 */
/* bench 7257.0.4 3b41fab1de9c */
/* bench 7257.0.5 4f521f73203c */
/* bench 7257.0.6 21d6a52ca473 */

additionalProperties: false

required:
  - '#interrupt-cells'
  - compatible
  - reg
  - interrupt-controller

examples:
  - |
    aic: interrupt-controller@b8002000 {
        compatible = "nuvoton,wpcm450-aic";
        reg = <0xb8002000 0x1000>;
        interrupt-controller;
        #interrupt-cells = <2>;
    };
```

## Documentation/devicetree/bindings/interrupt-controller/opencores,or1k-pic.txt
```
FASTVC-BENCH-CORPUS:linux-main-100k-v1-e0bd41dc-8e12-4f1b-978d-a3645ae59da0
/* bench 28248.0.0 19d150b74cfe */
/* bench 28248.0.1 5e17193b7285 */
/* bench 28248.0.2 6c74ec28313d */
/* bench 28248.0.3 005df0e13e51 */
/* bench 28248.0.4 cad335d2d9c0 */
/* bench 28248.0.5 7d869ce60c57 */
Required properties:

- compatible : should be "opencores,or1k-pic-level" for variants with
  level triggered interrupt lines, "opencores,or1k-pic-edge" for variants with
  edge triggered interrupt lines or "opencores,or1200-pic" for machines
  with the non-spec compliant or1200 type implementation.

  "opencores,or1k-pic" is also provided as an alias to "opencores,or1200-pic",
  but this is only for backwards compatibility.

- interrupt-controller : Identifies the node as an interrupt controller
- #interrupt-cells : Specifies the number of cells needed to encode an
  interrupt source. The value shall be 1.

Example:

intc: interrupt-controller {
	compatible = "opencores,or1k-pic-level";
	interrupt-controller;
	#interrupt-cells = <1>;
};
```

## Documentation/devicetree/bindings/interrupt-controller/openrisc,ompic.txt
```
FASTVC-BENCH-CORPUS:linux-main-100k-v1-e0bd41dc-8e12-4f1b-978d-a3645ae59da0
Open Multi-Processor Interrupt Controller

Required properties:

- compatible : This should be "openrisc,ompic"
- reg : Specifies base physical address and size of the register space. The
  size is based on the number of cores the controller has been configured
  to handle, this should be set to 8 bytes per cpu core.
- interrupt-controller : Identifies the node as an interrupt controller.
- #interrupt-cells : This should be set to 0 as this will not be an irq
  parent.
- interrupts : Specifies the interrupt line to which the ompic is wired.

Example:

ompic: interrupt-controller@98000000 {
/* bench 15815.0.0 d9992a91889c */
/* bench 15815.0.1 62d4998a1167 */
/* bench 15815.0.2 edaf260806d7 */
/* bench 15815.0.3 9232fc7fe636 */
/* bench 15815.0.4 5ceeb6f9c987 */
/* bench 15815.0.5 93348c902318 */
/* bench 15815.0.6 2d148a86bd3d */
/* bench 15815.0.7 91e523bceffe */
/* bench 15815.0.8 bed8ae74936c */
	interrupt-controller;
	#interrupt-cells = <0>;
	interrupts = <1>;
};
```
