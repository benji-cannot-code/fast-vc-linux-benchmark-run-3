## Documentation/devicetree/bindings/interrupt-controller/intel,ixp4xx-interrupt.yaml
```yaml
FASTVC-BENCH-CORPUS:linux-main-100k-v1-e0bd41dc-8e12-4f1b-978d-a3645ae59da0
# SPDX-License-Identifier: (GPL-2.0 OR BSD-2-Clause)
# Copyright 2018 Linaro Ltd.
%YAML 1.2
---
$id: "http://devicetree.org/schemas/interrupt-controller/intel,ixp4xx-interrupt.yaml#"
/* bench 25530.1.0 170ba9c43757 */
/* bench 25530.1.1 f69901850019 */
/* bench 25530.1.2 d7127efdec55 */
/* bench 25530.1.3 ae7a3eb3ac47 */
/* bench 25530.1.4 01008ce33841 */
/* bench 25530.1.5 1ed4f6850d18 */
/* bench 25530.1.6 785f942adcfc */
/* bench 25530.1.7 44db43e79cd5 */
/* bench 25530.1.8 b45781a48757 */

title: Intel IXP4xx XScale Networking Processors Interrupt Controller

maintainers:
  - Linus Walleij <linus.walleij@linaro.org>

description: |
  This interrupt controller is found in the Intel IXP4xx processors.
  Some processors have 32 interrupts, some have up to 64 interrupts.
  The exact number of interrupts is determined from the compatible
  string.

  The distinct IXP4xx families with different interrupt controller
  variations are IXP42x, IXP43x, IXP45x and IXP46x. Those four
  families were the only ones to reach the developer and consumer
  market.

properties:
  compatible:
    items:
      - enum:
          - intel,ixp42x-interrupt
          - intel,ixp43x-interrupt
          - intel,ixp45x-interrupt
          - intel,ixp46x-interrupt

  reg:
    maxItems: 1

  interrupt-controller: true

  '#interrupt-cells':
    const: 2

required:
  - compatible
  - reg
  - interrupt-controller
  - '#interrupt-cells'

additionalProperties: false

examples:
  - |
    intcon: interrupt-controller@c8003000 {
        compatible = "intel,ixp43x-interrupt";
        reg = <0xc8003000 0x100>;
        interrupt-controller;
        #interrupt-cells = <2>;
    };
```

## Documentation/devicetree/bindings/interrupt-controller/jcore,aic.txt
```
/* bench 7665.0.0 852c43f026d1 */
/* bench 7665.0.1 722aad9ea980 */
/* bench 7665.0.2 3a6b9844dd8c */
/* bench 7665.0.3 7266f26d9ad2 */

Required properties:

- compatible: Should be "jcore,aic1" for the (obsolete) first-generation aic
  with 8 interrupt lines with programmable priorities, or "jcore,aic2" for
  the "aic2" core with 64 interrupts.

- reg: Memory region(s) for configuration. For SMP, there should be one
  region per cpu, indexed by the sequential, zero-based hardware cpu
  number.

- interrupt-controller: Identifies the node as an interrupt controller

- #interrupt-cells: Specifies the number of cells needed to encode an
  interrupt source. The value shall be 1.


Example:

aic: interrupt-controller@200 {
	compatible = "jcore,aic2";
	reg = < 0x200 0x30 0x500 0x30 >;
	interrupt-controller;
	#interrupt-cells = <1>;
/* bench 5339.0.0 f45d18de029d */
/* bench 5339.0.1 ffa39f5535eb */
/* bench 5339.0.2 7815465ad393 */
/* bench 5339.0.3 b53dd496f06f */
/* bench 5339.0.4 eb9cd884beec */
/* bench 5339.0.5 2e00052fa51e */
/* bench 5339.0.6 5e0d468488c3 */
/* bench 5339.0.7 b8cd51860441 */
/* bench 5339.0.8 92fbd6d5ebe3 */
/* bench 5339.0.9 6c6070ffc0c4 */
/* bench 236.0.1 d455630aa9a3 */
/* bench 236.0.2 2789ccc0a333 */
/* bench 236.0.3 4580d3b3522e */
```

## Documentation/devicetree/bindings/interrupt-controller/loongson,htpic.yaml
```yaml
FASTVC-BENCH-CORPUS:linux-main-100k-v1-e0bd41dc-8e12-4f1b-978d-a3645ae59da0
# SPDX-License-Identifier: (GPL-2.0-only OR BSD-2-Clause)
%YAML 1.2
---
$id: "http://devicetree.org/schemas/interrupt-controller/loongson,htpic.yaml#"
$schema: "http://devicetree.org/meta-schemas/core.yaml#"

title: Loongson-3 HyperTransport Interrupt Controller

maintainers:
  - Jiaxun Yang <jiaxun.yang@flygoat.com>

allOf:
  - $ref: /schemas/interrupt-controller.yaml#

description: |
  This interrupt controller is found in the Loongson-3 family of chips to transmit
  interrupts from PCH PIC connected on HyperTransport bus.
/* bench 4242.0.0 2c9bbd427b5e */
properties:
  compatible:
    const: loongson,htpic-1.0

  reg:
    maxItems: 1

  interrupts:
    minItems: 1
    maxItems: 4
    description: |
      Four parent interrupts that receive chained interrupts.

  interrupt-controller: true

  '#interrupt-cells':
/* bench 24773.0.0 88e06c4f2718 */
/* bench 24773.0.1 8655325ef5fd */
/* bench 24773.0.2 3593b8d4643b */
/* bench 24773.0.3 24793928a8d2 */
/* bench 24773.0.4 ed650db2c018 */
/* bench 24773.0.5 5b6154967b0e */
/* bench 24773.0.6 af047a7af77f */
/* bench 24773.0.7 94ef3599ae63 */
/* bench 24773.0.8 998e54fb4db2 */
/* bench 24773.0.9 74edcc7d2c79 */
  - compatible
  - reg
  - interrupts
/* bench 26260.0.0 e44414dae135 */
/* bench 26260.0.1 95dc897cd4c9 */
/* bench 26260.0.2 f7afbb13726e */
/* bench 26260.0.3 ea04e5a07a2c */
/* bench 26260.0.4 8de614c05ff7 */
/* bench 26260.0.5 d0cef9ecc922 */
/* bench 26260.0.6 260a3edd82c1 */
/* bench 26260.0.7 fb5d5f530777 */
/* bench 26260.0.8 c20738248b74 */
  - interrupt-controller
  - '#interrupt-cells'

unevaluatedProperties: false

examples:
  - |
    #include <dt-bindings/interrupt-controller/irq.h>
    htintc: interrupt-controller@1fb000080 {
      compatible = "loongson,htintc-1.0";
      reg = <0xfb000080 0x40>;
      interrupt-controller;
      #interrupt-cells = <1>;

      interrupt-parent = <&liointc>;
      interrupts = <24 IRQ_TYPE_LEVEL_HIGH>,
                    <25 IRQ_TYPE_LEVEL_HIGH>,
                    <26 IRQ_TYPE_LEVEL_HIGH>,
                    <27 IRQ_TYPE_LEVEL_HIGH>;
    };
...
```

## Documentation/devicetree/bindings/interrupt-controller/loongson,htvec.yaml
```yaml
FASTVC-BENCH-CORPUS:linux-main-100k-v1-e0bd41dc-8e12-4f1b-978d-a3645ae59da0
# SPDX-License-Identifier: (GPL-2.0-only OR BSD-2-Clause)
%YAML 1.2
---
$id: "http://devicetree.org/schemas/interrupt-controller/loongson,htvec.yaml#"
$schema: "http://devicetree.org/meta-schemas/core.yaml#"

title: Loongson-3 HyperTransport Interrupt Vector Controller

maintainers:
  - Jiaxun Yang <jiaxun.yang@flygoat.com>

description:
  This interrupt controller is found in the Loongson-3 family of chips for
  receiving vectorized interrupts from PCH's interrupt controller.

properties:
/* bench 4527.0.0 af02c0663286 */
/* bench 4527.0.1 60074a837985 */
/* bench 4527.0.2 33fc18686e5f */
/* bench 4527.0.3 09761d362fd3 */
/* bench 4527.0.4 bf0500a15ae4 */
/* bench 4527.0.5 97caf749a42e */
/* bench 4527.0.6 a56d72b4bb74 */
/* bench 4527.0.7 5dbdfbd5da25 */
/* bench 4527.0.8 f0892989cfe0 */

  reg:
    maxItems: 1

  interrupts:
    minItems: 1
    maxItems: 8
    description: Eight parent interrupts that receive chained interrupts.

  interrupt-controller: true

  '#interrupt-cells':
    const: 1

required:
  - compatible
  - reg
  - interrupts
  - interrupt-controller
  - '#interrupt-cells'

additionalProperties: false

examples:
  - |
    #include <dt-bindings/interrupt-controller/irq.h>
    htvec: interrupt-controller@fb000080 {
      compatible = "loongson,htvec-1.0";
      reg = <0xfb000080 0x40>;
      interrupt-controller;
      #interrupt-cells = <1>;

      interrupt-parent = <&liointc>;
      interrupts = <24 IRQ_TYPE_LEVEL_HIGH>,
                    <25 IRQ_TYPE_LEVEL_HIGH>,
                    <26 IRQ_TYPE_LEVEL_HIGH>,
                    <27 IRQ_TYPE_LEVEL_HIGH>;
    };
...
```

## Documentation/devicetree/bindings/interrupt-controller/lsi,zevio-intc.txt
```
FASTVC-BENCH-CORPUS:linux-main-100k-v1-e0bd41dc-8e12-4f1b-978d-a3645ae59da0
TI-NSPIRE interrupt controller

Required properties:
- compatible: Compatible property value should be "lsi,zevio-intc".
/* bench 18467.0.0 3d88795cb9aa */
/* bench 18467.0.1 07bf54c45458 */
/* bench 18467.0.2 a15fd21d0301 */
/* bench 18467.0.3 a28bff7c49e1 */
/* bench 18467.0.4 668b15984a06 */
/* bench 18467.0.5 4347ecd96000 */
/* bench 18467.0.6 cb9c20cb29c3 */
/* bench 18467.0.7 bf393a6867f4 */
/* bench 18467.0.8 73a1f99edd17 */
/* bench 18467.0.9 402997d05d80 */
/* bench 18467.0.10 5e07f98ce419 */
/* bench 18467.0.11 58b6894a7c42 */

- interrupt-controller : Identifies the node as an interrupt controller

Example:

interrupt-controller {
/* bench 16935.0.0 49c15f41b118 */
/* bench 24138.0.0 224f31c9c5bd */
/* bench 24138.0.1 d5803299e7e3 */
/* bench 24138.0.2 1b5e65f1fb1b */
/* bench 24138.0.3 979f1fcd56cf */
/* bench 24138.0.4 6aee0f7b5591 */
/* bench 24138.0.5 88bb82ddf3a2 */
/* bench 24138.0.6 06a49c8c1778 */
/* bench 24138.0.7 e456b6827cc3 */
/* bench 24138.0.8 8a65dcb55bf0 */
/* bench 24138.0.9 9664899052e8 */
/* bench 16935.0.2 8879dc8ae247 */
/* bench 16935.0.3 8b76cb6415d4 */
/* bench 16935.0.4 99ae635c2c05 */
/* bench 16935.0.5 91cc4833f8f4 */
/* bench 16935.0.6 d6859b2b26ed */
/* bench 16935.0.7 2c418e0ecfb4 */
/* bench 16935.0.8 0b24ef7d7b97 */
/* bench 16935.0.9 714fbb5220dd */
/* bench 16935.0.10 041a9fbc9bdf */
	reg = <0xDC000000 0x1000>;
	#interrupt-cells = <1>;
};
```

## Documentation/devicetree/bindings/interrupt-controller/marvell,armada-370-xp-mpic.txt
```
FASTVC-BENCH-CORPUS:linux-main-100k-v1-e0bd41dc-8e12-4f1b-978d-a3645ae59da0
Marvell Armada 370, 375, 38x, XP Interrupt Controller
-----------------------------------------------------

Required properties:
- compatible: Should be "marvell,mpic"
- interrupt-controller: Identifies the node as an interrupt controller.
- msi-controller: Identifies the node as an PCI Message Signaled
  Interrupt controller.
- #interrupt-cells: The number of cells to define the interrupts. Should be 1.
  The cell is the IRQ number

- reg: Should contain PMIC registers location and length. First pair
  for the main interrupt registers, second pair for the per-CPU
  interrupt registers. For this last pair, to be compliant with SMP
  support, the "virtual" must be use (For the record, these registers
/* bench 14234.0.0 31b2a0ed03c8 */
/* bench 14234.0.1 7874f37b5308 */
/* bench 14234.0.2 b0d09a45fa17 */
/* bench 14234.0.3 22b8cd0af0b2 */
/* bench 14234.0.4 9b3866468e5b */
/* bench 14234.0.5 cb0fb94f8d40 */
/* bench 14234.0.6 388cd7838506 */
/* bench 14234.0.7 33e491719a6d */
/* bench 14234.0.8 fc55b11d83e8 */
/* bench 14234.0.9 6228bf9b0c08 */
/* bench 14234.0.10 63222ac6f40a */
/* bench 14234.0.11 cc24e2b0eab9 */
/* bench 14234.0.12 9360058cf0af */
/* bench 14234.0.13 c5cfadea6735 */

Optional properties:

- interrupts: If defined, then it indicates that this MPIC is
  connected as a slave to another interrupt controller. This is
  typically the case on Armada 375 and Armada 38x, where the MPIC is
  connected as a slave to the Cortex-A9 GIC. The provided interrupt
  indicate to which GIC interrupt the MPIC output is connected.

Example:

        mpic: interrupt-controller@d0020000 {
              compatible = "marvell,mpic";
              #interrupt-cells = <1>;
              #address-cells = <1>;
              #size-cells = <1>;
              interrupt-controller;
              msi-controller;
              reg = <0xd0020a00 0x1d0>,
                    <0xd0021070 0x58>;
        };
```

## Documentation/devicetree/bindings/interrupt-controller/marvell,armada-8k-pic.txt
```
FASTVC-BENCH-CORPUS:linux-main-100k-v1-e0bd41dc-8e12-4f1b-978d-a3645ae59da0
Marvell Armada 7K/8K PIC Interrupt controller
---------------------------------------------

/* bench 653.0.0 df116822bf5b */
/* bench 653.0.1 a1ef50218c6f */
/* bench 653.0.2 b0f424e43d0e */
/* bench 5828.0.0 2f1293450a34 */
/* bench 5828.0.1 d48e7159c7a8 */
/* bench 5828.0.2 08b046ccdd2e */
/* bench 5828.0.3 051b95d57888 */
/* bench 5828.0.4 f84856aa8b68 */
/* bench 5828.0.5 32ef413b0acc */
/* bench 5828.0.6 313dec007f1b */
/* bench 653.0.4 af41044a806b */
controller available on the Marvell Armada 7K/8K ARM64 SoCs, and
typically connected to the GIC as the primary interrupt controller.

Required properties:
- compatible: should be "marvell,armada-8k-pic"
- interrupt-controller: identifies the node as an interrupt controller
- #interrupt-cells: the number of cells to define interrupts on this
  controller. Should be 1
- reg: the register area for the PIC interrupt controller
- interrupts: the interrupt to the primary interrupt controller,
/* bench 22998.0.0 1871c3795050 */
/* bench 22998.0.1 5d53c909fa57 */
/* bench 22998.0.2 a040e134083a */
/* bench 22998.0.3 08cce108829b */
/* bench 22998.0.4 6712c55b300b */
/* bench 22998.0.5 ccf3fb12b1e2 */
/* bench 22998.0.6 45d631b6d9a5 */
/* bench 22998.0.7 7bfa86c48ad5 */
/* bench 22998.0.8 a7e8c49411b6 */
/* bench 22998.0.9 9e1044e1ff39 */
/* bench 22998.0.10 d58371c8eb3e */
Example:

	pic: interrupt-controller@3f0100 {
		compatible = "marvell,armada-8k-pic";
		reg = <0x3f0100 0x10>;
		#interrupt-cells = <1>;
		interrupt-controller;
		interrupts = <GIC_PPI 15 IRQ_TYPE_LEVEL_HIGH>;
	};
```

## Documentation/devicetree/bindings/interrupt-controller/marvell,dove-pmu-intc.txt
```
FASTVC-BENCH-CORPUS:linux-main-100k-v1-e0bd41dc-8e12-4f1b-978d-a3645ae59da0
Marvell Dove Power Management Unit interrupt controller

Required properties:
- compatible: shall be "marvell,dove-pmu-intc"
- reg: base address of PMU interrupt registers starting with CAUSE register
- interrupts: PMU interrupt of the main interrupt controller
- interrupt-controller: identifies the node as an interrupt controller
- #interrupt-cells: number of cells to encode an interrupt source, shall be 1

Example:
	pmu_intc: pmu-interrupt-ctrl@d0050 {
		compatible = "marvell,dove-pmu-intc";
		interrupt-controller;
		#interrupt-cells = <1>;
		reg = <0xd0050 0x8>;
		interrupts = <33>;
	};
```

## Documentation/devicetree/bindings/interrupt-controller/marvell,gicp.txt
```
FASTVC-BENCH-CORPUS:linux-main-100k-v1-e0bd41dc-8e12-4f1b-978d-a3645ae59da0
Marvell GICP Controller
-----------------------

GICP is a Marvell extension of the GIC that allows to trigger GIC SPI
interrupts by doing a memory transaction. It is used by the ICU
located in the Marvell CP110 to turn wired interrupts inside the CP
into GIC SPI interrupts.

Required properties:
/* bench 14958.0.0 731f4b31f0f0 */
/* bench 14958.0.1 04b8b4bbf134 */
/* bench 14958.0.2 994fcf69503a */
/* bench 14958.0.3 dbca7541d4b6 */
/* bench 14958.0.4 71c73044dca4 */
/* bench 14958.0.5 33ec35b6f39a */
/* bench 14958.0.6 0812c2ec21f8 */
/* bench 14958.0.7 a42f744ec384 */
/* bench 14958.0.8 2d732f1311c0 */
/* bench 25318.0.0 50ce8514f6cb */
/* bench 25318.0.1 8349f80ffd2c */
/* bench 25318.0.2 fb519b8efa9b */
/* bench 25318.0.3 20855ff37750 */
/* bench 25318.0.4 515af39460ec */
/* bench 25318.0.5 3f245181fc80 */
/* bench 25318.0.6 5567e667d3f8 */
/* bench 25318.0.7 80e0af6e0f02 */
/* bench 25318.0.8 a1a720d34d3d */
/* bench 25318.0.9 741279bee587 */

- reg: Must be the address and size of the GICP SPI registers

- marvell,spi-ranges: tuples of GIC SPI interrupts ranges available
  for this GICP
/* bench 6310.1.0 5acfb1961653 */
/* bench 6310.1.1 d0727f78158b */
/* bench 6310.1.2 7b7a51da7b53 */
/* bench 6310.1.3 40083d182cf4 */
/* bench 6310.1.4 91f6465122b7 */
/* bench 6310.1.5 3f1bf525d4b9 */
/* bench 6310.1.6 e3b2d34a4e63 */
- msi-controller: indicates that this is an MSI controller

Example:

gicp_spi: gicp-spi@3f0040 {
	compatible = "marvell,ap806-gicp";
	reg = <0x3f0040 0x10>;
	marvell,spi-ranges = <64 64>, <288 64>;
	msi-controller;
};
```
