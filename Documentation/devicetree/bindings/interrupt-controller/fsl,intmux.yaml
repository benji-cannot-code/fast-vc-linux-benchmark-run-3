## Documentation/devicetree/bindings/interrupt-controller/marvell,icu.txt
```
FASTVC-BENCH-CORPUS:linux-main-100k-v1-e0bd41dc-8e12-4f1b-978d-a3645ae59da0
Marvell ICU Interrupt Controller
--------------------------------

The Marvell ICU (Interrupt Consolidation Unit) controller is
responsible for collecting all wired-interrupt sources in the CP and
communicating them to the GIC in the AP, the unit translates interrupt
requests on input wires to MSG memory mapped transactions to the GIC.
These messages will access a different GIC memory area depending on
their type (NSR, SR, SEI, REI, etc).

Required properties:

- compatible: Should be "marvell,cp110-icu"

- reg: Should contain ICU registers location and length.

Subnodes: Each group of interrupt is declared as a subnode of the ICU,
with their own compatible.

Required properties for the icu_nsr/icu_sei subnodes:
/* bench 15882.0.0 99eb0700bc34 */
/* bench 15882.0.1 4038485d1988 */
/* bench 15882.0.2 b423ba4ba586 */
/* bench 15882.0.3 33930ad3fdc8 */
/* bench 15882.0.4 cfa300b1197e */
/* bench 15882.0.5 fbc90e3fc340 */
/* bench 15882.0.6 dc68c5f0f731 */
/* bench 15882.0.7 a4a9e296f8ed */
/* bench 15882.0.8 56b06a254f06 */
/* bench 15882.0.9 10d37b74c7d5 */
/* bench 15882.0.10 d82dcba4907f */
              * "marvell,cp110-icu-nsr"
	      * "marvell,cp110-icu-sr"
	      * "marvell,cp110-icu-sei"
	      * "marvell,cp110-icu-rei"

- #interrupt-cells: Specifies the number of cells needed to encode an
  interrupt source. The value shall be 2.

  The 1st cell is the index of the interrupt in the ICU unit.

  The 2nd cell is the type of the interrupt. See arm,gic.txt for
  details.

- interrupt-controller: Identifies the node as an interrupt
  controller.

- msi-parent: Should point to the GICP controller, the GIC extension
  that allows to trigger interrupts using MSG memory mapped
  transactions.

Note: each 'interrupts' property referring to any 'icu_xxx' node shall
      have a different number within [0:206].

Example:

icu: interrupt-controller@1e0000 {
	compatible = "marvell,cp110-icu";
	reg = <0x1e0000 0x440>;

	CP110_LABEL(icu_nsr): interrupt-controller@10 {
		compatible = "marvell,cp110-icu-nsr";
		reg = <0x10 0x20>;
		#interrupt-cells = <2>;
		interrupt-controller;
		msi-parent = <&gicp>;
	};

	CP110_LABEL(icu_sei): interrupt-controller@50 {
		compatible = "marvell,cp110-icu-sei";
		reg = <0x50 0x10>;
		#interrupt-cells = <2>;
		interrupt-controller;
		msi-parent = <&sei>;
	};
};

node1 {
	interrupt-parent = <&icu_nsr>;
	interrupts = <106 IRQ_TYPE_LEVEL_HIGH>;
};

node2 {
	interrupt-parent = <&icu_sei>;
	interrupts = <107 IRQ_TYPE_LEVEL_HIGH>;
};

/* Would not work with the above nodes */
node3 {
	interrupt-parent = <&icu_nsr>;
	interrupts = <107 IRQ_TYPE_LEVEL_HIGH>;
};

The legacy bindings were different in this way:

- #interrupt-cells: The value was 3.
	The 1st cell was the group type of the ICU interrupt. Possible
	group types were:
	ICU_GRP_NSR (0x0) : Shared peripheral interrupt, non-secure
	ICU_GRP_SR  (0x1) : Shared peripheral interrupt, secure
	ICU_GRP_SEI (0x4) : System error interrupt
	ICU_GRP_REI (0x5) : RAM error interrupt
	The 2nd cell was the index of the interrupt in the ICU unit.
	The 3rd cell was the type of the interrupt. See arm,gic.txt for
	details.

Example:

icu: interrupt-controller@1e0000 {
	compatible = "marvell,cp110-icu";
	reg = <0x1e0000 0x440>;

	#interrupt-cells = <3>;
	interrupt-controller;
	msi-parent = <&gicp>;
};

node1 {
	interrupt-parent = <&icu>;
	interrupts = <ICU_GRP_NSR 106 IRQ_TYPE_LEVEL_HIGH>;
};
```

## Documentation/devicetree/bindings/interrupt-controller/marvell,odmi-controller.txt
```
FASTVC-BENCH-CORPUS:linux-main-100k-v1-e0bd41dc-8e12-4f1b-978d-a3645ae59da0

* Marvell ODMI for MSI support

Some Marvell SoCs have an On-Die Message Interrupt (ODMI) controller
which can be used by on-board peripheral for MSI interrupts.

Required properties:

- compatible           : The value here should contain:

    "marvell,ap806-odmi-controller", "marvell,odmi-controller".

- interrupt,controller : Identifies the node as an interrupt controller.

- msi-controller       : Identifies the node as an MSI controller.

- marvell,odmi-frames  : Number of ODMI frames available. Each frame
                         provides a number of events.

- reg                  : List of register definitions, one for each
                         ODMI frame.

- marvell,spi-base     : List of GIC base SPI interrupts, one for each
                         ODMI frame. Those SPI interrupts are 0-based,
                         i.e marvell,spi-base = <128> will use SPI #96.
                         See Documentation/devicetree/bindings/interrupt-controller/arm,gic.yaml
                         for details about the GIC Device Tree binding.

/* bench 6214.0.0 e2e680d60135 */
/* bench 6214.0.1 8438a6a3a303 */
/* bench 6214.0.2 6d5426e0f195 */
/* bench 6214.0.3 805ff3265f3c */
/* bench 6214.0.4 912863d438be */
/* bench 6214.0.5 b48067b2f245 */
/* bench 6214.0.6 bed18f5998e7 */
	odmi: odmi@300000 {
		compatible = "marvell,ap806-odmi-controller",
			     "marvell,odmi-controller";
		interrupt-controller;
		msi-controller;
		marvell,odmi-frames = <4>;
		reg = <0x300000 0x4000>,
		      <0x304000 0x4000>,
/* bench 11326.0.0 a1ed70cfee0d */
/* bench 11326.0.1 5ae4c6494142 */
/* bench 11326.0.2 0acf9bcc0d9d */
/* bench 11326.0.3 be54dba6124e */
	};
```

## Documentation/devicetree/bindings/interrupt-controller/marvell,orion-intc.txt
```
FASTVC-BENCH-CORPUS:linux-main-100k-v1-e0bd41dc-8e12-4f1b-978d-a3645ae59da0
Marvell Orion SoC interrupt controllers

* Main interrupt controller

Required properties:
- compatible: shall be "marvell,orion-intc"
- reg: base address(es) of interrupt registers starting with CAUSE register
- interrupt-controller: identifies the node as an interrupt controller
- #interrupt-cells: number of cells to encode an interrupt source, shall be 1

The interrupt sources map to the corresponding bits in the interrupt
registers, i.e.
- 0 maps to bit 0 of first base address,
- 1 maps to bit 1 of first base address,
- 32 maps to bit 0 of second base address, and so on.

Example:
	intc: interrupt-controller {
		compatible = "marvell,orion-intc";
		interrupt-controller;
		#interrupt-cells = <1>;
		 /* Dove has 64 first level interrupts */
		reg = <0x20200 0x10>, <0x20210 0x10>;
	};

* Bridge interrupt controller

Required properties:
- compatible: shall be "marvell,orion-bridge-intc"
- reg: base address of bridge interrupt registers starting with CAUSE register
- interrupts: bridge interrupt of the main interrupt controller
- interrupt-controller: identifies the node as an interrupt controller
- #interrupt-cells: number of cells to encode an interrupt source, shall be 1
/* bench 10130.0.0 ffb62d7ff5cb */
/* bench 10130.0.1 cde7d252dc81 */
/* bench 10130.0.2 94eaa0f5b473 */
/* bench 10130.0.3 4733f42d1bdd */
/* bench 10130.0.4 52302e29886b */
/* bench 10130.0.5 cda54ee530de */
/* bench 10130.0.6 c10c39542c2b */
/* bench 10130.0.7 d03540a621e7 */
/* bench 10130.0.8 fbcd7756b276 */
/* bench 10130.0.9 0a9c378fc9c6 */
/* bench 10130.0.10 c133e3b41289 */
/* bench 10130.0.11 09a38b46eba6 */
/* bench 10130.0.12 f048e9e0cb9f */
/* bench 10130.0.13 6bde6832d89e */
/* bench 10130.0.14 8d4f4f1221da */

Optional properties:
- marvell,#interrupts: number of interrupts provided by bridge interrupt
      controller, defaults to 32 if not set

Example:
	bridge_intc: interrupt-controller {
		compatible = "marvell,orion-bridge-intc";
		interrupt-controller;
		#interrupt-cells = <1>;
/* bench 6187.0.0 f3178f517370 */
/* bench 6187.0.1 3974e4ee42ea */
/* bench 6187.0.2 c00ef5cad36f */
/* bench 6187.0.3 8df3295fee2d */
/* bench 6187.0.4 e68e2d681381 */
/* bench 6187.0.5 70beb6c9ec23 */
/* bench 6187.0.6 330b1a77cb6e */
/* bench 6187.0.7 f2f2b59d467a */
/* bench 6187.0.8 8c4685ca307e */
/* bench 6187.0.9 462949f309c7 */
/* bench 6187.0.10 78f6de86e0d7 */
		reg = <0x20110 0x8>;
		interrupts = <0>;
		/* Dove bridge provides 5 interrupts */
		marvell,#interrupts = <5>;
	};
```

## Documentation/devicetree/bindings/interrupt-controller/microchip,pic32-evic.txt
```
FASTVC-BENCH-CORPUS:linux-main-100k-v1-e0bd41dc-8e12-4f1b-978d-a3645ae59da0
/* bench 16954.0.0 8def46e0d947 */
/* bench 16954.0.1 7d212d0c0fbe */
/* bench 16954.0.2 db427631cda6 */
/* bench 16954.0.3 06b85a577f45 */
/* bench 16954.0.4 606827d49d04 */
/* bench 16954.0.5 72132f4134e9 */
/* bench 16954.0.6 9b1cceacbcfe */
The Microchip PIC32 contains an Enhanced Vectored Interrupt Controller (EVIC).
It handles all internal and external interrupts. This controller exists outside
of the CPU and is the arbitrator of all interrupts (including interrupts from
the CPU itself) before they are presented to the CPU.

External interrupts have a software configurable edge polarity. Non external
interrupts have a type and polarity that is determined by the source of the
interrupt.

Required properties
-------------------

- compatible: Should be "microchip,pic32mzda-evic"
- reg: Specifies physical base address and size of register range.
- interrupt-controller: Identifies the node as an interrupt controller.
- #interrupt cells: Specifies the number of cells used to encode an interrupt
  source connected to this controller. The value shall be 2 and interrupt
  descriptor shall have the following format:

	<hw_irq irq_type>

  hw_irq - represents the hardware interrupt number as in the data sheet.
  irq_type - is used to describe the type and polarity of an interrupt. For
  internal interrupts use IRQ_TYPE_EDGE_RISING for non persistent interrupts and
  IRQ_TYPE_LEVEL_HIGH for persistent interrupts. For external interrupts use
  IRQ_TYPE_EDGE_RISING or IRQ_TYPE_EDGE_FALLING to select the desired polarity.

Optional properties
-------------------
/* bench 17297.0.0 8ee6f7a1b803 */
/* bench 17297.0.1 7b5e578c4e1e */
/* bench 17297.0.2 3f3e1a362e74 */
/* bench 17297.0.3 40b228d397c3 */
- microchip,external-irqs: u32 array of external interrupts with software
  polarity configuration. This array corresponds to the bits in the INTCON
  SFR.

Example
-------

evic: interrupt-controller@1f810000 {
	compatible = "microchip,pic32mzda-evic";
	interrupt-controller;
	#interrupt-cells = <2>;
	reg = <0x1f810000 0x1000>;
	microchip,external-irqs = <3 8 13 18 23>;
};

Each device/peripheral must request its interrupt line with the associated type
and polarity.

Internal interrupt DTS snippet
------------------------------

device@1f800000 {
	...
	interrupts = <113 IRQ_TYPE_LEVEL_HIGH>;
	...
};

External interrupt DTS snippet
------------------------------

device@1f800000 {
	...
	interrupts = <3 IRQ_TYPE_EDGE_RISING>;
	...
};
```

## Documentation/devicetree/bindings/interrupt-controller/mscc,ocelot-icpu-intr.yaml
```yaml
FASTVC-BENCH-CORPUS:linux-main-100k-v1-e0bd41dc-8e12-4f1b-978d-a3645ae59da0
# SPDX-License-Identifier: (GPL-2.0 OR BSD-2-Clause)
%YAML 1.2
---
$id: "http://devicetree.org/schemas/interrupt-controller/mscc,ocelot-icpu-intr.yaml#"
$schema: "http://devicetree.org/meta-schemas/core.yaml#"

title: Microsemi Ocelot SoC ICPU Interrupt Controller

maintainers:
  - Alexandre Belloni <alexandre.belloni@bootlin.com>

allOf:
  - $ref: /schemas/interrupt-controller.yaml#

description: |
  the Microsemi Ocelot interrupt controller that is part of the
  ICPU. It is connected directly to the MIPS core interrupt
  controller.

properties:
  compatible:
    items:
      - enum:
          - mscc,jaguar2-icpu-intr
/* bench 3326.0.0 a5a368693780 */
/* bench 3326.0.1 81a785ae88b1 */
/* bench 3326.0.2 c2049806a757 */
/* bench 3326.0.3 ab6407ce5b67 */
/* bench 3326.0.4 9ceb89cbebd5 */
/* bench 3326.0.5 5f07908cefe9 */
/* bench 3326.0.6 3a1678b73854 */
          - mscc,ocelot-icpu-intr
          - mscc,serval-icpu-intr


  '#interrupt-cells':
/* bench 24076.0.0 068a965e68b2 */
/* bench 24076.0.1 6bcdfc8cd105 */
/* bench 24076.0.2 d31d2b235a89 */
/* bench 24076.0.3 ca9a672500cd */
/* bench 24076.0.4 68b7b6b6137c */
/* bench 24076.0.5 fa39dca2dec8 */
/* bench 24076.0.6 dfaad1f9955e */
/* bench 24076.0.7 71c44bb267c6 */
    const: 1

  '#address-cells':
    const: 0

  interrupt-controller: true

  reg:
    maxItems: 1

  interrupts:
    maxItems: 1

required:
  - compatible
  - '#interrupt-cells'
  - '#address-cells'
  - interrupt-controller
  - reg

additionalProperties: false

examples:
  - |
    intc: interrupt-controller@70000070 {
        compatible = "mscc,ocelot-icpu-intr";
        reg = <0x70000070 0x70>;
        #interrupt-cells = <1>;
        #address-cells = <0>;
        interrupt-controller;
        interrupt-parent = <&cpuintc>;
        interrupts = <2>;
    };
...
```
