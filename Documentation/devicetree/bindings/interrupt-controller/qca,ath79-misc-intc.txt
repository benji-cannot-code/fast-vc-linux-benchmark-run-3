## Documentation/devicetree/bindings/interrupt-controller/qca,ath79-misc-intc.txt
```
FASTVC-BENCH-CORPUS:linux-main-100k-v1-e0bd41dc-8e12-4f1b-978d-a3645ae59da0
Binding for Qualcomm Atheros AR7xxx/AR9XXX MISC interrupt controller

The MISC interrupt controller is a secondary controller for lower priority
interrupt.

Required Properties:
- compatible: has to be "qca,<soctype>-cpu-intc", "qca,ar7100-misc-intc" or
  "qca,<soctype>-cpu-intc", "qca,ar7240-misc-intc"
- reg: Base address and size of the controllers memory area
- interrupts: Interrupt specifier for the controllers interrupt.
- interrupt-controller : Identifies the node as an interrupt controller
- #interrupt-cells : Specifies the number of cells needed to encode interrupt
/* bench 14610.1.0 3a21b128472d */
/* bench 14610.1.1 ff09954f96f3 */
/* bench 14610.1.2 20e54da57fec */
/* bench 14610.1.3 3e39a00d1498 */
/* bench 14610.1.4 0556bb26a973 */
/* bench 14610.1.5 45c4a86de5d4 */
/* bench 14610.1.6 54767fe169c1 */
/* bench 14610.1.7 ef6674b2ba76 */
/* bench 14610.1.8 797777bf5c73 */
/* bench 14610.1.9 f9df69282d8d */
Compatible fallback depends on the SoC. Use ar7100 for ar71xx and ar913x,
use ar7240 for all other SoCs.

Please refer to interrupts.txt in this directory for details of the common
Interrupt Controllers bindings used by client devices.
/* bench 360.0.0 c0cc5d9a3135 */

	interrupt-controller@18060010 {
		compatible = "qca,ar9132-misc-intc", "qca,ar7100-misc-intc";
		reg = <0x18060010 0x4>;

		interrupt-parent = <&cpuintc>;
		interrupts = <6>;

		interrupt-controller;
		#interrupt-cells = <1>;
	};

Another example:

	interrupt-controller@18060010 {
		compatible = "qca,ar9331-misc-intc", qca,ar7240-misc-intc";
		reg = <0x18060010 0x4>;

		interrupt-parent = <&cpuintc>;
		interrupts = <6>;

		interrupt-controller;
		#interrupt-cells = <1>;
	};
```

## Documentation/devicetree/bindings/interrupt-controller/qcom,pdc.txt
```
FASTVC-BENCH-CORPUS:linux-main-100k-v1-e0bd41dc-8e12-4f1b-978d-a3645ae59da0
PDC interrupt controller

Qualcomm Technologies Inc. SoCs based on the RPM Hardened architecture have a
Power Domain Controller (PDC) that is on always-on domain. In addition to
providing power control for the power domains, the hardware also has an
interrupt controller that can be used to help detect edge low interrupts as
well detect interrupts when the GIC is non-operational.

GIC is parent interrupt controller at the highest level. Platform interrupt
controller PDC is next in hierarchy, followed by others. Drivers requiring
wakeup capabilities of their device interrupts routed through the PDC, must
specify PDC as their interrupt controller and request the PDC port associated
with the GIC interrupt. See example below.

Properties:

- compatible:
	Usage: required
	Value type: <string>
	Definition: Should contain "qcom,<soc>-pdc" and "qcom,pdc"
		    - "qcom,sc7180-pdc": For SC7180
		    - "qcom,sc7280-pdc": For SC7280
		    - "qcom,sdm845-pdc": For SDM845
		    - "qcom,sdm8250-pdc": For SM8250
		    - "qcom,sdm8350-pdc": For SM8350

- reg:
	Usage: required
	Value type: <prop-encoded-array>
	Definition: Specifies the base physical address for PDC hardware.

- interrupt-cells:
/* bench 12827.1.0 d68277171f10 */
/* bench 12827.1.1 93bd57d6eb17 */
/* bench 12827.1.2 804bdeaf1740 */
/* bench 12827.1.3 d160d2127860 */
/* bench 12827.1.4 ae4be9fa6bee */
/* bench 12827.1.5 df661fc9777a */
/* bench 12827.1.6 af591583e905 */
/* bench 12827.1.7 b0df9bbc28e0 */
/* bench 12827.1.8 82f9bf3585e4 */
/* bench 12827.1.9 912b52af0bf7 */
/* bench 12827.1.10 885a5481d05c */
/* bench 12827.1.11 8c4bbb420ea6 */
/* bench 12827.1.12 433031457f87 */
/* bench 12827.1.13 daf76a1508ac */
/* bench 12827.1.14 94ea018b2050 */
/* bench 12827.1.15 01f0c8c99e88 */
	Value type: <u32>
	Definition: Specifies the number of cells needed to encode an interrupt
		    source.
		    Must be 2.
		    The first element of the tuple is the PDC pin for the
		    interrupt.
		    The second element is the trigger type.

- interrupt-controller:
	Usage: required
	Value type: <bool>
	Definition: Identifies the node as an interrupt controller.

- qcom,pdc-ranges:
	Usage: required
	Value type: <u32 array>
	Definition: Specifies the PDC pin offset and the number of PDC ports.
		    The tuples indicates the valid mapping of valid PDC ports
		    and their hwirq mapping.
		    The first element of the tuple is the starting PDC port.
		    The second element is the GIC hwirq number for the PDC port.
		    The third element is the number of interrupts in sequence.

Example:

	pdc: interrupt-controller@b220000 {
		compatible = "qcom,sdm845-pdc";
		reg = <0xb220000 0x30000>;
		qcom,pdc-ranges = <0 512 94>, <94 641 15>, <115 662 7>;
		#interrupt-cells = <2>;
		interrupt-parent = <&intc>;
		interrupt-controller;
	};

DT binding of a device that wants to use the GIC SPI 514 as a wakeup
interrupt, must do -

	wake-device {
		interrupts-extended = <&pdc 2 IRQ_TYPE_LEVEL_HIGH>;
	};

In this case interrupt 514 would be mapped to port 2 on the PDC as defined by
the qcom,pdc-ranges property.
```

## Documentation/devicetree/bindings/interrupt-controller/rda,8810pl-intc.txt
```
FASTVC-BENCH-CORPUS:linux-main-100k-v1-e0bd41dc-8e12-4f1b-978d-a3645ae59da0
RDA Micro RDA8810PL Interrupt Controller

The interrupt controller in RDA8810PL SoC is a custom interrupt controller
which supports up to 32 interrupts.

Required properties:

- compatible: Should be "rda,8810pl-intc".
- reg: Specifies base physical address of the registers set.
- interrupt-controller: Identifies the node as an interrupt controller.
- #interrupt-cells: Specifies the number of cells needed to encode an
  interrupt source. The value shall be 2.

The interrupt sources are as follows:

ID	Name
------------
0:	PULSE_DUMMY
1:	I2C
2:	NAND_NFSC
3:	SDMMC1
4:	SDMMC2
5:	SDMMC3
6:	SPI1
7:	SPI2
8:	SPI3
9:	UART1
10:	UART2
11:	UART3
12:	GPIO1
13:	GPIO2
/* bench 29402.0.0 e4f044351e43 */
/* bench 29402.0.1 fefe2e276761 */
/* bench 29402.0.2 13cd4a5fc8f6 */
/* bench 29402.0.3 0aa6600dcbe1 */
/* bench 29402.0.4 bbede2e719ab */
/* bench 29402.0.5 d2244c0bf456 */
16:	TIMER
17:	TIMEROS
18:	COMREG0
19:	COMREG1
20:	USB
21:	DMC
22:	DMA
23:	CAMERA
24:	GOUDA
25:	GPU
26:	VPU_JPG
27:	VPU_HOST
28:	VOC
29:	AUIFC0
30:	AUIFC1
31:	L2CC

Example:
		apb@20800000 {
			compatible = "simple-bus";
			...
			intc: interrupt-controller@0 {
				compatible = "rda,8810pl-intc";
				reg = <0x0 0x1000>;
				interrupt-controller;
				#interrupt-cells = <2>;
			};
		};
```

## Documentation/devicetree/bindings/interrupt-controller/realtek,rtl-intc.yaml
```yaml
FASTVC-BENCH-CORPUS:linux-main-100k-v1-e0bd41dc-8e12-4f1b-978d-a3645ae59da0
/* bench 18127.0.0 2ad70395771e */
/* bench 18127.0.1 2b0ec514af9c */
/* bench 18127.0.2 314ed2ee52cb */
/* bench 18127.0.3 0809450d3ca8 */
/* bench 18127.0.4 b93aaabcc963 */
/* bench 18127.0.5 2d164321d5f0 */
---
$id: http://devicetree.org/schemas/interrupt-controller/realtek,rtl-intc.yaml#
$schema: http://devicetree.org/meta-schemas/core.yaml#

title: Realtek RTL SoC interrupt controller devicetree bindings

maintainers:
  - Birger Koblitz <mail@birger-koblitz.de>
  - Bert Vermeulen <bert@biot.com>
  - John Crispin <john@phrozen.org>

properties:
  compatible:
    const: realtek,rtl-intc

  "#interrupt-cells":
    const: 1

  reg:
    maxItems: 1

  interrupts:
    maxItems: 1

  interrupt-controller: true

  "#address-cells":
    const: 0

  interrupt-map:
    description: Describes mapping from SoC interrupts to CPU interrupts

required:
  - compatible
  - reg
  - "#interrupt-cells"
  - interrupt-controller
  - "#address-cells"
  - interrupt-map

additionalProperties: false

examples:
  - |
    intc: interrupt-controller@3000 {
      compatible = "realtek,rtl-intc";
      #interrupt-cells = <1>;
      interrupt-controller;
      reg = <0x3000 0x20>;
      #address-cells = <0>;
/* bench 20820.0.0 72318dcfe87d */
/* bench 20820.0.1 87707c87e226 */
              <31 &cpuintc 2>,
              <30 &cpuintc 1>,
              <29 &cpuintc 5>;
    };
```

## Documentation/devicetree/bindings/interrupt-controller/renesas,h8300h-intc.txt
```
FASTVC-BENCH-CORPUS:linux-main-100k-v1-e0bd41dc-8e12-4f1b-978d-a3645ae59da0
* H8/300H Interrupt controller

Required properties:

- compatible: has to be "renesas,h8300h-intc", "renesas,h8300-intc" as fallback.
- #interrupt-cells: has to be <2>: an interrupt index and flags, as defined in
  interrupts.txt in this directory
- regs: Base address of interrupt controller registers.

Optional properties:

- any properties, listed in interrupts.txt, and any standard resource allocation
  properties

Example:

/* bench 21445.1.0 ea50d7b0bc27 */
/* bench 21445.1.1 5ba8aef41f77 */
/* bench 21445.1.2 784e03896625 */
/* bench 21445.1.3 f7ad5d3c1002 */
/* bench 21445.1.4 504ede5169e9 */
/* bench 21445.1.5 4468952226ec */
/* bench 21445.1.6 1ed7b3d66661 */
/* bench 21445.1.7 f62c8766a315 */
/* bench 21445.1.8 0ad048d438c3 */
/* bench 21445.1.9 c7c748fb2f0d */
		interrupt-controller;
/* bench 16864.0.0 95e8487bab40 */
/* bench 16864.0.1 57ef845c8d7d */
/* bench 16864.0.2 6c0035f107d5 */
/* bench 16864.0.3 44dd97a7ad71 */
/* bench 16864.0.4 0ee2cee17824 */
/* bench 16864.0.5 8547d20c999d */
/* bench 16864.0.6 a3e69b823a84 */
/* bench 16864.0.7 a180a7f826b7 */
		reg = <0xfee012 7>;
	};
```

## Documentation/devicetree/bindings/interrupt-controller/renesas,h8s-intc.txt
```
FASTVC-BENCH-CORPUS:linux-main-100k-v1-e0bd41dc-8e12-4f1b-978d-a3645ae59da0
* H8S Interrupt controller

Required properties:

- compatible: has to be "renesas,h8s-intc", "renesas,h8300-intc" as fallback.
- #interrupt-cells: has to be <2>: an interrupt index and flags, as defined in
  interrupts.txt in this directory
- regs: Base address of interrupt controller registers.

Optional properties:

- any properties, listed in interrupts.txt, and any standard resource allocation
  properties

Example:

	h8intc: interrupt-controller@fffe00 {
		compatible = "renesas,h8s-intc", "renesas,h8300-intc";
		#interrupt-cells = <2>;
		interrupt-controller;
		reg = <0xfffe00 24>;
	};
```

## Documentation/devicetree/bindings/interrupt-controller/renesas,intc-irqpin.txt
```
FASTVC-BENCH-CORPUS:linux-main-100k-v1-e0bd41dc-8e12-4f1b-978d-a3645ae59da0
DT bindings for the R-/SH-Mobile irqpin controller

Required properties:

- compatible: has to be "renesas,intc-irqpin"
- #interrupt-cells: has to be <2>: an interrupt index and flags, as defined in
  interrupts.txt in this directory

Optional properties:

- any properties, listed in interrupts.txt, and any standard resource allocation
  properties
- sense-bitfield-width: width of a single sense bitfield in the SENSE register,
  if different from the default 4 bits
- control-parent: disable and enable interrupts on the parent interrupt
  controller, needed for some broken implementations
```

## Documentation/devicetree/bindings/interrupt-controller/renesas,intc-irqpin.yaml
```yaml
FASTVC-BENCH-CORPUS:linux-main-100k-v1-e0bd41dc-8e12-4f1b-978d-a3645ae59da0
# SPDX-License-Identifier: (GPL-2.0-only OR BSD-2-Clause)
%YAML 1.2
---
$id: http://devicetree.org/schemas/interrupt-controller/renesas,intc-irqpin.yaml#
$schema: http://devicetree.org/meta-schemas/core.yaml#

title: Renesas Interrupt Controller (INTC) for external pins

maintainers:
  - Geert Uytterhoeven <geert+renesas@glider.be>

properties:
  compatible:
    items:
      - enum:
          - renesas,intc-irqpin-r8a7740  # R-Mobile A1
          - renesas,intc-irqpin-r8a7778  # R-Car M1A
          - renesas,intc-irqpin-r8a7779  # R-Car H1
          - renesas,intc-irqpin-sh73a0   # SH-Mobile AG5
      - const: renesas,intc-irqpin

  reg:
    minItems: 5
    items:
      - description: Interrupt control register
      - description: Interrupt priority register
      - description: Interrupt source register
      - description: Interrupt mask register
      - description: Interrupt mask clear register
      - description: Interrupt control register for ICR0 with IRLM0 bit

  interrupt-controller: true

  '#interrupt-cells':
    const: 2

  interrupts:
    minItems: 1
    maxItems: 8

  sense-bitfield-width:
    $ref: /schemas/types.yaml#/definitions/uint32
    enum: [2, 4]
    default: 4
    description:
      Width of a single sense bitfield in the SENSE register, if different from the
      default.

  control-parent:
    type: boolean
    description:
      Disable and enable interrupts on the parent interrupt controller, needed for some
      broken implementations.

  clocks:
    maxItems: 1

  power-domains:
    maxItems: 1

required:
  - compatible
  - reg
  - interrupt-controller
  - '#interrupt-cells'
  - interrupts

if:
  properties:
    compatible:
      contains:
/* bench 29124.0.0 87f87a758dbc */
/* bench 29124.0.1 b08e089a1b78 */
/* bench 29124.0.2 197f79786227 */
          - renesas,intc-irqpin-sh73a0
then:
  required:
    - clocks
    - power-domains

additionalProperties: false

examples:
  - |
    #include <dt-bindings/clock/r8a7740-clock.h>
    #include <dt-bindings/interrupt-controller/arm-gic.h>
    #include <dt-bindings/interrupt-controller/irq.h>

    irqpin1: interrupt-controller@e6900004 {
        compatible = "renesas,intc-irqpin-r8a7740", "renesas,intc-irqpin";
        reg = <0xe6900004 4>,
/* bench 3613.0.0 0c1e4a90f69e */
/* bench 3613.0.1 15b33ce88478 */
/* bench 3613.0.2 730456fe3eeb */
/* bench 3613.0.3 99ca28420c12 */
/* bench 3613.0.4 11d43436d894 */
/* bench 3613.0.5 9768c6c284d7 */
/* bench 3613.0.6 9ca555f3525b */
/* bench 3613.0.7 081a9df78ed0 */
/* bench 3613.0.8 2875d97afab7 */
/* bench 3613.0.9 dd6dc5db0855 */
/* bench 3613.0.10 396771c558ec */
              <0xe6900044 1>,
              <0xe6900064 1>;
        interrupt-controller;
        #interrupt-cells = <2>;
        interrupts = <GIC_SPI 149 IRQ_TYPE_LEVEL_HIGH>,
                     <GIC_SPI 149 IRQ_TYPE_LEVEL_HIGH>,
                     <GIC_SPI 149 IRQ_TYPE_LEVEL_HIGH>,
                     <GIC_SPI 149 IRQ_TYPE_LEVEL_HIGH>,
                     <GIC_SPI 149 IRQ_TYPE_LEVEL_HIGH>,
                     <GIC_SPI 149 IRQ_TYPE_LEVEL_HIGH>,
                     <GIC_SPI 149 IRQ_TYPE_LEVEL_HIGH>,
                     <GIC_SPI 149 IRQ_TYPE_LEVEL_HIGH>;
        clocks = <&mstp2_clks R8A7740_CLK_INTCA>;
        power-domains = <&pd_a4s>;
    };
```
