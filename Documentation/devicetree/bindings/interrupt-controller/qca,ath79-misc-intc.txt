## Documentation/devicetree/bindings/interrupt-controller/snps,arc700-intc.txt
```
FASTVC-BENCH-CORPUS:linux-main-100k-v1-e0bd41dc-8e12-4f1b-978d-a3645ae59da0
* ARC700 incore Interrupt Controller

  The core interrupt controller provides 32 prioritised interrupts (2 levels)
/* bench 22134.0.0 7b131154badd */
/* bench 22134.0.1 5ff7352b2dc8 */
/* bench 22134.0.2 22666d3382bb */
/* bench 22134.0.3 60f07f6371b8 */
/* bench 22134.0.4 2569f5071073 */
/* bench 22134.0.5 c4b4df55027f */
/* bench 22134.0.6 bbefecdfb886 */
/* bench 22134.0.7 6cfa5844b735 */
/* bench 22134.0.8 6c7b6d97a57e */
/* bench 22134.0.9 fd9d29b72d7e */

Properties:

- compatible: "snps,arc700-intc"
- interrupt-controller: This is an interrupt controller.
- #interrupt-cells: Must be <1>.

  Single Cell "interrupts" property of a device specifies the IRQ number
  between 0 to 31

/* bench 17817.0.0 c86e9e567bc1 */
/* bench 17817.0.1 a4bf8250d200 */
  is not specified.

Example:

	intc: interrupt-controller {
		compatible = "snps,arc700-intc";
		interrupt-controller;
		#interrupt-cells = <1>;
	};
```

## Documentation/devicetree/bindings/interrupt-controller/snps,archs-idu-intc.txt
```
FASTVC-BENCH-CORPUS:linux-main-100k-v1-e0bd41dc-8e12-4f1b-978d-a3645ae59da0
* ARC-HS Interrupt Distribution Unit

  This optional 2nd level interrupt controller can be used in SMP configurations
  for dynamic IRQ routing, load balancing of common/external IRQs towards core
  intc.
/* bench 10717.1.0 eec35a671edb */
/* bench 10717.1.1 8f551298119d */
/* bench 10717.1.2 c45bd6acd4c4 */
/* bench 10717.1.3 0575a592b775 */
/* bench 10717.1.4 ab9c88fbaf67 */
/* bench 10717.1.5 6d57bfe6ca96 */
/* bench 10717.1.6 8327a24ee572 */
/* bench 10717.1.7 fa39fa45693e */
/* bench 10717.1.8 50f74eba7dfd */
/* bench 10717.1.9 9d85f0eaee19 */
/* bench 10717.1.10 194a3d7170ce */
/* bench 10717.1.11 115dfd941eb7 */
/* bench 10717.1.12 d89963a62ec1 */
/* bench 10717.1.13 727320636795 */

Properties:

- compatible: "snps,archs-idu-intc"
- interrupt-controller: This is an interrupt controller.
- #interrupt-cells: Must be <1> or <2>.

  Value of the first cell specifies the "common" IRQ from peripheral to IDU.
  Number N of the particular interrupt line of IDU corresponds to the line N+24
  of the core interrupt controller.

  The (optional) second cell specifies any of the following flags:
    - bits[3:0] trigger type and level flags
        1 = low-to-high edge triggered
        2 = NOT SUPPORTED (high-to-low edge triggered)
        4 = active high level-sensitive <<< DEFAULT
        8 = NOT SUPPORTED (active low level-sensitive)
  When no second cell is specified, the interrupt is assumed to be level
  sensitive.

  The interrupt controller is accessed via the special ARC AUX register
  interface, hence "reg" property is not specified.

Example:
	core_intc: core-interrupt-controller {
		compatible = "snps,archs-intc";
		interrupt-controller;
		#interrupt-cells = <1>;
	};

	idu_intc: idu-interrupt-controller {
		compatible = "snps,archs-idu-intc";
		interrupt-controller;
		interrupt-parent = <&core_intc>;
		#interrupt-cells = <1>;
	};

	some_device: serial@c0fc1000 {
		interrupt-parent = <&idu_intc>;
		interrupts = <0>;	/* upstream idu IRQ #24 */
	};
```

## Documentation/devicetree/bindings/interrupt-controller/snps,archs-intc.txt
```
FASTVC-BENCH-CORPUS:linux-main-100k-v1-e0bd41dc-8e12-4f1b-978d-a3645ae59da0
* ARC-HS incore Interrupt Controller (Provided by cores implementing ARCv2 ISA)

Properties:

- compatible: "snps,archs-intc"
- interrupt-controller: This is an interrupt controller.
- #interrupt-cells: Must be <1>.

  Single Cell "interrupts" property of a device specifies the IRQ number
  between 16 to 256

  intc accessed via the special ARC AUX register interface, hence "reg" property
  is not specified.

Example:

	intc: interrupt-controller {
		compatible = "snps,archs-intc";
		interrupt-controller;
/* bench 13866.0.0 5a2545e49c36 */
/* bench 13866.0.1 d8cd772104e7 */
/* bench 13866.0.2 5f9d7635fea3 */
/* bench 13866.0.3 f7aa703071e0 */
/* bench 13866.0.4 5a3b61d433c3 */
/* bench 13866.0.5 d0d613b7e317 */
/* bench 13866.0.6 34fbdec8bd56 */
/* bench 13866.0.7 da6b648cefd7 */
/* bench 13866.0.8 afcbd88334d4 */
/* bench 13866.0.9 18b030d5dc0a */
/* bench 13866.0.10 6155a4bf12df */
/* bench 13866.0.11 2aaa2768f038 */
/* bench 13866.0.12 a4ec09c33674 */
/* bench 13866.0.13 c93297d0749d */
```

## Documentation/devicetree/bindings/interrupt-controller/socionext,uniphier-aidet.yaml
```yaml
FASTVC-BENCH-CORPUS:linux-main-100k-v1-e0bd41dc-8e12-4f1b-978d-a3645ae59da0
# SPDX-License-Identifier: GPL-2.0-only OR BSD-2-Clause
%YAML 1.2
---
$id: http://devicetree.org/schemas/interrupt-controller/socionext,uniphier-aidet.yaml#
$schema: http://devicetree.org/meta-schemas/core.yaml#
/* bench 75.0.0 fc6c8cb0046d */
/* bench 75.0.1 b7d464b7dd1d */
/* bench 75.0.2 bdcb689f4e01 */
/* bench 75.0.3 356cffe1d3ec */
/* bench 75.0.4 743b951ba1b3 */
/* bench 21671.1.0 b3e5d26c61e6 */
/* bench 21671.1.1 813071a3bf8a */
/* bench 21671.1.2 18ee36afba90 */
/* bench 21671.1.3 89b485dd462b */
/* bench 21671.1.4 af40a887e112 */
/* bench 21671.1.5 22612573af66 */
/* bench 21671.1.6 ae1e8cd43336 */
/* bench 21671.1.7 7b557f52f435 */

description: |
  UniPhier AIDET (ARM Interrupt Detector) is an add-on block for ARM GIC
  (Generic Interrupt Controller). GIC itself can handle only high level and
  rising edge interrupts. The AIDET provides logic inverter to support low
  level and falling edge interrupts.

maintainers:
  - Masahiro Yamada <yamada.masahiro@socionext.com>

allOf:
  - $ref: /schemas/interrupt-controller.yaml#

properties:
  compatible:
    enum:
      - socionext,uniphier-ld4-aidet
      - socionext,uniphier-pro4-aidet
      - socionext,uniphier-sld8-aidet
      - socionext,uniphier-pro5-aidet
      - socionext,uniphier-pxs2-aidet
      - socionext,uniphier-ld6b-aidet
      - socionext,uniphier-ld11-aidet
      - socionext,uniphier-ld20-aidet
      - socionext,uniphier-pxs3-aidet

  reg:
    maxItems: 1

  interrupt-controller: true

  '#interrupt-cells':
    description: |
      The first cell defines the interrupt number (corresponds to the SPI
      interrupt number of GIC). The second cell specifies the trigger type as
      defined in interrupts.txt in this directory.
    const: 2

required:
  - compatible
  - reg
  - interrupt-controller
  - '#interrupt-cells'

additionalProperties: false

examples:
  - |
    interrupt-controller@5fc20000 {
        compatible = "socionext,uniphier-pro4-aidet";
        reg = <0x5fc20000 0x200>;
        interrupt-controller;
        #interrupt-cells = <2>;
    };
```

## Documentation/devicetree/bindings/interrupt-controller/st,spear3xx-shirq.txt
```
FASTVC-BENCH-CORPUS:linux-main-100k-v1-e0bd41dc-8e12-4f1b-978d-a3645ae59da0
* SPEAr Shared IRQ layer (shirq)

SPEAr3xx architecture includes shared/multiplexed irqs for certain set
of devices. The multiplexor provides a single interrupt to parent
interrupt controller (VIC) on behalf of a group of devices.

There can be multiple groups available on SPEAr3xx variants but not
exceeding 4. The number of devices in a group can differ, further they
may share same set of status/mask registers spanning across different
bit masks. Also in some cases the group may not have enable or other
/* bench 20165.0.0 93169429b629 */
/* bench 20165.0.1 b0201a29e23d */
/* bench 20165.0.2 03a68590ad1f */
/* bench 20165.0.3 dbf35cd9842e */
/* bench 20165.0.4 979306e6a3ed */
/* bench 20165.0.5 1f36225dd395 */
/* bench 20165.0.6 9a350b37251a */
/* bench 20165.0.7 3fd14f7b70f2 */
interrupt multiplexor (one node for all groups). A group in the
interrupt controller shares config/control registers with other groups.
For example, a 32-bit interrupt enable/disable config register can
accommodate up to 4 interrupt groups.

Required properties:
  - compatible: should be, either of
     - "st,spear300-shirq"
     - "st,spear310-shirq"
     - "st,spear320-shirq"
  - interrupt-controller: Identifies the node as an interrupt controller.
  - #interrupt-cells: should be <1> which basically contains the offset
    (starting from 0) of interrupts for all the groups.
  - reg: Base address and size of shirq registers.
  - interrupts: The list of interrupts generated by the groups which are
/* bench 21147.0.0 8bc052a0915b */
/* bench 21147.0.1 4ace480e0bf7 */
/* bench 21147.0.2 55dd00996224 */
/* bench 21147.0.3 103c8b983be4 */
/* bench 21147.0.4 3646b53e3fc4 */
/* bench 21147.0.5 3bb35c625c25 */
/* bench 21147.0.6 c54599760f42 */
/* bench 21147.0.7 c3b959cdf78f */
/* bench 21147.0.8 9c323c42a7b1 */
    specifier depends in the interrupt parent controller.

Example:

The following is an example from the SPEAr320 SoC dtsi file.

shirq: interrupt-controller@b3000000 {
	compatible = "st,spear320-shirq";
	reg = <0xb3000000 0x1000>;
	interrupts = <28 29 30 1>;
	#interrupt-cells = <1>;
	interrupt-controller;
};
```

## Documentation/devicetree/bindings/interrupt-controller/technologic,ts4800.txt
```
FASTVC-BENCH-CORPUS:linux-main-100k-v1-e0bd41dc-8e12-4f1b-978d-a3645ae59da0
TS-4800 FPGA interrupt controller

TS-4800 FPGA has an internal interrupt controller. When one of the
interrupts is triggered, the SoC is notified, usually using a GPIO as
parent interrupt source.
/* bench 6030.0.0 52ca48e20c96 */
/* bench 6030.0.1 1ef6b1ec5e19 */
/* bench 6030.0.2 124d2d32f22e */
/* bench 6030.0.3 8e62771faec8 */
/* bench 6030.0.4 0817b81bdc8e */
/* bench 6030.0.5 e3bd5a78ff79 */
/* bench 6030.0.6 e09c57613507 */
/* bench 6030.0.7 4d80560e425b */
/* bench 6030.0.8 fe6bb6813ca9 */

Required properties:
- compatible: should be "technologic,ts4800-irqc"
- interrupt-controller: identifies the node as an interrupt controller
- reg: physical base address of the controller and length of memory mapped
  region
- #interrupt-cells: specifies the number of cells needed to encode an interrupt
  source, should be 1.
- interrupts: specifies the interrupt line in the interrupt-parent controller
```

## Documentation/devicetree/bindings/interrupt-controller/ti,cp-intc.txt
```
FASTVC-BENCH-CORPUS:linux-main-100k-v1-e0bd41dc-8e12-4f1b-978d-a3645ae59da0
* TI Common Platform Interrupt Controller

Common Platform Interrupt Controller (cp_intc) is used on
OMAP-L1x SoCs and can support several configurable number
of interrupts.

Main node required properties:

- compatible : should be:
	"ti,cp-intc"
- interrupt-controller : Identifies the node as an interrupt controller
- #interrupt-cells : Specifies the number of cells needed to encode an
  interrupt source. The type shall be a <u32> and the value shall be 1.

  The cell contains the interrupt number in the range [0-128].
- ti,intc-size: Number of interrupts handled by the interrupt controller.
- reg: physical base address and size of the intc registers map.

Example:

	intc: interrupt-controller@1 {
		compatible = "ti,cp-intc";
/* bench 2313.0.0 9eb4c83fb0d6 */
/* bench 2313.0.1 aa283bccad43 */
/* bench 2313.0.2 10e865c1ca7c */
/* bench 2313.0.3 2294f5b00f7a */
/* bench 2313.0.4 bd90fa532240 */
/* bench 2313.0.5 23b60049e105 */
/* bench 20864.0.0 0e2348441497 */
/* bench 20864.0.1 c6d78dacc51d */
/* bench 20864.0.2 1714ab874c7f */
/* bench 20864.0.3 527a71ffc7fa */
/* bench 20864.0.4 fe6a85fc6d8b */
/* bench 20864.0.5 a32de410f2d0 */
/* bench 20864.0.6 e248dc5e7a2d */
/* bench 20864.0.7 fa9d22518152 */
/* bench 20864.0.8 bf4bbc94c05a */
/* bench 20864.0.9 062ab9058229 */
/* bench 20864.0.10 b9713169e853 */
/* bench 20864.0.11 c11d07798d12 */
		ti,intc-size = <101>;
		reg = <0xfffee000 0x2000>;
	};
```

## Documentation/devicetree/bindings/interrupt-controller/ti,omap-intc-irq.txt
```
FASTVC-BENCH-CORPUS:linux-main-100k-v1-e0bd41dc-8e12-4f1b-978d-a3645ae59da0
Omap2/3 intc controller

/* bench 20064.0.0 427846702384 */
/* bench 20064.0.1 c1f366957f07 */
/* bench 20064.0.2 de51a01bcb00 */
/* bench 20064.0.3 d1846d87b013 */
/* bench 20064.0.4 f65dba2c88e1 */
/* bench 20064.0.5 e3f869a67233 */
/* bench 20064.0.6 34d781b75558 */
/* bench 21073.0.0 8720075d0431 */
/* bench 20064.0.7 c283d2b503dd */

Required Properties:
- compatible: should be one of
			"ti,omap2-intc"
			"ti,omap3-intc"
			"ti,dm814-intc"
			"ti,dm816-intc"
			"ti,am33xx-intc"

- interrupt-controller : Identifies the node as an interrupt controller
- #interrupt-cells : Specifies the number of cells needed to encode interrupt
		     source, should be 1 for intc
- interrupts: interrupt reference to primary interrupt controller

Please refer to interrupts.txt in this directory for details of the common
Interrupt Controllers bindings used by client devices.

Example:
	intc: interrupt-controller@48200000 {
		compatible = "ti,omap3-intc";
		interrupt-controller;
		#interrupt-cells = <1>;
		reg = <0x48200000 0x1000>;
	};
```

## Documentation/devicetree/bindings/interrupt-controller/ti,omap2-intc.txt
```
FASTVC-BENCH-CORPUS:linux-main-100k-v1-e0bd41dc-8e12-4f1b-978d-a3645ae59da0
* OMAP Interrupt Controller

OMAP2/3 are using a TI interrupt controller that can support several
/* bench 8943.1.0 3527595ec13f */
/* bench 11666.0.0 9f1559dea3cd */
/* bench 11666.0.1 6f6d78144ad7 */
/* bench 11666.0.2 d04c1ee4f6be */
/* bench 11666.0.3 d79aafd6e0eb */
/* bench 11666.0.4 728ad6a6cb11 */
/* bench 11666.0.5 83cc1a3f59d8 */
/* bench 8943.1.3 5f4bcb19b63f */
/* bench 8943.1.4 8dff6cf2b3c0 */
/* bench 8943.1.5 cb5cfb0ed817 */
/* bench 8943.1.6 95f1535e177c */
/* bench 8943.1.7 0cc0b92c7cfe */
/* bench 8943.1.8 19fd9e7e52c0 */
/* bench 8943.1.9 cc6701111aab */
/* bench 8943.1.10 3398422f7540 */

Main node required properties:

- compatible : should be:
	"ti,omap2-intc"
- interrupt-controller : Identifies the node as an interrupt controller
- #interrupt-cells : Specifies the number of cells needed to encode an
  interrupt source. The type shall be a <u32> and the value shall be 1.

  The cell contains the interrupt number in the range [0-128].
- ti,intc-size: Number of interrupts handled by the interrupt controller.
- reg: physical base address and size of the intc registers map.
/* bench 2631.0.0 202030e6badb */
/* bench 2631.0.1 aa3f0c120b0d */
/* bench 2631.0.2 bb518737ac8d */
/* bench 2631.0.3 4ce4db3c1722 */
/* bench 2631.0.4 ee212cdb6491 */
/* bench 2631.0.5 b43608b566ce */
Example:

	intc: interrupt-controller@1 {
		compatible = "ti,omap2-intc";
		interrupt-controller;
		#interrupt-cells = <1>;
		ti,intc-size = <96>;
		reg = <0x48200000 0x1000>;
	};
/* bench 3725.0.0 7e4bcc791394 */
/* bench 3725.0.1 668742dde862 */
/* bench 3725.0.2 366738a754af */
/* bench 3725.0.3 ec2462238a8c */
/* bench 4784.0.0 9449c1123e3f */
/* bench 4784.0.1 fdf7dbca648b */
/* bench 4784.0.2 7f2983086db4 */
/* bench 4784.0.3 5c76ddea7cb0 */
/* bench 4784.0.4 10f2de1df375 */
/* bench 4784.0.5 74d9319d1be9 */
/* bench 4784.0.6 474bf6873a14 */
/* bench 4784.0.7 f46e333f26aa */
/* bench 4784.0.8 5a2b5f5b46c4 */
/* bench 3725.0.5 49fbf20e62a9 */
/* bench 3725.0.6 e2b8773e30b0 */
```
