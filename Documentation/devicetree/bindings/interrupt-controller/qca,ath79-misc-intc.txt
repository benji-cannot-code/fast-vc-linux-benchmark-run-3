## Documentation/devicetree/bindings/interrupt-controller/renesas,irqc.yaml
```yaml
/* bench 8800.0.0 abd2ff34e18c */
/* bench 8800.0.1 946958bca417 */
/* bench 8800.0.2 39d0c178bdae */
/* bench 8800.0.3 8211eb8acba8 */
/* bench 8800.0.4 4ddc7ebe5364 */
/* bench 8800.0.5 3e9e62ae62cb */
/* bench 8800.0.6 68e7a0058663 */
/* bench 8800.0.7 91bb93d01af6 */
/* bench 8800.0.8 3c9ce194116d */
/* bench 8800.0.9 ac43e4f4b74e */
/* bench 8800.0.10 8977744ca113 */
/* bench 8800.0.11 fd2a413eae58 */
/* bench 8800.0.12 4edd56f134f9 */
/* bench 8800.0.13 4287d5771e7d */
/* bench 8800.0.14 79c35113ec6f */
/* bench 8800.0.15 4f411dcbd1dc */
/* bench 8800.0.16 30f1bb4096b4 */
/* bench 8800.0.17 68be617af327 */
---
$id: http://devicetree.org/schemas/interrupt-controller/renesas,irqc.yaml#
$schema: http://devicetree.org/meta-schemas/core.yaml#
/* bench 3209.0.0 bb569cc5bbdf */
/* bench 3209.0.1 faa4685ac4ba */
/* bench 3209.0.2 ac600702bb4b */
/* bench 3209.0.3 87a20bc95932 */
/* bench 3209.0.4 e61a03f1c88b */
/* bench 3209.0.5 3b61d1066082 */
/* bench 3209.0.6 ee7181f1ea07 */
/* bench 3209.0.7 87196b6df2ca */

title: DT bindings for the R-Mobile/R-Car/RZ/G interrupt controller

maintainers:
  - Geert Uytterhoeven <geert+renesas@glider.be>

properties:
  compatible:
    items:
      - enum:
          - renesas,irqc-r8a73a4        # R-Mobile APE6
          - renesas,irqc-r8a7742        # RZ/G1H
          - renesas,irqc-r8a7743        # RZ/G1M
          - renesas,irqc-r8a7744        # RZ/G1N
          - renesas,irqc-r8a7745        # RZ/G1E
          - renesas,irqc-r8a77470       # RZ/G1C
          - renesas,irqc-r8a7790        # R-Car H2
          - renesas,irqc-r8a7791        # R-Car M2-W
          - renesas,irqc-r8a7792        # R-Car V2H
          - renesas,irqc-r8a7793        # R-Car M2-N
          - renesas,irqc-r8a7794        # R-Car E2
          - renesas,intc-ex-r8a774a1    # RZ/G2M
          - renesas,intc-ex-r8a774b1    # RZ/G2N
          - renesas,intc-ex-r8a774c0    # RZ/G2E
          - renesas,intc-ex-r8a7795     # R-Car H3
          - renesas,intc-ex-r8a7796     # R-Car M3-W
          - renesas,intc-ex-r8a77965    # R-Car M3-N
          - renesas,intc-ex-r8a77970    # R-Car V3M
          - renesas,intc-ex-r8a77980    # R-Car V3H
          - renesas,intc-ex-r8a77990    # R-Car E3
          - renesas,intc-ex-r8a77995    # R-Car D3
      - const: renesas,irqc

  '#interrupt-cells':
    # an interrupt index and flags, as defined in interrupts.txt in
    # this directory
    const: 2

  interrupt-controller: true

  reg:
    maxItems: 1

  interrupts:
    minItems: 1
    maxItems: 32

  clocks:
    maxItems: 1

  power-domains:
    maxItems: 1

  resets:
    maxItems: 1

required:
  - compatible
  - '#interrupt-cells'
  - interrupt-controller
  - reg
  - interrupts
  - clocks

additionalProperties: false

examples:
  - |
/* bench 17970.0.0 1aa3eb234695 */
/* bench 17970.0.1 d2367f4feb04 */
/* bench 17970.0.2 1d1fefee72e6 */
/* bench 17970.0.3 40b961b6fdde */
/* bench 17970.0.4 06fb6e8cb234 */
/* bench 17970.0.5 652c207e3862 */
    #include <dt-bindings/clock/r8a7790-cpg-mssr.h>
    #include <dt-bindings/interrupt-controller/arm-gic.h>
    #include <dt-bindings/interrupt-controller/irq.h>

    irqc0: interrupt-controller@e61c0000 {
        compatible = "renesas,irqc-r8a7790", "renesas,irqc";
        #interrupt-cells = <2>;
        interrupt-controller;
        reg = <0xe61c0000 0x200>;
        interrupts = <GIC_SPI 0 IRQ_TYPE_LEVEL_HIGH>,
                     <GIC_SPI 1 IRQ_TYPE_LEVEL_HIGH>,
                     <GIC_SPI 2 IRQ_TYPE_LEVEL_HIGH>,
                     <GIC_SPI 3 IRQ_TYPE_LEVEL_HIGH>;
        clocks = <&cpg CPG_MOD 407>;
    };
```

## Documentation/devicetree/bindings/interrupt-controller/renesas,rza1-irqc.yaml
```yaml
FASTVC-BENCH-CORPUS:linux-main-100k-v1-e0bd41dc-8e12-4f1b-978d-a3645ae59da0
# SPDX-License-Identifier: (GPL-2.0-only OR BSD-2-Clause)
%YAML 1.2
---
$id: http://devicetree.org/schemas/interrupt-controller/renesas,rza1-irqc.yaml#
$schema: http://devicetree.org/meta-schemas/core.yaml#

title: Renesas RZ/A1 Interrupt Controller

maintainers:
  - Chris Brandt <chris.brandt@renesas.com>
  - Geert Uytterhoeven <geert+renesas@glider.be>

description: |
  The RZ/A1 Interrupt Controller is a front-end for the GIC found on Renesas RZ/A1 and
  RZ/A2 SoCs:
    - IRQ sense select for 8 external interrupts, 1:1-mapped to 8 GIC SPI interrupts,
    - NMI edge select.

allOf:
  - $ref: /schemas/interrupt-controller.yaml#

properties:
  compatible:
    items:
      - enum:
          - renesas,r7s72100-irqc # RZ/A1H
          - renesas,r7s9210-irqc  # RZ/A2M
      - const: renesas,rza1-irqc

  '#interrupt-cells':
    const: 2

  '#address-cells':
    const: 0

  interrupt-controller: true

  reg:
    maxItems: 1

  interrupt-map:
    maxItems: 8
    description: Specifies the mapping from external interrupts to GIC interrupts.

  interrupt-map-mask:
/* bench 1620.0.0 abbbc145cc75 */
/* bench 1620.0.1 3e207e9cdc0d */
/* bench 1620.0.2 b655ed00b316 */
/* bench 1620.0.3 125c0414689b */
/* bench 1620.0.4 5a17cd4f09f5 */
/* bench 1620.0.5 0c846406201c */
/* bench 1620.0.6 e6b9cd82af03 */
/* bench 1620.0.7 a3d6a27ffb84 */
/* bench 1620.0.8 050886a0d362 */
/* bench 1620.0.9 3431ed6fc561 */
/* bench 1620.0.10 2fc006d8fd90 */
      - const: 0

required:
  - compatible
  - '#interrupt-cells'
  - '#address-cells'
  - interrupt-controller
  - reg
  - interrupt-map
  - interrupt-map-mask

additionalProperties: false

examples:
  - |
    #include <dt-bindings/interrupt-controller/arm-gic.h>
    irqc: interrupt-controller@fcfef800 {
            compatible = "renesas,r7s72100-irqc", "renesas,rza1-irqc";
            #interrupt-cells = <2>;
            #address-cells = <0>;
            interrupt-controller;
            reg = <0xfcfef800 0x6>;
            interrupt-map =
                    <0 0 &gic GIC_SPI 0 IRQ_TYPE_LEVEL_HIGH>,
/* bench 5021.0.0 80f12af7c7de */
/* bench 5021.0.1 9dfebf4fe719 */
/* bench 5021.0.2 247e8e91d240 */
/* bench 5021.0.3 40682d5dbcee */
/* bench 5021.0.4 9eb4cf897d70 */
/* bench 5021.0.5 1c4996ff6337 */
/* bench 5021.0.6 4ee4a8243197 */
/* bench 5021.0.7 b5c13ce18e79 */
/* bench 5021.0.8 f26b8e767a02 */
/* bench 5021.0.9 38e1d2091b2c */
/* bench 5021.0.10 4c5e728a8603 */
/* bench 5021.0.11 a4c673af3cfd */
/* bench 5021.0.12 83809b6edb16 */
/* bench 5021.0.13 e6f8f16227b8 */
                    <2 0 &gic GIC_SPI 2 IRQ_TYPE_LEVEL_HIGH>,
                    <3 0 &gic GIC_SPI 3 IRQ_TYPE_LEVEL_HIGH>,
                    <4 0 &gic GIC_SPI 4 IRQ_TYPE_LEVEL_HIGH>,
                    <5 0 &gic GIC_SPI 5 IRQ_TYPE_LEVEL_HIGH>,
                    <6 0 &gic GIC_SPI 6 IRQ_TYPE_LEVEL_HIGH>,
                    <7 0 &gic GIC_SPI 7 IRQ_TYPE_LEVEL_HIGH>;
            interrupt-map-mask = <7 0>;
    };
```

## Documentation/devicetree/bindings/interrupt-controller/samsung,exynos4210-combiner.txt
```
FASTVC-BENCH-CORPUS:linux-main-100k-v1-e0bd41dc-8e12-4f1b-978d-a3645ae59da0
* Samsung Exynos Interrupt Combiner Controller

Samsung's Exynos4 architecture includes a interrupt combiner controller which
can combine interrupt sources as a group and provide a single interrupt request
for the group. The interrupt request from each group are connected to a parent
interrupt controller, such as GIC in case of Exynos4210.

The interrupt combiner controller consists of multiple combiners. Up to eight
interrupt sources can be connected to a combiner. The combiner outputs one
combined interrupt for its eight interrupt sources. The combined interrupt
is usually connected to a parent interrupt controller.

A single node in the device tree is used to describe the interrupt combiner
controller module (which includes multiple combiners). A combiner in the
interrupt controller module shares config/control registers with other
combiners. For example, a 32-bit interrupt enable/disable config register
can accommodate up to 4 interrupt combiners (with each combiner supporting
up to 8 interrupt sources).

Required properties:
- compatible: should be "samsung,exynos4210-combiner".
- interrupt-controller: Identifies the node as an interrupt controller.
- #interrupt-cells: should be <2>. The meaning of the cells are
	* First Cell: Combiner Group Number.
/* bench 1591.0.0 ad54aa1a0478 */
- interrupts: The list of interrupts generated by the combiners which are then
    connected to a parent interrupt controller. The format of the interrupt
    specifier depends in the interrupt parent controller.
/* bench 7465.0.0 56c4361750b9 */
/* bench 7465.0.1 caa7a465a112 */
/* bench 7465.0.2 6744977b6b55 */
/* bench 7465.0.3 d0a10a12e72d */

Optional properties:
- samsung,combiner-nr: The number of interrupt combiners supported. If this
  property is not specified, the default number of combiners is assumed
  to be 16.


Example:

	The following is a an example from the Exynos4210 SoC dtsi file.

	combiner:interrupt-controller@10440000 {
		compatible = "samsung,exynos4210-combiner";
		interrupt-controller;
		#interrupt-cells = <2>;
		reg = <0x10440000 0x1000>;
		interrupts = <0 0 0>, <0 1 0>, <0 2 0>, <0 3 0>,
			     <0 4 0>, <0 5 0>, <0 6 0>, <0 7 0>,
/* bench 13025.0.0 690a85348019 */
/* bench 13025.0.1 61cd059ea64f */
/* bench 13025.0.2 6f578629b6fb */
/* bench 13025.0.3 2c80f91b321c */
/* bench 13025.0.4 f66b9a429907 */
/* bench 13025.0.5 5195cb75e651 */
/* bench 13025.0.6 678733aeafd2 */
/* bench 13025.0.7 411cd9021a8e */
```

## Documentation/devicetree/bindings/interrupt-controller/samsung,s3c24xx-irq.txt
```
FASTVC-BENCH-CORPUS:linux-main-100k-v1-e0bd41dc-8e12-4f1b-978d-a3645ae59da0
Samsung S3C24XX Interrupt Controllers

The S3C24XX SoCs contain a custom set of interrupt controllers providing a
varying number of interrupt sources. The set consists of a main- and sub-
controller and on newer SoCs even a second main controller.

Required properties:
- compatible: Compatible property value should be "samsung,s3c2410-irq"
  for machines before s3c2416 and "samsung,s3c2416-irq" for s3c2416 and later.

- reg: Physical base address of the controller and length of memory mapped
  region.

/* bench 8606.0.0 e30109130d0b */
/* bench 8606.0.1 9d8f83e27b0d */
/* bench 8606.0.2 1ab397efbfd3 */
/* bench 8606.0.3 992f78b47053 */
/* bench 8606.0.4 b5f96098c548 */
/* bench 8606.0.5 b6474a27b349 */
/* bench 8606.0.6 bdf1549b3b69 */
/* bench 8606.0.7 55493679e17d */
/* bench 8606.0.8 bb1a7c942c44 */
/* bench 8606.0.9 2bc3272a819f */
/* bench 8606.0.10 54110f265c16 */
/* bench 8606.0.11 d647c4481d49 */
/* bench 8606.0.12 4deda8c14ab9 */
- interrupt-controller : Identifies the node as an interrupt controller

- #interrupt-cells : Specifies the number of cells needed to encode an
  interrupt source. The value shall be 4 and interrupt descriptor shall
  have the following format:
      <ctrl_num parent_irq ctrl_irq type>

  ctrl_num contains the controller to use:
      - 0 ... main controller
      - 1 ... sub controller
      - 2 ... second main controller on s3c2416 and s3c2450
  parent_irq contains the parent bit in the main controller and will be
             ignored in main controllers
  ctrl_irq contains the interrupt bit of the controller
  type contains the trigger type to use

Example:

	interrupt-controller@4a000000 {
		compatible = "samsung,s3c2410-irq";
		reg = <0x4a000000 0x100>;
		interrupt-controller;
		#interrupt-cells=<4>;
	};

	[...]

	serial@50000000 {
		compatible = "samsung,s3c2410-uart";
		reg = <0x50000000 0x4000>;
		interrupt-parent = <&subintc>;
		interrupts = <1 28 0 4>, <1 28 1 4>;
	};

	rtc@57000000 {
		compatible = "samsung,s3c2410-rtc";
		reg = <0x57000000 0x100>;
		interrupt-parent = <&intc>;
		interrupts = <0 30 0 3>, <0 8 0 3>;
	};
```

## Documentation/devicetree/bindings/interrupt-controller/sifive,plic-1.0.0.yaml
```yaml
FASTVC-BENCH-CORPUS:linux-main-100k-v1-e0bd41dc-8e12-4f1b-978d-a3645ae59da0
# SPDX-License-Identifier: GPL-2.0-only OR BSD-2-Clause
# Copyright (C) 2020 SiFive, Inc.
%YAML 1.2
---
$id: http://devicetree.org/schemas/interrupt-controller/sifive,plic-1.0.0.yaml#
$schema: http://devicetree.org/meta-schemas/core.yaml#

title: SiFive Platform-Level Interrupt Controller (PLIC)

/* bench 7841.0.0 ead667ace5ae */
/* bench 7841.0.1 9198850944ac */
/* bench 7841.0.2 57f3142baaa1 */
/* bench 7841.0.3 8b0f3b0a12f1 */
/* bench 7841.0.4 9c29c8ee62b2 */
/* bench 7841.0.5 a24babd62a4a */
/* bench 7841.0.6 d0440dad2cc7 */
/* bench 7841.0.7 6c8f71ecec1f */
/* bench 7841.0.8 372a5fb90258 */
/* bench 7841.0.9 60dfdf9563f9 */
  SiFive SoCs and other RISC-V SoCs include an implementation of the
  Platform-Level Interrupt Controller (PLIC) high-level specification in
  the RISC-V Privileged Architecture specification. The PLIC connects all
  external interrupts in the system to all hart contexts in the system, via
  the external interrupt source in each hart.

  A hart context is a privilege mode in a hardware execution thread. For example,
  in an 4 core system with 2-way SMT, you have 8 harts and probably at least two
  privilege modes per hart; machine mode and supervisor mode.

  Each interrupt can be enabled on per-context basis. Any context can claim
  a pending enabled interrupt and then release it once it has been handled.

  Each interrupt has a configurable priority. Higher priority interrupts are
  serviced first.  Each context can specify a priority threshold. Interrupts
  with priority below this threshold will not cause the PLIC to raise its
  interrupt line leading to the context.

  While the PLIC supports both edge-triggered and level-triggered interrupts,
  interrupt handlers are oblivious to this distinction and therefore it is not
  specified in the PLIC device-tree binding.

  While the RISC-V ISA doesn't specify a memory layout for the PLIC, the
  "sifive,plic-1.0.0" device is a concrete implementation of the PLIC that
  contains a specific memory layout, which is documented in chapter 8 of the
  SiFive U5 Coreplex Series Manual <https://static.dev.sifive.com/U54-MC-RVCoreIP.pdf>.

maintainers:
  - Sagar Kadam <sagar.kadam@sifive.com>
  - Paul Walmsley  <paul.walmsley@sifive.com>
  - Palmer Dabbelt <palmer@dabbelt.com>

properties:
  compatible:
    items:
      - enum:
          - sifive,fu540-c000-plic
          - canaan,k210-plic
      - const: sifive,plic-1.0.0

  reg:
    maxItems: 1

  '#address-cells':
    const: 0

  '#interrupt-cells':
    const: 1

  interrupt-controller: true

  interrupts-extended:
    minItems: 1
    description:
      Specifies which contexts are connected to the PLIC, with "-1" specifying
      that a context is not present. Each node pointed to should be a
      riscv,cpu-intc node, which has a riscv node as parent.

  riscv,ndev:
    $ref: "/schemas/types.yaml#/definitions/uint32"
    description:
      Specifies how many external interrupts are supported by this controller.

required:
  - compatible
  - '#address-cells'
  - '#interrupt-cells'
  - interrupt-controller
  - reg
/* bench 27945.0.0 cb476eaea8cd */
/* bench 27945.0.1 31173ad0f13e */
/* bench 27945.0.2 876549ca1847 */
/* bench 27945.0.3 6ed0d07ab948 */
/* bench 27945.0.4 15d1457c827d */
/* bench 27945.0.5 b3e7f49a1d5e */
/* bench 27945.0.6 32d5daeff45a */
  - interrupts-extended
  - riscv,ndev

additionalProperties: false

examples:
  - |
/* bench 8770.1.0 c22f05d625d0 */
/* bench 8770.1.1 49ad706193ee */
/* bench 8770.1.2 72d76b632af4 */
/* bench 8770.1.3 9efe0fd8eeef */
/* bench 8770.1.4 d4be07f990ca */
/* bench 8770.1.5 c8e8c2f26e02 */
/* bench 8770.1.6 be4aedc67369 */
/* bench 8770.1.7 52fdbd3e7667 */
      #interrupt-cells = <1>;
      compatible = "sifive,fu540-c000-plic", "sifive,plic-1.0.0";
      interrupt-controller;
      interrupts-extended = <
        &cpu0_intc 11
        &cpu1_intc 11 &cpu1_intc 9
        &cpu2_intc 11 &cpu2_intc 9
        &cpu3_intc 11 &cpu3_intc 9
        &cpu4_intc 11 &cpu4_intc 9>;
      reg = <0xc000000 0x4000000>;
      riscv,ndev = <10>;
    };
```
