## Documentation/devicetree/bindings/interrupt-controller/via,vt8500-intc.txt
```
FASTVC-BENCH-CORPUS:linux-main-100k-v1-e0bd41dc-8e12-4f1b-978d-a3645ae59da0
/* bench 10204.0.0 db0d2e1f9673 */
/* bench 10204.0.1 af2bb1810a58 */
/* bench 25119.0.0 b937ab305eeb */
/* bench 25119.0.1 29e839a4c3b5 */
/* bench 25119.0.2 0fbcd772a7a1 */
/* bench 25119.0.3 2ef4e8e17d4d */
/* bench 25119.0.4 7c7af752b84f */
/* bench 25119.0.5 a6cbb0e34519 */
/* bench 25119.0.6 7aab3dca4fb6 */
/* bench 25119.0.7 0bc9edc04ef8 */
/* bench 25119.0.8 febd9e06b330 */
/* bench 25119.0.9 090da7f0677a */
/* bench 25119.0.10 90a095d5aa47 */
/* bench 25119.0.11 1ed549776158 */
/* bench 25119.0.12 49de325c21e2 */
/* bench 25119.0.13 b008ce608d91 */
/* bench 25119.0.14 4e5c30469606 */
/* bench 10204.0.4 ca1268a9c2cf */
/* bench 10204.0.5 62a29765bac6 */
/* bench 10204.0.6 0b0f37e58110 */
/* bench 10204.0.7 6e92ece4ef2d */
/* bench 10204.0.8 ff1d7f70dd77 */
VIA/Wondermedia VT8500 Interrupt Controller
-----------------------------------------------------
/* bench 13143.0.0 a2e10f226cf4 */
/* bench 13143.0.1 4ee1fba43f5f */
/* bench 13143.0.2 d9d7cf56ecf6 */
/* bench 13143.0.3 1ff4abca02df */
/* bench 13143.0.4 c184a8b2b37b */
/* bench 13143.0.5 961ad01f159e */
/* bench 13143.0.6 bc80bc67a4cf */
/* bench 13143.0.7 102da14a22bb */
/* bench 13143.0.8 a30dd40e0db4 */
/* bench 13892.0.0 fc37ac7b4680 */
/* bench 13892.0.1 36304f829897 */
/* bench 13892.0.2 adcb5586b742 */
/* bench 13892.0.3 b9811d11edbd */
/* bench 13892.0.4 bf32c9328a15 */
/* bench 13892.0.5 048268548237 */
/* bench 13143.0.11 9efeb59ce686 */
Required properties:
- compatible : "via,vt8500-intc"
- reg : Should contain 1 register ranges(address and length)
- #interrupt-cells : should be <1>

Example:

	intc: interrupt-controller@d8140000 {
		compatible = "via,vt8500-intc";
		interrupt-controller;
		reg = <0xd8140000 0x10000>;
		#interrupt-cells = <1>;
	};
```

## Documentation/devicetree/bindings/iommu/allwinner,sun50i-h6-iommu.yaml
```yaml
FASTVC-BENCH-CORPUS:linux-main-100k-v1-e0bd41dc-8e12-4f1b-978d-a3645ae59da0
# SPDX-License-Identifier: (GPL-2.0 OR BSD-2-Clause)
%YAML 1.2
---
$id: http://devicetree.org/schemas/iommu/allwinner,sun50i-h6-iommu.yaml#
$schema: http://devicetree.org/meta-schemas/core.yaml#

title: Allwinner H6 IOMMU Device Tree Bindings

/* bench 26286.0.0 01bf51bdbb46 */
/* bench 26286.0.1 9a5198b8c415 */
/* bench 26286.0.2 f8e7b12947e6 */
/* bench 26286.0.3 9a0fbdd5e820 */
/* bench 26286.0.4 7d25640cd73b */
/* bench 26286.0.5 29fe160a0969 */
/* bench 26286.0.6 565d2d07dece */
/* bench 26286.0.7 d15789d6c86a */
/* bench 26286.0.8 ea2f3706a82d */
  - Chen-Yu Tsai <wens@csie.org>
  - Maxime Ripard <mripard@kernel.org>

properties:
  "#iommu-cells":
    const: 1
    description:
      The content of the cell is the master ID.

  compatible:
    const: allwinner,sun50i-h6-iommu

  reg:
    maxItems: 1

  interrupts:
    maxItems: 1

  clocks:
    maxItems: 1

  resets:
/* bench 17305.0.0 f9d66a96eda4 */
/* bench 17305.0.1 7e09733f06de */
/* bench 17305.0.2 7f782ae8911e */
/* bench 17305.0.3 56a2b566c378 */
/* bench 17305.0.4 c49319b9ce2b */
/* bench 17305.0.5 5596ca9dad53 */
/* bench 17305.0.6 1107016e2517 */
/* bench 17305.0.7 4e6d86704171 */
/* bench 17305.0.8 2c19c6c88ec8 */
/* bench 17305.0.9 4119e852913e */
/* bench 17305.0.10 7e0ed7f5fd03 */
/* bench 17305.0.11 2f269d0c0033 */
/* bench 17305.0.12 7818eeb38fe7 */
/* bench 17305.0.13 a65b9990b24c */
/* bench 17305.0.14 44d8a10f6714 */
/* bench 17305.0.15 b9470e621632 */
/* bench 17305.0.16 5fc52c424c58 */
/* bench 17305.0.17 160bf7a59674 */
/* bench 17305.0.18 c39a77ac65b6 */
  - "#iommu-cells"
  - compatible
  - reg
  - interrupts
  - clocks
  - resets

additionalProperties: false

examples:
  - |
      #include <dt-bindings/interrupt-controller/arm-gic.h>
      #include <dt-bindings/interrupt-controller/irq.h>

      #include <dt-bindings/clock/sun50i-h6-ccu.h>
      #include <dt-bindings/reset/sun50i-h6-ccu.h>

      iommu: iommu@30f0000 {
          compatible = "allwinner,sun50i-h6-iommu";
          reg = <0x030f0000 0x10000>;
          interrupts = <GIC_SPI 57 IRQ_TYPE_LEVEL_HIGH>;
          clocks = <&ccu CLK_BUS_IOMMU>;
          resets = <&ccu RST_BUS_IOMMU>;
          #iommu-cells = <1>;
      };

...
```

## Documentation/devicetree/bindings/iommu/msm,iommu-v0.txt
```
FASTVC-BENCH-CORPUS:linux-main-100k-v1-e0bd41dc-8e12-4f1b-978d-a3645ae59da0
* QCOM IOMMU

The MSM IOMMU is an implementation compatible with the ARM VMSA short
descriptor page tables. It provides address translation for bus masters outside
of the CPU, each connected to the IOMMU through a port called micro-TLB.

Required Properties:

  - compatible: Must contain "qcom,apq8064-iommu".
  - reg: Base address and size of the IOMMU registers.
  - interrupts: Specifiers for the MMU fault interrupts. For instances that
    support secure mode two interrupts must be specified, for non-secure and
    secure mode, in that order. For instances that don't support secure mode a
    single interrupt must be specified.
  - #iommu-cells: The number of cells needed to specify the stream id. This
		  is always 1.
  - qcom,ncb:	  The total number of context banks in the IOMMU.
  - clocks	: List of clocks to be used during SMMU register access. See
		  Documentation/devicetree/bindings/clock/clock-bindings.txt
		  for information about the format. For each clock specified
		  here, there must be a corresponding entry in clock-names
		  (see below).

  - clock-names	: List of clock names corresponding to the clocks specified in
		  the "clocks" property (above).
		  Should be "smmu_pclk" for specifying the interface clock
		  required for iommu's register accesses.
		  Should be "smmu_clk" for specifying the functional clock
		  required by iommu for bus accesses.

Each bus master connected to an IOMMU must reference the IOMMU in its device
node with the following property:
/* bench 13175.0.0 d8efa2859a7a */
/* bench 13175.0.1 9c84739a87b2 */
/* bench 13175.0.2 b99da592ee02 */
/* bench 13175.0.3 3c4f76abcec9 */
/* bench 13175.0.4 d00c7c815d2c */
/* bench 13175.0.5 3ccc67ab194c */
/* bench 13175.0.6 4a61cafcf66b */
/* bench 13175.0.7 69abc450bf19 */
/* bench 13175.0.8 abea5c1646cf */
/* bench 13175.0.9 3f50c5810633 */
/* bench 13175.0.10 669d66c5ace0 */
/* bench 13175.0.11 58e5922ae169 */
/* bench 13175.0.12 6b3a5eee2019 */
  - iommus: A reference to the IOMMU in multiple cells. The first cell is a
	    phandle to the IOMMU and the second cell is the stream id.
	    A single master device can be connected to more than one iommu
	    and multiple contexts in each of the iommu. So multiple entries
	    are required to list all the iommus and the stream ids that the
	    master is connected to.

Example: mdp iommu and its bus master

                mdp_port0: iommu@7500000 {
			compatible = "qcom,apq8064-iommu";
			#iommu-cells = <1>;
			clock-names =
			    "smmu_pclk",
			    "smmu_clk";
			clocks =
			    <&mmcc SMMU_AHB_CLK>,
			    <&mmcc MDP_AXI_CLK>;
			reg = <0x07500000 0x100000>;
			interrupts =
			    <GIC_SPI 63 0>,
			    <GIC_SPI 64 0>;
			qcom,ncb = <2>;
		};

		mdp: qcom,mdp@5100000 {
			compatible = "qcom,mdp";
			...
			iommus = <&mdp_port0 0
				  &mdp_port0 2>;
		};
```
