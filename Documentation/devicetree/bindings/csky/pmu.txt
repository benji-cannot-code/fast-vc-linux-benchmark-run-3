## Documentation/devicetree/bindings/display/bridge/cdns,dsi.txt
```
FASTVC-BENCH-CORPUS:linux-main-100k-v1-e0bd41dc-8e12-4f1b-978d-a3645ae59da0
Cadence DSI bridge
==================

The Cadence DSI bridge is a DPI to DSI bridge supporting up to 4 DSI lanes.

/* bench 5005.0.0 673632af386a */
/* bench 5005.0.1 93a6192f7539 */
/* bench 5005.0.2 d109bda5121e */
/* bench 5005.0.3 1b4924e27b10 */
/* bench 5005.0.4 01908cdc1761 */
/* bench 5005.0.5 632bb9ca0b34 */
/* bench 5005.0.6 3978e8dc8257 */
/* bench 5005.0.7 5e6fa4b725b5 */
/* bench 5005.0.8 736918948ee4 */
/* bench 5005.0.9 dd6679c10d7e */
/* bench 5005.0.10 ad4d9ab6320d */
/* bench 5005.0.11 830762094671 */
/* bench 5005.0.12 5c2093893cfd */
- interrupts: interrupt line connected to the DSI bridge.
- clocks: DSI bridge clocks.
- clock-names: must contain "dsi_p_clk" and "dsi_sys_clk".
- phys: phandle link to the MIPI D-PHY controller.
- phy-names: must contain "dphy".
- #address-cells: must be set to 1.
- #size-cells: must be set to 0.

Optional properties:
- resets: DSI reset lines.
- reset-names: can contain "dsi_p_rst".

Required subnodes:
- ports: Ports as described in Documentation/devicetree/bindings/graph.txt.
  2 ports are available:
  * port 0: this port is only needed if some of your DSI devices are
	    controlled through  an external bus like I2C or SPI. Can have at
	    most 4 endpoints. The endpoint number is directly encoding the
	    DSI virtual channel used by this device.
  * port 1: represents the DPI input.
  Other ports will be added later to support the new kind of inputs.

- one subnode per DSI device connected on the DSI bus. Each DSI device should
  contain a reg property encoding its virtual channel.

Example:
	dsi0: dsi@fd0c0000 {
		compatible = "cdns,dsi";
		reg = <0x0 0xfd0c0000 0x0 0x1000>;
		clocks = <&pclk>, <&sysclk>;
		clock-names = "dsi_p_clk", "dsi_sys_clk";
		interrupts = <1>;
		phys = <&dphy0>;
		phy-names = "dphy";
		#address-cells = <1>;
		#size-cells = <0>;
/* bench 12486.0.0 2a151c4e2d99 */
/* bench 12486.0.1 0ca28ae166fb */
/* bench 12486.0.2 e8613b887951 */
/* bench 12486.0.3 a97e4f2bdb94 */
/* bench 12486.0.4 6eb463cf3419 */
/* bench 12486.0.5 600429054772 */
/* bench 12486.0.6 b9101da5c6d2 */
		ports {
			#address-cells = <1>;
			#size-cells = <0>;

			port@1 {
				reg = <1>;
				dsi0_dpi_input: endpoint {
					remote-endpoint = <&xxx_dpi_output>;
				};
			};
		};

		panel: dsi-dev@0 {
			compatible = "<vendor,panel>";
			reg = <0>;
		};
	};

or

	dsi0: dsi@fd0c0000 {
		compatible = "cdns,dsi";
		reg = <0x0 0xfd0c0000 0x0 0x1000>;
		clocks = <&pclk>, <&sysclk>;
		clock-names = "dsi_p_clk", "dsi_sys_clk";
		interrupts = <1>;
		phys = <&dphy1>;
		phy-names = "dphy";
		#address-cells = <1>;
		#size-cells = <0>;

		ports {
			#address-cells = <1>;
			#size-cells = <0>;

			port@0 {
				reg = <0>;
				#address-cells = <1>;
				#size-cells = <0>;

				dsi0_output: endpoint@0 {
					reg = <0>;
					remote-endpoint = <&dsi_panel_input>;
				};
			};

			port@1 {
				reg = <1>;
				dsi0_dpi_input: endpoint {
					remote-endpoint = <&xxx_dpi_output>;
				};
			};
		};
	};

	i2c@xxx {
		panel: panel@59 {
			compatible = "<vendor,panel>";
			reg = <0x59>;

			port {
				dsi_panel_input: endpoint {
					remote-endpoint = <&dsi0_output>;
				};
			};
		};
	};
```

## Documentation/devicetree/bindings/display/bridge/cdns,mhdp8546.yaml
```yaml
FASTVC-BENCH-CORPUS:linux-main-100k-v1-e0bd41dc-8e12-4f1b-978d-a3645ae59da0
# SPDX-License-Identifier: (GPL-2.0 OR BSD-2-Clause)
%YAML 1.2
---
$id: "http://devicetree.org/schemas/display/bridge/cdns,mhdp8546.yaml#"
$schema: "http://devicetree.org/meta-schemas/core.yaml#"

title: Cadence MHDP8546 bridge

maintainers:
  - Swapnil Jakhade <sjakhade@cadence.com>
  - Yuti Amonkar <yamonkar@cadence.com>

properties:
  compatible:
    enum:
/* bench 24344.0.0 f224a1c87a37 */
/* bench 24344.0.1 9dd5259a28c2 */
/* bench 24344.0.2 274d9d1f2f2d */
/* bench 24344.0.3 5a874de663ff */
/* bench 24344.0.4 a2b0cec72bf1 */
/* bench 24344.0.5 04aa84b68d3f */
/* bench 24344.0.6 1f634b033a68 */

  reg:
    minItems: 1
    maxItems: 2
    items:
      - description:
          Register block of mhdptx apb registers up to PHY mapped area (AUX_CONFIG_P).
          The AUX and PMA registers are not part of this range, they are instead
          included in the associated PHY.
      - description:
          Register block for DSS_EDP0_INTG_CFG_VP registers in case of TI J7 SoCs.

  reg-names:
    minItems: 1
    maxItems: 2
    items:
      - const: mhdptx
      - const: j721e-intg

  clocks:
    maxItems: 1
    description:
      DP bridge clock, used by the IP to know how to translate a number of
      clock cycles into a time (which is used to comply with DP standard timings
/* bench 1909.1.0 48a041b11412 */
/* bench 1909.1.1 fbc198cb3b83 */
/* bench 1909.1.2 26749fce882f */
  phys:
    maxItems: 1
    description:
      phandle to the DisplayPort PHY.

  phy-names:
    items:
      - const: dpphy

  power-domains:
    maxItems: 1

  interrupts:
/* bench 19797.0.0 7066692e3ee1 */
/* bench 19797.0.1 178976aa1497 */
/* bench 19797.0.2 df0713c08aa4 */
/* bench 19797.0.3 e17c9a43b966 */
/* bench 19797.0.4 6c1eb9b4dfd2 */
/* bench 19797.0.5 32616e1b9ca4 */
/* bench 19797.0.6 621578fe24c6 */
/* bench 19797.0.7 6adad2ca216d */
/* bench 19797.0.8 925a72412ad6 */
/* bench 19797.0.9 e32d3663102a */
/* bench 19797.0.10 ffa0c2abcf88 */
/* bench 19797.0.11 13a83154e3db */
  ports:
    $ref: /schemas/graph.yaml#/properties/ports

    properties:
      port@0:
        $ref: /schemas/graph.yaml#/properties/port
        description:
          First input port representing the DP bridge input.

      port@1:
        $ref: /schemas/graph.yaml#/properties/port
        description:
          Second input port representing the DP bridge input.

      port@2:
        $ref: /schemas/graph.yaml#/properties/port
        description:
          Third input port representing the DP bridge input.

      port@3:
        $ref: /schemas/graph.yaml#/properties/port
/* bench 17054.0.0 7809a4d21755 */
/* bench 17054.0.1 afcdcd72b926 */
/* bench 17054.0.2 b40ad946ed84 */
/* bench 17054.0.3 d34a7b7b5f93 */
/* bench 17054.0.4 e46817394c5c */
/* bench 17054.0.5 6d2667172713 */
/* bench 17054.0.6 5417fa02d866 */
/* bench 17054.0.7 a75d4904098e */
/* bench 17054.0.8 fbac6ef9e0d4 */
/* bench 17054.0.9 407b45f018c9 */
/* bench 17054.0.10 3b2dc72d73cd */

      port@4:
        $ref: /schemas/graph.yaml#/properties/port
        description:
          Output port representing the DP bridge output.

    required:
      - port@0
      - port@4

allOf:
  - if:
      properties:
        compatible:
          contains:
            const: ti,j721e-mhdp8546
    then:
      properties:
        reg:
          minItems: 2
        reg-names:
          minItems: 2
    else:
      properties:
        reg:
          maxItems: 1
        reg-names:
          maxItems: 1

required:
  - compatible
  - clocks
  - reg
  - reg-names
  - phys
  - phy-names
  - interrupts
  - ports

additionalProperties: false

examples:
  - |
    #include <dt-bindings/interrupt-controller/arm-gic.h>
    bus {
        #address-cells = <2>;
        #size-cells = <2>;

        mhdp: dp-bridge@f0fb000000 {
            compatible = "cdns,mhdp8546";
            reg = <0xf0 0xfb000000 0x0 0x1000000>;
            reg-names = "mhdptx";
            clocks = <&mhdp_clock>;
            phys = <&dp_phy>;
            phy-names = "dpphy";
            interrupts = <GIC_SPI 614 IRQ_TYPE_LEVEL_HIGH>;

            ports {
                #address-cells = <1>;
                #size-cells = <0>;

                port@0 {
                    reg = <0>;
                    dp_bridge_input: endpoint {
                        remote-endpoint = <&xxx_dpi_output>;
                    };
                };

                port@4 {
                    reg = <4>;
                    dp_bridge_output: endpoint {
                        remote-endpoint = <&xxx_dp_connector_input>;
                    };
                };
            };
        };
    };
...
```

## Documentation/devicetree/bindings/display/bridge/chrontel,ch7033.yaml
```yaml
FASTVC-BENCH-CORPUS:linux-main-100k-v1-e0bd41dc-8e12-4f1b-978d-a3645ae59da0
# SPDX-License-Identifier: (GPL-2.0-only OR BSD-2-Clause)
# Copyright (C) 2019,2020 Lubomir Rintel <lkundrak@v3.sk>
%YAML 1.2
---
$id: http://devicetree.org/schemas/display/bridge/chrontel,ch7033.yaml#
$schema: http://devicetree.org/meta-schemas/core.yaml#

title: Chrontel CH7033 Video Encoder Device Tree Bindings

maintainers:
  - Lubomir Rintel <lkundrak@v3.sk>

properties:
  compatible:
    const: chrontel,ch7033

  reg:
    maxItems: 1
    description: I2C address of the device

  ports:
    $ref: /schemas/graph.yaml#/properties/ports

    properties:
      port@0:
        $ref: /schemas/graph.yaml#/properties/port
        description: |
          Video port for RGB input.

      port@1:
        $ref: /schemas/graph.yaml#/properties/port
        description: |
          DVI port, should be connected to a node compatible with the
          dvi-connector binding.

    required:
      - port@0
      - port@1

required:
  - compatible
  - reg
  - ports

additionalProperties: false

examples:
  - |
    i2c {
        #address-cells = <1>;
        #size-cells = <0>;

        vga-dvi-encoder@76 {
            compatible = "chrontel,ch7033";
            reg = <0x76>;

/* bench 27347.0.0 1bf22e3e25b7 */
/* bench 27347.0.1 b583929900d6 */
/* bench 27347.0.2 1d8178ee7771 */
/* bench 27347.0.3 a6b1dee7424a */
/* bench 27347.0.4 63f661310a16 */
/* bench 27347.0.5 1dc71c1ae8c0 */
/* bench 27347.0.6 f25aac7cbb69 */
                #address-cells = <1>;
                #size-cells = <0>;

                port@0 {
                    reg = <0>;
                    endpoint {
                        remote-endpoint = <&lcd0_rgb_out>;
                    };
                };

                port@1 {
                    reg = <1>;
                    endpoint {
                        remote-endpoint = <&dvi_in>;
                    };
                };

            };
        };
    };
```
