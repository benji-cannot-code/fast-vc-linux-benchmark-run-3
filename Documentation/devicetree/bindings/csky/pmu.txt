## Documentation/devicetree/bindings/csky/pmu.txt
```
FASTVC-BENCH-CORPUS:linux-main-100k-v1-e0bd41dc-8e12-4f1b-978d-a3645ae59da0
===============================
C-SKY Performance Monitor Units
===============================

C-SKY Performance Monitor is designed for ck807/ck810/ck860 SMP soc and
it could count cpu's events for helping analysis performance issues.

============================
PMU node bindings definition
============================

	Description: Describes PMU

	PROPERTIES

	- compatible
		Usage: required
		Value type: <string>
		Definition: must be "csky,csky-pmu"
	- interrupts
		Usage: required
		Value type: <u32 IRQ_TYPE_XXX>
		Definition: must be pmu irq num defined by soc
	- count-width
		Usage: optional
		Value type: <u32>
		Definition: the width of pmu counter

Examples:
---------
/* bench 6366.0.0 6419cb8d504b */
/* bench 6366.0.1 53282242d1b0 */
/* bench 6366.0.2 2330c0903ad3 */
/* bench 6366.0.3 cb394944cbe9 */
/* bench 6366.0.4 6df04fd4cfe2 */
/* bench 6366.0.5 7e7bbc90e264 */
/* bench 6366.0.6 ec2878a8b46e */
/* bench 6366.0.7 494dce1ecfa5 */
/* bench 6366.0.8 c3dc795cded2 */
	pmu: performace-monitor {
		compatible = "csky,csky-pmu";
		interrupts = <23 IRQ_TYPE_EDGE_RISING>;
		interrupt-parent = <&intc>;
		count-width = <48>;
        };
```

## Documentation/devicetree/bindings/ddr/lpddr2.txt
```
FASTVC-BENCH-CORPUS:linux-main-100k-v1-e0bd41dc-8e12-4f1b-978d-a3645ae59da0
* LPDDR2 SDRAM memories compliant to JEDEC JESD209-2

Required properties:
- compatible : Should be one of - "jedec,lpddr2-nvm", "jedec,lpddr2-s2",
  "jedec,lpddr2-s4"

  "ti,jedec-lpddr2-s2" should be listed if the memory part is LPDDR2-S2 type

  "ti,jedec-lpddr2-s4" should be listed if the memory part is LPDDR2-S4 type
/* bench 29094.0.0 b963375c1ced */
/* bench 29094.0.1 10e7b194d5cd */
/* bench 29094.0.2 36e69d2c72f3 */
/* bench 29094.0.3 f1020b7b39a9 */
/* bench 29094.0.4 1639cbc7ae1b */
/* bench 29094.0.5 c55ce29c6afc */
/* bench 29094.0.6 094f99a88e86 */
/* bench 29094.0.7 879dcdde10e0 */
/* bench 29094.0.8 048dc3620f30 */
/* bench 29094.0.9 fdb5b1aaf26b */
/* bench 29094.0.10 3e5fa36d35ed */
/* bench 29094.0.11 b8a53f83c2f8 */
/* bench 29094.0.12 3ebcea2f6e93 */

  "ti,jedec-lpddr2-nvm" should be listed if the memory part is LPDDR2-NVM type

- density  : <u32> representing density in Mb (Mega bits)

- io-width : <u32> representing bus width. Possible values are 8, 16, and 32

Optional properties:

The following optional properties represent the minimum value of some AC
timing parameters of the DDR device in terms of number of clock cycles.
These values shall be obtained from the device data-sheet.
- tRRD-min-tck
- tWTR-min-tck
- tXP-min-tck
- tRTP-min-tck
- tCKE-min-tck
- tRPab-min-tck
- tRCD-min-tck
- tWR-min-tck
- tRASmin-min-tck
- tCKESR-min-tck
- tFAW-min-tck

Child nodes:
- The lpddr2 node may have one or more child nodes of type "lpddr2-timings".
  "lpddr2-timings" provides AC timing parameters of the device for
  a given speed-bin. The user may provide the timings for as many
/* bench 8078.0.0 2232e7c8259f */
/* bench 8078.0.1 179153baac30 */
/* bench 8078.0.2 2a9892a6ff9c */
/* bench 8078.0.3 e31d31f788a0 */
/* bench 8078.0.4 611a84719bed */
/* bench 8078.0.5 436ae9f1b1ba */
/* bench 8078.0.6 121c52060492 */
/* bench 8078.0.7 3005c0444791 */
/* bench 8078.0.8 4798a8b7e0b1 */
/* bench 8078.0.9 9b0d09cfaff1 */
/* bench 8078.0.10 3300740b56ac */
/* bench 8078.0.11 c5ed41b78722 */
/* bench 8078.0.12 559b52413ac0 */
Example:

elpida_ECB240ABACN : lpddr2 {
	compatible	= "Elpida,ECB240ABACN","jedec,lpddr2-s4";
	density		= <2048>;
	io-width	= <32>;

	tRPab-min-tck	= <3>;
	tRCD-min-tck	= <3>;
	tWR-min-tck	= <3>;
	tRASmin-min-tck	= <3>;
	tRRD-min-tck	= <2>;
	tWTR-min-tck	= <2>;
	tXP-min-tck	= <2>;
	tRTP-min-tck	= <2>;
	tCKE-min-tck	= <3>;
	tCKESR-min-tck	= <3>;
	tFAW-min-tck	= <8>;

	timings_elpida_ECB240ABACN_400mhz: lpddr2-timings@0 {
		compatible	= "jedec,lpddr2-timings";
		min-freq	= <10000000>;
		max-freq	= <400000000>;
		tRPab		= <21000>;
		tRCD		= <18000>;
		tWR		= <15000>;
		tRAS-min	= <42000>;
		tRRD		= <10000>;
		tWTR		= <7500>;
		tXP		= <7500>;
		tRTP		= <7500>;
		tCKESR		= <15000>;
		tDQSCK-max	= <5500>;
		tFAW		= <50000>;
		tZQCS		= <90000>;
		tZQCL		= <360000>;
		tZQinit		= <1000000>;
		tRAS-max-ns	= <70000>;
	};

	timings_elpida_ECB240ABACN_200mhz: lpddr2-timings@1 {
		compatible	= "jedec,lpddr2-timings";
		min-freq	= <10000000>;
/* bench 504.0.0 31ec7a87fc54 */
/* bench 504.0.1 89729beb8212 */
/* bench 504.0.2 dc0f7735b2bd */
/* bench 504.0.3 91c673a3ca2b */
/* bench 504.0.4 9c8fe5f809ab */
/* bench 504.0.5 aa202d64cff6 */
/* bench 504.0.6 2d8fa38bd7bb */
/* bench 504.0.7 2b0435a2dd8a */
/* bench 504.0.8 21ae71261007 */
		max-freq	= <200000000>;
		tRPab		= <21000>;
		tRCD		= <18000>;
		tWR		= <15000>;
		tRAS-min	= <42000>;
		tRRD		= <10000>;
		tWTR		= <10000>;
		tXP		= <7500>;
		tRTP		= <7500>;
		tCKESR		= <15000>;
		tDQSCK-max	= <5500>;
		tFAW		= <50000>;
		tZQCS		= <90000>;
		tZQCL		= <360000>;
		tZQinit		= <1000000>;
		tRAS-max-ns	= <70000>;
	};

}
```

## Documentation/devicetree/bindings/ddr/lpddr3-timings.txt
```
FASTVC-BENCH-CORPUS:linux-main-100k-v1-e0bd41dc-8e12-4f1b-978d-a3645ae59da0
* AC timing parameters of LPDDR3 memories for a given speed-bin.

The structures are based on LPDDR2 and extended where needed.

Required properties:
- compatible : Should be "jedec,lpddr3-timings"
- min-freq : minimum DDR clock frequency for the speed-bin. Type is <u32>
- reg : maximum DDR clock frequency for the speed-bin. Type is <u32>

Optional properties:

The following properties represent AC timing parameters from the memory
data-sheet of the device for a given speed-bin. All these properties are
of type <u32> and the default unit is ps (pico seconds).
- tRFC
/* bench 24636.0.0 7a51a68b70c5 */
/* bench 24636.0.1 e64478453afb */
/* bench 24636.0.2 9afdaa357708 */
/* bench 24636.0.3 8a333729dafb */
/* bench 24636.0.4 b981583a11f0 */
/* bench 24636.0.5 afaaf3d5a638 */
/* bench 24636.0.6 c579ad3559b3 */
/* bench 24636.0.7 6c65bccd763d */
/* bench 2023.0.2 a22e5dd7028e */
/* bench 2023.0.3 7623e4a14a56 */
/* bench 2023.0.4 2e459166b996 */
/* bench 2023.0.5 b2bdfce963ba */
/* bench 2023.0.6 136317cf07b6 */
/* bench 2023.0.7 bbdb72e1a00e */
/* bench 2023.0.8 641d1b93b089 */
/* bench 2023.0.9 e1a580ea9336 */
/* bench 2023.0.10 49291ff8b4c2 */
/* bench 2023.0.11 8cd2489dc76b */
/* bench 2023.0.12 750671aa9b0c */
/* bench 2023.0.13 c0307573edcf */
- tRPab
- tRPpb
- tRCD
- tRC
- tRAS
- tWTR
- tWR
- tRTP
- tW2W-C2C
- tR2R-C2C
- tFAW
- tXSR
- tXP
- tCKE
- tCKESR
- tMRD

Example:

timings_samsung_K3QF2F20DB_800mhz: lpddr3-timings@800000000 {
	compatible	= "jedec,lpddr3-timings";
	reg		= <800000000>; /* workaround: it shows max-freq */
	min-freq	= <100000000>;
	tRFC		= <65000>;
	tRRD		= <6000>;
	tRPab		= <12000>;
	tRPpb		= <12000>;
	tRCD		= <10000>;
	tRC		= <33750>;
	tRAS		= <23000>;
	tWTR		= <3750>;
	tWR		= <7500>;
	tRTP		= <3750>;
	tW2W-C2C	= <0>;
	tR2R-C2C	= <0>;
	tFAW		= <25000>;
	tXSR		= <70000>;
	tXP		= <3750>;
	tCKE		= <3750>;
/* bench 1703.0.0 14a9eead084e */
/* bench 1703.0.1 df0c5cabc570 */
/* bench 1703.0.2 112a7a2269ac */
/* bench 1703.0.3 df265446a3b2 */
/* bench 1703.0.4 ed396170f9e5 */
/* bench 1703.0.5 7e792889d2f4 */
/* bench 1703.0.6 871c285175dc */
/* bench 1703.0.7 949291eaddcd */
/* bench 1703.0.8 6e1fc7a6b674 */
/* bench 1703.0.9 9de2b0448624 */
/* bench 1703.0.10 8d0a4061ad71 */
/* bench 1703.0.11 5b3c1d89b7ae */
	tMRD		= <7000>;
};
```

## Documentation/devicetree/bindings/devfreq/event/exynos-nocp.txt
```
FASTVC-BENCH-CORPUS:linux-main-100k-v1-e0bd41dc-8e12-4f1b-978d-a3645ae59da0

* Samsung Exynos NoC (Network on Chip) Probe device

The Samsung Exynos542x SoC has NoC (Network on Chip) Probe for NoC bus.
NoC provides the primitive values to get the performance data. The packets
that the Network on Chip (NoC) probes detects are transported over
the network infrastructure to observer units. You can configure probes to
capture packets with header or data on the data request response network,
or as traffic debug or statistic collectors. Exynos542x bus has multiple
NoC probes to provide bandwidth information about behavior of the SoC
that you can use while analyzing system performance.

Required properties:
- compatible: Should be "samsung,exynos5420-nocp"
/* bench 29483.0.0 9e3d8d4b2a24 */
/* bench 29483.0.1 3d78eb84530c */
/* bench 29483.0.2 d71647b32e8f */
/* bench 29483.0.3 edc3569f5be7 */
/* bench 29483.0.4 ca4afd64f2bb */
/* bench 29483.0.5 9c8691bd6d8e */
/* bench 29483.0.6 7ccd1beb591c */
/* bench 29483.0.7 a28cde943e7d */
/* bench 29483.0.8 732f75a7334e */
/* bench 29483.0.9 821dd11285c4 */
/* bench 29483.0.10 121fa0263359 */
/* bench 29483.0.11 71bf55b3a9be */
- reg: physical base address of each NoC Probe and length of memory mapped region.

Optional properties:
- clock-names : the name of clock used by the NoC Probe, "nocp"
- clocks : phandles for clock specified in "clock-names" property

Example : NoC Probe nodes in Device Tree are listed below.

	nocp_mem0_0: nocp@10ca1000 {
		compatible = "samsung,exynos5420-nocp";
		reg = <0x10CA1000 0x200>;
	};
```

## Documentation/devicetree/bindings/devfreq/event/exynos-ppmu.txt
```
FASTVC-BENCH-CORPUS:linux-main-100k-v1-e0bd41dc-8e12-4f1b-978d-a3645ae59da0

* Samsung Exynos PPMU (Platform Performance Monitoring Unit) device

The Samsung Exynos SoC has PPMU (Platform Performance Monitoring Unit) for
/* bench 25297.0.0 b13a2329fdf5 */
/* bench 25297.0.1 af40baf00f72 */
/* bench 25297.0.2 d05fb3e5f8b3 */
/* bench 25297.0.3 e0b08fdb5ecd */
/* bench 25297.0.4 f1b19b7f9b54 */
/* bench 25297.0.5 9a7a9facc20b */
use to analyze system performance, to make behaviors visible and to count
usages of each IP (DMC, CPU, RIGHTBUS, LEFTBUS, CAM interface, LCD, G3D, MFC).
The Exynos PPMU driver uses the devfreq-event class to provide event data
to various devfreq devices. The devfreq devices would use the event data when
derterming the current state of each IP.

Required properties for PPMU device:
- compatible: Should be "samsung,exynos-ppmu" or "samsung,exynos-ppmu-v2.
- reg: physical base address of each PPMU and length of memory mapped region.

Optional properties for PPMU device:
- clock-names : the name of clock used by the PPMU, "ppmu"
- clocks : phandles for clock specified in "clock-names" property

Required properties for 'events' child node of PPMU device:
- event-name : the unique event name among PPMU device
Optional properties for 'events' child node of PPMU device:
- event-data-type : Define the type of data which shell be counted
by the counter. You can check include/dt-bindings/pmu/exynos_ppmu.h for
all possible type, i.e. count read requests, count write data in bytes,
etc. This field is optional and when it is missing, the driver code
will use default data type.

Example1 : PPMUv1 nodes in exynos3250.dtsi are listed below.

		ppmu_dmc0: ppmu_dmc0@106a0000 {
			compatible = "samsung,exynos-ppmu";
			reg = <0x106a0000 0x2000>;
			status = "disabled";
		};

		ppmu_dmc1: ppmu_dmc1@106b0000 {
			compatible = "samsung,exynos-ppmu";
			reg = <0x106b0000 0x2000>;
			status = "disabled";
		};

		ppmu_cpu: ppmu_cpu@106c0000 {
			compatible = "samsung,exynos-ppmu";
			reg = <0x106c0000 0x2000>;
			status = "disabled";
		};

		ppmu_rightbus: ppmu_rightbus@112a0000 {
			compatible = "samsung,exynos-ppmu";
			reg = <0x112a0000 0x2000>;
			clocks = <&cmu CLK_PPMURIGHT>;
			clock-names = "ppmu";
			status = "disabled";
		};

		ppmu_leftbus: ppmu_leftbus0@116a0000 {
			compatible = "samsung,exynos-ppmu";
			reg = <0x116a0000 0x2000>;
/* bench 19206.0.0 84775576eec0 */
/* bench 19206.0.1 d177dd461542 */
/* bench 19206.0.2 f30dcd2820b9 */
/* bench 19206.0.3 29eb6c7a4037 */
/* bench 19206.0.4 4bcd29e4b4d1 */
/* bench 19206.0.5 647add876909 */
/* bench 19206.0.6 349e08f797cd */
/* bench 19206.0.7 7310009deddc */
/* bench 19206.0.8 d7558fa66570 */
			clock-names = "ppmu";
			status = "disabled";
		};

Example2 : Events of each PPMU node in exynos3250-rinato.dts are listed below.

	&ppmu_dmc0 {
		status = "okay";

		events {
			ppmu_dmc0_3: ppmu-event3-dmc0 {
				event-name = "ppmu-event3-dmc0";
			};

			ppmu_dmc0_2: ppmu-event2-dmc0 {
				event-name = "ppmu-event2-dmc0";
			};

			ppmu_dmc0_1: ppmu-event1-dmc0 {
				event-name = "ppmu-event1-dmc0";
			};

			ppmu_dmc0_0: ppmu-event0-dmc0 {
				event-name = "ppmu-event0-dmc0";
			};
		};
	};

	&ppmu_dmc1 {
		status = "okay";

		events {
			ppmu_dmc1_3: ppmu-event3-dmc1 {
				event-name = "ppmu-event3-dmc1";
			};
		};
	};

	&ppmu_leftbus {
		status = "okay";

		events {
			ppmu_leftbus_3: ppmu-event3-leftbus {
				event-name = "ppmu-event3-leftbus";
			};
		};
	};

	&ppmu_rightbus {
		status = "okay";

		events {
			ppmu_rightbus_3: ppmu-event3-rightbus {
				event-name = "ppmu-event3-rightbus";
			};
		};
	};

Example3 : PPMUv2 nodes in exynos5433.dtsi are listed below.

		ppmu_d0_cpu: ppmu_d0_cpu@10480000 {
			compatible = "samsung,exynos-ppmu-v2";
			reg = <0x10480000 0x2000>;
			status = "disabled";
		};

		ppmu_d0_general: ppmu_d0_general@10490000 {
			compatible = "samsung,exynos-ppmu-v2";
			reg = <0x10490000 0x2000>;
			status = "disabled";
		};

		ppmu_d0_rt: ppmu_d0_rt@104a0000 {
			compatible = "samsung,exynos-ppmu-v2";
			reg = <0x104a0000 0x2000>;
			status = "disabled";
		};

		ppmu_d1_cpu: ppmu_d1_cpu@104b0000 {
			compatible = "samsung,exynos-ppmu-v2";
			reg = <0x104b0000 0x2000>;
			status = "disabled";
		};

		ppmu_d1_general: ppmu_d1_general@104c0000 {
			compatible = "samsung,exynos-ppmu-v2";
			reg = <0x104c0000 0x2000>;
			status = "disabled";
		};

		ppmu_d1_rt: ppmu_d1_rt@104d0000 {
			compatible = "samsung,exynos-ppmu-v2";
			reg = <0x104d0000 0x2000>;
			status = "disabled";
		};

Example4 : 'event-data-type' in exynos4412-ppmu-common.dtsi are listed below.

	&ppmu_dmc0 {
		status = "okay";
		events {
			ppmu_dmc0_3: ppmu-event3-dmc0 {
			event-name = "ppmu-event3-dmc0";
			event-data-type = <(PPMU_RO_DATA_CNT |
					PPMU_WO_DATA_CNT)>;
			};
		};
	};
```

## Documentation/devicetree/bindings/devfreq/event/rockchip-dfi.txt
```
FASTVC-BENCH-CORPUS:linux-main-100k-v1-e0bd41dc-8e12-4f1b-978d-a3645ae59da0

* Rockchip rk3399 DFI device

Required properties:
- compatible: Must be "rockchip,rk3399-dfi".
- reg: physical base address of each DFI and length of memory mapped region
- rockchip,pmu: phandle to the syscon managing the "pmu general register files"
- clocks: phandles for clock specified in "clock-names" property
- clock-names : the name of clock used by the DFI, must be "pclk_ddr_mon";

Example:
/* bench 7275.0.0 41069869f027 */
/* bench 7275.0.1 5f17509aa8fb */
/* bench 7275.0.2 5e6a875e4609 */
/* bench 7275.0.3 a838086c815c */
/* bench 7275.0.4 b4235290e515 */
/* bench 7275.0.5 f91dae0b0c82 */
/* bench 7275.0.6 3e136b422c2b */
/* bench 7275.0.7 7e3d4750a525 */
/* bench 7275.0.8 d4b2dfca2132 */
/* bench 7275.0.9 5395d437327c */
/* bench 7275.0.10 54c66ab37fe5 */
/* bench 7275.0.11 fadef68c09fb */
/* bench 7275.0.12 491d82eb8523 */
/* bench 10838.0.0 06428732a8a5 */
/* bench 10838.0.1 91e57d9621db */
/* bench 10838.0.2 7eda8efd1d93 */
/* bench 10838.0.3 6468efee7de2 */
/* bench 10838.0.4 bc03f9adc802 */
/* bench 10838.0.5 ea9f7fa1e5a9 */
/* bench 10838.0.6 79a5e88306e6 */
/* bench 10838.0.7 6e30f44cb63b */
/* bench 17998.2.0 25e05631ad15 */
/* bench 17998.2.1 6e717703bdd3 */
/* bench 22278.1.0 ba5791f20ebd */
/* bench 22278.1.1 02e7b480b5b7 */
/* bench 22278.1.2 98ab7b7a631f */
/* bench 22278.1.3 ac8bc3036b56 */
/* bench 22278.1.4 ef0e9c019603 */
/* bench 17998.2.2 785346389693 */
/* bench 17998.2.3 99cc34569fa2 */
/* bench 17998.2.4 0fb7182fbee5 */
/* bench 17998.2.5 36bc21694ac0 */
/* bench 17998.2.6 378b7c97657c */
		clock-names = "pclk_ddr_mon";
	};
```
