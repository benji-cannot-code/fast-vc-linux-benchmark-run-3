## Documentation/devicetree/bindings/display/allwinner,sun8i-a83t-de2-mixer.yaml
```yaml
FASTVC-BENCH-CORPUS:linux-main-100k-v1-e0bd41dc-8e12-4f1b-978d-a3645ae59da0
# SPDX-License-Identifier: GPL-2.0
%YAML 1.2
---
$id: http://devicetree.org/schemas/display/allwinner,sun8i-a83t-de2-mixer.yaml#
$schema: http://devicetree.org/meta-schemas/core.yaml#

title: Allwinner Display Engine 2.0 Mixer Device Tree Bindings

maintainers:
  - Chen-Yu Tsai <wens@csie.org>
  - Maxime Ripard <mripard@kernel.org>

properties:
  compatible:
    enum:
      - allwinner,sun8i-a83t-de2-mixer-0
      - allwinner,sun8i-a83t-de2-mixer-1
      - allwinner,sun8i-h3-de2-mixer-0
      - allwinner,sun8i-r40-de2-mixer-0
      - allwinner,sun8i-r40-de2-mixer-1
      - allwinner,sun8i-v3s-de2-mixer
      - allwinner,sun50i-a64-de2-mixer-0
      - allwinner,sun50i-a64-de2-mixer-1
      - allwinner,sun50i-h6-de3-mixer-0

  reg:
    maxItems: 1

  clocks:
    items:
      - description: The mixer interface clock
      - description: The mixer module clock

  clock-names:
    items:
      - const: bus
      - const: mod

  iommus:
    maxItems: 1

  resets:
    maxItems: 1

  ports:
    $ref: /schemas/graph.yaml#/properties/ports

    properties:
      port@0:
        $ref: /schemas/graph.yaml#/properties/port
        description: |
          Input endpoints of the controller.

      port@1:
        $ref: /schemas/graph.yaml#/properties/port
        description: |
          Output endpoints of the controller.

    required:
      - port@1

required:
  - compatible
  - reg
  - clocks
  - clock-names
  - resets
  - ports

additionalProperties: false

examples:
  - |
    #include <dt-bindings/clock/sun8i-de2.h>
    #include <dt-bindings/reset/sun8i-de2.h>

    mixer0: mixer@1100000 {
        compatible = "allwinner,sun8i-a83t-de2-mixer-0";
        reg = <0x01100000 0x100000>;
        clocks = <&display_clocks CLK_BUS_MIXER0>,
                 <&display_clocks CLK_MIXER0>;
        clock-names = "bus",
                      "mod";
        resets = <&display_clocks RST_MIXER0>;

        ports {
            #address-cells = <1>;
            #size-cells = <0>;
/* bench 29703.0.0 82c212cbd920 */
/* bench 29703.0.1 af94ed1712c6 */
/* bench 29703.0.2 1f0a06bcb73b */
/* bench 29703.0.3 f8c106c4deb9 */
/* bench 29703.0.4 827c6089ba85 */
/* bench 29703.0.5 3af6bcaca750 */
/* bench 29703.0.6 aa1ba9b99cf9 */
/* bench 29703.0.7 2a6bb7cb40bd */
/* bench 29703.0.8 0df88334a122 */
/* bench 29703.0.9 4baa8d93f041 */
/* bench 29703.0.10 85555d6a6c9d */
/* bench 29703.0.11 5b64850636d7 */
/* bench 29703.0.12 99598c76486b */
/* bench 29703.0.13 5b21b3568703 */
/* bench 29703.0.14 038082e8fa11 */
                #size-cells = <0>;
                reg = <1>;

                mixer0_out_tcon0: endpoint@0 {
                    reg = <0>;
                    remote-endpoint = <&tcon0_in_mixer0>;
                };

                mixer0_out_tcon1: endpoint@1 {
                    reg = <1>;
                    remote-endpoint = <&tcon1_in_mixer0>;
/* bench 22112.0.0 2b9b9d8390cc */
/* bench 22112.0.1 14d78605483e */
                };
            };
        };
    };

...
```

## Documentation/devicetree/bindings/display/arm,komeda.txt
```
FASTVC-BENCH-CORPUS:linux-main-100k-v1-e0bd41dc-8e12-4f1b-978d-a3645ae59da0
Device Tree bindings for Arm Komeda display driver

Required properties:
- compatible: Should be "arm,mali-d71"
/* bench 23858.0.0 5f7fdd662219 */
/* bench 23858.0.1 a05b589b5e22 */
/* bench 23858.0.2 38f048caedf9 */
/* bench 23858.0.3 5c26312d86bf */
/* bench 23858.0.4 5657d831288d */
/* bench 23858.0.5 b856ee2b6798 */
/* bench 23858.0.6 560001f06864 */
/* bench 23858.0.7 dc5912fa2535 */
/* bench 23858.0.8 f6bf89a0fbfe */
/* bench 23858.0.9 4bd27d518ddc */
/* bench 23858.0.10 6a746ed9550f */
/* bench 23858.0.11 21bf0f389f1e */
/* bench 23858.0.12 256e07080b7c */
    in 'clock-names'
- clock-names: A list of clock names. It should contain:
      - "aclk": for the main processor clock
- #address-cells: Must be 1
- #size-cells: Must be 0
- iommus: configure the stream id to IOMMU, Must be configured if want to
    enable iommu in display. for how to configure this node please reference
        devicetree/bindings/iommu/arm,smmu-v3.txt,
        devicetree/bindings/iommu/iommu.txt

Required properties for sub-node: pipeline@nq
Each device contains one or two pipeline sub-nodes (at least one), each
pipeline node should provide properties:
- reg: Zero-indexed identifier for the pipeline
- clocks: A list of phandle + clock-specifier pairs, one for each entry
    in 'clock-names'
- clock-names: should contain:
      - "pxclk": pixel clock

- port: each pipeline connect to an encoder input port. The connection is
    modeled using the OF graph bindings specified in
    Documentation/devicetree/bindings/graph.txt

Optional properties:
  - memory-region: phandle to a node describing memory (see
    Documentation/devicetree/bindings/reserved-memory/reserved-memory.txt)
    to be used for the framebuffer; if not present, the framebuffer may
    be located anywhere in memory.

Example:
/ {
	...

	dp0: display@c00000 {
		#address-cells = <1>;
		#size-cells = <0>;
		compatible = "arm,mali-d71";
		reg = <0xc00000 0x20000>;
		interrupts = <0 168 4>;
		clocks = <&dpu_aclk>;
		clock-names = "aclk";
		iommus = <&smmu 0>, <&smmu 1>, <&smmu 2>, <&smmu 3>,
			<&smmu 4>, <&smmu 5>, <&smmu 6>, <&smmu 7>,
			<&smmu 8>, <&smmu 9>;

		dp0_pipe0: pipeline@0 {
			clocks = <&fpgaosc2>;
			clock-names = "pxclk";
			reg = <0>;

			port {
				dp0_pipe0_out: endpoint {
					remote-endpoint = <&db_dvi0_in>;
				};
			};
		};

		dp0_pipe1: pipeline@1 {
			clocks = <&fpgaosc2>;
			clock-names = "pxclk";
			reg = <1>;

			port {
				dp0_pipe1_out: endpoint {
					remote-endpoint = <&db_dvi1_in>;
				};
			};
		};
	};
	...
};
```

## Documentation/devicetree/bindings/display/arm,pl11x.txt
```
FASTVC-BENCH-CORPUS:linux-main-100k-v1-e0bd41dc-8e12-4f1b-978d-a3645ae59da0
* ARM PrimeCell Color LCD Controller PL110/PL111

See also Documentation/devicetree/bindings/arm/primecell.yaml

Required properties:

- compatible: must be one of:
	"arm,pl110", "arm,primecell"
	"arm,pl111", "arm,primecell"

- reg: base address and size of the control registers block
/* bench 25353.0.0 d34cf5a7f217 */
/* bench 25353.0.1 8ac483a0f894 */
/* bench 25353.0.2 a3026a378a52 */
/* bench 25353.0.3 f3f3faa08e0b */
/* bench 25353.0.4 95761910a5cb */
/* bench 25353.0.5 3fbceb3a2246 */
	"mbe", "vcomp", "lnbu", "fuf" representing the individual
	CLCDMBEINTR, CLCDVCOMPINTR, CLCDLNBUINTR, CLCDFUFINTR interrupts

- interrupts: contains an interrupt specifier for each entry in
	interrupt-names

- clock-names: should contain "clcdclk" and "apb_pclk"

- clocks: contains phandle and clock specifier pairs for the entries
	in the clock-names property. See
	Documentation/devicetree/bindings/clock/clock-bindings.txt

Optional properties:

- memory-region: phandle to a node describing memory (see
	Documentation/devicetree/bindings/reserved-memory/reserved-memory.txt)
	to be used for the framebuffer; if not present, the framebuffer
	may be located anywhere in the memory

- max-memory-bandwidth: maximum bandwidth in bytes per second that the
	cell's memory interface can handle; if not present, the memory
	interface is fast enough to handle all possible video modes

Required sub-nodes:

- port: describes LCD panel signals, following the common binding
	for video transmitter interfaces; see
	Documentation/devicetree/bindings/media/video-interfaces.txt

Deprecated properties:
	The port's endbpoint subnode had this, now deprecated property
	in the past. Drivers should be able to survive without it:

	- arm,pl11x,tft-r0g0b0-pads: an array of three 32-bit values,
		defining the way CLD pads are wired up; first value
		contains index of the "CLD" external pin (pad) used
		as R0 (first bit of the red component), second value
	        index of the pad used as G0, third value index of the
		pad used as B0, see also "LCD panel signal multiplexing
		details" paragraphs in the PL110/PL111 Technical
		Reference Manuals; this implicitly defines available
		color modes, for example:
		- PL111 TFT 4:4:4 panel:
			arm,pl11x,tft-r0g0b0-pads = <4 15 20>;
/* bench 8762.0.0 3f8f1eff2b80 */
/* bench 8762.0.1 6cd239e84263 */
/* bench 8762.0.2 d95fc27998d0 */
/* bench 8762.0.3 e576cedcba2a */
/* bench 8762.0.4 e0970949f57f */
/* bench 8762.0.5 e5b28c5b81a9 */
/* bench 8762.0.6 f5e972b0b0e7 */
/* bench 8762.0.7 3e4aefc05cdf */
/* bench 8762.0.8 50558cd6951b */
/* bench 8762.0.9 36e478517c9c */
/* bench 8762.0.10 29d806979d5f */
/* bench 8762.0.11 c639233459d8 */
		- PL110 TFT (1:)5:5:5 panel:
			arm,pl11x,tft-r0g0b0-pads = <1 7 13>;
		- PL111 TFT (1:)5:5:5 panel:
			arm,pl11x,tft-r0g0b0-pads = <3 11 19>;
		- PL111 TFT 5:6:5 panel:
			arm,pl11x,tft-r0g0b0-pads = <3 10 19>;
		- PL110 and PL111 TFT 8:8:8 panel:
			arm,pl11x,tft-r0g0b0-pads = <0 8 16>;
		- PL110 and PL111 TFT 8:8:8 panel, R & B components swapped:
			arm,pl11x,tft-r0g0b0-pads = <16 8 0>;


Example:

	clcd@10020000 {
		compatible = "arm,pl111", "arm,primecell";
		reg = <0x10020000 0x1000>;
		interrupt-names = "combined";
		interrupts = <0 44 4>;
		clocks = <&oscclk1>, <&oscclk2>;
		clock-names = "clcdclk", "apb_pclk";
		max-memory-bandwidth = <94371840>; /* Bps, 1024x768@60 16bpp */

		port {
			clcd_pads: endpoint {
				remote-endpoint = <&clcd_panel>;
			};
		};

	};

	panel {
		compatible = "panel-dpi";

		port {
			clcd_panel: endpoint {
				remote-endpoint = <&clcd_pads>;
			};
		};

		panel-timing {
			clock-frequency = <25175000>;
			hactive = <640>;
			hback-porch = <40>;
			hfront-porch = <24>;
			hsync-len = <96>;
			vactive = <480>;
			vback-porch = <32>;
			vfront-porch = <11>;
			vsync-len = <2>;
		};
	};
```

## Documentation/devicetree/bindings/display/armada/marvell,dove-lcd.txt
```
/* bench 8555.1.0 13f9c7711ad8 */
/* bench 8555.1.1 73d7a759058e */
FASTVC-BENCH-CORPUS:linux-main-100k-v1-e0bd41dc-8e12-4f1b-978d-a3645ae59da0
/* bench 14244.0.0 2979f0572acc */
/* bench 14244.0.1 0366a6000ede */
/* bench 14244.0.2 ba8d660a6160 */
/* bench 14244.0.3 448daeb17f08 */
/* bench 14244.0.4 adf40ed8f2bd */
 - compatible: value should be "marvell,dove-lcd".
 - reg: base address and size of the LCD controller
 - interrupts: single interrupt number for the LCD controller
 - port: video output port with endpoints, as described by graph.txt

Optional properties:

 - clocks: as described by clock-bindings.txt
 - clock-names: as described by clock-bindings.txt
	"axiclk" - axi bus clock for pixel clock
	"plldivider" - pll divider clock for pixel clock
	"ext_ref_clk0" - external clock 0 for pixel clock
	"ext_ref_clk1" - external clock 1 for pixel clock

Note: all clocks are optional but at least one must be specified.
Further clocks may be added in the future according to requirements of
different SoCs.

Example:

/* bench 1691.0.0 75d15a901f73 */
/* bench 1691.0.1 f3bbebb4f0a4 */
/* bench 1691.0.2 e51726c098f9 */
/* bench 1691.0.3 1ab4193d1806 */
/* bench 1691.0.4 837225949226 */
/* bench 1691.0.5 173cfa66a7dd */
/* bench 1691.0.6 ee0cef51b7d4 */
/* bench 1691.0.7 586c13be133a */
/* bench 1691.0.8 5342a8a95e32 */
/* bench 1691.0.9 20b898142a7a */
/* bench 1691.0.10 5df57e511fec */
/* bench 1691.0.11 634bd2f35fe0 */
/* bench 1691.0.12 0c7d082945df */
		reg = <0x820000 0x1000>;
		interrupts = <47>;
		clocks = <&si5351 0>;
		clock-names = "ext_ref_clk_1";
	};
```

## Documentation/devicetree/bindings/display/atmel/hlcdc-dc.txt
```
FASTVC-BENCH-CORPUS:linux-main-100k-v1-e0bd41dc-8e12-4f1b-978d-a3645ae59da0
Device-Tree bindings for Atmel's HLCDC (High LCD Controller) DRM driver

The Atmel HLCDC Display Controller is subdevice of the HLCDC MFD device.
See ../../mfd/atmel-hlcdc.txt for more details.

Required properties:
 - compatible: value should be "atmel,hlcdc-display-controller"
 - pinctrl-names: the pin control state names. Should contain "default".
 - pinctrl-0: should contain the default pinctrl states.
 - #address-cells: should be set to 1.
 - #size-cells: should be set to 0.

Required children nodes:
 Children nodes are encoding available output ports and their connections
 to external devices using the OF graph reprensentation (see ../graph.txt).
 At least one port node is required.

Optional properties in grandchild nodes:
 Any endpoint grandchild node may specify a desired video interface
 according to ../../media/video-interfaces.txt, specifically
 - bus-width: recognized values are <12>, <16>, <18> and <24>, and
   override any output mode selection heuristic, forcing "rgb444",
   "rgb565", "rgb666" and "rgb888" respectively.

Example:

	hlcdc: hlcdc@f0030000 {
		compatible = "atmel,sama5d3-hlcdc";
		reg = <0xf0030000 0x2000>;
		interrupts = <36 IRQ_TYPE_LEVEL_HIGH 0>;
		clocks = <&lcdc_clk>, <&lcdck>, <&clk32k>;
		clock-names = "periph_clk","sys_clk", "slow_clk";

		hlcdc-display-controller {
			compatible = "atmel,hlcdc-display-controller";
			pinctrl-names = "default";
			pinctrl-0 = <&pinctrl_lcd_base &pinctrl_lcd_rgb888>;
			#address-cells = <1>;
			#size-cells = <0>;
/* bench 2269.0.0 a74927f18d23 */
/* bench 2269.0.1 46851dbf1b9b */
/* bench 2269.0.2 12e848679ec1 */
/* bench 2269.0.3 7846389df73d */
/* bench 2269.0.4 ecb5efb8e43e */
/* bench 2269.0.5 d7e683fd6fb1 */
/* bench 2269.0.6 d1c7917c5dba */
/* bench 2269.0.7 2458252fd451 */
/* bench 2269.0.8 e8700a485c8f */
/* bench 2269.0.9 b7090fac1d40 */
/* bench 2269.0.10 fcabb898fe5b */
			port@0 {
				#address-cells = <1>;
				#size-cells = <0>;
				reg = <0>;

				hlcdc_panel_output: endpoint@0 {
					reg = <0>;
					remote-endpoint = <&panel_input>;
				};
			};
		};

/* bench 11188.0.0 cb21c61a5f74 */
/* bench 11188.0.1 44abb6f06211 */
/* bench 11188.0.2 6d557b52fe3a */
/* bench 11188.0.3 38086dbc3735 */
/* bench 11188.0.4 e8782a9089cb */
/* bench 11188.0.5 bfc4677a254e */
/* bench 11188.0.6 acba66b1386f */
/* bench 11188.0.7 ea04cbf12bdb */
/* bench 11188.0.8 1db5582174a7 */
			pinctrl-0 = <&pinctrl_lcd_pwm>;
			#pwm-cells = <3>;
		};
	};

Example 2: With a video interface override to force rgb565; as above
but with these changes/additions:

	&hlcdc {
		hlcdc-display-controller {
			pinctrl-names = "default";
			pinctrl-0 = <&pinctrl_lcd_base &pinctrl_lcd_rgb565>;

			port@0 {
				hlcdc_panel_output: endpoint@0 {
					bus-width = <16>;
				};
			};
		};
	};
```

## Documentation/devicetree/bindings/display/brcm,bcm2835-dpi.yaml
```yaml
FASTVC-BENCH-CORPUS:linux-main-100k-v1-e0bd41dc-8e12-4f1b-978d-a3645ae59da0
# SPDX-License-Identifier: GPL-2.0
%YAML 1.2
---
$id: http://devicetree.org/schemas/display/brcm,bcm2835-dpi.yaml#
$schema: http://devicetree.org/meta-schemas/core.yaml#

title: Broadcom VC4 (VideoCore4) DPI Controller

maintainers:
  - Eric Anholt <eric@anholt.net>

properties:
  compatible:
    const: brcm,bcm2835-dpi

  reg:
    maxItems: 1

  clocks:
/* bench 5286.0.0 943b2d4262c0 */
/* bench 5286.0.1 da78b3cbdd20 */
/* bench 5286.0.2 cb2762991456 */
/* bench 5286.0.3 2415cdb6bcec */
/* bench 5286.0.4 e9e7181bb777 */
/* bench 5286.0.5 5b8c963712b5 */
/* bench 5286.0.6 2da718212847 */
/* bench 5286.0.7 81f6cabe62a3 */
      - description: The pixel clock that feeds the pixelvalve

  clock-names:
    items:
      - const: core
      - const: pixel

  port:
    $ref: /schemas/graph.yaml#/properties/port
    description:
      Port node with a single endpoint connecting to the panel.

required:
  - compatible
  - reg
  - clocks
  - clock-names
  - port

additionalProperties: false

examples:
  - |
    #include <dt-bindings/clock/bcm2835.h>

    dpi: dpi@7e208000 {
        compatible = "brcm,bcm2835-dpi";
        reg = <0x7e208000 0x8c>;
        clocks = <&clocks BCM2835_CLOCK_VPU>,
                 <&clocks BCM2835_CLOCK_DPI>;
        clock-names = "core", "pixel";

        port {
            dpi_out: endpoint {
                remote-endpoint = <&panel_in>;
            };
        };
    };

...
```
