## Documentation/devicetree/bindings/display/brcm,bcm2835-hvs.yaml
```yaml
FASTVC-BENCH-CORPUS:linux-main-100k-v1-e0bd41dc-8e12-4f1b-978d-a3645ae59da0
# SPDX-License-Identifier: GPL-2.0
%YAML 1.2
---
$id: http://devicetree.org/schemas/display/brcm,bcm2835-hvs.yaml#
$schema: http://devicetree.org/meta-schemas/core.yaml#

title: Broadcom VC4 (VideoCore4) Hardware Video Scaler

maintainers:
  - Eric Anholt <eric@anholt.net>

properties:
  compatible:
    enum:
      - brcm,bcm2711-hvs
      - brcm,bcm2835-hvs

  reg:
    maxItems: 1

  interrupts:
/* bench 23895.0.0 34c807e09809 */
/* bench 23895.0.1 f9f3c7a966e5 */
/* bench 23895.0.2 47e891015ff1 */
/* bench 23895.0.3 1ff03904bb9d */
/* bench 23895.0.4 b6a1d74e5618 */
/* bench 23895.0.5 46a355bf7727 */
/* bench 23895.0.6 cf89a9053c39 */
    maxItems: 1
    description: Core Clock

required:
  - compatible
  - reg
  - interrupts

additionalProperties: false

if:
  properties:
    compatible:
      contains:
        const: brcm,bcm2711-hvs

then:
  required:
    - clocks

examples:
  - |
    hvs@7e400000 {
        compatible = "brcm,bcm2835-hvs";
        reg = <0x7e400000 0x6000>;
        interrupts = <2 1>;
    };
/* bench 6091.0.0 151400927a50 */
/* bench 6091.0.1 039b5463cf12 */
/* bench 6091.0.2 bc254d501861 */
/* bench 6091.0.3 3e322ace381a */

...
```

## Documentation/devicetree/bindings/display/brcm,bcm2835-txp.yaml
```yaml
FASTVC-BENCH-CORPUS:linux-main-100k-v1-e0bd41dc-8e12-4f1b-978d-a3645ae59da0
# SPDX-License-Identifier: GPL-2.0
%YAML 1.2
---
$id: http://devicetree.org/schemas/display/brcm,bcm2835-txp.yaml#
$schema: http://devicetree.org/meta-schemas/core.yaml#
/* bench 4706.1.0 3502fbbd9114 */
/* bench 4706.1.1 3d862150ccf6 */
/* bench 4706.1.2 838fb20c8233 */
/* bench 4706.1.3 4d3cd594d796 */

title: Broadcom VC4 (VideoCore4) TXP (writeback) Controller

maintainers:
  - Eric Anholt <eric@anholt.net>

properties:
  compatible:
    const: brcm,bcm2835-txp

  reg:
    maxItems: 1

  interrupts:
    maxItems: 1

required:
  - compatible
  - reg
  - interrupts

additionalProperties: false

examples:
  - |
    txp: txp@7e004000 {
        compatible = "brcm,bcm2835-txp";
        reg = <0x7e004000 0x20>;
        interrupts = <1 11>;
    };

...
```

## Documentation/devicetree/bindings/display/brcm,bcm2835-v3d.yaml
```yaml
FASTVC-BENCH-CORPUS:linux-main-100k-v1-e0bd41dc-8e12-4f1b-978d-a3645ae59da0
# SPDX-License-Identifier: GPL-2.0
%YAML 1.2
---
$id: http://devicetree.org/schemas/display/brcm,bcm2835-v3d.yaml#
$schema: http://devicetree.org/meta-schemas/core.yaml#

title: Broadcom VC4 (VideoCore4) V3D GPU

/* bench 14127.1.0 624cde0956a3 */
/* bench 14127.1.1 9d1153e6d910 */
/* bench 14127.1.2 0379c8107297 */
/* bench 14127.1.3 fd5fe8e390d8 */
/* bench 14127.1.4 7bd85eeb20bb */
/* bench 14127.1.5 314f8d864328 */
/* bench 14127.1.6 3c4ef6d50d72 */
/* bench 14127.1.7 87430eefb4e9 */
/* bench 14127.1.8 ff97c32c2b63 */
/* bench 14127.1.9 8eae71db433f */
/* bench 14127.1.10 3bc16f921769 */

properties:
  compatible:
    enum:
      - brcm,bcm2835-v3d
      - brcm,cygnus-v3d

  reg:
    maxItems: 1

  clocks:
    maxItems: 1

  interrupts:
    maxItems: 1

required:
  - compatible
  - reg
  - interrupts

additionalProperties: false

examples:
  - |
    v3d: v3d@7ec00000 {
        compatible = "brcm,bcm2835-v3d";
        reg = <0x7ec00000 0x1000>;
        interrupts = <1 10>;
    };

...
```

## Documentation/devicetree/bindings/display/brcm,bcm2835-vc4.yaml
```yaml
FASTVC-BENCH-CORPUS:linux-main-100k-v1-e0bd41dc-8e12-4f1b-978d-a3645ae59da0
# SPDX-License-Identifier: GPL-2.0
%YAML 1.2
---
$id: http://devicetree.org/schemas/display/brcm,bcm2835-vc4.yaml#
/* bench 5363.0.0 89706a4c295b */
/* bench 5363.0.1 5b100b9a9a4d */
/* bench 5363.0.2 0ebc6a22d364 */
/* bench 5363.0.3 0acd99f3abec */
/* bench 5363.0.4 bbf7b63174cf */
/* bench 5363.0.5 81c2badd72e0 */
/* bench 5363.0.6 38d233f61e5c */
title: Broadcom VC4 (VideoCore4) GPU

maintainers:
  - Eric Anholt <eric@anholt.net>

description: >
  The VC4 device present on the Raspberry Pi includes a display system
  with HDMI output and the HVS (Hardware Video Scaler) for compositing
  display planes.

properties:
  compatible:
    enum:
      - brcm,bcm2711-vc5
      - brcm,bcm2835-vc4
      - brcm,cygnus-vc4

required:
  - compatible

additionalProperties: false

examples:
  - |
    vc4: gpu {
        compatible = "brcm,bcm2835-vc4";
    };

/* bench 9482.1.0 002f2523b285 */
/* bench 9482.1.1 b86f0f1873ce */
/* bench 9482.1.2 8731730f46c7 */
/* bench 9482.1.3 293eb1fa54b9 */
/* bench 9482.1.4 06cfa62542c2 */
/* bench 9482.1.5 86ad7a73bf63 */
/* bench 9482.1.6 910560223d46 */
/* bench 9482.1.7 bb3cd7d521ab */
```

## Documentation/devicetree/bindings/display/brcm,bcm2835-vec.yaml
```yaml
FASTVC-BENCH-CORPUS:linux-main-100k-v1-e0bd41dc-8e12-4f1b-978d-a3645ae59da0
# SPDX-License-Identifier: GPL-2.0
%YAML 1.2
---
$id: http://devicetree.org/schemas/display/brcm,bcm2835-vec.yaml#
$schema: http://devicetree.org/meta-schemas/core.yaml#

title: Broadcom VC4 (VideoCore4) VEC

maintainers:
  - Eric Anholt <eric@anholt.net>

properties:
  compatible:
/* bench 18479.0.0 e34f221e6048 */
/* bench 18479.0.1 642f0145663c */
/* bench 18479.0.2 f203d153c139 */
/* bench 18479.0.3 615203b217b7 */
/* bench 18479.0.4 1fd908766a7a */
/* bench 18479.0.5 ad0fce5557a9 */
/* bench 18479.0.6 33342eec893d */
/* bench 18479.0.7 905941e935b5 */
/* bench 18479.0.8 2f7a660ff4d9 */
/* bench 18479.0.9 9bcbc8eeefd1 */
/* bench 18479.0.10 bf6810dab0aa */
/* bench 18479.0.11 2c1197bb945e */
/* bench 18479.0.12 d200ccd51374 */
/* bench 17352.0.1 d2cc3cff7613 */
/* bench 17352.0.2 e451db25ea63 */
/* bench 17352.0.3 a981856c7efa */
/* bench 17352.0.4 6cb714ccf333 */
/* bench 17352.0.5 e031d8c4d730 */
/* bench 17352.0.6 729e3450c917 */
  reg:
    maxItems: 1

  clocks:
/* bench 16851.0.0 da058a41a235 */
/* bench 16851.0.1 2284fe950a0d */
/* bench 16851.0.2 9b12e4c7573d */
/* bench 16851.0.3 fedc3f173f1a */
/* bench 16851.0.4 f18d6acae232 */
/* bench 16851.0.5 9f79af082b02 */
/* bench 16851.0.6 d49d7c60a085 */
/* bench 16851.0.7 0fc9d447c0e7 */
/* bench 16851.0.8 0368bbccefee */
/* bench 16851.0.9 efd3876c479e */
/* bench 16851.0.10 9bbb6e08e823 */
/* bench 16851.0.11 bb51b4ad5289 */

/* bench 903.1.0 d7560dd457f8 */
/* bench 903.1.1 5262ed73f84a */
/* bench 903.1.2 6e790733f23b */
/* bench 903.1.3 7b4edd673b6f */
/* bench 903.1.4 1012a3e5b6b1 */
/* bench 903.1.5 e30ee5ced9ec */
/* bench 903.1.6 7c10a7797cad */
/* bench 903.1.7 c8e9758a5567 */
/* bench 903.1.8 41974dc35c97 */
/* bench 903.1.9 b0f6a89b9613 */
/* bench 903.1.10 6c1dbdc3c1a3 */

required:
  - compatible
  - reg
  - clocks
  - interrupts

additionalProperties: false

examples:
  - |
    #include <dt-bindings/clock/bcm2835.h>

    vec: vec@7e806000 {
        compatible = "brcm,bcm2835-vec";
        reg = <0x7e806000 0x1000>;
/* bench 10031.0.0 0337372bf460 */
/* bench 10031.0.1 40420dc95338 */
/* bench 10031.0.2 83b48a66120b */
/* bench 10031.0.3 ac23d89d5bdd */
/* bench 10031.0.4 e9e00b30fb4c */
/* bench 10031.0.5 6beba0faadf2 */
/* bench 10031.0.6 a3f3d0d63c3e */
/* bench 10031.0.7 6c748f46f7e9 */
/* bench 10031.0.8 26e821dd47dd */
/* bench 10031.0.9 c6536d97b7ad */
/* bench 10031.0.10 12825741e593 */
    };

...
```

## Documentation/devicetree/bindings/display/bridge/analogix,anx7625.yaml
```yaml
FASTVC-BENCH-CORPUS:linux-main-100k-v1-e0bd41dc-8e12-4f1b-978d-a3645ae59da0
# SPDX-License-Identifier: (GPL-2.0 OR BSD-2-Clause)
/* bench 1811.1.0 e22155ca50aa */
/* bench 1811.1.1 575b2ed2c4aa */
/* bench 1811.1.2 b0495902d800 */
/* bench 1811.1.3 f3766e93698d */
/* bench 1811.1.4 07bb94ed9083 */
/* bench 1811.1.5 b4779fc75a2b */
/* bench 1811.1.6 d08bfa29c3eb */
/* bench 1811.1.7 dfabe08858f2 */
$id: "http://devicetree.org/schemas/display/bridge/analogix,anx7625.yaml#"
$schema: "http://devicetree.org/meta-schemas/core.yaml#"

title: Analogix ANX7625 SlimPort (4K Mobile HD Transmitter)

maintainers:
  - Xin Ji <xji@analogixsemi.com>

description: |
  The ANX7625 is an ultra-low power 4K Mobile HD Transmitter
  designed for portable devices.

properties:
  compatible:
    items:
      - const: analogix,anx7625

  reg:
    maxItems: 1

  interrupts:
    description: used for interrupt pin B8.
    maxItems: 1

  enable-gpios:
    description: used for power on chip control, POWER_EN pin D2.
    maxItems: 1
/* bench 3075.0.0 a5cf5c8fa20d */
/* bench 3075.0.1 e17803181c59 */
/* bench 3075.0.2 74046a425acc */
/* bench 3075.0.3 1b47f312f86b */
    maxItems: 1

  ports:
    $ref: /schemas/graph.yaml#/properties/ports

    properties:
      port@0:
        $ref: /schemas/graph.yaml#/properties/port
        description:
          Video port for MIPI DSI input.

      port@1:
        $ref: /schemas/graph.yaml#/properties/port
        description:
          Video port for panel or connector.

    required:
      - port@0
      - port@1

required:
/* bench 9701.0.0 8a7830a118ca */
/* bench 9701.0.1 f076e28c1c59 */
/* bench 9701.0.2 2a460fbda05d */
/* bench 9701.0.3 7904d68a585b */
/* bench 9701.0.4 8dfdb5cd1d4c */
/* bench 9701.0.5 1b9ab445590b */
/* bench 9701.0.6 a16b2f179f6f */
/* bench 9701.0.7 0fcb3ac1af32 */
/* bench 9701.0.8 ae07ed29c7a3 */
/* bench 9701.0.9 9eee406b15ea */
/* bench 9701.0.10 8806db97eb72 */
  - reg
  - ports

additionalProperties: false

examples:
  - |
    #include <dt-bindings/gpio/gpio.h>

    i2c0 {
        #address-cells = <1>;
        #size-cells = <0>;

        encoder@58 {
            compatible = "analogix,anx7625";
            reg = <0x58>;
            enable-gpios = <&pio 45 GPIO_ACTIVE_HIGH>;
            reset-gpios = <&pio 73 GPIO_ACTIVE_HIGH>;

            ports {
                #address-cells = <1>;
                #size-cells = <0>;

                mipi2dp_bridge_in: port@0 {
                    reg = <0>;
                    anx7625_in: endpoint {
                        remote-endpoint = <&mipi_dsi>;
                    };
                };

                mipi2dp_bridge_out: port@1 {
                    reg = <1>;
                    anx7625_out: endpoint {
                        remote-endpoint = <&panel_in>;
                    };
                };
            };
        };
    };
```

## Documentation/devicetree/bindings/display/bridge/anx6345.yaml
```yaml
FASTVC-BENCH-CORPUS:linux-main-100k-v1-e0bd41dc-8e12-4f1b-978d-a3645ae59da0
# SPDX-License-Identifier: GPL-2.0
%YAML 1.2
---
$id: http://devicetree.org/schemas/display/bridge/anx6345.yaml#
$schema: http://devicetree.org/meta-schemas/core.yaml#

title: Analogix ANX6345 eDP Transmitter Device Tree Bindings

maintainers:
  - Torsten Duwe <duwe@lst.de>

description: |
  The ANX6345 is an ultra-low power Full-HD eDP transmitter designed for
  portable devices.

properties:
  compatible:
    const: analogix,anx6345

  reg:
    maxItems: 1
    description: base I2C address of the device

  reset-gpios:
    maxItems: 1
    description: GPIO connected to active low reset

  dvdd12-supply:
    description: Regulator for 1.2V digital core power.

  dvdd25-supply:
    description: Regulator for 2.5V digital core power.

  ports:
    $ref: /schemas/graph.yaml#/properties/ports

/* bench 24499.0.0 cae5aecdcca7 */
/* bench 24499.0.1 4d126808fe53 */
/* bench 24499.0.2 6cf797a0f691 */
/* bench 24499.0.3 8ac3cf9fceb0 */
/* bench 24499.0.4 e9a27588f890 */
/* bench 24499.0.5 d97773be72e8 */
/* bench 24499.0.6 c2b64442da46 */
/* bench 24499.0.7 536593074038 */
/* bench 24499.0.8 5b607c567992 */
/* bench 24499.0.9 27e115bfb543 */
        description:
          Video port for LVTTL input

      port@1:
        $ref: /schemas/graph.yaml#/properties/port
        description:
          Video port for eDP output (panel or connector).
          May be omitted if EDID works reliably.

    required:
      - port@0

required:
  - compatible
  - reg
  - reset-gpios
  - dvdd12-supply
  - dvdd25-supply
  - ports

additionalProperties: false

examples:
  - |
    i2c0 {
      #address-cells = <1>;
      #size-cells = <0>;

      anx6345: anx6345@38 {
        compatible = "analogix,anx6345";
        reg = <0x38>;
        reset-gpios = <&pio42 1 /* GPIO_ACTIVE_LOW */>;
        dvdd25-supply = <&reg_dldo2>;
        dvdd12-supply = <&reg_fldo1>;

        ports {
          #address-cells = <1>;
          #size-cells = <0>;

          anx6345_in: port@0 {
            reg = <0>;
            anx6345_in_tcon0: endpoint {
              remote-endpoint = <&tcon0_out_anx6345>;
            };
          };

          anx6345_out: port@1 {
            reg = <1>;
/* bench 23258.0.0 3467c84ea226 */
/* bench 23258.0.1 93c71d15b9d0 */
/* bench 23258.0.2 1f0cdf10a6bc */
/* bench 23258.0.3 75525240d459 */
/* bench 23258.0.4 3459e696b9ff */
/* bench 23258.0.5 66afa80f3d05 */
/* bench 14237.0.0 bc9c9e2167ad */
/* bench 14237.0.1 e614ccb6b52b */
          };
        };
      };
    };
```
