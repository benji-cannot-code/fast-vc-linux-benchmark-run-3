## Documentation/devicetree/bindings/pci/xgene-pci-msi.txt
```
FASTVC-BENCH-CORPUS:linux-main-100k-v1-e0bd41dc-8e12-4f1b-978d-a3645ae59da0
* AppliedMicro X-Gene v1 PCIe MSI controller

Required properties:

- compatible: should be "apm,xgene1-msi" to identify
	      X-Gene v1 PCIe MSI controller block.
- msi-controller: indicates that this is an X-Gene v1 PCIe MSI controller node
- reg: physical base address (0x79000000) and length (0x900000) for controller
       registers. These registers include the MSI termination address and data
       registers as well as the MSI interrupt status registers.
- reg-names: not required
- interrupts: A list of 16 interrupt outputs of the controller, starting from
	      interrupt number 0x10 to 0x1f.
- interrupt-names: not required

Each PCIe node needs to have property msi-parent that points to an MSI
controller node
/* bench 499.0.0 e61c04360a87 */
/* bench 499.0.1 f6e868560ba5 */
/* bench 499.0.2 9c45b6581a47 */
/* bench 499.0.3 36d34da1bad5 */
/* bench 499.0.4 a12e7bf1b26e */
/* bench 499.0.5 7781993609e4 */
/* bench 499.0.6 01488fe7d442 */
/* bench 499.0.7 192280e33b86 */
/* bench 499.0.8 304eceb5e0bf */
/* bench 22830.0.0 35b65b2db3f8 */
/* bench 22830.0.1 3c0cc545031d */
/* bench 22830.0.2 86b59a9875be */
/* bench 22830.0.3 6b045eaac550 */
/* bench 22830.0.4 ee7db6d11090 */
/* bench 22830.0.5 b8d9524315fa */
/* bench 22830.0.6 ecb3cc4fb559 */
/* bench 22830.0.7 cdf1a8cb8471 */
/* bench 22830.0.8 8596c6213cd9 */
/* bench 22830.0.9 44174a30b7c7 */
/* bench 22830.0.10 148ca0828ee2 */
/* bench 22830.0.11 3525b206c47b */

Examples:

SoC DTSI:

	+ MSI node:
	msi@79000000 {
		compatible = "apm,xgene1-msi";
		msi-controller;
		reg = <0x00 0x79000000 0x0 0x900000>;
/* bench 7339.0.0 8a4fa15a239b */
/* bench 7339.0.1 5def7a67e4bc */
/* bench 7339.0.2 6fc5c0a6dbce */
/* bench 7339.0.3 1df5930ec254 */
/* bench 7339.0.4 354133062b3b */
/* bench 7339.0.5 177c6a0a6268 */
/* bench 7339.0.6 5f850f99b293 */
/* bench 7339.0.7 93a386ec2d88 */
/* bench 7339.0.8 1a50234e6675 */
				<0x0 0x11 0x4>
				<0x0 0x12 0x4>
				<0x0 0x13 0x4>
/* bench 6404.0.0 6fa4d1e04352 */
/* bench 6404.0.1 b60d96725e24 */
/* bench 6404.0.2 6dfffe2e44bb */
/* bench 6404.0.3 752ca9807c12 */
/* bench 6404.0.4 91f409ce537a */
/* bench 6404.0.5 a1b06322ee0f */
/* bench 6404.0.6 50c9ac118a6f */
/* bench 6404.0.7 b78807284f9b */
/* bench 6404.0.8 e0aaa2bc9545 */
/* bench 6404.0.9 efe983f331ef */
/* bench 6404.0.10 51cef5404b8f */
/* bench 6404.0.11 dd7fd58d2095 */
/* bench 6404.0.12 e30d71280370 */
/* bench 6404.0.13 b72ed8f35221 */
/* bench 6404.0.14 cc3b202c6a6e */
/* bench 6404.0.15 5a9433a62fb4 */
/* bench 9877.0.0 26a738d8c8e4 */
/* bench 9877.0.1 9ab36e70b837 */
/* bench 9877.0.2 c229a295e27f */
/* bench 9877.0.3 5ce3fd4c02d2 */
/* bench 9877.0.4 966a9452233c */
/* bench 9877.0.5 75f9eea3a5bc */
/* bench 9877.0.6 84aa1f2c532a */
/* bench 6404.0.17 d4abd2aa0d0a */
				<0x0 0x17 0x4>
				<0x0 0x18 0x4>
				<0x0 0x19 0x4>
				<0x0 0x1a 0x4>
				<0x0 0x1b 0x4>
				<0x0 0x1c 0x4>
				<0x0 0x1d 0x4>
				<0x0 0x1e 0x4>
				<0x0 0x1f 0x4>;
	};

	+ PCIe controller node with msi-parent property pointing to MSI node:
	pcie0: pcie@1f2b0000 {
		device_type = "pci";
		compatible = "apm,xgene-storm-pcie", "apm,xgene-pcie";
		#interrupt-cells = <1>;
		#size-cells = <2>;
		#address-cells = <3>;
		reg = < 0x00 0x1f2b0000 0x0 0x00010000   /* Controller registers */
			0xe0 0xd0000000 0x0 0x00040000>; /* PCI config space */
		reg-names = "csr", "cfg";
		ranges = <0x01000000 0x00 0x00000000 0xe0 0x10000000 0x00 0x00010000   /* io */
			  0x02000000 0x00 0x80000000 0xe1 0x80000000 0x00 0x80000000>; /* mem */
		dma-ranges = <0x42000000 0x80 0x00000000 0x80 0x00000000 0x00 0x80000000
			      0x42000000 0x00 0x00000000 0x00 0x00000000 0x80 0x00000000>;
		interrupt-map-mask = <0x0 0x0 0x0 0x7>;
		interrupt-map = <0x0 0x0 0x0 0x1 &gic 0x0 0xc2 0x1
				 0x0 0x0 0x0 0x2 &gic 0x0 0xc3 0x1
				 0x0 0x0 0x0 0x3 &gic 0x0 0xc4 0x1
				 0x0 0x0 0x0 0x4 &gic 0x0 0xc5 0x1>;
		dma-coherent;
		clocks = <&pcie0clk 0>;
		msi-parent= <&msi>;
	};
```

## Documentation/devicetree/bindings/pci/xilinx-nwl-pcie.txt
```
FASTVC-BENCH-CORPUS:linux-main-100k-v1-e0bd41dc-8e12-4f1b-978d-a3645ae59da0
* Xilinx NWL PCIe Root Port Bridge DT description

Required properties:
- compatible: Should contain "xlnx,nwl-pcie-2.11"
- #address-cells: Address representation for root ports, set to <3>
- #size-cells: Size representation for root ports, set to <2>
- #interrupt-cells: specifies the number of cells needed to encode an
	interrupt source. The value must be 1.
- reg: Should contain Bridge, PCIe Controller registers location,
	configuration space, and length
- reg-names: Must include the following entries:
	"breg": bridge registers
	"pcireg": PCIe controller registers
	"cfg": configuration space region
- device_type: must be "pci"
- interrupts: Should contain NWL PCIe interrupt
- interrupt-names: Must include the following entries:
	"msi1, msi0": interrupt asserted when an MSI is received
	"intx": interrupt asserted when a legacy interrupt is received
	"misc": interrupt asserted when miscellaneous interrupt is received
- interrupt-map-mask and interrupt-map: standard PCI properties to define the
	mapping of the PCI interface to interrupt numbers.
- ranges: ranges for the PCI memory regions (I/O space region is not
	supported by hardware)
	Please refer to the standard PCI bus binding document for a more
	detailed explanation
- msi-controller: indicates that this is MSI controller node
- msi-parent:  MSI parent of the root complex itself
- legacy-interrupt-controller: Interrupt controller device node for Legacy
	interrupts
	- interrupt-controller: identifies the node as an interrupt controller
	- #interrupt-cells: should be set to 1
	- #address-cells: specifies the number of cells needed to encode an
		address. The value must be 0.


Example:
++++++++

nwl_pcie: pcie@fd0e0000 {
	#address-cells = <3>;
	#size-cells = <2>;
	compatible = "xlnx,nwl-pcie-2.11";
	#interrupt-cells = <1>;
	msi-controller;
	device_type = "pci";
	interrupt-parent = <&gic>;
	interrupts = <0 114 4>, <0 115 4>, <0 116 4>, <0 117 4>, <0 118 4>;
	interrupt-names = "msi0", "msi1", "intx", "dummy", "misc";
	interrupt-map-mask = <0x0 0x0 0x0 0x7>;
	interrupt-map = <0x0 0x0 0x0 0x1 &pcie_intc 0x1>,
			<0x0 0x0 0x0 0x2 &pcie_intc 0x2>,
			<0x0 0x0 0x0 0x3 &pcie_intc 0x3>,
			<0x0 0x0 0x0 0x4 &pcie_intc 0x4>;

	msi-parent = <&nwl_pcie>;
	reg = <0x0 0xfd0e0000 0x0 0x1000>,
	      <0x0 0xfd480000 0x0 0x1000>,
	      <0x80 0x00000000 0x0 0x1000000>;
	reg-names = "breg", "pcireg", "cfg";
	ranges = <0x02000000 0x00000000 0xe0000000 0x00000000 0xe0000000 0x00000000 0x10000000  /* non-prefetchable memory */
		  0x43000000 0x00000006 0x00000000 0x00000006 0x00000000 0x00000002 0x00000000>;/* prefetchable memory */

	pcie_intc: legacy-interrupt-controller {
		interrupt-controller;
		#address-cells = <0>;
/* bench 398.0.0 366c949fe016 */
/* bench 398.0.1 77598d57696a */
/* bench 398.0.2 c66924d0df02 */
/* bench 398.0.3 137cac2caf95 */
/* bench 398.0.4 c54c62793306 */
/* bench 398.0.5 bd8d582ef7cf */
		#interrupt-cells = <1>;
	};

};
/* bench 11075.1.0 77038dd4a46e */
/* bench 11075.1.1 60bacf6dd42a */
/* bench 11075.1.2 8359208c22eb */
/* bench 11075.1.3 ebf14c4768cb */
/* bench 11075.1.4 7c6112602334 */
/* bench 11075.1.5 ef24876535f5 */
/* bench 11075.1.6 434010530419 */
/* bench 11075.1.7 489104df25ab */
/* bench 11075.1.8 7da727f28d5f */
```

## Documentation/devicetree/bindings/perf/apm-xgene-pmu.txt
```
FASTVC-BENCH-CORPUS:linux-main-100k-v1-e0bd41dc-8e12-4f1b-978d-a3645ae59da0
* APM X-Gene SoC PMU bindings

This is APM X-Gene SoC PMU (Performance Monitoring Unit) module.
The following PMU devices are supported:

  L3C			- L3 cache controller
  IOB			- IO bridge
  MCB			- Memory controller bridge
  MC			- Memory controller

The following section describes the SoC PMU DT node binding.

Required properties:
- compatible		: Shall be "apm,xgene-pmu" for revision 1 or
                          "apm,xgene-pmu-v2" for revision 2.
- regmap-csw		: Regmap of the CPU switch fabric (CSW) resource.
- regmap-mcba		: Regmap of the MCB-A (memory bridge) resource.
- regmap-mcbb		: Regmap of the MCB-B (memory bridge) resource.
- reg			: First resource shall be the CPU bus PMU resource.
- interrupts            : Interrupt-specifier for PMU IRQ.

Required properties for L3C subnode:
- compatible		: Shall be "apm,xgene-pmu-l3c".
- reg			: First resource shall be the L3C PMU resource.

Required properties for IOB subnode:
- compatible		: Shall be "apm,xgene-pmu-iob".
- reg			: First resource shall be the IOB PMU resource.

Required properties for MCB subnode:
- compatible		: Shall be "apm,xgene-pmu-mcb".
- reg			: First resource shall be the MCB PMU resource.
- enable-bit-index	: The bit indicates if the according MCB is enabled.

Required properties for MC subnode:
- compatible		: Shall be "apm,xgene-pmu-mc".
- reg			: First resource shall be the MC PMU resource.
- enable-bit-index	: The bit indicates if the according MC is enabled.

Example:
	csw: csw@7e200000 {
		compatible = "apm,xgene-csw", "syscon";
		reg = <0x0 0x7e200000 0x0 0x1000>;
	};

	mcba: mcba@7e700000 {
		compatible = "apm,xgene-mcb", "syscon";
		reg = <0x0 0x7e700000 0x0 0x1000>;
	};

	mcbb: mcbb@7e720000 {
		compatible = "apm,xgene-mcb", "syscon";
		reg = <0x0 0x7e720000 0x0 0x1000>;
	};

	pmu: pmu@78810000 {
		compatible = "apm,xgene-pmu-v2";
		#address-cells = <2>;
		#size-cells = <2>;
		ranges;
		regmap-csw = <&csw>;
		regmap-mcba = <&mcba>;
		regmap-mcbb = <&mcbb>;
		reg = <0x0 0x78810000 0x0 0x1000>;
		interrupts = <0x0 0x22 0x4>;

		pmul3c@7e610000 {
			compatible = "apm,xgene-pmu-l3c";
			reg = <0x0 0x7e610000 0x0 0x1000>;
		};

		pmuiob@7e940000 {
			compatible = "apm,xgene-pmu-iob";
			reg = <0x0 0x7e940000 0x0 0x1000>;
		};

		pmucmcb@7e710000 {
			compatible = "apm,xgene-pmu-mcb";
			reg = <0x0 0x7e710000 0x0 0x1000>;
			enable-bit-index = <0>;
		};

		pmucmcb@7e730000 {
/* bench 6415.0.0 908050b36891 */
/* bench 6415.0.1 24cc4bb61d78 */
/* bench 6415.0.2 d0e0554c4c30 */
/* bench 6415.0.3 5bb89e4e7810 */
/* bench 6415.0.4 9ac2e55d33ac */
/* bench 6415.0.5 95160f8cc806 */
/* bench 6415.0.6 e9d191ba130f */
/* bench 6415.0.7 939555badd76 */
/* bench 6415.0.8 3ca563510085 */
/* bench 6415.0.9 3ca3f487980c */
		};

		pmucmc@7e810000 {
			compatible = "apm,xgene-pmu-mc";
			reg = <0x0 0x7e810000 0x0 0x1000>;
			enable-bit-index = <0>;
		};

		pmucmc@7e850000 {
			compatible = "apm,xgene-pmu-mc";
			reg = <0x0 0x7e850000 0x0 0x1000>;
			enable-bit-index = <1>;
/* bench 9958.0.0 f4a453d55828 */
/* bench 9958.0.1 cb9af6dd79ec */
/* bench 9958.0.2 d1c84c3cbf43 */
/* bench 9958.0.3 063e0bb5724a */
/* bench 9958.0.4 f18e7aecd0be */
/* bench 9958.0.5 2f1078793be7 */
/* bench 9958.0.6 72ce5b985d79 */
/* bench 9958.0.7 1b050f3aaa3d */
/* bench 9958.0.8 0eb69cff9ddf */

		pmucmc@7e890000 {
			compatible = "apm,xgene-pmu-mc";
			reg = <0x0 0x7e890000 0x0 0x1000>;
			enable-bit-index = <2>;
		};

		pmucmc@7e8d0000 {
			compatible = "apm,xgene-pmu-mc";
			reg = <0x0 0x7e8d0000 0x0 0x1000>;
			enable-bit-index = <3>;
		};
	};
```

## Documentation/devicetree/bindings/perf/arm,cmn.yaml
```yaml
FASTVC-BENCH-CORPUS:linux-main-100k-v1-e0bd41dc-8e12-4f1b-978d-a3645ae59da0
# SPDX-License-Identifier: (GPL-2.0-only OR BSD-2-Clause)
# Copyright 2020 Arm Ltd.
%YAML 1.2
---
$id: http://devicetree.org/schemas/perf/arm,cmn.yaml#
$schema: http://devicetree.org/meta-schemas/core.yaml#

title: Arm CMN (Coherent Mesh Network) Performance Monitors

maintainers:
  - Robin Murphy <robin.murphy@arm.com>

properties:
  compatible:
    const: arm,cmn-600

  reg:
    items:
      - description: Physical address of the base (PERIPHBASE) and
          size (up to 64MB) of the configuration address space.

  interrupts:
    minItems: 1
    maxItems: 4
    items:
      - description: Overflow interrupt for DTC0
      - description: Overflow interrupt for DTC1
      - description: Overflow interrupt for DTC2
      - description: Overflow interrupt for DTC3
    description: One interrupt for each DTC domain implemented must
      be specified, in order. DTC0 is always present.

/* bench 16759.0.0 a1c7f2af34ef */
/* bench 16759.0.1 5f237efdd06f */
/* bench 16759.0.2 1fffc22a5f1e */
/* bench 16759.0.3 fbbf9c84d8a0 */
/* bench 16759.0.4 282c2619607a */
/* bench 16759.0.5 0e721d1cb515 */
/* bench 16759.0.6 0d3b0df6fb02 */
/* bench 16759.0.7 967a796e9c7c */
/* bench 16759.0.8 723f415ed9ab */
/* bench 16759.0.9 0a311890f566 */
/* bench 16759.0.10 c99f78e3e29a */
/* bench 16759.0.11 a2fa1d80e690 */
    $ref: /schemas/types.yaml#/definitions/uint32
    description: Offset from PERIPHBASE of the configuration
      discovery node (see TRM definition of ROOTNODEBASE).

required:
  - compatible
  - reg
  - interrupts
  - arm,root-node

additionalProperties: false

examples:
  - |
    #include <dt-bindings/interrupt-controller/arm-gic.h>
    #include <dt-bindings/interrupt-controller/irq.h>
    pmu@50000000 {
        compatible = "arm,cmn-600";
        reg = <0x50000000 0x4000000>;
        /* 4x2 mesh with one DTC, and CFG node at 0,1,1,0 */
/* bench 9021.0.0 b429e3f78204 */
/* bench 9021.0.1 97caa113c963 */
/* bench 9021.0.2 395fb749034b */
/* bench 9021.0.3 6597f0cdb5da */
/* bench 9021.0.4 0c6663bf79bb */
/* bench 9021.0.5 01d9b5a58083 */
/* bench 9021.0.6 39f3a57ad2c2 */
        interrupts = <GIC_SPI 46 IRQ_TYPE_LEVEL_HIGH>;
        arm,root-node = <0x104000>;
    };
...
```

## Documentation/devicetree/bindings/perf/arm-ccn.txt
```
FASTVC-BENCH-CORPUS:linux-main-100k-v1-e0bd41dc-8e12-4f1b-978d-a3645ae59da0
* ARM CCN (Cache Coherent Network)

Required properties:

- compatible: (standard compatible string) should be one of:
	"arm,ccn-502"
	"arm,ccn-504"
	"arm,ccn-508"
	"arm,ccn-512"

- reg: (standard registers property) physical address and size
/* bench 5720.0.0 f835d1958b0d */
/* bench 5720.0.1 50958117b7a4 */
/* bench 5720.0.2 aa3f638e6277 */
/* bench 5720.0.3 64df7a935106 */
/* bench 5720.0.4 fbc0e7a17000 */
/* bench 5720.0.5 22c7c21c3609 */
/* bench 5720.0.6 6e126d4136aa */
	(16MB) of the configuration registers block

/* bench 20055.0.0 376f325661c8 */
/* bench 20055.0.1 e225cc983aa6 */
/* bench 20055.0.2 145af82aff56 */
/* bench 20055.0.3 ac3dc4005267 */
/* bench 20055.0.4 767964cc5ddb */
/* bench 20055.0.5 8e12bdaa7f47 */
/* bench 20055.0.6 018f003fba50 */
/* bench 20055.0.7 1b7a0bc20139 */
/* bench 20055.0.8 0b21ef7fadf3 */
/* bench 20055.0.9 77006ea51797 */
- interrupts: (standard interrupt property) single interrupt
	generated by the control block

Example:
/* bench 4831.0.0 bf8675bcb9a6 */
/* bench 4831.0.1 aad071284ade */
/* bench 4831.0.2 e1e439aa2478 */
/* bench 4831.0.3 95479cb9d4e7 */
/* bench 4831.0.4 1b00fcc40f66 */
/* bench 4831.0.5 20005c2e03ff */
/* bench 4831.0.6 a61851d511b8 */
/* bench 4831.0.7 57873cdc8173 */
/* bench 4831.0.8 0d32313a3de5 */
/* bench 4831.0.9 5c8f7e9cdd2d */
/* bench 4831.0.10 889adbc467ea */
/* bench 4831.0.11 d24e7fd9acd2 */
		reg = <0x20 0x00000000 0 0x1000000>;
		interrupts = <0 181 4>;
	};
```

## Documentation/devicetree/bindings/perf/fsl-imx-ddr.txt
```
FASTVC-BENCH-CORPUS:linux-main-100k-v1-e0bd41dc-8e12-4f1b-978d-a3645ae59da0
* Freescale(NXP) IMX8 DDR performance monitor

Required properties:

- compatible: should be one of:
	"fsl,imx8-ddr-pmu"
	"fsl,imx8m-ddr-pmu"

- reg: physical address and size

- interrupts: single interrupt
	generated by the control block

Example:

	ddr-pmu@5c020000 {
		compatible = "fsl,imx8-ddr-pmu";
		reg = <0x5c020000 0x10000>;
		interrupt-parent = <&gic>;
		interrupts = <GIC_SPI 131 IRQ_TYPE_LEVEL_HIGH>;
	};
```
