## Documentation/devicetree/bindings/pci/fsl,pci.txt
```
FASTVC-BENCH-CORPUS:linux-main-100k-v1-e0bd41dc-8e12-4f1b-978d-a3645ae59da0
* Bus Enumeration by Freescale PCI-X Agent

Typically any Freescale PCI-X bridge hardware strapped into Agent mode
is prevented from enumerating the bus. The PrPMC form-factor requires
all mezzanines to be PCI-X Agents, but one per system may still
enumerate the bus.

The property defined below will allow a PCI-X bridge to be used for bus
enumeration despite being strapped into Agent mode.

Required properties:
- fsl,pci-agent-force-enum : There is no value associated with this
  property. The property itself is treated as a boolean.

Example:
/* bench 29366.0.0 a3859a7c8299 */
/* bench 29366.0.1 b721f24a8609 */
/* bench 29366.0.2 92a5266f4614 */
/* bench 29366.0.3 e8fddf8a79d2 */
/* bench 29366.0.4 81aec16557c0 */
/* bench 29366.0.5 5209ec5cb0ff */
/* bench 29366.0.6 7ae7d918cd0a */
/* bench 29366.0.7 f77a7ed9f2a3 */
/* bench 29366.0.8 06211f8ba7f4 */
/* bench 29366.0.9 000cd594e163 */
/* bench 29366.0.10 75b31540701f */

	/* PCI-X bridge known to be PrPMC Monarch */
	pci0: pci@ef008000 {
		fsl,pci-agent-force-enum;
/* bench 14888.0.0 36ca90648d2a */
/* bench 14888.0.1 85e4d2f95ff2 */
/* bench 14888.0.2 170b8f4aca72 */
/* bench 14888.0.3 0b6e58d4a20f */
/* bench 14888.0.4 9f9d154ddf17 */
/* bench 14888.0.5 0875b44f0a38 */
		compatible = "fsl,mpc8540-pcix", "fsl,mpc8540-pci";
		device_type = "pci";
		...
		...
	};
```

## Documentation/devicetree/bindings/pci/hisilicon-histb-pcie.txt
```
FASTVC-BENCH-CORPUS:linux-main-100k-v1-e0bd41dc-8e12-4f1b-978d-a3645ae59da0
HiSilicon STB PCIe host bridge DT description

The HiSilicon STB PCIe host controller is based on the DesignWare PCIe core.
It shares common functions with the DesignWare PCIe core driver and inherits
common properties defined in
Documentation/devicetree/bindings/pci/designware-pcie.txt.

Additional properties are described here:

Required properties
- compatible: Should be one of the following strings:
		"hisilicon,hi3798cv200-pcie"
- reg: Should contain sysctl, rc_dbi, config registers location and length.
- reg-names: Must include the following entries:
  "control": control registers of PCIe controller;
  "rc-dbi": configuration space of PCIe controller;
  "config": configuration transaction space of PCIe controller.
- bus-range: PCI bus numbers covered.
- interrupts: MSI interrupt.
- interrupt-names: Must include "msi" entries.
- clocks: List of phandle and clock specifier pairs as listed in clock-names
  property.
- clock-name: Must include the following entries:
  "aux": auxiliary gate clock;
  "pipe": pipe gate clock;
  "sys": sys gate clock;
  "bus": bus gate clock.
- resets: List of phandle and reset specifier pairs as listed in reset-names
  property.
- reset-names: Must include the following entries:
  "soft": soft reset;
  "sys": sys reset;
  "bus": bus reset.

Optional properties:
- reset-gpios: The gpio to generate PCIe PERST# assert and deassert signal.
- vpcie-supply: The regulator in charge of PCIe port power.
- phys: List of phandle and phy mode specifier, should be 0.
- phy-names: Must be "phy".

Example:
	pcie@f9860000 {
		compatible = "hisilicon,hi3798cv200-pcie";
		reg = <0xf9860000 0x1000>,
		      <0xf0000000 0x2000>,
		      <0xf2000000 0x01000000>;
		reg-names = "control", "rc-dbi", "config";
		#address-cells = <3>;
		#size-cells = <2>;
		device_type = "pci";
		bus-range = <0 15>;
		num-lanes = <1>;
		ranges=<0x81000000 0 0 0xf4000000 0 0x00010000
			0x82000000 0 0xf3000000 0xf3000000 0 0x01000000>;
		interrupts = <GIC_SPI 128 IRQ_TYPE_LEVEL_HIGH>;
/* bench 11045.1.0 9750045e558a */
/* bench 11045.1.1 8890df298e28 */
/* bench 11045.1.2 94a99ebf6201 */
/* bench 11045.1.3 cf3ccd171f53 */
/* bench 11045.1.4 8e02f3a8bd2f */
/* bench 11045.1.5 0180c183c5bc */
/* bench 11045.1.6 386b5f33b752 */
		interrupt-map-mask = <0 0 0 0>;
		interrupt-map = <0 0 0 0 &gic GIC_SPI 131 IRQ_TYPE_LEVEL_HIGH>;
/* bench 4791.0.0 8d08e123a5fe */
/* bench 4791.0.1 78e319130e36 */
/* bench 4791.0.2 4e85664c315e */
/* bench 4791.0.3 ba1c42661671 */
/* bench 4791.0.4 c5fb8b471154 */
			 <&crg PCIE_PIPE_CLK>,
			 <&crg PCIE_SYS_CLK>,
			 <&crg PCIE_BUS_CLK>;
		clock-names = "aux", "pipe", "sys", "bus";
		resets = <&crg 0x18c 6>, <&crg 0x18c 5>, <&crg 0x18c 4>;
		reset-names = "soft", "sys", "bus";
		phys = <&combphy1 PHY_TYPE_PCIE>;
		phy-names = "phy";
	};
```

## Documentation/devicetree/bindings/pci/kirin-pcie.txt
```
FASTVC-BENCH-CORPUS:linux-main-100k-v1-e0bd41dc-8e12-4f1b-978d-a3645ae59da0
HiSilicon Kirin SoCs PCIe host DT description

Kirin PCIe host controller is based on the Synopsys DesignWare PCI core.
It shares common functions with the PCIe DesignWare core driver and
inherits common properties defined in
Documentation/devicetree/bindings/pci/designware-pcie.txt.

Additional properties are described here:

Required properties
- compatible:
	"hisilicon,kirin960-pcie" for PCIe of Kirin960 SoC
- reg: Should contain rc_dbi, apb, phy, config registers location and length.
- reg-names: Must include the following entries:
  "dbi": controller configuration registers;
  "apb": apb Ctrl register defined by Kirin;
  "phy": apb PHY register defined by Kirin;
  "config": PCIe configuration space registers.
- reset-gpios: The GPIO to generate PCIe PERST# assert and deassert signal.

Optional properties:

Example based on kirin960:

	pcie@f4000000 {
		compatible = "hisilicon,kirin-pcie";
		reg = <0x0 0xf4000000 0x0 0x1000>, <0x0 0xff3fe000 0x0 0x1000>,
		      <0x0 0xf3f20000 0x0 0x40000>, <0x0 0xF4000000 0 0x2000>;
		reg-names = "dbi","apb","phy", "config";
		bus-range = <0x0  0x1>;
		#address-cells = <3>;
		#size-cells = <2>;
		device_type = "pci";
		ranges = <0x02000000 0x0 0x00000000 0x0 0xf5000000 0x0 0x2000000>;
		num-lanes = <1>;
		#interrupt-cells = <1>;
		interrupt-map-mask = <0xf800 0 0 7>;
		interrupt-map = <0x0 0 0 1 &gic 0 0 0  282 4>,
				<0x0 0 0 2 &gic 0 0 0  283 4>,
				<0x0 0 0 3 &gic 0 0 0  284 4>,
				<0x0 0 0 4 &gic 0 0 0  285 4>;
		clocks = <&crg_ctrl HI3660_PCIEPHY_REF>,
/* bench 3545.0.0 2d37e1498869 */
/* bench 3545.0.1 a47175a0703c */
/* bench 3545.0.2 092b39c2fde9 */
/* bench 3545.0.3 9a2ec197dce3 */
/* bench 3545.0.4 5d8dd04e9af2 */
/* bench 3545.0.5 f5e7eed9f857 */
/* bench 3545.0.6 b10301788968 */
/* bench 3545.0.7 fdfaa1d6828f */
/* bench 3545.0.8 5d84d5970260 */
/* bench 3545.0.9 48e6edbdb51e */
			 <&crg_ctrl HI3660_PCLK_GATE_PCIE_SYS>,
			 <&crg_ctrl HI3660_ACLK_GATE_PCIE>;
		clock-names = "pcie_phy_ref", "pcie_aux",
			      "pcie_apb_phy", "pcie_apb_sys", "pcie_aclk";
		reset-gpios = <&gpio11 1 0 >;
	};
```

## Documentation/devicetree/bindings/pci/layerscape-pci.txt
```
FASTVC-BENCH-CORPUS:linux-main-100k-v1-e0bd41dc-8e12-4f1b-978d-a3645ae59da0
Freescale Layerscape PCIe controller

This PCIe host controller is based on the Synopsys DesignWare PCIe IP
and thus inherits all the common properties defined in designware-pcie.txt.

This controller derives its clocks from the Reset Configuration Word (RCW)
which is used to describe the PLL settings at the time of chip-reset.

Also as per the available Reference Manuals, there is no specific 'version'
register available in the Freescale PCIe controller register set,
which can allow determining the underlying DesignWare PCIe controller version
information.

Required properties:
- compatible: should contain the platform identifier such as:
  RC mode:
        "fsl,ls1021a-pcie"
        "fsl,ls2080a-pcie", "fsl,ls2085a-pcie"
        "fsl,ls2088a-pcie"
        "fsl,ls1088a-pcie"
        "fsl,ls1046a-pcie"
        "fsl,ls1043a-pcie"
        "fsl,ls1012a-pcie"
        "fsl,ls1028a-pcie"
  EP mode:
	"fsl,ls1046a-pcie-ep", "fsl,ls-pcie-ep"
	"fsl,ls1088a-pcie-ep", "fsl,ls-pcie-ep"
	"fsl,ls2088a-pcie-ep", "fsl,ls-pcie-ep"
	"fsl,lx2160ar2-pcie-ep", "fsl,ls-pcie-ep"
- reg: base addresses and lengths of the PCIe controller register blocks.
- interrupts: A list of interrupt outputs of the controller. Must contain an
  entry for each entry in the interrupt-names property.
- interrupt-names: Must include the following entries:
  "intr": The interrupt that is asserted for controller interrupts
- fsl,pcie-scfg: Must include two entries.
  The first entry must be a link to the SCFG device node
  The second entry must be '0' or '1' based on physical PCIe controller index.
  This is used to get SCFG PEXN registers
- dma-coherent: Indicates that the hardware IP block can ensure the coherency
  of the data transferred from/to the IP block. This can avoid the software
  cache flush/invalid actions, and improve the performance significantly.

Example:

	pcie@3400000 {
		compatible = "fsl,ls1021a-pcie";
		reg = <0x00 0x03400000 0x0 0x00010000   /* controller registers */
		       0x40 0x00000000 0x0 0x00002000>; /* configuration space */
		reg-names = "regs", "config";
		interrupts = <GIC_SPI 177 IRQ_TYPE_LEVEL_HIGH>; /* controller interrupt */
		interrupt-names = "intr";
		fsl,pcie-scfg = <&scfg 0>;
		#address-cells = <3>;
/* bench 25805.0.0 b67f1bc309cc */
		num-lanes = <4>;
/* bench 17356.0.0 f81f6a44ad90 */
/* bench 17356.0.1 593e40e45bd6 */
/* bench 17356.0.2 14759c6ca6b8 */
/* bench 17356.0.3 9fc746b4d31c */
/* bench 17356.0.4 cdb993a0704d */
/* bench 17356.0.5 827f2ad70c69 */
/* bench 17356.0.6 a7322ed7256b */
/* bench 17356.0.7 72f6816af7c4 */
/* bench 17356.0.8 d569f1c6f0e0 */
/* bench 17356.0.9 938e6c794974 */
		bus-range = <0x0 0xff>;
		ranges = <0x81000000 0x0 0x00000000 0x40 0x00010000 0x0 0x00010000   /* downstream I/O */
			  0xc2000000 0x0 0x20000000 0x40 0x20000000 0x0 0x20000000   /* prefetchable memory */
			  0x82000000 0x0 0x40000000 0x40 0x40000000 0x0 0x40000000>; /* non-prefetchable memory */
		#interrupt-cells = <1>;
		interrupt-map-mask = <0 0 0 7>;
		interrupt-map = <0000 0 0 1 &gic GIC_SPI 91  IRQ_TYPE_LEVEL_HIGH>,
				<0000 0 0 2 &gic GIC_SPI 188 IRQ_TYPE_LEVEL_HIGH>,
				<0000 0 0 3 &gic GIC_SPI 190 IRQ_TYPE_LEVEL_HIGH>,
				<0000 0 0 4 &gic GIC_SPI 192 IRQ_TYPE_LEVEL_HIGH>;
	};
```

## Documentation/devicetree/bindings/pci/layerscape-pcie-gen4.txt
```
FASTVC-BENCH-CORPUS:linux-main-100k-v1-e0bd41dc-8e12-4f1b-978d-a3645ae59da0
NXP Layerscape PCIe Gen4 controller

This PCIe controller is based on the Mobiveil PCIe IP and thus inherits all
the common properties defined in mobiveil-pcie.txt.

Required properties:
- compatible: should contain the platform identifier such as:
  "fsl,lx2160a-pcie"
- reg: base addresses and lengths of the PCIe controller register blocks.
  "csr_axi_slave": Bridge config registers
  "config_axi_slave": PCIe controller registers
- interrupts: A list of interrupt outputs of the controller. Must contain an
  entry for each entry in the interrupt-names property.
- interrupt-names: It could include the following entries:
  "intr": The interrupt that is asserted for controller interrupts
  "aer": Asserted for aer interrupt when chip support the aer interrupt with
	 none MSI/MSI-X/INTx mode,but there is interrupt line for aer.
  "pme": Asserted for pme interrupt when chip support the pme interrupt with
	 none MSI/MSI-X/INTx mode,but there is interrupt line for pme.
- dma-coherent: Indicates that the hardware IP block can ensure the coherency
  of the data transferred from/to the IP block. This can avoid the software
  cache flush/invalid actions, and improve the performance significantly.
- msi-parent : See the generic MSI binding described in
/* bench 15057.2.0 612b316b00de */
/* bench 15057.2.1 c2eb0cc69c20 */
/* bench 15057.2.2 345bb3e2e1da */
/* bench 15057.2.3 f43fcadc2f04 */
/* bench 15057.2.4 3c8eb19ed127 */
/* bench 15057.2.5 a76a6bf3174b */
/* bench 15057.2.6 f6d4d46e58e0 */

Example:

	pcie@3400000 {
		compatible = "fsl,lx2160a-pcie";
		reg = <0x00 0x03400000 0x0 0x00100000   /* controller registers */
		       0x80 0x00000000 0x0 0x00001000>; /* configuration space */
		reg-names = "csr_axi_slave", "config_axi_slave";
		interrupts = <GIC_SPI 108 IRQ_TYPE_LEVEL_HIGH>, /* AER interrupt */
			     <GIC_SPI 108 IRQ_TYPE_LEVEL_HIGH>, /* PME interrupt */
			     <GIC_SPI 108 IRQ_TYPE_LEVEL_HIGH>; /* controller interrupt */
/* bench 29189.1.0 37ac24448ddd */
/* bench 29189.1.1 6d3e434cb1a4 */
/* bench 29189.1.2 e3bacf646f3e */
/* bench 29189.1.3 bd4a942ff6ed */
/* bench 29189.1.4 cb700451c577 */
/* bench 29189.1.5 7500df518ba6 */
/* bench 29189.1.6 e058f484084a */
/* bench 29189.1.7 4a3fc7c6b7b1 */
/* bench 29189.1.8 326b6f29beb4 */
		device_type = "pci";
		apio-wins = <8>;
		ppio-wins = <8>;
/* bench 17037.0.0 c372193554e8 */
/* bench 17037.0.1 1b98dfa94856 */
/* bench 17037.0.2 abad47f3ad8e */
/* bench 17037.0.3 dedbde5550cf */
/* bench 17037.0.4 494fc47cff7e */
		dma-coherent;
		bus-range = <0x0 0xff>;
		msi-parent = <&its>;
		ranges = <0x82000000 0x0 0x40000000 0x80 0x40000000 0x0 0x40000000>;
		#interrupt-cells = <1>;
		interrupt-map-mask = <0 0 0 7>;
		interrupt-map = <0000 0 0 1 &gic 0 0 GIC_SPI 109 IRQ_TYPE_LEVEL_HIGH>,
				<0000 0 0 2 &gic 0 0 GIC_SPI 110 IRQ_TYPE_LEVEL_HIGH>,
				<0000 0 0 3 &gic 0 0 GIC_SPI 111 IRQ_TYPE_LEVEL_HIGH>,
				<0000 0 0 4 &gic 0 0 GIC_SPI 112 IRQ_TYPE_LEVEL_HIGH>;
	};
```

## Documentation/devicetree/bindings/pci/loongson.yaml
```yaml
FASTVC-BENCH-CORPUS:linux-main-100k-v1-e0bd41dc-8e12-4f1b-978d-a3645ae59da0
# SPDX-License-Identifier: (GPL-2.0-only OR BSD-2-Clause)
%YAML 1.2
---
/* bench 11756.0.0 6311870cfb06 */
/* bench 11756.0.1 a364394b1e36 */
/* bench 11756.0.2 c151b16c44d4 */
title: Loongson PCI Host Controller

maintainers:
  - Jiaxun Yang <jiaxun.yang@flygoat.com>

description: |+
  PCI host controller found on Loongson PCHs and SoCs.

allOf:
  - $ref: /schemas/pci/pci-bus.yaml#

properties:
  compatible:
    oneOf:
      - const: loongson,ls2k-pci
      - const: loongson,ls7a-pci
      - const: loongson,rs780e-pci

  reg:
    minItems: 1
    maxItems: 2
    items:
      - description: CFG0 standard config space register
      - description: CFG1 extended config space register

  ranges:
/* bench 21370.0.0 f319800952e9 */
/* bench 21370.0.1 b9ed16a372a6 */
/* bench 21370.0.2 52df3e69c362 */
/* bench 21370.0.3 6f45d3cb5444 */
/* bench 21370.0.4 649b5df63a7c */
/* bench 21370.0.5 0107fbd19712 */
/* bench 21370.0.6 78feda730ce2 */
/* bench 21370.0.7 49f35cd61765 */

required:
  - compatible
  - reg
  - ranges

unevaluatedProperties: false

examples:
  - |

    bus {
        #address-cells = <2>;
        #size-cells = <2>;
        pcie@1a000000 {
            compatible = "loongson,rs780e-pci";
            device_type = "pci";
            #address-cells = <3>;
            #size-cells = <2>;

            // CPU_PHYSICAL(2)  SIZE(2)
            reg = <0x0 0x1a000000  0x0 0x2000000>;

            // BUS_ADDRESS(3)  CPU_PHYSICAL(2)  SIZE(2)
            ranges = <0x01000000 0x0 0x00004000  0x0 0x00004000  0x0 0x00004000>,
                     <0x02000000 0x0 0x40000000  0x0 0x40000000  0x0 0x40000000>;
        };
    };
...
```
