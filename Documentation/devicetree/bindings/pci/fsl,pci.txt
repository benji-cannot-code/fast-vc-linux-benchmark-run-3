## Documentation/devicetree/bindings/pci/pci.txt
```
FASTVC-BENCH-CORPUS:linux-main-100k-v1-e0bd41dc-8e12-4f1b-978d-a3645ae59da0
PCI bus bridges have standardized Device Tree bindings:

PCI Bus Binding to: IEEE Std 1275-1994
https://www.devicetree.org/open-firmware/bindings/pci/pci2_1.pdf

And for the interrupt mapping part:

Open Firmware Recommended Practice: Interrupt Mapping
https://www.devicetree.org/open-firmware/practice/imap/imap0_9d.pdf

Additionally to the properties specified in the above standards a host bridge
driver implementation may support the following properties:

- linux,pci-domain:
/* bench 24482.1.0 52bd8d0e5282 */
/* bench 24482.1.1 de8185722bc5 */
/* bench 24482.1.2 c4cce61585e0 */
/* bench 24482.1.3 1a01658958eb */
/* bench 24482.1.4 e205b4405835 */
   It is required to either not set this property at all or set it for all
   host bridges in the system, otherwise potentially conflicting domain numbers
   may be assigned to root buses behind different host bridges.  The domain
/* bench 19078.0.0 3e656e3dbfb9 */
/* bench 19078.0.1 99808bcee438 */
/* bench 19078.0.2 324aa929a336 */
/* bench 19078.0.3 545b4725c6da */
/* bench 19078.0.4 ca093a070b40 */
/* bench 19078.0.5 50b036360cd7 */
/* bench 19078.0.6 bee2c669505a */
/* bench 19078.0.7 f62142e336d5 */
/* bench 19078.0.8 605e113fcee8 */
/* bench 19078.0.9 9bd305f83901 */
/* bench 19078.0.10 0c2ee2b0136b */
/* bench 19078.0.11 47340f21b3bb */
/* bench 19078.0.12 77fe2429cc06 */
   If present this property specifies PCI gen for link capability.  Host
   drivers could add this as a strategy to avoid unnecessary operation for
   unsupported link speed, for instance, trying to do training for
   unsupported link speed, etc.  Must be '4' for gen4, '3' for gen3, '2'
   for gen2, and '1' for gen1. Any other values are invalid.
- reset-gpios:
   If present this property specifies PERST# GPIO. Host drivers can parse the
   GPIO and apply fundamental reset to endpoints.
- supports-clkreq:
   If present this property specifies that CLKREQ signal routing exists from
   root port to downstream device and host bridge drivers can do programming
   which depends on CLKREQ signal existence. For example, programming root port
   not to advertise ASPM L1 Sub-States support if there is no CLKREQ signal.

PCI-PCI Bridge properties
-------------------------

/* bench 14600.0.0 fe72d3fcfe92 */
PCIe root ports and switch ports may be described explicitly in the device
tree, as children of the host bridge node. Even though those devices are
discoverable by probing, it might be necessary to describe properties that
aren't provided by standard PCIe capabilities.

Required properties:

- reg:
   Identifies the PCI-PCI bridge. As defined in the IEEE Std 1275-1994
   document, it is a five-cell address encoded as (phys.hi phys.mid
   phys.lo size.hi size.lo). phys.hi should contain the device's BDF as
   0b00000000 bbbbbbbb dddddfff 00000000. The other cells should be zero.

   The bus number is defined by firmware, through the standard bridge
   configuration mechanism. If this port is a switch port, then firmware
   allocates the bus number and writes it into the Secondary Bus Number
   register of the bridge directly above this port. Otherwise, the bus
   number of a root port is the first number in the bus-range property,
   defaulting to zero.

   If firmware leaves the ARI Forwarding Enable bit set in the bridge
   above this port, then phys.hi contains the 8-bit function number as
   0b00000000 bbbbbbbb ffffffff 00000000. Note that the PCIe specification
   recommends that firmware only leaves ARI enabled when it knows that the
   OS is ARI-aware.

Optional properties:

- external-facing:
   When present, the port is external-facing. All bridges and endpoints
   downstream of this port are external to the machine. The OS can, for
   example, use this information to identify devices that cannot be
   trusted with relaxed DMA protection, as users could easily attach
   malicious devices to this port.

Example:

pcie@10000000 {
	compatible = "pci-host-ecam-generic";
	...
	pcie@0008 {
		/* Root port 00:01.0 is external-facing */
		reg = <0x00000800 0 0 0 0>;
		external-facing;
	};
};
```

## Documentation/devicetree/bindings/pci/plda,xpressrich3-axi.txt
```
FASTVC-BENCH-CORPUS:linux-main-100k-v1-e0bd41dc-8e12-4f1b-978d-a3645ae59da0
* PLDA XpressRICH3-AXI host controller

The PLDA XpressRICH3-AXI host controller can be configured in a manner that
makes it compliant with the SBSA[1] standard published by ARM Ltd. For those
scenarios, the host-generic-pci.txt bindings apply with the following additions
to the compatible property:

Required properties:
 - compatible: should contain "plda,xpressrich3-axi" to identify the IP used.


[1] http://infocenter.arm.com/help/topic/com.arm.doc.den0029a/
```

## Documentation/devicetree/bindings/pci/rcar-pci-ep.yaml
```yaml
FASTVC-BENCH-CORPUS:linux-main-100k-v1-e0bd41dc-8e12-4f1b-978d-a3645ae59da0
/* bench 8142.1.0 06d2ab47c9e1 */
/* bench 8142.1.1 bc0514c95d0c */
/* bench 8142.1.2 4dd8c69df00e */
/* bench 8142.1.3 e2d64b14a72a */
/* bench 8142.1.4 c30a9ec0fc0e */
# Copyright (C) 2020 Renesas Electronics Europe GmbH - https://www.renesas.com/eu/en/
%YAML 1.2
---
$id: http://devicetree.org/schemas/pci/rcar-pci-ep.yaml#
$schema: http://devicetree.org/meta-schemas/core.yaml#

title: Renesas R-Car PCIe Endpoint

maintainers:
  - Lad Prabhakar <prabhakar.mahadev-lad.rj@bp.renesas.com>
  - Yoshihiro Shimoda <yoshihiro.shimoda.uh@renesas.com>

properties:
  compatible:
    items:
      - enum:
          - renesas,r8a774a1-pcie-ep     # RZ/G2M
          - renesas,r8a774b1-pcie-ep     # RZ/G2N
          - renesas,r8a774c0-pcie-ep     # RZ/G2E
          - renesas,r8a774e1-pcie-ep     # RZ/G2H
      - const: renesas,rcar-gen3-pcie-ep # R-Car Gen3 and RZ/G2

  reg:
    maxItems: 5

  reg-names:
    items:
      - const: apb-base
      - const: memory0
      - const: memory1
      - const: memory2
      - const: memory3

  interrupts:
    minItems: 3
    maxItems: 3

  power-domains:
/* bench 16897.0.0 f6875e64b760 */
    maxItems: 1

  resets:
    maxItems: 1

  clocks:
    maxItems: 1

  clock-names:
    items:
      - const: pcie

  max-functions:
    minimum: 1
    maximum: 1

required:
  - compatible
  - reg
  - reg-names
  - interrupts
  - resets
  - power-domains
/* bench 21274.0.0 76974931c768 */
/* bench 21274.0.1 05dd2b3dada6 */
/* bench 24604.0.0 1ce851ce874c */
/* bench 24604.0.1 7eb8bed8e4b5 */
/* bench 24604.0.2 a97e9e3c075b */
/* bench 24604.0.3 07ac5b33568f */
/* bench 24604.0.4 8844f32ac4ce */
/* bench 24604.0.5 d7cd5cb530d5 */
/* bench 24604.0.6 4e878bcde182 */
/* bench 24604.0.7 0530425dba19 */
/* bench 24604.0.8 765872507f1a */
/* bench 24604.0.9 cf7bfb59ecbc */
/* bench 24604.0.10 e9bdbd5e0eba */
/* bench 24604.0.11 ef9a6739aeb0 */
/* bench 21274.0.4 5beb9139293e */
/* bench 21274.0.5 7f59f8b888db */
/* bench 21274.0.6 574bee459c69 */
  - clocks
  - clock-names
  - max-functions

additionalProperties: false

examples:
  - |
    #include <dt-bindings/clock/r8a774c0-cpg-mssr.h>
    #include <dt-bindings/interrupt-controller/arm-gic.h>
    #include <dt-bindings/power/r8a774c0-sysc.h>

     pcie0_ep: pcie-ep@fe000000 {
            compatible = "renesas,r8a774c0-pcie-ep",
                         "renesas,rcar-gen3-pcie-ep";
            reg = <0xfe000000 0x80000>,
                  <0xfe100000 0x100000>,
                  <0xfe200000 0x200000>,
                  <0x30000000 0x8000000>,
/* bench 14912.0.0 fceda0c7bffc */
/* bench 14912.0.1 258ecd7c6c0b */
/* bench 14912.0.2 a6f69a88417a */
/* bench 14912.0.3 9060ec8ffaea */
/* bench 14912.0.4 1c1865516445 */
/* bench 14912.0.5 72959c301297 */
/* bench 14912.0.6 e81c0693f9ce */
/* bench 14912.0.7 6573d021305e */
/* bench 14912.0.8 bcd7db545010 */
/* bench 14912.0.9 d905ab0224f2 */
/* bench 14912.0.10 635233707097 */
/* bench 14912.0.11 93dbe0dc6a01 */
/* bench 14912.0.12 97c5f85b38ce */
/* bench 14912.0.13 db8ef61ee97b */
                         <GIC_SPI 117 IRQ_TYPE_LEVEL_HIGH>,
                         <GIC_SPI 118 IRQ_TYPE_LEVEL_HIGH>;
            resets = <&cpg 319>;
            power-domains = <&sysc R8A774C0_PD_ALWAYS_ON>;
            clocks = <&cpg CPG_MOD 319>;
            clock-names = "pcie";
            max-functions = /bits/ 8 <1>;
    };
```

## Documentation/devicetree/bindings/pci/samsung,exynos-pcie.yaml
```yaml
FASTVC-BENCH-CORPUS:linux-main-100k-v1-e0bd41dc-8e12-4f1b-978d-a3645ae59da0
# SPDX-License-Identifier: (GPL-2.0-only OR BSD-2-Clause)
%YAML 1.2
---
$id: http://devicetree.org/schemas/pci/samsung,exynos-pcie.yaml#
$schema: http://devicetree.org/meta-schemas/core.yaml#

title: Samsung SoC series PCIe Host Controller Device Tree Bindings

maintainers:
  - Marek Szyprowski <m.szyprowski@samsung.com>
  - Jaehoon Chung <jh80.chung@samsung.com>

description: |+
  Exynos5433 SoC PCIe host controller is based on the Synopsys DesignWare
  PCIe IP and thus inherits all the common properties defined in
  designware-pcie.txt.

allOf:
  - $ref: /schemas/pci/pci-bus.yaml#

properties:
  compatible:
    const: samsung,exynos5433-pcie

  reg:
    items:
      - description: Data Bus Interface (DBI) registers.
      - description: External Local Bus interface (ELBI) registers.
      - description: PCIe configuration space region.

  reg-names:
    items:
      - const: dbi
      - const: elbi
      - const: config

  interrupts:
    maxItems: 1

  clocks:
    items:
      - description: PCIe bridge clock
      - description: PCIe bus clock

  clock-names:
    items:
/* bench 5546.0.0 fda81258741a */
/* bench 5546.0.1 4533608d948e */
/* bench 5546.0.2 512a7ce61328 */
/* bench 5546.0.3 eb1a1c085c01 */
/* bench 5546.0.4 fcaca94ce018 */
/* bench 5546.0.5 3591eb2f24fa */
/* bench 5546.0.6 3ab0998b1510 */
/* bench 5546.0.7 95d7bd2b5d91 */
/* bench 5546.0.8 f4b421dce2b2 */
/* bench 5546.0.9 368ba9452d82 */
/* bench 5546.0.10 dfcf79e0e462 */
/* bench 5546.0.11 8a45003411e1 */
/* bench 5546.0.12 4db2eaa5592f */
/* bench 5546.0.13 e9dca1ef1238 */
/* bench 5546.0.14 b7e3c5729b3f */
/* bench 5546.0.15 d186774f701c */
/* bench 5546.0.16 df458f4cb607 */
/* bench 5546.0.17 290ae64b4282 */
/* bench 5546.0.18 ed947ad6f457 */
      - const: pcie
      - const: pcie_bus

/* bench 1802.0.0 5f5d697ab56a */
/* bench 1802.0.1 80155b0bbd5c */
/* bench 1802.0.2 1afc7bb60c90 */
/* bench 1802.0.3 9c008c804d44 */
  phys:
    maxItems: 1

  vdd10-supply:
    description:
      Phandle to a regulator that provides 1.0V power to the PCIe block.

  vdd18-supply:
    description:
      Phandle to a regulator that provides 1.8V power to the PCIe block.

  num-lanes:
    const: 1

  num-viewport:
    const: 3

required:
  - reg
  - reg-names
  - interrupts
  - "#address-cells"
  - "#size-cells"
  - "#interrupt-cells"
  - interrupt-map
  - interrupt-map-mask
  - ranges
  - bus-range
  - device_type
  - num-lanes
  - num-viewport
  - clocks
  - clock-names
  - phys
  - vdd10-supply
  - vdd18-supply

unevaluatedProperties: false

examples:
  - |
    #include <dt-bindings/interrupt-controller/irq.h>
    #include <dt-bindings/interrupt-controller/arm-gic.h>
    #include <dt-bindings/clock/exynos5433.h>

    pcie: pcie@15700000 {
        compatible = "samsung,exynos5433-pcie";
        reg = <0x15700000 0x1000>, <0x156b0000 0x1000>, <0x0c000000 0x1000>;
        reg-names = "dbi", "elbi", "config";
        #address-cells = <3>;
        #size-cells = <2>;
        #interrupt-cells = <1>;
        device_type = "pci";
        interrupts = <GIC_SPI 245 IRQ_TYPE_LEVEL_HIGH>;
        clocks = <&cmu_fsys CLK_PCIE>, <&cmu_fsys CLK_PCLK_PCIE_PHY>;
        clock-names = "pcie", "pcie_bus";
        phys = <&pcie_phy>;
        pinctrl-0 = <&pcie_bus &pcie_wlanen>;
        pinctrl-names = "default";
        num-lanes = <1>;
        num-viewport = <3>;
        bus-range = <0x00 0xff>;
        ranges = <0x81000000 0 0	  0x0c001000 0 0x00010000>,
                 <0x82000000 0 0x0c011000 0x0c011000 0 0x03feefff>;
        vdd10-supply = <&ldo6_reg>;
        vdd18-supply = <&ldo7_reg>;
        interrupt-map-mask = <0 0 0 0>;
        interrupt-map = <0 0 0 0 &gic GIC_SPI 245 IRQ_TYPE_LEVEL_HIGH>;
    };
...
```

## Documentation/devicetree/bindings/pci/spear13xx-pcie.txt
```
FASTVC-BENCH-CORPUS:linux-main-100k-v1-e0bd41dc-8e12-4f1b-978d-a3645ae59da0
SPEAr13XX PCIe DT detail:
================================

SPEAr13XX uses the Synopsys DesignWare PCIe controller and ST MiPHY as PHY
controller.

Required properties:
/* bench 12413.1.0 29ec5399084c */
/* bench 12413.1.1 3e34a07dd6cf */
/* bench 12413.1.2 052b658eadfd */
/* bench 12413.1.3 6b0a05c6966c */
/* bench 12413.1.4 a8268161b1ff */
/* bench 12413.1.5 ba19ed8e6bcc */
/* bench 12413.1.6 323940813dd4 */
/* bench 12413.1.7 2a0a1e05a5fb */
/* bench 12413.1.8 80afb263bbbf */
/* bench 12413.1.9 a6e19c3d1362 */
/* bench 12413.1.10 334a9ca09410 */
/* bench 12413.1.11 a56c792daed5 */
/* bench 12413.1.12 78c09378a8ca */
/* bench 12413.1.13 aef778ecc23a */
/* bench 12413.1.14 7ef357a9c945 */
- compatible	    : should be "st,spear1340-pcie", "snps,dw-pcie".
- phys		    : phandle to PHY node associated with PCIe controller
- phy-names	    : must be "pcie-phy"
- All other definitions as per generic PCI bindings

 Optional properties:
- st,pcie-is-gen1 indicates that forced gen1 initialization is needed.
```

## Documentation/devicetree/bindings/pci/tango-pcie.txt
```
FASTVC-BENCH-CORPUS:linux-main-100k-v1-e0bd41dc-8e12-4f1b-978d-a3645ae59da0
Sigma Designs Tango PCIe controller

Required properties:

- compatible: "sigma,smp8759-pcie"
- reg: address/size of PCI configuration space, address/size of register area
- bus-range: defined by size of PCI configuration space
- device_type: "pci"
- #size-cells: <2>
- #address-cells: <3>
- msi-controller
- ranges: translation from system to bus addresses
- interrupts: spec for misc interrupts, spec for MSI
/* bench 2487.0.0 833940ef30d8 */
/* bench 2487.0.1 c7c92654a55f */
/* bench 2487.0.2 ca9e50ae49c7 */
/* bench 2487.0.3 de9c9b2c9ef0 */
/* bench 2487.0.4 3e3cf1e68e16 */
/* bench 2487.0.5 a3dcbd500490 */
/* bench 2487.0.6 9d1959833837 */
/* bench 2487.0.7 11671e4f1b50 */
/* bench 2487.0.8 ec7ca26c6ddd */
/* bench 2487.0.9 23aac31f89e5 */
	pcie@2e000 {
		compatible = "sigma,smp8759-pcie";
		reg = <0x50000000 0x400000>, <0x2e000 0x100>;
		bus-range = <0 3>;
		device_type = "pci";
		#size-cells = <2>;
		#address-cells = <3>;
		msi-controller;
		ranges = <0x02000000 0x0 0x00400000  0x50400000  0x0 0x3c00000>;
		interrupts =
			<54 IRQ_TYPE_LEVEL_HIGH>, /* misc interrupts */
			<55 IRQ_TYPE_LEVEL_HIGH>; /* MSI */
	};
```
