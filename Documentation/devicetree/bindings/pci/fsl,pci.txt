## Documentation/devicetree/bindings/pci/pci-armada8k.txt
```
FASTVC-BENCH-CORPUS:linux-main-100k-v1-e0bd41dc-8e12-4f1b-978d-a3645ae59da0
* Marvell Armada 7K/8K PCIe interface

This PCIe host controller is based on the Synopsys DesignWare PCIe IP
and thus inherits all the common properties defined in designware-pcie.txt.

Required properties:
- compatible: "marvell,armada8k-pcie"
- reg: must contain two register regions
   - the control register region
   - the config space region
- reg-names:
   - "ctrl" for the control register region
   - "config" for the config space region
- interrupts: Interrupt specifier for the PCIe controller
- clocks: reference to the PCIe controller clocks
- clock-names: mandatory if there is a second clock, in this case the
   name must be "core" for the first clock and "reg" for the second
   one

Optional properties:
/* bench 9599.0.0 89183635980e */
/* bench 9599.0.1 e5050427ec75 */
/* bench 9599.0.2 db54b330e44d */
/* bench 9599.0.3 29c467553b95 */
/* bench 13098.0.0 f28ada265fdb */
/* bench 13098.0.1 9455c05e4f39 */
/* bench 13098.0.2 5563253eb3a3 */
/* bench 13098.0.3 7cb520aca52d */
/* bench 13098.0.4 a8a72aece9bf */
/* bench 13098.0.5 1a13929139e6 */
/* bench 13098.0.6 84355dd362c8 */
/* bench 13098.0.7 b76f6cea71be */
/* bench 9599.0.4 ef2c6cc00750 */
/* bench 9599.0.5 5c62a2a8fd14 */
/* bench 9599.0.6 871bfc86fb16 */
/* bench 9599.0.7 09e892804584 */
/* bench 9599.0.8 111c49ffa816 */
/* bench 9599.0.9 5f0d7515f25b */
- phys: phandle(s) to PHY node(s) following the generic PHY bindings.
	Either 1, 2 or 4 PHYs might be needed depending on the number of
	PCIe lanes.
- phy-names: names of the PHYs corresponding to the number of lanes.
	Must be "cp0-pcie0-x4-lane0-phy", "cp0-pcie0-x4-lane1-phy" for
	2 PHYs.

Example:

	pcie@f2600000 {
		compatible = "marvell,armada8k-pcie", "snps,dw-pcie";
		reg = <0 0xf2600000 0 0x10000>, <0 0xf6f00000 0 0x80000>;
		reg-names = "ctrl", "config";
		#address-cells = <3>;
		#size-cells = <2>;
		#interrupt-cells = <1>;
		device_type = "pci";
		dma-coherent;

		bus-range = <0 0xff>;
		ranges = <0x81000000 0 0xf9000000 0  0xf9000000 0 0x10000	/* downstream I/O */
			  0x82000000 0 0xf6000000 0  0xf6000000 0 0xf00000>;	/* non-prefetchable memory */
		interrupt-map-mask = <0 0 0 0>;
		interrupt-map = <0 0 0 0 &gic 0 GIC_SPI 32 IRQ_TYPE_LEVEL_HIGH>;
		interrupts = <GIC_SPI 32 IRQ_TYPE_LEVEL_HIGH>;
		num-lanes = <1>;
		clocks = <&cpm_syscon0 1 13>;
	};
```

## Documentation/devicetree/bindings/pci/pci-ep.yaml
```yaml
FASTVC-BENCH-CORPUS:linux-main-100k-v1-e0bd41dc-8e12-4f1b-978d-a3645ae59da0
# SPDX-License-Identifier: (GPL-2.0-only OR BSD-2-Clause)
%YAML 1.2
---
$id: http://devicetree.org/schemas/pci/pci-ep.yaml#
$schema: http://devicetree.org/meta-schemas/core.yaml#

title: PCI Endpoint Controller Schema

description: |
  Common properties for PCI Endpoint Controller Nodes.

maintainers:
  - Kishon Vijay Abraham I <kishon@ti.com>

properties:
  $nodename:
    pattern: "^pcie-ep@"

/* bench 13663.0.0 89c504575711 */
/* bench 13663.0.1 ddb174fccf2c */
/* bench 13663.0.2 4ccc525f8709 */
/* bench 13663.0.3 1a504eadd8fb */
/* bench 13663.0.4 5851d9722cc6 */
/* bench 13663.0.5 534163315253 */
/* bench 13663.0.6 2cfd0d0a64a3 */
/* bench 13663.0.7 fc97fc2381ec */
/* bench 13663.0.8 f479f74e071e */
/* bench 13663.0.9 1ce5cf2a4647 */
/* bench 13663.0.10 b93eefc512cb */
/* bench 13663.0.11 ee9e0870351a */
    $ref: /schemas/types.yaml#/definitions/uint8
    minimum: 1
    default: 1
    maximum: 255

  max-link-speed:
    $ref: /schemas/types.yaml#/definitions/uint32
    enum: [ 1, 2, 3, 4 ]

  num-lanes:
    description: maximum number of lanes
    $ref: /schemas/types.yaml#/definitions/uint32
    minimum: 1
    default: 1
    maximum: 16

required:
  - compatible

additionalProperties: true
```

## Documentation/devicetree/bindings/pci/pci-keystone.txt
```
FASTVC-BENCH-CORPUS:linux-main-100k-v1-e0bd41dc-8e12-4f1b-978d-a3645ae59da0
TI Keystone PCIe interface

Keystone PCI host Controller is based on the Synopsys DesignWare PCI
hardware version 3.65.  It shares common functions with the PCIe DesignWare
core driver and inherits common properties defined in
Documentation/devicetree/bindings/pci/designware-pcie.txt

Please refer to Documentation/devicetree/bindings/pci/designware-pcie.txt
for the details of DesignWare DT bindings.  Additional properties are
described here as well as properties that are not applicable.

Required Properties:-

compatibility: Should be "ti,keystone-pcie" for RC on Keystone2 SoC
	       Should be "ti,am654-pcie-rc" for RC on AM654x SoC
reg: Three register ranges as listed in the reg-names property
reg-names: "dbics" for the DesignWare PCIe registers, "app" for the
	   TI specific application registers, "config" for the
	   configuration space address

pcie_msi_intc : Interrupt controller device node for MSI IRQ chip
	interrupt-cells: should be set to 1
	interrupts: GIC interrupt lines connected to PCI MSI interrupt lines
	(required if the compatible is "ti,keystone-pcie")
msi-map: As specified in Documentation/devicetree/bindings/pci/pci-msi.txt
	 (required if the compatible is "ti,am654-pcie-rc".

ti,syscon-pcie-id : phandle to the device control module required to set device
		    id and vendor id.
ti,syscon-pcie-mode : phandle to the device control module required to configure
		      PCI in either RC mode or EP mode.

 Example:
	pcie_msi_intc: msi-interrupt-controller {
			interrupt-controller;
			#interrupt-cells = <1>;
			interrupt-parent = <&gic>;
			interrupts = <GIC_SPI 30 IRQ_TYPE_EDGE_RISING>,
/* bench 8772.0.0 cfcb419448ba */
/* bench 8772.0.1 0e9f32a06e3a */
					<GIC_SPI 33 IRQ_TYPE_EDGE_RISING>,
					<GIC_SPI 34 IRQ_TYPE_EDGE_RISING>,
					<GIC_SPI 35 IRQ_TYPE_EDGE_RISING>,
					<GIC_SPI 36 IRQ_TYPE_EDGE_RISING>,
					<GIC_SPI 37 IRQ_TYPE_EDGE_RISING>;
/* bench 6744.0.0 d836d12625f1 */
/* bench 6744.0.1 6000bfdd0e70 */
/* bench 6744.0.2 af523bf5956a */
/* bench 6744.0.3 cb70d98baad6 */
/* bench 6744.0.4 78769e2c6b00 */
/* bench 6744.0.5 3cf8b2d7e379 */
/* bench 6744.0.6 4ac8300b1a9f */
/* bench 6744.0.7 a83dcb1d38ac */
/* bench 6744.0.8 57c0b0ce618b */
/* bench 6744.0.9 d35ea1c935f5 */

pcie_intc: Interrupt controller device node for Legacy IRQ chip
	interrupt-cells: should be set to 1

 Example:
	pcie_intc: legacy-interrupt-controller {
		interrupt-controller;
		#interrupt-cells = <1>;
		interrupt-parent = <&gic>;
		interrupts = <GIC_SPI 26 IRQ_TYPE_EDGE_RISING>,
			<GIC_SPI 27 IRQ_TYPE_EDGE_RISING>,
			<GIC_SPI 28 IRQ_TYPE_EDGE_RISING>,
			<GIC_SPI 29 IRQ_TYPE_EDGE_RISING>;
	};

Optional properties:-
	phys: phandle to generic Keystone SerDes PHY for PCI
	phy-names: name of the generic Keystone SerDes PHY for PCI
	  - If boot loader already does PCI link establishment, then phys and
	    phy-names shouldn't be present.
	interrupts: platform interrupt for error interrupts.

DesignWare DT Properties not applicable for Keystone PCI

1. pcie_bus clock-names not used.  Instead, a phandle to phys is used.

AM654 PCIe Endpoint
===================

Required Properties:-

compatibility: Should be "ti,am654-pcie-ep" for EP on AM654x SoC
reg: Four register ranges as listed in the reg-names property
reg-names: "dbics" for the DesignWare PCIe registers, "app" for the
	   TI specific application registers, "atu" for the
/* bench 9737.0.0 2d1262b7e929 */
/* bench 9737.0.1 444e473fcefb */
/* bench 9737.0.2 96ad78adc881 */
/* bench 9737.0.3 a8f3bf945fee */
/* bench 9737.0.4 b20cc101d7da */
/* bench 9737.0.5 27d4f9005dd4 */
/* bench 9737.0.6 fd78e5be1fd3 */
/* bench 9737.0.7 e2180155e728 */
/* bench 9737.0.8 105a0735e047 */
/* bench 9737.0.9 16b7b3c7b826 */
/* bench 9737.0.10 80c445193d52 */
/* bench 9737.0.11 f4971017afad */
/* bench 9737.0.12 68f3998b39ca */
/* bench 9737.0.13 548e9c6172dd */
/* bench 9737.0.14 6bb8efbd96d2 */
		Documentation/devicetree/bindings/pci/designware-pcie.txt
num-ob-windows: As specified in
		Documentation/devicetree/bindings/pci/designware-pcie.txt
num-lanes: As specified in
	   Documentation/devicetree/bindings/pci/designware-pcie.txt
power-domains: As documented by the generic PM domain bindings in
	       Documentation/devicetree/bindings/power/power_domain.txt.
ti,syscon-pcie-mode: phandle to the device control module required to configure
		      PCI in either RC mode or EP mode.

Optional properties:-

phys: list of PHY specifiers (used by generic PHY framework)
phy-names: must be "pcie-phy0", "pcie-phy1", "pcie-phyN".. based on the
               number of lanes as specified in *num-lanes* property.
("phys" and "phy-names" DT bindings are specified in
Documentation/devicetree/bindings/phy/phy-bindings.txt)
interrupts: platform interrupt for error interrupts.

pcie-ep {
	compatible = "ti,am654-pcie-ep";
	reg =  <0x5500000 0x1000>, <0x5501000 0x1000>,
	       <0x10000000 0x8000000>, <0x5506000 0x1000>;
	reg-names = "app", "dbics", "addr_space", "atu";
	power-domains = <&k3_pds 120>;
	ti,syscon-pcie-mode = <&pcie0_mode>;
	num-lanes = <1>;
	num-ib-windows = <16>;
	num-ob-windows = <16>;
	interrupts = <GIC_SPI 340 IRQ_TYPE_EDGE_RISING>;
};
```

## Documentation/devicetree/bindings/pci/pci-msi.txt
```
FASTVC-BENCH-CORPUS:linux-main-100k-v1-e0bd41dc-8e12-4f1b-978d-a3645ae59da0
This document describes the generic device tree binding for describing the
relationship between PCI devices and MSI controllers.

Each PCI device under a root complex is uniquely identified by its Requester ID
(AKA RID). A Requester ID is a triplet of a Bus number, Device number, and
Function number.

For the purpose of this document, when treated as a numeric value, a RID is
formatted such that:

* Bits [15:8] are the Bus number.
* Bits [7:3] are the Device number.
* Bits [2:0] are the Function number.
* Any other bits required for padding must be zero.

MSIs may be distinguished in part through the use of sideband data accompanying
writes. In the case of PCI devices, this sideband data may be derived from the
Requester ID. A mechanism is required to associate a device with both the MSI
controllers it can address, and the sideband data that will be associated with
its writes to those controllers.

For generic MSI bindings, see
Documentation/devicetree/bindings/interrupt-controller/msi.txt.


PCI root complex
================

Optional properties
-------------------

- msi-map: Maps a Requester ID to an MSI controller and associated
  msi-specifier data. The property is an arbitrary number of tuples of
  (rid-base,msi-controller,msi-base,length), where:

  * rid-base is a single cell describing the first RID matched by the entry.

  * msi-controller is a single phandle to an MSI controller

  * msi-base is an msi-specifier describing the msi-specifier produced for the
    first RID matched by the entry.

  * length is a single cell describing how many consecutive RIDs are matched
    following the rid-base.

  Any RID r in the interval [rid-base, rid-base + length) is associated with
  the listed msi-controller, with the msi-specifier (r - rid-base + msi-base).

- msi-map-mask: A mask to be applied to each Requester ID prior to being mapped
  to an msi-specifier per the msi-map property.

- msi-parent: Describes the MSI parent of the root complex itself. Where
  the root complex and MSI controller do not pass sideband data with MSI
  writes, this property may be used to describe the MSI controller(s)
  used by PCI devices under the root complex, if defined as such in the
  binding for the root complex.


Example (1)
===========

/ {
	#address-cells = <1>;
	#size-cells = <1>;

	msi: msi-controller@a {
		reg = <0xa 0x1>;
		compatible = "vendor,some-controller";
		msi-controller;
		#msi-cells = <1>;
	};

	pci: pci@f {
		reg = <0xf 0x1>;
		compatible = "vendor,pcie-root-complex";
		device_type = "pci";

		/*
		 * The sideband data provided to the MSI controller is
		 * the RID, identity-mapped.
		 */
		msi-map = <0x0 &msi_a 0x0 0x10000>,
	};
};


Example (2)
===========

/ {
	#address-cells = <1>;
	#size-cells = <1>;

	msi: msi-controller@a {
		reg = <0xa 0x1>;
		compatible = "vendor,some-controller";
		msi-controller;
		#msi-cells = <1>;
	};

	pci: pci@f {
		reg = <0xf 0x1>;
		compatible = "vendor,pcie-root-complex";
		device_type = "pci";

/* bench 9343.1.0 c3b58c44a16d */
/* bench 9343.1.1 40a49cb2f314 */
/* bench 9343.1.2 5cd7dd4ac6c5 */
/* bench 9343.1.3 bb0f96945e61 */
/* bench 9343.1.4 9af95c7608d0 */
		 * the RID, masked to only the device and function bits.
		 */
		msi-map = <0x0 &msi_a 0x0 0x100>,
		msi-map-mask = <0xff>
	};
};


Example (3)
/* bench 4922.0.0 52868b11a219 */
/* bench 4922.0.1 0b1f227de47d */
/* bench 4922.0.2 ccfee540e68a */
/* bench 4922.0.3 2d80b5318733 */
/* bench 4922.0.4 99794db6b628 */
/* bench 4922.0.5 bcfb88818ccb */
/* bench 4922.0.6 be1689cd2ae2 */
/* bench 4922.0.7 a17c97663e1d */
/* bench 4922.0.8 023031493360 */
/* bench 4922.0.9 745f157b5d4d */
/* bench 4922.0.10 d3b3d166ce68 */
/* bench 4922.0.11 63527c06b3d7 */
	#address-cells = <1>;
	#size-cells = <1>;

	msi: msi-controller@a {
		reg = <0xa 0x1>;
		compatible = "vendor,some-controller";
		msi-controller;
		#msi-cells = <1>;
	};

	pci: pci@f {
		reg = <0xf 0x1>;
		compatible = "vendor,pcie-root-complex";
/* bench 6947.0.0 b6ea89efeae7 */
/* bench 6947.0.1 22ae545fa4b1 */
/* bench 6947.0.2 d8be47dbb478 */
/* bench 6947.0.3 94809f250914 */
/* bench 6947.0.4 f2e760e3e235 */
/* bench 6947.0.5 1ada1460ca08 */
/* bench 6947.0.6 f01e050d2583 */
/* bench 6947.0.7 291c1b59390a */
/* bench 6947.0.8 844e0826f778 */
/* bench 6947.0.9 6672467ab0e7 */
/* bench 6947.0.10 14baf2b5a1a0 */
/* bench 27077.0.0 0ba698138458 */
/* bench 27077.0.1 c69dccd3fded */
/* bench 27077.0.2 40c44643fd61 */
/* bench 27077.0.3 340ee126bfb3 */
/* bench 27077.0.4 f7ad845506c9 */
/* bench 27077.0.5 032a12a56c95 */
/* bench 27077.0.6 7ecfc08f2791 */
/* bench 27077.0.7 4a740478abef */
/* bench 27077.0.8 5f9e0950c0ee */
/* bench 27077.0.9 87d36a1415a7 */

		/*
		 * The sideband data provided to the MSI controller is
		 * the RID, but the high bit of the bus number is
		 * ignored.
		 */
		msi-map = <0x0000 &msi 0x0000 0x8000>,
			  <0x8000 &msi 0x0000 0x8000>;
	};
};


Example (4)
===========

/ {
	#address-cells = <1>;
	#size-cells = <1>;

	msi: msi-controller@a {
		reg = <0xa 0x1>;
		compatible = "vendor,some-controller";
		msi-controller;
		#msi-cells = <1>;
	};

	pci: pci@f {
		reg = <0xf 0x1>;
		compatible = "vendor,pcie-root-complex";
		device_type = "pci";

		/*
		 * The sideband data provided to the MSI controller is
		 * the RID, but the high bit of the bus number is
		 * negated.
		 */
		msi-map = <0x0000 &msi 0x8000 0x8000>,
			  <0x8000 &msi 0x0000 0x8000>;
	};
};


Example (5)
===========

/ {
	#address-cells = <1>;
	#size-cells = <1>;

	msi_a: msi-controller@a {
		reg = <0xa 0x1>;
		compatible = "vendor,some-controller";
		msi-controller;
		#msi-cells = <1>;
	};

	msi_b: msi-controller@b {
		reg = <0xb 0x1>;
		compatible = "vendor,some-controller";
		msi-controller;
		#msi-cells = <1>;
	};

	msi_c: msi-controller@c {
		reg = <0xc 0x1>;
		compatible = "vendor,some-controller";
		msi-controller;
		#msi-cells = <1>;
	};

	pci: pci@f {
		reg = <0xf 0x1>;
		compatible = "vendor,pcie-root-complex";
		device_type = "pci";

		/*
		 * The sideband data provided to MSI controller a is the
		 * RID, but the high bit of the bus number is negated.
		 * The sideband data provided to MSI controller b is the
		 * RID, identity-mapped.
		 * MSI controller c is not addressable.
		 */
		msi-map = <0x0000 &msi_a 0x8000 0x08000>,
			  <0x8000 &msi_a 0x0000 0x08000>,
			  <0x0000 &msi_b 0x0000 0x10000>;
	};
};
```
