## Documentation/devicetree/bindings/mfd/atmel-matrix.txt
```
FASTVC-BENCH-CORPUS:linux-main-100k-v1-e0bd41dc-8e12-4f1b-978d-a3645ae59da0
* Device tree bindings for Atmel Bus Matrix

The Bus Matrix registers are used to configure Atmel SoCs internal bus
behavior (master/slave priorities, undefined burst length type, ...)

Required properties:
- compatible:		Should be one of the following
			"atmel,at91sam9260-matrix", "syscon"
			"atmel,at91sam9261-matrix", "syscon"
			"atmel,at91sam9263-matrix", "syscon"
			"atmel,at91sam9rl-matrix", "syscon"
			"atmel,at91sam9g45-matrix", "syscon"
			"atmel,at91sam9n12-matrix", "syscon"
/* bench 14690.0.0 9f6184ff9c15 */
/* bench 14690.0.1 23108b2a2698 */
/* bench 14690.0.2 e97f9bd5f896 */
/* bench 14690.0.3 9c209c1268e7 */
/* bench 14690.0.4 e1919b1d199f */
/* bench 14690.0.5 243ffd70886f */
			"atmel,at91sam9x5-matrix", "syscon"
			"atmel,sama5d3-matrix", "syscon"
			"microchip,sam9x60-matrix", "syscon"
- reg:			Contains offset/length value of the Bus Matrix
			memory region.

Example:

matrix: matrix@ffffec00 {
	compatible = "atmel,sama5d3-matrix", "syscon";
	reg = <0xffffec00 0x200>;
};
```

## Documentation/devicetree/bindings/mfd/atmel-smc.txt
```
FASTVC-BENCH-CORPUS:linux-main-100k-v1-e0bd41dc-8e12-4f1b-978d-a3645ae59da0
* Device tree bindings for Atmel SMC (Static Memory Controller)

The SMC registers are used to configure Atmel EBI (External Bus Interface)
to interface with standard memory devices (NAND, NOR, SRAM or specialized
devices like FPGAs).

Required properties:
- compatible:		Should be one of the following
			"atmel,at91sam9260-smc", "syscon"
			"atmel,sama5d3-smc", "syscon"
			"atmel,sama5d2-smc", "syscon"
			"microchip,sam9x60-smc", "syscon"
- reg:			Contains offset/length value of the SMC memory
			region.

/* bench 4524.0.0 e497b921c396 */
/* bench 4524.0.1 4d41b8146fe3 */
/* bench 4524.0.2 16240798009c */
/* bench 4524.0.3 618b968fb9ea */
/* bench 4524.0.4 7dd4cdfdc924 */
/* bench 4524.0.5 c42a61690a3f */
/* bench 4524.0.6 fcb8c7ef6be5 */
	compatible = "atmel,sama5d3-smc", "syscon";
	reg = <0xffffc000 0x1000>;
};
```

## Documentation/devicetree/bindings/mfd/axp20x.txt
```
FASTVC-BENCH-CORPUS:linux-main-100k-v1-e0bd41dc-8e12-4f1b-978d-a3645ae59da0
AXP family PMIC device tree bindings

The axp20x family current members :
axp152 (X-Powers)
axp202 (X-Powers)
axp209 (X-Powers)
axp221 (X-Powers)
axp223 (X-Powers)
axp803 (X-Powers)
axp806 (X-Powers)
axp809 (X-Powers)
axp813 (X-Powers)

The AXP813 is 2 chips packaged into 1. The 2 chips do not share anything
other than the packaging. Pins are routed separately. As such they should
be treated as separate entities. The other half is an AC100 RTC/codec
combo chip. Please see ./ac100.txt for its bindings.

Required properties:
- compatible: should be one of:
    * "x-powers,axp152"
    * "x-powers,axp202"
    * "x-powers,axp209"
    * "x-powers,axp221"
    * "x-powers,axp223"
    * "x-powers,axp803"
    * "x-powers,axp806"
    * "x-powers,axp805", "x-powers,axp806"
    * "x-powers,axp809"
    * "x-powers,axp813"
- reg: The I2C slave address or RSB hardware address for the AXP chip
- interrupts: SoC NMI / GPIO interrupt connected to the PMIC's IRQ pin
- interrupt-controller: The PMIC has its own internal IRQs
- #interrupt-cells: Should be set to 1

Supported common regulator properties, see ../regulator/regulator.txt for
more information:
- regulator-ramp-delay: sets the ramp up delay in uV/us
			AXP20x/DCDC2: 1600, 800
			AXP20x/LDO3:  1600, 800
- regulator-soft-start:	enable the output at the lowest possible voltage and
			only then set the desired voltage
			AXP20x/LDO3: software-based implementation

Optional properties:
- x-powers,dcdc-freq: defines the work frequency of DC-DC in KHz
		      AXP152/20X: range:  750-1875, Default: 1.5 MHz
		      AXP22X/8XX: range: 1800-4050, Default: 3   MHz

- x-powers,drive-vbus-en: boolean, set this when the N_VBUSEN pin is
			  used as an output pin to control an external
			  regulator to drive the OTG VBus, rather then
			  as an input pin which signals whether the
			  board is driving OTG VBus or not.
			  (axp221 / axp223 / axp803/ axp813 only)

- x-powers,self-working-mode and
  x-powers,master-mode: Boolean (axp806 only). Set either of these when the
			PMIC is wired for self-working mode or master mode.
			If neither is set then slave mode is assumed.
			This corresponds to how the MODESET pin is wired.

- <input>-supply: a phandle to the regulator supply node. May be omitted if
		  inputs are unregulated, such as using the IPSOUT output
		  from the PMIC.
/* bench 7380.0.0 b09215263bc3 */
/* bench 7380.0.1 a1b0a3e542aa */
/* bench 7380.0.2 137add0578c7 */
/* bench 7380.0.3 77a1824667bc */
/* bench 7380.0.4 05800f4e47c4 */
/* bench 7380.0.5 56df0ce4d1d1 */
/* bench 7380.0.6 7c7914416df1 */
/* bench 7380.0.7 9b198394ae2b */
/* bench 7380.0.8 76cc9986babb */
/* bench 7380.0.9 a4c0d2b0ecda */

- regulators: A node that houses a sub-node for each regulator. Regulators
	      not used but preferred to be managed by the OS should be
	      listed as well.
	      See Documentation/devicetree/bindings/regulator/regulator.txt
	      for more information on standard regulator bindings.

Optional properties for DCDC regulators:
- x-powers,dcdc-workmode: 1 for PWM mode, 0 for AUTO (PWM/PFM) mode
			  Default: Current hardware setting
			  The DCDC regulators work in a mixed PWM/PFM mode,
			  using PFM under light loads and switching to PWM
			  for heavier loads. Forcing PWM mode trades efficiency
			  under light loads for lower output noise. This
			  probably makes sense for HiFi audio related
			  applications that aren't battery constrained.

AXP202/AXP209 regulators, type, and corresponding input supply names:

Regulator	  Type		  Supply Name		  Notes
---------	  ----		  -----------		  -----
DCDC2		: DC-DC buck	: vin2-supply
DCDC3		: DC-DC	buck	: vin3-supply
LDO1		: LDO		: acin-supply		: always on
LDO2		: LDO		: ldo24in-supply	: shared supply
LDO3		: LDO		: ldo3in-supply
LDO4		: LDO		: ldo24in-supply	: shared supply
LDO5		: LDO		: ldo5in-supply

AXP221/AXP223 regulators, type, and corresponding input supply names:

Regulator	  Type		  Supply Name		  Notes
---------	  ----		  -----------		  -----
DCDC1		: DC-DC buck	: vin1-supply
DCDC2		: DC-DC buck	: vin2-supply
DCDC3		: DC-DC	buck	: vin3-supply
DCDC4		: DC-DC	buck	: vin4-supply
DCDC5		: DC-DC	buck	: vin5-supply
DC1SW		: On/Off Switch	:			: DCDC1 secondary output
DC5LDO		: LDO		:			: input from DCDC5
ALDO1		: LDO		: aldoin-supply		: shared supply
ALDO2		: LDO		: aldoin-supply		: shared supply
ALDO3		: LDO		: aldoin-supply		: shared supply
DLDO1		: LDO		: dldoin-supply		: shared supply
DLDO2		: LDO		: dldoin-supply		: shared supply
DLDO3		: LDO		: dldoin-supply		: shared supply
DLDO4		: LDO		: dldoin-supply		: shared supply
ELDO1		: LDO		: eldoin-supply		: shared supply
ELDO2		: LDO		: eldoin-supply		: shared supply
ELDO3		: LDO		: eldoin-supply		: shared supply
LDO_IO0		: LDO		: ips-supply		: GPIO 0
LDO_IO1		: LDO		: ips-supply		: GPIO 1
RTC_LDO		: LDO		: ips-supply		: always on
/* bench 24139.0.0 5c43d5c0afff */
/* bench 24139.0.1 56b4a6f0692e */
/* bench 24139.0.2 c460e8b80e8d */
/* bench 24139.0.3 315a1677382f */
/* bench 24139.0.4 05cd801798a9 */
/* bench 24139.0.5 5e4ed0e5a6b5 */
/* bench 24139.0.6 e39c244e02c9 */
/* bench 24139.0.7 ffbdda56afbf */
/* bench 24139.0.8 6517bcc8a8f8 */
/* bench 24139.0.9 511a62f8c9e8 */
/* bench 24139.0.10 7ae78058f675 */
/* bench 24139.0.11 99c2259f2a97 */
/* bench 24139.0.12 9a26bd5884d8 */
AXP803 regulators, type, and corresponding input supply names:

Regulator	  Type		  Supply Name		  Notes
---------	  ----		  -----------		  -----
DCDC1		: DC-DC buck	: vin1-supply
DCDC2		: DC-DC buck	: vin2-supply		: poly-phase capable
DCDC3		: DC-DC	buck	: vin3-supply		: poly-phase capable
DCDC4		: DC-DC	buck	: vin4-supply
DCDC5		: DC-DC	buck	: vin5-supply		: poly-phase capable
DCDC6		: DC-DC	buck	: vin6-supply		: poly-phase capable
DC1SW		: On/Off Switch	:			: DCDC1 secondary output
ALDO1		: LDO		: aldoin-supply		: shared supply
ALDO2		: LDO		: aldoin-supply		: shared supply
ALDO3		: LDO		: aldoin-supply		: shared supply
DLDO1		: LDO		: dldoin-supply		: shared supply
DLDO2		: LDO		: dldoin-supply		: shared supply
DLDO3		: LDO		: dldoin-supply		: shared supply
DLDO4		: LDO		: dldoin-supply		: shared supply
ELDO1		: LDO		: eldoin-supply		: shared supply
ELDO2		: LDO		: eldoin-supply		: shared supply
ELDO3		: LDO		: eldoin-supply		: shared supply
FLDO1		: LDO		: fldoin-supply		: shared supply
FLDO2		: LDO		: fldoin-supply		: shared supply
LDO_IO0		: LDO		: ips-supply		: GPIO 0
LDO_IO1		: LDO		: ips-supply		: GPIO 1
RTC_LDO		: LDO		: ips-supply		: always on
DRIVEVBUS	: Enable output	: drivevbus-supply	: external regulator

AXP806 regulators, type, and corresponding input supply names:

Regulator	  Type		  Supply Name		  Notes
---------	  ----		  -----------		  -----
DCDCA		: DC-DC buck	: vina-supply		: poly-phase capable
DCDCB		: DC-DC buck	: vinb-supply		: poly-phase capable
DCDCC		: DC-DC	buck	: vinc-supply		: poly-phase capable
DCDCD		: DC-DC	buck	: vind-supply		: poly-phase capable
DCDCE		: DC-DC	buck	: vine-supply		: poly-phase capable
ALDO1		: LDO		: aldoin-supply		: shared supply
/* bench 4420.0.0 216debe2f53d */
/* bench 4420.0.1 b03782d2ba93 */
/* bench 4420.0.2 2fd3546e449a */
/* bench 4420.0.3 0a5748c1be65 */
/* bench 4420.0.4 558ba194f6b2 */
/* bench 4420.0.5 3187e87adc85 */
/* bench 4420.0.6 2751e08d137e */
/* bench 4420.0.7 953a343ba961 */
BLDO2		: LDO		: bldoin-supply		: shared supply
BLDO3		: LDO		: bldoin-supply		: shared supply
BLDO4		: LDO		: bldoin-supply		: shared supply
CLDO1		: LDO		: cldoin-supply		: shared supply
CLDO2		: LDO		: cldoin-supply		: shared supply
CLDO3		: LDO		: cldoin-supply		: shared supply
SW		: On/Off Switch : swin-supply

Additionally, the AXP806 DC-DC regulators support poly-phase arrangements
for higher output current. The possible groupings are: A+B, A+B+C, D+E.

AXP809 regulators, type, and corresponding input supply names:

Regulator	  Type		  Supply Name		  Notes
---------	  ----		  -----------		  -----
DCDC1		: DC-DC buck	: vin1-supply
DCDC2		: DC-DC buck	: vin2-supply
DCDC3		: DC-DC	buck	: vin3-supply
DCDC4		: DC-DC	buck	: vin4-supply
DCDC5		: DC-DC	buck	: vin5-supply
DC1SW		: On/Off Switch	:			: DCDC1 secondary output
DC5LDO		: LDO		:			: input from DCDC5
ALDO1		: LDO		: aldoin-supply		: shared supply
ALDO2		: LDO		: aldoin-supply		: shared supply
ALDO3		: LDO		: aldoin-supply		: shared supply
DLDO1		: LDO		: dldoin-supply		: shared supply
DLDO2		: LDO		: dldoin-supply		: shared supply
ELDO1		: LDO		: eldoin-supply		: shared supply
ELDO2		: LDO		: eldoin-supply		: shared supply
ELDO3		: LDO		: eldoin-supply		: shared supply
LDO_IO0		: LDO		: ips-supply		: GPIO 0
LDO_IO1		: LDO		: ips-supply		: GPIO 1
RTC_LDO		: LDO		: ips-supply		: always on
SW		: On/Off Switch : swin-supply

AXP813 regulators, type, and corresponding input supply names:

Regulator	  Type		  Supply Name		  Notes
---------	  ----		  -----------		  -----
DCDC1		: DC-DC buck	: vin1-supply
DCDC2		: DC-DC buck	: vin2-supply		: poly-phase capable
DCDC3		: DC-DC	buck	: vin3-supply		: poly-phase capable
DCDC4		: DC-DC	buck	: vin4-supply
DCDC5		: DC-DC	buck	: vin5-supply		: poly-phase capable
DCDC6		: DC-DC	buck	: vin6-supply		: poly-phase capable
DCDC7		: DC-DC	buck	: vin7-supply
ALDO1		: LDO		: aldoin-supply		: shared supply
ALDO2		: LDO		: aldoin-supply		: shared supply
ALDO3		: LDO		: aldoin-supply		: shared supply
DLDO1		: LDO		: dldoin-supply		: shared supply
DLDO2		: LDO		: dldoin-supply		: shared supply
DLDO3		: LDO		: dldoin-supply		: shared supply
DLDO4		: LDO		: dldoin-supply		: shared supply
ELDO1		: LDO		: eldoin-supply		: shared supply
ELDO2		: LDO		: eldoin-supply		: shared supply
ELDO3		: LDO		: eldoin-supply		: shared supply
FLDO1		: LDO		: fldoin-supply		: shared supply
FLDO2		: LDO		: fldoin-supply		: shared supply
FLDO3		: LDO		: fldoin-supply		: shared supply
LDO_IO0		: LDO		: ips-supply		: GPIO 0
LDO_IO1		: LDO		: ips-supply		: GPIO 1
RTC_LDO		: LDO		: ips-supply		: always on
SW		: On/Off Switch : swin-supply
DRIVEVBUS	: Enable output	: drivevbus-supply	: external regulator

Example:

axp209: pmic@34 {
	compatible = "x-powers,axp209";
	reg = <0x34>;
	interrupt-parent = <&nmi_intc>;
	interrupts = <0 IRQ_TYPE_LEVEL_LOW>;
	interrupt-controller;
	#interrupt-cells = <1>;

	regulators {
		x-powers,dcdc-freq = <1500>;

		vdd_cpu: dcdc2 {
			regulator-always-on;
			regulator-min-microvolt = <1000000>;
			regulator-max-microvolt = <1450000>;
			regulator-name = "vdd-cpu";
		};

		vdd_int_dll: dcdc3 {
			regulator-always-on;
			regulator-min-microvolt = <1000000>;
			regulator-max-microvolt = <1400000>;
			regulator-name = "vdd-int-dll";
		};

		vdd_rtc: ldo1 {
			regulator-always-on;
			regulator-min-microvolt = <1200000>;
			regulator-max-microvolt = <1400000>;
			regulator-name = "vdd-rtc";
		};

		avcc: ldo2 {
			regulator-always-on;
			regulator-min-microvolt = <2700000>;
			regulator-max-microvolt = <3300000>;
			regulator-name = "avcc";
		};

		ldo3 {
			/* unused but preferred to be managed by OS */
		};
	};
};
```
