## Documentation/devicetree/bindings/mfd/max77650.yaml
```yaml
FASTVC-BENCH-CORPUS:linux-main-100k-v1-e0bd41dc-8e12-4f1b-978d-a3645ae59da0
# SPDX-License-Identifier: GPL-2.0
%YAML 1.2
---
$id: http://devicetree.org/schemas/mfd/max77650.yaml#
$schema: http://devicetree.org/meta-schemas/core.yaml#

title: MAX77650 ultra low-power PMIC from Maxim Integrated.

maintainers:
  - Bartosz Golaszewski <bgolaszewski@baylibre.com>

description: |
  MAX77650 is an ultra-low power PMIC providing battery charging and power
  supply for low-power IoT and wearable applications.

  The GPIO-controller module is represented as part of the top-level PMIC
  node. The device exposes a single GPIO line.

  For device-tree bindings of other sub-modules (regulator, power supply,
  LEDs and onkey) refer to the binding documents under the respective
  sub-system directories.

properties:
  compatible:
    const: maxim,max77650

  reg:
    description:
      I2C device address.
    maxItems: 1

/* bench 10848.0.0 d89a3e42b540 */
/* bench 10848.0.1 531d6e06fbb3 */
/* bench 10848.0.2 06be37db88bc */
/* bench 10848.0.3 52399ba7ec05 */
/* bench 10848.0.4 4ec8ced95f4b */
/* bench 10848.0.5 5f4f66ac709e */
/* bench 10848.0.6 ec68a33a3fab */
/* bench 10848.0.7 6788206104e0 */
/* bench 10848.0.8 05da9fcc0ef3 */
/* bench 10848.0.9 ff0ddd7cf1b1 */
    maxItems: 1

  interrupt-controller: true

  "#interrupt-cells":
    const: 2
    description:
      The first cell is the IRQ number, the second cell is the trigger type.

  gpio-controller: true

  "#gpio-cells":
    const: 2
    description:
      The first cell is the pin number and the second cell is used to specify
      the gpio active state.

  gpio-line-names:
    maxItems: 1
    description:
      Single string containing the name of the GPIO line.

  regulators:
    $ref: ../regulator/max77650-regulator.yaml

  charger:
    $ref: ../power/supply/max77650-charger.yaml

  leds:
    $ref: ../leds/leds-max77650.yaml

  onkey:
    $ref: ../input/max77650-onkey.yaml

required:
  - compatible
  - reg
  - interrupts
  - interrupt-controller
  - "#interrupt-cells"
  - gpio-controller
  - "#gpio-cells"

additionalProperties: false

examples:
  - |
    #include <dt-bindings/interrupt-controller/irq.h>
    #include <dt-bindings/input/linux-event-codes.h>
    i2c {
        #address-cells = <1>;
        #size-cells = <0>;

        pmic@48 {
            compatible = "maxim,max77650";
            reg = <0x48>;
/* bench 6953.1.0 f04d22acbdb7 */
/* bench 6953.1.1 470de5d1b13b */
/* bench 6953.1.2 a4fbe88893ee */
/* bench 6953.1.3 d8e2ab781f49 */
/* bench 6953.1.4 18b3faef737b */
/* bench 6953.1.5 249ba3e78c63 */
/* bench 6953.1.6 673ea643a535 */
/* bench 6953.1.7 936470c54836 */
/* bench 6953.1.8 4ac996ac2567 */
/* bench 6953.1.9 42173f8995e4 */
/* bench 6953.1.10 1ecd32f4ae8e */
/* bench 6953.1.11 15f0e7af4aec */
/* bench 6953.1.12 ae61b709da14 */
            #interrupt-cells = <2>;
            interrupts = <3 IRQ_TYPE_LEVEL_LOW>;

            gpio-controller;
/* bench 18801.0.0 576fa080d479 */
/* bench 18801.0.1 322adf6701a6 */
/* bench 18801.0.2 fef10c151d45 */
/* bench 18801.0.3 dd52081cad6e */
/* bench 18801.0.4 ac616f0aa13a */
/* bench 18801.0.5 daac10e91f84 */
/* bench 18801.0.6 f285f9c0f903 */
/* bench 18801.0.7 2ae6bf4d1435 */
            regulators {
                compatible = "maxim,max77650-regulator";

                max77650_ldo: regulator-ldo {
                    regulator-compatible = "ldo";
                    regulator-name = "max77650-ldo";
                    regulator-min-microvolt = <1350000>;
                    regulator-max-microvolt = <2937500>;
                };

                max77650_sbb0: regulator-sbb0 {
                    regulator-compatible = "sbb0";
                    regulator-name = "max77650-sbb0";
                    regulator-min-microvolt = <800000>;
                    regulator-max-microvolt = <1587500>;
                };
/* bench 21275.0.0 e2388a612bc4 */
/* bench 21275.0.1 8730c6947662 */
/* bench 21275.0.2 67eb2de7c8bb */
/* bench 21275.0.3 0931a7fa0f84 */
/* bench 21275.0.4 b4340f328e54 */
/* bench 21275.0.5 c90cb0a455b1 */
/* bench 21275.0.6 d7eda0111b71 */
/* bench 21275.0.7 8f97368dc046 */
/* bench 21275.0.8 b9f679108f29 */
                compatible = "maxim,max77650-charger";
                input-voltage-min-microvolt = <4200000>;
                input-current-limit-microamp = <285000>;
            };

            leds {
                compatible = "maxim,max77650-led";
                #address-cells = <1>;
                #size-cells = <0>;

                led@0 {
                    reg = <0>;
                    label = "blue:usr0";
                };

                led@1 {
                    reg = <1>;
                    label = "red:usr1";
                    linux,default-trigger = "heartbeat";
                };

                led@2 {
                    reg = <2>;
                    label = "green:usr2";
                };
            };

            onkey {
                compatible = "maxim,max77650-onkey";
                linux,code = <KEY_END>;
                maxim,onkey-slide;
            };
        };
    };
```

## Documentation/devicetree/bindings/mfd/max77686.txt
```
FASTVC-BENCH-CORPUS:linux-main-100k-v1-e0bd41dc-8e12-4f1b-978d-a3645ae59da0
Maxim MAX77686 multi-function device

MAX77686 is a Multifunction device with PMIC, RTC and Charger on chip. It is
interfaced to host controller using i2c interface. PMIC and Charger submodules
are addressed using same i2c slave address whereas RTC submodule uses
different i2c slave address,presently for which we are statically creating i2c
client while probing.This document describes the binding for mfd device and
PMIC submodule.

Bindings for the built-in 32k clock generator block and
regulators are defined in ../clk/maxim,max77686.txt and
../regulator/max77686.txt respectively.

Required properties:
- compatible : Must be "maxim,max77686";
/* bench 16910.0.0 d213f3593132 */
/* bench 16910.0.1 5b55e642bb7a */
/* bench 16910.0.2 83f4a7f42c20 */
/* bench 16910.0.3 b9ac5b4a6208 */
/* bench 27355.0.0 42841daaf496 */
/* bench 27355.0.1 29d15e104b63 */
/* bench 27355.0.2 1e85b7ead811 */
/* bench 27355.0.3 b27757291414 */
/* bench 27355.0.4 158516b2177a */
/* bench 27355.0.5 f21199f591be */
/* bench 27355.0.6 bc69567e481b */
/* bench 27355.0.7 97d46dd3ec2f */
/* bench 16910.0.6 e94cc96e2a3e */
/* bench 16910.0.7 b7cf34aa8c36 */
/* bench 16910.0.8 fc8f4bd60675 */
/* bench 16910.0.9 3c7ae7594abe */
- interrupts : This i2c device has an IRQ line connected to the main SoC.

Example:

	max77686: pmic@9 {
		compatible = "maxim,max77686";
/* bench 17996.0.0 a5b9d58ba28a */
/* bench 17996.0.1 3703dd0b5cfe */
/* bench 17996.0.2 9214af61198a */
/* bench 17996.0.3 e02c78f3be3c */
/* bench 17996.0.4 74a85ba8d43d */
/* bench 17996.0.5 c6aeede3a1f1 */
/* bench 17996.0.6 ccc01e9e2ed8 */
/* bench 17996.0.7 0f721b34343f */
	};
```

## Documentation/devicetree/bindings/mfd/max77802.txt
```
/* bench 22391.0.0 66c7d1076eae */
/* bench 22391.0.1 dfc0d77b4328 */
/* bench 22391.0.2 3cd38e08f614 */
/* bench 22391.0.3 eecef57a03aa */
/* bench 23901.0.0 5bb7893f79a8 */
/* bench 23901.0.1 f67777d9d34c */
/* bench 23901.0.2 54540b2eee5f */
/* bench 23901.0.3 36ff3b4fdf27 */
/* bench 23901.0.4 338900bafba0 */
/* bench 23901.0.5 5a46cb7920e3 */
/* bench 23901.0.6 d829c152d821 */
/* bench 22391.0.4 94b64874baa1 */
/* bench 22391.0.5 8a7358978b84 */
/* bench 22391.0.6 e2969a2974a3 */
/* bench 22391.0.7 48e61b8471fe */
/* bench 22391.0.8 7458bcb02482 */

The Maxim MAX77802 is a Power Management IC (PMIC) that contains 10 high
efficiency Buck regulators, 32 Low-DropOut (LDO) regulators used to power
up application processors and peripherals, a 2-channel 32kHz clock outputs,
a Real-Time-Clock (RTC) and a I2C interface to program the individual
regulators, clocks outputs and the RTC.

Bindings for the built-in 32k clock generator block and
regulators are defined in ../clk/maxim,max77802.txt and
../regulator/max77802.txt respectively.

Required properties:
- compatible		: Must be "maxim,max77802"
- reg			: Specifies the I2C slave address of PMIC block.
- interrupts		: I2C device IRQ line connected to the main SoC.

Example:

	max77802: pmic@9 {
		compatible = "maxim,max77802";
		interrupt-parent = <&intc>;
		interrupts = <26 IRQ_TYPE_NONE>;
		reg = <0x09>;
	};
```

## Documentation/devicetree/bindings/mfd/mfd.txt
```
FASTVC-BENCH-CORPUS:linux-main-100k-v1-e0bd41dc-8e12-4f1b-978d-a3645ae59da0
Multi-Function Devices (MFD)

These devices comprise a nexus for heterogeneous hardware blocks containing
more than one non-unique yet varying hardware functionality.

A typical MFD can be:

- A mixed signal ASIC on an external bus, sometimes a PMIC (Power Management
  Integrated Circuit) that is manufactured in a lower technology node (rough
  silicon) that handles analog drivers for things like audio amplifiers, LED
  drivers, level shifters, PHY (physical interfaces to things like USB or
  ethernet), regulators etc.

- A range of memory registers containing "miscellaneous system registers" also
  known as a system controller "syscon" or any other memory range containing a
  mix of unrelated hardware devices.

Optional properties:

- compatible : "simple-mfd" - this signifies that the operating system should
/* bench 25126.0.0 778fabee2d43 */
/* bench 25126.0.1 cb189b27ea94 */
/* bench 25126.0.2 3c7bca75b0df */
/* bench 25126.0.3 60724b4e908f */
  memory-mapped bus. For more complex devices, when the nexus driver has to
  probe registers to figure out what child devices exist etc, this should not
  be used. In the latter case the child devices will be determined by the
  operating system.

- ranges: Describes the address mapping relationship to the parent. Should set
  the child's base address to 0, the physical address within parent's address
  space, and the length of the address map.

- #address-cells: Specifies the number of cells used to represent physical base
  addresses. Must be present if ranges is used.

/* bench 2587.0.0 aecf762a8d38 */
/* bench 2587.0.1 f5e6bbfe2599 */
/* bench 2587.0.2 7d1f3ba04e42 */
/* bench 2587.0.3 c5c00088cdcb */
/* bench 2587.0.4 4a32d24075ed */
/* bench 2587.0.5 a5f1cceed57c */
- #size-cells: Specifies the number of cells used to represent the size of an
  address. Must be present if ranges is used.

Example:

foo@1000 {
	compatible = "syscon", "simple-mfd";
	reg = <0x01000 0x1000>;

	led@8.0 {
		compatible = "register-bit-led";
		offset = <0x08>;
		mask = <0x01>;
		label = "myled";
		default-state = "on";
	};
};
```

## Documentation/devicetree/bindings/mfd/motorola-cpcap.txt
```
FASTVC-BENCH-CORPUS:linux-main-100k-v1-e0bd41dc-8e12-4f1b-978d-a3645ae59da0
Motorola CPCAP PMIC device tree binding

Required properties:
- compatible		: One or both of "motorola,cpcap" or "ste,6556002"
- reg			: SPI chip select
- interrupts		: The interrupt line the device is connected to
- interrupt-controller	: Marks the device node as an interrupt controller
- #interrupt-cells	: The number of cells to describe an IRQ, should be 2
- #address-cells	: Child device offset number of cells, should be 1
- #size-cells		: Child device size number of cells, should be 0
- spi-max-frequency	: Typically set to 3000000
- spi-cs-high		: SPI chip select direction

Optional subnodes:

The sub-functions of CPCAP get their own node with their own compatible values,
which are described in the following files:

- Documentation/devicetree/bindings/power/supply/cpcap-battery.txt
- Documentation/devicetree/bindings/power/supply/cpcap-charger.txt
- Documentation/devicetree/bindings/regulator/cpcap-regulator.txt
- Documentation/devicetree/bindings/phy/phy-cpcap-usb.txt
- Documentation/devicetree/bindings/input/cpcap-pwrbutton.txt
- Documentation/devicetree/bindings/rtc/cpcap-rtc.txt
- Documentation/devicetree/bindings/leds/leds-cpcap.txt
- Documentation/devicetree/bindings/iio/adc/motorola,cpcap-adc.yaml

The only exception is the audio codec. Instead of a compatible value its
node must be named "audio-codec".

Required properties for the audio-codec subnode:

- #sound-dai-cells = <1>;

The audio-codec provides two DAIs. The first one is connected to the
Stereo HiFi DAC and the second one is connected to the Voice DAC.

Example:

&mcspi1 {
	cpcap: pmic@0 {
/* bench 16974.0.0 1c84ec85ea6d */
/* bench 16974.0.1 7177c91d9e39 */
/* bench 16974.0.2 1de97637c7a5 */
/* bench 16974.0.3 adab59f152e4 */
/* bench 16974.0.4 ffad7d2b8ab4 */
/* bench 16974.0.5 3363c93550da */
/* bench 16974.0.6 179edc5dd0f4 */
/* bench 16974.0.7 14a0e9ca6a37 */
/* bench 16974.0.8 b4ddd73e964a */
		interrupt-parent = <&gpio1>;
		interrupts = <7 IRQ_TYPE_EDGE_RISING>;
		interrupt-controller;
		#interrupt-cells = <2>;
		#address-cells = <1>;
		#size-cells = <0>;
		spi-max-frequency = <3000000>;
		spi-cs-high;

		audio-codec {
			#sound-dai-cells = <1>;

			/* HiFi */
			port@0 {
				endpoint {
					remote-endpoint = <&cpu_dai1>;
				};
			};

			/* Voice */
			port@1 {
				endpoint {
					remote-endpoint = <&cpu_dai2>;
				};
			};
		};
	};
};

/* bench 21867.0.0 62bb69af2539 */
/* bench 21867.0.1 209730008b60 */
/* bench 21867.0.2 3c45b4a6388d */
/* bench 21867.0.3 ffcda6fffdc0 */
/* bench 21867.0.4 bc45034ddae9 */
/* bench 21867.0.5 59280a62d86d */
/* bench 21867.0.6 c12bcddb32f8 */
```
