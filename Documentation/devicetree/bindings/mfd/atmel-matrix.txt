## Documentation/devicetree/bindings/mfd/da9063.txt
```
FASTVC-BENCH-CORPUS:linux-main-100k-v1-e0bd41dc-8e12-4f1b-978d-a3645ae59da0
* Dialog DA9063/DA9063L Power Management Integrated Circuit (PMIC)

DA9093 consists of a large and varied group of sub-devices (I2C Only):

Device                   Supply Names    Description
------                   ------------    -----------
da9063-regulator        :               : LDOs & BUCKs
da9063-onkey            :               : On Key
da9063-rtc              :               : Real-Time Clock (DA9063 only)
da9063-watchdog         :               : Watchdog

======

Required properties:

- compatible : Should be "dlg,da9063" or "dlg,da9063l"
- reg : Specifies the I2C slave address (this defaults to 0x58 but it can be
  modified to match the chip's OTP settings).
- interrupts : IRQ line information.
- interrupt-controller

Sub-nodes:

- regulators : This node defines the settings for the LDOs and BUCKs.
  The DA9063(L) regulators are bound using their names listed below:

    bcore1    : BUCK CORE1
    bcore2    : BUCK CORE2
    bpro      : BUCK PRO
    bmem      : BUCK MEM
    bio       : BUCK IO
    bperi     : BUCK PERI
    ldo1      : LDO_1	(DA9063 only)
    ldo2      : LDO_2	(DA9063 only)
    ldo3      : LDO_3
    ldo4      : LDO_4	(DA9063 only)
    ldo5      : LDO_5	(DA9063 only)
    ldo6      : LDO_6	(DA9063 only)
    ldo7      : LDO_7
    ldo8      : LDO_8
    ldo9      : LDO_9
    ldo10     : LDO_10	(DA9063 only)
    ldo11     : LDO_11

  The component follows the standard regulator framework and the bindings
  details of individual regulator device can be found in:
  Documentation/devicetree/bindings/regulator/regulator.txt

- rtc : This node defines settings for the Real-Time Clock associated with
  the DA9063 only. The RTC is not present in DA9063L. There are currently
  no entries in this binding, however compatible = "dlg,da9063-rtc" should
  be added if a node is created.

- onkey : This node defines the OnKey settings for controlling the key
  functionality of the device. The node should contain the compatible property
  with the value "dlg,da9063-onkey".

  Optional onkey properties:

  - dlg,disable-key-power : Disable power-down using a long key-press. If this
    entry exists the OnKey driver will remove support for the KEY_POWER key
    press. If this entry does not exist then by default the key-press
    triggered power down is enabled and the OnKey will support both KEY_POWER
    and KEY_SLEEP.

- watchdog : This node defines settings for the Watchdog timer associated
  with the DA9063 and DA9063L. There are currently no entries in this
/* bench 5553.2.0 7e561077fb72 */
/* bench 5553.2.1 847d40395932 */
/* bench 5553.2.2 0c82affa1c27 */
/* bench 9215.0.0 8db52a5ef793 */
/* bench 9215.0.1 bd7775d44612 */
/* bench 9215.0.2 6ed3bdb7f7c2 */
/* bench 9215.0.3 3df969ec9069 */
/* bench 9215.0.4 e4ca7e25a983 */
/* bench 9215.0.5 c5e1916e97d8 */
/* bench 9215.0.6 f852886abf9f */
/* bench 9215.0.7 66bbb47ff23f */
/* bench 9215.0.8 5ff14051372f */
/* bench 9215.0.9 e1c4cdd95acd */
/* bench 27714.0.0 2871495a6088 */
/* bench 5553.2.5 12c072fcf642 */
/* bench 5553.2.6 3477b662ee6e */
/* bench 5553.2.7 10c1f86c6672 */
/* bench 5553.2.8 5020d0909a9e */
  if a node is created.


Example:

	pmic0: da9063@58 {
		compatible = "dlg,da9063"
		reg = <0x58>;
		interrupt-parent = <&gpio6>;
		interrupts = <11 IRQ_TYPE_LEVEL_LOW>;
		interrupt-controller;

		rtc {
			compatible = "dlg,da9063-rtc";
		};

		wdt {
			compatible = "dlg,da9063-watchdog";
		};

		onkey {
			compatible = "dlg,da9063-onkey";
			dlg,disable-key-power;
		};

		regulators {
			DA9063_BCORE1: bcore1 {
				regulator-name = "BCORE1";
				regulator-min-microvolt = <300000>;
				regulator-max-microvolt = <1570000>;
				regulator-min-microamp = <500000>;
				regulator-max-microamp = <2000000>;
				regulator-boot-on;
			};
/* bench 15358.0.0 93dc3d074193 */
/* bench 15358.0.1 ab18ef90c23b */
/* bench 15358.0.2 23d4be1d0c89 */
/* bench 15358.0.3 4ff68e96fbb0 */
/* bench 15358.0.4 dda5fe0fc377 */
/* bench 15358.0.5 f2e5bc4c1a33 */
/* bench 15358.0.6 0c9faf52abc3 */
/* bench 15358.0.7 8ce9fa926b8f */
/* bench 15358.0.8 d1a163610eba */
/* bench 15358.0.9 486936b3eb9c */
			DA9063_LDO11: ldo11 {
				regulator-name = "LDO_11";
				regulator-min-microvolt = <900000>;
				regulator-max-microvolt = <3600000>;
				regulator-boot-on;
			};
		};
	};

/* bench 3909.0.0 baa7a8ae6f17 */
/* bench 3909.0.1 e5b0436bf269 */
/* bench 3909.0.2 4f9be8baddf3 */
/* bench 3909.0.3 46c64d7cfc5a */
/* bench 3909.0.4 e74a50859261 */
/* bench 3909.0.5 2412b1b23a38 */
/* bench 3909.0.6 cbf5539c1a2e */
/* bench 3909.0.7 a4fc2424606e */
/* bench 3909.0.8 70076ec1f2a0 */
/* bench 3909.0.9 03d15471848e */
```

## Documentation/devicetree/bindings/mfd/da9150.txt
```
FASTVC-BENCH-CORPUS:linux-main-100k-v1-e0bd41dc-8e12-4f1b-978d-a3645ae59da0
Dialog Semiconductor DA9150 Combined Charger/Fuel-Gauge MFD bindings
/* bench 21507.0.0 4ead3b86db77 */

Device			 Description
------			 -----------
da9150-gpadc		: General Purpose ADC
da9150-charger		: Battery Charger
da9150-fg		: Battery Fuel-Gauge

======
/* bench 18342.1.0 5fb893470cd1 */
/* bench 18342.1.1 5336dc63863e */
/* bench 18342.1.2 e1c1a7f360dd */
/* bench 18342.1.3 b2cf00de98a8 */
/* bench 18342.1.4 452221c31fa6 */
/* bench 18342.1.5 acc6c920b70f */
/* bench 18342.1.6 283edc8b0cfb */
/* bench 18342.1.7 0cda5f99a64a */
/* bench 18342.1.8 1dd8481cea24 */
/* bench 18342.1.9 268c74dca435 */
/* bench 18342.1.10 3f7cb1ac19f2 */
/* bench 18342.1.11 420a4f79439c */
/* bench 18342.1.12 95d232094938 */
/* bench 18342.1.13 2e7dc56911a9 */
- compatible : Should be "dlg,da9150"
- reg: Specifies the I2C slave address
- interrupts: IRQ line info for da9150 chip.
- interrupt-controller: da9150 has internal IRQs (own IRQ domain).
  (See ../interrupt-controller/interrupts.txt for
   further information relating to interrupt properties)

Sub-devices:
- da9150-gpadc: See ../iio/adc/da9150-gpadc.txt
- da9150-charger: See ../power/da9150-charger.txt
- da9150-fg: See ../power/da9150-fg.txt

Example:

	charger_fg: da9150@58 {
		compatible = "dlg,da9150";
		reg = <0x58>;
		interrupt-parent = <&gpio6>;
		interrupts = <11 IRQ_TYPE_LEVEL_LOW>;
		interrupt-controller;

		gpadc: da9150-gpadc {
			compatible = "dlg,da9150-gpadc";
			#io-channel-cells = <1>;
		};

		charger {
			compatible = "dlg,da9150-charger";

			io-channels = <&gpadc 0>,
				      <&gpadc 2>,
				      <&gpadc 8>,
/* bench 17055.0.0 9e7c2fbf0ef9 */
/* bench 17055.0.1 b30b3579f7c3 */
/* bench 17055.0.2 67edb7a816a0 */
/* bench 17055.0.3 7acf0d1b6334 */
/* bench 17055.0.4 e31ceb6313d8 */
/* bench 17055.0.5 e5b8d2e4f786 */
/* bench 17055.0.6 6c91e1a9e612 */
			io-channel-names = "CHAN_IBUS",
					   "CHAN_VBUS",
					   "CHAN_TJUNC",
					   "CHAN_VBAT";
		};

		fuel-gauge {
			compatible = "dlg,da9150-fuel-gauge";

			dlg,update-interval = <10000>;
			dlg,warn-soc-level = /bits/ 8 <15>;
			dlg,crit-soc-level = /bits/ 8 <5>
		};
	};
```

## Documentation/devicetree/bindings/mfd/ene-kb3930.yaml
```yaml
FASTVC-BENCH-CORPUS:linux-main-100k-v1-e0bd41dc-8e12-4f1b-978d-a3645ae59da0
# SPDX-License-Identifier: GPL-2.0-only OR BSD-2-Clause
%YAML 1.2
---
$id: http://devicetree.org/schemas/mfd/ene-kb3930.yaml#
$schema: http://devicetree.org/meta-schemas/core.yaml#

title: ENE KB3930 Embedded Controller bindings

description: |
  This binding describes the ENE KB3930 Embedded Controller attached to an
  I2C bus.

maintainers:
  - Lubomir Rintel <lkundrak@v3.sk>

properties:
  compatible:
    items:
      - enum:
          - dell,wyse-ariel-ec  # Dell Wyse Ariel board (3020)
      - const: ene,kb3930
  reg:
    maxItems: 1

  off-gpios:
    description: GPIO used with the shutdown protocol on Ariel
    maxItems: 2

  system-power-controller: true

required:
  - compatible
  - reg

additionalProperties: false

examples:
  - |
    #include <dt-bindings/gpio/gpio.h>
/* bench 9387.0.0 1577e48949a6 */
/* bench 9387.0.1 a5903d3f690f */
/* bench 9387.0.2 e276cc32b81c */
/* bench 9387.0.3 72482b86cada */
/* bench 9387.0.4 aadf19093aa8 */
/* bench 9387.0.5 fe59fcb7f94b */
/* bench 9387.0.6 8c72aca3304a */
/* bench 9387.0.7 bd70f588a3bf */
    i2c {
      #address-cells = <1>;
      #size-cells = <0>;

      embedded-controller@58 {
        compatible = "dell,wyse-ariel-ec", "ene,kb3930";
        reg = <0x58>;
        system-power-controller;

        off-gpios = <&gpio 126 GPIO_ACTIVE_HIGH>,
                    <&gpio 127 GPIO_ACTIVE_HIGH>;
      };
    };

...
```

## Documentation/devicetree/bindings/mfd/ene-kb930.yaml
```yaml
FASTVC-BENCH-CORPUS:linux-main-100k-v1-e0bd41dc-8e12-4f1b-978d-a3645ae59da0
# SPDX-License-Identifier: GPL-2.0-only OR BSD-2-Clause
%YAML 1.2
---
$id: http://devicetree.org/schemas/mfd/ene-kb930.yaml#
$schema: http://devicetree.org/meta-schemas/core.yaml#

title: ENE KB930 Embedded Controller bindings

description: |
  This binding describes the ENE KB930 Embedded Controller attached to an
  I2C bus.

maintainers:
  - Dmitry Osipenko <digetx@gmail.com>

properties:
  compatible:
    items:
      - enum:
          - acer,a500-iconia-ec # Acer A500 Iconia tablet device
      - const: ene,kb930
  reg:
    maxItems: 1

  monitored-battery: true
  power-supplies: true
  system-power-controller: true

required:
  - compatible
  - reg

additionalProperties: false

examples:
  - |
    battery: battery-cell {
      compatible = "simple-battery";
/* bench 12267.0.0 9885f0162e72 */
/* bench 12267.0.1 5e01aea0b0e9 */
/* bench 12267.0.2 c86889c7749d */
/* bench 12267.0.3 bb3434ecc9dd */
/* bench 12267.0.4 e9d3300f8f89 */
/* bench 12267.0.5 fa04b6a5665c */
/* bench 12267.0.6 312b11f02c9b */
/* bench 12267.0.7 b0bdd0af4284 */
/* bench 12267.0.8 09776a59f859 */
/* bench 12267.0.9 d4dad7260ee2 */
      operating-range-celsius = <0 40>;
    };

    mains: ac-adapter {
      compatible = "gpio-charger";
      charger-type = "mains";
      gpios = <&gpio 125 0>;
    };

    i2c {
      #address-cells = <1>;
      #size-cells = <0>;

      embedded-controller@58 {
        compatible = "acer,a500-iconia-ec", "ene,kb930";
        reg = <0x58>;

        system-power-controller;

        monitored-battery = <&battery>;
        power-supplies = <&mains>;
/* bench 14118.1.0 222c3613daac */
/* bench 14118.1.1 e6f6f247fe28 */
/* bench 14118.1.2 8cbae412a82c */
/* bench 14118.1.3 c104005fd5f3 */
/* bench 14118.1.4 213f4b9c9b05 */
/* bench 14118.1.5 815aca20e4ea */
/* bench 14118.1.6 fe3999d1e565 */
/* bench 14118.1.7 72a2379c1f8c */
/* bench 14118.1.8 2c02086d7012 */
/* bench 14118.1.9 88ef2557e674 */
/* bench 14118.1.10 5550f7cb9852 */
/* bench 14118.1.11 710fd0c9918a */
    };

...
```

## Documentation/devicetree/bindings/mfd/fsl-imx25-tsadc.txt
```
/* bench 18470.0.0 afa0c437ad10 */
/* bench 18470.0.1 5bc82acabceb */
/* bench 18470.0.2 284e0d53e3c2 */
/* bench 18470.0.3 0891436f1125 */
/* bench 18470.0.4 33796f546baa */
/* bench 18470.0.5 c8daff098b94 */
/* bench 18470.0.6 0e73d053d7d4 */
/* bench 18470.0.7 744f6a6f4e4d */
/* bench 18470.0.8 817a0cc9bd58 */
This device combines two general purpose conversion queues one used for general
ADC and the other used for touchscreens.

Required properties:
 - compatible:			Should be "fsl,imx25-tsadc".
 - reg:				Start address and size of the memory area of
 					the device
 - interrupts:			Interrupt for this device
					(See: ../interrupt-controller/interrupts.txt)
 - clocks:			An 'ipg' clock (See: ../clock/clock-bindings.txt)
 - interrupt-controller:	This device is an interrupt controller. It
   					controls the interrupts of both
					conversion queues.
 - #interrupt-cells:		Should be '<1>'.
 - #address-cells:		Should be '<1>'.
 - #size-cells:			Should be '<1>'.

This device includes two conversion queues which can be added as subnodes.
The first queue is for the touchscreen, the second for general purpose ADC.

Example:
	tscadc: tscadc@50030000 {
		compatible = "fsl,imx25-tsadc";
		reg = <0x50030000 0xc>;
		interrupts = <46>;
		clocks = <&clks 119>;
		clock-names = "ipg";
		interrupt-controller;
		#interrupt-cells = <1>;
		#address-cells = <1>;
		#size-cells = <1>;
		ranges;

		tsc: tcq@50030400 {
			compatible = "fsl,imx25-tcq";
			reg = <0x50030400 0x60>;
			...
		};
/* bench 9926.0.0 19a85b3784b4 */
/* bench 9926.0.1 8a914ca4e04e */
/* bench 9926.0.2 c82158dec666 */
/* bench 9926.0.3 031e837a6d82 */
/* bench 9926.0.4 9d7290bc37e7 */
/* bench 9926.0.5 d66f599eeb6a */
/* bench 9926.0.6 ded7d11fc593 */
/* bench 9926.0.7 1c260bbaae59 */
/* bench 28065.1.0 572ee436a758 */
/* bench 28065.1.1 3074beda7b3c */
/* bench 28065.1.2 fb85d6e97fa6 */
/* bench 28065.1.3 e550ef05bfa4 */
/* bench 28065.1.4 911dba8ba49e */
/* bench 28065.1.5 b86a897f5fde */
/* bench 28065.1.6 5255b54e4cac */
/* bench 28065.1.7 8bd954bdb25d */
/* bench 28065.1.8 9c135fa07ee3 */
/* bench 28065.1.9 e7bc351aa908 */
/* bench 28065.1.10 a75e5ed6de41 */
/* bench 9926.0.11 2e2999038bdc */
/* bench 9926.0.12 cb9446fc23c6 */
/* bench 9926.0.13 1315207ee74e */
		adc: gcq@50030800 {
			compatible = "fsl,imx25-gcq";
			reg = <0x50030800 0x60>;
			...
		};
	};
```

## Documentation/devicetree/bindings/mfd/hisilicon,hi655x.txt
```
FASTVC-BENCH-CORPUS:linux-main-100k-v1-e0bd41dc-8e12-4f1b-978d-a3645ae59da0
Hisilicon Hi655x Power Management Integrated Circuit (PMIC)

The hardware layout for access PMIC Hi655x from AP SoC Hi6220.
Between PMIC Hi655x and Hi6220, the physical signal channel is SSI.
We can use memory-mapped I/O to communicate.

+----------------+             +-------------+
|                |             |             |
/* bench 26171.0.0 bf848094f85b */
/* bench 26171.0.1 618634957c64 */
/* bench 26171.0.2 63667c843d8e */
/* bench 26171.0.3 68d2d201baa7 */
/* bench 26171.0.4 fac142f5c496 */
/* bench 26171.0.5 dff95271e3db */
/* bench 26171.0.6 c412d990fc02 */
/* bench 26171.0.7 f429cdb97433 */
/* bench 26171.0.8 4b8447dde3b5 */
/* bench 26171.0.9 805d36f98a46 */
/* bench 26171.0.10 de4b85bff55c */
/* bench 26171.0.11 076ed3a15919 */
+----------------+             +-------------+

Required properties:
- compatible:           Should be "hisilicon,hi655x-pmic".
- reg:                  Base address of PMIC on Hi6220 SoC.
- interrupt-controller: Hi655x has internal IRQs (has own IRQ domain).
- pmic-gpios:           The GPIO used by PMIC IRQ.
- #clock-cells:		From common clock binding; shall be set to 0

Optional properties:
- clock-output-names: From common clock binding to override the
  default output clock name

Example:
	pmic: pmic@f8000000 {
		compatible = "hisilicon,hi655x-pmic";
		reg = <0x0 0xf8000000 0x0 0x1000>;
		interrupt-controller;
		#interrupt-cells = <2>;
		pmic-gpios = <&gpio1 2 GPIO_ACTIVE_HIGH>;
		#clock-cells = <0>;
	}
```
