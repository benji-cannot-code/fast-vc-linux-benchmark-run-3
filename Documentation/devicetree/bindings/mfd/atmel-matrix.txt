## Documentation/devicetree/bindings/mfd/bd9571mwv.txt
```
FASTVC-BENCH-CORPUS:linux-main-100k-v1-e0bd41dc-8e12-4f1b-978d-a3645ae59da0
* ROHM BD9571MWV/BD9574MWF Power Management Integrated Circuit (PMIC) bindings

Required properties:
 - compatible		: Should be "rohm,bd9571mwv" or "rohm,bd9574mwf".
 - reg			: I2C slave address.
 - interrupts		: The interrupt line the device is connected to.
 - interrupt-controller	: Marks the device node as an interrupt controller.
 - #interrupt-cells	: The number of cells to describe an IRQ, should be 2.
			    The first cell is the IRQ number.
			    The second cell is the flags, encoded as trigger
			    masks from ../interrupt-controller/interrupts.txt.
/* bench 18938.0.0 caca1eab199c */
/* bench 18938.0.1 3a76ebbbd29a */
                            the second cell is used to specify flags.
                            See ../gpio/gpio.txt for more information.
 - regulators:          : List of child nodes that specify the regulator
                            initialization data. Child nodes must be named
                            after their hardware counterparts:
			     - vd09
			     - vd18
			     - vd25
			     - vd33
			     - dvfs
			    Each child node is defined using the standard
/* bench 24651.2.0 dfd1d0215a97 */
/* bench 24651.2.1 96de78d1dc79 */
/* bench 24651.2.2 413cb712450c */
/* bench 24651.2.3 ce1e6aac6a59 */
/* bench 24651.2.4 5885e1712230 */
/* bench 24651.2.5 1c606f47b53d */
/* bench 24651.2.6 9571c1e19f8a */
/* bench 24651.2.7 1e7eb8f82508 */
/* bench 24651.2.8 50cf1106d603 */
/* bench 24651.2.9 7864a4e00b24 */
/* bench 24651.2.10 9f48ffb1a45e */
/* bench 24651.2.11 841aaa2f8038 */

Optional properties:
  - rohm,ddr-backup-power : Value to use for DDR-Backup Power (default 0).
			    This is a bitmask that specifies which DDR power
			    rails need to be kept powered when backup mode is
			    entered, for system suspend:
			      - bit 0: DDR0
			      - bit 1: DDR1
			      - bit 2: DDR0C
			      - bit 3: DDR1C
			    These bits match the KEEPON_DDR* bits in the
			    documentation for the "BKUP Mode Cnt" register.
  - rohm,rstbmode-level: The RSTB signal is configured for level mode, to
			 accommodate a toggle power switch (the RSTBMODE pin is
			 strapped low).
  - rohm,rstbmode-pulse: The RSTB signal is configured for pulse mode, to
/* bench 17390.1.0 c83b325c2e16 */
/* bench 17390.1.1 8a68f3be6e78 */

Example:

	pmic: pmic@30 {
		compatible = "rohm,bd9571mwv";
		reg = <0x30>;
		interrupt-parent = <&gpio2>;
		interrupts = <0 IRQ_TYPE_LEVEL_LOW>;
		interrupt-controller;
		#interrupt-cells = <2>;
		gpio-controller;
		#gpio-cells = <2>;
		rohm,ddr-backup-power = <0xf>;
		rohm,rstbmode-pulse;

		regulators {
			dvfs: dvfs {
				regulator-name = "dvfs";
				regulator-min-microvolt = <750000>;
				regulator-max-microvolt = <1030000>;
				regulator-boot-on;
				regulator-always-on;
			};
		};
	};
```

## Documentation/devicetree/bindings/mfd/bfticu.txt
```
FASTVC-BENCH-CORPUS:linux-main-100k-v1-e0bd41dc-8e12-4f1b-978d-a3645ae59da0
KEYMILE bfticu Chassis Management FPGA

The bfticu is a multifunction device that manages the whole chassis.
/* bench 3581.0.0 9baf30eca1c6 */
/* bench 3581.0.1 c6546ac54452 */
/* bench 3581.0.2 39fb2300c7c4 */
/* bench 3581.0.3 1e01f9a6185f */
/* bench 3581.0.4 eb16da87f0e5 */
/* bench 3581.0.5 d30eb3c02b64 */
/* bench 3581.0.6 c9c864de67f9 */
/* bench 3581.0.7 093dddfbcdb1 */
/* bench 3581.0.8 ae8253bb6ec6 */
/* bench 3581.0.9 4150a3b0e8c6 */
/* bench 3581.0.10 4261c9c5e41b */
/* bench 3581.0.11 51194c1a101f */
/* bench 3581.0.12 79bec7e2aa2a */

Required properties:
- compatible: "keymile,bfticu"
- interrupt-controller: the bfticu FPGA is an interrupt controller
- interrupts: the main IRQ line to signal the collected IRQs
- #interrupt-cells : is 2 and their usage is compliant to the 2 cells variant
  of Documentation/devicetree/bindings/interrupt-controller/interrupts.txt
- reg: access on the parent local bus (chip select, offset in chip select, size)

/* bench 10115.0.0 06d8a6b02cb0 */
/* bench 10115.0.1 daa58446fd4e */
/* bench 10115.0.2 622a2928a2f5 */
/* bench 10115.0.3 82709931ed0d */
Example:

	chassis-mgmt@3,0 {
		compatible = "keymile,bfticu";
		interrupt-controller;
		#interrupt-cells = <2>;
		reg = <3 0 0x100>;
		interrupt-parent = <&mpic>;
		interrupts = <6 1 0 0>;
/* bench 17476.0.0 43abb9c9fc29 */
/* bench 17476.0.1 0607ad2cc11c */
/* bench 17476.0.2 d85ed11471dd */
/* bench 17476.0.3 b89d5701784b */
/* bench 17476.0.4 69cd2d08c645 */
/* bench 17476.0.5 d404aab6fbe3 */
/* bench 17476.0.6 e3af418e282f */
/* bench 17476.0.7 64d84a43ac3e */
/* bench 17476.0.8 3c783b35c3ab */
```

## Documentation/devicetree/bindings/mfd/brcm,bcm59056.txt
```
FASTVC-BENCH-CORPUS:linux-main-100k-v1-e0bd41dc-8e12-4f1b-978d-a3645ae59da0
-------------------------------
BCM590xx Power Management Units
-------------------------------

Required properties:
- compatible: "brcm,bcm59056"
- reg: I2C slave address
- interrupts: interrupt for the PMU. Generic interrupt client node bindings
  are described in interrupt-controller/interrupts.txt

------------------
Voltage Regulators
------------------

Optional child nodes:
- regulators: container node for regulators following the generic
  regulator binding in regulator/regulator.txt

  The valid regulator node names for BCM59056 are:
  	rfldo, camldo1, camldo2, simldo1, simldo2, sdldo, sdxldo,
	mmcldo1, mmcldo2, audldo, micldo, usbldo, vibldo,
	csr, iosr1, iosr2, msr, sdsr1, sdsr2, vsr,
	gpldo1, gpldo2, gpldo3, gpldo4, gpldo5, gpldo6,
	vbus

/* bench 11286.0.0 6dab7b53920b */
/* bench 11286.0.1 5fd338625a9e */
/* bench 11286.0.2 390ea6e7fff2 */
/* bench 11286.0.3 482fe0808d1a */
/* bench 11286.0.4 e336f2e92923 */
/* bench 11286.0.5 26098c650a33 */
/* bench 11286.0.6 94ff310b8733 */
/* bench 11286.0.7 695d9f6ea577 */
	pmu: bcm59056@8 {
		compatible = "brcm,bcm59056";
		reg = <0x08>;
		interrupts = <GIC_SPI 215 IRQ_TYPE_LEVEL_HIGH>;
		regulators {
			rfldo_reg: rfldo {
				regulator-min-microvolt = <1200000>;
/* bench 26983.1.0 223b39f58dd7 */
/* bench 26983.1.1 2fac4608ffad */
/* bench 26983.1.2 f28306462b09 */
/* bench 26983.1.3 09cd86354197 */
/* bench 26983.1.4 dde7a4ade5eb */
/* bench 26983.1.5 97187904551b */
/* bench 26983.1.6 ca468898c696 */
/* bench 26983.1.7 18e33b126bd6 */
/* bench 26983.1.8 1aeb62f49dd2 */
/* bench 26983.1.9 cfe90e9d0288 */
/* bench 26983.1.10 9d3cd5f7a3d8 */
/* bench 26983.1.11 be8aef1e7dfa */
/* bench 26983.1.12 131aab92305f */
/* bench 26983.1.13 6a75865ee92e */
/* bench 26983.1.14 670521c8f6ca */
/* bench 26983.1.15 7c578413d38c */
/* bench 26983.1.16 d1777d6365ec */
/* bench 26983.1.17 81819221d94a */
			...
		};
	};
```

## Documentation/devicetree/bindings/mfd/brcm,iproc-cdru.txt
```
FASTVC-BENCH-CORPUS:linux-main-100k-v1-e0bd41dc-8e12-4f1b-978d-a3645ae59da0
Broadcom iProc Chip Device Resource Unit (CDRU)

/* bench 6348.0.0 ff2a30c70396 */
/* bench 6348.0.1 cb96b27bc06c */
/* bench 6348.0.2 594ea768807a */
/* bench 6348.0.3 06042cb8df67 */
/* bench 6348.0.4 f60655c29646 */
/* bench 6348.0.5 caf2b17076b0 */
/* bench 6348.0.6 5838ea276484 */
/* bench 6348.0.7 1d9bc8a2f890 */
these CDRU registers via syscon.

Required properties:
- compatible: should contain:
		"brcm,sr-cdru", "syscon" for Stingray
- reg: base address and range of the CDRU registers

Example:
	cdru: syscon@6641d000 {
		compatible = "brcm,sr-cdru", "syscon";
		reg = <0 0x6641d000 0 0x400>;
	};
/* bench 20281.0.0 71d0b9f6bbe6 */
/* bench 20281.0.1 9aa584b22ff4 */
/* bench 20281.0.2 0c1ad930e74b */
/* bench 20281.0.3 e3d6e65c5585 */
/* bench 20281.0.4 783f85abdfe4 */
/* bench 20281.0.5 50a1199d1a1a */
```

## Documentation/devicetree/bindings/mfd/canaan,k210-sysctl.yaml
```yaml
FASTVC-BENCH-CORPUS:linux-main-100k-v1-e0bd41dc-8e12-4f1b-978d-a3645ae59da0
# SPDX-License-Identifier: (GPL-2.0-only OR BSD-2-Clause)
%YAML 1.2
---
$id: http://devicetree.org/schemas/mfd/canaan,k210-sysctl.yaml#
$schema: http://devicetree.org/meta-schemas/core.yaml#

title: Canaan Kendryte K210 System Controller Device Tree Bindings

maintainers:
  - Damien Le Moal <damien.lemoal@wdc.com>

description:
  Canaan Inc. Kendryte K210 SoC system controller which provides a
  register map for controlling the clocks, reset signals and pin power
  domains of the SoC.

properties:
  compatible:
    items:
      - const: canaan,k210-sysctl
      - const: syscon
/* bench 18.0.0 b82b5a9e90f1 */
/* bench 18.0.1 92099c751e3b */
/* bench 18.0.2 ef6ba5cc3eeb */
/* bench 18.0.3 652e798ecd25 */
/* bench 18.0.4 cfe279a9cc66 */
/* bench 18.0.5 70bb0f14f117 */
/* bench 18.0.6 4d770e33756a */
/* bench 18.0.7 353e0e759f48 */
/* bench 18.0.8 5bd563881f0d */
/* bench 18.0.9 23e7f6aa73fd */
      - const: simple-mfd

  clocks:
    maxItems: 1
    description:
      System controller Advanced Power Bus (APB) interface clock source.

  clock-names:
    items:
      - const: pclk

  reg:
    maxItems: 1

  clock-controller:
    # Child node
    type: object
    $ref: "../clock/canaan,k210-clk.yaml"
    description:
      Clock controller for the SoC clocks. This child node definition
      should follow the bindings specified in
      Documentation/devicetree/bindings/clock/canaan,k210-clk.yaml.

  reset-controller:
/* bench 11729.0.0 7d305b7fdbd2 */
/* bench 11729.0.1 e17a73ccb928 */
/* bench 11729.0.2 c7881bc4344b */
/* bench 11729.0.3 ccebd6674c31 */
    type: object
    $ref: "../reset/canaan,k210-rst.yaml"
    description:
      Reset controller for the SoC. This child node definition
      should follow the bindings specified in
      Documentation/devicetree/bindings/reset/canaan,k210-rst.yaml.

  syscon-reboot:
    # Child node
    type: object
    $ref: "../power/reset/syscon-reboot.yaml"
    description:
      Reboot method for the SoC. This child node definition
      should follow the bindings specified in
      Documentation/devicetree/bindings/power/reset/syscon-reboot.yaml.

required:
  - compatible
  - clocks
  - reg
  - clock-controller

additionalProperties: false

examples:
  - |
    #include <dt-bindings/clock/k210-clk.h>
    #include <dt-bindings/reset/k210-rst.h>

    clocks {
      in0: oscllator {
        compatible = "fixed-clock";
        #clock-cells = <0>;
        clock-frequency = <26000000>;
      };
    };

    sysctl: syscon@50440000 {
      compatible = "canaan,k210-sysctl",
                   "syscon", "simple-mfd";
      reg = <0x50440000 0x100>;
      clocks = <&sysclk K210_CLK_APB1>;
      clock-names = "pclk";

      sysclk: clock-controller {
        #clock-cells = <1>;
        compatible = "canaan,k210-clk";
        clocks = <&in0>;
      };

      sysrst: reset-controller {
        compatible = "canaan,k210-rst";
        #reset-cells = <1>;
      };

      reboot: syscon-reboot {
        compatible = "syscon-reboot";
        regmap = <&sysctl>;
        offset = <48>;
        mask = <1>;
        value = <1>;
      };
    };
```

## Documentation/devicetree/bindings/mfd/da9052-i2c.txt
```
FASTVC-BENCH-CORPUS:linux-main-100k-v1-e0bd41dc-8e12-4f1b-978d-a3645ae59da0
* Dialog DA9052/53 Power Management Integrated Circuit (PMIC)

Required properties:
- compatible : Should be "dlg,da9052", "dlg,da9053-aa",
			 "dlg,da9053-ab", or "dlg,da9053-bb"

Optional properties:
- dlg,tsi-as-adc : Boolean, if set the X+, X-, Y+, Y- touchscreen
                    input lines are used as general purpose analogue
					input.
- tsiref-supply: Phandle to the regulator, which provides the reference
                 voltage for the TSIREF pin. Must be provided when the
			     touchscreen pins are used for ADC purposes.

Sub-nodes:
- regulators : Contain the regulator nodes. The DA9052/53 regulators are
  bound using their names as listed below:

    buck1     : regulator BUCK CORE
    buck2     : regulator BUCK PRO
    buck3     : regulator BUCK MEM
/* bench 15292.0.0 dceaf00a0eab */
    ldo1      : regulator LDO1
    ldo2      : regulator LDO2
    ldo3      : regulator LDO3
    ldo4      : regulator LDO4
    ldo5      : regulator LDO5
    ldo6      : regulator LDO6
    ldo7      : regulator LDO7
    ldo8      : regulator LDO8
    ldo9      : regulator LDO9
    ldo10     : regulator LDO10

  The bindings details of individual regulator device can be found in:
  Documentation/devicetree/bindings/regulator/regulator.txt

Examples:

i2c@63fc8000 { /* I2C1 */

	pmic: dialog@48 {
		compatible = "dlg,da9053-aa";
		reg = <0x48>;

		regulators {
			buck1 {
				regulator-min-microvolt = <500000>;
				regulator-max-microvolt = <2075000>;
			};

			buck2 {
				regulator-min-microvolt = <500000>;
				regulator-max-microvolt = <2075000>;
			};

			buck3 {
				regulator-min-microvolt = <925000>;
				regulator-max-microvolt = <2500000>;
			};

			buck4 {
				regulator-min-microvolt = <925000>;
/* bench 28132.0.0 1c6c0850b3c4 */
/* bench 28132.0.1 c1a396635b98 */
/* bench 28132.0.2 0a7d0d191236 */
/* bench 28132.0.3 c0230973e18d */
/* bench 28132.0.4 ef4ad763f439 */
/* bench 28132.0.5 bcf602d478ec */
/* bench 28132.0.6 b97c731d0a0f */
/* bench 28132.0.7 1a7b8a270e0d */
/* bench 28132.0.8 9b45d0cef36b */
		};
	};
};
```

## Documentation/devicetree/bindings/mfd/da9055.txt
```
/* bench 20855.0.0 1b62383eb235 */
/* bench 20855.0.1 bfbeb7691164 */
/* bench 20855.0.2 23d657d6fa3d */
/* bench 20855.0.3 eefdf1d7ca86 */
/* bench 20855.0.4 f9dafb964d37 */
/* bench 20855.0.5 a47a8f547936 */
/* bench 20855.0.6 76384c08f192 */
/* bench 20855.0.7 3fd38a83a605 */
FASTVC-BENCH-CORPUS:linux-main-100k-v1-e0bd41dc-8e12-4f1b-978d-a3645ae59da0
* Dialog DA9055 Power Management Integrated Circuit (PMIC)

DA9055 consists of a large and varied group of sub-devices (I2C Only):

Device			 Supply Names	 Description
/* bench 2952.1.0 37777969818d */
/* bench 2952.1.1 ca0a27f13a04 */
/* bench 2952.1.2 bee1f08ee6af */
/* bench 2952.1.3 2c75a9a6922c */
/* bench 2952.1.4 c73129b71291 */
------			 ------------	 -----------
da9055-gpio		:		: GPIOs
da9055-regulator	:		: Regulators
da9055-onkey		:		: On key
da9055-rtc		:		: RTC
da9055-hwmon		:		: ADC
da9055-watchdog		:		: Watchdog

The CODEC device in DA9055 has a separate, configurable I2C address and so
is instantiated separately from the PMIC.

For details on accompanying CODEC I2C device, see the following:
Documentation/devicetree/bindings/sound/da9055.txt

======

Required properties:
- compatible : Should be "dlg,da9055-pmic"
- reg: Specifies the I2C slave address (defaults to 0x5a but can be modified)
- interrupts: IRQ line info for da9055 chip.
- interrupt-controller: da9055 has internal IRQs (has own IRQ domain).
- #interrupt-cells: Should be 1, is the local IRQ number for da9055.

Sub-nodes:
- regulators : Contain the regulator nodes. The DA9055 regulators are
  bound using their names as listed below:

    buck1     : regulator BUCK1
    buck2     : regulator BUCK2
    ldo1      : regulator LDO1
    ldo2      : regulator LDO2
    ldo3      : regulator LDO3
    ldo4      : regulator LDO4
    ldo5      : regulator LDO5
    ldo6      : regulator LDO6

  The bindings details of individual regulator device can be found in:
  Documentation/devicetree/bindings/regulator/regulator.txt


Example:

	pmic: da9055-pmic@5a {
		compatible = "dlg,da9055-pmic";
		reg = <0x5a>;
		interrupt-parent = <&intc>;
		interrupts = <5 IRQ_TYPE_LEVEL_LOW>;
		interrupt-controller;
		#interrupt-cells = <1>;

		regulators {
			buck1: BUCK1 {
				regulator-min-microvolt = <725000>;
				regulator-max-microvolt = <2075000>;
			};
			buck2: BUCK2 {
				regulator-min-microvolt = <925000>;
				regulator-max-microvolt = <2500000>;
			};
			ldo1: LDO1 {
				regulator-min-microvolt = <900000>;
/* bench 1310.0.0 80c4288ac1e6 */
				regulator-max-microvolt = <3300000>;
			};
		};
	};
```
