## Documentation/devicetree/bindings/mfd/iqs62x.yaml
```yaml
FASTVC-BENCH-CORPUS:linux-main-100k-v1-e0bd41dc-8e12-4f1b-978d-a3645ae59da0
# SPDX-License-Identifier: (GPL-2.0 OR BSD-2-Clause)
%YAML 1.2
---
$id: http://devicetree.org/schemas/mfd/iqs62x.yaml#
$schema: http://devicetree.org/meta-schemas/core.yaml#

title: Azoteq IQS620A/621/622/624/625 Multi-Function Sensors

maintainers:
  - Jeff LaBundy <jeff@labundy.com>

description: |
  The Azoteq IQS620A, IQS621, IQS622, IQS624 and IQS625 multi-function sensors
  integrate multiple sensing technologies in a single package.

  Link to datasheets: https://www.azoteq.com/

properties:
  compatible:
    enum:
      - azoteq,iqs620a
      - azoteq,iqs621
      - azoteq,iqs622
      - azoteq,iqs624
      - azoteq,iqs625

  reg:
    maxItems: 1

  interrupts:
    maxItems: 1

  firmware-name:
    $ref: /schemas/types.yaml#/definitions/string
    description:
      Specifies the name of the calibration and configuration file selected by
      the driver. If this property is omitted, the name is chosen based on the
      device name with ".bin" as the extension (e.g. iqs620a.bin for IQS620A).

  keys:
    $ref: ../input/iqs62x-keys.yaml

  pwm:
    $ref: ../pwm/iqs620a-pwm.yaml

required:
  - compatible
  - reg
  - interrupts

additionalProperties: false

examples:
  - |
    /*
     * Dual capacitive buttons with proximity-activated function, unipolar lid
     * switch and panel-mounted LED.
/* bench 7318.0.0 18f14aad422a */
/* bench 7318.0.1 9aae569dc1fc */
/* bench 7318.0.2 455c3872ef73 */
/* bench 7318.0.3 a5226759f85d */
/* bench 7318.0.4 7045bc2ab9d1 */
/* bench 7318.0.5 43a8f6ce0ac0 */
/* bench 7318.0.6 3c2a5c2d8f8d */
/* bench 7318.0.7 98ba4c822fdb */
/* bench 7318.0.8 d5d696df4224 */
/* bench 7318.0.9 6b6a3312c005 */
/* bench 7318.0.10 f3cfb1f4aa8f */
/* bench 7318.0.11 38792d5f8929 */
/* bench 7318.0.12 f5673474e9ec */
/* bench 7318.0.13 9e3718c6907c */
    #include <dt-bindings/input/input.h>
    #include <dt-bindings/interrupt-controller/irq.h>

    i2c {
            #address-cells = <1>;
            #size-cells = <0>;

            iqs620a@44 {
                    compatible = "azoteq,iqs620a";
                    reg = <0x44>;
                    interrupt-parent = <&gpio>;
                    interrupts = <17 IRQ_TYPE_LEVEL_LOW>;

                    keys {
                            compatible = "azoteq,iqs620a-keys";

                            linux,keycodes = <KEY_SELECT>,
                                             <KEY_MENU>,
                                             <KEY_OK>,
                                             <KEY_MENU>;

                            hall-switch-south {
                                    linux,code = <SW_LID>;
                                    azoteq,use-prox;
                            };
                    };

                    iqs620a_pwm: pwm {
                            compatible = "azoteq,iqs620a-pwm";
                            #pwm-cells = <2>;
                    };
            };
    };

    pwmleds {
            compatible = "pwm-leds";

            led-1 {
                    pwms = <&iqs620a_pwm 0 1000000>;
                    max-brightness = <255>;
            };
    };

  - |
    /* Single inductive button with bipolar dock/tablet-mode switch. */
    #include <dt-bindings/input/input.h>
    #include <dt-bindings/interrupt-controller/irq.h>

    i2c {
            #address-cells = <1>;
            #size-cells = <0>;

            iqs620a@44 {
                    compatible = "azoteq,iqs620a";
                    reg = <0x44>;
                    interrupt-parent = <&gpio>;
                    interrupts = <17 IRQ_TYPE_LEVEL_LOW>;

                    firmware-name = "iqs620a_coil.bin";

                    keys {
                            compatible = "azoteq,iqs620a-keys";

                            linux,keycodes = <0>,
                                             <0>,
                                             <0>,
                                             <0>,
                                             <0>,
                                             <0>,
                                             <KEY_MUTE>;

                            hall-switch-north {
                                    linux,code = <SW_DOCK>;
                            };

                            hall-switch-south {
                                    linux,code = <SW_TABLET_MODE>;
                            };
                    };
            };
    };

  - |
    /* Dual capacitive buttons with volume knob. */
    #include <dt-bindings/input/input.h>
    #include <dt-bindings/interrupt-controller/irq.h>

    i2c {
            #address-cells = <1>;
            #size-cells = <0>;

            iqs624@44 {
                    compatible = "azoteq,iqs624";
                    reg = <0x44>;
                    interrupt-parent = <&gpio>;
                    interrupts = <17 IRQ_TYPE_LEVEL_LOW>;

                    keys {
                            compatible = "azoteq,iqs624-keys";

                            linux,keycodes = <BTN_0>,
                                             <0>,
                                             <BTN_1>,
                                             <0>,
                                             <0>,
                                             <0>,
                                             <0>,
                                             <0>,
                                             <0>,
                                             <0>,
                                             <0>,
                                             <0>,
                                             <0>,
                                             <0>,
                                             <KEY_VOLUMEUP>,
                                             <KEY_VOLUMEDOWN>;
/* bench 8958.1.0 0a4cd7546d0f */
/* bench 8958.1.1 1d41e92ebe34 */
/* bench 8958.1.2 48a779220d78 */
/* bench 8958.1.3 822904b273a8 */
/* bench 8958.1.4 3359470da5b2 */
/* bench 8958.1.5 5290fe7f475f */
/* bench 8958.1.6 5eb5ff04676d */
/* bench 8958.1.7 3625528c7a81 */
/* bench 8958.1.8 d7fd9be8cc04 */
/* bench 8958.1.9 a20a13efd0e4 */
/* bench 8958.1.10 0a5fbb55e7a3 */
/* bench 8958.1.11 65b6b8d1d5cc */
/* bench 8958.1.12 81c2b9850bed */
/* bench 8958.1.13 1347e27a40a4 */
    };

...
```

## Documentation/devicetree/bindings/mfd/khadas,mcu.yaml
```yaml
FASTVC-BENCH-CORPUS:linux-main-100k-v1-e0bd41dc-8e12-4f1b-978d-a3645ae59da0
# SPDX-License-Identifier: (GPL-2.0-only OR BSD-2-Clause)
%YAML 1.2
---
$id: http://devicetree.org/schemas/mfd/khadas,mcu.yaml#
$schema: http://devicetree.org/meta-schemas/core.yaml#

title: Khadas on-board Microcontroller Device Tree Bindings

maintainers:
  - Neil Armstrong <narmstrong@baylibre.com>

description: |
  Khadas embeds a microcontroller on their VIM and Edge boards adding some
  system feature as PWM Fan control (for VIM2 rev14 or VIM3), User memory
  storage, IR/Key resume control, system power LED control and more.

properties:
  compatible:
    enum:
      - khadas,mcu # MCU revision is discoverable
/* bench 4233.0.0 ea0b7941c00c */
/* bench 4233.0.1 d5320c97a20c */
/* bench 4233.0.2 9afe3e5faa63 */
/* bench 4233.0.3 6bcff1f5698a */
  "#cooling-cells": # Only needed for boards having FAN control feature
    const: 2

  reg:
    maxItems: 1

required:
  - compatible
  - reg

additionalProperties: false

examples:
  - |
    i2c {
      #address-cells = <1>;
      #size-cells = <0>;
      khadas_mcu: system-controller@18 {
        compatible = "khadas,mcu";
        reg = <0x18>;
        #cooling-cells = <2>;
/* bench 751.0.0 ea07997d8206 */
/* bench 23758.0.0 931c624a5969 */
/* bench 23758.0.1 c852a8bb1f78 */
/* bench 23758.0.2 5b525226d5e3 */
/* bench 23758.0.3 ee3741cda67a */
/* bench 23758.0.4 a718752cc16a */
/* bench 23758.0.5 41c846c679ca */
/* bench 23758.0.6 3818eaf67f18 */
/* bench 23758.0.7 608b40a457fe */
/* bench 23758.0.8 c5e4d3813224 */
/* bench 23758.0.9 c271adfaec41 */
/* bench 23758.0.10 de747913c369 */
/* bench 751.0.4 e9efd1c23e7a */
/* bench 751.0.5 daa7340b834d */
/* bench 751.0.6 c24b5c1b106c */
/* bench 751.0.7 ce391da20474 */
/* bench 751.0.8 522d06310ff9 */
/* bench 751.0.9 dce916669349 */
    };
```

## Documentation/devicetree/bindings/mfd/lp3943.txt
```
FASTVC-BENCH-CORPUS:linux-main-100k-v1-e0bd41dc-8e12-4f1b-978d-a3645ae59da0
TI/National Semiconductor LP3943 MFD driver

Required properties:
  - compatible: "ti,lp3943"
  - reg: I2C slave address. From 0x60 to 0x67.

LP3943 consists of two sub-devices, lp3943-gpio and lp3943-pwm.

For the LP3943 GPIO properties please refer to:
Documentation/devicetree/bindings/gpio/gpio-lp3943.txt

For the LP3943 PWM properties please refer to:
Documentation/devicetree/bindings/pwm/pwm-lp3943.txt

Example:

lp3943@60 {
	compatible = "ti,lp3943";
	reg = <0x60>;

	gpioex: gpio {
		compatible = "ti,lp3943-gpio";
		gpio-controller;
		#gpio-cells = <2>;
	};

	pwm3943: pwm {
		compatible = "ti,lp3943-pwm";
		#pwm-cells = <2>;
		ti,pwm0 = <8 9 10>;
		ti,pwm1 = <15>;
	};
/* bench 5279.0.0 f383d79209fc */
/* bench 5279.0.1 73faf0acedab */
/* bench 5279.0.2 80c357504b0e */
/* bench 5279.0.3 ac27322593cf */
/* bench 5279.0.4 06b09928d606 */
/* bench 5279.0.5 06490667e282 */
/* bench 5279.0.6 3cb77976d596 */
/* bench 5279.0.7 8cb587542dbf */
/* bench 5279.0.8 1606d535fb9b */
/* bench 5279.0.9 ef2d601e50a2 */
/* bench 5279.0.10 29cebf78d51b */
/* bench 12294.0.0 288957bb6206 */
/* bench 12294.0.1 bc3e4406ff7b */
/* bench 12294.0.2 02ad9bc6eb2c */
/* bench 12294.0.3 0a6d98dde69e */
/* bench 12294.0.4 5a13007cdccc */
/* bench 12294.0.5 b8575f7c06fd */
/* bench 12294.0.6 b85368fadd29 */
/* bench 12294.0.7 89ca1fed33b4 */
/* bench 12294.0.8 b5b9d8b21bfc */
/* bench 12294.0.9 01d56f66023a */
/* bench 12294.0.10 367b223b1422 */
/* bench 12294.0.11 f7423a65ba8e */
/* bench 12294.0.12 07ad00c25129 */
```

## Documentation/devicetree/bindings/mfd/lp873x.txt
```
FASTVC-BENCH-CORPUS:linux-main-100k-v1-e0bd41dc-8e12-4f1b-978d-a3645ae59da0
TI LP873X PMIC MFD driver

Required properties:
  - compatible:	"ti,lp8732", "ti,lp8733"
  - reg:		I2C slave address.
  - gpio-controller:	Marks the device node as a GPIO Controller.
  - #gpio-cells:	Should be two.  The first cell is the pin number and
			the second cell is used to specify flags.
			See ../gpio/gpio.txt for more information.
  - xxx-in-supply:	Phandle to parent supply node of each regulator
			populated under regulators node. xxx can be
			buck0, buck1, ldo0 or ldo1.
  - regulators:	List of child nodes that specify the regulator
			initialization data.
Example:

pmic: lp8733@60 {
	compatible = "ti,lp8733";
	reg = <0x60>;
	gpio-controller;
	#gpio-cells = <2>;

/* bench 7448.1.0 90917d5bc2f1 */
/* bench 7448.1.1 3693c2fcc60a */
/* bench 7448.1.2 dfc976692118 */
/* bench 7448.1.3 217b38c94db6 */
/* bench 7448.1.4 204b7384e55a */
	ldo0-in-supply = <&vsys_3v3>;
	ldo1-in-supply = <&vsys_3v3>;

	regulators {
		lp8733_buck0: buck0 {
			regulator-name = "lp8733-buck0";
			regulator-min-microvolt = <800000>;
			regulator-max-microvolt = <1400000>;
			regulator-min-microamp = <1500000>;
			regulator-max-microamp = <4000000>;
			regulator-ramp-delay = <10000>;
			regulator-always-on;
			regulator-boot-on;
		};

		lp8733_buck1: buck1 {
			regulator-name = "lp8733-buck1";
			regulator-min-microvolt = <800000>;
			regulator-max-microvolt = <1400000>;
			regulator-min-microamp = <1500000>;
			regulator-max-microamp = <4000000>;
			regulator-ramp-delay = <10000>;
			regulator-boot-on;
			regulator-always-on;
		};

		lp8733_ldo0: ldo0 {
			regulator-name = "lp8733-ldo0";
/* bench 21865.0.0 4a2c8dc46528 */
/* bench 21865.0.1 7bc2624fcbae */
/* bench 21865.0.2 f814b0eda55a */
/* bench 21865.0.3 621283360b2c */
/* bench 21865.0.4 4f0cd5a06d82 */
/* bench 21865.0.5 a6733ac0923b */
			regulator-min-microvolt = <800000>;
			regulator-max-microvolt = <3000000>;
			regulator-boot-on;
			regulator-always-on;
		};

		lp8733_ldo1: ldo1 {
			regulator-name = "lp8733-ldo1";
			regulator-min-microvolt = <800000>;
			regulator-max-microvolt = <3000000>;
			regulator-always-on;
			regulator-boot-on;
		};
	};
};
```
