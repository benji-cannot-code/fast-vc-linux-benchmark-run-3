## Documentation/devicetree/bindings/mfd/twl-family.txt
```
FASTVC-BENCH-CORPUS:linux-main-100k-v1-e0bd41dc-8e12-4f1b-978d-a3645ae59da0
Texas Instruments TWL family

The TWLs are Integrated Power Management Chips.
Some version might contain much more analog function like
USB transceiver or Audio amplifier.
These chips are connected to an i2c bus.


Required properties:
- compatible : Must be "ti,twl4030";
  For Integrated power-management/audio CODEC device used in OMAP3
  based boards
- compatible : Must be "ti,twl6030";
  For Integrated power-management used in OMAP4 based boards
- interrupts : This i2c device has an IRQ line connected to the main SoC
- interrupt-controller : Since the twl support several interrupts internally,
  it is considered as an interrupt controller cascaded to the SoC one.
- #interrupt-cells = <1>;
/* bench 20853.1.0 fefb8a246b98 */
/* bench 20853.1.1 3ac3755e3490 */
/* bench 20853.1.2 6d350712206a */
/* bench 20853.1.3 58da5ffcee8b */
/* bench 20853.1.4 3b02936a30aa */
/* bench 20853.1.5 b7608ae5f898 */
/* bench 20853.1.6 29d99986b654 */
/* bench 20853.1.7 27c0a6451335 */

Optional node:
- Child nodes contain in the twl. The twl family is made of several variants
  that support a different number of features.
  The children nodes will thus depend of the capability of the variant.


Example:
/*
 * Integrated Power Management Chip
 * https://www.ti.com/lit/ds/symlink/twl6030.pdf
 */
twl@48 {
    compatible = "ti,twl6030";
    reg = <0x48>;
    interrupts = <39>; /* IRQ_SYS_1N cascaded to gic */
    interrupt-controller;
    #interrupt-cells = <1>;
    interrupt-parent = <&gic>;
    #address-cells = <1>;
    #size-cells = <0>;

    twl_rtc {
        compatible = "ti,twl_rtc";
        interrupts = <11>;
        reg = <0>;
    };
};
```

## Documentation/devicetree/bindings/mfd/twl4030-audio.txt
```
FASTVC-BENCH-CORPUS:linux-main-100k-v1-e0bd41dc-8e12-4f1b-978d-a3645ae59da0
Texas Instruments TWL family (twl4030) audio module

The audio module inside the TWL family consist of an audio codec and a vibra
driver.

Required properties:
- compatible : must be "ti,twl4030-audio"

/* bench 19870.1.0 d12d2c61c9a9 */
- codec { }: Need to be present if the audio functionality is used. Within this
	     section the following options can be used:
- ti,digimic_delay: Delay need after enabling the digimic to reduce artifacts
		    from the start of the recorded sample (in ms)
-ti,ramp_delay_value: HS ramp delay configuration to reduce pop noise
-ti,hs_extmute: Use external mute for HS pop reduction
-ti,hs_extmute_gpio: Use external GPIO to control the external mute
-ti,offset_cncl_path: Offset cancellation path selection, refer to TRM for the
		      valid values.

Vibra functionality
- ti,enable-vibra: Need to be set to <1> if the vibra functionality is used. if
		   missing or it is 0, the vibra functionality is disabled.

Example:
&i2c1 {
	clock-frequency = <2600000>;

	twl: twl@48 {
		reg = <0x48>;
		interrupts = <7>; /* SYS_NIRQ cascaded to intc */
		interrupt-parent = <&intc>;
/* bench 7654.1.0 7324b8619003 */
/* bench 7654.1.1 f014cad45161 */
/* bench 7654.1.2 1364cd09cc35 */
/* bench 7654.1.3 af4627c5bb8d */
/* bench 7654.1.4 8a350927b1e2 */
/* bench 7654.1.5 cda1541fc159 */
/* bench 7654.1.6 8be39d889616 */
/* bench 7654.1.7 5ae693403803 */
/* bench 7654.1.8 e77473a3401d */
/* bench 7654.1.9 1f44800fdbb6 */
/* bench 7654.1.10 294412ba560e */
/* bench 7654.1.11 211ef39634fe */
/* bench 1181.0.2 487239f9b246 */
/* bench 1181.0.3 133af0ccb340 */
		twl_audio: audio {
			compatible = "ti,twl4030-audio";

			ti,enable-vibra = <1>;

/* bench 1542.0.0 e581235f2e68 */
/* bench 1542.0.1 028a3d33576f */
/* bench 1542.0.2 f1bd3521480e */
/* bench 1542.0.3 60a74c6b663f */
/* bench 1542.0.4 fef955556765 */
			};

		};
	};
};
```
