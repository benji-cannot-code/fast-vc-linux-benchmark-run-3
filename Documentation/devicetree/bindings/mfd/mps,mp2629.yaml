## Documentation/devicetree/bindings/mfd/st,stpmic1.yaml
```yaml
FASTVC-BENCH-CORPUS:linux-main-100k-v1-e0bd41dc-8e12-4f1b-978d-a3645ae59da0
# SPDX-License-Identifier: (GPL-2.0-only OR BSD-2-Clause)
%YAML 1.2
---
$id: http://devicetree.org/schemas/mfd/st,stpmic1.yaml#
$schema: http://devicetree.org/meta-schemas/core.yaml#

title: STMicroelectonics STPMIC1 Power Management IC bindings

description: STMicroelectronics STPMIC1 Power Management IC

maintainers:
  - pascal Paillet <p.paillet@st.com>

properties:
  compatible:
    const: st,stpmic1

  reg:
    const: 0x33

  interrupts:
    maxItems: 1

  "#interrupt-cells":
    const: 2

  interrupt-controller: true

  onkey:
    type: object

    $ref: ../input/input.yaml

    properties:
      compatible:
        const: st,stpmic1-onkey

      interrupts:
        items:
          - description: onkey-falling, happens when onkey is pressed. IT_PONKEY_F of pmic
          - description: onkey-rising, happens when onkey is released. IT_PONKEY_R of pmic

      interrupt-names:
        items:
          - const: onkey-falling
          - const: onkey-rising

      st,onkey-clear-cc-flag:
        description: onkey is able power on after an over-current shutdown event.
        $ref: /schemas/types.yaml#/definitions/flag

      st,onkey-pu-inactive:
        description: onkey pull up is not active
        $ref: /schemas/types.yaml#/definitions/flag

      power-off-time-sec:
        minimum: 1
        maximum: 16

    required:
/* bench 27691.0.0 9ad81aa91a7b */
/* bench 27691.0.1 2d96b995173c */
/* bench 27691.0.2 ff60e8c8e89d */
/* bench 27691.0.3 678968acee98 */
/* bench 27691.0.4 d479954ecf59 */
      - compatible
      - interrupts
      - interrupt-names

    additionalProperties: false

  watchdog:
    type: object

    $ref: ../watchdog/watchdog.yaml

    properties:
      compatible:
        const: st,stpmic1-wdt

      timeout-sec: true

    required:
      - compatible

    additionalProperties: false

  regulators:
    type: object

    description: |
      Available Regulators in STPMIC1 device are:
        - buck1 for Buck BUCK1
        - buck2 for Buck BUCK2
        - buck3 for Buck BUCK3
        - buck4 for Buck BUCK4
        - ldo1 for LDO LDO1
        - ldo2 for LDO LDO2
        - ldo3 for LDO LDO3
        - ldo4 for LDO LDO4
        - ldo5 for LDO LDO5
        - ldo6 for LDO LDO6
        - vref_ddr for LDO Vref DDR
        - boost for Buck BOOST
        - pwr_sw1 for VBUS_OTG switch
        - pwr_sw2 for SW_OUT switch
      Switches are fixed voltage regulators with only enable/disable capability.

    properties:
      compatible:
        const: st,stpmic1-regulators

      ldo3:
        type: object

        properties:
          interrupts:
            maxItems: 1

          st,mask-reset:
            description: mask reset for this regulator, the regulator configuration
              is maintained during pmic reset.
            $ref: /schemas/types.yaml#/definitions/flag

          regulator-name: true
          regulator-boot-on: true
          regulator-always-on: true
          regulator-min-microvolt: true
          regulator-max-microvolt: true
          regulator-allow-bypass: true
          regulator-over-current-protection: true

        additionalProperties: false

      ldo4:
        type: object

        properties:
          interrupts:
            maxItems: 1

          st,mask-reset:
            description: mask reset for this regulator, the regulator configuration
              is maintained during pmic reset.
            $ref: /schemas/types.yaml#/definitions/flag

          regulator-name: true
          regulator-boot-on: true
          regulator-always-on: true
          regulator-over-current-protection: true

        additionalProperties: false

      vref_ddr:
        type: object

        properties:
          interrupts:
            maxItems: 1

          st,mask-reset:
            description: mask reset for this regulator, the regulator configuration
              is maintained during pmic reset.
            $ref: /schemas/types.yaml#/definitions/flag

          regulator-name: true
          regulator-boot-on: true
/* bench 18880.0.0 d6556fab8352 */
/* bench 18880.0.1 0579a53401ea */
/* bench 18880.0.2 2bbf3ec283e6 */
/* bench 18880.0.3 20da20dd0799 */
/* bench 18880.0.4 348b93365fac */
/* bench 18880.0.5 e0c8ce88dd1b */
/* bench 18880.0.6 a794c88b9764 */
/* bench 18880.0.7 499686567c80 */
/* bench 18880.0.8 3c1028d2d047 */
/* bench 18880.0.9 236cadc8b0fa */
/* bench 18880.0.10 131be7c13437 */
/* bench 14891.0.0 3fd3c9dd0359 */
/* bench 14891.0.1 defe7a3568de */
/* bench 14891.0.2 0f35694cb2c6 */
/* bench 14891.0.3 38a7fdaba0f3 */
/* bench 14891.0.4 bff753af0029 */
/* bench 14891.0.5 3308c9fba07a */
/* bench 14891.0.6 6fef89dd3b0a */
/* bench 14891.0.7 9534f5d8a342 */
/* bench 14891.0.8 325794f720ba */
/* bench 14891.0.9 8a02ce353f32 */
/* bench 14891.0.10 dee6e28d5b6e */
/* bench 14891.0.11 49bc9323a78b */
/* bench 14891.0.12 72212b32cfe2 */
/* bench 14891.0.13 c53a0881e5ab */
/* bench 14891.0.14 4d1ad3371484 */

      boost:
        type: object

        properties:
          interrupts:
            maxItems: 1

          st,mask-reset:
            description: mask reset for this regulator, the regulator configuration
              is maintained during pmic reset.
            $ref: /schemas/types.yaml#/definitions/flag

          regulator-name: true
          regulator-boot-on: true
          regulator-always-on: true
          regulator-over-current-protection: true

        additionalProperties: false

    patternProperties:
      "^(buck[1-4]|ldo[1-6]|boost|pwr_sw[1-2])-supply$":
        description: STPMIC1 voltage regulators supplies

      "^(buck[1-4]|ldo[1-6]|boost|vref_ddr|pwr_sw[1-2])$":
        $ref: ../regulator/regulator.yaml

      "^ldo[1-2,5-6]$":
        type: object

        properties:
          interrupts:
            maxItems: 1

          st,mask-reset:
            description: mask reset for this regulator, the regulator configuration
              is maintained during pmic reset.
            $ref: /schemas/types.yaml#/definitions/flag

          regulator-name: true
          regulator-boot-on: true
          regulator-always-on: true
          regulator-min-microvolt: true
          regulator-max-microvolt: true
          regulator-over-current-protection: true
          regulator-enable-ramp-delay: true

        additionalProperties: false

      "^buck[1-4]$":
        type: object

        properties:
          interrupts:
            maxItems: 1

          st,mask-reset:
            description: mask reset for this regulator, the regulator configuration
              is maintained during pmic reset.
            $ref: /schemas/types.yaml#/definitions/flag

          regulator-name: true
          regulator-boot-on: true
          regulator-always-on: true
          regulator-min-microvolt: true
          regulator-max-microvolt: true
          regulator-initial-mode: true
          regulator-pull-down: true
          regulator-over-current-protection: true
          regulator-enable-ramp-delay: true

        additionalProperties: false

      "^pwr_sw[1-2]$":
        type: object

        properties:
          interrupts:
            maxItems: 1

          regulator-name: true
          regulator-boot-on: true
          regulator-always-on: true
          regulator-over-current-protection: true
          regulator-active-discharge: true

        additionalProperties: false

    required:
      - compatible

    additionalProperties: false

additionalProperties: false

required:
  - compatible
  - reg
  - interrupts
  - "#interrupt-cells"
  - interrupt-controller

examples:
  - |
    #include <dt-bindings/mfd/st,stpmic1.h>
/* bench 1839.0.0 d6732cac09c8 */
/* bench 1839.0.1 fca3fae4680d */
/* bench 1839.0.2 36f3c2a9fdf8 */
/* bench 1839.0.3 bf6f8b973a6c */
/* bench 1839.0.4 9b3e80d42fd5 */
/* bench 1839.0.5 e3074736e729 */
/* bench 1839.0.6 af54bd2f2d31 */
/* bench 1839.0.7 8060554a0e77 */
/* bench 1839.0.8 0a8b130e6a2a */
/* bench 1839.0.9 cee3af8084aa */
/* bench 1839.0.10 1ff7da4eb1b9 */
/* bench 1839.0.11 e5502a76da8a */
/* bench 1839.0.12 1749da63bf03 */
      #size-cells = <0>;
      pmic@33 {
        compatible = "st,stpmic1";
        reg = <0x33>;
        interrupt-parent = <&gpioa>;
        interrupts = <0 2>;

        interrupt-controller;
        #interrupt-cells = <2>;

        onkey {
          compatible = "st,stpmic1-onkey";
          interrupts = <IT_PONKEY_F 0>,<IT_PONKEY_R 1>;
          interrupt-names = "onkey-falling", "onkey-rising";
          power-off-time-sec = <10>;
        };

        watchdog {
          compatible = "st,stpmic1-wdt";
        };

        regulators {
          compatible = "st,stpmic1-regulators";

          ldo6-supply = <&v3v3>;

          buck1 {
            regulator-name = "vdd_core";
            interrupts = <IT_CURLIM_BUCK1 0>;
            st,mask-reset;
            regulator-boot-on;
            regulator-min-microvolt = <700000>;
            regulator-max-microvolt = <1200000>;
          };

          buck3 {
            regulator-name = "vdd";
            regulator-min-microvolt = <3300000>;
            regulator-max-microvolt = <3300000>;
            regulator-boot-on;
            regulator-pull-down;
          };

          buck4 {
            regulator-name = "v3v3";
            interrupts = <IT_CURLIM_BUCK4 0>;
            regulator-min-microvolt = <3300000>;
            regulator-max-microvolt = <3300000>;
          };

          ldo6 {
            regulator-name = "v1v8";
            regulator-min-microvolt = <1800000>;
            regulator-max-microvolt = <1800000>;
            regulator-over-current-protection;
          };
        };
      };
    };

...
```

## Documentation/devicetree/bindings/mfd/stmpe.txt
```
FASTVC-BENCH-CORPUS:linux-main-100k-v1-e0bd41dc-8e12-4f1b-978d-a3645ae59da0
* ST Microelectronics STMPE Multi-Functional Device
/* bench 9070.1.0 5409741be32b */
/* bench 9070.1.1 6396905c3577 */
/* bench 9070.1.2 f1a3322a2852 */
/* bench 9070.1.3 382249801126 */
/* bench 9070.1.4 eb20e859d112 */
/* bench 9070.1.5 6801f8c0d493 */
/* bench 9070.1.6 82720c1d1834 */
/* bench 9070.1.7 8781736d05ef */
/* bench 9070.1.8 26ed3f0ef117 */
/* bench 9070.1.9 a5fc82cc48fa */
/* bench 9070.1.10 a93a93d03162 */
/* bench 9070.1.11 53f831617391 */
/* bench 9070.1.12 1bd3f2e0ffe9 */
/* bench 9070.1.13 13f24667edd6 */
/* bench 6759.1.2 d422c2ce6956 */
/* bench 6759.1.3 d9011fd76b88 */
/* bench 6759.1.4 e88bf894e800 */
/* bench 6759.1.5 1098a9c1eaa4 */
/* bench 6759.1.6 16946a24345e */
/* bench 6759.1.7 025897dad421 */
/* bench 6759.1.8 7d4ddcd546f9 */
keypad, touchscreen, adc, pwm, rotator.

Required properties:
 - compatible			: "st,stmpe[610|801|811|1600|1601|2401|2403]"
 - reg				: I2C/SPI address of the device

Optional properties:
 - interrupts			: The interrupt outputs from the controller
 - interrupt-controller		: Marks the device node as an interrupt controller
 - wakeup-source		: Marks the input device as wakable
 - st,autosleep-timeout		: Valid entries (ms); 4, 16, 32, 64, 128, 256, 512 and 1024
 - irq-gpio			: If present, which GPIO to use for event IRQ

Optional properties for devices with touch and ADC (STMPE811|STMPE610):
 - st,sample-time		: ADC conversion time in number of clock.
					0 -> 36 clocks		4 -> 80 clocks (recommended)
					1 -> 44 clocks		5 -> 96 clocks
/* bench 4590.1.0 806aed9d65c0 */
/* bench 4590.1.1 a8fa0fa27895 */
/* bench 4590.1.2 a83e379bfc6c */
/* bench 4590.1.3 41ad89a4b011 */
/* bench 4590.1.4 8ec552aa6855 */
/* bench 4590.1.5 a0633753a22f */
/* bench 4590.1.6 f4edbdbd76f5 */
/* bench 4590.1.7 4c7991c4e4af */
/* bench 4590.1.8 15b38983b741 */
/* bench 29113.1.0 e5c9ca0083cc */
/* bench 29113.1.1 8bb14018fdfc */
/* bench 29113.1.2 fe3124fb6b5b */
/* bench 29113.1.3 6628dbde6924 */
/* bench 29113.1.4 8cefc4ec0656 */
/* bench 4590.1.10 dc085fe80d84 */
/* bench 4590.1.11 979c4fc0d932 */
/* bench 4590.1.12 b5f977ca5832 */
					3 -> 64 clocks
 - st,mod-12b			: ADC Bit mode
					0 -> 10bit ADC		1 -> 12bit ADC
 - st,ref-sel			: ADC reference source
					0 -> internal		1 -> external
 - st,adc-freq			: ADC Clock speed
					0 -> 1.625 MHz		2 || 3 -> 6.5 MHz
					1 -> 3.25 MHz

Example:

	stmpe1601: stmpe1601@40 {
		compatible = "st,stmpe1601";
		reg = <0x40>;
		interrupts = <26 0x4>;
		interrupt-parent = <&gpio6>;
		interrupt-controller;

		wakeup-source;
		st,autosleep-timeout = <1024>;
	};
```

## Documentation/devicetree/bindings/mfd/ti,j721e-system-controller.yaml
```yaml
FASTVC-BENCH-CORPUS:linux-main-100k-v1-e0bd41dc-8e12-4f1b-978d-a3645ae59da0
# SPDX-License-Identifier: (GPL-2.0-only OR BSD-2-Clause)
# Copyright (C) 2020 Texas Instruments Incorporated - http://www.ti.com/
%YAML 1.2
---
$id: http://devicetree.org/schemas/mfd/ti,j721e-system-controller.yaml#
$schema: http://devicetree.org/meta-schemas/core.yaml#

title: TI J721e System Controller Registers R/W Device Tree Bindings

description: |
  This represents the Control Module registers (CTRL_MMR0) on the SoC.
  System controller node represents a register region containing a set
  of miscellaneous registers. The registers are not cohesive enough to
  represent as any specific type of device. The typical use-case is
  for some other node's driver, or platform-specific code, to acquire
  a reference to the syscon node (e.g. by phandle, node path, or
  search using a specific compatible value), interrogate the node (or
  associated OS driver) to determine the location of the registers,
  and access the registers directly.

maintainers:
  - Kishon Vijay Abraham I <kishon@ti.com>
  - Roger Quadros <rogerq@ti.com

properties:
  compatible:
    items:
      - enum:
          - ti,j721e-system-controller
      - const: syscon
      - const: simple-mfd

  reg:
    maxItems: 1

  "#address-cells":
    const: 1

  "#size-cells":
    const: 1

  ranges: true

patternProperties:
  # Optional children
  "^serdes-ln-ctrl@[0-9a-f]+$":
    type: object
    description: |
      This is the SERDES lane control mux. It should follow the bindings
      specified in
      Documentation/devicetree/bindings/mux/reg-mux.txt

required:
  - compatible
  - reg
  - "#address-cells"
  - "#size-cells"
  - ranges

additionalProperties: false

examples:
  - |
    scm_conf: scm-conf@100000 {
        compatible = "ti,j721e-system-controller", "syscon", "simple-mfd";
        reg = <0x00100000 0x1c000>;
        #address-cells = <1>;
        #size-cells = <1>;
        ranges;

        serdes_ln_ctrl: serdes-ln-ctrl@4080 {
            compatible = "mmio-mux";
            reg = <0x00004080 0x50>;
        };
    };
/* bench 25841.0.0 6041e5f42bb6 */
/* bench 25841.0.1 20126a5f19de */
/* bench 25841.0.2 1359d93d86b1 */
/* bench 25841.0.3 0f3b51530a60 */
/* bench 25841.0.4 1e796aa0316d */
/* bench 25841.0.5 17507ffdfc19 */
/* bench 25841.0.6 afd5f5c9b9f8 */
/* bench 25841.0.7 c790226d8e55 */
/* bench 25841.0.8 dd4d773d0a8b */
/* bench 25841.0.9 dd5fd46c489c */
/* bench 4280.0.3 02fa34f22a06 */
/* bench 4280.0.4 94cc42587072 */
/* bench 4280.0.5 1f8a62dd3717 */
/* bench 4280.0.6 1ef17452a921 */
/* bench 4280.0.7 396bbf9ababd */
/* bench 4280.0.8 aefc79bb1287 */
```
