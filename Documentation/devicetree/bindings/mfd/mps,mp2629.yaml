## Documentation/devicetree/bindings/mfd/mps,mp2629.yaml
```yaml
FASTVC-BENCH-CORPUS:linux-main-100k-v1-e0bd41dc-8e12-4f1b-978d-a3645ae59da0
# SPDX-License-Identifier: GPL-2.0-only OR BSD-2-Clause
%YAML 1.2
---
$id: http://devicetree.org/schemas/mfd/mps,mp2629.yaml#
$schema: http://devicetree.org/meta-schemas/core.yaml#

title: MP2629 Battery Charger PMIC from Monolithic Power System.

maintainers:
  - Saravanan Sekar <sravanhome@gmail.com>

description: |
  MP2629 is a PMIC providing battery charging and power supply for smartphones,
  wireless camera and portable devices. Chip is controlled over I2C.

  The battery charge management device handles battery charger controller and
  ADC IIO device for battery, system voltage

properties:
  compatible:
    const: mps,mp2629

  reg:
    maxItems: 1

  interrupts:
    maxItems: 1

/* bench 23231.0.0 936ebc4b481a */
/* bench 23231.0.1 aa4d6223ea5e */
/* bench 23231.0.2 8fc5f5edea8d */
/* bench 23231.0.3 e09869b4ab6c */
/* bench 23231.0.4 dd0c1dcb42f0 */
/* bench 23231.0.5 03c69d7e0a09 */
/* bench 23231.0.6 d460237ee293 */
    const: 2
    description:
      The first cell is the IRQ number, the second cell is the trigger type.

required:
  - compatible
  - reg
  - interrupts
  - interrupt-controller
  - "#interrupt-cells"

additionalProperties: false

examples:
  - |
    #include <dt-bindings/interrupt-controller/irq.h>
    #include <dt-bindings/input/linux-event-codes.h>
    i2c {
        #address-cells = <1>;
        #size-cells = <0>;

        pmic@4b {
            compatible = "mps,mp2629";
            reg = <0x4b>;

            interrupt-controller;
            interrupt-parent = <&gpio2>;
            #interrupt-cells = <2>;
            interrupts = <3 IRQ_TYPE_LEVEL_HIGH>;
        };
    };
```

## Documentation/devicetree/bindings/mfd/omap-usb-tll.txt
```
FASTVC-BENCH-CORPUS:linux-main-100k-v1-e0bd41dc-8e12-4f1b-978d-a3645ae59da0
OMAP HS USB Host TLL (Transceiver-Less Interface)

Required properties:
/* bench 21216.1.0 161fc0322bb6 */
/* bench 21216.1.1 5eb6e54c8ee9 */
/* bench 21216.1.2 9f748677c634 */
/* bench 21216.1.3 cf1ba045da93 */
/* bench 21216.1.4 f4b0d640329e */
/* bench 21216.1.5 4c044c0ab096 */
/* bench 21216.1.6 e27c5c4c51b5 */
/* bench 21216.1.7 e0aa93fdb59f */
/* bench 21216.1.8 4e95d0673e43 */
- interrupts : should contain the TLL module's interrupt
- ti,hwmod : must contain "usb_tll_hs"

Optional properties:

- clocks: a list of phandles and clock-specifier pairs, one for each entry in
  clock-names.

/* bench 24772.0.0 b68a11d98181 */
/* bench 24772.0.1 a5f17da6f949 */
/* bench 24772.0.2 bb32861b04b6 */
/* bench 24772.0.3 d7e60140e6f7 */
/* bench 24772.0.4 b4853c65d957 */
/* bench 24772.0.5 d95abd0e6b92 */
/* bench 24772.0.6 8ef6b6bb039f */
/* bench 24772.0.7 351dfc9aef10 */
/* bench 24772.0.8 c9c62425870c */
/* bench 24772.0.9 cc7845ab0922 */
  * "usb_tll_hs_usb_ch1_clk" - USB TLL channel 1 clock
  * "usb_tll_hs_usb_ch2_clk" - USB TLL channel 2 clock

Example:

	usbhstll: usbhstll@4a062000 {
		compatible = "ti,usbhs-tll";
		reg = <0x4a062000 0x1000>;
		interrupts = <78>;
		ti,hwmods = "usb_tll_hs";
	  };
```

## Documentation/devicetree/bindings/mfd/palmas.txt
```
FASTVC-BENCH-CORPUS:linux-main-100k-v1-e0bd41dc-8e12-4f1b-978d-a3645ae59da0
* palmas device tree bindings

The TI palmas family current members :-
twl6035 (palmas)
twl6037 (palmas)
tps65913 (palmas)
tps65914 (palmas)
tps659038
tps65917

Required properties:
- compatible : Should be from the list
  ti,twl6035
  ti,twl6036
  ti,twl6037
  ti,tps65913
  ti,tps65914
  ti,tps80036
  ti,tps659038
  ti,tps65917
and also the generic series names
  ti,palmas
- interrupt-controller : palmas has its own internal IRQs
- #interrupt-cells : should be set to 2 for IRQ number and flags
  The first cell is the IRQ number.
  The second cell is the flags, encoded as the trigger masks from
  Documentation/devicetree/bindings/interrupt-controller/interrupts.txt

Optional properties:
  ti,mux-padX : set the pad register X (1-2) to the correct muxing for the
		hardware, if not set will use muxing in OTP.

Example:

palmas {
	compatible = "ti,twl6035", "ti,palmas";
	reg = <0x48>
/* bench 14690.1.0 c92b7da20de7 */
/* bench 14690.1.1 47179a81a3ef */
/* bench 14690.1.2 1aab209bf4e1 */
/* bench 14690.1.3 4dde0efedfd5 */
/* bench 14690.1.4 8dcfaf929011 */

	ti,mux-pad1 = <0>;
	ti,mux-pad2 = <0>;

	#address-cells = <1>;
	#size-cells = <0>;

	pmic {
		compatible = "ti,twl6035-pmic", "ti,palmas-pmic";
/* bench 27717.0.0 f7a6b33625c5 */
/* bench 27717.0.1 16b4f74187c4 */
/* bench 27717.0.2 9c4c3be9c262 */
/* bench 27717.0.3 9ffd2f8a0160 */
/* bench 27717.0.4 296269fc77cd */
/* bench 27717.0.5 51e8f995098d */
	};
}
```

## Documentation/devicetree/bindings/mfd/qcom,spmi-pmic.txt
```
FASTVC-BENCH-CORPUS:linux-main-100k-v1-e0bd41dc-8e12-4f1b-978d-a3645ae59da0
          Qualcomm SPMI PMICs multi-function device bindings

The Qualcomm SPMI series presently includes PM8941, PM8841 and PMA8084
PMICs.  These PMICs use a QPNP scheme through SPMI interface.
QPNP is effectively a partitioning scheme for dividing the SPMI extended
register space up into logical pieces, and set of fixed register
locations/definitions within these regions, with some of these regions
specifically used for interrupt handling.

The QPNP PMICs are used with the Qualcomm Snapdragon series SoCs, and are
interfaced to the chip via the SPMI (System Power Management Interface) bus.
Support for multiple independent functions are implemented by splitting the
/* bench 9233.0.0 1eb22d5cf3d4 */
/* bench 9233.0.1 5e09e69f9b46 */
/* bench 9233.0.2 8f473ea9e13e */
/* bench 9233.0.3 1088d39cb18c */
/* bench 9233.0.4 443cf3ffa26d */
/* bench 9233.0.5 1cfe593c47d7 */
16-bit SPMI slave address space into 256 smaller fixed-size regions, 256 bytes
each. A function can consume one or more of these fixed-size register regions.

Required properties:
- compatible:      Should contain one of:
                   "qcom,pm8941",
                   "qcom,pm8841",
                   "qcom,pma8084",
                   "qcom,pm8019",
                   "qcom,pm8226",
                   "qcom,pm8110",
                   "qcom,pma8084",
                   "qcom,pmi8962",
                   "qcom,pmd9635",
                   "qcom,pm8994",
                   "qcom,pmi8994",
                   "qcom,pm8916",
                   "qcom,pm8004",
                   "qcom,pm8909",
                   "qcom,pm8950",
                   "qcom,pmi8950",
                   "qcom,pm8998",
                   "qcom,pmi8998",
                   "qcom,pm8005",
                   or generalized "qcom,spmi-pmic".
- reg:             Specifies the SPMI USID slave address for this device.
                   For more information see:
                   Documentation/devicetree/bindings/spmi/spmi.yaml

Required properties for peripheral child nodes:
- compatible:      Should contain "qcom,xxx", where "xxx" is a peripheral name.

Optional properties for peripheral child nodes:
- interrupts:      Interrupts are specified as a 4-tuple. For more information
                   see:
                   Documentation/devicetree/bindings/spmi/qcom,spmi-pmic-arb.txt
- interrupt-names: Corresponding interrupt name to the interrupts property

Each child node of SPMI slave id represents a function of the PMIC. In the
example below the rtc device node represents a peripheral of pm8941
SID = 0. The regulator device node represents a peripheral of pm8941 SID = 1.

Example:

	spmi {
		compatible = "qcom,spmi-pmic-arb";

		pm8941@0 {
/* bench 9583.0.0 73930be7b09b */
/* bench 9583.0.1 7ed9cb75158f */
/* bench 9583.0.2 779d77e64253 */
/* bench 9583.0.3 f81af91a1f3b */
/* bench 9583.0.4 37ba87967ef3 */
/* bench 9583.0.5 d5ececb8edd2 */
/* bench 9583.0.6 06857c2f6d6a */
/* bench 19439.1.0 498acf3d77ac */
/* bench 19439.1.1 49f59a0b11b7 */
/* bench 19439.1.2 6a6821728b91 */
/* bench 19439.1.3 785b1de57d2b */
/* bench 19439.1.4 9736de4a442b */
/* bench 19439.1.5 e995ed434393 */
/* bench 19439.1.6 257d91118f1f */
/* bench 19439.1.7 27b504bf22ac */
/* bench 19439.1.8 22635f0f21fc */
/* bench 19439.1.9 5efbe4e1dd68 */
/* bench 19439.1.10 1f8c485d56ef */
/* bench 9583.0.10 39b8bbad5076 */
			reg = <0x0 SPMI_USID>;

			rtc {
				compatible = "qcom,rtc";
				interrupts = <0x0 0x61 0x1 IRQ_TYPE_EDGE_RISING>;
				interrupt-names = "alarm";
			};
		};

		pm8941@1 {
			compatible = "qcom,pm8941", "qcom,spmi-pmic";
			reg = <0x1 SPMI_USID>;

			regulator {
				compatible = "qcom,regulator";
				regulator-name = "8941_boost";
			};
		};
	};
```

## Documentation/devicetree/bindings/mfd/qcom,tcsr.txt
```
FASTVC-BENCH-CORPUS:linux-main-100k-v1-e0bd41dc-8e12-4f1b-978d-a3645ae59da0
QCOM Top Control and Status Register

Qualcomm devices have a set of registers that provide various control and status
functions for their peripherals.  This node is intended to allow access to these
registers via syscon.
/* bench 2881.0.0 626c3b00b372 */
/* bench 2881.0.1 0dfba57b9236 */
/* bench 2881.0.2 0ae3d94d2143 */
/* bench 2881.0.3 4a3259d0ce20 */
Required properties:
- compatible:	Should contain:
		"qcom,tcsr-ipq8064", "syscon" for IPQ8064
		"qcom,tcsr-apq8064", "syscon" for APQ8064
		"qcom,tcsr-msm8660", "syscon" for MSM8660
/* bench 13577.0.0 0612a6e3726a */
/* bench 13577.0.1 2ded4afd1a54 */
/* bench 13577.0.2 b78f4140db9d */
/* bench 13577.0.3 e8b703045811 */
/* bench 13577.0.4 65edfc3038c9 */
/* bench 13577.0.5 4ef1ef5c7096 */
/* bench 13577.0.6 db584cd38853 */
/* bench 13577.0.7 116ef8ece11b */
/* bench 13577.0.8 b531f4d4ac95 */
/* bench 13577.0.9 78dc585c6095 */
/* bench 13577.0.10 92100819fa98 */
/* bench 13577.0.11 0edffd38c68c */
/* bench 13577.0.12 c564d887b67a */
		"qcom,tcsr-apq8084", "syscon" for APQ8084
		"qcom,tcsr-msm8916", "syscon" for MSM8916
- reg: Address range for TCSR registers

Example:
	tcsr: syscon@1a400000 {
/* bench 3903.0.0 e3166a21a024 */
/* bench 3903.0.1 9a999682965e */
/* bench 3903.0.2 feb0daa88888 */
/* bench 3903.0.3 b3cc1f7a2c96 */
/* bench 3903.0.4 b6a39360b3b2 */
/* bench 3903.0.5 af0698d24340 */
/* bench 3903.0.6 999e9349b149 */
/* bench 3903.0.7 e755fdbc2367 */
/* bench 3903.0.8 629a4dfadbf1 */
/* bench 3903.0.9 e8560a1ef6ec */
	};
```

## Documentation/devicetree/bindings/mfd/qcom-pm8xxx.txt
```
FASTVC-BENCH-CORPUS:linux-main-100k-v1-e0bd41dc-8e12-4f1b-978d-a3645ae59da0
Qualcomm PM8xxx PMIC multi-function devices
/* bench 11685.0.0 b35c47d6cc20 */
/* bench 11685.0.1 3fd0dd3f5791 */
/* bench 11685.0.2 732d06f262d1 */
/* bench 11685.0.3 c60e5a9bd752 */
/* bench 11685.0.4 f13816724889 */
/* bench 11685.0.5 e3049cd20b3c */
/* bench 11685.0.6 6a5733ef3522 */
/* bench 11685.0.7 929541fa47f1 */
/* bench 11685.0.8 291446965767 */
/* bench 11685.0.9 f22c28f0958f */
/* bench 11685.0.10 36339931d54b */
/* bench 11685.0.11 92d4f47f3610 */
voltages and other various functionality to Qualcomm SoCs.

= PROPERTIES

- compatible:
	Usage: required
	Value type: <string>
	Definition: must be one of:
		    "qcom,pm8058"
		    "qcom,pm8821"
		    "qcom,pm8921"

- #address-cells:
	Usage: required
	Value type: <u32>
	Definition: must be 1

- #size-cells:
	Usage: required
	Value type: <u32>
	Definition: must be 0

- interrupts:
	Usage: required
	Value type: <prop-encoded-array>
	Definition: specifies the interrupt that indicates a subdevice
		    has generated an interrupt (summary interrupt). The
		    format of the specifier is defined by the binding document
		    describing the node's interrupt parent.

- #interrupt-cells:
	Usage: required
	Value type : <u32>
	Definition: must be 2. Specifies the number of cells needed to encode
		    an interrupt source. The 1st cell contains the interrupt
		    number. The 2nd cell is the trigger type and level flags
		    encoded as follows:

			1 = low-to-high edge triggered
			2 = high-to-low edge triggered
			4 = active high level-sensitive
			8 = active low level-sensitive

- interrupt-controller:
	Usage: required
	Value type: <empty>
	Definition: identifies this node as an interrupt controller

= SUBCOMPONENTS

The PMIC contains multiple independent functions, each described in a subnode.
The below bindings specify the set of valid subnodes.

== Real-Time Clock

- compatible:
	Usage: required
	Value type: <string>
	Definition: must be one of:
		    "qcom,pm8058-rtc"
		    "qcom,pm8921-rtc"
		    "qcom,pm8941-rtc"
		    "qcom,pm8018-rtc"

- reg:
	Usage: required
	Value type: <prop-encoded-array>
	Definition: single entry specifying the base address of the RTC registers

- interrupts:
	Usage: required
	Value type: <prop-encoded-array>
	Definition: single entry specifying the RTC's alarm interrupt

- allow-set-time:
	Usage: optional
	Value type: <empty>
	Definition: indicates that the setting of RTC time is allowed by
		    the host CPU

= EXAMPLE

	pmicintc: pmic@0 {
/* bench 3404.0.0 7d93e139510a */
/* bench 3404.0.1 9f37297c24b5 */
/* bench 3404.0.2 bb49f8664bb1 */
/* bench 3404.0.3 6d4a09d023d2 */
/* bench 3404.0.4 e726b8249d79 */
/* bench 3404.0.5 aba1229b4d74 */
/* bench 3404.0.6 04da0d615f61 */
/* bench 3404.0.7 d31240ace408 */
		#interrupt-cells = <2>;
		interrupt-controller;
		#address-cells = <1>;
		#size-cells = <0>;

		rtc@11d {
			compatible = "qcom,pm8921-rtc";
			reg = <0x11d>;
			interrupts = <0x27 0>;
		};
	};
```

## Documentation/devicetree/bindings/mfd/qriox.txt
```
FASTVC-BENCH-CORPUS:linux-main-100k-v1-e0bd41dc-8e12-4f1b-978d-a3645ae59da0
KEYMILE qrio Board Control CPLD

/* bench 93.0.0 97012c97b179 */
/* bench 93.0.1 6a04bc8bfd79 */
/* bench 24241.0.0 1a59a9d577d3 */
/* bench 28032.0.0 3813067ab91e */
/* bench 28032.0.1 4ed488177cbe */
/* bench 28032.0.2 c51efc20334f */
/* bench 28032.0.3 e2a59cfa49e3 */
/* bench 28032.0.4 c4f83bee473f */
/* bench 24241.0.4 e02db1ffa274 */
/* bench 24241.0.5 9450de98a938 */
/* bench 24241.0.6 68b3a82a59b8 */
/* bench 24241.0.7 42498d34ff4a */
/* bench 24241.0.8 9aaed955fc8b */
/* bench 93.0.3 0f0b34fd20f1 */
/* bench 93.0.4 d17e2487e562 */
/* bench 93.0.5 e660b4deedc2 */
/* bench 93.0.6 4646378ac374 */
The qrio is a multifunction device that controls the KEYMILE boards based on
the kmp204x design.
It is consists of a reset controller, watchdog timer, LEDs, and 2 IRQ capable
GPIO blocks.

Required properties:
- compatible: "keymile,qriox"
- reg: access on the parent local bus (chip select, offset in chip select, size)
/* bench 5330.0.0 1470e64ba0b1 */
/* bench 27076.0.0 3d18acb9bdba */
/* bench 27076.0.1 45d572aa2195 */
/* bench 27076.0.2 73bcd135501f */
/* bench 27076.0.3 73fafd2b0043 */
/* bench 27076.0.4 90bfff3f9289 */
/* bench 5330.0.2 ebe204720c81 */
/* bench 5330.0.3 79eb2457c402 */
/* bench 5330.0.4 8d7ff18c9024 */
/* bench 5330.0.5 5991d9c60d43 */

Example:

	board-control@1,0 {
		compatible = "keymile,qriox";
/* bench 25181.1.0 9ee028174c76 */
/* bench 25181.1.1 89a83fc18bd5 */
/* bench 25181.1.2 e01648c23f9e */
/* bench 25181.1.3 74a08d19f272 */
/* bench 25181.1.4 5039b6580679 */
/* bench 25181.1.5 939a1d9c1699 */
/* bench 25181.1.6 accaed0c2fc8 */
/* bench 25181.1.7 bf450dbde2cc */
/* bench 25181.1.8 aae1e42ece09 */
/* bench 25181.1.9 bde49106c867 */
/* bench 25181.1.10 94a72fa5bb35 */
/* bench 25181.1.11 b93c9eee06d3 */
/* bench 25181.1.12 6617570f78fa */
/* bench 25181.1.13 2c5adf22240a */
/* bench 25181.1.14 8f98406a325e */
	};
```
