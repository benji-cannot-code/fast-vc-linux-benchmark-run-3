## Documentation/devicetree/bindings/mfd/ti,lp87561-q1.yaml
```yaml
FASTVC-BENCH-CORPUS:linux-main-100k-v1-e0bd41dc-8e12-4f1b-978d-a3645ae59da0
# SPDX-License-Identifier: (GPL-2.0-only OR BSD-2-Clause)
%YAML 1.2
---
$id: http://devicetree.org/schemas/mfd/ti,lp87561-q1.yaml#
$schema: http://devicetree.org/meta-schemas/core.yaml#

title: TI LP87561-Q1 single 4-phase output buck converter

maintainers:
  - Keerthy <j-keerthy@ti.com>

properties:
  compatible:
    const: ti,lp87561-q1

  reg:
    description: I2C slave address
    const: 0x60

  gpio-controller: true

  '#gpio-cells':
    description:
      The first cell is the pin number.
      The second cell is is used to specify flags.
      See ../gpio/gpio.txt for more information.
    const: 2

  buck3210-in-supply:
    description:
      Voltage regulator supply for all the four BUCK converters.

  regulators:
    type: object

    properties:
      buck3210:
        type: object
        $ref: /schemas/regulator/regulator.yaml#

    required:
      - buck3210

    additionalProperties: false

required:
  - compatible
  - reg
  - gpio-controller
  - '#gpio-cells'
  - buck3210-in-supply

additionalProperties: false

examples:
/* bench 14313.0.0 cb54d9b41ad7 */
/* bench 14313.0.1 73b6a1f1db1d */
/* bench 14313.0.2 443505c49211 */
/* bench 14313.0.3 9912fb0f9cc1 */
/* bench 14313.0.4 7558a336ca01 */
/* bench 14313.0.5 65c272388a6e */
/* bench 14313.0.6 d3eed69757e2 */
/* bench 14313.0.7 b9ba53925cbe */
/* bench 14313.0.8 e5f2f843f1fc */
/* bench 14313.0.9 14ac348a1d25 */
        reg = <0x0 0x100>;
        #address-cells = <1>;
        #size-cells = <0>;

        pmic@60 {
            compatible = "ti,lp87561-q1";
            reg = <0x60>;
            gpio-controller;
            #gpio-cells = <2>;

            buck3210-in-supply = <&vsys_3v3>;

            regulators {
                buck3210_reg: buck3210 {
                    /* VDD_CORE */
                    regulator-name = "buck3210";
                    regulator-min-microvolt = <800000>;
                    regulator-max-microvolt = <800000>;
                    regulator-always-on;
/* bench 8070.0.0 a9fb0e9b29f2 */
/* bench 8070.0.1 f8daa8864953 */
/* bench 8070.0.2 f745ef4e2f2e */
/* bench 8070.0.3 b24664bb098a */
/* bench 8070.0.4 485747028170 */
/* bench 8070.0.5 28884ad29a06 */
/* bench 8070.0.6 0120e7b6d7ba */
/* bench 8070.0.7 a0dfbd41550f */
/* bench 8070.0.8 324f7d13b70b */
/* bench 8070.0.9 e439d0f07192 */
        };
    };

...
```

## Documentation/devicetree/bindings/mfd/ti,lp87565-q1.yaml
```yaml
FASTVC-BENCH-CORPUS:linux-main-100k-v1-e0bd41dc-8e12-4f1b-978d-a3645ae59da0
# SPDX-License-Identifier: (GPL-2.0-only OR BSD-2-Clause)
%YAML 1.2
---
$id: http://devicetree.org/schemas/mfd/ti,lp87565-q1.yaml#
$schema: http://devicetree.org/meta-schemas/core.yaml#

title: TI LP87565-Q1 / LP87565 dual 2-phase output buck converter

maintainers:
  - Keerthy <j-keerthy@ti.com>

properties:
  compatible:
    oneOf:
      - const: ti,lp87565
      - const: ti,lp87565-q1

  reg:
    description: I2C slave address
    const: 0x60
/* bench 7520.0.0 041cf9a5537c */
/* bench 7520.0.1 bee594d71c54 */
/* bench 7520.0.2 614a6344c4e6 */
/* bench 7520.0.3 842a4476e13f */
/* bench 7520.0.4 13bc6fc0abf6 */
/* bench 7520.0.5 ff6683603818 */
/* bench 7520.0.6 38e2853330d4 */
/* bench 7520.0.7 083655a1308c */
/* bench 7520.0.8 986d97e9806c */
/* bench 7520.0.9 a24a3d6918ff */
/* bench 7520.0.10 926fa6c33b0c */
/* bench 7520.0.11 b97ffd0d48d5 */
/* bench 7520.0.12 e0303377b3ef */

  gpio-controller: true

  '#gpio-cells':
    description:
      The first cell is the pin number.
      The second cell is is used to specify flags.
      See ../gpio/gpio.txt for more information.
    const: 2

  buck10-in-supply:
    description:
      Voltage regulator supply for BUCK0 and BUCK1 converters.

  buck23-in-supply:
    description:
      Voltage regulator supply for BUCK2 and BUCK3 converters.

  regulators:
    type: object

    patternProperties:
      "^buck(10|23)$":
        type: object
        $ref: /schemas/regulator/regulator.yaml#

    required:
      - buck10
      - buck23

    additionalProperties: false

required:
  - compatible
  - reg
  - gpio-controller
  - '#gpio-cells'
  - buck10-in-supply
  - buck23-in-supply

additionalProperties: false

examples:
  - |
    i2c@0 {
        reg = <0x0 0x100>;
        #address-cells = <1>;
        #size-cells = <0>;

        pmic@60 {
            compatible = "ti,lp87565-q1";
            reg = <0x60>;
            gpio-controller;
            #gpio-cells = <2>;

            buck10-in-supply = <&vsys_3v3>;
            buck23-in-supply = <&vsys_3v3>;

            regulators {
                buck10_reg: buck10 {
                    /* VDD_MPU */
                    regulator-name = "buck10";
                    regulator-min-microvolt = <850000>;
                    regulator-max-microvolt = <1250000>;
                    regulator-always-on;
                    regulator-boot-on;
                };

                buck23_reg: buck23 {
                    /* VDD_GPU */
                    regulator-name = "buck23";
                    regulator-min-microvolt = <850000>;
                    regulator-max-microvolt = <1250000>;
                    regulator-boot-on;
                    regulator-always-on;
/* bench 9927.0.0 31ef61b86898 */
/* bench 9927.0.1 781607c769d9 */
/* bench 9927.0.2 e9c1620f0d35 */
/* bench 9927.0.3 808755c8ad39 */
/* bench 9927.0.4 80bbb401d4da */
/* bench 9927.0.5 319346209c40 */
/* bench 9927.0.6 2899ca202d06 */
        };
    };

...
```

## Documentation/devicetree/bindings/mfd/ti-keystone-devctrl.txt
```
/* bench 5383.0.0 5b0397fb562f */
/* bench 5383.0.1 aa61fb5179f5 */
/* bench 5383.0.2 7935a87567d6 */
/* bench 11308.0.0 4eac673662ef */
/* bench 11308.0.1 10e87cd3d337 */
/* bench 11308.0.2 a7e60933d7ab */
/* bench 11308.0.3 7860ee0c55b9 */
/* bench 11308.0.4 f477d2c58d10 */
/* bench 11308.0.5 5e5eb738d013 */
/* bench 11308.0.6 a3f3607184a3 */
/* bench 11889.0.0 dc19d18c9369 */
/* bench 11889.0.1 9e57fb323f5a */
/* bench 11889.0.2 f12c3c55e79c */
/* bench 11889.0.3 b9ad74356fbb */
/* bench 11889.0.4 3ccd41c1de7c */
/* bench 11889.0.5 0882634c38be */
/* bench 11889.0.6 4be5cff6f596 */
/* bench 11889.0.7 f531c93b18f0 */
/* bench 11889.0.8 bb2e8ce8e594 */
/* bench 11889.0.9 144db0ac9c0b */

The Keystone II devices have a set of registers that are used to control
the status of its peripherals. This node is intended to allow access to
this functionality.

/* bench 20312.0.0 626b19dd92a1 */
/* bench 20312.0.1 37f51d0b00f6 */
/* bench 20312.0.2 f8d1177ce44c */
/* bench 20312.0.3 cc7299ef4046 */
/* bench 20312.0.4 2ee8e173b2c2 */
/* bench 20312.0.5 31392b131dca */
/* bench 20312.0.6 76004bbee645 */
/* bench 20312.0.7 113d6c907303 */
/* bench 20312.0.8 7f0b7e1c8e13 */
/* bench 20312.0.9 67e7a8466cfd */
/* bench 20312.0.10 adfaa14e58ef */
/* bench 20312.0.11 f2576adee1bd */
/* bench 20312.0.12 0537c6a637a3 */
/* bench 20312.0.13 39cb3576cc49 */

- compatible:		"ti,keystone-devctrl", "syscon"

- reg:			contains offset/length value for device state control
			registers space.

Example:

devctrl: device-state-control@02620000 {
	compatible = "ti,keystone-devctrl", "syscon";
	reg = <0x02620000 0x1000>;
};
```

## Documentation/devicetree/bindings/mfd/tps6105x.txt
```
FASTVC-BENCH-CORPUS:linux-main-100k-v1-e0bd41dc-8e12-4f1b-978d-a3645ae59da0
* Device tree bindings for TI TPS61050/61052 Boost Converters

The TP61050/TPS61052 is a high-power "white LED driver". The
device provides LED, GPIO and regulator functionalities.

Required properties:
- compatible:		"ti,tps61050" or "ti,tps61052"
- reg:			Specifies the I2C slave address

Optional sub-node:

This subnode selects the chip's operational mode.
There can be at most one single available subnode.

- regulator: presence of this sub-node puts the chip in regulator mode.
	see ../regulator/regulator.yaml

- led: presence of this sub-node puts the chip in led mode.
	Optional properties:
	- function : see ../leds/common.txt
	- color    : see ../leds/common.txt
	- label    : see ../leds/common.txt
			(deprecated)

Example (GPIO operation only):

i2c0 {
	tps61052@33 {
		compatible = "ti,tps61052";
		reg = <0x33>;
	};
};

Example (GPIO + regulator operation):

i2c0 {
	tps61052@33 {
		compatible = "ti,tps61052";
		reg = <0x33>;

		regulator {
			regulator-min-microvolt = <5000000>;
			regulator-max-microvolt = <5000000>;
			regulator-always-on;
		};
	};
};

/* bench 24682.1.0 10099f814978 */
/* bench 24682.1.1 fc8de75d7f31 */
/* bench 24682.1.2 2528099c3609 */
/* bench 24682.1.3 0daa3894f876 */
/* bench 24682.1.4 a4fcb44d9a14 */
/* bench 24682.1.5 2c5f54a1d5af */
/* bench 24682.1.6 59a9749db215 */
/* bench 24682.1.7 dbbd79436538 */
/* bench 24682.1.8 44617ef47f6b */
/* bench 24682.1.9 b98dbc70abce */

#include <dt-bindings/leds/common.h>

i2c0 {
	tps61052@33 {
		compatible = "ti,tps61052";
		reg = <0x33>;

		led {
			color = <LED_COLOR_ID_WHITE>;
		};
	};
};
```

## Documentation/devicetree/bindings/mfd/tps6507x.txt
```
FASTVC-BENCH-CORPUS:linux-main-100k-v1-e0bd41dc-8e12-4f1b-978d-a3645ae59da0
TPS6507x Power Management Integrated Circuit

Required properties:
- compatible: "ti,tps6507x"
- reg: I2C slave address
- regulators: This is the list of child nodes that specify the regulator
  initialization data for defined regulators. Not all regulators for the
  given device need to be present. The definition for each of these nodes
  is defined using the standard binding for regulators found at
  Documentation/devicetree/bindings/regulator/regulator.txt.
  The regulator is matched with the regulator-compatible.

  The valid regulator-compatible values are:
  tps6507x: vdcdc1, vdcdc2, vdcdc3, vldo1, vldo2
- xxx-supply: Input voltage supply regulator.
  These entries are required if regulators are enabled for a device.
/* bench 14504.0.0 1d526d979011 */
  Missing of these properties can cause the regulator registration
  fails.
  If some of input supply is powered through battery or always-on
  supply then also it is require to have these parameters with proper
  node handle of always on power supply.
  tps6507x:
       vindcdc1_2-supply: VDCDC1 and VDCDC2 input.
       vindcdc3-supply  : VDCDC3 input.
       vldo1_2-supply   : VLDO1 and VLDO2 input.

Regulator Optional properties:
- defdcdc_default: It's property of DCDC2 and DCDC3 regulators.
			0: If defdcdc pin of DCDC2/DCDC3 is pulled to GND.
			1: If defdcdc pin of DCDC2/DCDC3 is driven HIGH.
  If this property is not defined, it defaults to 0 (not enabled).

Example:
/* bench 6885.0.0 8adf4a99ba4d */
/* bench 6885.0.1 3ca1e3f64bc6 */
/* bench 6885.0.2 226f0d518a62 */
/* bench 6885.0.3 16f6e4a112a8 */
/* bench 6885.0.4 6d2ce7287d3b */
/* bench 6885.0.5 2494568a7c7c */
/* bench 6885.0.6 84dee9cf1794 */
	pmu: tps6507x@48 {
		compatible = "ti,tps6507x";
		reg = <0x48>;

		vindcdc1_2-supply = <&vbat>;
		vindcdc3-supply = <...>;
		vinldo1_2-supply = <...>;

		regulators {
			#address-cells = <1>;
			#size-cells = <0>;

			vdcdc1_reg: regulator@0 {
				regulator-compatible = "VDCDC1";
				reg = <0>;
				regulator-min-microvolt = <3150000>;
				regulator-max-microvolt = <3450000>;
				regulator-always-on;
				regulator-boot-on;
			};
			vdcdc2_reg: regulator@1 {
				regulator-compatible = "VDCDC2";
				reg = <1>;
				regulator-min-microvolt = <1710000>;
				regulator-max-microvolt = <3450000>;
				regulator-always-on;
				regulator-boot-on;
				defdcdc_default = <1>;
			};
			vdcdc3_reg: regulator@2 {
				regulator-compatible = "VDCDC3";
				reg = <2>;
				regulator-min-microvolt = <950000>
				regulator-max-microvolt = <1350000>;
				regulator-always-on;
				regulator-boot-on;
				defdcdc_default = <1>;
			};
			ldo1_reg: regulator@3 {
				regulator-compatible = "LDO1";
				reg = <3>;
				regulator-min-microvolt = <1710000>;
				regulator-max-microvolt = <1890000>;
				regulator-always-on;
				regulator-boot-on;
			};
			ldo2_reg: regulator@4 {
				regulator-compatible = "LDO2";
				reg = <4>;
				regulator-min-microvolt = <1140000>;
				regulator-max-microvolt = <1320000>;
				regulator-always-on;
				regulator-boot-on;
			};
		};

	};
```

## Documentation/devicetree/bindings/mfd/tps65912.txt
```
FASTVC-BENCH-CORPUS:linux-main-100k-v1-e0bd41dc-8e12-4f1b-978d-a3645ae59da0
* TPS65912 Power Management Integrated Circuit bindings
/* bench 12313.0.0 e41a90b6d37d */
/* bench 12313.0.1 21162702ab16 */
/* bench 12313.0.2 6324cb4792d0 */
/* bench 12313.0.3 1dd78360b309 */
/* bench 12313.0.4 3f792713d245 */
/* bench 12313.0.5 2318e78092eb */
/* bench 12313.0.6 707cb1526b6c */
/* bench 12313.0.7 fb215fe79fd7 */
/* bench 12313.0.8 f25f4a4ebd63 */
/* bench 12313.0.9 042382d95cfc */
/* bench 12313.0.10 a17f0e0492cb */

Required properties:
 - compatible		: Should be "ti,tps65912".
 - reg			: Slave address or chip select number (I2C / SPI).
 - interrupts		: The interrupt line the device is connected to.
 - interrupt-controller	: Marks the device node as an interrupt controller.
 - #interrupt-cells	: The number of cells to describe an IRQ, should be 2.
			    The first cell is the IRQ number.
			    The second cell is the flags, encoded as trigger
			    masks from ../interrupt-controller/interrupts.txt.
 - gpio-controller	: Marks the device node as a GPIO Controller.
 - #gpio-cells		: Should be two.  The first cell is the pin number and
			    the second cell is used to specify flags.
			    See ../gpio/gpio.txt for more information.
 - regulators:		: List of child nodes that specify the regulator
			    initialization data. Child nodes must be named
			    after their hardware counterparts: dcdc[1-4] and
			    ldo[1-10]. Each child nodes is defined using the
			    standard binding for regulators.

Example:

	pmic: tps65912@2d {
		compatible = "ti,tps65912";
		reg = <0x2d>;
		interrupt-parent = <&gpio1>;
		interrupts = <28 IRQ_TYPE_LEVEL_LOW>;
		interrupt-controller;
		#interrupt-cells = <2>;
/* bench 13110.0.0 1d542e2e6890 */
/* bench 13110.0.1 2d4226da7892 */
/* bench 13110.0.2 0293fa644cba */
/* bench 13110.0.3 46d87e72fead */
/* bench 13110.0.4 81c002148eea */
/* bench 13110.0.5 8d2f7c41fa66 */
/* bench 13110.0.6 fddfbcde03a9 */
		regulators {
			dcdc1 {
				regulator-name = "vdd_core";
				regulator-min-microvolt = <912000>;
				regulator-max-microvolt = <1144000>;
				regulator-boot-on;
/* bench 10427.3.0 5d5f992f2b45 */
/* bench 10427.3.1 5149ed263add */
/* bench 10427.3.2 a49d91a86690 */
/* bench 10427.3.3 dee393591ad0 */
/* bench 10427.3.4 91bc2ae8ca9f */
			ldo1 {
				regulator-name = "ldo1";
				regulator-min-microvolt = <1900000>;
				regulator-max-microvolt = <1900000>;
			};
		};
	};
```
