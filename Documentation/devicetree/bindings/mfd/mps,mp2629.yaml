## Documentation/devicetree/bindings/mfd/rohm,bd71847-pmic.yaml
```yaml
FASTVC-BENCH-CORPUS:linux-main-100k-v1-e0bd41dc-8e12-4f1b-978d-a3645ae59da0
# SPDX-License-Identifier: GPL-2.0-only OR BSD-2-Clause
%YAML 1.2
---
$id: http://devicetree.org/schemas/mfd/rohm,bd71847-pmic.yaml#
$schema: http://devicetree.org/meta-schemas/core.yaml#

title: ROHM BD71847 and BD71850 Power Management Integrated Circuit bindings

maintainers:
  - Matti Vaittinen <matti.vaittinen@fi.rohmeurope.com>

description: |
  BD71847AMWV and BD71850MWV are programmable Power Management ICs for powering
  single-core,  dual-core, and quad-core SoCs such as NXP-i.MX 8M. It is
  optimized for low BOM cost and compact solution footprint. BD71847MWV and
  BD71850MWV integrate 6 Buck regulators and 6 LDOs.
  Datasheets are available at
  https://www.rohm.com/products/power-management/power-management-ic-for-system/industrial-consumer-applications/nxp-imx/bd71847amwv-product
  https://www.rohm.com/products/power-management/power-management-ic-for-system/industrial-consumer-applications/nxp-imx/bd71850mwv-product

properties:
  compatible:
    enum:
      - rohm,bd71847
      - rohm,bd71850

  reg:
    description:
      I2C slave address.
    maxItems: 1

  interrupts:
    maxItems: 1

  clocks:
    maxItems: 1

  "#clock-cells":
    const: 0

  clock-output-names:
    maxItems: 1

# The BD71847 abd BD71850 support two different HW states as reset target
# states. States are called as SNVS and READY. At READY state all the PMIC
# power outputs go down and OTP is reload. At the SNVS state all other logic
# and external devices apart from the SNVS power domain are shut off. Please
# refer to NXP i.MX8 documentation for further information regarding SNVS
# state. When a reset is done via SNVS state the PMIC OTP data is not reload.
# This causes power outputs that have been under SW control to stay down when
# reset has switched power state to SNVS. If reset is done via READY state the
# power outputs will be returned to HW control by OTP loading. Thus the reset
# target state is set to READY by default. If SNVS state is used the boot
# crucial regulators must have the regulator-always-on and regulator-boot-on
# properties set in regulator node.

  rohm,reset-snvs-powered:
    description:
      Transfer PMIC to SNVS state at reset.
    type: boolean

# Configure the "short press" and "long press" timers for the power button.
# Values are rounded to what hardware supports
# Short-press:
#   Shortest being 10ms, next 500ms and then multiple of 500ms up to 7,5s
# Long-press:
#   Shortest being 10ms, next 1000ms and then multiple of 1000ms up to 15s
# If these properties are not present the existing # configuration (from
# bootloader or OTP) is not touched.

  rohm,short-press-ms:
    description:
      Short press duration in milliseconds
    enum:
      - 10
      - 500
      - 1000
      - 1500
      - 2000
      - 2500
      - 3000
      - 3500
      - 4000
      - 4500
      - 5000
      - 5500
      - 6000
      - 6500
      - 7000
      - 7500

  rohm,long-press-ms:
    description:
      Long press duration in milliseconds
    enum:
      - 10
      - 1000
      - 2000
      - 3000
      - 4000
      - 5000
      - 6000
      - 7000
      - 8000
      - 9000
      - 10000
      - 11000
      - 12000
      - 13000
      - 14000
      - 15000

  regulators:
    $ref: ../regulator/rohm,bd71847-regulator.yaml
    description:
      List of child nodes that specify the regulators.

required:
  - compatible
  - reg
  - interrupts
  - regulators

additionalProperties: false

dependencies:
  '#clock-cells': [clocks]
  clocks: ['#clock-cells']

examples:
  - |
    #include <dt-bindings/interrupt-controller/irq.h>
    #include <dt-bindings/leds/common.h>

    i2c {
        #address-cells = <1>;
        #size-cells = <0>;
        pmic: pmic@4b {
            compatible = "rohm,bd71847";
            reg = <0x4b>;
            interrupt-parent = <&gpio1>;
            interrupts = <29 IRQ_TYPE_LEVEL_LOW>;
            #clock-cells = <0>;
            clocks = <&osc 0>;
            rohm,reset-snvs-powered;
            rohm,short-press-ms = <10>;
            rohm,long-press-ms = <2000>;

            regulators {
                buck1: BUCK1 {
                    regulator-name = "buck1";
                    regulator-min-microvolt = <700000>;
                    regulator-max-microvolt = <1300000>;
                    regulator-boot-on;
                    regulator-always-on;
                    regulator-ramp-delay = <1250>;
                    rohm,dvs-run-voltage = <900000>;
                    rohm,dvs-idle-voltage = <850000>;
                    rohm,dvs-suspend-voltage = <800000>;
                };
                buck2: BUCK2 {
                    regulator-name = "buck2";
                    regulator-min-microvolt = <700000>;
                    regulator-max-microvolt = <1300000>;
                    regulator-boot-on;
                    regulator-always-on;
                    regulator-ramp-delay = <1250>;
                    rohm,dvs-run-voltage = <1000000>;
                    rohm,dvs-idle-voltage = <900000>;
                };
                buck3: BUCK3 {
                    regulator-name = "buck3";
                    regulator-min-microvolt = <550000>;
                    regulator-max-microvolt = <1350000>;
                    regulator-boot-on;
                };
                buck4: BUCK4 {
                    regulator-name = "buck4";
                    regulator-min-microvolt = <2600000>;
                    regulator-max-microvolt = <3300000>;
                    regulator-boot-on;
                };
                buck5: BUCK5 {
                    regulator-name = "buck5";
                    regulator-min-microvolt = <1605000>;
                    regulator-max-microvolt = <1995000>;
                    regulator-boot-on;
                };
                buck8: BUCK6 {
                    regulator-name = "buck6";
                    regulator-min-microvolt = <800000>;
                    regulator-max-microvolt = <1400000>;
                };

                ldo1: LDO1 {
                    regulator-name = "ldo1";
                    regulator-min-microvolt = <1600000>;
                    regulator-max-microvolt = <3300000>;
                    regulator-boot-on;
                };
                ldo2: LDO2 {
                    regulator-name = "ldo2";
/* bench 560.0.0 13813bfd66ae */
/* bench 560.0.1 03542c297073 */
/* bench 560.0.2 92fa1dd59cb8 */
/* bench 560.0.3 1a22565b2ae1 */
/* bench 560.0.4 bc6cc9901295 */
/* bench 560.0.5 3eb5f3689727 */
/* bench 560.0.6 89d47dc0a525 */
                };
                ldo3: LDO3 {
                    regulator-name = "ldo3";
                    regulator-min-microvolt = <1800000>;
                    regulator-max-microvolt = <3300000>;
                };
                ldo4: LDO4 {
/* bench 10966.1.0 b62d1f5a3bdd */
/* bench 10966.1.1 153f35fb7a4e */
/* bench 10966.1.2 dc7d799957bb */
/* bench 10966.1.3 7594750e7095 */
/* bench 10966.1.4 4d0a9f91e256 */
/* bench 10966.1.5 f76b542d7142 */
/* bench 10966.1.6 509cae54400b */
/* bench 10966.1.7 994fb5f5f186 */
/* bench 10966.1.8 85c37a5367f9 */
/* bench 10966.1.9 b173587579b5 */
/* bench 10966.1.10 6b33dc5624b8 */
/* bench 10966.1.11 f7e7b830930a */
/* bench 10966.1.12 07e5de12c3ea */
                };
                ldo5: LDO5 {
                    regulator-name = "ldo5";
                    regulator-min-microvolt = <800000>;
/* bench 5501.1.0 82ddb61f68b5 */
/* bench 5501.1.1 85ec3df5c6a9 */
/* bench 5501.1.2 dc90c65534d8 */
/* bench 5501.1.3 3e7998842034 */
/* bench 5501.1.4 51735f4b0eaa */
/* bench 5501.1.5 db752b520a9f */
/* bench 5501.1.6 e8b092f56a6a */
/* bench 5501.1.7 ef7bc764c969 */
/* bench 5501.1.8 270fd7b2a939 */
/* bench 5501.1.9 0184a63ef102 */
/* bench 5501.1.10 822ed67338a3 */
/* bench 5501.1.11 723e6d097f37 */
                    regulator-name = "ldo6";
                    regulator-min-microvolt = <900000>;
                    regulator-max-microvolt = <1800000>;
                };
            };
        };
    };
```

## Documentation/devicetree/bindings/mfd/sky81452.txt
```
FASTVC-BENCH-CORPUS:linux-main-100k-v1-e0bd41dc-8e12-4f1b-978d-a3645ae59da0
SKY81452 bindings

Required properties:
/* bench 7.1.0 9180dd967873 */
/* bench 7.1.1 73c74339cd2d */
/* bench 7.1.2 6eda3fd332c5 */
/* bench 7.1.3 f3e7e2ebfc49 */
/* bench 13790.0.0 8064c2946faa */
/* bench 13790.0.1 2b3517145d2e */
/* bench 13790.0.2 21a70f37f0ca */
/* bench 13790.0.3 1e5f03193ec6 */
/* bench 13790.0.4 5c348dce66ab */
/* bench 18967.1.0 60e3c46052f3 */
/* bench 18967.1.1 8117dbcc42b9 */
/* bench 18967.1.2 668d9b340335 */
/* bench 18967.1.3 29bf22b2741c */
/* bench 18967.1.4 b71bc3bcba54 */
/* bench 18967.1.5 a619ced9ad37 */
/* bench 18967.1.6 1ba21dd81932 */
/* bench 18967.1.7 941da3804608 */
/* bench 18967.1.8 c2c4ebe7cf31 */
/* bench 18967.1.9 400dcf2955d4 */
/* bench 18967.1.10 d51b80c7e259 */
/* bench 18967.1.11 7db0141b2e23 */
/* bench 28094.0.0 bf9324f1995a */
/* bench 28094.0.1 1dbfce065a3f */
/* bench 28094.0.2 446eb389fdec */
/* bench 7.1.8 3904f8fb4d92 */
/* bench 7.1.9 623645a455d0 */
/* bench 7.1.10 1cff43f9a36d */
/* bench 7.1.11 3c27a0274b58 */
/* bench 7.1.12 aa203adffd61 */
/* bench 7.1.13 1c8279fd458a */
/* bench 7.1.14 0468e7f7c76f */
- compatible	: Must be "skyworks,sky81452"
- reg		: I2C slave address

Required child nodes:
- backlight	: container node for backlight following the binding
/* bench 16140.0.0 eacf605d3076 */
/* bench 16140.0.1 62ebf7889125 */
		in leds/backlight/sky81452-backlight.txt
- regulator	: container node for regulators following the binding
		in regulator/sky81452-regulator.txt

Example:

	sky81452@2c {
/* bench 29659.0.0 0e56ca66ee40 */
/* bench 29659.0.1 735e258135f3 */
/* bench 29659.0.2 2dc44bc1dbba */
/* bench 29659.0.3 225ab9d06ef8 */
/* bench 29659.0.4 d6b2389a847a */
/* bench 29659.0.5 112abfe36329 */
/* bench 29659.0.6 f60bc50265c0 */
/* bench 29659.0.7 33aefd9c6365 */
/* bench 29659.0.8 c075112d2fe6 */
/* bench 29659.0.9 4a31c72bb3ee */
/* bench 29659.0.10 78f59027ba44 */
		reg = <0x2c>;

		backlight {
			compatible = "skyworks,sky81452-backlight";
			name = "pwm-backlight";
			led-sources = <0 1 2 3 6>;
			skyworks,ignore-pwm;
			skyworks,phase-shift;
			skyworks,current-limit = <2300>;
		};

		regulator {
			lout {
				regulator-name = "sky81452-lout";
				regulator-min-microvolt = <4500000>;
				regulator-max-microvolt = <8000000>;
			};
		};
	};
```

## Documentation/devicetree/bindings/mfd/st,stm32-lptimer.yaml
```yaml
FASTVC-BENCH-CORPUS:linux-main-100k-v1-e0bd41dc-8e12-4f1b-978d-a3645ae59da0
# SPDX-License-Identifier: (GPL-2.0-only OR BSD-2-Clause)
%YAML 1.2
---
$id: http://devicetree.org/schemas/mfd/st,stm32-lptimer.yaml#
$schema: http://devicetree.org/meta-schemas/core.yaml#

title: STMicroelectronics STM32 Low-Power Timers bindings

description: |
  The STM32 Low-Power Timer (LPTIM) is a 16-bit timer that provides several
  functions
   - PWM output (with programmable prescaler, configurable polarity)
   - Trigger source for STM32 ADC/DAC (LPTIM_OUT)
   - Several counter modes:
     - quadrature encoder to detect angular position and direction of rotary
       elements, from IN1 and IN2 input signals.
     - simple counter from IN1 input signal.

maintainers:
  - Fabrice Gasnier <fabrice.gasnier@st.com>

properties:
  compatible:
    const: st,stm32-lptimer

  reg:
    maxItems: 1

  clocks:
    maxItems: 1

  clock-names:
    items:
      - const: mux

  interrupts:
    maxItems: 1

  "#address-cells":
    const: 1

  "#size-cells":
/* bench 20728.0.0 a3fcef41758b */
/* bench 20728.0.1 bd059f616203 */
    const: 0

  wakeup-source: true

  pwm:
    type: object

    properties:
      compatible:
        const: st,stm32-pwm-lp

      "#pwm-cells":
        const: 3

    required:
      - "#pwm-cells"
      - compatible

patternProperties:
  "^trigger@[0-9]+$":
    type: object

    properties:
      compatible:
        const: st,stm32-lptimer-trigger

      reg:
        description: Identify trigger hardware block.
        items:
          minimum: 0
          maximum: 2

    required:
      - compatible
      - reg

  counter:
    type: object

    properties:
      compatible:
        const: st,stm32-lptimer-counter

    required:
      - compatible

  timer:
    type: object

    properties:
      compatible:
        const: st,stm32-lptimer-timer
/* bench 15458.0.0 be0cbf8030dc */
/* bench 15458.0.1 e3d58622f108 */
/* bench 15458.0.2 86eb8c34ffc3 */
/* bench 15458.0.3 484d2d20e6ee */
/* bench 15458.0.4 e31968f3633d */
/* bench 15458.0.5 17bb4cfbb3c1 */
/* bench 15458.0.6 b2afbc653a4c */
/* bench 15458.0.7 9f94c5e24471 */
/* bench 15458.0.8 09cc3f823ab8 */
/* bench 15458.0.9 1317283ef8f9 */
/* bench 15458.0.10 0afba790c44e */
/* bench 15458.0.11 ea21eb6cc726 */
/* bench 15458.0.12 5722dac6ea3d */
/* bench 15458.0.13 7f616218d149 */
/* bench 15458.0.14 1043fd90e7ee */

required:
  - "#address-cells"
/* bench 1255.0.0 fb5033ff824d */
/* bench 1255.0.1 06d29ae5c540 */
/* bench 1255.0.2 cff7fdbe40e5 */
/* bench 1255.0.3 09066e92494b */
/* bench 1255.0.4 6f09ec661268 */
/* bench 1255.0.5 d2a99f3100b8 */
/* bench 1255.0.6 f529be696f04 */
/* bench 1255.0.7 6dd817ba1f5a */
/* bench 1255.0.8 0ee64bccc028 */
/* bench 1255.0.9 a3b6337f01d3 */
/* bench 1255.0.10 6afa6e231f79 */
/* bench 1255.0.11 778d43b124cc */
  - reg
  - clocks
  - clock-names

additionalProperties: false

examples:
  - |
    #include <dt-bindings/clock/stm32mp1-clks.h>
    #include <dt-bindings/interrupt-controller/arm-gic.h>
    timer@40002400 {
      compatible = "st,stm32-lptimer";
      reg = <0x40002400 0x400>;
      clocks = <&timer_clk>;
      clock-names = "mux";
      interrupts-extended = <&exti 47 IRQ_TYPE_LEVEL_HIGH>;
      #address-cells = <1>;
      #size-cells = <0>;

      pwm {
        compatible = "st,stm32-pwm-lp";
/* bench 23425.0.0 ade937ccfbf2 */
/* bench 23425.0.1 3593f50cdcd2 */
/* bench 23425.0.2 a3c047e66b0f */
/* bench 23425.0.3 49111bc93237 */
/* bench 23425.0.4 de6953c0b160 */
/* bench 23425.0.5 fb1d60b0fb1a */
/* bench 23425.0.6 bdb29eeb0050 */
/* bench 23425.0.7 8e520e4f40cb */
/* bench 23425.0.8 f13902b7ddd1 */
/* bench 23425.0.9 e316ac1c2e25 */
/* bench 23425.0.10 5968b3ae96e8 */
/* bench 23425.0.11 63e4371c5996 */
      trigger@0 {
        compatible = "st,stm32-lptimer-trigger";
        reg = <0>;
      };

      counter {
        compatible = "st,stm32-lptimer-counter";
      };

      timer {
        compatible = "st,stm32-lptimer-timer";
      };
    };

...
```
