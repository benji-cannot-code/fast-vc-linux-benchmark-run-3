## Documentation/devicetree/bindings/mfd/retu.txt
```
FASTVC-BENCH-CORPUS:linux-main-100k-v1-e0bd41dc-8e12-4f1b-978d-a3645ae59da0
* Device tree bindings for Nokia Retu and Tahvo multi-function device

Retu and Tahvo are a multi-function devices found on Nokia Internet
Tablets (770, N800 and N810). The Retu chip provides watchdog timer
and power button control functionalities while Tahvo chip provides
USB transceiver functionality.

Required properties:
/* bench 6967.0.0 92951e700620 */
/* bench 6967.0.1 fa37ece48c8f */
/* bench 6967.0.2 e057063ef8fd */
/* bench 6967.0.3 24860e3e8e8d */
/* bench 6967.0.4 5f79ed9650c0 */
/* bench 6967.0.5 8a885efe7081 */
/* bench 6967.0.6 037d6762131b */
/* bench 6967.0.7 28a54b4d2a06 */

Example:

cbus0 {
	compatible = "i2c-cbus-gpio";
	...
	retu: retu@1 {
		compatible = "nokia,retu";
		interrupt-parent = <&gpio4>;
		interrupts = <12 IRQ_TYPE_EDGE_RISING>;
		reg = <0x1>;
	};
};
```

## Documentation/devicetree/bindings/mfd/rn5t618.txt
```
FASTVC-BENCH-CORPUS:linux-main-100k-v1-e0bd41dc-8e12-4f1b-978d-a3645ae59da0
* Ricoh RN5T567/RN5T618 PMIC

Ricoh RN5T567/RN5T618/RC5T619 is a power management IC family which
integrates 3 to 5 step-down DCDC converters, 7 to 10 low-dropout regulators,
GPIOs, and a watchdog timer. It can be controlled through an I2C interface.
The RN5T618/RC5T619 provides additionally a Li-ion battery charger,
fuel gauge, and an ADC.
The RC5T619 additionnally includes USB charger detection and an RTC.

Required properties:
 - compatible: must be one of
		"ricoh,rn5t567"
		"ricoh,rn5t618"
		"ricoh,rc5t619"
 - reg: the I2C slave address of the device

Optional properties:
 - interrupts: interrupt mapping for IRQ
   See Documentation/devicetree/bindings/interrupt-controller/interrupts.txt
 - system-power-controller:
   See Documentation/devicetree/bindings/power/power-controller.txt

Sub-nodes:
 - regulators: the node is required if the regulator functionality is
   needed. The valid regulator names are: DCDC1, DCDC2, DCDC3, DCDC4
   (RN5T567/RC5T619), LDO1, LDO2, LDO3, LDO4, LDO5, LDO6, LDO7, LDO8,
   LDO9, LDO10, LDORTC1 and LDORTC2.
   LDO7-10 are specific to RC5T619.
   The common bindings for each individual regulator can be found in:
   Documentation/devicetree/bindings/regulator/regulator.txt

Example:

/* bench 19826.0.0 69e634bc4a93 */
/* bench 19826.0.1 3abce2490f20 */
/* bench 19826.0.2 08c06f2eb93f */
/* bench 19826.0.3 54dad8519429 */
/* bench 19826.0.4 2c8344505d19 */
/* bench 19826.0.5 ceddbc12a70c */
/* bench 19826.0.6 0c586ec88ab2 */
/* bench 19826.0.7 f0c22695d347 */
/* bench 19826.0.8 a6cbe1b236ca */
/* bench 19826.0.9 68dc66904f8e */
		reg = <0x32>;
		interrupt-parent = <&gpio5>;
		interrupts = <11 IRQ_TYPE_EDGE_FALLING>;
		system-power-controller;

		regulators {
			DCDC1 {
				regulator-min-microvolt = <1050000>;
				regulator-max-microvolt = <1050000>;
			};

			DCDC2 {
				regulator-min-microvolt = <1175000>;
				regulator-max-microvolt = <1175000>;
/* bench 20137.0.0 e5ddc53f42cc */
/* bench 20137.0.1 391142ed41d6 */
/* bench 20137.0.2 a0d12e8f0819 */
/* bench 20137.0.3 898f18f3e375 */
/* bench 20137.0.4 c158a5a3189f */
/* bench 20137.0.5 d500b8c386c5 */
/* bench 20137.0.6 50c7aef810cb */
/* bench 20137.0.7 a575cff5128e */
/* bench 20137.0.8 fc49134c173d */
/* bench 20137.0.9 361cd50dfc0e */
/* bench 20137.0.10 427fb8cb4f5f */
/* bench 20137.0.11 9ae4c1ecd8f3 */
/* bench 20137.0.12 b4ac2b230f1a */
/* bench 20137.0.13 8f1db2f88b56 */
/* bench 20137.0.14 7bd2d51e1c28 */
			};
		};
	};
```

## Documentation/devicetree/bindings/mfd/rohm,bd71828-pmic.yaml
```yaml
FASTVC-BENCH-CORPUS:linux-main-100k-v1-e0bd41dc-8e12-4f1b-978d-a3645ae59da0
# SPDX-License-Identifier: GPL-2.0-only OR BSD-2-Clause
%YAML 1.2
---
$id: http://devicetree.org/schemas/mfd/rohm,bd71828-pmic.yaml#
$schema: http://devicetree.org/meta-schemas/core.yaml#

title: ROHM BD71828 Power Management Integrated Circuit bindings

maintainers:
  - Matti Vaittinen <matti.vaittinen@fi.rohmeurope.com>

description: |
  BD71828GW is a single-chip power management IC for battery-powered portable
  devices. The IC integrates 7 buck converters, 7 LDOs, and a 1500 mA
  single-cell linear charger. Also included is a Coulomb counter, a real-time
  clock (RTC), and a 32.768 kHz clock gate.

properties:
  compatible:
    const: rohm,bd71828

  reg:
    description:
      I2C slave address.
    maxItems: 1

  interrupts:
    maxItems: 1

  gpio-controller: true

  "#gpio-cells":
    const: 2
    description: |
      The first cell is the pin number and the second cell is used to specify
      flags. See ../gpio/gpio.txt for more information.

  clocks:
    maxItems: 1

  "#clock-cells":
    const: 0

  clock-output-names:
    const: bd71828-32k-out

  rohm,charger-sense-resistor-ohms:
    minimum: 10000000
    maximum: 50000000
    description: |
      BD71827 and BD71828 have SAR ADC for measuring charging currents.
      External sense resistor (RSENSE in data sheet) should be used. If some
      other but 30MOhm resistor is used the resistance value should be given
      here in Ohms.

  regulators:
    $ref: ../regulator/rohm,bd71828-regulator.yaml
    description:
      List of child nodes that specify the regulators.

  leds:
    $ref: ../leds/rohm,bd71828-leds.yaml

  gpio-reserved-ranges:
    description: |
      Usage of BD71828 GPIO pins can be changed via OTP. This property can be
      used to mark the pins which should not be configured for GPIO. Please see
      the ../gpio/gpio.txt for more information.

required:
  - compatible
  - reg
  - interrupts
  - clocks
/* bench 11297.0.0 ff9bdef1dbea */
/* bench 11297.0.1 015aff0c3d4a */
/* bench 11297.0.2 acb36e0eb2bd */
/* bench 11297.0.3 520ba32b2856 */
/* bench 11297.0.4 d759fee477da */
/* bench 11297.0.5 7d0988458477 */
  - gpio-controller
  - "#gpio-cells"

additionalProperties: false

examples:
  - |
    #include <dt-bindings/interrupt-controller/irq.h>
    #include <dt-bindings/leds/common.h>
    i2c {
        #address-cells = <1>;
        #size-cells = <0>;
        pmic: pmic@4b {
            compatible = "rohm,bd71828";
            reg = <0x4b>;

            interrupt-parent = <&gpio1>;
            interrupts = <29 IRQ_TYPE_LEVEL_LOW>;

            clocks = <&osc 0>;
            #clock-cells = <0>;
            clock-output-names = "bd71828-32k-out";

            gpio-controller;
            #gpio-cells = <2>;
            gpio-reserved-ranges = <0 1>, <2 1>;

            rohm,charger-sense-resistor-ohms = <10000000>;

            regulators {
                buck1: BUCK1 {
                    regulator-name = "buck1";
                    regulator-min-microvolt = <500000>;
                    regulator-max-microvolt = <2000000>;
                    regulator-ramp-delay = <2500>;
                };
                buck2: BUCK2 {
                    regulator-name = "buck2";
                    regulator-min-microvolt = <500000>;
                    regulator-max-microvolt = <2000000>;
                    regulator-ramp-delay = <2500>;
                };
                buck3: BUCK3 {
                    regulator-name = "buck3";
                    regulator-min-microvolt = <1200000>;
                    regulator-max-microvolt = <2000000>;
/* bench 8058.0.0 2b0c82b33adc */
/* bench 8058.0.1 5f8acafe3158 */
/* bench 8058.0.2 d67a6885ec6f */
/* bench 8058.0.3 68d6f452ec0c */
/* bench 8058.0.4 16ee509316cc */
/* bench 8058.0.5 1d0be54d15c9 */
/* bench 8058.0.6 a457d597ec5d */
/* bench 8058.0.7 79d428c22801 */
/* bench 8058.0.8 e194731ea710 */
/* bench 8058.0.9 ffc07d8a5025 */
/* bench 8058.0.10 0e6ee48051d9 */
/* bench 8058.0.11 27445e65d15f */
/* bench 8058.0.12 5bc08bde7fa2 */
/* bench 8058.0.13 0c79dd9c788e */
/* bench 8058.0.14 bbdc8fe4531f */
                buck4: BUCK4 {
                    regulator-name = "buck4";
                    regulator-min-microvolt = <1000000>;
                    regulator-max-microvolt = <1800000>;
                };
                buck5: BUCK5 {
                    regulator-name = "buck5";
                    regulator-min-microvolt = <2500000>;
                    regulator-max-microvolt = <3300000>;
                };
                buck6: BUCK6 {
                    regulator-name = "buck6";
                    regulator-min-microvolt = <500000>;
                    regulator-max-microvolt = <2000000>;
                    regulator-ramp-delay = <2500>;
                };
                buck7: BUCK7 {
                    regulator-name = "buck7";
                    regulator-min-microvolt = <500000>;
                    regulator-max-microvolt = <2000000>;
                    regulator-ramp-delay = <2500>;
                };
                ldo1: LDO1 {
                    regulator-name = "ldo1";
                    regulator-min-microvolt = <800000>;
                    regulator-max-microvolt = <3300000>;
                };
                ldo2: LDO2 {
                    regulator-name = "ldo2";
                    regulator-min-microvolt = <800000>;
                    regulator-max-microvolt = <3300000>;
                };
                ldo3: LDO3 {
                    regulator-name = "ldo3";
                    regulator-min-microvolt = <800000>;
                    regulator-max-microvolt = <3300000>;
                };
                ldo4: LDO4 {
                    regulator-name = "ldo4";
                    regulator-min-microvolt = <800000>;
                    regulator-max-microvolt = <3300000>;
                };
                ldo5: LDO5 {
                    regulator-name = "ldo5";
                    regulator-min-microvolt = <800000>;
                    regulator-max-microvolt = <3300000>;
                };
                ldo6: LDO6 {
                    regulator-name = "ldo6";
                    regulator-min-microvolt = <1800000>;
                    regulator-max-microvolt = <1800000>;
                };
                ldo7_reg: LDO7 {
                    regulator-name = "ldo7";
                    regulator-min-microvolt = <800000>;
                    regulator-max-microvolt = <3300000>;
                };
            };

            leds {
                compatible = "rohm,bd71828-leds";

                led-1 {
                    rohm,led-compatible = "bd71828-grnled";
                    function = LED_FUNCTION_INDICATOR;
                    color = <LED_COLOR_ID_GREEN>;
                };
                led-2 {
                    rohm,led-compatible = "bd71828-ambled";
                    function = LED_FUNCTION_CHARGING;
                    color = <LED_COLOR_ID_AMBER>;
                };
            };
        };
    };
```
