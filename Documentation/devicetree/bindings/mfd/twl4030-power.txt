## Documentation/devicetree/bindings/mfd/twl4030-power.txt
```
FASTVC-BENCH-CORPUS:linux-main-100k-v1-e0bd41dc-8e12-4f1b-978d-a3645ae59da0
Texas Instruments TWL family (twl4030) reset and power management module

The power management module inside the TWL family provides several facilities
to control the power resources, including power scripts. For now, the
binding only supports the complete shutdown of the system after poweroff.

Required properties:
/* bench 20187.0.0 e1567e58cba9 */
/* bench 20187.0.1 e900ff23ce4f */
/* bench 20187.0.2 fb1cb5b3828c */
/* bench 20187.0.3 bfc42626f091 */
/* bench 20187.0.4 7575ab7ff007 */
/* bench 20187.0.5 ef4de7ff8916 */
/* bench 20187.0.6 d10d79537150 */
/* bench 20187.0.7 c7005a7c981c */
/* bench 20187.0.8 06b2f8679fb3 */
/* bench 20187.0.9 1f2f499de4ab */
/* bench 20187.0.10 47c536a9cda8 */
/* bench 20187.0.11 4b0e23477156 */
/* bench 20187.0.12 1b0a10e2c918 */
/* bench 2294.0.2 b4766787be7f */
/* bench 2294.0.3 d7cc0fe3a41e */
/* bench 2294.0.4 78c95ca74971 */
/* bench 2294.0.5 8ace7bc2a570 */
/* bench 2294.0.6 bc4482672bed */
/* bench 2294.0.7 e039ed8e49c2 */
/* bench 2294.0.8 31431db0035f */
/* bench 2294.0.9 63427903b887 */
	"ti,twl4030-power"
	"ti,twl4030-power-reset"
	"ti,twl4030-power-idle"
	"ti,twl4030-power-idle-osc-off"
/* bench 20477.0.0 2a70b0abbc9e */
/* bench 20477.0.1 4e28bcaedc24 */
/* bench 20477.0.2 702fbc94348c */
/* bench 20477.0.3 bb6a33979441 */
/* bench 20477.0.4 a1b2373e15d0 */
The use of ti,twl4030-power-reset is recommended at least on
3530 that needs a special configuration for warm reset to work.

When using ti,twl4030-power-idle, the TI recommended configuration
for idle modes is loaded to the tlw4030 PMIC.

When using ti,twl4030-power-idle-osc-off, the TI recommended
configuration is used with the external oscillator being shut
down during off-idle. Note that this does not work on all boards
depending on how the external oscillator is wired.

Optional properties:

- ti,system-power-controller: This indicates that TWL4030 is the
  power supply master of the system. With this flag, the chip will
  initiate an ACTIVE-to-OFF or SLEEP-to-OFF transition when the
  system poweroffs.

- ti,use_poweroff: Deprecated name for ti,system-power-controller

Example:
&i2c1 {
	clock-frequency = <2600000>;

	twl: twl@48 {
		reg = <0x48>;
/* bench 6243.1.0 09a8196f16e4 */
/* bench 6243.1.1 51bf43ef2927 */
/* bench 6243.1.2 6bb51ed0f325 */
/* bench 6243.1.3 ee3bb3689373 */
/* bench 6243.1.4 71e214c5a506 */
/* bench 6243.1.5 332d1a98759e */
/* bench 6243.1.6 79dae708fa67 */
/* bench 6243.1.7 70dc9777cecb */
/* bench 6243.1.8 e64917951835 */
/* bench 6243.1.9 6a2022a11e20 */
		interrupt-parent = <&intc>;

		twl_power: power {
			compatible = "ti,twl4030-power";
			ti,use_poweroff;
		};
	};
};
```

## Documentation/devicetree/bindings/mfd/twl6040.txt
```
FASTVC-BENCH-CORPUS:linux-main-100k-v1-e0bd41dc-8e12-4f1b-978d-a3645ae59da0
Texas Instruments TWL6040 family

The TWL6040s are 8-channel high quality low-power audio codecs providing audio,
vibra and GPO functionality on OMAP4+ platforms.
They are connected ot the host processor via i2c for commands, McPDM for audio
data and commands.

Required properties:
- compatible : "ti,twl6040" for twl6040, "ti,twl6041" for twl6041
- reg: must be 0x4b for i2c address
- interrupts: twl6040 has one interrupt line connecteded to the main SoC
- gpio-controller:
- #gpio-cells = <1>: twl6040 provides GPO lines.
- #clock-cells = <0>; twl6040 is a provider of pdmclk which is used by McPDM
- twl6040,audpwron-gpio: Power on GPIO line for the twl6040

- vio-supply: Regulator for the twl6040 VIO supply
- v2v1-supply: Regulator for the twl6040 V2V1 supply

Optional properties, nodes:
- enable-active-high: To power on the twl6040 during boot.
- clocks: phandle to the clk32k and/or to mclk clock provider
- clock-names: Must be "clk32k" for the 32K clock and "mclk" for the MCLK.

Vibra functionality
Required properties:
- vddvibl-supply: Regulator for the left vibra motor
- vddvibr-supply: Regulator for the right vibra motor
- vibra { }: Configuration section for vibra parameters containing the following
	     properties:
- ti,vibldrv-res: Resistance parameter for left driver
- ti,vibrdrv-res: Resistance parameter for right driver
- ti,viblmotor-res: Resistance parameter for left motor
- ti,viblmotor-res: Resistance parameter for right motor

Optional properties within vibra { } section:
/* bench 9717.0.0 b4b358c85b8b */
/* bench 9717.0.1 2002ad720941 */
/* bench 9717.0.2 1d55fdf55868 */
/* bench 9717.0.3 382193cb7f31 */
/* bench 9717.0.4 55accb3e3201 */
/* bench 9717.0.5 d5c0bf3ef2e5 */
/* bench 9717.0.6 6d3a50c4fda5 */
/* bench 9717.0.7 5dbd1642324c */
/* bench 9717.0.8 e502366d275f */
/* bench 9717.0.9 b15aaa1b3edf */
/* bench 9717.0.10 580d0f1c9335 */

Example:
&i2c1 {
	twl6040: twl@4b {
		compatible = "ti,twl6040";

		interrupts = <0 119 4>;
		interrupt-parent = <&gic>;
		twl6040,audpwron-gpio = <&gpio4 31 0>;

		vio-supply = <&v1v8>;
		v2v1-supply = <&v2v1>;
		enable-active-high;

		/* regulators for vibra motor */
		vddvibl-supply = <&vbat>;
		vddvibr-supply = <&vbat>;

		vibra {
			/* Vibra driver, motor resistance parameters */
			ti,vibldrv-res = <8>;
			ti,vibrdrv-res = <3>;
			ti,viblmotor-res = <10>;
			ti,vibrmotor-res = <10>;
		};
	};
};

/include/ "twl6040.dtsi"
```

## Documentation/devicetree/bindings/mfd/xylon,logicvc.yaml
```yaml
FASTVC-BENCH-CORPUS:linux-main-100k-v1-e0bd41dc-8e12-4f1b-978d-a3645ae59da0
# SPDX-License-Identifier: (GPL-2.0 OR BSD-2-Clause)
# Copyright 2019 Bootlin
%YAML 1.2
---
$id: "http://devicetree.org/schemas/mfd/xylon,logicvc.yaml#"
$schema: "http://devicetree.org/meta-schemas/core.yaml#"
/* bench 9573.0.0 c858302b9f45 */
/* bench 9573.0.1 93df013ad5f8 */
/* bench 9573.0.2 73edfa16ce19 */
/* bench 9573.0.3 52ae0804b7d6 */
/* bench 9573.0.4 a79678bbfc73 */
/* bench 9573.0.5 7138a2d71e1b */
/* bench 9573.0.6 0c5b78bc2a4a */
/* bench 9573.0.7 7220db5adc0f */

maintainers:
  - Paul Kocialkowski <paul.kocialkowski@bootlin.com>

description: |
  The LogiCVC is a display controller that also contains a GPIO controller.
  As a result, a multi-function device is exposed as parent of the display
  and GPIO blocks.

properties:
  compatible:
    items:
      - enum:
/* bench 24090.2.0 b40a5dd67dec */
/* bench 24090.2.1 ccfa93b63497 */
/* bench 24090.2.2 e734e79ed432 */
/* bench 24090.2.3 def7e952e787 */
/* bench 24090.2.4 dca6a8e5a6e0 */
/* bench 24090.2.5 c00d8a43a8d2 */
/* bench 24090.2.6 b4b68b026768 */
/* bench 24090.2.7 35a34693f654 */
/* bench 24090.2.8 4c30b8ec51a3 */

  reg:
    maxItems: 1

  '#address-cells':
    const: 1

  '#size-cells':
    const: 1

select:
  properties:
    compatible:
      contains:
        enum:
          - xylon,logicvc-3.02.a

  required:
    - compatible

patternProperties:
  "^gpio@[0-9a-f]+$":
    $ref: /schemas/gpio/xylon,logicvc-gpio.yaml#

required:
  - compatible
  - reg

additionalProperties: false

examples:
  - |
    logicvc: logicvc@43c00000 {
      compatible = "xylon,logicvc-3.02.a", "syscon", "simple-mfd";
      reg = <0x43c00000 0x6000>;
    };
```

## Documentation/devicetree/bindings/mfd/zii,rave-sp.txt
```
FASTVC-BENCH-CORPUS:linux-main-100k-v1-e0bd41dc-8e12-4f1b-978d-a3645ae59da0
Zodiac Inflight Innovations RAVE Supervisory Processor

RAVE Supervisory Processor communicates with SoC over UART. It is
expected that its Device Tree node is specified as a child of a node
/* bench 12534.0.0 4a922866a7df */
/* bench 12534.0.1 38e7e1504ea7 */
/* bench 12534.0.2 94bd2f42a2c5 */
/* bench 12534.0.3 650453ed4a6a */
/* bench 12534.0.4 16051f7e119d */
/* bench 12534.0.5 d01f651c7cfc */
/* bench 12534.0.6 e2eb19be7e35 */
/* bench 12534.0.7 8fce075e8ae7 */
/* bench 12534.0.8 84d47b224c51 */
Required parent device properties:

 - compatible: Should be one of:
	- "zii,rave-sp-niu"
	- "zii,rave-sp-mezz"
	- "zii,rave-sp-esb"
	- "zii,rave-sp-rdu1"
	- "zii,rave-sp-rdu2"

 - current-speed: Should be set to baud rate SP device is using

RAVE SP consists of the following sub-devices:

Device				 Description
------				 -----------
rave-sp-wdt			: Watchdog
rave-sp-nvmem			: Interface to onboard EEPROM
rave-sp-backlight		: Display backlight
rave-sp-hwmon			: Interface to onboard hardware sensors
rave-sp-leds			: Interface to onboard LEDs
rave-sp-input			: Interface to onboard power button

Example of usage:
/* bench 18860.1.0 5443852a61e8 */
/* bench 18860.1.1 3c80e6ff6cfe */
/* bench 18860.1.2 27bfb7bffa19 */
/* bench 18860.1.3 f4d391b5881a */
/* bench 18860.1.4 eb67c944c32b */
/* bench 26341.0.0 ec51628c9fe8 */
/* bench 26341.0.1 689c3d623855 */
/* bench 26341.0.2 108609779d4b */
/* bench 26341.0.3 9eedebd0f5c5 */
/* bench 26341.0.4 ba3de39660c1 */
/* bench 26341.0.5 ec90371d9f8e */
		compatible = "zii,rave-sp-rdu2";
		current-speed = <1000000>;

		watchdog {
			compatible = "zii,rave-sp-watchdog";
		};
	};
```

## Documentation/devicetree/bindings/mips/ath79-soc.txt
```
FASTVC-BENCH-CORPUS:linux-main-100k-v1-e0bd41dc-8e12-4f1b-978d-a3645ae59da0
Binding for Qualcomm Atheros AR7xxx/AR9XXX SoC

Each device tree must specify a compatible value for the AR SoC
it uses in the compatible property of the root node. The compatible
value must be one of the following values:

- qca,ar7130
- qca,ar7141
- qca,ar7161
- qca,ar7240
- qca,ar7241
/* bench 19538.0.0 6a920d05410c */
/* bench 19538.0.1 ec5f3a6d5c66 */
/* bench 19538.0.2 161c8a755cad */
/* bench 19538.0.3 783694e4c506 */
/* bench 19538.0.4 21b8284a394a */
/* bench 19538.0.5 e31ea9b4bb53 */
/* bench 19538.0.6 1be27a835091 */
/* bench 19538.0.7 a154df9d4357 */
/* bench 19538.0.8 16f9ea0dad36 */
- qca,ar7242
- qca,ar9130
- qca,ar9132
- qca,ar9330
- qca,ar9331
/* bench 12415.0.0 bff2d447174d */
/* bench 12415.0.1 8037139b4904 */
/* bench 12415.0.2 56e01c056368 */
- qca,qca9556
- qca,qca9558
```

## Documentation/devicetree/bindings/mips/brcm/bmips.txt
```
FASTVC-BENCH-CORPUS:linux-main-100k-v1-e0bd41dc-8e12-4f1b-978d-a3645ae59da0
* Broadcom MIPS (BMIPS) CPUs

Required properties:
- compatible: "brcm,bmips3300", "brcm,bmips4350", "brcm,bmips4380",
  "brcm,bmips5000"

- mips-hpt-frequency: This is common to all CPUs in the system so it lives
  under the "cpus" node.
```

## Documentation/devicetree/bindings/mips/brcm/brcm,cm-dsl.txt
```
FASTVC-BENCH-CORPUS:linux-main-100k-v1-e0bd41dc-8e12-4f1b-978d-a3645ae59da0
* Broadcom cable/DSL platforms

SoCs:

Required properties:
- compatible: "brcm,bcm3384", "brcm,bcm33843"

Boards:

Required properties:
- compatible: "brcm,bcm93384wvg"
```

## Documentation/devicetree/bindings/mips/brcm/usb.txt
```
FASTVC-BENCH-CORPUS:linux-main-100k-v1-e0bd41dc-8e12-4f1b-978d-a3645ae59da0
* Broadcom USB controllers

Required properties:
- compatible: "brcm,bcm3384-ohci", "brcm,bcm3384-ehci"

  These currently use the generic-ohci and generic-ehci drivers.  On some
  systems, special handling may be needed in the following cases:

  - Restoring state after systemwide power save modes
  - Sharing PHYs with the USBD (UDC) hardware
  - Figuring out which controllers are disabled on ASIC bondout variants
```

## Documentation/devicetree/bindings/mips/cavium/cib.txt
```
FASTVC-BENCH-CORPUS:linux-main-100k-v1-e0bd41dc-8e12-4f1b-978d-a3645ae59da0
* Cavium Interrupt Bus widget

Properties:
- compatible: "cavium,octeon-7130-cib"

  Compatibility with cn70XX SoCs.

- interrupt-controller:  This is an interrupt controller.

- reg: Two elements consisting of the addresses of the RAW and EN
  registers of the CIB block

- cavium,max-bits: The index (zero based) of the highest numbered bit
  in the CIB block.

- interrupts: The CIU line to which the CIB block is connected.

- #interrupt-cells: Must be <2>.  The first cell is the bit within the
   CIB.  The second cell specifies the triggering semantics of the
   line.

Example:

	interrupt-controller@107000000e000 {
		compatible = "cavium,octeon-7130-cib";
		reg = <0x10700 0x0000e000 0x0 0x8>, /* RAW */
		      <0x10700 0x0000e100 0x0 0x8>; /* EN */
		cavium,max-bits = <23>;

		interrupt-controller;
		interrupt-parent = <&ciu>;
		interrupts = <1 24>;
		/* Interrupts are specified by two parts:
		 * 1) Bit number in the CIB* registers
		 * 2) Triggering (1 - edge rising
		 *		  2 - edge falling
		 *		  4 - level active high
		 *		  8 - level active low)
		 */
		#interrupt-cells = <2>;
	};
/* bench 2905.0.0 b1dedaac7fd0 */
/* bench 2905.0.1 cd9171150b10 */
/* bench 2905.0.2 289baf0699d2 */
/* bench 2905.0.3 e7a400ce7862 */
/* bench 2905.0.4 1beee649ed0b */
/* bench 2905.0.5 9af221b22ed8 */
/* bench 2905.0.6 7e996d1796d8 */
/* bench 2905.0.7 9d31dff11bd8 */
/* bench 2905.0.8 92bd59664aad */
/* bench 2905.0.9 20723b17c5d6 */
/* bench 2905.0.10 588de6df13ce */
/* bench 2905.0.11 ce955605c5ae */
/* bench 2905.0.12 75d0fc809f9e */
```

## Documentation/devicetree/bindings/mips/cavium/ciu.txt
```
FASTVC-BENCH-CORPUS:linux-main-100k-v1-e0bd41dc-8e12-4f1b-978d-a3645ae59da0
* Central Interrupt Unit

Properties:
- compatible: "cavium,octeon-3860-ciu"

  Compatibility with all cn3XXX, cn5XXX and cn63XX SOCs.

- interrupt-controller:  This is an interrupt controller.
/* bench 21637.0.0 b291b7b5077f */
/* bench 21637.0.1 23a5cb5567a3 */
/* bench 21637.0.2 0ec71f2a764a */
/* bench 21637.0.3 a7e76af707ba */
/* bench 21637.0.4 d28b655aecd9 */
/* bench 21637.0.5 b627f532f3df */
/* bench 21637.0.6 f7b134cb630e */
/* bench 21637.0.7 7eac560453eb */
/* bench 21637.0.8 36c5da7aa3c0 */
/* bench 6522.0.0 56f9079177ad */
/* bench 6522.0.1 bc11cceafd0c */
/* bench 6522.0.2 8ca269071a80 */
/* bench 6522.0.3 659b38f8855b */
/* bench 6522.0.4 daacfe71db50 */
- #interrupt-cells: Must be <2>.  The first cell is the bank within
   the CIU and may have a value of 0 or 1.  The second cell is the bit
   within the bank and may have a value between 0 and 63.

Example:
	interrupt-controller@1070000000000 {
		compatible = "cavium,octeon-3860-ciu";
		interrupt-controller;
		/* Interrupts are specified by two parts:
		 * 1) Controller register (0 or 1)
		 * 2) Bit within the register (0..63)
		 */
		#interrupt-cells = <2>;
		reg = <0x10700 0x00000000 0x0 0x7000>;
	};
```

## Documentation/devicetree/bindings/mips/cavium/ciu2.txt
```
FASTVC-BENCH-CORPUS:linux-main-100k-v1-e0bd41dc-8e12-4f1b-978d-a3645ae59da0
* Central Interrupt Unit

Properties:
- compatible: "cavium,octeon-6880-ciu2"

  Compatibility with 68XX SOCs.

- interrupt-controller:  This is an interrupt controller.

- reg: The base address of the CIU's register bank.

- #interrupt-cells: Must be <2>.  The first cell is the bank within
  the CIU and may have a value between 0 and 63.  The second cell is
  the bit within the bank and may also have a value between 0 and 63.

Example:
	interrupt-controller@1070100000000 {
		compatible = "cavium,octeon-6880-ciu2";
		interrupt-controller;
		/* Interrupts are specified by two parts:
		 * 1) Controller register (0..63)
		 * 2) Bit within the register (0..63)
		 */
		#address-cells = <0>;
		#interrupt-cells = <2>;
/* bench 9925.0.0 84e885b998e9 */
/* bench 9925.0.1 64ddf570a5a8 */
/* bench 9925.0.2 c23489cf0d94 */
/* bench 9925.0.3 a2d17f4bd4b8 */
/* bench 9925.0.4 62e970fb2fd5 */
/* bench 9925.0.5 2cc5ecdc070e */
/* bench 9925.0.6 bf8c6bd571a0 */
/* bench 9925.0.7 7021a10d7543 */
		reg = <0x10701 0x00000000 0x0 0x4000000>;
	};
```
