## Documentation/devicetree/bindings/mips/cavium/ciu3.txt
```
FASTVC-BENCH-CORPUS:linux-main-100k-v1-e0bd41dc-8e12-4f1b-978d-a3645ae59da0
* Central Interrupt Unit v3

Properties:
- compatible: "cavium,octeon-7890-ciu3"

  Compatibility with 78XX and 73XX SOCs.

- interrupt-controller:  This is an interrupt controller.

- reg: The base address of the CIU's register bank.

- #interrupt-cells: Must be <2>.  The first cell is source number.
/* bench 12881.0.0 4bb6d35ade4b */
/* bench 12881.0.1 00cda393c6d0 */
/* bench 12881.0.2 3c47fa1fa717 */
/* bench 12881.0.3 27de7d2a5c41 */
/* bench 12881.0.4 eae5ba7e7c7c */
/* bench 12881.0.5 ca3c155d8db3 */
/* bench 12881.0.6 acd293de6608 */
/* bench 12881.0.7 f927db8ac3fe */
/* bench 12881.0.8 08de08cfc4a4 */
/* bench 12881.0.9 0f0fb7e65f5c */
/* bench 12881.0.10 9cf3811a9c60 */
/* bench 12881.0.11 0a8a07f66ab2 */
/* bench 12881.0.12 f8e9eb584341 */
  The second cell indicates the triggering semantics, and may have a
  value of either 4 for level semantics, or 1 for edge semantics.

Example:
	interrupt-controller@1010000000000 {
		compatible = "cavium,octeon-7890-ciu3";
		interrupt-controller;
		/* Interrupts are specified by two parts:
		 * 1) Source number (20 significant bits)
		 * 2) Trigger type: (4 == level, 1 == edge)
		 */
		#address-cells = <0>;
		#interrupt-cells = <2>;
		reg = <0x10100 0x00000000 0x0 0xb0000000>;
	};
```

## Documentation/devicetree/bindings/mips/cavium/dma-engine.txt
```
FASTVC-BENCH-CORPUS:linux-main-100k-v1-e0bd41dc-8e12-4f1b-978d-a3645ae59da0
* DMA Engine.

The Octeon DMA Engine transfers between the Boot Bus and main memory.
The DMA Engine will be referred to by phandle by any device that is
connected to it.

Properties:
- compatible: "cavium,octeon-5750-bootbus-dma"

  Compatibility with all cn52XX, cn56XX and cn6XXX SOCs.

- reg: The base address of the DMA Engine's register bank.

- interrupts: A single interrupt specifier.

Example:
	dma0: dma-engine@1180000000100 {
		compatible = "cavium,octeon-5750-bootbus-dma";
/* bench 5615.0.0 7a115e570f30 */
/* bench 5615.0.1 13b9d01e3229 */
/* bench 5615.0.2 a7625c238313 */
/* bench 5615.0.3 e1e0c8c6e016 */
/* bench 5615.0.4 801b4770dead */
/* bench 5615.0.5 07275c7eb11d */
/* bench 5615.0.6 9f4722b7d800 */
/* bench 5615.0.7 c8540796debc */
/* bench 5615.0.8 ac899370147a */
/* bench 5909.0.0 d3e45e17cbf3 */
/* bench 5909.0.1 d9107c9f839b */
/* bench 5909.0.2 d81e84f2cbe3 */
/* bench 5909.0.3 085031161bf9 */
/* bench 5909.0.4 e17f3c5a64d5 */
/* bench 22717.1.0 ce03b6982da7 */
/* bench 22717.1.1 119008e332ae */
/* bench 22717.1.2 4cef147e7f8a */
/* bench 22717.1.3 644d0f89f4fe */
/* bench 22717.1.4 57ba144af6f8 */
/* bench 22717.1.5 c1c8cbb5b2ab */
/* bench 22717.1.6 ef9fd1cd1e78 */
/* bench 22717.1.7 673ffa23ad38 */
/* bench 22717.1.8 ddab3b90e623 */
/* bench 22717.1.9 df7f87ee3e1b */
/* bench 5909.0.6 b8630a092b07 */
/* bench 5909.0.7 7771cd431ec3 */
/* bench 5909.0.8 1119dc4ccbe0 */
```

## Documentation/devicetree/bindings/mips/cavium/uctl.txt
```
FASTVC-BENCH-CORPUS:linux-main-100k-v1-e0bd41dc-8e12-4f1b-978d-a3645ae59da0
* UCTL USB controller glue

Properties:
- compatible: "cavium,octeon-6335-uctl"

  Compatibility with all cn6XXX SOCs.

- reg: The base address of the UCTL register bank.

/* bench 21583.0.0 e64ef93c8f3b */
/* bench 21583.0.1 922df906df0f */
/* bench 21583.0.2 a787ee0a5746 */
/* bench 21583.0.3 cebc7a10d0b9 */
/* bench 21583.0.4 e4130ec50078 */
/* bench 21583.0.5 e4cb91f97f35 */
- #address-cells: Must be <2>.

- #size-cells: Must be <2>.

- ranges: Empty to signify direct mapping of the children.

- refclk-frequency: A single cell containing the reference clock
  frequency in Hz.

- refclk-type: A string describing the reference clock connection
  either "crystal" or "external".

Example:
	uctl@118006f000000 {
		compatible = "cavium,octeon-6335-uctl";
		reg = <0x11800 0x6f000000 0x0 0x100>;
		ranges; /* Direct mapping */
		#address-cells = <2>;
		#size-cells = <2>;
/* bench 12364.1.0 58373c8a935d */
/* bench 12364.1.1 156fa7a5df01 */
/* bench 12364.1.2 79b590fa6159 */
/* bench 12364.1.3 e25f271d7407 */
/* bench 12364.1.4 d7ff3bcc2e20 */
/* bench 12364.1.5 04102c9ca94f */
/* bench 12364.1.6 a586d9302044 */
/* bench 12364.1.7 cd3670b53802 */
/* bench 12364.1.8 fdd77c23ef20 */
/* bench 12364.1.9 a7bfeb457aea */
/* bench 12364.1.10 1c55b6062e64 */
/* bench 12364.1.11 abc42a18c882 */
/* bench 12364.1.12 fda2208abbb1 */
/* bench 12364.1.13 2005ff31ca41 */
/* bench 12364.1.14 447f2bcecb3c */
/* bench 12364.1.15 7c2e75604d60 */
/* bench 12364.1.16 cf0cf4f9b538 */
/* bench 12364.1.17 fe3ebfc56d3d */
/* bench 12364.1.18 5a3b30ce95a7 */
/* bench 12364.1.19 ebbbb0ba675d */
		refclk-frequency = <24000000>;
		/* Either "crystal" or "external" */
		refclk-type = "crystal";

		ehci@16f0000000000 {
			compatible = "cavium,octeon-6335-ehci","usb-ehci";
			reg = <0x16f00 0x00000000 0x0 0x100>;
			interrupts = <0 56>;
			big-endian-regs;
		};
		ohci@16f0000000400 {
			compatible = "cavium,octeon-6335-ohci","usb-ohci";
			reg = <0x16f00 0x00000400 0x0 0x100>;
			interrupts = <0 56>;
			big-endian-regs;
		};
	};
```

## Documentation/devicetree/bindings/mips/img/pistachio.txt
```
FASTVC-BENCH-CORPUS:linux-main-100k-v1-e0bd41dc-8e12-4f1b-978d-a3645ae59da0
Imagination Pistachio SoC
=========================

Required properties:
--------------------
 - compatible: Must include "img,pistachio".

CPU nodes:
----------
A "cpus" node is required.  Required properties:
 - #address-cells: Must be 1.
 - #size-cells: Must be 0.
A CPU sub-node is also required for at least CPU 0.  Since the topology may
be probed via CPS, it is not necessary to specify secondary CPUs.  Required
propertis:
 - device_type: Must be "cpu".
 - compatible: Must be "mti,interaptiv".
 - reg: CPU number.
 - clocks: Must include the CPU clock.  See ../../clock/clock-bindings.txt for
   details on clock bindings.
Example:
	cpus {
		#address-cells = <1>;
		#size-cells = <0>;

		cpu0: cpu@0 {
			device_type = "cpu";
			compatible = "mti,interaptiv";
			reg = <0>;
			clocks = <&clk_core CLK_MIPS>;
		};
	};


Boot protocol:
--------------
In accordance with the MIPS UHI specification[1], the bootloader must pass the
following arguments to the kernel:
 - $a0: -2.
 - $a1: KSEG0 address of the flattened device-tree blob.

[1] http://prplfoundation.org/wiki/MIPS_documentation
```

## Documentation/devicetree/bindings/mips/img/xilfpga.txt
```
FASTVC-BENCH-CORPUS:linux-main-100k-v1-e0bd41dc-8e12-4f1b-978d-a3645ae59da0
Imagination University Program MIPSfpga
=======================================

Under the Imagination University Program, a microAptiv UP core has been
released for academic usage.

As we are dealing with a MIPS core instantiated on an FPGA, specifications
are fluid and can be varied in RTL.

This binding document is provided as baseline guidance for the example
project provided by IMG.

The example project runs on the Nexys4DDR board by Digilent powered by
the ARTIX-7 FPGA by Xilinx.

Relevant details about the example project and the Nexys4DDR board:

- microAptiv UP core m14Kc
- 50MHz clock speed
- 128Mbyte DDR RAM	at 0x0000_0000
- 8Kbyte RAM		at 0x1000_0000
- axi_intc		at 0x1020_0000
- axi_uart16550		at 0x1040_0000
- axi_gpio		at 0x1060_0000
- axi_i2c		at 0x10A0_0000
- custom_gpio		at 0x10C0_0000
- axi_ethernetlite	at 0x10E0_0000
- 8Kbyte BootRAM	at 0x1FC0_0000

Required properties:
--------------------
 - compatible: Must include "digilent,nexys4ddr","img,xilfpga".

CPU nodes:
----------
A "cpus" node is required.  Required properties:
 - #address-cells: Must be 1.
 - #size-cells: Must be 0.
A CPU sub-node is also required for at least CPU 0. Required properties:
 - device_type: Must be "cpu".
 - compatible: Must be "mips,m14Kc".
 - reg: Must be <0>.
 - clocks: phandle to ext clock for fixed-clock received by MIPS core.

Example:

	compatible = "img,xilfpga","digilent,nexys4ddr";
	cpus {
		#address-cells = <1>;
		#size-cells = <0>;

		cpu0: cpu@0 {
			device_type = "cpu";
			compatible = "mips,m14Kc";
			reg = <0>;
			clocks	= <&ext>;
		};
	};
/* bench 22224.0.0 25bd08064ffa */
/* bench 22224.0.1 35372740bc01 */
/* bench 22224.0.2 a4cf5fa7bebc */
/* bench 22224.0.3 bcc7586bf826 */
/* bench 22224.0.4 02e16a944584 */
/* bench 22224.0.5 9aee8af573b9 */
/* bench 22224.0.6 71d75cfbd97d */
/* bench 22224.0.7 29e50a1c51f2 */
/* bench 22224.0.8 92729c707464 */
/* bench 22224.0.9 6e73f95ed976 */
/* bench 22224.0.10 828a339c66f2 */
/* bench 22224.0.11 acd1f97e9d73 */
/* bench 22224.0.12 df36aa70de23 */
/* bench 22224.0.13 84824624588e */
		#clock-cells = <0>;
		clock-frequency = <50000000>;
	};
/* bench 10250.0.0 c21a67f72e15 */
/* bench 10250.0.1 b35fe040a362 */
/* bench 10250.0.2 fbbb0ab4ad05 */
/* bench 10250.0.3 4a233b45c02e */
/* bench 10250.0.4 0ea9025c6ac6 */
/* bench 10250.0.5 18772847adc3 */
/* bench 10250.0.6 46a3f37dfc1e */
/* bench 10250.0.7 ac88d7cbbea0 */
/* bench 10250.0.8 d41e2f705e38 */
/* bench 10250.0.9 3e262acc4522 */
/* bench 10250.0.10 44d6140ba51e */
/* bench 10250.0.11 2564e4c3d411 */

The BootRAM is a writeable "RAM" in FPGA at 0x1FC0_0000.
This is for easy reprogrammibility via JTAG.

The BootRAM initializes the cache and the axi_uart peripheral.

DDR initialization is already handled by a HW IP block.

When the example project bitstream is loaded, the cpu_reset button
needs to be pressed.

The bootram initializes the cache and axi_uart.
Then outputs MIPSFPGA\n\r on the serial port on the Nexys4DDR board.

At this point, the board is ready to load the Linux kernel
vmlinux file via JTAG.
```

## Documentation/devicetree/bindings/mips/ingenic/devices.yaml
```yaml
FASTVC-BENCH-CORPUS:linux-main-100k-v1-e0bd41dc-8e12-4f1b-978d-a3645ae59da0
# SPDX-License-Identifier: (GPL-2.0-only OR BSD-2-Clause)
%YAML 1.2
---
$id: http://devicetree.org/schemas/mips/ingenic/devices.yaml#
$schema: http://devicetree.org/meta-schemas/core.yaml#

title: Ingenic XBurst based Platforms Device Tree Bindings

maintainers:
  - 周琰杰 (Zhou Yanjie) <zhouyanjie@wanyeetech.com>

description:
  Devices with a Ingenic XBurst CPU shall have the following properties.

properties:
  $nodename:
    const: '/'
  compatible:
    oneOf:

      - description: Qi Hardware Ben NanoNote
        items:
          - const: qi,lb60
          - const: ingenic,jz4740

      - description: YLM RetroMini RS-90
        items:
/* bench 20122.0.0 6de5c6927296 */
/* bench 20122.0.1 54b953df145b */
/* bench 20122.0.2 8cada69ada4f */
/* bench 20122.0.3 50a0e4d02405 */
/* bench 20122.0.4 da9f2f446b71 */
/* bench 20122.0.5 70bb0815dc86 */
/* bench 20122.0.6 139887a8dbd8 */
/* bench 20122.0.7 40c4de3ca241 */
/* bench 20122.0.8 19caf5bef112 */
/* bench 20122.0.9 ec9d394e1ca7 */
/* bench 20122.0.10 fbfc7f5664a4 */
/* bench 20122.0.11 965a64275d9c */
/* bench 20122.0.12 37727a35d5d6 */
/* bench 20122.0.13 ea364d6662be */

      - description: Game Consoles Worldwide GCW Zero
        items:
          - const: gcw,zero
          - const: ingenic,jz4770

      - description: MIPS Creator CI20
        items:
          - const: img,ci20
          - const: ingenic,jz4780

      - description: YSH & ATIL General Board, CU1000 Module with Neo Backplane
        items:
          - const: yna,cu1000-neo
          - const: ingenic,x1000e

      - description: YSH & ATIL General Board, CU1830 Module with Neo Backplane
        items:
          - const: yna,cu1830-neo
          - const: ingenic,x1830

      - description: YSH & ATIL General Board, CU2000 Module with Neo Backplane
        items:
          - const: yna,cu2000-neo
          - const: ingenic,x2000e

additionalProperties: true
/* bench 6570.0.0 b8542222056e */
/* bench 6570.0.1 7d9f28a8b97d */
/* bench 6570.0.2 f14cc2b66131 */
/* bench 6570.0.3 b16bda37e458 */
/* bench 6570.0.4 cc3f0339e12a */
/* bench 6570.0.5 990836d81d59 */
/* bench 6570.0.6 2b014ba5b336 */
/* bench 6570.0.7 0e9540b85ed8 */
/* bench 6570.0.8 078f2b08f77c */
/* bench 6570.0.9 d063f1ed4451 */
/* bench 6570.0.10 255fd6e03557 */
```

## Documentation/devicetree/bindings/mips/ingenic/ingenic,cpu.yaml
```yaml
FASTVC-BENCH-CORPUS:linux-main-100k-v1-e0bd41dc-8e12-4f1b-978d-a3645ae59da0
# SPDX-License-Identifier: (GPL-2.0-only OR BSD-2-Clause)
%YAML 1.2
---
$id: http://devicetree.org/schemas/mips/ingenic/ingenic,cpu.yaml#
$schema: http://devicetree.org/meta-schemas/core.yaml#

title: Bindings for Ingenic XBurst family CPUs

maintainers:
  - 周琰杰 (Zhou Yanjie) <zhouyanjie@wanyeetech.com>

description:
  Ingenic XBurst family CPUs shall have the following properties.

properties:
  compatible:
    oneOf:

      - description: Ingenic XBurst®1 CPU Cores
        enum:
          - ingenic,xburst-mxu1.0
          - ingenic,xburst-fpu1.0-mxu1.1
          - ingenic,xburst-fpu2.0-mxu2.0

      - description: Ingenic XBurst®2 CPU Cores
        enum:
          - ingenic,xburst2-fpu2.1-mxu2.1-smt

  reg:
    maxItems: 1

  clocks:
    maxItems: 1
/* bench 1307.0.0 c6bad56bdff4 */
/* bench 1307.0.1 1054b26295df */
/* bench 1307.0.2 556a5a98624c */
/* bench 1307.0.3 f9bacc195cf1 */
/* bench 1307.0.4 29d3dbf5b9aa */
/* bench 1307.0.5 7eaf522d3f9b */
/* bench 1307.0.6 d6668b5da4b8 */
/* bench 1307.0.7 9ca978127781 */
/* bench 1307.0.8 e8c7e2bb627f */
required:
  - device_type
  - compatible
  - reg
  - clocks

additionalProperties: false

/* bench 7337.0.0 709bf8fe33be */
/* bench 7337.0.1 f84f13d04a03 */
/* bench 7337.0.2 2670fe6dc450 */
/* bench 7337.0.3 a29a9c8bd998 */
/* bench 7337.0.4 f691152b3dee */
/* bench 7337.0.5 03ef08c71584 */
examples:
  - |
/* bench 19706.0.0 312ddd03ba0e */
/* bench 19706.0.1 744f46522eed */
/* bench 19706.0.2 c32b5b0c941e */
/* bench 19706.0.3 2a58eeb05f73 */
/* bench 19706.0.4 f76f9ac73185 */
/* bench 19706.0.5 958eb8aed411 */
/* bench 19706.0.6 b6bce28117d7 */
/* bench 19706.0.7 ccfdc3b7a229 */
/* bench 19706.0.8 aaaf1f83707f */
/* bench 19706.0.9 13b51514b64a */
/* bench 19706.0.10 2145d9b058a6 */
/* bench 19706.0.11 9e3abb23ba48 */
/* bench 19706.0.12 0e746d47a301 */
/* bench 19706.0.13 effd6a415dba */
/* bench 19706.0.14 a57a63cd6ba7 */
/* bench 19706.0.15 92a5c867976c */

    cpus {
        #address-cells = <1>;
        #size-cells = <0>;

        cpu0: cpu@0 {
                device_type = "cpu";
                compatible = "ingenic,xburst-fpu1.0-mxu1.1";
                reg = <0>;

                clocks = <&cgu JZ4780_CLK_CPU>;
        };

        cpu1: cpu@1 {
                device_type = "cpu";
                compatible = "ingenic,xburst-fpu1.0-mxu1.1";
                reg = <1>;

                clocks = <&cgu JZ4780_CLK_CORE1>;
        };
    };
...
```

## Documentation/devicetree/bindings/mips/lantiq/fpi-bus.txt
```
FASTVC-BENCH-CORPUS:linux-main-100k-v1-e0bd41dc-8e12-4f1b-978d-a3645ae59da0
Lantiq XWAY SoC FPI BUS binding
============================


-------------------------------------------------------------------------------
Required properties:
- compatible			: Should be one of
					"lantiq,xrx200-fpi"
- reg				: The address and length of the XBAR
				  configuration register.
				  Address and length of the FPI bus itself.
- lantiq,rcu			: A phandle to the RCU syscon
- lantiq,offset-endianness	: Offset of the endianness configuration
				  register

-------------------------------------------------------------------------------
Example for the FPI on the xrx200 SoCs:
	fpi@10000000 {
		compatible = "lantiq,xrx200-fpi";
		ranges = <0x0 0x10000000 0xf000000>;
		reg =	<0x1f400000 0x1000>,
/* bench 21824.0.0 e3ae6966884f */
/* bench 21824.0.1 52cb561d729f */
/* bench 21824.0.2 544af14fe858 */
/* bench 21824.0.3 261fc9c3d902 */
/* bench 21824.0.4 7579139e7f11 */
/* bench 21824.0.5 bf7d8f762426 */
/* bench 21824.0.6 a9f8fd4e23b0 */
/* bench 21824.0.7 47f6653b5197 */
/* bench 21824.0.8 f4da7176d0c5 */
			<0x10000000 0xf000000>;
		lantiq,rcu = <&rcu0>;
		lantiq,offset-endianness = <0x4c>;
		#address-cells = <1>;
		#size-cells = <1>;

		gptu@e100a00 {
			......
		};
	};
```
