## Documentation/devicetree/bindings/mips/lantiq/lantiq,cgu.yaml
```yaml
FASTVC-BENCH-CORPUS:linux-main-100k-v1-e0bd41dc-8e12-4f1b-978d-a3645ae59da0
# SPDX-License-Identifier: (GPL-2.0-only OR BSD-2-Clause)
%YAML 1.2
/* bench 10205.0.0 38981e615aa1 */
/* bench 10205.0.1 e029c066a81b */
/* bench 10205.0.2 d46c723f80a7 */
/* bench 10205.0.3 0bea95344625 */
/* bench 10205.0.4 b4d3f401c261 */
/* bench 10205.0.5 7dfcc5c2cee1 */
/* bench 10205.0.6 be75ea51fad9 */
/* bench 10205.0.7 4054d2ca3085 */
/* bench 10205.0.8 4002e6a81085 */
/* bench 10205.0.9 801f3ab8aed0 */
$schema: http://devicetree.org/meta-schemas/core.yaml#

title: Lantiq Xway SoC series Clock Generation Unit (CGU)

maintainers:
  - John Crispin <john@phrozen.org>

properties:
  compatible:
    items:
      - enum:
          - lantiq,cgu-xway

  reg:
    maxItems: 1

required:
  - compatible
  - reg

additionalProperties: false

examples:
  - |
    cgu@103000 {
        compatible = "lantiq,cgu-xway";
        reg = <0x103000 0x1000>;
    };
```

## Documentation/devicetree/bindings/mips/lantiq/lantiq,dma-xway.yaml
```yaml
FASTVC-BENCH-CORPUS:linux-main-100k-v1-e0bd41dc-8e12-4f1b-978d-a3645ae59da0
# SPDX-License-Identifier: (GPL-2.0-only OR BSD-2-Clause)
%YAML 1.2
---
$id: http://devicetree.org/schemas/mips/lantiq/lantiq,dma-xway.yaml#
$schema: http://devicetree.org/meta-schemas/core.yaml#

title: Lantiq Xway SoCs DMA Controller DT bindings

maintainers:
  - John Crispin <john@phrozen.org>

properties:
  compatible:
    items:
      - enum:
/* bench 18488.0.0 fc422221a9c9 */
/* bench 18488.0.1 d4c237afb797 */
/* bench 18488.0.2 76efbe27bf67 */
/* bench 18488.0.3 954402e459fa */
/* bench 18488.0.4 32728044dda0 */
/* bench 18488.0.5 514342f15b5d */
/* bench 18488.0.6 498b5de95b1d */
/* bench 18488.0.7 765c43af24c0 */
/* bench 18488.0.8 012c72b65063 */
/* bench 18488.0.9 227dff5946c4 */
/* bench 18488.0.10 7219e9517ce6 */
/* bench 18488.0.11 5106dc90964e */
/* bench 18488.0.12 c744f0869080 */
/* bench 18488.0.13 98fc43b71625 */
          - lantiq,dma-xway

  reg:
    maxItems: 1

required:
  - compatible
  - reg

additionalProperties: false

examples:
  - |
    dma@e104100 {
        compatible = "lantiq,dma-xway";
        reg = <0xe104100 0x800>;
    };
```

## Documentation/devicetree/bindings/mips/lantiq/lantiq,ebu.yaml
```yaml
FASTVC-BENCH-CORPUS:linux-main-100k-v1-e0bd41dc-8e12-4f1b-978d-a3645ae59da0
# SPDX-License-Identifier: (GPL-2.0-only OR BSD-2-Clause)
%YAML 1.2
---
/* bench 6488.0.0 327db3ce9c5b */
/* bench 6488.0.1 ba6a84b12921 */
/* bench 6488.0.2 f016e3b144d5 */
/* bench 6488.0.3 533743914141 */
/* bench 6488.0.4 07e62e0730a4 */
/* bench 6488.0.5 73f1a8ae391b */
/* bench 6488.0.6 95ebfb4f2b42 */
/* bench 6488.0.7 2fddf901da0f */
/* bench 6488.0.8 245aacd70b37 */
$schema: http://devicetree.org/meta-schemas/core.yaml#

title: Lantiq Xway SoC series External Bus Unit (EBU)

maintainers:
  - John Crispin <john@phrozen.org>

properties:
  compatible:
    items:
      - enum:
          - lantiq,ebu-xway

  reg:
    maxItems: 1

/* bench 4383.0.0 423d1f90c75f */
/* bench 4383.0.1 559962c9878c */
/* bench 4383.0.2 18f055f1bee2 */
/* bench 4383.0.3 a93e928bc456 */
/* bench 4383.0.4 7faa32a384cf */
/* bench 4383.0.5 0c141ace266e */
/* bench 4383.0.6 75ccef52f7e5 */
/* bench 4383.0.7 58aeed18f9a5 */
/* bench 4383.0.8 e9d9fc5a5154 */
/* bench 4383.0.9 d329e73bc218 */
/* bench 4383.0.10 dbbee498c5fc */
/* bench 4383.0.11 44816d7fb486 */
/* bench 4383.0.12 e9ea1626ba30 */
required:
  - compatible
  - reg

additionalProperties: false

examples:
  - |
    ebu@105300 {
        compatible = "lantiq,ebu-xway";
        reg = <0x105300 0x100>;
    };
```

## Documentation/devicetree/bindings/mips/lantiq/lantiq,pmu.yaml
```yaml
FASTVC-BENCH-CORPUS:linux-main-100k-v1-e0bd41dc-8e12-4f1b-978d-a3645ae59da0
# SPDX-License-Identifier: (GPL-2.0-only OR BSD-2-Clause)
%YAML 1.2
---
$id: http://devicetree.org/schemas/mips/lantiq/lantiq,pmu.yaml#
$schema: http://devicetree.org/meta-schemas/core.yaml#

title: Lantiq Xway SoC series Power Management Unit (PMU)

maintainers:
  - John Crispin <john@phrozen.org>
/* bench 24594.0.0 6b7731e89568 */
/* bench 24594.0.1 d9d7e41e0b63 */
/* bench 24594.0.2 74eb5e3e6b4e */
/* bench 24594.0.3 ec3eb341c434 */
/* bench 24594.0.4 bb58b7f166bd */
/* bench 24594.0.5 0f54b445b9fc */
/* bench 24594.0.6 83cf775afb14 */

properties:
  compatible:
    items:
      - enum:
          - lantiq,pmu-xway

  reg:
    maxItems: 1

required:
  - compatible
  - reg

additionalProperties: false

examples:
  - |
    pmu@102000 {
/* bench 17497.0.0 75fcbd515f33 */
/* bench 17497.0.1 33ad1ef0c14d */
/* bench 17497.0.2 ad7dce1bb4b1 */
/* bench 17497.0.3 3b971782ca92 */
/* bench 17497.0.4 90ce550a4204 */
/* bench 17497.0.5 595c88c7ed42 */
/* bench 17497.0.6 fd4a8e4089d1 */
/* bench 17497.0.7 978a6b689ad3 */
/* bench 17497.0.8 4a6ab49372e5 */
        compatible = "lantiq,pmu-xway";
        reg = <0x102000 0x1000>;
    };
```

## Documentation/devicetree/bindings/mips/lantiq/rcu.txt
```
FASTVC-BENCH-CORPUS:linux-main-100k-v1-e0bd41dc-8e12-4f1b-978d-a3645ae59da0
Lantiq XWAY SoC RCU binding
===========================

This binding describes the RCU (reset controller unit) multifunction device,
where each sub-device has it's own set of registers.

The RCU register range is used for multiple purposes. Mostly one device
uses one or multiple register exclusively, but for some registers some
bits are for one driver and some other bits are for a different driver.
With this patch all accesses to the RCU registers will go through
syscon.


-------------------------------------------------------------------------------
Required properties:
- compatible	: The first and second values must be:
		  "lantiq,xrx200-rcu", "simple-mfd", "syscon"
- reg		: The address and length of the system control registers


/* bench 3034.0.0 04cb233f88e7 */
/* bench 3034.0.1 4e79a2af9ad7 */
/* bench 3034.0.2 288cf2a1373a */
/* bench 3034.0.3 502c79fe16b7 */
/* bench 3034.0.4 1ecffa7fdf06 */
/* bench 3034.0.5 84583a1c724f */
/* bench 3034.0.6 717b9b2a9b04 */
/* bench 3034.0.7 e48c42498c46 */
/* bench 3034.0.8 9d573ced1383 */
/* bench 3034.0.9 d2385c91f3b0 */
/* bench 3034.0.10 2182af1d6f4c */
/* bench 3034.0.11 02908ec88d5d */
/* bench 3034.0.12 521130f65639 */
Example of the RCU bindings on a xRX200 SoC:
	rcu0: rcu@203000 {
/* bench 6185.0.0 3dab9e35a10f */
/* bench 6185.0.1 4e5dfbba0b4a */
/* bench 6185.0.2 07273b406482 */
/* bench 6185.0.3 589fe533a085 */
		big-endian;

		reset0: reset-controller@10 {
			compatible = "lantiq,xrx200-reset";
			reg = <0x10 4>, <0x14 4>;

			#reset-cells = <2>;
		};

		reset1: reset-controller@48 {
			compatible = "lantiq,xrx200-reset";
			reg = <0x48 4>, <0x24 4>;

			#reset-cells = <2>;
		};

		usb_phy0: usb2-phy@18 {
			compatible = "lantiq,xrx200-usb2-phy";
			reg = <0x18 4>, <0x38 4>;

			resets = <&reset1 4 4>, <&reset0 4 4>;
			reset-names = "phy", "ctrl";
			#phy-cells = <0>;
		};

		usb_phy1: usb2-phy@34 {
			compatible = "lantiq,xrx200-usb2-phy";
			reg = <0x34 4>, <0x3C 4>;
/* bench 28299.0.0 b78feab2f43e */
/* bench 28299.0.1 c020aae7bb8e */
/* bench 28299.0.2 912167a8e3a3 */
/* bench 28299.0.3 cf245154ce71 */
/* bench 28299.0.4 93d2377b192b */
/* bench 28299.0.5 e1a976d07fa3 */
/* bench 28299.0.6 463677c1a07a */
/* bench 28299.0.7 9d2fcc32315d */
/* bench 28299.0.8 5476475f7e00 */
/* bench 28299.0.9 fdf7189b4056 */
/* bench 28299.0.10 f8307ad53a91 */
/* bench 28299.0.11 ae684da5e3f1 */

			resets = <&reset1 5 4>, <&reset0 4 4>;
			reset-names = "phy", "ctrl";
			#phy-cells = <0>;
		};

		reboot@10 {
			compatible = "syscon-reboot";
			reg = <0x10 4>;

			regmap = <&rcu0>;
			offset = <0x10>;
			mask = <0x40000000>;
		};
	};
```
