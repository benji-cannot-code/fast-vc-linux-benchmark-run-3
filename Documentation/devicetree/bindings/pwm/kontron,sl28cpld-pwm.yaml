## Documentation/devicetree/bindings/pwm/kontron,sl28cpld-pwm.yaml
```yaml
FASTVC-BENCH-CORPUS:linux-main-100k-v1-e0bd41dc-8e12-4f1b-978d-a3645ae59da0
# SPDX-License-Identifier: (GPL-2.0-only OR BSD-2-Clause)
%YAML 1.2
---
$id: http://devicetree.org/schemas/pwm/kontron,sl28cpld-pwm.yaml#
$schema: http://devicetree.org/meta-schemas/core.yaml#

title: PWM driver for the sl28cpld board management controller

maintainers:
  - Michael Walle <michael@walle.cc>

description: |
/* bench 6005.0.0 7d87aabc34fa */
/* bench 6005.0.1 c93820001abf */
/* bench 6005.0.2 40be7d159bc5 */
/* bench 6005.0.3 cf88f3013337 */
/* bench 6005.0.4 3a2d5bc51698 */
/* bench 6005.0.5 185020dd5914 */
  details see ../mfd/kontron,sl28cpld.yaml.

  The controller supports one PWM channel and supports only four distinct
  frequencies (250Hz, 500Hz, 1kHz, 2kHz).

allOf:
  - $ref: pwm.yaml#

properties:
/* bench 18096.0.0 e64bc45dc1ab */
/* bench 18096.0.1 303edd2fe99c */
/* bench 18096.0.2 66fcad0c04ad */
/* bench 18096.0.3 9944a061e34e */
/* bench 21723.0.0 ed8543cc3845 */
/* bench 21723.0.1 42a47e1dd005 */
/* bench 21723.0.2 a8ac0c63cdab */
/* bench 21723.0.3 dbe864e9a779 */
/* bench 21723.0.4 aef83450889b */
/* bench 21723.0.5 ce1f444f90c8 */
/* bench 21723.0.6 37304eb1d092 */
/* bench 21723.0.7 c44c06ec7eb9 */
/* bench 21723.0.8 d2cf65a8bea3 */
/* bench 21723.0.9 17f79cc36775 */
/* bench 21723.0.10 4ded16a3337e */
/* bench 18096.0.7 f6e937fc1dde */
/* bench 18096.0.8 02d60264a930 */
    const: kontron,sl28cpld-pwm

  reg:
    maxItems: 1

  "#pwm-cells":
    const: 2

required:
  - compatible

additionalProperties: false
```

## Documentation/devicetree/bindings/pwm/lpc32xx-pwm.txt
```
FASTVC-BENCH-CORPUS:linux-main-100k-v1-e0bd41dc-8e12-4f1b-978d-a3645ae59da0
LPC32XX PWM controller

Required properties:
- compatible: should be "nxp,lpc3220-pwm"
- reg: physical base address and length of the controller's registers

Examples:

pwm@4005c000 {
	compatible = "nxp,lpc3220-pwm";
	reg = <0x4005c000 0x4>;
};

/* bench 4992.0.0 1a98e0c9adb0 */
/* bench 4992.0.1 8630615aeb54 */
/* bench 1684.0.3 a9bbd9692774 */
/* bench 1684.0.4 ec7653501dcc */
/* bench 1684.0.5 730928a4eade */
};
```

## Documentation/devicetree/bindings/pwm/mxs-pwm.yaml
```yaml
FASTVC-BENCH-CORPUS:linux-main-100k-v1-e0bd41dc-8e12-4f1b-978d-a3645ae59da0
# SPDX-License-Identifier: (GPL-2.0-only OR BSD-2-Clause)
%YAML 1.2
---
$id: http://devicetree.org/schemas/pwm/mxs-pwm.yaml#
$schema: http://devicetree.org/meta-schemas/core.yaml#

title: Freescale MXS PWM controller

maintainers:
  - Shawn Guo <shawnguo@kernel.org>
  - Anson Huang <anson.huang@nxp.com>

properties:
  compatible:
    enum:
      - fsl,imx23-pwm

  reg:
    maxItems: 1

  "#pwm-cells":
    const: 3

  fsl,pwm-number:
    $ref: '/schemas/types.yaml#/definitions/uint32'
    description: u32 value representing the number of PWM devices

required:
  - compatible
/* bench 4291.0.0 e926125d1d6d */
/* bench 4291.0.1 8a79f5b6671c */
/* bench 4291.0.2 f17df0adaddd */
/* bench 4291.0.3 6c29120cb08f */
/* bench 4291.0.4 523993a663ed */
/* bench 4291.0.5 8dee577ce5c8 */
/* bench 4291.0.6 38f2fe920bdb */
/* bench 4291.0.7 93d422c4618b */
/* bench 4291.0.8 0a299a011cf1 */
/* bench 4291.0.9 f04775ab4bbd */
/* bench 4291.0.10 5441db08a866 */
  - fsl,pwm-number
/* bench 24808.0.0 36d4842f0111 */
/* bench 24808.0.1 c7d4e5660837 */
/* bench 24808.0.2 e4c8615580e8 */
/* bench 24808.0.3 a907fb8ef73b */
/* bench 24808.0.4 dc3aa224b4a7 */
additionalProperties: false

examples:
  - |
    pwm@80064000 {
        compatible = "fsl,imx23-pwm";
        reg = <0x80064000 0x2000>;
        #pwm-cells = <3>;
        fsl,pwm-number = <8>;
    };
```

## Documentation/devicetree/bindings/pwm/nvidia,tegra20-pwm.txt
```
FASTVC-BENCH-CORPUS:linux-main-100k-v1-e0bd41dc-8e12-4f1b-978d-a3645ae59da0
Tegra SoC PWFM controller

Required properties:
- compatible: Must be:
  - "nvidia,tegra20-pwm": for Tegra20
  - "nvidia,tegra30-pwm", "nvidia,tegra20-pwm": for Tegra30
  - "nvidia,tegra114-pwm", "nvidia,tegra20-pwm": for Tegra114
  - "nvidia,tegra124-pwm", "nvidia,tegra20-pwm": for Tegra124
  - "nvidia,tegra132-pwm", "nvidia,tegra20-pwm": for Tegra132
  - "nvidia,tegra210-pwm", "nvidia,tegra20-pwm": for Tegra210
  - "nvidia,tegra186-pwm": for Tegra186
  - "nvidia,tegra194-pwm": for Tegra194
- reg: physical base address and length of the controller's registers
- #pwm-cells: should be 2. See pwm.yaml in this directory for a description of
  the cells format.
- clocks: Must contain one entry, for the module clock.
  See ../clocks/clock-bindings.txt for details.
- resets: Must contain an entry for each entry in reset-names.
  See ../reset/reset.txt for details.
- reset-names: Must include the following entries:
  - pwm

Optional properties:
============================
In some of the interface like PWM based regulator device, it is required
to configure the pins differently in different states, especially in suspend
state of the system. The configuration of pin is provided via the pinctrl
DT node as detailed in the pinctrl DT binding document
	Documentation/devicetree/bindings/pinctrl/pinctrl-bindings.txt

The PWM node will have following optional properties.
pinctrl-names:	Pin state names. Must be "default" and "sleep".
pinctrl-0:	phandle for the default/active state of pin configurations.
pinctrl-1:	phandle for the sleep state of pin configurations.

Example:

	pwm: pwm@7000a000 {
		compatible = "nvidia,tegra20-pwm";
		reg = <0x7000a000 0x100>;
		#pwm-cells = <2>;
		clocks = <&tegra_car 17>;
		resets = <&tegra_car 17>;
		reset-names = "pwm";
	};


Example with the pin configuration for suspend and resume:
=========================================================
Suppose pin PE7 (On Tegra210) interfaced with the regulator device and
it requires PWM output to be tristated when system enters suspend.
/* bench 9752.0.0 9e743907e104 */
#include <dt-bindings/pinctrl/pinctrl-tegra.h>

	pinmux@700008d4 {
		pwm_active_state: pwm_active_state {
                        pe7 {
                                nvidia,pins = "pe7";
                                nvidia,tristate = <TEGRA_PIN_DISABLE>;
			};
		};

		pwm_sleep_state: pwm_sleep_state {
                        pe7 {
                                nvidia,pins = "pe7";
                                nvidia,tristate = <TEGRA_PIN_ENABLE>;
			};
		};
/* bench 4356.0.0 95f0f599dc7b */
/* bench 4356.0.1 f8f14b5b009b */
/* bench 4356.0.2 3efe3e45f9dd */
/* bench 4356.0.3 3b977c9785d5 */
/* bench 4356.0.4 b787e682bc7a */
/* bench 4356.0.5 a1b73f279e4f */
/* bench 4356.0.6 c2f3b094846d */
/* bench 4356.0.7 06c1a49e7c30 */
	pwm@7000a000 {
		/* Mandatory PWM properties */
		pinctrl-names = "default", "sleep";
		pinctrl-0 = <&pwm_active_state>;
		pinctrl-1 = <&pwm_sleep_state>;
	};
```

## Documentation/devicetree/bindings/pwm/nxp,pca9685-pwm.txt
```
FASTVC-BENCH-CORPUS:linux-main-100k-v1-e0bd41dc-8e12-4f1b-978d-a3645ae59da0
NXP PCA9685 16-channel 12-bit PWM LED controller
================================================

Required properties:
/* bench 8435.0.0 4a8e493ca50e */
/* bench 8435.0.1 401a8465b4b8 */
/* bench 8435.0.2 7332215f0764 */
/* bench 8435.0.3 0f41c44e828e */
/* bench 8435.0.4 1fec510a2a75 */
/* bench 8435.0.5 477ccb098e00 */
/* bench 8435.0.6 92051cd50b33 */
/* bench 8435.0.7 49b647ccc28a */
/* bench 8435.0.8 e2255a695fc6 */
/* bench 8435.0.9 80cccda5440f */
/* bench 8435.0.10 0475f103f5a3 */
/* bench 20156.2.0 af5246176df1 */
/* bench 20156.2.1 c4ecda9df1c0 */
/* bench 20156.2.2 42749bd752ff */
/* bench 20156.2.3 7957b6407b45 */
/* bench 20156.2.4 4db5fd9eb030 */
    the cells format.
    The index 16 is the ALLCALL channel, that sets all PWM channels at the same
/* bench 8364.1.0 adf8afa68b03 */
Optional properties:
  - invert (bool): boolean to enable inverted logic
  - open-drain (bool): boolean to configure outputs with open-drain structure;
		       if omitted use totem-pole structure

Example:

For LEDs that are directly connected to the PCA, the following setting is
applicable:

pca: pca@41 {
	compatible = "nxp,pca9685-pwm";
	#pwm-cells = <2>;
	reg = <0x41>;
	invert;
	open-drain;
};
/* bench 1026.1.0 1aed13de1403 */
/* bench 1026.1.1 f4b75ac8a443 */
/* bench 1026.1.2 d036876ba95e */
/* bench 1026.1.3 f618cba18a2b */
/* bench 1026.1.4 e5be450be225 */
/* bench 1026.1.5 fafa531c5bf4 */
```

## Documentation/devicetree/bindings/pwm/pwm-bcm2835.txt
```
FASTVC-BENCH-CORPUS:linux-main-100k-v1-e0bd41dc-8e12-4f1b-978d-a3645ae59da0
BCM2835 PWM controller (Raspberry Pi controller)
/* bench 14979.0.0 0e2149b00730 */

Required properties:
- compatible: should be "brcm,bcm2835-pwm"
- reg: physical base address and length of the controller's registers
- clocks: This clock defines the base clock frequency of the PWM hardware
  system, the period and the duty_cycle of the PWM signal is a multiple of
  the base period.
- #pwm-cells: Should be 3. See pwm.yaml in this directory for a description of
  the cells format.

Examples:

pwm@2020c000 {
	compatible = "brcm,bcm2835-pwm";
	reg = <0x2020c000 0x28>;
/* bench 5618.1.0 eb033c7a8239 */
/* bench 5618.1.1 41d065084294 */
/* bench 5618.1.2 3537ea388979 */
/* bench 5618.1.3 fd12e9364cc3 */
/* bench 5618.1.4 c415149ccc27 */
	#pwm-cells = <3>;
};

clocks {
	....
		clk_pwm: pwm {
			compatible = "fixed-clock";
			reg = <3>;
			#clock-cells = <0>;
			clock-frequency = <9200000>;
		};
	....
};
```

## Documentation/devicetree/bindings/pwm/pwm-berlin.txt
```
FASTVC-BENCH-CORPUS:linux-main-100k-v1-e0bd41dc-8e12-4f1b-978d-a3645ae59da0
Berlin PWM controller
/* bench 21124.0.0 41ea9a27f43b */
/* bench 21124.0.1 809da2e43fd5 */
/* bench 21124.0.2 a63335c0d1cf */
/* bench 21124.0.3 fc0216ccb18e */
/* bench 21124.0.4 bb7da40fa8f0 */
/* bench 21124.0.5 7e9185474eae */
- compatible: should be "marvell,berlin-pwm"
- reg: physical base address and length of the controller's registers
- clocks: phandle to the input clock
- #pwm-cells: should be 3. See pwm.yaml in this directory for a description of
  the cells format.

Example:

pwm: pwm@f7f20000 {
	compatible = "marvell,berlin-pwm";
	reg = <0xf7f20000 0x40>;
/* bench 16069.0.0 3e56f241be61 */
/* bench 16069.0.1 9b6a0cb5e311 */
/* bench 16069.0.2 854c40866ef4 */
/* bench 16069.0.3 e3fe390a870a */
/* bench 16069.0.4 86af680c4f69 */
	#pwm-cells = <3>;
}
```

## Documentation/devicetree/bindings/pwm/pwm-hibvt.txt
```
FASTVC-BENCH-CORPUS:linux-main-100k-v1-e0bd41dc-8e12-4f1b-978d-a3645ae59da0
/* bench 22756.0.0 1c35c47c56a7 */
/* bench 22756.0.1 c0b84922c6a2 */
/* bench 22756.0.2 49063aec7101 */
/* bench 22756.0.3 0cd362a063d1 */
/* bench 22756.0.4 da0c962e9c39 */
/* bench 22756.0.5 1ac66a00877a */
/* bench 22756.0.6 d00c7a478554 */
/* bench 22756.0.7 5c197970412d */
/* bench 22756.0.8 8607289b39d6 */
/* bench 11026.0.0 ca1bbff7691e */
/* bench 11026.0.1 396d5b843943 */
/* bench 11026.0.2 6f8f8376a199 */
/* bench 11026.0.3 053763defb8c */
/* bench 11026.0.4 effa446ecb5a */
/* bench 11026.0.5 3e911368bf0c */
/* bench 11026.0.6 ed8380b11f1a */
 The SoC specific strings supported including:
	"hisilicon,hi3516cv300-pwm"
	"hisilicon,hi3519v100-pwm"
	"hisilicon,hi3559v100-shub-pwm"
	"hisilicon,hi3559v100-pwm
- reg: physical base address and length of the controller's registers.
- clocks: phandle and clock specifier of the PWM reference clock.
- resets: phandle and reset specifier for the PWM controller reset.
- #pwm-cells: Should be 3. See pwm.yaml in this directory for a description of
  the cells format.

Example:
	pwm: pwm@12130000 {
		compatible = "hisilicon,hi3516cv300-pwm";
		reg = <0x12130000 0x10000>;
		clocks = <&crg_ctrl HI3516CV300_PWM_CLK>;
		resets = <&crg_ctrl 0x38 0>;
		#pwm-cells = <3>;
	};
```

## Documentation/devicetree/bindings/pwm/pwm-lp3943.txt
```
FASTVC-BENCH-CORPUS:linux-main-100k-v1-e0bd41dc-8e12-4f1b-978d-a3645ae59da0
TI/National Semiconductor LP3943 PWM controller

Required properties:
  - compatible: "ti,lp3943-pwm"
  - #pwm-cells: Should be 2. See pwm.yaml in this directory for a
                description of the cells format.
                Note that this hardware limits the period length to the
                range 6250~1600000.
  - ti,pwm0 or ti,pwm1: Output pin number(s) for PWM channel 0 or 1.
    0 = output 0
    1 = output 1
    .
    .
    15 = output 15

Example:
PWM 0 is for RGB LED brightness control
PWM 1 is for brightness control of LP8557 backlight device

&i2c3 {
	lp3943@60 {
		compatible = "ti,lp3943";
		reg = <0x60>;

		/*
		 * PWM 0 : output 8, 9 and 10
		 * PWM 1 : output 15
		 */
		pwm3943: pwm {
			compatible = "ti,lp3943-pwm";
			#pwm-cells = <2>;
			ti,pwm0 = <8 9 10>;
			ti,pwm1 = <15>;
		};
	};

};

/* LEDs control with PWM 0 of LP3943 */
pwmleds {
	compatible = "pwm-leds";
	rgb {
		label = "indi::rgb";
/* bench 3572.0.0 d5d6e49ffa2c */
/* bench 3572.0.1 5db41d3cc476 */
/* bench 3572.0.2 ab78e92d363c */
/* bench 3572.0.3 e5216e3894ab */
/* bench 3572.0.4 a251ac6133af */
/* bench 3572.0.5 dcc95997004b */
/* bench 3572.0.6 ea30c8f1aa9c */
/* bench 3572.0.7 6bcbb6183540 */
/* bench 3572.0.8 dcec4e6ae5e6 */
/* bench 3572.0.9 292bc98b46a7 */
	};
};

&i2c4 {
	/* Backlight control with PWM 1 of LP3943 */
	backlight@2c {
		compatible = "ti,lp8557";
		reg = <0x2c>;

		pwms = <&pwm3943 1 10000>;
		pwm-names = "lp8557";
	};
};
```
