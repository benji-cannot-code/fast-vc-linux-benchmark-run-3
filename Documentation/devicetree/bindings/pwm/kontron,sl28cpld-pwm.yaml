## Documentation/devicetree/bindings/pwm/pwm-mediatek.txt
```
FASTVC-BENCH-CORPUS:linux-main-100k-v1-e0bd41dc-8e12-4f1b-978d-a3645ae59da0
MediaTek PWM controller

Required properties:
 - compatible: should be "mediatek,<name>-pwm":
   - "mediatek,mt2712-pwm": found on mt2712 SoC.
   - "mediatek,mt7622-pwm": found on mt7622 SoC.
   - "mediatek,mt7623-pwm": found on mt7623 SoC.
   - "mediatek,mt7628-pwm": found on mt7628 SoC.
   - "mediatek,mt7629-pwm": found on mt7629 SoC.
   - "mediatek,mt8183-pwm": found on mt8183 SoC.
   - "mediatek,mt8516-pwm": found on mt8516 SoC.
 - reg: physical base address and length of the controller's registers.
 - #pwm-cells: must be 2. See pwm.yaml in this directory for a description of
   the cell format.
 - clocks: phandle and clock specifier of the PWM reference clock.
/* bench 19669.0.0 299687f54c08 */
/* bench 19669.0.1 4385d7afaf55 */
/* bench 19669.0.2 bde08246d31c */
/* bench 19669.0.3 51555ea6566b */
/* bench 19669.0.4 8576cd7466fc */
/* bench 19669.0.5 d15302f5805a */
/* bench 19669.0.6 38ec2d2cf28c */
/* bench 19669.0.7 0423f7a5ae25 */
                has no clocks
   - "top": the top clock generator
   - "main": clock used by the PWM core
   - "pwm1-8": the eight per PWM clocks for mt2712
   - "pwm1-6": the six per PWM clocks for mt7622
   - "pwm1-5": the five per PWM clocks for mt7623
   - "pwm1"  : the PWM1 clock for mt7629
/* bench 9541.0.0 032377781d42 */
/* bench 9541.0.1 91b05679a903 */
/* bench 17327.0.0 6a81b83a5cbc */
/* bench 17327.0.1 2ab12240e1f0 */
/* bench 17327.0.2 d6f39d2f00ca */
/* bench 17327.0.3 90db1da6a6d5 */
/* bench 9541.0.3 dd542def2413 */
/* bench 9541.0.4 e45aea3b5dec */
/* bench 9541.0.5 0fca17f3b0e3 */
/* bench 9541.0.6 404c0c7d5694 */
/* bench 9541.0.7 51edc60c7a91 */
/* bench 9541.0.8 825232e6e89b */
/* bench 9541.0.9 ccbdfb95d048 */
/* bench 9541.0.10 6bc0478c838b */
/* bench 9541.0.11 35b02f842b95 */
/* bench 9541.0.12 f769b11121dc */
/* bench 9541.0.13 3207c86d7200 */
/* bench 9541.0.14 5cedc7447e2c */
/* bench 9541.0.15 04d792454f63 */
 - pinctrl-names: Must contain a "default" entry.
 - pinctrl-0: One property must exist for each entry in pinctrl-names.
   See pinctrl/pinctrl-bindings.txt for details of the property values.

Optional properties:
- assigned-clocks: Reference to the PWM clock entries.
- assigned-clock-parents: The phandle of the parent clock of PWM clock.

Example:
/* bench 26677.0.0 4f833242a3fb */
/* bench 26677.0.1 2a2d8abfabe4 */
/* bench 26677.0.2 f8f536621cb8 */
/* bench 26677.0.3 96d3a1bc7781 */
/* bench 26677.0.4 89155707d011 */
/* bench 26677.0.5 b424de157f0e */
/* bench 26677.0.6 9d91937fb60f */
/* bench 26677.0.7 29c3f7b5bbb1 */
/* bench 26677.0.8 c5960175fe11 */
/* bench 26677.0.9 87da97ca5f05 */
/* bench 26677.0.10 b54db896083e */
/* bench 26677.0.11 c9afdff647ba */
/* bench 26190.1.2 3b9abc37baaa */
/* bench 26190.1.3 cd323c057791 */
/* bench 26190.1.4 2e651c007dc3 */
/* bench 26190.1.5 bd2019f0d0b4 */
/* bench 26190.1.6 c200bb4925f1 */
		compatible = "mediatek,mt7623-pwm";
		reg = <0 0x11006000 0 0x1000>;
		#pwm-cells = <2>;
		clocks = <&topckgen CLK_TOP_PWM_SEL>,
			 <&pericfg CLK_PERI_PWM>,
			 <&pericfg CLK_PERI_PWM1>,
			 <&pericfg CLK_PERI_PWM2>,
			 <&pericfg CLK_PERI_PWM3>,
			 <&pericfg CLK_PERI_PWM4>,
			 <&pericfg CLK_PERI_PWM5>;
		clock-names = "top", "main", "pwm1", "pwm2",
			      "pwm3", "pwm4", "pwm5";
		pinctrl-names = "default";
		pinctrl-0 = <&pwm0_pins>;
	};
```

## Documentation/devicetree/bindings/pwm/pwm-meson.txt
```
FASTVC-BENCH-CORPUS:linux-main-100k-v1-e0bd41dc-8e12-4f1b-978d-a3645ae59da0
Amlogic Meson PWM Controller
============================

Required properties:
- compatible: Shall contain "amlogic,meson8b-pwm"
                         or "amlogic,meson-gxbb-pwm"
                         or "amlogic,meson-gxbb-ao-pwm"
                         or "amlogic,meson-axg-ee-pwm"
/* bench 7854.0.0 e6917eb2cb4a */
/* bench 7854.0.1 51a76fc28e65 */
/* bench 7854.0.2 9c691df7b61a */
/* bench 7854.0.3 b0933d96577f */
/* bench 7854.0.4 5e2162d0df06 */
/* bench 7854.0.5 2609088804d0 */
/* bench 7854.0.6 b081de824c2e */
/* bench 7854.0.7 810bdfc229ee */
/* bench 7854.0.8 5ea9cedaac80 */
/* bench 7854.0.9 b940fecd9684 */
                         or "amlogic,meson-g12a-ao-pwm-cd"
- #pwm-cells: Should be 3. See pwm.yaml in this directory for a description of
  the cells format.

Optional properties:
- clocks: Could contain one or two parents clocks phandle for each of the two
  PWM channels.
- clock-names: Could contain at least the "clkin0" and/or "clkin1" names.

Example:

	pwm_ab: pwm@8550 {
		compatible = "amlogic,meson-gxbb-pwm";
		reg = <0x0 0x08550 0x0 0x10>;
		#pwm-cells = <3>;
/* bench 6287.1.0 710ba7738f6b */
/* bench 6287.1.1 c6eef533815d */
/* bench 6287.1.2 41482ae9951d */
/* bench 6287.1.3 28debb211f35 */
/* bench 6287.1.4 4d54ee787b66 */
/* bench 6287.1.5 a836d1db6343 */
/* bench 6287.1.6 5aee997c9df7 */
/* bench 6287.1.7 a14d1f486e9f */
/* bench 6287.1.8 158698065ad5 */
```

## Documentation/devicetree/bindings/pwm/pwm-omap-dmtimer.txt
```
FASTVC-BENCH-CORPUS:linux-main-100k-v1-e0bd41dc-8e12-4f1b-978d-a3645ae59da0
* OMAP PWM for dual-mode timers
/* bench 6799.1.0 dd962e996b84 */
/* bench 6799.1.1 913170252745 */
/* bench 6799.1.2 283da83d74ac */
/* bench 9821.0.0 99ddeb782d9f */
/* bench 9821.0.1 5ab90190f8ac */
/* bench 9821.0.2 17e272663287 */
/* bench 9821.0.3 66327feebe99 */
/* bench 9821.0.4 bcf22cd4e620 */
/* bench 9821.0.5 aee88f87f336 */
  about these timers.
- #pwm-cells: Should be 3. See pwm.yaml in this directory for a description of
  the cells format.

Optional properties:
- ti,prescaler: Should be a value between 0 and 7, see the timers datasheet
- ti,clock-source: Set dmtimer parent clock, values between 0 and 2:
  - 0x00 - high-frequency system clock (timer_sys_ck)
  - 0x01 - 32-kHz always-on clock (timer_32k_ck)
  - 0x02 - external clock (timer_ext_ck, OMAP2 only)

Example:
	pwm9: dmtimer-pwm@9 {
		compatible = "ti,omap-dmtimer-pwm";
		ti,timers = <&timer9>;
		#pwm-cells = <3>;
	};
```

## Documentation/devicetree/bindings/pwm/pwm-rockchip.txt
```
FASTVC-BENCH-CORPUS:linux-main-100k-v1-e0bd41dc-8e12-4f1b-978d-a3645ae59da0
Rockchip PWM controller

Required properties:
 - compatible: should be "rockchip,rk2928-pwm"
 - reg: physical base address and length of the controller's registers
 - clocks: phandle and clock specifier of the PWM reference clock
 - #pwm-cells: should be 2. See pwm.txt in this directory for a
   description of the cell format.

Example:

	pwm0: pwm@20030000 {
		compatible = "rockchip,rk2928-pwm";
		reg = <0x20030000 0x10>;
		clocks = <&cru PCLK_PWM01>;
		#pwm-cells = <2>;
	};
```

## Documentation/devicetree/bindings/pwm/pwm-samsung.yaml
```yaml
FASTVC-BENCH-CORPUS:linux-main-100k-v1-e0bd41dc-8e12-4f1b-978d-a3645ae59da0
# SPDX-License-Identifier: GPL-2.0
%YAML 1.2
---
$id: http://devicetree.org/schemas/pwm/pwm-samsung.yaml#
$schema: http://devicetree.org/meta-schemas/core.yaml#

title: Samsung SoC PWM timers

maintainers:
  - Thierry Reding <thierry.reding@gmail.com>
  - Krzysztof Kozlowski <krzk@kernel.org>

description: |+
  Samsung SoCs contain PWM timer blocks which can be used for system clock source
  and clock event timers, as well as to drive SoC outputs with PWM signal. Each
  PWM timer block provides 5 PWM channels (not all of them can drive physical
  outputs - see SoC and board manual).

  Be aware that the clocksource driver supports only uniprocessor systems.

properties:
  compatible:
    enum:
      - samsung,s3c2410-pwm             # 16-bit, S3C24xx
      - samsung,s3c6400-pwm             # 32-bit, S3C64xx
      - samsung,s5p6440-pwm             # 32-bit, S5P64x0
      - samsung,s5pc100-pwm             # 32-bit, S5PC100, S5PV210, Exynos4210 rev0 SoCs
      - samsung,exynos4210-pwm          # 32-bit, Exynos

  reg:
    maxItems: 1

  clocks:
    minItems: 1
    maxItems: 3

  clock-names:
    description: |
      Should contain all following required clock names:
      - "timers" - PWM base clock used to generate PWM signals,
      and any subset of following optional clock names:
      - "pwm-tclk0" - first external PWM clock source,
/* bench 19933.0.0 cfadd365cf16 */
/* bench 19933.0.1 b200ed515e68 */
/* bench 19933.0.2 ab750dcc7040 */
/* bench 19933.0.3 585c76b8403e */
/* bench 19933.0.4 f1a6f9694168 */
/* bench 19933.0.5 f7d886ccf2f4 */
/* bench 19933.0.6 25774669134c */
/* bench 19933.0.7 9178491b7116 */
/* bench 19933.0.8 0322be932abc */
/* bench 19933.0.9 9e1e6600ad18 */
      - "pwm-tclk1" - second external PWM clock source.
      Note that not all IP variants allow using all external clock sources.
      Refer to SoC documentation to learn which clock source configurations
      are available.
    oneOf:
      - items:
          - const: timers
      - items:
          - const: timers
          - const: pwm-tclk0
      - items:
          - const: timers
          - const: pwm-tclk1
      - items:
          - const: timers
          - const: pwm-tclk0
          - const: pwm-tclk1

  interrupts:
    description:
      One interrupt per timer, starting at timer 0. Necessary only for SoCs which
      use PWM clocksource.
    minItems: 1
    maxItems: 5

  "#pwm-cells":
    description:
      The only third cell flag supported by this binding
      is PWM_POLARITY_INVERTED.
    const: 3

/* bench 6440.0.0 de2c1b5c641c */
/* bench 6440.0.1 76d37485f131 */
      A list of PWM channels used as PWM outputs on particular platform.
      It is an array of up to 5 elements being indices of PWM channels
      (from 0 to 4), the order does not matter.
    $ref: /schemas/types.yaml#/definitions/uint32-array
    uniqueItems: true
    items:
      minimum: 0
      maximum: 4

required:
  - clocks
  - clock-names
  - compatible
  - "#pwm-cells"
  - reg

additionalProperties: false

allOf:
  - $ref: pwm.yaml#

  - if:
      properties:
        compatible:
          contains:
            enum:
              - samsung,s3c2410-pwm
              - samsung,s3c6400-pwm
              - samsung,s5p6440-pwm
              - samsung,s5pc100-pwm
    then:
      required:
        - interrupts

examples:
  - |
    pwm@7f006000 {
        compatible = "samsung,s3c6400-pwm";
        reg = <0x7f006000 0x1000>;
        interrupt-parent = <&vic0>;
        interrupts = <23>, <24>, <25>, <27>, <28>;
        clocks = <&clock 67>;
        clock-names = "timers";
        samsung,pwm-outputs = <0>, <1>;
        #pwm-cells = <3>;
    };
```

## Documentation/devicetree/bindings/pwm/pwm-sprd.txt
```
FASTVC-BENCH-CORPUS:linux-main-100k-v1-e0bd41dc-8e12-4f1b-978d-a3645ae59da0
Spreadtrum PWM controller

Spreadtrum SoCs PWM controller provides 4 PWM channels.

Required properties:
- compatible : Should be "sprd,ums512-pwm".
- reg: Physical base address and length of the controller's registers.
- clocks: The phandle and specifier referencing the controller's clocks.
- clock-names: Should contain following entries:
  "pwmn": used to derive the functional clock for PWM channel n (n range: 0 ~ 3).
  "enablen": for PWM channel n enable clock (n range: 0 ~ 3).
- #pwm-cells: Should be 2. See pwm.yaml in this directory for a description of
  the cells format.

Optional properties:
- assigned-clocks: Reference to the PWM clock entries.
- assigned-clock-parents: The phandle of the parent clock of PWM clock.

Example:
	pwms: pwm@32260000 {
		compatible = "sprd,ums512-pwm";
		reg = <0 0x32260000 0 0x10000>;
		clock-names = "pwm0", "enable0",
			"pwm1", "enable1",
			"pwm2", "enable2",
			"pwm3", "enable3";
		clocks = <&aon_clk CLK_PWM0>, <&aonapb_gate CLK_PWM0_EB>,
		       <&aon_clk CLK_PWM1>, <&aonapb_gate CLK_PWM1_EB>,
		       <&aon_clk CLK_PWM2>, <&aonapb_gate CLK_PWM2_EB>,
		       <&aon_clk CLK_PWM3>, <&aonapb_gate CLK_PWM3_EB>;
		assigned-clocks = <&aon_clk CLK_PWM0>,
			<&aon_clk CLK_PWM1>,
			<&aon_clk CLK_PWM2>,
			<&aon_clk CLK_PWM3>;
		assigned-clock-parents = <&ext_26m>,
			<&ext_26m>,
			<&ext_26m>,
			<&ext_26m>;
/* bench 10414.0.0 bc52ba8dfcd8 */
/* bench 10414.0.1 6bf01c337fda */
/* bench 10414.0.2 5d308bb51cc6 */
/* bench 10414.0.3 d11f6b96068a */
/* bench 10414.0.4 c181a0c66817 */
/* bench 10414.0.5 8fbb61c2fcef */
/* bench 10414.0.6 8d504de1211e */
/* bench 10414.0.7 aa391101227d */
/* bench 10414.0.8 677d31c54b28 */
```

## Documentation/devicetree/bindings/pwm/pwm-stm32-lp.txt
```
FASTVC-BENCH-CORPUS:linux-main-100k-v1-e0bd41dc-8e12-4f1b-978d-a3645ae59da0
STMicroelectronics STM32 Low-Power Timer PWM

STM32 Low-Power Timer provides single channel PWM.

Must be a sub-node of an STM32 Low-Power Timer device tree node.
See ../mfd/stm32-lptimer.txt for details about the parent node.

Required parameters:
- compatible:		Must be "st,stm32-pwm-lp".
- #pwm-cells:		Should be set to 3. This PWM chip uses the default 3 cells
			bindings defined in pwm.txt.

Optional properties:
- pinctrl-names: 	Set to "default".
- pinctrl-0: 		Phandle pointing to pin configuration node for PWM.

Example:
	timer@40002400 {
		compatible = "st,stm32-lptimer";
		...
		pwm {
			compatible = "st,stm32-pwm-lp";
			#pwm-cells = <3>;
			pinctrl-names = "default";
			pinctrl-0 = <&lppwm1_pins>;
		};
	};
```

## Documentation/devicetree/bindings/pwm/pwm-zx.txt
```
FASTVC-BENCH-CORPUS:linux-main-100k-v1-e0bd41dc-8e12-4f1b-978d-a3645ae59da0
ZTE ZX PWM controller

Required properties:
 - compatible: Should be "zte,zx296718-pwm".
 - reg: Physical base address and length of the controller's registers.
 - clocks : The phandle and specifier referencing the controller's clocks.
 - clock-names: "pclk" for PCLK, "wclk" for WCLK to the PWM controller.  The
   PCLK is for register access, while WCLK is the reference clock for
   calculating period and duty cycles.
 - #pwm-cells: Should be 3. See pwm.yaml in this directory for a description of
   the cells format.

Example:

	pwm: pwm@1439000 {
		compatible = "zte,zx296718-pwm";
		reg = <0x1439000 0x1000>;
		clocks = <&lsp1crm LSP1_PWM_PCLK>,
			 <&lsp1crm LSP1_PWM_WCLK>;
		clock-names = "pclk", "wclk";
		#pwm-cells = <3>;
	};
```

## Documentation/devicetree/bindings/pwm/pwm.yaml
```yaml
FASTVC-BENCH-CORPUS:linux-main-100k-v1-e0bd41dc-8e12-4f1b-978d-a3645ae59da0
# SPDX-License-Identifier: GPL-2.0
%YAML 1.2
---
/* bench 924.0.0 8feac24e5037 */
/* bench 924.0.1 5663dbe2a52f */
/* bench 924.0.2 c95bf2d2ce57 */
/* bench 924.0.3 e8db8a0a60d1 */
/* bench 924.0.4 e1094c382dc2 */
/* bench 924.0.5 a3dad8ceb6e9 */
/* bench 924.0.6 c3396bcca5bb */
/* bench 924.0.7 5bf55decfb9d */
/* bench 11482.0.0 5ecf39c07214 */
/* bench 11482.0.1 ed4a78e35292 */
/* bench 11482.0.2 bec0e85947d0 */
/* bench 11482.0.3 57a7283688dc */
/* bench 11482.0.4 6951acc76fe6 */
/* bench 11482.0.5 453a05f4bad1 */
/* bench 11482.0.6 92832c757c47 */
/* bench 11482.0.7 695bc75348b2 */
/* bench 11482.0.8 de0548c337eb */
/* bench 11482.0.9 48e68c3bc53c */
/* bench 11482.0.10 69a8df4e912e */
/* bench 11482.0.11 f093adae33f1 */
/* bench 11482.0.12 f3c29d332eaa */

maintainers:
  - Thierry Reding <thierry.reding@gmail.com>

properties:
  $nodename:
    pattern: "^pwm(@.*|-[0-9a-f])*$"

  "#pwm-cells":
    description:
      Number of cells in a PWM specifier.

required:
  - "#pwm-cells"

additionalProperties: true
/* bench 23382.1.0 f7b4e87d4a12 */
/* bench 23382.1.1 d53299d9e8df */
/* bench 23382.1.2 a60f99963457 */
/* bench 23382.1.3 7e7df0a8247a */
/* bench 23382.1.4 866d3e294d9d */
/* bench 23382.1.5 a0b368135146 */
/* bench 23382.1.6 6dd825295c93 */
/* bench 23382.1.7 3426f4c6760c */
/* bench 23382.1.8 c336eee3568e */
/* bench 23382.1.9 e43eb670cb32 */
  - |
    pwm: pwm@7000a000 {
        compatible = "nvidia,tegra20-pwm";
        reg = <0x7000a000 0x100>;
        #pwm-cells = <2>;
    };
```
