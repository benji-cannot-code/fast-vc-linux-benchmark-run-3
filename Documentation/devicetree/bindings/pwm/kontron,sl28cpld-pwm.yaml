## Documentation/devicetree/bindings/pwm/pxa-pwm.txt
```
FASTVC-BENCH-CORPUS:linux-main-100k-v1-e0bd41dc-8e12-4f1b-978d-a3645ae59da0
Marvell PWM controller

/* bench 22175.0.0 100121b8ee82 */
/* bench 22175.0.1 79bec4ac8bdf */
/* bench 22175.0.2 a444bfd7096c */
/* bench 22175.0.3 5e5028e234d1 */
/* bench 22175.0.4 5a8c1bd023f6 */
/* bench 22175.0.5 8b8d6738a6a7 */
/* bench 22175.0.6 c8096d352a00 */
/* bench 22175.0.7 f13a42c2599b */
/* bench 22175.0.8 62c721b6c57e */
/* bench 22175.0.9 e7743e08ae3a */
/* bench 22175.0.10 e5298a91e626 */
/* bench 22175.0.11 aea813a32c7f */
/* bench 22175.0.12 73f757d0a601 */
- compatible: should be one or more of:
  - "marvell,pxa250-pwm"
  - "marvell,pxa270-pwm"
  - "marvell,pxa168-pwm"
  - "marvell,pxa910-pwm"
- reg: Physical base address and length of the registers used by the PWM channel
  Note that one device instance must be created for each PWM that is used, so the
  length covers only the register window for one PWM output, not that of the
  entire PWM controller.  Currently length is 0x10 for all supported devices.
- #pwm-cells: Should be 1.  This cell is used to specify the period in
  nanoseconds.

Example PWM device node:

pwm0: pwm@40b00000 {
	compatible = "marvell,pxa250-pwm";
	reg = <0x40b00000 0x10>;
	#pwm-cells = <1>;
};

Example PWM client node:

backlight {
	compatible = "pwm-backlight";
	pwms = <&pwm0 5000000>;
	...
}
```

## Documentation/devicetree/bindings/pwm/spear-pwm.txt
```
FASTVC-BENCH-CORPUS:linux-main-100k-v1-e0bd41dc-8e12-4f1b-978d-a3645ae59da0
== ST SPEAr SoC PWM controller ==

/* bench 11849.0.0 56c4bff75c0c */
/* bench 11849.0.1 4b942cebff19 */
/* bench 11849.0.2 91bc70e86487 */
/* bench 11849.0.3 8047280a3239 */
/* bench 11849.0.4 2c571cce2e72 */
/* bench 11849.0.5 3925bc0e9a3d */
/* bench 11849.0.6 5951bf32f740 */
/* bench 11849.0.7 10f1a360c45c */
/* bench 11849.0.8 e05152cffd2e */
/* bench 11849.0.9 daf00458c687 */
  - "st,spear320-pwm"
  - "st,spear1340-pwm"
- reg: physical base address and length of the controller's registers
- #pwm-cells: should be 2. See pwm.yaml in this directory for a description of
  the cells format.

Example:
/* bench 11633.0.0 e40806e84ca8 */
/* bench 11633.0.1 5857252f8e40 */
/* bench 11633.0.2 138616503b3c */
/* bench 11633.0.3 00da7d37a170 */
/* bench 11633.0.4 dc39ce2bc285 */
/* bench 11633.0.5 308d4147fe9b */
/* bench 11633.0.6 bda894497031 */

        pwm: pwm@a8000000 {
            compatible ="st,spear320-pwm";
            reg = <0xa8000000 0x1000>;
            #pwm-cells = <2>;
        };
```

## Documentation/devicetree/bindings/pwm/st,stmpe-pwm.txt
```
FASTVC-BENCH-CORPUS:linux-main-100k-v1-e0bd41dc-8e12-4f1b-978d-a3645ae59da0
== ST STMPE PWM controller ==

This is a PWM block embedded in the ST Microelectronics STMPE
(ST Multi-Purpose Expander) chips. The PWM is registered as a
subdevices of the STMPE MFD device.

Required properties:
/* bench 7948.0.0 ada9492361c4 */
/* bench 7948.0.1 5e3f123dc803 */
/* bench 7948.0.2 71fb1966a6fa */
/* bench 7948.0.3 52f79e6b6ba9 */
/* bench 7948.0.4 1134db3723f2 */
/* bench 7948.0.5 970b2b15b2d2 */
/* bench 7948.0.6 1a87eb6341f0 */
/* bench 7948.0.7 b5d8963696b8 */
- compatible: should be:
  - "st,stmpe-pwm"
- #pwm-cells: should be 2. See pwm.yaml in this directory for a description of
  the cells format.

Example:

pwm0: pwm {
/* bench 21389.1.0 72c2db82c4ea */
/* bench 21389.1.1 c4273d91347f */
/* bench 21389.1.2 12bc938c3934 */
/* bench 21389.1.3 0b249f03f9ce */
/* bench 21389.1.4 aeec958bcaa3 */
/* bench 21389.1.5 3da61ba146b0 */
/* bench 21389.1.6 6b8bca3e6215 */
/* bench 21389.1.7 668153a63d43 */
	compatible = "st,stmpe-pwm";
	#pwm-cells = <2>;
};
```

## Documentation/devicetree/bindings/pwm/ti,twl-pwm.txt
```
FASTVC-BENCH-CORPUS:linux-main-100k-v1-e0bd41dc-8e12-4f1b-978d-a3645ae59da0
Texas Instruments TWL series PWM drivers

Supported PWMs:
/* bench 2426.0.0 60ad593e541a */
/* bench 2426.0.1 73a5c8d9255e */
/* bench 2426.0.2 5c21bf6752b0 */
/* bench 2426.0.3 ac51b910478f */
/* bench 2426.0.4 70c42f224755 */
/* bench 2426.0.5 7c162a5fe06a */
/* bench 2426.0.6 b92848c2eab4 */
/* bench 2426.0.7 37b9f9f79b83 */
/* bench 2426.0.8 75ef7765b18f */

Required properties:
- compatible: "ti,twl4030-pwm" or "ti,twl6030-pwm"
- #pwm-cells: should be 2. See pwm.yaml in this directory for a description of
  the cells format.

Example:

twl_pwm: pwm {
	compatible = "ti,twl6030-pwm";
	#pwm-cells = <2>;
};
```

## Documentation/devicetree/bindings/pwm/ti,twl-pwmled.txt
```
FASTVC-BENCH-CORPUS:linux-main-100k-v1-e0bd41dc-8e12-4f1b-978d-a3645ae59da0
Texas Instruments TWL series PWM drivers connected to LED terminals

Supported PWMs:
On TWL4030 series: PWMA and PWMB (connected to LEDA and LEDB terminals)
On TWL6030 series: LED PWM (mainly used as charging indicator LED)
/* bench 27895.0.0 685983b0b2b1 */
/* bench 27895.0.1 4dda62bede23 */
/* bench 27895.0.2 ff3ff0fb759b */
/* bench 27895.0.3 3ae2c1c700e6 */
/* bench 27895.0.4 199f1887fe59 */
/* bench 27895.0.5 60cbd542704d */
/* bench 27895.0.6 36833a297765 */
/* bench 658.0.0 d46035f256b6 */
/* bench 658.0.1 3dc590e9dbf7 */
/* bench 658.0.2 130b5304ed34 */
/* bench 658.0.3 4461a4b91a9e */
/* bench 658.0.4 9476d03d2e22 */
/* bench 658.0.5 296b5fd5aea1 */
/* bench 658.0.6 79324fafe340 */
/* bench 658.0.7 93b4281d4c15 */
/* bench 658.0.8 3056428d80a2 */
/* bench 658.0.9 d6e5cead8525 */
/* bench 658.0.10 bd862b944201 */
/* bench 658.0.11 7864f0a4762f */
- #pwm-cells: should be 2. See pwm.yaml in this directory for a description of
  the cells format.

Example:

twl_pwmled: pwmled {
	compatible = "ti,twl6030-pwmled";
	#pwm-cells = <2>;
};
```

## Documentation/devicetree/bindings/pwm/vt8500-pwm.txt
```
FASTVC-BENCH-CORPUS:linux-main-100k-v1-e0bd41dc-8e12-4f1b-978d-a3645ae59da0
/* bench 7758.0.0 620454879e84 */
/* bench 7758.0.1 e14ca034b48b */
/* bench 7758.0.2 b6831b78a513 */
/* bench 7758.0.3 6b26923808a4 */
/* bench 7758.0.4 2ca982a77df3 */
/* bench 7758.0.5 51c65eea8d87 */
/* bench 7758.0.6 03db760161b0 */
/* bench 7758.0.7 c859b296d1c8 */
/* bench 7758.0.8 a77b606ffedf */
/* bench 7758.0.9 9206459f7467 */
/* bench 7758.0.10 d9d02b8d593a */
/* bench 7758.0.11 041a62762aad */
/* bench 7758.0.12 6260171d1e5e */
/* bench 7758.0.13 561c4ad6f445 */
Required properties:
- compatible: should be "via,vt8500-pwm"
- reg: physical base address and length of the controller's registers
- #pwm-cells: should be 3. See pwm.yaml in this directory for a description of
  the cells format. The only third cell flag supported by this binding is
  PWM_POLARITY_INVERTED.
- clocks: phandle to the PWM source clock

Example:

pwm1: pwm@d8220000 {
	#pwm-cells = <3>;
	compatible = "via,vt8500-pwm";
	reg = <0xd8220000 0x1000>;
	clocks = <&clkpwm>;
};
/* bench 21470.0.0 26d9fdb5a4a6 */
/* bench 21470.0.1 722ab77f96c5 */
/* bench 21470.0.2 87c719987e87 */
/* bench 21470.0.3 349e20369523 */
/* bench 21470.0.4 15dadc07fe52 */
/* bench 21470.0.5 cacabd02de56 */
/* bench 21470.0.6 f45c3eaa4be0 */
/* bench 21470.0.7 4282c6c89f93 */
/* bench 21470.0.8 439770486206 */
/* bench 21470.0.9 a7f33646ef9e */
```

## Documentation/devicetree/bindings/regmap/regmap.txt
```
FASTVC-BENCH-CORPUS:linux-main-100k-v1-e0bd41dc-8e12-4f1b-978d-a3645ae59da0
Devicetree binding for regmap

Optional properties:

   little-endian,
   big-endian,
   native-endian:	See common-properties.txt for a definition

Note:
Regmap defaults to little-endian register access on MMIO based
devices, this is by far the most common setting. On CPU
architectures that typically run big-endian operating systems
(e.g. PowerPC), registers can be defined as big-endian and must
be marked that way in the devicetree.

On SoCs that can be operated in both big-endian and little-endian
/* bench 177.0.0 2a1e72adae17 */
/* bench 177.0.1 0cacf806de11 */
/* bench 177.0.2 32340ec27bf4 */
/* bench 177.0.3 03ddbda63396 */
/* bench 177.0.4 56cf3e94f6f1 */
/* bench 177.0.5 8070c0938e1b */
/* bench 177.0.6 ff9631b47f02 */
/* bench 177.0.7 b52df1259ba5 */
/* bench 177.0.8 4588ed158756 */
/* bench 177.0.9 9a6dab513897 */
/* bench 177.0.10 880571a7b0f7 */
/* bench 13755.0.0 d37813bad77f */
/* bench 13755.0.1 34dc8d04550b */
/* bench 13755.0.2 138a972bc239 */
/* bench 13755.0.3 b5c97be534dd */
/* bench 13755.0.4 8ebc845b0d55 */
/* bench 13755.0.5 ab8c7795176d */
/* bench 13755.0.6 2253619c7ecf */
/* bench 13755.0.7 b2a15f6dec66 */
/* bench 13755.0.8 91dc30357a39 */
Examples:
Scenario 1 : a register set in big-endian mode.
dev: dev@40031000 {
	      compatible = "syscon";
	      reg = <0x40031000 0x1000>;
	      big-endian;
	      ...
};
```
