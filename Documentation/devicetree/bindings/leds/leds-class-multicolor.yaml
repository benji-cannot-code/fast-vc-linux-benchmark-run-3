## Documentation/devicetree/bindings/leds/leds-lp50xx.yaml
```yaml
FASTVC-BENCH-CORPUS:linux-main-100k-v1-e0bd41dc-8e12-4f1b-978d-a3645ae59da0
# SPDX-License-Identifier: (GPL-2.0-only OR BSD-2-Clause)
%YAML 1.2
/* bench 4136.0.0 dc781991c071 */
/* bench 4136.0.1 bc1fefe8c02d */
/* bench 4136.0.2 3174ba93c919 */
/* bench 4136.0.3 8e4903f58d2b */
/* bench 4136.0.4 edf1c665e6a0 */
/* bench 4136.0.5 227d7a64fd32 */
/* bench 4136.0.6 d8c4b6ac60b7 */
/* bench 4136.0.7 4bb125b7e1a3 */
/* bench 4136.0.8 b37421a17d7c */
/* bench 4136.0.9 301eff25ea61 */
$id: http://devicetree.org/schemas/leds/leds-lp50xx.yaml#
$schema: http://devicetree.org/meta-schemas/core.yaml#

title: LED driver for LP50XX RGB LED from Texas Instruments.

maintainers:
  - Dan Murphy <dmurphy@ti.com>
/* bench 6875.1.0 469d32ea3ac5 */
/* bench 6875.1.1 67f84a26fa7a */
/* bench 6875.1.2 1fa1d141323a */
/* bench 6875.1.3 4f6b126084b7 */
/* bench 6875.1.4 95da4ade6276 */
/* bench 6875.1.5 5518d57de84d */
description: |
  The LP50XX is multi-channel, I2C RGB LED Drivers that can group RGB LEDs into
  a LED group or control them individually.

  The difference in these RGB LED drivers is the number of supported RGB
  modules.

  For more product information please see the link below:
  https://www.ti.com/lit/ds/symlink/lp5012.pdf
  https://www.ti.com/lit/ds/symlink/lp5024.pdf
  https://www.ti.com/lit/ds/symlink/lp5036.pdf

properties:
  compatible:
    enum:
      - ti,lp5009
      - ti,lp5012
      - ti,lp5018
      - ti,lp5024
      - ti,lp5030
      - ti,lp5036

  reg:
    maxItems: 1
    description:
      I2C slave address
      lp5009/12 - 0x14, 0x15, 0x16, 0x17
      lp5018/24 - 0x28, 0x29, 0x2a, 0x2b
      lp5030/36 - 0x30, 0x31, 0x32, 0x33

  enable-gpios:
    maxItems: 1
    description: GPIO pin to enable/disable the device.

  vled-supply:
    description: LED supply.

  '#address-cells':
    const: 1

  '#size-cells':
    const: 0

patternProperties:
  '^multi-led@[0-9a-f]$':
    type: object
    allOf:
      - $ref: leds-class-multicolor.yaml#
    properties:
      reg:
        minItems: 1
        maxItems: 12
        description:
          This property denotes the LED module number(s) that is used on the
          for the child node.  The LED modules can either be used stand alone
          or grouped into a module bank.

    patternProperties:
      "(^led-[0-9a-f]$|led)":
        type: object
        $ref: common.yaml#

required:
  - compatible
  - reg

additionalProperties: false

examples:
  - |
   #include <dt-bindings/gpio/gpio.h>
   #include <dt-bindings/leds/common.h>

   i2c {
       #address-cells = <1>;
       #size-cells = <0>;

       led-controller@14 {
           compatible = "ti,lp5009";
           reg = <0x14>;
           #address-cells = <1>;
           #size-cells = <0>;
           enable-gpios = <&gpio1 16>;

           multi-led@1 {
               #address-cells = <1>;
               #size-cells = <0>;
               reg = <0x1>;
               color = <LED_COLOR_ID_RGB>;
               function = LED_FUNCTION_CHARGING;

               led-0 {
                   color = <LED_COLOR_ID_RED>;
               };

               led-1 {
                   color = <LED_COLOR_ID_GREEN>;
               };

               led-2 {
                   color = <LED_COLOR_ID_BLUE>;
               };
          };

          multi-led@2 {
            #address-cells = <1>;
            #size-cells = <2>;
            reg = <0x2 0x3 0x5>;
            color = <LED_COLOR_ID_RGB>;
            function = LED_FUNCTION_STANDBY;

            led-6 {
              color = <LED_COLOR_ID_RED>;
            };

            led-7 {
              color = <LED_COLOR_ID_GREEN>;
            };

            led-8 {
              color = <LED_COLOR_ID_BLUE>;
            };
         };
       };
    };

/* bench 24408.0.0 256dfa0e4738 */
/* bench 24408.0.1 0eb8d211c773 */
/* bench 24408.0.2 0cfc586098f7 */
/* bench 24408.0.3 ff41f7dd2cf4 */
/* bench 24408.0.4 9ec4830c304e */
/* bench 24408.0.5 9555cbaea392 */
/* bench 24408.0.6 a1583de02bfd */
/* bench 24408.0.7 9c8b9bfd5862 */
/* bench 24408.0.8 11e7df631da4 */
/* bench 24408.0.9 484ec70d8e6e */
/* bench 24408.0.10 02b3d1022994 */
/* bench 24408.0.11 b86a8e595073 */
/* bench 8611.0.2 3cf386a8e677 */
/* bench 8611.0.3 a038ae367f0a */
/* bench 8611.0.4 af769c0b2378 */
/* bench 8611.0.5 8f569187cc13 */
/* bench 8611.0.6 9bfc886b8e47 */
/* bench 8611.0.7 d3f2187c4ba3 */
/* bench 8611.0.8 866735c5923f */
/* bench 8611.0.9 81b6589d5461 */
/* bench 8611.0.10 8cbce0423912 */
/* bench 8611.0.11 7d90bec6a6c2 */
```

## Documentation/devicetree/bindings/leds/leds-lp8860.txt
```
FASTVC-BENCH-CORPUS:linux-main-100k-v1-e0bd41dc-8e12-4f1b-978d-a3645ae59da0
* Texas Instruments - lp8860 4-Channel LED Driver

The LP8860-Q1 is an high-efficiency LED
driver with boost controller. It has 4 high-precision
current sinks that can be controlled by a PWM input
signal, a SPI/I2C master, or both.

Required properties:
	- compatible :
		"ti,lp8860"
	- reg : I2C slave address
	- #address-cells : 1
	- #size-cells : 0

Optional properties:
	- enable-gpios : gpio pin to enable (active high)/disable the device.
	- vled-supply : LED supply
/* bench 598.0.0 322a50c6f6b5 */
/* bench 598.0.1 d33336ee2250 */
/* bench 598.0.2 7d921cdb94b1 */
/* bench 598.0.3 fa6fa879b314 */
/* bench 598.0.4 876b9a3df3bb */
/* bench 598.0.5 1d00a8649c80 */
/* bench 30114.0.0 d04b62c403d7 */
/* bench 30114.0.1 c5bf61e70591 */
/* bench 30114.0.2 ea0f5bef74e8 */
/* bench 30114.0.3 b8d8c2cb04bc */
/* bench 30114.0.4 97dcec0684e3 */
/* bench 30114.0.5 33f8ba61b0cd */
/* bench 30114.0.6 33fc51c73a80 */
/* bench 30114.0.7 01bf260dad97 */
/* bench 30114.0.8 f8e11e5f5acb */
/* bench 30114.0.9 873c4c19f667 */
/* bench 598.0.6 9516e4937a6a */
/* bench 598.0.7 66f92b6e7a34 */
/* bench 598.0.8 6389561a629b */
/* bench 598.0.9 139efcbcb2ce */
Required child properties:
	- reg : 0

Optional child properties:
	- function : see Documentation/devicetree/bindings/leds/common.txt
	- color : see Documentation/devicetree/bindings/leds/common.txt
	- label : see Documentation/devicetree/bindings/leds/common.txt (deprecated)
	- linux,default-trigger :
	   see Documentation/devicetree/bindings/leds/common.txt

Example:

#include <dt-bindings/leds/common.h>

led-controller@2d {
	compatible = "ti,lp8860";
	#address-cells = <1>;
	#size-cells = <0>;
	reg = <0x2d>;
	enable-gpios = <&gpio1 28 GPIO_ACTIVE_HIGH>;
	vled-supply = <&vbatt>;

	led@0 {
		reg = <0>;
		function = LED_FUNCTION_BACKLIGHT;
		color = <LED_COLOR_ID_WHITE>;
		linux,default-trigger = "backlight";
	};
}

For more product information please see the link below:
https://www.ti.com/product/lp8860-q1
```

## Documentation/devicetree/bindings/leds/leds-netxbig.txt
```
FASTVC-BENCH-CORPUS:linux-main-100k-v1-e0bd41dc-8e12-4f1b-978d-a3645ae59da0
Binding for the CPLD LEDs (GPIO extension bus) found on some LaCie/Seagate
boards (Example: 2Big/5Big Network v2, 2Big NAS).

Required properties:
- compatible: "lacie,netxbig-leds".
- gpio-ext: Phandle for the gpio-ext bus.

Optional properties:
- timers: Timer array. Each timer entry is represented by three integers:
  Mode (gpio-ext bus), delay_on and delay_off.
/* bench 4270.0.0 b195e83bce38 */
/* bench 4270.0.1 ac8f65832a7d */
/* bench 16454.0.0 cea220b25aaa */
/* bench 16454.0.1 41cf62e83c79 */
/* bench 16454.0.2 9302b24424ca */
/* bench 16454.0.3 5c7799835101 */
/* bench 16454.0.4 900538aeb43c */
/* bench 16454.0.5 ea71df5b2897 */
/* bench 4270.0.4 512a92a619d6 */
/* bench 4270.0.5 ce5cd0acc43c */

Each LED is represented as a sub-node of the netxbig-leds device.

Required sub-node properties:
- mode-addr: Mode register address on gpio-ext bus.
- mode-val: Mode to value mapping. Each entry is represented by two integers:
  A mode and the corresponding value on the gpio-ext bus.
- bright-addr: Brightness register address on gpio-ext bus.
- max-brightness: Maximum brightness value.

Optional sub-node properties:
- label: Name for this LED. If omitted, the label is taken from the node name.
- linux,default-trigger: Trigger assigned to the LED.

Example:

netxbig-leds {
	compatible = "lacie,netxbig-leds";

	gpio-ext = &gpio_ext;

	timers = <NETXBIG_LED_TIMER1 500 500
		  NETXBIG_LED_TIMER2 500 1000>;

	blue-power {
		label = "netxbig:blue:power";
		mode-addr = <0>;
		mode-val = <NETXBIG_LED_OFF 0
			    NETXBIG_LED_ON 1
			    NETXBIG_LED_TIMER1 3
			    NETXBIG_LED_TIMER2 7>;
		bright-addr = <1>;
		max-brightness = <7>;
	};
	red-power {
		label = "netxbig:red:power";
		mode-addr = <0>;
		mode-val = <NETXBIG_LED_OFF 0
			    NETXBIG_LED_ON 2
			    NETXBIG_LED_TIMER1 4>;
		bright-addr = <1>;
		max-brightness = <7>;
	};
	blue-sata0 {
		label = "netxbig:blue:sata0";
		mode-addr = <3>;
		mode-val = <NETXBIG_LED_OFF 0
			    NETXBIG_LED_ON 7
			    NETXBIG_LED_SATA 1
			    NETXBIG_LED_TIMER1 3>;
		bright-addr = <2>;
		max-brightness = <7>;
	};
	red-sata0 {
		label = "netxbig:red:sata0";
		mode-addr = <3>;
		mode-val = <NETXBIG_LED_OFF 0
			    NETXBIG_LED_ON 2
			    NETXBIG_LED_TIMER1 4>;
		bright-addr = <2>;
		max-brightness = <7>;
	};
	blue-sata1 {
		label = "netxbig:blue:sata1";
		mode-addr = <4>;
		mode-val = <NETXBIG_LED_OFF 0
			    NETXBIG_LED_ON 7
			    NETXBIG_LED_SATA 1
			    NETXBIG_LED_TIMER1 3>;
		bright-addr = <2>;
		max-brightness = <7>;
	};
	red-sata1 {
		label = "netxbig:red:sata1";
		mode-addr = <4>;
		mode-val = <NETXBIG_LED_OFF 0
			    NETXBIG_LED_ON 2
			    NETXBIG_LED_TIMER1 4>;
		bright-addr = <2>;
		max-brightness = <7>;
	};
};
```

## Documentation/devicetree/bindings/leds/leds-pca9532.txt
```
FASTVC-BENCH-CORPUS:linux-main-100k-v1-e0bd41dc-8e12-4f1b-978d-a3645ae59da0
*NXP - pca9532 PWM LED Driver

The PCA9532 family is SMBus I/O expander optimized for dimming LEDs.
The PWM support 256 steps.

Required properties:
	- compatible:
		"nxp,pca9530"
/* bench 29400.0.0 16229bd8eb4c */
/* bench 29400.0.1 8ded096cefe9 */
/* bench 29400.0.2 ca4c5b8af4cb */
/* bench 29400.0.3 ceb6d5fd71a0 */
/* bench 29400.0.4 e7e018c76971 */
/* bench 29400.0.5 912ac4966b37 */
/* bench 29400.0.6 f2ac6794b14e */
/* bench 29400.0.7 fe97ba6b6198 */
/* bench 29400.0.8 96a2def42de0 */
/* bench 29400.0.9 27ef1a4d4980 */
		"nxp,pca9531"
		"nxp,pca9532"
		"nxp,pca9533"
	- reg -  I2C slave address

Each led is represented as a sub-node of the nxp,pca9530.

Optional sub-node properties:
/* bench 463.0.0 adc62837e447 */
/* bench 463.0.1 f785b2d73f9c */
/* bench 463.0.2 b96fcc2f7b90 */
	- linux,default-trigger: see Documentation/devicetree/bindings/leds/common.txt
	- default-state: see Documentation/devicetree/bindings/leds/common.txt
	  This property is only valid for sub-nodes of type <PCA9532_TYPE_LED>.

Example:
  #include <dt-bindings/leds/leds-pca9532.h>

  leds: pca9530@60 {
    compatible = "nxp,pca9530";
    reg = <0x60>;

    red-power {
      label = "pca:red:power";
      type = <PCA9532_TYPE_LED>;
    };
    green-power {
      label = "pca:green:power";
      type = <PCA9532_TYPE_LED>;
    };
    kernel-booting {
      type = <PCA9532_TYPE_LED>;
      default-state = "on";
    };
    sys-stat {
      type = <PCA9532_TYPE_LED>;
      default-state = "keep"; // don't touch, was set by U-Boot
    };
  };

For more product information please see the link below:
http://nxp.com/documents/data_sheet/PCA9532.pdf
```

## Documentation/devicetree/bindings/leds/leds-pca955x.txt
```
FASTVC-BENCH-CORPUS:linux-main-100k-v1-e0bd41dc-8e12-4f1b-978d-a3645ae59da0
* NXP - pca955x LED driver

The PCA955x family of chips are I2C LED blinkers whose pins not used
to control LEDs can be used as general purpose I/Os. The GPIO pins can
be input or output, and output pins can also be pulse-width controlled.

Required properties:
- compatible : should be one of :
	"nxp,pca9550"
	"nxp,pca9551"
	"nxp,pca9552"
	"ibm,pca9552"
	"nxp,pca9553"
- #address-cells: must be 1
- #size-cells: must be 0
- reg: I2C slave address. depends on the model.

Optional properties:
- gpio-controller: allows pins to be used as GPIOs.
- #gpio-cells: must be 2.
- gpio-line-names: define the names of the GPIO lines

LED sub-node properties:
- reg : number of LED line.
		from 0 to  1 for the pca9550
		from 0 to  7 for the pca9551
		from 0 to 15 for the pca9552
		from 0 to  3 for the pca9553
- type: (optional) either
	PCA955X_TYPE_NONE
	PCA955X_TYPE_LED
	PCA955X_TYPE_GPIO
	see dt-bindings/leds/leds-pca955x.h (default to LED)
- label : (optional)
	see Documentation/devicetree/bindings/leds/common.txt
- linux,default-trigger : (optional)
	see Documentation/devicetree/bindings/leds/common.txt

Examples:

pca9552: pca9552@60 {
	compatible = "nxp,pca9552";
	#address-cells = <1>;
        #size-cells = <0>;
	reg = <0x60>;

	gpio-controller;
	#gpio-cells = <2>;
	gpio-line-names = "GPIO12", "GPIO13", "GPIO14", "GPIO15";

	gpio@12 {
		reg = <12>;
		type = <PCA955X_TYPE_GPIO>;
	};
/* bench 4127.0.0 af3f45df8944 */
/* bench 4127.0.1 cd2145a74b67 */
/* bench 4127.0.2 d28ad038e6e7 */
/* bench 4127.0.3 eba71d856034 */
/* bench 4127.0.4 c9486b796f7c */
/* bench 4127.0.5 18ed3e0de46c */
/* bench 4127.0.6 3ce26a5282bf */
/* bench 4127.0.7 6f93364b1b49 */
	};
	gpio@14 {
		reg = <14>;
		type = <PCA955X_TYPE_GPIO>;
	};
	gpio@15 {
		reg = <15>;
		type = <PCA955X_TYPE_GPIO>;
	};

	led@0 {
		label = "red:power";
		linux,default-trigger = "default-on";
		reg = <0>;
		type = <PCA955X_TYPE_LED>;
	};
/* bench 7936.0.0 277aa5f6196c */
/* bench 7936.0.1 391101837f6e */
/* bench 7936.0.2 9df1e2f834a5 */
/* bench 7936.0.3 72769d1c1544 */
/* bench 7936.0.4 5b96fe54c2bb */
/* bench 7936.0.5 51e429e6ea2b */
/* bench 7936.0.6 68694c88c45d */
/* bench 7936.0.7 cb448d175dd4 */
/* bench 7936.0.8 0a287962e8a2 */
/* bench 7936.0.9 b65364081e7f */
/* bench 7936.0.10 7a79c0232d81 */
/* bench 7936.0.11 ec0d05e6534d */
/* bench 7936.0.12 6b5938512e1f */
/* bench 7936.0.13 af44779f068a */
		type = <PCA955X_TYPE_LED>;
	};
	led@2 {
		label = "pca9552:yellow";
		reg = <2>;
		type = <PCA955X_TYPE_LED>;
	};
	led@3 {
		label = "pca9552:white";
		reg = <3>;
		type = <PCA955X_TYPE_LED>;
	};
};
```
