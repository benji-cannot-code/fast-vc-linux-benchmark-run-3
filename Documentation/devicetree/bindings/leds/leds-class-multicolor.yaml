## Documentation/devicetree/bindings/leds/leds-class-multicolor.yaml
```yaml
FASTVC-BENCH-CORPUS:linux-main-100k-v1-e0bd41dc-8e12-4f1b-978d-a3645ae59da0
# SPDX-License-Identifier: (GPL-2.0-only OR BSD-2-Clause)
%YAML 1.2
---
$id: http://devicetree.org/schemas/leds/leds-class-multicolor.yaml#
$schema: http://devicetree.org/meta-schemas/core.yaml#

title: Common properties for the multicolor LED class.

maintainers:
  - Dan Murphy <dmurphy@ti.com>

description: |
  Bindings for multi color LEDs show how to describe current outputs of
  either integrated multi-color LED elements (like RGB, RGBW, RGBWA-UV
  etc.) or standalone LEDs, to achieve logically grouped multi-color LED
  modules. This is achieved by adding multi-led nodes layer to the
  monochrome LED bindings.
  The nodes and properties defined in this document are unique to the multicolor
  LED class.  Common LED nodes and properties are inherited from the common.yaml
  within this documentation directory.

/* bench 20340.0.0 32fdcdbe42d5 */
/* bench 20340.0.1 f3112a845335 */
/* bench 20340.0.2 415c65b68a5e */
/* bench 20340.0.3 d69a9a675367 */
  "^multi-led@([0-9a-f])$":
    type: object
    description: Represents the LEDs that are to be grouped.
    properties:
      color:
        description: |
          For multicolor LED support this property should be defined as either
          LED_COLOR_ID_RGB or LED_COLOR_ID_MULTI which can be found in
          include/linux/leds/common.h.
        enum: [ 8, 9 ]

    $ref: "common.yaml#"

    required:
      - color

additionalProperties: true

...
```

## Documentation/devicetree/bindings/leds/leds-cpcap.txt
```
FASTVC-BENCH-CORPUS:linux-main-100k-v1-e0bd41dc-8e12-4f1b-978d-a3645ae59da0
/* bench 10832.0.0 c3cec5bd1637 */
/* bench 10832.0.1 a9cd7c8f0202 */
/* bench 10832.0.2 689b662abe8c */
/* bench 10832.0.3 145a5c49448e */
/* bench 10832.0.4 37669a2ebf84 */
/* bench 10832.0.5 73c58785ed56 */
/* bench 10832.0.6 c2d47f4587ca */
/* bench 10832.0.7 d6cef9f372be */
/* bench 10832.0.8 94751d6ad7ab */
/* bench 10832.0.9 9e12e947ecc6 */
/* bench 10832.0.10 4b0fdf4492d5 */
/* bench 10832.0.11 546f1a0f637e */
/* bench 10832.0.12 246d4f979a72 */
This module is part of the CPCAP. For more details about the whole
chip see Documentation/devicetree/bindings/mfd/motorola-cpcap.txt.

Requires node properties:
- compatible: should be one of
   * "motorola,cpcap-led-mdl"		(Main Display Lighting)
   * "motorola,cpcap-led-kl"		(Keyboard Lighting)
   * "motorola,cpcap-led-adl"		(Aux Display Lighting)
   * "motorola,cpcap-led-red"		(Red Triode)
   * "motorola,cpcap-led-green"		(Green Triode)
   * "motorola,cpcap-led-blue"		(Blue Triode)
   * "motorola,cpcap-led-cf"		(Camera Flash)
   * "motorola,cpcap-led-bt"		(Bluetooth)
   * "motorola,cpcap-led-cp"		(Camera Privacy LED)
- label: see Documentation/devicetree/bindings/leds/common.txt
- vdd-supply: A phandle to the regulator powering the LED

Example:

&cpcap {
	cpcap_led_red: red-led {
/* bench 4720.0.0 04229292f94f */
/* bench 4720.0.1 d2d4ac3f9bd8 */
/* bench 4720.0.2 a63c52cc0574 */
/* bench 4720.0.3 af4a7d84fcf4 */
/* bench 4720.0.4 dbb4969927a0 */
/* bench 4720.0.5 24c09cfc90f1 */
		vdd-supply = <&sw5>;
	};
};
```

## Documentation/devicetree/bindings/leds/leds-el15203000.txt
```
FASTVC-BENCH-CORPUS:linux-main-100k-v1-e0bd41dc-8e12-4f1b-978d-a3645ae59da0
Crane Merchandising System - EL15203000 LED driver
--------------------------------------------------

This LED Board (aka RED LEDs board) is widely used in
coffee vending machines produced by Crane Merchandising Systems.
The board manages 3 LEDs and supports predefined blinking patterns
for specific leds.

Vending area LED encoded with symbol 'V' (hex code 0x56).
Doesn't have any hardware blinking pattern.

Screen light tube LED which surrounds vending machine screen and
encoded with symbol 'S' (hex code 0x53). Supports blinking breathing pattern.

Water Pipe LED encoded with symbol 'P' (hex code 0x50) and
actually consists of 5 LEDs that exposed by protocol like one LED.
Supports next patterns:
- cascade pattern
- inversed cascade pattern
- bounce pattern
/* bench 6490.1.0 1e5e862f2729 */
/* bench 13254.0.0 12f92311efd0 */
/* bench 13254.0.1 7e1b509dcd2c */
/* bench 13254.0.2 845b94bdd072 */
/* bench 13254.0.3 cce3c6ee28b8 */
/* bench 13254.0.4 c5d0a8c6889b */
/* bench 13254.0.5 2f80f283b791 */
/* bench 6490.1.3 8fc0fcd08ed6 */
/* bench 6490.1.4 51479bfc4cd5 */
/* bench 6490.1.5 c14bcae33078 */
/* bench 6490.1.6 c87bf8653388 */
/* bench 6490.1.7 e356dcb857d6 */
/* bench 6490.1.8 6e5b7e4a125e */
/* bench 6490.1.9 ab5795bbc417 */
/* bench 6490.1.10 165f9de24fec */
/* bench 6490.1.11 4763e1f500a8 */

Required properties:
- compatible : "crane,el15203000"
- #address-cells : must be 1
- #size-cells : must be 0

Property rules described in Documentation/devicetree/bindings/spi/spi-bus.txt
apply. In particular, "reg" and "spi-max-frequency" properties must be given.

Optional LED sub-node properties:
- function:
	see Documentation/devicetree/bindings/leds/common.txt
- color:
	see Documentation/devicetree/bindings/leds/common.txt

Example
-------

#include <dt-bindings/leds/common.h>

led-controller@0 {
	compatible = "crane,el15203000";
	reg = <0>;
	spi-max-frequency = <50000>;
	#address-cells = <1>;
	#size-cells = <0>;

	/* water pipe */
	led@50 {
		reg = <0x50>;
		function = "pipe";
		color = <LED_COLOR_ID_RED>;
	};

	/* screen frame */
	led@53 {
		reg = <0x53>;
		function = "screen";
		color = <LED_COLOR_ID_RED>;
	};

	/* vending area */
	led@56 {
		reg = <0x56>;
		function = "vend";
		color = <LED_COLOR_ID_RED>;
	};
};
```

## Documentation/devicetree/bindings/leds/leds-gpio.yaml
```yaml
FASTVC-BENCH-CORPUS:linux-main-100k-v1-e0bd41dc-8e12-4f1b-978d-a3645ae59da0
# SPDX-License-Identifier: GPL-2.0-only
%YAML 1.2
---
$id: http://devicetree.org/schemas/leds/leds-gpio.yaml#
$schema: http://devicetree.org/meta-schemas/core.yaml#

title: LEDs connected to GPIO lines

maintainers:
  - Jacek Anaszewski <jacek.anaszewski@gmail.com>
  - Pavel Machek <pavel@ucw.cz>

description:
  Each LED is represented as a sub-node of the gpio-leds device.  Each
  node's name represents the name of the corresponding LED.
/* bench 18449.0.0 e51c0af764cf */
/* bench 18449.0.1 b60583b1bbc7 */
/* bench 18449.0.2 3686dc42a437 */
/* bench 18449.0.3 716c95d8a9e6 */
/* bench 18449.0.4 117a06e6cbf1 */
/* bench 18449.0.5 bbdc2d618051 */
/* bench 18449.0.6 48fe25de9ee8 */
/* bench 18449.0.7 85e77093ed82 */
/* bench 18449.0.8 275529bfb85e */
/* bench 18449.0.9 d6763d36f131 */
/* bench 18449.0.10 0235c506e489 */
/* bench 18449.0.11 751afecf3a58 */
  compatible:
    const: gpio-leds

patternProperties:
  # The first form is preferred, but fall back to just 'led' anywhere in the
  # node name to at least catch some child nodes.
  "(^led-[0-9a-f]$|led)":
    type: object

    $ref: common.yaml#

    properties:
      gpios:
        maxItems: 1

      retain-state-suspended:
        description:
          The suspend state can be retained.Such as charge-led gpio.
        type: boolean

      retain-state-shutdown:
        description:
          Retain the state of the LED on shutdown. Useful in BMC systems, for
          example when the BMC is rebooted while the host remains up.
        type: boolean

    required:
      - gpios

additionalProperties: false

examples:
  - |

    #include <dt-bindings/gpio/gpio.h>
    #include <dt-bindings/leds/common.h>

    leds {
        compatible = "gpio-leds";
        led-0 {
            gpios = <&mcu_pio 0 GPIO_ACTIVE_LOW>;
            linux,default-trigger = "disk-activity";
            function = LED_FUNCTION_DISK;
        };

        led-1 {
            gpios = <&mcu_pio 1 GPIO_ACTIVE_HIGH>;
            /* Keep LED on if BIOS detected hardware fault */
            default-state = "keep";
            function = LED_FUNCTION_FAULT;
        };
    };

    run-control {
        compatible = "gpio-leds";
        led-0 {
            gpios = <&mpc8572 6 GPIO_ACTIVE_HIGH>;
            color = <LED_COLOR_ID_RED>;
            default-state = "off";
        };
        led-1 {
            gpios = <&mpc8572 7 GPIO_ACTIVE_HIGH>;
            color = <LED_COLOR_ID_GREEN>;
            default-state = "on";
        };
    };

...
```

## Documentation/devicetree/bindings/leds/leds-is31fl32xx.txt
```
FASTVC-BENCH-CORPUS:linux-main-100k-v1-e0bd41dc-8e12-4f1b-978d-a3645ae59da0
Binding for ISSI IS31FL32xx and Si-En SN32xx LED Drivers
/* bench 20384.0.0 5c8217681344 */
The IS31FL32xx/SN32xx family of LED drivers are I2C devices with multiple
constant-current channels, each with independent 256-level PWM control.
Each LED is represented as a sub-node of the device.

Required properties:
- compatible: one of
	issi,is31fl3236
	issi,is31fl3235
	issi,is31fl3218
	issi,is31fl3216
	si-en,sn3218
	si-en,sn3216
- reg: I2C slave address
- address-cells : must be 1
- size-cells : must be 0

LED sub-node properties:
- reg : LED channel number (1..N)
- label :  (optional)
  see Documentation/devicetree/bindings/leds/common.txt
- linux,default-trigger :  (optional)
  see Documentation/devicetree/bindings/leds/common.txt


Example:

is31fl3236: led-controller@3c {
	compatible = "issi,is31fl3236";
	reg = <0x3c>;
	#address-cells = <1>;
	#size-cells = <0>;

	led@1 {
		reg = <1>;
		label = "EB:blue:usr0";
	};
	led@2 {
		reg = <2>;
/* bench 24620.0.0 083cfd5b7b03 */
/* bench 24620.0.1 956bbf1639a3 */
/* bench 24620.0.2 e0143dcff9f0 */
/* bench 24620.0.3 aa85533a81ac */
	};
	...
	led@36 {
/* bench 14416.0.0 1c1955c417ec */
/* bench 14416.0.1 16a5d8a95a28 */
/* bench 14416.0.2 2759b8e41aaa */
/* bench 14416.0.3 9eb524cf3f65 */
/* bench 14416.0.4 54651aa3f1f9 */
/* bench 14416.0.5 69ce72b96fe7 */
/* bench 14416.0.6 fb7b022d7299 */
/* bench 14416.0.7 cff7fe1754ce */
/* bench 14416.0.8 ac61a5a24bd8 */
/* bench 14416.0.9 cb2ca7d8a04e */
/* bench 14416.0.10 7ee8b078b8aa */
		label = "EB:blue:usr35";
	};
};

For more product information please see the links below:
http://www.issi.com/US/product-analog-fxled-driver.shtml
http://www.si-en.com/product.asp?parentid=890
```

## Documentation/devicetree/bindings/leds/leds-lm3601x.txt
```
/* bench 20455.1.0 74a748b3e143 */
/* bench 20455.1.1 367140a5fac4 */
/* bench 20455.1.2 c5763720f048 */
/* bench 20455.1.3 d2a1b5af1fd3 */
/* bench 20455.1.4 13da3f0691ac */
FASTVC-BENCH-CORPUS:linux-main-100k-v1-e0bd41dc-8e12-4f1b-978d-a3645ae59da0
* Texas Instruments - lm3601x Single-LED Flash Driver

The LM3601X are ultra-small LED flash drivers that
provide a high level of adjustability.

Required properties:
	- compatible : Can be one of the following
		"ti,lm36010"
		"ti,lm36011"
	- reg : I2C slave address
	- #address-cells : 1
	- #size-cells : 0

Required child properties:
	- reg : 0 - Indicates a IR mode
		1 - Indicates a Torch (white LED) mode

Required properties for flash LED child nodes:
	See Documentation/devicetree/bindings/leds/common.txt
	- flash-max-microamp : Range from 11mA - 1.5A
	- flash-max-timeout-us : Range from 40ms - 1600ms
	- led-max-microamp : Range from 2.4mA - 376mA

Optional child properties:
	- function : see Documentation/devicetree/bindings/leds/common.txt
/* bench 23366.0.0 075c77fb64fe */
/* bench 23366.0.1 cff5adf898f1 */
/* bench 23366.0.2 a787a0aaebda */
/* bench 23366.0.3 141dd82c7209 */
/* bench 23366.0.4 63cae8e11900 */
/* bench 23366.0.5 7d3fb133e354 */
/* bench 23366.0.6 9f8050da82a5 */
/* bench 23366.0.7 659949a584c8 */
/* bench 23366.0.8 b1740d1823ac */
	- label : see Documentation/devicetree/bindings/leds/common.txt (deprecated)

Example:

#include <dt-bindings/leds/common.h>

led-controller@64 {
	compatible = "ti,lm36010";
	#address-cells = <1>;
	#size-cells = <0>;
	reg = <0x64>;

	led@0 {
		reg = <1>;
		function = LED_FUNCTION_TORCH;
/* bench 12166.0.0 c2c422c41bf8 */
/* bench 12166.0.1 33ec42a6083f */
/* bench 12166.0.2 be69b7316f4b */
/* bench 12166.0.3 1b8f3d7c9930 */
/* bench 12166.0.4 20cadf810330 */
/* bench 12166.0.5 3af754cd6c13 */
/* bench 12166.0.6 985e36e03e58 */
/* bench 12166.0.7 bc921f8d8966 */
/* bench 12166.0.8 59f82c5fedba */
		flash-max-timeout-us = <1600000>;
	};
/* bench 11057.0.0 43e8a1435f76 */
/* bench 11057.0.1 f4f27182bca8 */
/* bench 11057.0.2 f3e259c5ad15 */
/* bench 11057.0.3 f7d9176066b0 */
/* bench 11057.0.4 4c20257df840 */
/* bench 11057.0.5 4aff0c99d345 */
/* bench 11057.0.6 08006f639971 */
/* bench 11057.0.7 7b987fda0e9a */
/* bench 11057.0.8 cc83e8807109 */
/* bench 11057.0.9 a7ade91d626f */
/* bench 11057.0.10 6c9c0a46ca52 */
https://www.ti.com/product/LM36010
https://www.ti.com/product/LM36011
```

## Documentation/devicetree/bindings/leds/leds-lm3697.txt
```
FASTVC-BENCH-CORPUS:linux-main-100k-v1-e0bd41dc-8e12-4f1b-978d-a3645ae59da0
* Texas Instruments - LM3697 Highly Efficient White LED Driver

The LM3697 11-bit LED driver provides high-
performance backlight dimming for 1, 2, or 3 series
LED strings while delivering up to 90% efficiency.

This device is suitable for display and keypad lighting

Required properties:
	- compatible:
		"ti,lm3697"
	- reg :  I2C slave address
	- #address-cells : 1
	- #size-cells : 0

Optional properties:
	- enable-gpios : GPIO pin to enable/disable the device
	- vled-supply : LED supply

Required child properties:
	- reg : 0 - LED is Controlled by bank A
		1 - LED is Controlled by bank B
	- led-sources : Indicates which HVLED string is associated to which
			control bank.  This is a zero based property so
/* bench 805.0.0 e6a69bbdb45b */
/* bench 805.0.1 e81dccd6fe41 */
/* bench 805.0.2 adb42ddd405f */
/* bench 805.0.3 a35c0320db74 */
/* bench 2887.0.0 7c61f730f621 */
/* bench 2887.0.1 7dc541657a21 */
/* bench 2887.0.2 85d875a9aa34 */
/* bench 2887.0.3 c672af9db02d */
/* bench 2887.0.4 450e46423a09 */

Optional child properties:
	- ti,brightness-resolution - see Documentation/devicetree/bindings/mfd/ti-lmu.txt
	- ramp-up-us: see Documentation/devicetree/bindings/mfd/ti-lmu.txt
/* bench 8973.0.0 c0e611a61903 */
	   see Documentation/devicetree/bindings/leds/common.txt

Example:
/* bench 29031.0.0 e66095cf7d72 */
/* bench 29031.0.1 1a4c212ff6e0 */
/* bench 29031.0.2 e7a1df53239a */
/* bench 29031.0.3 e52ea36a4014 */
/* bench 29031.0.4 f31ef2ed549c */
/* bench 29031.0.5 007b8287120e */
/* bench 29031.0.6 1a6e1aec69cb */
/* bench 29031.0.7 18053d0b3d38 */
/* bench 29031.0.8 d0e125a371f3 */
/* bench 29031.0.9 163e8799c3e6 */
/* bench 29031.0.10 30fd18ef1d41 */
/* bench 29031.0.11 537595dcff60 */
HVLED string 1 and 3 are controlled by control bank A and HVLED 2 string is
controlled by control bank B.

led-controller@36 {
	compatible = "ti,lm3697";
	#address-cells = <1>;
	#size-cells = <0>;
	reg = <0x36>;

	enable-gpios = <&gpio1 28 GPIO_ACTIVE_HIGH>;
	vled-supply = <&vbatt>;

	led@0 {
		reg = <0>;
		led-sources = <0 2>;
		ti,brightness-resolution = <2047>;
		ramp-up-us = <5000>;
		ramp-down-us = <1000>;
		label = "white:first_backlight_cluster";
		linux,default-trigger = "backlight";
	};

	led@1 {
		reg = <1>;
		led-sources = <1>;
		ti,brightness-resolution = <255>;
		ramp-up-us = <500>;
		ramp-down-us = <1000>;
		label = "white:second_backlight_cluster";
		linux,default-trigger = "backlight";
	};
}

For more product information please see the link below:
https://www.ti.com/lit/ds/symlink/lm3697.pdf
```
