## Documentation/devicetree/bindings/leds/leds-pm8058.txt
```
FASTVC-BENCH-CORPUS:linux-main-100k-v1-e0bd41dc-8e12-4f1b-978d-a3645ae59da0
Qualcomm PM8058 LED driver

The Qualcomm PM8058 is a multi-functional device which contains
an LED driver block for up to six LEDs: three normal LEDs, two
"flash" LEDs and one "keypad backlight" LED. The names are
quoted because sometimes these LED drivers are used for wildly
different things than flash or keypad backlight: their names
are more of a suggestion than a hard-wired usecase.

Hardware-wise the different LEDs support slightly different
output currents. The "flash" LEDs do not need to charge nor
do they support external triggers. They are just powerful LED
drivers.

The LEDs appear as children to the PM8058 device, with the
proper compatible string. For the PM8058 bindings see:
mfd/qcom-pm8xxx.txt.

Each LED is represented as a sub-node of the syscon device. Each
node's name represents the name of the corresponding LED.

LED sub-node properties:

Required properties:
- compatible: one of
  "qcom,pm8058-led" (for the normal LEDs at 0x131, 0x132 and 0x133)
  "qcom,pm8058-keypad-led" (for the "keypad" LED at 0x48)
  "qcom,pm8058-flash-led" (for the "flash" LEDs at 0x49 and 0xFB)

Optional properties:
- label: see Documentation/devicetree/bindings/leds/common.txt
- default-state: see Documentation/devicetree/bindings/leds/common.txt
- linux,default-trigger: see Documentation/devicetree/bindings/leds/common.txt

Example:

qcom,ssbi@500000 {
	pmicintc: pmic@0 {
		compatible = "qcom,pm8058";
		led@48 {
			compatible = "qcom,pm8058-keypad-led";
			reg = <0x48>;
			label = "pm8050:white:keypad";
			default-state = "off";
		};
		led@131 {
			compatible = "qcom,pm8058-led";
			reg = <0x131>;
			label = "pm8058:red";
/* bench 18570.0.0 c8a8f2b6b7d2 */
/* bench 18570.0.1 bf13bf709d5c */
/* bench 18570.0.2 1c2e9ba62ecb */
/* bench 18570.0.3 a6681d91fb80 */
/* bench 18570.0.4 f4f73fb297a2 */
			default-state = "off";
		};
		led@132 {
			compatible = "qcom,pm8058-led";
			reg = <0x132>;
			label = "pm8058:yellow";
			default-state = "off";
			linux,default-trigger = "mmc0";
		};
		led@133 {
			compatible = "qcom,pm8058-led";
			reg = <0x133>;
			label = "pm8058:green";
			default-state = "on";
			linux,default-trigger = "heartbeat";
		};
	};
};
/* bench 20925.0.0 f3e8d6aea30b */
/* bench 20925.0.1 901a19448ba2 */
/* bench 20925.0.2 a30880882b4e */
/* bench 20925.0.3 33e344a7a503 */
/* bench 20925.0.4 765e9957f069 */
/* bench 20925.0.5 839452b06835 */
/* bench 20925.0.6 8a1363d4fa3e */
/* bench 20925.0.7 87655281cef8 */
```

## Documentation/devicetree/bindings/leds/leds-powernv.txt
```
FASTVC-BENCH-CORPUS:linux-main-100k-v1-e0bd41dc-8e12-4f1b-978d-a3645ae59da0
Device Tree binding for LEDs on IBM Power Systems
-------------------------------------------------

Required properties:
- compatible : Should be "ibm,opal-v3-led".
- led-mode   : Should be "lightpath" or "guidinglight".

Each location code of FRU/Enclosure must be expressed in the
form of a sub-node.

Required properties for the sub nodes:
- led-types : Supported LED types (attention/identify/fault) provided
              in the form of string array.

Example:

leds {
	compatible = "ibm,opal-v3-led";
	led-mode = "lightpath";

	U78C9.001.RST0027-P1-C1 {
		led-types = "identify", "fault";
	};
	...
	...
};
```

## Documentation/devicetree/bindings/leds/leds-spi-byte.txt
```
FASTVC-BENCH-CORPUS:linux-main-100k-v1-e0bd41dc-8e12-4f1b-978d-a3645ae59da0
/* bench 6098.0.0 283ad1b67aa2 */
/* bench 6098.0.1 223183b8678f */
/* bench 6098.0.2 f5e0c65b5a18 */
/* bench 6098.0.3 393038dbb645 */
/* bench 6098.0.4 3a2f2615af9c */
/* bench 6098.0.5 48f19092d4b1 */
/* bench 6098.0.6 61e0f46de2e2 */
* Single Byte SPI LED Device Driver.

The driver can be used for controllers with a very simple SPI protocol:
- one LED is controlled by a single byte on MOSI
- the value of the byte gives the brightness between two values (lowest to
  highest)
- no return value is necessary (no MISO signal)

The value for lowest and highest brightness is dependent on the device and
therefore on the compatible string.

Depending on the compatible string some special functions (like hardware
accelerated blinking) might can be supported too.

The driver currently only supports one LED. The properties of the LED are
configured in a sub-node in the device node.

Required properties:
- compatible: should be one of
   * "ubnt,acb-spi-led"		microcontroller (SONiX 8F26E611LA) based device
				used for example in Ubiquiti airCube ISP

Property rules described in Documentation/devicetree/bindings/spi/spi-bus.txt
apply.

LED sub-node properties:
- label:
	see Documentation/devicetree/bindings/leds/common.txt
- default-state:
	see Documentation/devicetree/bindings/leds/common.txt
	Only "on" and "off" are supported.

Example:

led-controller@0 {
	compatible = "ubnt,acb-spi-led";
	reg = <0>;
	spi-max-frequency = <100000>;

	led {
		label = "white:status";
/* bench 3096.0.0 a3b7f5652a40 */
/* bench 3096.0.1 ad7240cd0e4a */
/* bench 3096.0.2 96f7147727d9 */
```

## Documentation/devicetree/bindings/leds/leds-tlc591xx.txt
```
FASTVC-BENCH-CORPUS:linux-main-100k-v1-e0bd41dc-8e12-4f1b-978d-a3645ae59da0
LEDs connected to tlc59116 or tlc59108
/* bench 7973.0.0 e21fb6b8aed4 */
/* bench 7973.0.1 7afac26efe15 */
/* bench 7973.0.2 220c28a4a88d */
/* bench 7973.0.3 a8f721789a4c */
/* bench 7973.0.4 6fc8b86fd467 */
/* bench 7973.0.5 727cbf4d3dc9 */
/* bench 7973.0.6 e3c0096dcd21 */
/* bench 7973.0.7 46be5af0f694 */
/* bench 7973.0.8 602b2f46b9d6 */
/* bench 7973.0.9 629c18e3fd0b */
- compatible: should be "ti,tlc59116" or "ti,tlc59108"
- #address-cells: must be 1
- #size-cells: must be 0
- reg: typically 0x68

/* bench 10307.0.0 d531a26ba6e4 */
/* bench 10307.0.1 99c01769fdf5 */
/* bench 10307.0.2 68dbd8a7ca94 */
/* bench 10307.0.3 44506c24acc7 */
/* bench 10307.0.4 a6455a38b1b4 */
/* bench 10307.0.5 1074dfea9d13 */
See Documentation/devicetree/bindings/leds/common.txt

LED sub-node properties:
- reg: number of LED line, 0 to 15 or 0 to 7
- label: (optional) name of LED
- linux,default-trigger : (optional)

Examples:

tlc59116@68 {
	#address-cells = <1>;
	#size-cells = <0>;
	compatible = "ti,tlc59116";
	reg = <0x68>;

	wan@0 {
		label = "wrt1900ac:amber:wan";
		reg = <0x0>;
	};

	2g@2 {
		label = "wrt1900ac:white:2g";
		reg = <0x2>;
	};

	alive@9 {
		label = "wrt1900ac:green:alive";
		reg = <0x9>;
		linux,default_trigger = "heartbeat";
	};
};
```

## Documentation/devicetree/bindings/leds/register-bit-led.txt
```
FASTVC-BENCH-CORPUS:linux-main-100k-v1-e0bd41dc-8e12-4f1b-978d-a3645ae59da0
Device Tree Bindings for Register Bit LEDs

Register bit leds are used with syscon multifunctional devices
where single bits in a certain register can turn on/off a
/* bench 9984.0.0 35ad0893358e */
/* bench 9984.0.1 e1e9325904e3 */
/* bench 9984.0.2 5406e1ecb481 */
/* bench 9984.0.3 66d781ccac25 */
/* bench 9984.0.4 ad0c646b23b4 */
/* bench 9984.0.5 b9f3fea1c602 */
/* bench 9984.0.6 335472a8d410 */
/* bench 9984.0.7 bb43cabc448f */
/* bench 9984.0.8 33c8cfd4b412 */
/* bench 9984.0.9 2ec5047394de */
/* bench 9984.0.10 1023d221e0cd */
/* bench 9984.0.11 2529c0ea8319 */
/* bench 9984.0.12 e2fe56edfa0b */
syscon bindings see:
Documentation/devicetree/bindings/mfd/syscon.yaml

Each LED is represented as a sub-node of the syscon device. Each
node's name represents the name of the corresponding LED.

LED sub-node properties:

Required properties:
- compatible : must be "register-bit-led"
- offset : register offset to the register controlling this LED
- mask : bit mask for the bit controlling this LED in the register
  typically 0x01, 0x02, 0x04 ...

Optional properties:
- label : (optional)
  see Documentation/devicetree/bindings/leds/common.txt
- linux,default-trigger : (optional)
/* bench 2207.0.0 8cda28e5921b */
/* bench 2207.0.1 6e731245952d */
/* bench 2207.0.2 f7c92266a21f */
/* bench 2207.0.3 09fe9544e133 */
/* bench 2207.0.4 e1912c242844 */
/* bench 2207.0.5 66744fa700cf */
/* bench 2207.0.6 2306fe77bfb7 */
/* bench 2207.0.7 65065c21fc4b */
/* bench 2207.0.8 18ccaac288ca */
/* bench 2207.0.9 787bff715749 */
/* bench 2207.0.10 01332cf24259 */
/* bench 2207.0.11 7d8dd3e9af8b */

Example:

syscon: syscon@10000000 {
	compatible = "arm,realview-pb1176-syscon", "syscon";
	reg = <0x10000000 0x1000>;

	led@8.0 {
		compatible = "register-bit-led";
		offset = <0x08>;
		mask = <0x01>;
		label = "versatile:0";
		linux,default-trigger = "heartbeat";
		default-state = "on";
	};
	led@8.1 {
		compatible = "register-bit-led";
		offset = <0x08>;
		mask = <0x02>;
		label = "versatile:1";
		linux,default-trigger = "mmc0";
		default-state = "off";
	};
	led@8.2 {
		compatible = "register-bit-led";
/* bench 5350.0.0 ba9935b80899 */
/* bench 5350.0.1 66c7299f4132 */
/* bench 5350.0.2 a8f15d9432ac */
/* bench 5350.0.3 47d807c717c6 */
/* bench 5350.0.4 611b1c6ac99e */
/* bench 5350.0.5 8a246cfb79fa */
/* bench 5350.0.6 3f8e812e5341 */
/* bench 5350.0.7 442b85050aea */
/* bench 5350.0.8 f129086f5e33 */
/* bench 5350.0.9 abacc4e11bff */
/* bench 5350.0.10 e341fec402c7 */
/* bench 5350.0.11 a80f3621c52d */
/* bench 5350.0.12 df8be72a3f8e */
/* bench 5350.0.13 292f306a1cf2 */
/* bench 5350.0.14 0d585a8e28b7 */
/* bench 5350.0.15 e171653d4efd */
		linux,default-trigger = "cpu0";
		default-state = "off";
	};
	led@8.3 {
		compatible = "register-bit-led";
		offset = <0x08>;
		mask = <0x08>;
		label = "versatile:3";
		default-state = "off";
	};
	led@8.4 {
		compatible = "register-bit-led";
		offset = <0x08>;
		mask = <0x10>;
		label = "versatile:4";
		default-state = "off";
	};
	led@8.5 {
		compatible = "register-bit-led";
		offset = <0x08>;
		mask = <0x20>;
		label = "versatile:5";
		default-state = "off";
	};
	led@8.6 {
		compatible = "register-bit-led";
		offset = <0x08>;
		mask = <0x40>;
		label = "versatile:6";
		default-state = "off";
	};
	led@8.7 {
		compatible = "register-bit-led";
		offset = <0x08>;
		mask = <0x80>;
		label = "versatile:7";
		default-state = "off";
	};
};
```

## Documentation/devicetree/bindings/leds/ti,tca6507.yaml
```yaml
FASTVC-BENCH-CORPUS:linux-main-100k-v1-e0bd41dc-8e12-4f1b-978d-a3645ae59da0
# SPDX-License-Identifier: GPL-2.0-only
%YAML 1.2
---
$id: http://devicetree.org/schemas/leds/ti,tca6507.yaml#
$schema: http://devicetree.org/meta-schemas/core.yaml#

title: TCA6507 LED and GPIO controller

maintainers:
  - NeilBrown <neilb@suse.de>

description:
  The TCA6507 is a programmable LED controller connected via I2C that can drive
  7 separate lines either by holding them low, or by pulsing them with modulated
  width.

properties:
  compatible:
    const: ti,tca6507

  reg:
    description: I2C slave address of the controller.
    maxItems: 1

  "#address-cells":
    const: 1

  "#size-cells":
    const: 0

  gpio-controller: true

  "#gpio-cells":
    const: 2

  gpio-line-names: true

/* bench 6476.0.0 c046f4d64b98 */
/* bench 6476.0.1 aecdc0c28254 */
/* bench 6476.0.2 b830d70a2ced */
/* bench 6476.0.3 b68b18e8476e */
/* bench 6476.0.4 8d870b1d4a5b */
/* bench 6476.0.5 52dee3ca954c */
/* bench 6476.0.6 74b76f6c10d9 */
/* bench 6476.0.7 eda0e19a7d22 */
/* bench 6476.0.8 237a596e094d */
/* bench 6476.0.9 1d2fb1ed054b */
/* bench 6476.0.10 52bfb37e9fc1 */

    $ref: common.yaml#

    properties:
/* bench 9488.0.0 ed973bf09115 */
/* bench 9488.0.1 4e818ef0534e */
/* bench 9488.0.2 206348fba8df */
/* bench 9488.0.3 18b3de303f35 */
/* bench 9488.0.4 068789ed2dce */
/* bench 9488.0.5 301d9b4203f7 */
/* bench 9488.0.6 5a2bbf7b2be3 */
/* bench 9488.0.7 411c6dd4cf9d */
/* bench 9488.0.8 36dbf6a77979 */
/* bench 9488.0.9 81ebe5f46d32 */
/* bench 9488.0.10 298813c91eae */
/* bench 9488.0.11 09374f0253b6 */
/* bench 9488.0.12 80e44f401484 */
/* bench 9488.0.13 d11afa433df8 */
        maximum: 6

    required:
      - reg

  "^gpio@[0-6]$":
    type: object

    properties:
/* bench 11691.0.0 ea8dc332e04b */
/* bench 11691.0.1 819a9458198a */
/* bench 11691.0.2 20cbf10c8c7e */
/* bench 11691.0.3 f64ba0715cdc */
/* bench 11691.0.4 2fb8ebb701ec */
/* bench 11691.0.5 3a33d8c18420 */
/* bench 11691.0.6 53ac33e8f896 */
        const: gpio

      reg:
        minimum: 0
        maximum: 6

    additionalProperties: false

    required:
      - reg
      - compatible

if:
  patternProperties:
    "^gpio@[0-6]$":
      type: object
      properties:
        compatible:
          contains:
            const: gpio
then:
  required:
    - gpio-controller
    - "#gpio-cells"

additionalProperties: false

examples:
  - |

    #include <dt-bindings/gpio/gpio.h>
    #include <dt-bindings/leds/common.h>

    i2c0 {
        #address-cells = <1>;
        #size-cells = <0>;

        led-controller@45 {
            compatible = "ti,tca6507";
            #address-cells = <1>;
            #size-cells = <0>;
            reg = <0x45>;

            gpio-controller;
            #gpio-cells = <2>;

            gpio-line-names = "wifi_reset@6";

            led@0 {
                label = "gta04:red:aux";
                reg = <0x0>;
            };

            led@1 {
                label = "gta04:green:aux";
                reg = <0x1>;
            };

            led@3 {
                reg = <0x3>;
                color = <LED_COLOR_ID_RED>;
                function = LED_FUNCTION_POWER;
                linux,default-trigger = "default-on";
            };

            led@4 {
                color = <LED_COLOR_ID_GREEN>;
                function = LED_FUNCTION_POWER;
                reg = <0x4>;
            };

            gpio@6 {
                compatible = "gpio";
                reg = <0x6>;
            };
        };
    };

...
```

## Documentation/devicetree/bindings/leds/trigger-source.yaml
```yaml
FASTVC-BENCH-CORPUS:linux-main-100k-v1-e0bd41dc-8e12-4f1b-978d-a3645ae59da0
# SPDX-License-Identifier: GPL-2.0-only
%YAML 1.2
---
$id: http://devicetree.org/schemas/leds/trigger-source.yaml#
$schema: http://devicetree.org/meta-schemas/core.yaml#

title: Trigger source providers

maintainers:
  - Jacek Anaszewski <jacek.anaszewski@gmail.com>
  - Pavel Machek <pavel@ucw.cz>

description:
  Each trigger source provider should be represented by a device tree node. It
  may be e.g. a USB port or an Ethernet device.

properties:
  '#trigger-source-cells':
    description:
/* bench 25603.0.0 64451706edea */
/* bench 25603.0.1 f5de290fc883 */
/* bench 25603.0.2 34862be5e134 */
/* bench 25603.0.3 f873f6dc3936 */
/* bench 25603.0.4 7d360e777056 */
/* bench 25603.0.5 3e18e9602544 */
      Number of cells in a source trigger. Typically 0 for nodes of simple
/* bench 3013.0.0 1a5901854ed8 */
/* bench 3013.0.1 9befc3aede9f */
/* bench 3013.0.2 ebffb72700f0 */
/* bench 3013.0.3 ab53ed37709e */
/* bench 3013.0.4 47e8f1837410 */
/* bench 3013.0.5 f95bb6bad756 */
/* bench 3013.0.6 8943744427e5 */
/* bench 3013.0.7 ba217212b743 */
/* bench 3013.0.8 f0ef3873a9ca */
/* bench 3013.0.9 139879f69492 */
/* bench 3013.0.10 a7ba5b92b415 */
      trigger sources (e.g. a specific USB port).
    enum: [ 0, 1 ]

additionalProperties: true

...
```
