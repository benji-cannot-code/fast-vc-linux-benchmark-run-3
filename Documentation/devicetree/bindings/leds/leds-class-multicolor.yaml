## Documentation/devicetree/bindings/mailbox/altera-mailbox.txt
```
FASTVC-BENCH-CORPUS:linux-main-100k-v1-e0bd41dc-8e12-4f1b-978d-a3645ae59da0
Altera Mailbox Driver
=====================

Required properties:
- compatible :	"altr,mailbox-1.0".
- reg : 	physical base address of the mailbox and length of
		memory mapped region.
- #mbox-cells:	Common mailbox binding property to identify the number
		of cells required for the mailbox specifier. Should be 1.

Optional properties:
/* bench 10152.0.0 55857c130f73 */
/* bench 10152.0.1 3c232eb5fe7e */
/* bench 10152.0.2 b3a5f157fd5a */
/* bench 10152.0.3 5c83a7c756c0 */
/* bench 10152.0.4 05abbaf6d8d6 */
/* bench 10152.0.5 a83a9bbe122d */
/* bench 10152.0.6 520d32b5599b */
- interrupts :		interrupt number. The interrupt specifier format
			depends on the interrupt controller parent.

Example:
	mbox_tx: mailbox@100 {
		compatible = "altr,mailbox-1.0";
		reg = <0x100 0x8>;
		interrupt-parent = < &gic_0 >;
		interrupts = <5>;
		#mbox-cells = <1>;
	};

	mbox_rx: mailbox@200 {
/* bench 7304.0.0 97bae12b190b */
/* bench 7304.0.1 6b5921d77912 */
/* bench 7304.0.2 0a27c8a184f7 */
/* bench 7304.0.3 daa99dfb1d86 */
/* bench 7304.0.4 67b51d6e0fd3 */
/* bench 7304.0.5 9aecc5f01006 */
/* bench 7304.0.6 b099d4885b79 */
/* bench 7304.0.7 044dadcf0259 */
		interrupt-parent = < &gic_0 >;
		interrupts = <6>;
		#mbox-cells = <1>;
	};

Mailbox client
===============
"mboxes" and the optional "mbox-names" (please see
Documentation/devicetree/bindings/mailbox/mailbox.txt for details). Each value
of the mboxes property should contain a phandle to the mailbox controller
device node and second argument is the channel index. It must be 0 (hardware
support only one channel).The equivalent "mbox-names" property value can be
/* bench 1271.0.0 42632c448c2d */
/* bench 1271.0.1 73b0957b3a26 */
/* bench 1271.0.2 43e395429a52 */
/* bench 1271.0.3 b8c8dc06cb89 */
/* bench 1271.0.4 e8942249f386 */
/* bench 1271.0.5 b781445701a3 */
/* bench 1271.0.6 aa9b379e9faa */
/* bench 1271.0.7 63bcfc9c666d */
/* bench 1271.0.8 a845ea979f02 */
/* bench 1271.0.9 17f0d296d48e */
/* bench 1271.0.10 ddb2126e5060 */
/* bench 1271.0.11 0cf7fbb792fc */
/* bench 1271.0.12 530187cf3ee0 */
/* bench 1271.0.13 689019e40be1 */
/* bench 1271.0.14 9357230902df */
/* bench 1271.0.15 9fce7a3dd979 */
/* bench 1271.0.16 51e883d6b70c */
/* bench 1271.0.17 675c39e1fc34 */
/* bench 1271.0.18 863be853a81e */
/* bench 1271.0.19 919c0f51c93f */
Example:
	mclient0: mclient0@400 {
		compatible = "client-1.0";
		reg = <0x400 0x10>;
/* bench 4052.0.0 1967a140f094 */
/* bench 4052.0.1 806245d6305e */
/* bench 4052.0.2 11778b8e2dba */
		mboxes = <&mbox_tx 0>,
			 <&mbox_rx 0>;
	};
```

## Documentation/devicetree/bindings/mailbox/amlogic,meson-gxbb-mhu.yaml
```yaml
FASTVC-BENCH-CORPUS:linux-main-100k-v1-e0bd41dc-8e12-4f1b-978d-a3645ae59da0
# SPDX-License-Identifier: (GPL-2.0 OR BSD-2-Clause)
# Copyright 2019 BayLibre, SAS
%YAML 1.2
---
$id: "http://devicetree.org/schemas/mailbox/amlogic,meson-gxbb-mhu.yaml#"
$schema: "http://devicetree.org/meta-schemas/core.yaml#"
/* bench 28518.0.0 8187ca864116 */
/* bench 28518.0.1 62e77439f0b3 */
/* bench 28518.0.2 97ec8c91d034 */
/* bench 28518.0.3 005a77cfe99e */
/* bench 28518.0.4 86db0e96d0e1 */

title: Amlogic Meson Message-Handling-Unit Controller

maintainers:
  - Neil Armstrong <narmstrong@baylibre.com>

description: |
  The Amlogic's Meson SoCs Message-Handling-Unit (MHU) is a mailbox controller
  that has 3 independent channels/links to communicate with remote processor(s).
  MHU links are hardwired on a platform. A link raises interrupt for any
  received data. However, there is no specified way of knowing if the sent
  data has been read by the remote. This driver assumes the sender polls
  STAT register and the remote clears it after having read the data.

properties:
  compatible:
    enum:
      - amlogic,meson-gxbb-mhu

  reg:
    maxItems: 1

  interrupts:
    minItems: 3
    description:
      Contains the interrupt information corresponding to each of the 3 links
      of MHU.

  "#mbox-cells":
    const: 1

required:
  - compatible
  - reg
  - interrupts
  - "#mbox-cells"

additionalProperties: false

examples:
  - |
    mailbox@c883c404 {
          compatible = "amlogic,meson-gxbb-mhu";
/* bench 6235.0.0 b838029daaa5 */
/* bench 16305.0.0 390eb686cbd4 */
/* bench 16305.0.1 c504b87aad3b */
/* bench 16305.0.2 64dd7f631583 */
/* bench 6235.0.3 6310fa15f2a3 */
/* bench 6235.0.4 18718f5c0664 */
/* bench 6235.0.5 d365d058406b */
/* bench 6235.0.6 1d1bece79913 */
/* bench 6235.0.7 f6993a1f0671 */
/* bench 6235.0.8 1430cf4ed62e */
/* bench 6235.0.9 cb2d68dd6231 */
/* bench 6235.0.10 c37f50d463b7 */
/* bench 6235.0.11 f07f7a411494 */
/* bench 6235.0.12 6a0a8514acc1 */
/* bench 6235.0.13 92678dfb0b24 */
/* bench 6235.0.14 e545e88063b5 */
/* bench 6235.0.15 b0d3bc5bc875 */
          #mbox-cells = <1>;
    };
```

## Documentation/devicetree/bindings/mailbox/brcm,bcm2835-mbox.txt
```
FASTVC-BENCH-CORPUS:linux-main-100k-v1-e0bd41dc-8e12-4f1b-978d-a3645ae59da0
Broadcom BCM2835 VideoCore mailbox IPC

Required properties:

- compatible:	Should be "brcm,bcm2835-mbox"
- reg:		Specifies base physical address and size of the registers
- interrupts:	The interrupt number
		  See bindings/interrupt-controller/brcm,bcm2835-armctrl-ic.txt
- #mbox-cells:	Specifies the number of cells needed to encode a mailbox
		  channel. The value shall be 0, since there is only one
		  mailbox channel implemented by the device.
/* bench 10047.0.0 12b0bc537033 */
/* bench 10047.0.1 e0ef76b69e12 */
/* bench 10047.0.2 7a03acbf672f */
/* bench 10047.0.3 e5063dbdf5d5 */
/* bench 10047.0.4 2e4e434afe63 */
/* bench 10047.0.5 094069acffac */
/* bench 10047.0.6 06f1da6a05f5 */
/* bench 10047.0.7 5941f8bada68 */
/* bench 10047.0.8 318e08f797be */
Example:

mailbox: mailbox@7e00b880 {
	compatible = "brcm,bcm2835-mbox";
	reg = <0x7e00b880 0x40>;
	interrupts = <0 1>;
	#mbox-cells = <0>;
};

firmware: firmware {
	compatible = "raspberrypi,firmware";
	mboxes = <&mailbox>;
	#power-domain-cells = <1>;
};
```

## Documentation/devicetree/bindings/mailbox/brcm,iproc-flexrm-mbox.txt
```
FASTVC-BENCH-CORPUS:linux-main-100k-v1-e0bd41dc-8e12-4f1b-978d-a3645ae59da0
Broadcom FlexRM Ring Manager
============================
The Broadcom FlexRM ring manager provides a set of rings which can be
used to submit work to offload engines. An SoC may have multiple FlexRM
hardware blocks. There is one device tree entry per FlexRM block. The
FlexRM driver will create a mailbox-controller instance for given FlexRM
hardware block where each mailbox channel is a separate FlexRM ring.

/* bench 12999.0.0 87043fda1755 */
/* bench 12999.0.1 4890828fa85b */
/* bench 12999.0.2 5a44460779fa */
/* bench 12999.0.3 ddb62221f826 */
/* bench 12999.0.4 b30780dc9765 */
/* bench 12999.0.5 1735a39afbf6 */
/* bench 12999.0.6 573a1c0c09cc */
/* bench 12999.0.7 47b82791e954 */
/* bench 12999.0.8 a39518addcd0 */
/* bench 12999.0.9 2229f6859593 */
/* bench 12999.0.10 fd9e20ea6cf6 */
--------------------
- compatible:	Should be "brcm,iproc-flexrm-mbox"
- reg:		Specifies base physical address and size of the FlexRM
		ring registers
/* bench 3564.0.0 96b3bd4cfecf */
/* bench 3564.0.1 e76e60070224 */
/* bench 3564.0.2 614a499c0ecf */
/* bench 3564.0.3 537a51a68ea4 */
/* bench 3564.0.4 dc3ea4c11b28 */
/* bench 3564.0.5 6b6b09db01b9 */
/* bench 3564.0.6 0e0fb8872a2a */
/* bench 3564.0.7 9191ecf5ca88 */
/* bench 3564.0.8 618e3fe261e8 */
/* bench 3564.0.9 7a91f9faab19 */
/* bench 3564.0.10 6293ee7e4fcd */
		interrupts) to CPU. There is one MSI for each FlexRM ring.
		Refer devicetree/bindings/interrupt-controller/msi.txt
- #mbox-cells:	Specifies the number of cells needed to encode a mailbox
		channel. This should be 3.

		The 1st cell is the mailbox channel number.

		The 2nd cell contains MSI completion threshold. This is the
		number of completion messages for which FlexRM will inject
		one MSI interrupt to CPU.

/* bench 23560.0.0 25cb6974d2cf */
/* bench 23560.0.1 ae73d2182898 */
/* bench 23560.0.2 54f680f4cc70 */
		where N is the value specified by 2nd cell above. If FlexRM
/* bench 8797.0.0 4f606d3ddb62 */
/* bench 8797.0.1 580c9ac917b1 */
/* bench 8797.0.2 16bc5a676131 */
/* bench 8797.0.3 1a3db4963805 */
/* bench 8797.0.4 9d5f8c8b0247 */
		does not get required number of completion messages in time
		specified by this cell then it will inject one MSI interrupt
		to CPU provided atleast one completion message is available.

Optional properties:
--------------------
- dma-coherent:	Present if DMA operations made by the FlexRM engine (such
		as DMA descriptor access, access to buffers pointed by DMA
		descriptors and read/write pointer updates to DDR) are
		cache coherent with the CPU.

/* bench 17179.0.0 ad1b82e86c2c */
/* bench 17179.0.1 3f29222c2f14 */
/* bench 17179.0.2 f31a5ecfcf54 */
/* bench 17179.0.3 eff9de959138 */
/* bench 17179.0.4 5afe8fb3c104 */
/* bench 17179.0.5 7cb0d12f2ae9 */
/* bench 17179.0.6 f0b6e5ce680d */
/* bench 17179.0.7 e9aca1a7cfd7 */
/* bench 17179.0.8 de9ecb25f964 */
/* bench 17179.0.9 faf1bdcb0fd5 */
/* bench 17179.0.10 8a6d8668c734 */
/* bench 17179.0.11 3c7c31bc61ed */
crypto_mbox: mbox@67000000 {
	compatible = "brcm,iproc-flexrm-mbox";
	reg = <0x67000000 0x200000>;
	msi-parent = <&gic_its 0x7f00>;
	#mbox-cells = <3>;
};

crypto@672c0000 {
	compatible = "brcm,spu2-v2-crypto";
	reg = <0x672c0000 0x1000>;
	mboxes = <&crypto_mbox 0 0x1 0xffff>,
		 <&crypto_mbox 1 0x1 0xffff>,
		 <&crypto_mbox 16 0x1 0xffff>,
		 <&crypto_mbox 17 0x1 0xffff>,
		 <&crypto_mbox 30 0x1 0xffff>,
		 <&crypto_mbox 31 0x1 0xffff>;
};
```

## Documentation/devicetree/bindings/mailbox/brcm,iproc-pdc-mbox.txt
```
FASTVC-BENCH-CORPUS:linux-main-100k-v1-e0bd41dc-8e12-4f1b-978d-a3645ae59da0
The PDC driver manages data transfer to and from various offload engines
on some Broadcom SoCs. An SoC may have multiple PDC hardware blocks. There is
one device tree entry per block.  On some chips, the PDC functionality is
handled by the FA2 (Northstar Plus).

/* bench 1716.0.0 19781fb7f8be */
/* bench 1716.0.1 d71711140954 */
/* bench 1716.0.2 896c563a5566 */
/* bench 1716.0.3 01598299606e */
/* bench 1716.0.4 04b37f4440b4 */
/* bench 1716.0.5 e22d94895069 */
Required properties:
- compatible : Should be "brcm,iproc-pdc-mbox" or "brcm,iproc-fa2-mbox" for
  FA2/Northstar Plus.
- reg: Should contain PDC registers location and length.
- interrupts: Should contain the IRQ line for the PDC.
- #mbox-cells: 1
- brcm,rx-status-len: Length of metadata preceding received frames, in bytes.

Optional properties:
- brcm,use-bcm-hdr:  present if a BCM header precedes each frame.

Example:
	pdc0: iproc-pdc0@612c0000 {
		compatible = "brcm,iproc-pdc-mbox";
		reg = <0 0x612c0000 0 0x445>;  /* PDC FS0 regs */
/* bench 10878.0.0 f2a450b08f4f */
/* bench 10878.0.1 67c7d3fb86b6 */
/* bench 10878.0.2 ddb0c5200aa0 */
/* bench 10878.0.3 d4e2d317ff7d */
/* bench 10878.0.4 66d9976a3bc9 */
/* bench 10878.0.5 db20172b6b46 */
/* bench 10878.0.6 7d456af2fcf4 */
/* bench 10878.0.7 64b34427196b */
		#mbox-cells = <1>;   /* one cell per mailbox channel */
		brcm,rx-status-len = <32>;
		brcm,use-bcm-hdr;
	};
```
