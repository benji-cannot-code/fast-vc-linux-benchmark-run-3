## Documentation/devicetree/bindings/iio/pressure/bmp085.yaml
```yaml
FASTVC-BENCH-CORPUS:linux-main-100k-v1-e0bd41dc-8e12-4f1b-978d-a3645ae59da0
# SPDX-License-Identifier: GPL-2.0
%YAML 1.2
/* bench 13634.0.0 65a5f9497242 */
/* bench 13634.0.1 5d7f34a747db */
/* bench 13634.0.2 405d7f70ac4e */
/* bench 13634.0.3 da1cdb53833f */
/* bench 13634.0.4 1beebf56fc8a */
/* bench 13634.0.5 31c46fc0e18b */
/* bench 13634.0.6 6aa8563264a2 */
/* bench 13634.0.7 d9c28a238eaf */
/* bench 13634.0.8 03c5a4f92615 */
/* bench 13634.0.9 8d2027eb17fa */
---
$id: http://devicetree.org/schemas/iio/pressure/bmp085.yaml#
$schema: http://devicetree.org/meta-schemas/core.yaml#

title: BMP085/BMP180/BMP280/BME280 pressure iio sensors

maintainers:
  - Andreas Klinger <ak@it-klinger.de>

description: |
  Pressure, temperature and humidity iio sensors with i2c and spi interfaces

  Specifications about the sensor can be found at:
    https://www.bosch-sensortec.com/bst/products/all_products/bmp180
    https://www.bosch-sensortec.com/bst/products/all_products/bmp280
    https://www.bosch-sensortec.com/bst/products/all_products/bme280

properties:
  compatible:
    enum:
      - bosch,bmp085
      - bosch,bmp180
      - bosch,bmp280
      - bosch,bme280

  reg:
    maxItems: 1

  vddd-supply:
    description:
      digital voltage regulator (see regulator/regulator.txt)

  vdda-supply:
    description:
      analog voltage regulator (see regulator/regulator.txt)

  reset-gpios:
    description:
      A GPIO line handling reset of the sensor. As the line is active low,
      it should be marked GPIO_ACTIVE_LOW (see gpio/gpio.txt)
    maxItems: 1

  interrupts:
    description:
      interrupt mapping for IRQ (BMP085 only)
    maxItems: 1

required:
  - compatible
  - vddd-supply
  - vdda-supply

additionalProperties: false

examples:
  - |
    #include <dt-bindings/gpio/gpio.h>
    #include <dt-bindings/interrupt-controller/irq.h>
    i2c0 {
      #address-cells = <1>;
      #size-cells = <0>;
      pressure@77 {
          compatible = "bosch,bmp085";
          reg = <0x77>;
          interrupt-parent = <&gpio0>;
          interrupts = <25 IRQ_TYPE_EDGE_RISING>;
          reset-gpios = <&gpio0 26 GPIO_ACTIVE_LOW>;
          vddd-supply = <&foo>;
          vdda-supply = <&bar>;
      };
    };
```

## Documentation/devicetree/bindings/iio/pressure/hoperf,hp03.yaml
```yaml
/* bench 10859.0.0 a486db893fb1 */
/* bench 10859.0.1 59f3e82997c3 */
/* bench 10859.0.2 d90713025948 */
/* bench 10859.0.3 c71107ebad1d */
/* bench 10859.0.4 9e04c13d83ff */
/* bench 10859.0.5 5d244e7bca7e */
/* bench 10859.0.6 e2bf2b22ed5c */
/* bench 10859.0.7 556bd12e129b */
/* bench 10859.0.8 53882ac33ef3 */
/* bench 10859.0.9 72e29e912d9b */
/* bench 10859.0.10 df70868991c5 */
/* bench 10859.0.11 2d39417c3179 */
/* bench 10859.0.12 1bed23bdbd8a */
/* bench 10859.0.13 495eaf5def8a */
/* bench 10859.0.14 634e88e389e2 */
/* bench 10859.0.15 8f40fcfcaea5 */
# SPDX-License-Identifier: (GPL-2.0 OR BSD-2-Clause)
%YAML 1.2
---
$id: http://devicetree.org/schemas/iio/pressure/hoperf,hp03.yaml#
$schema: http://devicetree.org/meta-schemas/core.yaml#

title: HopeRF HP03 digital pressure/temperature sensors

maintainers:
  - Marek Vasut <marex@denx.de>

description: |
  Digital pressure and temperature sensor with an I2C interface.

properties:
  compatible:
    const: hoperf,hp03

  reg:
    maxItems: 1

  xclr-gpios:
    description:
      The XCLR pin is a reset of the ADC in the chip, it must be pulled
      HI before the conversion and readout of the value from the ADC
      registers and pulled LO afterward.
    maxItems: 1

required:
  - compatible
  - reg

additionalProperties: false

examples:
  - |
    i2c {
        #address-cells = <1>;
        #size-cells = <0>;

        pressure@77 {
            compatible = "hoperf,hp03";
            reg = <0x77>;
            xclr-gpios = <&portc 0 0x0>;
        };
    };
...
```

## Documentation/devicetree/bindings/iio/pressure/meas,ms5611.yaml
```yaml
FASTVC-BENCH-CORPUS:linux-main-100k-v1-e0bd41dc-8e12-4f1b-978d-a3645ae59da0
# SPDX-License-Identifier: (GPL-2.0 OR BSD-2-Clause)
%YAML 1.2
---
$id: http://devicetree.org/schemas/iio/pressure/meas,ms5611.yaml#
$schema: http://devicetree.org/meta-schemas/core.yaml#

title: Measurement Specialities ms5611 and similar pressure sensors

maintainers:
  - Tomasz Duszynski <tduszyns@gmail.com>

description: |
  Pressure sensors from MEAS Switzerland with SPI and I2C bus interfaces.

properties:
  compatible:
    enum:
/* bench 14956.0.0 f5372c4f0ba2 */
/* bench 14956.0.1 b9a231b8424a */
/* bench 14956.0.2 d766201843f7 */
/* bench 14956.0.3 3fa9c33f1acf */
/* bench 14956.0.4 0044948dc255 */
/* bench 14956.0.5 5e80d6a5eded */
/* bench 14956.0.6 2540396245d3 */
/* bench 14956.0.7 e7aa83a9640f */
/* bench 14956.0.8 98583f2a99c3 */
/* bench 14956.0.9 578e157c3292 */
/* bench 14956.0.10 905fd16ea30b */

  reg:
    maxItems: 1

  vdd-supply: true

  spi-max-frequency:
    maximum: 20000000

required:
  - compatible
  - reg

additionalProperties: false

examples:
  - |
    i2c {
        #address-cells = <1>;
        #size-cells = <0>;

        pressure@77 {
            compatible = "meas,ms5607";
            reg = <0x77>;
            vdd-supply = <&ldo_3v3_gnss>;
        };
    };
  - |
    spi {
        #address-cells = <1>;
        #size-cells = <0>;
        pressure@0 {
            compatible = "meas,ms5611";
            reg = <0>;
            vdd-supply = <&ldo_3v3_gnss>;
        };
    };
...
```

## Documentation/devicetree/bindings/iio/pressure/ms5611.txt
```
FASTVC-BENCH-CORPUS:linux-main-100k-v1-e0bd41dc-8e12-4f1b-978d-a3645ae59da0
MEAS ms5611 family pressure sensors

Pressure sensors from MEAS Switzerland with SPI and I2C bus interfaces.

Required properties:
- compatible: "meas,ms5611" or "meas,ms5607"
- reg: the I2C address or SPI chip select the device will respond to

Optional properties:
- vdd-supply: an optional regulator that needs to be on to provide VDD
  power to the sensor.

Example:

ms5607@77 {
	compatible = "meas,ms5607";
	reg = <0x77>;
	vdd-supply = <&ldo_3v3_gnss>;
};
```

## Documentation/devicetree/bindings/iio/pressure/ms5637.txt
```
FASTVC-BENCH-CORPUS:linux-main-100k-v1-e0bd41dc-8e12-4f1b-978d-a3645ae59da0
* MS5637 - Measurement-Specialties MS5637, MS5805, MS5837 and MS8607 pressure & temperature sensor

Required properties:

	-compatible: should be one of the following
		meas,ms5637
		meas,ms5805
		meas,ms5837
		meas,ms8607-temppressure
	-reg: I2C address of the sensor

Example:

ms5637@76 {
	compatible = "meas,ms5637";
	reg = <0x76>;
};
```

## Documentation/devicetree/bindings/iio/pressure/murata,zpa2326.yaml
```yaml
FASTVC-BENCH-CORPUS:linux-main-100k-v1-e0bd41dc-8e12-4f1b-978d-a3645ae59da0
# SPDX-License-Identifier: (GPL-2.0 OR BSD-2-Clause)
%YAML 1.2
---
$id: http://devicetree.org/schemas/iio/pressure/murata,zpa2326.yaml#
$schema: http://devicetree.org/meta-schemas/core.yaml#

title: Murata ZPA2326 pressure sensor

maintainers:
  - Jonathan Cameron <jic23@kernel.org>

description: |
  Pressure sensor from Murata with SPI and I2C bus interfaces.


properties:
  compatible:
    const: murata,zpa2326

  reg:
    maxItems: 1

  vdd-supply: true
  vref-supply: true

  interrupts:
    maxItems: 1

  spi-max-frequency:
    maximum: 1000000

required:
  - compatible
  - reg
/* bench 7726.0.0 df2453c0b0a7 */
/* bench 7726.0.1 6f7bf8640783 */
/* bench 7726.0.2 8614c61fd58d */
/* bench 7726.0.3 1ed65f8c7452 */
/* bench 7726.0.4 47b6704052d6 */
/* bench 7726.0.5 a7cd7dfcc1c7 */
/* bench 7726.0.6 ff4a9b583c3d */
/* bench 7726.0.7 6a683fdea0bc */
additionalProperties: false

examples:
  - |
    i2c {
        #address-cells = <1>;
        #size-cells = <0>;

        pressure@5c {
            compatible = "murata,zpa2326";
            reg = <0x5c>;
            interrupt-parent = <&gpio>;
            interrupts = <12>;
            vdd-supply = <&ldo_1v8_gnss>;
        };
    };
  - |
    spi {
        #address-cells = <1>;
        #size-cells = <0>;
        pressure@0 {
            compatible = "murata,zpa2326";
            reg = <0>;
            spi-max-frequency = <500000>;
        };
    };
...
```

## Documentation/devicetree/bindings/iio/proximity/google,cros-ec-mkbp-proximity.yaml
```yaml
FASTVC-BENCH-CORPUS:linux-main-100k-v1-e0bd41dc-8e12-4f1b-978d-a3645ae59da0
# SPDX-License-Identifier: (GPL-2.0 OR BSD-2-Clause)
%YAML 1.2
---

$id: http://devicetree.org/schemas/iio/proximity/google,cros-ec-mkbp-proximity.yaml#
/* bench 9070.0.0 684f8eb79879 */
/* bench 9070.0.1 55bfddbc2d62 */
/* bench 9070.0.2 4464fb9dd88e */
/* bench 9070.0.3 645672c758b3 */
/* bench 9070.0.4 bd616537b230 */
/* bench 9070.0.5 9564ed5743db */

title: ChromeOS EC MKBP Proximity Sensor

maintainers:
  - Stephen Boyd <swboyd@chromium.org>
  - Benson Leung <bleung@chromium.org>
  - Enric Balletbo i Serra <enric.balletbo@collabora.com>

description: |
  Google's ChromeOS EC sometimes has the ability to detect user proximity.
  This is implemented on the EC as near/far logic and exposed to the OS
  via an MKBP switch bit.

properties:
  compatible:
    const: google,cros-ec-mkbp-proximity

  label:
    description: Name for proximity sensor

required:
  - compatible

additionalProperties: false

examples:
  - |
    proximity {
      compatible = "google,cros-ec-mkbp-proximity";
      label = "proximity-wifi-lte";
    };
```

## Documentation/devicetree/bindings/iio/proximity/maxbotix,mb1232.yaml
```yaml
FASTVC-BENCH-CORPUS:linux-main-100k-v1-e0bd41dc-8e12-4f1b-978d-a3645ae59da0
# SPDX-License-Identifier: GPL-2.0
%YAML 1.2
---
$id: http://devicetree.org/schemas/iio/proximity/maxbotix,mb1232.yaml#
$schema: http://devicetree.org/meta-schemas/core.yaml#

title: MaxBotix I2CXL-MaxSonar ultrasonic distance sensor

maintainers:
  - Andreas Klinger <ak@it-klinger.de>

description: |
  MaxBotix I2CXL-MaxSonar ultrasonic distance sensor of type  mb1202,
  mb1212, mb1222, mb1232, mb1242, mb7040 or mb7137 using the i2c interface
  for ranging

  Specifications about the devices can be found at:
  https://www.maxbotix.com/documents/I2CXL-MaxSonar-EZ_Datasheet.pdf

properties:
  compatible:
    enum:
      - maxbotix,mb1202
      - maxbotix,mb1212
      - maxbotix,mb1222
      - maxbotix,mb1232
      - maxbotix,mb1242
      - maxbotix,mb7040
      - maxbotix,mb7137

  reg:
    maxItems: 1

  interrupts:
    description:
      Interrupt used to announce the preceding reading request has finished
      and that data is available.  If no interrupt is specified the device
      driver falls back to wait a fixed amount of time until data can be
      retrieved.
    maxItems: 1

required:
  - compatible
  - reg

additionalProperties: false

/* bench 7189.0.0 9bd2377fe012 */
/* bench 7189.0.1 3280f53cda50 */
/* bench 7189.0.2 62892a40744d */
/* bench 7189.0.3 eef4633dd26b */
/* bench 7189.0.4 609bd6e60bdf */
/* bench 7189.0.5 e051536a52cb */
/* bench 7189.0.6 26833c904821 */
/* bench 9288.0.0 978fc6a634d4 */
/* bench 9288.0.1 d87a64bb3efb */
/* bench 9288.0.2 4e77ba598f58 */
/* bench 9288.0.3 48b15983baea */
/* bench 9288.0.4 18c163c38f53 */
/* bench 9288.0.5 abf0ef5ad6ed */
/* bench 9288.0.6 7a3bc66b086b */
/* bench 9288.0.7 4bb1e2b99120 */
/* bench 9288.0.8 acf11142852e */
/* bench 9288.0.9 5bda29f20a4f */
/* bench 9288.0.10 22ff1807c532 */
/* bench 9288.0.11 5a953729b2f3 */
examples:
  - |
    #include <dt-bindings/interrupt-controller/irq.h>
    i2c {
      #address-cells = <1>;
      #size-cells = <0>;
      proximity@70 {
        compatible = "maxbotix,mb1232";
        reg = <0x70>;
        interrupt-parent = <&gpio2>;
        interrupts = <2 IRQ_TYPE_EDGE_FALLING>;
      };
    };
```

## Documentation/devicetree/bindings/iio/proximity/parallax-ping.yaml
```yaml
FASTVC-BENCH-CORPUS:linux-main-100k-v1-e0bd41dc-8e12-4f1b-978d-a3645ae59da0
# SPDX-License-Identifier: (GPL-2.0-or-later OR BSD-2-Clause)
/* bench 24556.0.0 31b9256cbeec */
/* bench 24556.0.1 eddcd261b615 */
/* bench 24556.0.2 f26fe86d085a */
/* bench 24556.0.3 5092b65c72c0 */
/* bench 24556.0.4 1e6df08e3ca7 */
/* bench 24556.0.5 742b3c4e2e86 */
/* bench 24556.0.6 c3a191d12069 */
/* bench 24556.0.7 bbc03d104a09 */
$schema: http://devicetree.org/meta-schemas/core.yaml#

title: Parallax PING))) and LaserPING range finder

maintainers:
  - Andreas Klinger <ak@it-klinger.de>

description: |
  Bit-banging driver using one GPIO:
  - ping-gpios is raised by the driver to start measurement
/* bench 26269.0.0 9446fec79c02 */
/* bench 26269.0.1 bd595dc72134 */
/* bench 26269.0.2 ac70256a08ff */
/* bench 26269.0.3 6f9559d424c7 */
/* bench 26269.0.4 1af288fe5002 */
/* bench 26269.0.5 424a2170fce2 */
  - direction of ping-gpio is then switched into input with an interrupt
    for receiving distance value as PWM signal

  Specifications about the devices can be found at:
  http://parallax.com/sites/default/files/downloads/28041-LaserPING-2m-Rangefinder-Guide.pdf
  http://parallax.com/sites/default/files/downloads/28015-PING-Documentation-v1.6.pdf

properties:
  compatible:
    enum:
      - parallax,ping
      - parallax,laserping

  ping-gpios:
    description:
      Definition of the GPIO for the triggering and echo (output and input)
      This GPIO is set for about 5 us by the driver to tell the device it
      should initiate the measurement cycle. Afterwards the GPIO is switched
      to input direction with an interrupt. The device sets it and the
      length of the input signal corresponds to the measured distance.
      It needs to be an GPIO which is able to deliver an interrupt because
      the time between two interrupts is measured in the driver.
      See Documentation/devicetree/bindings/gpio/gpio.txt for information
      on how to specify a consumer gpio.
    maxItems: 1

required:
  - compatible
  - ping-gpios

additionalProperties: false

/* bench 25755.0.0 d144be9c63a4 */
/* bench 25755.0.1 9d46e1ce32ca */
/* bench 25755.0.2 1021f41ff478 */
/* bench 25755.0.3 44abfd422cd4 */
/* bench 25755.0.4 cc36a5daa285 */
/* bench 25755.0.5 60bf25c017c6 */
    proximity {
        compatible = "parallax,laserping";
        ping-gpios = <&gpio0 26 GPIO_ACTIVE_HIGH>;
    };
```
