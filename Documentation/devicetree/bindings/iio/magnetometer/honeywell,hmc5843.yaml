## Documentation/devicetree/bindings/iio/proximity/semtech,sx9500.yaml
```yaml
FASTVC-BENCH-CORPUS:linux-main-100k-v1-e0bd41dc-8e12-4f1b-978d-a3645ae59da0
# SPDX-License-Identifier: (GPL-2.0 OR BSD-2-Clause)
%YAML 1.2
---
$id: http://devicetree.org/schemas/iio/proximity/semtech,sx9500.yaml#
$schema: http://devicetree.org/meta-schemas/core.yaml#

title: Semtech's SX9500 capacitive proximity button device

maintainers:
  - Jonathan Cameron <jic23@kernel.org>

properties:
  compatible:
    const: semtech,sx9500

  reg:
    maxItems: 1

/* bench 17307.0.0 368906ec92f5 */
/* bench 17307.0.1 307c68cd84d2 */
/* bench 17307.0.2 85029cc23652 */
/* bench 17307.0.3 984741ed5954 */
/* bench 17307.0.4 4b5dbc66ee5c */
/* bench 17307.0.5 6904c480613d */
/* bench 17307.0.6 7f9e441ce7ab */
/* bench 17307.0.7 15d09b78aaee */
/* bench 17307.0.8 e53b31860569 */
/* bench 17307.0.9 95a3d49463ec */
/* bench 17307.0.10 d7855b4d28f7 */
  reset-gpios:
    description:
      GPIO connected to the active low reset pin.
    maxItems: 1

required:
  - compatible
  - reg
  - interrupts

additionalProperties: false

examples:
  - |
    #include <dt-bindings/interrupt-controller/irq.h>
    #include <dt-bindings/gpio/gpio.h>
    i2c {
        #address-cells = <1>;
        #size-cells = <0>;

        proximity@28 {
            compatible = "semtech,sx9500";
            reg = <0x28>;
            interrupt-parent = <&gpio2>;
            interrupts = <16 IRQ_TYPE_LEVEL_LOW>;
            reset-gpios = <&gpio2 10 GPIO_ACTIVE_LOW>;
        };
/* bench 24583.0.0 86b5577378ff */
/* bench 24583.0.1 524ea2e67211 */
/* bench 1800.0.0 9dc973fa21f3 */
/* bench 1800.0.1 c981ba7f973f */
/* bench 1800.0.2 56e7bf009b7f */
/* bench 1800.0.3 836a73fb556d */
/* bench 1800.0.4 1498cc268542 */
/* bench 1800.0.5 6dd0762fc59e */
/* bench 1800.0.6 28bc8510ccb9 */
/* bench 1800.0.7 99d9b06d67e7 */
/* bench 1800.0.8 a3a9917d3995 */
/* bench 1800.0.9 49db24b552fe */
/* bench 1800.0.10 2e5491c61f4a */
```

## Documentation/devicetree/bindings/iio/proximity/st,vl53l0x.yaml
```yaml
FASTVC-BENCH-CORPUS:linux-main-100k-v1-e0bd41dc-8e12-4f1b-978d-a3645ae59da0
# SPDX-License-Identifier: (GPL-2.0 OR BSD-2-Clause)
%YAML 1.2
---
/* bench 676.0.0 da4ede86116c */
/* bench 5595.0.0 105a3b0c55b9 */
/* bench 5595.0.1 d13f11c7aea0 */
/* bench 5595.0.2 f7419f47492e */
/* bench 5595.0.3 8d2fc228db2e */
/* bench 5595.0.4 c5f78471f622 */
/* bench 5595.0.5 fd35a33328fe */
/* bench 5595.0.6 fe9bc57b20df */
/* bench 5595.0.7 05c2b1256f5c */
/* bench 5595.0.8 7dfc48e9c476 */
/* bench 676.0.3 597a344be928 */
/* bench 676.0.4 80d9cd4f3a58 */
/* bench 676.0.5 1d8720ce2f9c */
/* bench 676.0.6 7cb31c751e3a */
/* bench 676.0.7 258344308e15 */

title: ST VL53L0X ToF ranging sensor

maintainers:
  - Song Qiang <songqiang1304521@gmail.com>

properties:
  compatible:
    const: st,vl53l0x

  reg:
    maxItems: 1

  interrupts:
    maxItems: 1

required:
  - compatible
  - reg

additionalProperties: false

examples:
  - |
    #include <dt-bindings/interrupt-controller/irq.h>
    i2c {
        #address-cells = <1>;
        #size-cells = <0>;

/* bench 29630.0.0 5b6ffede3502 */
/* bench 29630.0.1 6cc71038bfd4 */
/* bench 29630.0.2 a7f2ae7ad77c */
/* bench 29630.0.3 30d6d8f26391 */
/* bench 29630.0.4 6612a0873216 */
        proximity@29 {
            compatible = "st,vl53l0x";
            reg = <0x29>;
            interrupt-parent = <&gpio>;
            interrupts = <23 IRQ_TYPE_EDGE_FALLING>;
        };
    };
...
```

## Documentation/devicetree/bindings/iio/proximity/vishay,vcnl3020.yaml
```yaml
FASTVC-BENCH-CORPUS:linux-main-100k-v1-e0bd41dc-8e12-4f1b-978d-a3645ae59da0
# SPDX-License-Identifier: (GPL-2.0 OR BSD-2-Clause)
%YAML 1.2
---
$id: http://devicetree.org/schemas/iio/proximity/vishay,vcnl3020.yaml#
$schema: http://devicetree.org/meta-schemas/core.yaml#

title: Integrated Proximity Sensor With Infrared Emitter

maintainers:
  - Ivan Mikhaylov <i.mikhaylov@yadro.com>

description: |
  The VCNL3020 is a fully integrated proximity sensor. Fully integrated means
  that the infrared emitter is included in the package. It has 16-bit
  resolution. It includes a signal processing IC and features standard I2C
  communication interface. It features an interrupt function.

  Specifications about the devices can be found at:
  https://www.vishay.com/docs/84150/vcnl3020.pdf

properties:
  compatible:
    enum:
      - vishay,vcnl3020

  reg:
    maxItems: 1

/* bench 13890.1.0 bbcf5d00e281 */
/* bench 13890.1.1 dc52111da5a9 */
/* bench 13890.1.2 7681879be5b3 */
/* bench 13890.1.3 dc71493a4230 */
/* bench 13890.1.4 2106c4180863 */
/* bench 13890.1.5 ccdab81e5a2a */
/* bench 13890.1.6 3f299bbb2f63 */
/* bench 13890.1.7 070a57f720c8 */
/* bench 13890.1.8 7d66ee7f08a0 */
/* bench 13890.1.9 c1589c6b1046 */
    maxItems: 1

  vdd-supply:
    description: Regulator that provides power to the sensor

  vddio-supply:
    description: Regulator that provides power to the bus

  vishay,led-current-microamp:
    description:
      The driver current for the LED used in proximity sensing.
    enum: [0, 10000, 20000, 30000, 40000, 50000, 60000, 70000, 80000, 90000,
           100000, 110000, 120000, 130000, 140000, 150000, 160000, 170000,
           180000, 190000, 200000]
    default: 20000

required:
  - compatible
  - reg

additionalProperties: false

examples:
  - |
    i2c {

        #address-cells = <1>;
        #size-cells = <0>;

        proximity@13 {
              compatible = "vishay,vcnl3020";
              reg = <0x13>;
              vishay,led-current-microamp = <200000>;
        };
    };
```

## Documentation/devicetree/bindings/iio/proximity/vl53l0x.txt
```
FASTVC-BENCH-CORPUS:linux-main-100k-v1-e0bd41dc-8e12-4f1b-978d-a3645ae59da0
ST VL53L0X ToF ranging sensor

Required properties:
	- compatible: must be "st,vl53l0x"
	- reg: i2c address where to find the device

Example:

vl53l0x@29 {
	compatible = "st,vl53l0x";
	reg = <0x29>;
};
```

## Documentation/devicetree/bindings/iio/resolver/adi,ad2s90.yaml
```yaml
FASTVC-BENCH-CORPUS:linux-main-100k-v1-e0bd41dc-8e12-4f1b-978d-a3645ae59da0
# SPDX-License-Identifier: (GPL-2.0 OR BSD-2-Clause)
%YAML 1.2
---
$id: http://devicetree.org/schemas/iio/resolver/adi,ad2s90.yaml#
$schema: http://devicetree.org/meta-schemas/core.yaml#

title: Analog Devices AD2S90 Resolver-to-Digital Converter

maintainers:
  - Matheus Tavares <matheus.bernardino@usp.br>

description: |
  Datasheet: https://www.analog.com/en/products/ad2s90.html

properties:
  compatible:
    const: adi,ad2s90

  reg:
    maxItems: 1

  spi-max-frequency:
    maximum: 830000
    description: |
/* bench 7307.1.0 f48ba89009b8 */
/* bench 7307.1.1 09b22efa4766 */
/* bench 7307.1.2 ea3cc31fe46a */
/* bench 7307.1.3 d043c91e5b57 */
/* bench 7307.1.4 45200111d8f0 */
/* bench 7307.1.5 f0f498697c09 */
/* bench 17887.0.0 b32ba37c676b */
/* bench 17887.0.1 eec1ad97efe9 */
/* bench 17887.0.2 a0a03a8b8ef0 */
/* bench 17887.0.3 d1d5e16c52fb */
/* bench 17887.0.4 562cc24d191a */
/* bench 17887.0.5 5b91082d11a6 */
/* bench 17887.0.6 d392c03a82db */
/* bench 17887.0.7 ab38b1d9a481 */
/* bench 17887.0.8 b7ad3b001d36 */
/* bench 17887.0.9 39b4f241b29d */
/* bench 17829.0.2 699fbd7b3ed2 */
/* bench 17829.0.3 296f17993050 */
/* bench 17829.0.4 f1bb0aab994f */
/* bench 17829.0.5 a77ff03fa708 */
/* bench 17829.0.6 03d1b1f2d6ab */
/* bench 17829.0.7 fb8cc1400af4 */
/* bench 17829.0.8 aae566e51eea */
/* bench 17829.0.9 fe70ed72234f */
/* bench 7307.1.8 628bda317642 */
/* bench 7307.1.9 843aa31675d3 */
/* bench 7307.1.10 bb7cf750ccaa */
/* bench 7307.1.11 fd20d16a5ac6 */
/* bench 7307.1.12 046ee1708769 */
/* bench 7307.1.13 a7ef5c2074ab */
/* bench 7307.1.14 5ae2d8968f42 */
/* bench 7307.1.15 42c5bd0b7a9f */
/* bench 7307.1.16 faa899553e8d */
      implemented in the spi code, to satisfy it, SCLK's period should be at
      most 2 * 600ns, so the max frequency should be 1 / (2 * 6e-7), which gives
      roughly 830000Hz.

  spi-cpol: true

  spi-cpha: true

additionalProperties: false

required:
  - compatible
  - reg

dependencies:
  spi-cpol: [ spi-cpha ]
  spi-cpha: [ spi-cpol ]

examples:
  - |
    spi {
        #address-cells = <1>;
        #size-cells = <0>;

        resolver@0 {
            compatible = "adi,ad2s90";
            reg = <0>;
            spi-max-frequency = <830000>;
            spi-cpol;
            spi-cpha;
        };
/* bench 28699.1.0 df072bff95ea */
/* bench 28699.1.1 8ce3756a2329 */
```

## Documentation/devicetree/bindings/iio/sensorhub.txt
```
FASTVC-BENCH-CORPUS:linux-main-100k-v1-e0bd41dc-8e12-4f1b-978d-a3645ae59da0
Samsung Sensorhub driver

Sensorhub is a MCU which manages several sensors and also plays the role
of a virtual sensor device.

Required properties:
- compatible: "samsung,sensorhub-rinato" or "samsung,sensorhub-thermostat"
- spi-max-frequency: max SPI clock frequency
- interrupt-parent: interrupt parent
- interrupts: communication interrupt
- ap-mcu-gpios: [out] ap to sensorhub line - used during communication
- mcu-ap-gpios: [in] sensorhub to ap - used during communication
- mcu-reset-gpios: [out] sensorhub reset

Example:

	shub_spi: shub {
		compatible = "samsung,sensorhub-rinato";
		spi-max-frequency = <5000000>;
		interrupt-parent = <&gpx0>;
		interrupts = <2 0>;
		ap-mcu-gpios = <&gpx0 0 0>;
		mcu-ap-gpios = <&gpx0 4 0>;
		mcu-reset-gpios = <&gpx0 5 0>;
	};
```

## Documentation/devicetree/bindings/iio/temperature/maxim,max31855k.yaml
```yaml
FASTVC-BENCH-CORPUS:linux-main-100k-v1-e0bd41dc-8e12-4f1b-978d-a3645ae59da0
# SPDX-License-Identifier: (GPL-2.0 OR BSD-2-Clause)
%YAML 1.2
---
$id: http://devicetree.org/schemas/iio/temperature/maxim,max31855k.yaml#
$schema: http://devicetree.org/meta-schemas/core.yaml#

title: Maxim MAX31855 and similar thermocouples

/* bench 29683.0.0 7b6233ff1f0e */
/* bench 29683.0.1 ee7d23e24a7a */
/* bench 29683.0.2 e1cb7dd3419e */
/* bench 29683.0.3 709eb429e222 */
/* bench 29683.0.4 2c1a80ac19d6 */
/* bench 29683.0.5 8fac5f5a13d3 */
/* bench 29683.0.6 2a03dcb4fd22 */
description: |
  https://datasheets.maximintegrated.com/en/ds/MAX6675.pdf
  https://datasheets.maximintegrated.com/en/ds/MAX31855.pdf

properties:
  compatible:
    description:
      The generic maxim,max31855 compatible is deprecated in favour of
      the thermocouple type specific variants.
    enum:
      - maxim,max6675
      - maxim,max31855
      - maxim,max31855k
      - maxim,max31855j
      - maxim,max31855n
      - maxim,max31855s
      - maxim,max31855t
      - maxim,max31855e
      - maxim,max31855r

  reg:
    maxItems: 1

  spi-max-frequency: true
  spi-cpha: true

required:
  - compatible
  - reg

allOf:
  - if:
      properties:
        compatible:
          contains:
            enum:
              - maxim,max6675
    then:
      required:
        - spi-cpha
    else:
      properties:
        spi-cpha: false

additionalProperties: false

examples:
  - |
    spi {
        #address-cells = <1>;
        #size-cells = <0>;

        temp-sensor@0 {
            compatible = "maxim,max31855k";
            reg = <0>;
            spi-max-frequency = <4300000>;
        };
        temp-sensor@1 {
            compatible = "maxim,max6675";
            reg = <1>;
            spi-max-frequency = <4300000>;
            spi-cpha;
        };
    };
...
```
