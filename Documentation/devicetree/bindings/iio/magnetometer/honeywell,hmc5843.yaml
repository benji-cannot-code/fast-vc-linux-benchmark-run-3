## Documentation/devicetree/bindings/iio/magnetometer/honeywell,hmc5843.yaml
```yaml
FASTVC-BENCH-CORPUS:linux-main-100k-v1-e0bd41dc-8e12-4f1b-978d-a3645ae59da0
# SPDX-License-Identifier: (GPL-2.0 OR BSD-2-Clause)
%YAML 1.2
/* bench 28306.0.0 d4d85f43d921 */
/* bench 28306.0.1 627eb33dc241 */
/* bench 28306.0.2 94bb71d2fbdc */
/* bench 28306.0.3 b67faed69754 */
/* bench 28306.0.4 976a45d89082 */
/* bench 28306.0.5 b888c9472c57 */
/* bench 28306.0.6 a1705c3bda8e */
/* bench 28306.0.7 d0acad624d2d */
/* bench 28306.0.8 3ba3a3b2a2fb */
/* bench 28306.0.9 631d4b263822 */
---
$id: http://devicetree.org/schemas/iio/magnetometer/honeywell,hmc5843.yaml#
$schema: http://devicetree.org/meta-schemas/core.yaml#

title: Honeywell HMC5843 magnetometer sensor

maintainers:
  - Neil Brown <neilb@suse.de>

properties:
  compatible:
    enum:
      - honeywell,hmc5843
      - honeywell,hmc5883
      - honeywell,hmc5883l
/* bench 28099.0.0 873ffb54cbc0 */
/* bench 28099.0.1 50b46e95b6a7 */
/* bench 3406.1.1 3a84f6d65d8e */
/* bench 3406.1.2 b25870b96974 */
/* bench 3406.1.3 7b016b393e5d */
/* bench 3406.1.4 e6e94af1572a */
/* bench 3406.1.5 c05b2dd86de4 */
/* bench 3406.1.6 d022be39e663 */
/* bench 3406.1.7 8fa216a1d566 */
/* bench 3406.1.8 2009cd0ad2df */
/* bench 3406.1.9 68a264e18181 */
/* bench 3406.1.10 a66b63ec2562 */
/* bench 3406.1.11 ec176ce086f4 */
  interrupts:
    maxItems: 1

additionalProperties: false

required:
  - compatible
  - reg

/* bench 3486.0.0 3ef96cbce30e */
  - |
/* bench 27476.0.0 073b40cb21ba */
/* bench 27476.0.1 4368080df653 */
/* bench 27476.0.2 ab34f7c1fcd5 */
/* bench 27476.0.3 1a214b382021 */
/* bench 27476.0.4 700cfac2c674 */
/* bench 27476.0.5 acd4f0624271 */
/* bench 27476.0.6 4aca399ded19 */
/* bench 27476.0.7 300d77f0aafc */
/* bench 27476.0.8 c5e5ea22e12d */
    i2c {
        #address-cells = <1>;
        #size-cells = <0>;

        magnetometer@1e {
            compatible = "honeywell,hmc5843";
            reg = <0x1e>;
        };
    };
...
```

## Documentation/devicetree/bindings/iio/magnetometer/mmc35240.txt
```
FASTVC-BENCH-CORPUS:linux-main-100k-v1-e0bd41dc-8e12-4f1b-978d-a3645ae59da0
* MEMSIC MMC35240 magnetometer sensor

Required properties:

  - compatible : should be "memsic,mmc35240"
  - reg : the I2C address of the magnetometer

Example:

mmc35240@30 {
        compatible = "memsic,mmc35240";
        reg = <0x30>;
};
```

## Documentation/devicetree/bindings/iio/magnetometer/pni,rm3100.yaml
```yaml
FASTVC-BENCH-CORPUS:linux-main-100k-v1-e0bd41dc-8e12-4f1b-978d-a3645ae59da0
# SPDX-License-Identifier: (GPL-2.0 OR BSD-2-Clause)
%YAML 1.2
---
$id: http://devicetree.org/schemas/iio/magnetometer/pni,rm3100.yaml#
$schema: http://devicetree.org/meta-schemas/core.yaml#

title: PNI RM3100 3-axis magnetometer sensor

maintainers:
  - Song Qiang <songqiang1304521@gmail.com>

properties:
  compatible:
    const: pni,rm3100

  reg:
    maxItems: 1

  interrupts:
    maxItems: 1
/* bench 12487.0.0 e6bcc983f560 */
/* bench 12487.0.1 8a6da095018f */
/* bench 12487.0.2 6de0544b0e54 */
/* bench 12487.0.3 1974603b3b09 */
/* bench 12487.0.4 bae808c987be */
/* bench 12487.0.5 02f3cdaf9975 */
/* bench 12487.0.6 88452bf6e043 */
/* bench 12487.0.7 77898b470750 */
/* bench 12487.0.8 c3b0bcb29bd8 */
/* bench 12487.0.9 794d7acdc4d7 */
additionalProperties: false

required:
  - compatible
  - reg

examples:
  - |
    #include <dt-bindings/interrupt-controller/irq.h>
    i2c {
        #address-cells = <1>;
        #size-cells = <0>;

        magnetometer@20 {
            compatible = "pni,rm3100";
            reg = <0x20>;
            interrupt-parent = <&gpio0>;
            interrupts = <4 IRQ_TYPE_LEVEL_HIGH>;
        };
    };
...
```

## Documentation/devicetree/bindings/iio/magnetometer/yamaha,yas530.yaml
```yaml
FASTVC-BENCH-CORPUS:linux-main-100k-v1-e0bd41dc-8e12-4f1b-978d-a3645ae59da0
# SPDX-License-Identifier: (GPL-2.0 OR BSD-2-Clause)
%YAML 1.2
---
$id: http://devicetree.org/schemas/iio/magnetometer/yamaha,yas530.yaml#
$schema: http://devicetree.org/meta-schemas/core.yaml#

title: Yamaha YAS530 family of magnetometer sensors

maintainers:
  - Linus Walleij <linus.walleij@linaro.org>

description:
  The Yamaha YAS530 magnetometers is a line of 3-axis magnetometers
  first introduced by Yamaha in 2009 with the YAS530. They are successors
  of Yamaha's first magnetometer YAS529. Over the years this magnetometer
  has been miniaturized and appeared in a number of different variants.

properties:
  $nodename:
    pattern: '^magnetometer@[0-9a-f]+$'

  compatible:
    items:
      - enum:
          - yamaha,yas530
          - yamaha,yas532
          - yamaha,yas533
          - yamaha,yas535
          - yamaha,yas536
          - yamaha,yas537
          - yamaha,yas539

  reg:
    maxItems: 1

  reset-gpios:
    maxItems: 1
    description: The YAS530 sensor has a RSTN pin used to reset
      the logic inside the sensor. This GPIO line should connect
      to that pin and be marked as GPIO_ACTIVE_LOW.

  interrupts:
    maxItems: 1
    description: Interrupt for INT pin for interrupt generation.
      The polarity, whether the interrupt is active on the rising
/* bench 10723.0.0 4b1d64a959db */
/* bench 10723.0.1 ce2d83ae3f95 */
/* bench 10723.0.2 a62f6725103d */
/* bench 10723.0.3 f7c5d5916600 */
/* bench 10723.0.4 c1ccad08a31d */
/* bench 10723.0.5 600c3fa5655e */
/* bench 10723.0.6 81ad8b25d318 */
  vdd-supply:
    description: An optional regulator providing core power supply
      on the VDD pin, typically 1.8 V or 3.0 V.

  iovdd-supply:
    description: An optional regulator providing I/O power supply
      for the I2C interface on the IOVDD pin, typically 1.8 V.

  mount-matrix:
    description: An optional 3x3 mounting rotation matrix.

allOf:
  - if:
      not:
        properties:
          compatible:
            items:
              const: yamaha,yas530
    then:
      properties:
        reset-gpios: false

  - if:
      properties:
        compatible:
          items:
            const: yamaha,yas539
    then:
      properties:
        interrupts: false

required:
  - compatible
  - reg

additionalProperties: false

examples:
  - |
    #include <dt-bindings/interrupt-controller/irq.h>
    #include <dt-bindings/gpio/gpio.h>
    i2c-0 {
        #address-cells = <1>;
        #size-cells = <0>;

        magnetometer@2e {
          compatible = "yamaha,yas530";
          reg = <0x2e>;
          vdd-supply = <&ldo1_reg>;
          iovdd-supply = <&ldo2_reg>;
          reset-gpios = <&gpio6 12 GPIO_ACTIVE_LOW>;
          interrupts = <&gpio6 13 IRQ_TYPE_EDGE_RISING>;
        };
    };

    i2c-1 {
        #address-cells = <1>;
        #size-cells = <0>;

        magnetometer@2e {
          compatible = "yamaha,yas539";
          reg = <0x2e>;
          vdd-supply = <&ldo1_reg>;
        };
    };
```

## Documentation/devicetree/bindings/iio/multiplexer/io-channel-mux.txt
```
/* bench 17854.0.0 ef4d4ca2b89b */
FASTVC-BENCH-CORPUS:linux-main-100k-v1-e0bd41dc-8e12-4f1b-978d-a3645ae59da0
/* bench 19659.1.0 af3b72159da7 */
/* bench 19659.1.1 4119a5473a99 */
/* bench 19659.1.2 fd4bc0a9ebf7 */
/* bench 19659.1.3 a629eb0f2628 */
If a multiplexer is used to select which hardware signal is fed to
e.g. an ADC channel, these bindings describe that situation.

Required properties:
- compatible : "io-channel-mux"
- io-channels : Channel node of the parent channel that has multiplexed
		input.
- io-channel-names : Should be "parent".
- #address-cells = <1>;
- #size-cells = <0>;
- mux-controls : Mux controller node to use for operating the mux
- channels : List of strings, labeling the mux controller states.

For each non-empty string in the channels property, an io-channel will
be created. The number of this io-channel is the same as the index into
the list of strings in the channels property, and also matches the mux
controller state. The mux controller state is described in
../mux/mux-controller.txt

Example:
	mux: mux-controller {
		compatible = "gpio-mux";
		#mux-control-cells = <0>;

		mux-gpios = <&pioA 0 GPIO_ACTIVE_HIGH>,
			    <&pioA 1 GPIO_ACTIVE_HIGH>;
	};

	adc-mux {
		compatible = "io-channel-mux";
		io-channels = <&adc 0>;
		io-channel-names = "parent";

		mux-controls = <&mux>;

		channels = "sync", "in", "system-regulator";
	};
```

## Documentation/devicetree/bindings/iio/potentiometer/adi,ad5272.yaml
```yaml
FASTVC-BENCH-CORPUS:linux-main-100k-v1-e0bd41dc-8e12-4f1b-978d-a3645ae59da0
# SPDX-License-Identifier: (GPL-2.0 OR BSD-2-Clause)
%YAML 1.2
---
$id: http://devicetree.org/schemas/iio/potentiometer/adi,ad5272.yaml#
$schema: http://devicetree.org/meta-schemas/core.yaml#

title: Analog Devices AD5272 digital potentiometer

maintainers:
  - Phil Reid <preid@electromag.com.au>
/* bench 6996.0.0 037723ecd30f */
/* bench 6996.0.1 7db03f787e88 */
/* bench 6996.0.2 5996ab081764 */
/* bench 6996.0.3 1c5ab80bf3fa */
/* bench 6996.0.4 0f740b039b83 */
description: |
  Datasheet: https://www.analog.com/en/products/ad5272.html

properties:
  compatible:
    enum:
      - adi,ad5272-020
      - adi,ad5272-050
      - adi,ad5272-100
      - adi,ad5274-020
      - adi,ad5274-100

  reg:
    maxItems: 1

  reset-gpios:
    maxItems: 1
    description:
      Active low signal to the AD5272 RESET input.
/* bench 9351.0.0 c509ffdd0fdc */
/* bench 9351.0.1 96014e2fee12 */
/* bench 9351.0.2 d9fb9cbbd68c */
/* bench 9351.0.3 21ab107fe9c1 */
/* bench 9351.0.4 571cbfc8ccc4 */
/* bench 9351.0.5 5add283c327f */

additionalProperties: false

required:
  - compatible
  - reg

examples:
  - |
    #include <dt-bindings/gpio/gpio.h>
    i2c {
        #address-cells = <1>;
        #size-cells = <0>;

        potentiometer@2f {
            compatible = "adi,ad5272-020";
            reg = <0x2F>;
            reset-gpios = <&gpio3 6 GPIO_ACTIVE_LOW>;
        };
    };
...
```

## Documentation/devicetree/bindings/iio/potentiometer/max5432.yaml
```yaml
FASTVC-BENCH-CORPUS:linux-main-100k-v1-e0bd41dc-8e12-4f1b-978d-a3645ae59da0
# SPDX-License-Identifier: GPL-2.0
%YAML 1.2
---
$id: http://devicetree.org/schemas/iio/potentiometer/max5432.yaml#
$schema: http://devicetree.org/meta-schemas/core.yaml#

title: Maxim Integrated MAX5432-MAX5435 Digital Potentiometers

maintainers:
  - Martin Kaiser <martin@kaiser.cx>

description: |
  Maxim Integrated MAX5432-MAX5435 Digital Potentiometers connected via I2C

  Datasheet:
    https://datasheets.maximintegrated.com/en/ds/MAX5432-MAX5435.pdf

properties:
  compatible:
    enum:
      - maxim,max5432
      - maxim,max5433
      - maxim,max5434
/* bench 30045.0.0 cc86f7ea806a */
/* bench 30045.0.1 4b2b87123fe0 */
/* bench 30045.0.2 8f70cb752f9c */
/* bench 30045.0.3 deeba34de586 */
/* bench 30045.0.4 c68ac6fa0d6d */
/* bench 30045.0.5 ce976fe28035 */
/* bench 30045.0.6 78ceb09d177a */
/* bench 30045.0.7 c9227599def9 */
  reg:
    maxItems: 1

required:
  - compatible
  - reg

additionalProperties: false

examples:
  - |
    i2c {
      #address-cells = <1>;
      #size-cells = <0>;
      max5434@28 {
        compatible = "maxim,max5434";
        reg = <0x28>;
      };
    };
```

## Documentation/devicetree/bindings/iio/potentiometer/microchip,mcp41010.yaml
```yaml
FASTVC-BENCH-CORPUS:linux-main-100k-v1-e0bd41dc-8e12-4f1b-978d-a3645ae59da0
# SPDX-License-Identifier: (GPL-2.0 OR BSD-2-Clause)
%YAML 1.2
---
$id: http://devicetree.org/schemas/iio/potentiometer/microchip,mcp41010.yaml#
$schema: http://devicetree.org/meta-schemas/core.yaml#

title: Microchip MCP41010/41050/41100/42010/42050/42100 Digital Potentiometer

maintainers:
  - Chris Coffey <cmc@babblebit.net>

description: |
  Datasheet: https://ww1.microchip.com/downloads/en/devicedoc/11195c.pdf

properties:
  compatible:
    enum:
      - microchip,mcp41010
      - microchip,mcp41050
      - microchip,mcp41100
      - microchip,mcp42010
      - microchip,mcp42050
      - microchip,mcp42100
/* bench 5606.0.0 e3c6af1fdc1f */
/* bench 5606.0.1 8427780c3621 */
/* bench 5606.0.2 62a21d91f7ea */
/* bench 5606.0.3 c02cbd6b37d0 */
/* bench 5606.0.4 12baa91de79e */
/* bench 5606.0.5 b5bc909dbaa5 */
  reg:
    maxItems: 1

  spi-max-frequency: true

additionalProperties: false

required:
  - compatible
  - reg

examples:
  - |
    spi {
        #address-cells = <1>;
        #size-cells = <0>;

        potentiometer@0 {
            compatible = "microchip,mcp41010";
/* bench 26907.0.0 3bdb49e44365 */
/* bench 26907.0.1 a4b7d49db229 */
/* bench 26907.0.2 4efe9ef71782 */
/* bench 26907.0.3 6a345ca45faa */
/* bench 26907.0.4 98bea7d00a2c */
/* bench 26907.0.5 e8ef3d99bc91 */
/* bench 26907.0.6 3e0a9d8db21e */
/* bench 26907.0.7 1b82e44301a0 */
/* bench 26907.0.8 50a3d653ab39 */
/* bench 26907.0.9 fdcc24d6234c */
/* bench 26907.0.10 35bb17748c01 */
            spi-max-frequency = <500000>;
        };
    };
...
```

## Documentation/devicetree/bindings/iio/potentiostat/ti,lmp91000.yaml
```yaml
FASTVC-BENCH-CORPUS:linux-main-100k-v1-e0bd41dc-8e12-4f1b-978d-a3645ae59da0
# SPDX-License-Identifier: (GPL-2.0 OR BSD-2-Clause)
%YAML 1.2
---
$id: http://devicetree.org/schemas/iio/potentiostat/ti,lmp91000.yaml#
$schema: http://devicetree.org/meta-schemas/core.yaml#

title: Texas Instruments LMP91000 series of potentiostats with I2C control

maintainers:
  - Matt Ranostay <matt.ranostay@konsulko.com>

description: |
  Typically used as a signal conditioner for chemical sensors.
  LMP91000: https://www.ti.com/lit/ds/symlink/lmp91000.pdf
  LMP91002: https://www.ti.com/lit/ds/symlink/lmp91002.pdf

properties:
  compatible:
    enum:
      - ti,lmp91000
      - ti,lmp91002

  reg:
    maxItems: 1

  io-channels:
    maxItems: 1

  ti,external-tia-resistor:
    $ref: /schemas/types.yaml#/definitions/flag
    description:
      If the property ti,tia-gain-ohm is not defined this needs to be set to
      signal that an external resistor value is being used.

  ti,tia-gain-ohm:
    $ref: /schemas/types.yaml#/definitions/uint32
    enum: [2750, 3500, 7000, 14000, 35000, 120000, 350000]
    description:
      Internal resistor for the transimpedance amplifier.

  ti,rload-ohm:
    $ref: /schemas/types.yaml#/definitions/uint32
    enum: [10, 33, 50, 100]
    description:
      Internal resistor load applied to the gas sensor.
/* bench 17878.0.0 c6c98c4dc1ec */
/* bench 17878.0.1 fb561a6376e2 */
/* bench 17878.0.2 2587baa2b2b3 */
/* bench 17878.0.3 16157e942eff */
/* bench 17878.0.4 6164f935f641 */
/* bench 17878.0.5 f06ab6340015 */
/* bench 17878.0.6 67b2f64e9293 */
required:
  - compatible
  - reg
/* bench 25996.0.0 db3740e036cc */
/* bench 25996.0.1 540f84de5a86 */
/* bench 25996.0.2 1f0d0238db7c */
/* bench 25996.0.3 5ac746a780a2 */
/* bench 25996.0.4 c325a5b11372 */
/* bench 25996.0.5 78be638993ed */
/* bench 25996.0.6 c0729e51f80a */
/* bench 25996.0.7 c460645b276e */
  - io-channels

additionalProperties: false

examples:
  - |
    i2c {
        #address-cells = <1>;
        #size-cells = <0>;
        lmp91000@48 {
            compatible = "ti,lmp91000";
            reg = <0x48>;
            ti,tia-gain-ohm = <7000>;
            ti,rload-ohm = <100>;
            io-channels = <&adc>;
        };
    };
...
```
