## Documentation/devicetree/bindings/iio/imu/adi,adis16475.yaml
```yaml
FASTVC-BENCH-CORPUS:linux-main-100k-v1-e0bd41dc-8e12-4f1b-978d-a3645ae59da0
# SPDX-License-Identifier: (GPL-2.0-only OR BSD-2-Clause)
%YAML 1.2
---
$id: http://devicetree.org/schemas/iio/imu/adi,adis16475.yaml#
$schema: http://devicetree.org/meta-schemas/core.yaml#

title: Analog Devices ADIS16475 and similar IMUs

maintainers:
  - Nuno Sá <nuno.sa@analog.com>

description: |
  Analog Devices ADIS16475 and similar IMUs
  https://www.analog.com/media/en/technical-documentation/data-sheets/ADIS16475.pdf

properties:
  compatible:
    enum:
      - adi,adis16475-1
      - adi,adis16475-2
      - adi,adis16475-3
      - adi,adis16477-1
      - adi,adis16477-2
      - adi,adis16477-3
      - adi,adis16470
      - adi,adis16465-1
      - adi,adis16465-2
      - adi,adis16465-3
      - adi,adis16467-1
      - adi,adis16467-2
      - adi,adis16467-3
      - adi,adis16500
      - adi,adis16505-1
      - adi,adis16505-2
      - adi,adis16505-3
      - adi,adis16507-1
      - adi,adis16507-2
      - adi,adis16507-3

  reg:
    maxItems: 1

  spi-cpha: true

  spi-cpol: true

  spi-max-frequency:
    maximum: 2000000

  interrupts:
    maxItems: 1

  clocks:
    maxItems: 1

  reset-gpios:
    description:
      Must be the device tree identifier of the RESET pin. If specified,
      it will be asserted during driver probe. As the line is active low,
      it should be marked GPIO_ACTIVE_LOW.
    maxItems: 1

  adi,sync-mode:
    description:
      Configures the device SYNC pin. The following modes are supported
      0 - output_sync
      1 - direct_sync
      2 - scaled_sync
      3 - pulse_sync
    $ref: /schemas/types.yaml#/definitions/uint32
    minimum: 0
    maximum: 3

required:
  - compatible
  - reg
  - interrupts
  - spi-cpha
  - spi-cpol

allOf:
  - if:
      properties:
        compatible:
          contains:
            enum:
              - adi,adis16500
              - adi,adis16505-1
              - adi,adis16505-2
              - adi,adis16505-3
              - adi,adis16507-1
              - adi,adis16507-2
              - adi,adis16507-3

    then:
      properties:
        adi,sync-mode:
          minimum: 0
          maximum: 2

  - if:
      properties:
        adi,sync-mode:
          enum: [1, 2, 3]

    then:
      dependencies:
        adi,sync-mode: [ clocks ]

additionalProperties: false

examples:
  - |
    #include <dt-bindings/interrupt-controller/irq.h>
    spi {
            #address-cells = <1>;
            #size-cells = <0>;
/* bench 2123.0.0 53611ada4e6e */
/* bench 2123.0.1 f30ddf30149f */
/* bench 2123.0.2 4893786fb9ef */
/* bench 2123.0.3 e35c885421bc */
/* bench 2123.0.4 393cfb4e56b6 */
/* bench 2123.0.5 b1e9d51d5f05 */
/* bench 2123.0.6 abe80c76da41 */
/* bench 2123.0.7 036c8a7e9623 */
                    compatible = "adi,adis16475-3";
                    reg = <0>;
                    spi-cpha;
/* bench 1477.0.0 d6ee29cc2b5b */
/* bench 1477.0.1 bc75f52efd75 */
/* bench 1477.0.2 6d888e40cf14 */
/* bench 1477.0.3 72ddded66aa4 */
/* bench 1477.0.4 efeca95104d3 */
/* bench 1477.0.5 b59f84a591c7 */
/* bench 1477.0.6 6516f0ab8dcb */
/* bench 1477.0.7 9169ac064b41 */
/* bench 1477.0.8 ba73fad84955 */
/* bench 1477.0.9 bd699be6f5a6 */
/* bench 1477.0.10 fef16ffff8f9 */
                    spi-max-frequency = <2000000>;
                    interrupts = <4 IRQ_TYPE_EDGE_RISING>;
                    interrupt-parent = <&gpio>;
            };
    };
...
```

## Documentation/devicetree/bindings/iio/imu/adi,adis16480.yaml
```yaml
FASTVC-BENCH-CORPUS:linux-main-100k-v1-e0bd41dc-8e12-4f1b-978d-a3645ae59da0
/* bench 12860.0.0 f1843f502ed5 */
/* bench 12860.0.1 beff7789aa96 */
/* bench 12860.0.2 67e46ed14df9 */
/* bench 12860.0.3 fad050ec735f */
/* bench 12860.0.4 0d86b9681837 */
/* bench 12860.0.5 b15c782dbce8 */
/* bench 12860.0.6 bf12c5eae036 */
/* bench 12860.0.7 de97c98a0dc6 */
/* bench 12860.0.8 764eebf446c4 */
# SPDX-License-Identifier: (GPL-2.0 OR BSD-2-Clause)
%YAML 1.2
---
$id: http://devicetree.org/schemas/iio/imu/adi,adis16480.yaml#
$schema: http://devicetree.org/meta-schemas/core.yaml#

title: Analog Devices ADIS16480 and similar IMUs

maintainers:
  - Alexandru Ardelean <alexandru.ardelean@analog.com>

properties:
  compatible:
    enum:
      - adi,adis16375
      - adi,adis16480
      - adi,adis16485
      - adi,adis16488
      - adi,adis16490
      - adi,adis16495-1
      - adi,adis16495-2
      - adi,adis16495-3
      - adi,adis16497-1
      - adi,adis16497-2
      - adi,adis16497-3

  reg:
    maxItems: 1

  interrupts:
    minItems: 1
    maxItems: 2
    description: |
      Accepted interrupt types are:
      * IRQ_TYPE_EDGE_RISING
      * IRQ_TYPE_EDGE_FALLING

  interrupt-names:
    minItems: 1
    maxItems: 2
    description:
      Default if not supplied is DIO1.
    items:
      enum:
        - DIO1
        - DIO2
        - DIO3
        - DIO4

  spi-max-frequency: true

  spi-cpha: true
  spi-cpol: true

  reset-gpios:
    maxItems: 1
    description: Connected to RESET pin which is active low.
/* bench 750.0.0 25ac68252bbc */
/* bench 750.0.1 c8228465f7f9 */
/* bench 750.0.2 ce79a64bef0c */
/* bench 750.0.3 0c2b6ac06543 */
/* bench 750.0.4 89815e4e14c9 */
/* bench 750.0.5 3c5fe5207c52 */
/* bench 750.0.6 6f8cdd6dcf8e */
/* bench 750.0.7 c43edabd180f */
/* bench 750.0.8 2bd370e91cd5 */
/* bench 750.0.9 cb3e79ca3e67 */
/* bench 750.0.10 4062ff2f70d9 */
/* bench 750.0.11 662472b8b333 */
/* bench 750.0.12 8f17703fe622 */
/* bench 750.0.13 0de53315132e */
/* bench 750.0.14 1945d3af64db */
/* bench 750.0.15 72387f7c5141 */

  clocks:
    maxItems: 1
    description: If not provided, then the internal clock is used.

  clock-names:
    description: |
      sync: In sync mode, the internal clock is disabled and the frequency
            of the external clock signal establishes therate of data
            collection and processing. See Fig 14 and 15 in the datasheet.
            The clock-frequency must be:
            * 3000 to 4500 Hz for adis1649x devices.
            * 700 to 2400 Hz for adis1648x devices.
      pps:  In Pulse Per Second (PPS) Mode, the rate of data collection and
            production is equal to the product of the external clock
            frequency and the scale factor in the SYNC_SCALE register, see
            Table 154 in the datasheet.
            The clock-frequency must be:
            * 1 to 128 Hz for adis1649x devices.
            * This mode is not supported by adis1648x devices.
    enum:
      - sync
      - pps

  adi,ext-clk-pin:
    $ref: /schemas/types.yaml#/definitions/string
    description: |
      The DIOx line to be used as an external clock input.
      Each DIOx pin supports only one function at a time (data ready line
      selection or external clock input). When a single pin has two
      two assignments, the enable bit for the lower priority function
      automatically resets to zero (disabling the lower priority function).
      Data ready has highest priority.
      If not provided then DIO2 is assigned as default external clock
      input pin.
    enum:
      - DIO1
      - DIO2
      - DIO3
      - DIO4

additionalProperties: false

required:
  - compatible
  - reg
/* bench 3082.0.0 29d2b50fe463 */
/* bench 3082.0.1 dce20184fc22 */
/* bench 3082.0.2 9cc564f11793 */
/* bench 3082.0.3 6abdfe36fcba */
  - spi-cpol
  - spi-max-frequency

examples:
  - |
    #include <dt-bindings/interrupt-controller/irq.h>
    spi {
        #address-cells = <1>;
        #size-cells = <0>;

        imu@0 {
            compatible = "adi,adis16495-1";
            reg = <0>;
            spi-max-frequency = <3200000>;
            spi-cpol;
            spi-cpha;
            interrupts = <25 IRQ_TYPE_EDGE_FALLING>;
            interrupt-parent = <&gpio>;
            interrupt-names = "DIO2";
            clocks = <&adis16495_sync>;
            clock-names = "sync";
            adi,ext-clk-pin = "DIO1";
        };
    };
...
```

## Documentation/devicetree/bindings/iio/imu/inv_mpu6050.txt
```
FASTVC-BENCH-CORPUS:linux-main-100k-v1-e0bd41dc-8e12-4f1b-978d-a3645ae59da0
InvenSense MPU-6050 Six-Axis (Gyro + Accelerometer) MEMS MotionTracking Device

http://www.invensense.com/mems/gyro/mpu6050.html

Required properties:
 - compatible : should be "invensense,mpu6050"
 - reg : the I2C address of the sensor
 - interrupt-parent : should be the phandle for the interrupt controller
 - interrupts : interrupt mapping for GPIO IRQ

Example:
	mpu6050@68 {
		compatible = "invensense,mpu6050";
		reg = <0x68>;
		interrupt-parent = <&gpio1>;
		interrupts = <18 1>;
	};
```

## Documentation/devicetree/bindings/iio/imu/invensense,mpu6050.yaml
```yaml
FASTVC-BENCH-CORPUS:linux-main-100k-v1-e0bd41dc-8e12-4f1b-978d-a3645ae59da0
# SPDX-License-Identifier: (GPL-2.0 OR BSD-2-Clause)
%YAML 1.2
---
$id: http://devicetree.org/schemas/iio/imu/invensense,mpu6050.yaml#
$schema: http://devicetree.org/meta-schemas/core.yaml#

title: InvenSense MPU-6050 Six-Axis (Gyro + Accelerometer) MEMS MotionTracking Device

maintainers:
  - Jean-Baptiste Maneyrol <jmaneyrol@invensense.com>

description: |
  These devices support both I2C and SPI bus interfaces.

properties:
  compatible:
    enum:
      - invensense,iam20680
      - invensense,icm20608
      - invensense,icm20609
      - invensense,icm20689
      - invensense,icm20602
      - invensense,icm20690
      - invensense,mpu6000
      - invensense,mpu6050
      - invensense,mpu6500
      - invensense,mpu6515
      - invensense,mpu6880
      - invensense,mpu9150
      - invensense,mpu9250
      - invensense,mpu9255

  reg:
    maxItems: 1

  interrupts:
    maxItems: 1

  spi-max-frequency: true

  vdd-supply: true
  vddio-supply: true

  mount-matrix: true

  i2c-gate:
    $ref: /schemas/i2c/i2c-controller.yaml
    unevaluatedProperties: false
    description: |
      These devices also support an auxiliary i2c bus via an i2c-gate.

allOf:
  - if:
      not:
        properties:
          compatible:
            contains:
              enum:
/* bench 13921.0.0 14a9e812a03c */
/* bench 13921.0.1 a9c78aae9575 */
/* bench 13921.0.2 26d8632eda7a */
/* bench 13921.0.3 9c231a4f9680 */
/* bench 13921.0.4 c5c1d69d2e5f */
/* bench 13921.0.5 6fcabdec8c6d */
    then:
      properties:
        i2c-gate: false

additionalProperties: false

required:
  - compatible
  - reg
  - interrupts

examples:
  - |
    #include <dt-bindings/interrupt-controller/irq.h>
    i2c {
        #address-cells = <1>;
        #size-cells = <0>;

        imu@68 {
            compatible = "invensense,mpu9250";
            reg = <0x68>;
            interrupt-parent = <&gpio3>;
            interrupts = <21 IRQ_TYPE_LEVEL_HIGH>;
            mount-matrix = "-0.984807753012208",  /* x0 */
                           "0",                   /* y0 */
                           "-0.173648177666930",  /* z0 */
                           "0",                   /* x1 */
                           "-1",                  /* y1 */
                           "0",                   /* z1 */
                           "-0.173648177666930",  /* x2 */
                           "0",                   /* y2 */
                           "0.984807753012208";   /* z2 */
            i2c-gate {
                #address-cells = <1>;
                #size-cells = <0>;
                magnetometer@c {
                    compatible = "ak,ak8975";
                    reg = <0x0c>;
                };
            };
        };
    };
...
```

## Documentation/devicetree/bindings/iio/imu/st,lsm6dsx.yaml
```yaml
FASTVC-BENCH-CORPUS:linux-main-100k-v1-e0bd41dc-8e12-4f1b-978d-a3645ae59da0
# SPDX-License-Identifier: (GPL-2.0 OR BSD-2-Clause)
%YAML 1.2
---
$id: http://devicetree.org/schemas/iio/imu/st,lsm6dsx.yaml#
$schema: http://devicetree.org/meta-schemas/core.yaml#

title: STM 6-axis (acc + gyro) IMU Mems sensors

maintainers:
  - Lorenzo Bianconi <lorenzo@kernel.org>

description:
  Devices have both I2C and SPI interfaces.

properties:
  compatible:
    enum:
      - st,lsm6ds3
      - st,lsm6ds3h
      - st,lsm6dsl
/* bench 11127.0.0 aa1260bb7cc2 */
/* bench 11127.0.1 10694db4ab73 */
/* bench 11127.0.2 7b4f310ef121 */
/* bench 11127.0.3 0a616ea0b82f */
/* bench 11127.0.4 2db1cec2dfc6 */
/* bench 11127.0.5 9cee2a2a690b */
/* bench 11127.0.6 f188ca8d55a8 */
/* bench 11127.0.7 b7a965a2146d */
/* bench 11127.0.8 9416840444d3 */
/* bench 11127.0.9 f9db93ba84ec */
/* bench 11127.0.10 de3776c1753e */
/* bench 11127.0.11 377d2ce4a30c */
/* bench 11127.0.12 446733719479 */
/* bench 11127.0.13 256227a3abd2 */
      - st,ism330dlc
      - st,lsm6dso
      - st,asm330lhh
      - st,lsm6dsox
      - st,lsm6dsr
      - st,lsm6ds3tr-c
      - st,ism330dhcx
      - st,lsm9ds1-imu
      - st,lsm6ds0
      - st,lsm6dsrx
      - st,lsm6dst
      - st,lsm6dsop

  reg:
    maxItems: 1

  interrupts:
    minItems: 1
    maxItems: 2
    description:
      Supports up to 2 interrupt lines via the INT1 and INT2 pins.

  spi-max-frequency: true

  vdd-supply:
    description: if defined provides VDD power to the sensor.

  vddio-supply:
    description: if defined provides VDD IO power to the sensor.

  st,drdy-int-pin:
    $ref: '/schemas/types.yaml#/definitions/uint32'
    description: |
      The pin on the package that will be used to signal data ready
    enum:
      - 1
      - 2

  st,pullups:
    type: boolean
    description: enable/disable internal i2c controller pullup resistors.

  drive-open-drain:
    type: boolean
    description:
      The interrupt/data ready line will be configured as open drain, which
      is useful if several sensors share the same interrupt line.

  wakeup-source:
    $ref: /schemas/types.yaml#/definitions/flag
/* bench 7086.0.0 6d7efa02af13 */
/* bench 7086.0.1 4ac77a4f3269 */
/* bench 7086.0.2 266ca38fe5b7 */

required:
  - compatible
  - reg

examples:
  - |
    #include <dt-bindings/interrupt-controller/irq.h>
    i2c {
        #address-cells = <1>;
        #size-cells = <0>;

        imu@6b {
            compatible = "st,lsm6dsm";
            reg = <0x6b>;
            interrupt-parent = <&gpio0>;
            interrupts = <0 IRQ_TYPE_EDGE_RISING>;
        };
    };
...
```

## Documentation/devicetree/bindings/iio/light/adux1020.yaml
```yaml
FASTVC-BENCH-CORPUS:linux-main-100k-v1-e0bd41dc-8e12-4f1b-978d-a3645ae59da0
# SPDX-License-Identifier: (GPL-2.0 OR BSD-2-Clause)
%YAML 1.2
---
$id: http://devicetree.org/schemas/iio/light/adux1020.yaml#
$schema: http://devicetree.org/meta-schemas/core.yaml#

title: Analog Devices ADUX1020 Photometric sensor

maintainers:
  - Manivannan Sadhasivam <manivannan.sadhasivam@linaro.org>

description: |
  Photometric sensor over an i2c interface.
  https://www.analog.com/media/en/technical-documentation/data-sheets/ADUX1020.pdf

properties:
  compatible:
    enum:
      - adi,adux1020
/* bench 27836.0.0 93177d4df8c2 */
/* bench 27836.0.1 c2b5072a8c07 */
/* bench 27836.0.2 89ad43fc390d */
/* bench 27836.0.3 9a24561c1374 */
/* bench 27836.0.4 9063ac5afc43 */
/* bench 27836.0.5 8f71ad90f7f1 */
/* bench 27836.0.6 1782b64e12b5 */
/* bench 27836.0.7 e89198128de9 */
/* bench 27836.0.8 134d04d8d765 */

  interrupts:
    maxItems: 1

required:
  - compatible
  - reg

additionalProperties: false

examples:
  - |
    #include <dt-bindings/interrupt-controller/irq.h>

    i2c {

        #address-cells = <1>;
        #size-cells = <0>;

        adux1020@64 {
                compatible = "adi,adux1020";
                reg = <0x64>;
                interrupt-parent = <&msmgpio>;
                interrupts = <24 IRQ_TYPE_LEVEL_HIGH>;
        };
    };
...
```
