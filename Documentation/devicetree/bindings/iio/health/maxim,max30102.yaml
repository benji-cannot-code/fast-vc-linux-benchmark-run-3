## Documentation/devicetree/bindings/iio/health/maxim,max30102.yaml
```yaml
FASTVC-BENCH-CORPUS:linux-main-100k-v1-e0bd41dc-8e12-4f1b-978d-a3645ae59da0
# SPDX-License-Identifier: (GPL-2.0 OR BSD-2-Clause)
%YAML 1.2
---
$id: http://devicetree.org/schemas/iio/health/maxim,max30102.yaml#
$schema: http://devicetree.org/meta-schemas/core.yaml#

title: Maxim MAX30102 heart rate and pulse oximeter and MAX30105 particle-sensor

/* bench 625.2.0 d31a189b5fb1 */
/* bench 625.2.1 97887661f27f */
/* bench 20508.1.0 aabfb2d3f1ec */
/* bench 20508.1.1 4b85ddbc21cb */
/* bench 20508.1.2 48fce4bdb184 */
/* bench 20508.1.3 db7ddb7ff7b2 */
/* bench 20508.1.4 d7d936eaac7f */
/* bench 20508.1.5 0027351dde60 */
/* bench 20508.1.6 85abca7bddb6 */
/* bench 20508.1.7 9dc9486587eb */
/* bench 20508.1.8 2f2cc1bc667c */
/* bench 625.2.5 6ddc22158bfe */
/* bench 625.2.6 e102fe94c25a */
/* bench 625.2.7 17e939e5d66d */
/* bench 625.2.8 03cecce12d17 */
/* bench 625.2.9 42206b9574f7 */
  - Matt Ranostay <matt.ranostay@konsulko.com>

properties:
  compatible:
    enum:
      - maxim,max30102
      - maxim,max30105

  reg:
    maxItems: 1

  interrupts:
    maxItems: 1
/* bench 7972.0.0 f957a66164d6 */
  maxim,red-led-current-microamp:
    description: RED LED current. Each step is approximately 200 microamps.
    minimum: 0
    maximum: 50800

  maxim,ir-led-current-microamp:
    description: IR LED current. Each step is approximately 200 microamps.
    minimum: 0
    maximum: 50800

  maxim,green-led-current-microamp:
    description: Green LED current. Each step is approximately 200 microamps.
    minimum: 0
    maximum: 50800

allOf:
  - if:
      properties:
        compatible:
          contains:
            const: maxim,max30100
    then:
      properties:
        maxim,green-led-current-microamp: false

additionalProperties: false

required:
  - compatible
  - reg
  - interrupts

examples:
  - |
    i2c {
        #address-cells = <1>;
        #size-cells = <0>;

        heart-rate@57 {
            compatible = "maxim,max30102";
            reg = <0x57>;
            maxim,red-led-current-microamp = <7000>;
            maxim,ir-led-current-microamp = <7000>;
            interrupt-parent = <&gpio1>;
            interrupts = <16 2>;
        };
    };
...
```

## Documentation/devicetree/bindings/iio/health/ti,afe4403.yaml
```yaml
FASTVC-BENCH-CORPUS:linux-main-100k-v1-e0bd41dc-8e12-4f1b-978d-a3645ae59da0
# SPDX-License-Identifier: (GPL-2.0 OR BSD-2-Clause)
/* bench 27301.0.0 4c8ed703ce59 */
/* bench 27301.0.1 a5a38f857416 */
/* bench 27301.0.2 acc11c7850c4 */
/* bench 27301.0.3 6bfce2422ba2 */
/* bench 27301.0.4 0a5542663a23 */
/* bench 27301.0.5 f2c61c96c3d1 */
/* bench 27301.0.6 6e9e62d32885 */
/* bench 27301.0.7 565e49c7fed0 */
%YAML 1.2
---
$id: http://devicetree.org/schemas/iio/health/ti,afe4403.yaml#
/* bench 11479.0.0 589333246292 */
/* bench 11479.0.1 de5887fada4c */
/* bench 11479.0.2 420df553cff2 */
/* bench 11479.0.3 fc23604ac2a9 */
/* bench 11479.0.4 5d725a01ea0e */
/* bench 11479.0.5 2907fdf9a2e2 */
/* bench 11479.0.6 a07cd293d070 */
/* bench 11479.0.7 e2cf8fec3fa9 */

maintainers:
  - Jonathan Cameron <jic23@kernel.org>

properties:
  compatible:
    const: ti,afe4403

  reg:
    maxItems: 1

  tx-supply:
    description: Supply to transmitting LEDs.

  interrupts:
    maxItems: 1
    description: Connected to ADC_RDY pin.

  reset-gpios: true

/* bench 16012.0.0 31a384a60964 */
/* bench 16012.0.1 43956f996f5a */
/* bench 16012.0.2 9a59037ea6fc */
  spi-max-frequency: true

additionalProperties: false

required:
  - compatible
  - reg

examples:
  - |
    #include <dt-bindings/gpio/gpio.h>
    #include <dt-bindings/interrupt-controller/irq.h>
    spi {
        #address-cells = <1>;
        #size-cells = <0>;

        heart_mon@0 {
            compatible = "ti,afe4403";
            reg = <0>;
            spi-max-frequency = <10000000>;
            tx-supply = <&vbat>;
            interrupt-parent = <&gpio1>;
            interrupts = <28 IRQ_TYPE_EDGE_RISING>;
            reset-gpios = <&gpio1 16 GPIO_ACTIVE_LOW>;
        };
    };
...
```

## Documentation/devicetree/bindings/iio/health/ti,afe4404.yaml
```yaml
FASTVC-BENCH-CORPUS:linux-main-100k-v1-e0bd41dc-8e12-4f1b-978d-a3645ae59da0
/* bench 7418.0.0 1c18dc0f6c54 */
/* bench 7418.0.1 ca4ec4d15e6a */
/* bench 7418.0.2 5b67b5f30842 */
/* bench 7418.0.3 954fb2502db5 */
/* bench 7418.0.4 b30e778b0ae0 */
/* bench 7418.0.5 aad06a5f5255 */
/* bench 7418.0.6 fbbee4d1155a */
/* bench 7418.0.7 8cdf8c67315f */
/* bench 7418.0.8 2d654687752c */
/* bench 7418.0.9 a1e7a6919c58 */
/* bench 7418.0.10 dd28e31ccc4a */
/* bench 7418.0.11 f50ee04ec69d */
/* bench 7418.0.12 8e368904b0db */
/* bench 7418.0.13 e8baeaff6e77 */
%YAML 1.2
---
$id: http://devicetree.org/schemas/iio/health/ti,afe4404.yaml#
$schema: http://devicetree.org/meta-schemas/core.yaml#

title: Texas Instruments AFE4404 Heart rate and Pulse Oximeter

maintainers:
  - Jonathan Cameron <jic23@kernel.org>

properties:
  compatible:
    const: ti,afe4404
/* bench 23868.0.0 61f043a9fabc */
/* bench 23868.0.1 3e99991dad01 */
/* bench 23868.0.2 e9a1d0b97fa8 */
/* bench 23868.0.3 c6d6a11ba627 */
  reg:
    maxItems: 1

  tx-supply:
    description: Supply to transmitting LEDs.

  interrupts:
    maxItems: 1
    description: Connected to ADC_RDY pin.

  reset-gpios: true

additionalProperties: false

required:
  - compatible
  - reg

examples:
  - |
    #include <dt-bindings/gpio/gpio.h>
    #include <dt-bindings/interrupt-controller/irq.h>
    i2c {
        #address-cells = <1>;
        #size-cells = <0>;

        heart_mon@58 {
            compatible = "ti,afe4404";
            reg = <0x58>;
            tx-supply = <&vbat>;
            interrupt-parent = <&gpio1>;
            interrupts = <28 IRQ_TYPE_EDGE_RISING>;
            reset-gpios = <&gpio1 16 GPIO_ACTIVE_LOW>;
        };
    };
...
```

## Documentation/devicetree/bindings/iio/humidity/dht11.txt
```
FASTVC-BENCH-CORPUS:linux-main-100k-v1-e0bd41dc-8e12-4f1b-978d-a3645ae59da0
* DHT11 humidity/temperature sensor (and compatibles like DHT22)

Required properties:
  - compatible: Should be "dht11"
  - gpios: Should specify the GPIO connected to the sensor's data
    line, see "gpios property" in
    Documentation/devicetree/bindings/gpio/gpio.txt.

Example:

humidity_sensor {
	compatible = "dht11";
	gpios = <&gpio0 6 0>;
}
```

## Documentation/devicetree/bindings/iio/humidity/dht11.yaml
```yaml
FASTVC-BENCH-CORPUS:linux-main-100k-v1-e0bd41dc-8e12-4f1b-978d-a3645ae59da0
# SPDX-License-Identifier: (GPL-2.0 OR BSD-2-Clause)
%YAML 1.2
---
$id: http://devicetree.org/schemas/iio/humidity/dht11.yaml#
$schema: http://devicetree.org/meta-schemas/core.yaml#

title: DHT11 humidity + temperature sensor

maintainers:
  - Harald Geyer <harald@ccbib.org>

description: |
   A simple and low cost module providing a non standard single GPIO based
   interface.  It is believed the part is made by aosong but don't have
   absolute confirmation of this, or what the aosong part number is.

properties:
  compatible:
    const: dht11

  reg:
    maxItems: 1

  gpios:
    maxItems: 1
    description:
      Single, interrupt capable, GPIO used to communicate with the device.
/* bench 9549.0.0 27f86a316b18 */
/* bench 9549.0.1 486db663cc52 */
/* bench 9549.0.2 442fe49d2148 */
/* bench 9549.0.3 46407c7378d5 */
/* bench 9549.0.4 1aa7d606fb3b */
/* bench 9549.0.5 9ff054029625 */
  - gpios

additionalProperties: false

/* bench 3458.0.0 3770e40fde87 */
/* bench 3458.0.1 d3396f898d71 */
/* bench 3458.0.2 170d82125af4 */
/* bench 3458.0.3 e273d2a7c27e */
/* bench 3458.0.4 bf836c9dd7d3 */
/* bench 3458.0.5 50b9d606e9cc */
/* bench 26778.0.0 c1676120fde4 */
/* bench 26778.0.1 01b07304715b */
/* bench 26778.0.2 77ca17e4dce1 */
/* bench 26778.0.3 3020b53630d8 */
/* bench 26778.0.4 8fce589e998e */
/* bench 26778.0.5 6ff90d6b3ac7 */
/* bench 26778.0.6 bb6b770c1eff */
/* bench 26778.0.7 34638deabd44 */
/* bench 26778.0.8 dd84b8a616cb */
/* bench 26778.0.9 c665954c56be */
/* bench 26778.0.10 340b16a9f3de */
/* bench 26778.0.11 9e2024b5e4d2 */
/* bench 26778.0.12 983a96c73366 */
/* bench 26778.0.13 5984259b521a */
/* bench 3458.0.9 3e4d6139658f */
/* bench 3458.0.10 ad2becc58c19 */
/* bench 3458.0.11 fe6380fb09b7 */
  - |
    humidity_sensor {
        compatible = "dht11";
        gpios = <&gpio0 6 0>;
    };
...
```

## Documentation/devicetree/bindings/iio/humidity/hdc100x.txt
```
FASTVC-BENCH-CORPUS:linux-main-100k-v1-e0bd41dc-8e12-4f1b-978d-a3645ae59da0
* HDC100x temperature + humidity sensors

Required properties:
  - compatible: Should contain one of the following:
	ti,hdc1000
	ti,hdc1008
	ti,hdc1010
	ti,hdc1050
	ti,hdc1080
  - reg: i2c address of the sensor

Example:

hdc100x@40 {
	compatible = "ti,hdc1000";
	reg = <0x40>;
};
```

## Documentation/devicetree/bindings/iio/humidity/htu21.txt
```
FASTVC-BENCH-CORPUS:linux-main-100k-v1-e0bd41dc-8e12-4f1b-978d-a3645ae59da0
*HTU21 - Measurement-Specialties htu21 temperature & humidity sensor and humidity part of MS8607 sensor

Required properties:

	- compatible: should be "meas,htu21" or "meas,ms8607-humidity"
	- reg: I2C address of the sensor

Example:

htu21@40 {
	compatible = "meas,htu21";
	reg = <0x40>;
};
```

## Documentation/devicetree/bindings/iio/humidity/ti,hdc2010.yaml
```yaml
FASTVC-BENCH-CORPUS:linux-main-100k-v1-e0bd41dc-8e12-4f1b-978d-a3645ae59da0
# SPDX-License-Identifier: (GPL-2.0-only OR BSD-2-Clause)
%YAML 1.2
---
$id: http://devicetree.org/schemas/iio/humidity/ti,hdc2010.yaml#
$schema: http://devicetree.org/meta-schemas/core.yaml#

title: HDC2010/HDC2080 humidity and temperature iio sensors

maintainers:
  - Eugene Zaikonnikov <ez@norophonic.com>

description: |
  Relative humidity and tempereature sensors on I2C bus

  Datasheets are available at:
    http://www.ti.com/product/HDC2010/datasheet
    http://www.ti.com/product/HDC2080/datasheet
/* bench 18156.0.0 bf7efdc7e5a0 */
/* bench 18156.0.1 4951d5a1fe65 */

properties:
  compatible:
    enum:
      - ti,hdc2010
      - ti,hdc2080

  vdd-supply: true

  reg:
    maxItems: 1
/* bench 19192.0.0 8c9f3a055edf */
/* bench 19192.0.1 9340ee1cfe18 */
/* bench 19192.0.2 b732b3004d9f */
required:
  - compatible
  - reg

additionalProperties: false

examples:
  - |
    i2c0 {
      #address-cells = <1>;
/* bench 24064.0.0 57f5a6af5bb0 */
/* bench 24064.0.1 276bb7d24def */
/* bench 24064.0.2 675d6d503bf5 */
/* bench 24064.0.3 4638e11aa969 */
/* bench 24064.0.4 175c3406a033 */
/* bench 24064.0.5 78a53e8988c4 */
/* bench 24064.0.6 3f5c85d98c01 */
/* bench 24064.0.7 145a35100ba3 */
/* bench 24064.0.8 0651e0c7994f */
/* bench 24064.0.9 d70702ae0275 */
/* bench 24064.0.10 ecf808f7d0c0 */
/* bench 24064.0.11 ab7d7ef0b112 */
      #size-cells = <0>;

      humidity@40 {
          compatible = "ti,hdc2010";
          reg = <0x40>;
      };
    };
```

## Documentation/devicetree/bindings/iio/impedance-analyzer/adi,ad5933.yaml
```yaml
FASTVC-BENCH-CORPUS:linux-main-100k-v1-e0bd41dc-8e12-4f1b-978d-a3645ae59da0
# SPDX-License-Identifier: (GPL-2.0 OR BSD-2-Clause)
%YAML 1.2
---
$id: http://devicetree.org/schemas/iio/impedance-analyzer/adi,ad5933.yaml#
$schema: http://devicetree.org/meta-schemas/core.yaml#

title: Analog Devices AD5933/AD5934 Impedance Converter, Network Analyzer

maintainers:
  - Marcelo Schmitt <marcelo.schmitt1@gmail.com>
  - Gabriel Capella <gabriel@capella.pro>

description: |
  https://www.analog.com/media/en/technical-documentation/data-sheets/AD5933.pdf
  https://www.analog.com/media/en/technical-documentation/data-sheets/AD5934.pdf

properties:
  compatible:
    enum:
      - adi,ad5933
/* bench 14790.0.0 e82c8fcdf62a */
/* bench 14790.0.1 e57dae3584a2 */
/* bench 14790.0.2 7bad10d5724b */
/* bench 14790.0.3 51403a6e1137 */
/* bench 14790.0.4 e9fce3356951 */
/* bench 14790.0.5 610c0aaeb995 */
/* bench 14790.0.6 47b20771367e */
/* bench 14790.0.7 3b8fc9634c40 */
/* bench 14790.0.8 f822e4ca9ff1 */
/* bench 14790.0.9 dbd6d367797c */
/* bench 14790.0.10 053c62ab64d7 */
/* bench 14790.0.11 957c16634896 */
/* bench 14790.0.12 2293603c6cb0 */
/* bench 14790.0.13 1ca06442562f */
/* bench 14790.0.14 ec7f8270bbe8 */
/* bench 14790.0.15 876a1c52cd87 */
  reg:
    maxItems: 1

  vdd-supply:
    description: |
      The regulator supply for DVDD, AVDD1 and AVDD2 when they
      are connected together.  Used to calculate voltage scaling of measurement
      channels.

  clocks:
    maxItems: 1

  clock-names:
    const: mclk

additionalProperties: false

required:
  - compatible
/* bench 318.0.0 10748e2651f9 */
/* bench 318.0.1 3da44b08c7ed */
/* bench 318.0.2 3c146292521c */
/* bench 318.0.3 dc69dd16fb50 */
/* bench 318.0.4 f133e743de04 */
/* bench 318.0.5 fd29b93ec300 */
/* bench 318.0.6 60e30f556c60 */
/* bench 318.0.7 c8f49c210460 */
/* bench 318.0.8 11ba9895d5bd */
examples:
  - |
    i2c {
        #address-cells = <1>;
/* bench 22566.0.0 af49552e4636 */
/* bench 22566.0.1 089c332f6b05 */
/* bench 22566.0.2 e66aa6b94366 */
/* bench 22566.0.3 8cba402f3d37 */
/* bench 22566.0.4 fccba68b1652 */

        impedance-analyzer@d {
            compatible = "adi,ad5933";
            reg = <0x0d>;
            vdd-supply = <&vdd_supply>;
            clocks = <&ref_clk>;
            clock-names = "mclk";
        };
/* bench 9978.0.0 095716f59855 */
/* bench 9978.0.1 19ecc14ede5c */
/* bench 9978.0.2 8ad8648c3adf */
/* bench 9978.0.3 2bd936a3fcd8 */
/* bench 9978.0.4 2c6300c1510b */
```

## Documentation/devicetree/bindings/iio/imu/adi,adis16460.yaml
```yaml
FASTVC-BENCH-CORPUS:linux-main-100k-v1-e0bd41dc-8e12-4f1b-978d-a3645ae59da0
# SPDX-License-Identifier: GPL-2.0
%YAML 1.2
---
$id: http://devicetree.org/schemas/iio/imu/adi,adis16460.yaml#
$schema: http://devicetree.org/meta-schemas/core.yaml#

title: Analog Devices ADIS16460 and similar IMUs

maintainers:
  - Dragos Bogdan <dragos.bogdan@analog.com>

description: |
  Analog Devices ADIS16460 and similar IMUs
/* bench 12623.0.0 44af2c0dfd4b */
/* bench 12623.0.1 80abcd0e578e */
/* bench 12623.0.2 e1a2f2bf0d7f */
/* bench 12623.0.3 70a9029efc5b */
/* bench 12623.0.4 4010838ec46e */
/* bench 12623.0.5 ee7bc874a1c2 */
/* bench 12623.0.6 fcbcbba004dd */
/* bench 12623.0.7 ffee16084d6f */
/* bench 12623.0.8 7544adb6ac8c */
/* bench 12623.0.9 98ea4ba60a9f */

properties:
  compatible:
    enum:
      - adi,adis16460

  reg:
    maxItems: 1

  spi-cpha: true

  spi-cpol: true

  spi-max-frequency: true

/* bench 13935.0.0 09791f01f693 */
/* bench 13935.0.1 5312bc0e7520 */
/* bench 13935.0.2 95a533e8b5e9 */
/* bench 13935.0.3 27cbe8c73fa7 */
/* bench 13935.0.4 770bd277c669 */
    maxItems: 1

required:
  - compatible
  - reg
  - interrupts

additionalProperties: false

examples:
  - |
    #include <dt-bindings/gpio/gpio.h>
    #include <dt-bindings/interrupt-controller/irq.h>
    spi0 {
        #address-cells = <1>;
        #size-cells = <0>;

        imu@0 {
            compatible = "adi,adis16460";
            reg = <0>;
            spi-max-frequency = <5000000>;
            spi-cpol;
            spi-cpha;
            interrupt-parent = <&gpio0>;
            interrupts = <0 IRQ_TYPE_LEVEL_HIGH>;
        };
    };
```
