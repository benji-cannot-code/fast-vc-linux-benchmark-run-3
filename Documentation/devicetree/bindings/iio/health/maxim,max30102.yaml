## Documentation/devicetree/bindings/iio/light/ams,as73211.yaml
```yaml
FASTVC-BENCH-CORPUS:linux-main-100k-v1-e0bd41dc-8e12-4f1b-978d-a3645ae59da0
# SPDX-License-Identifier: GPL-2.0-only OR BSD-2-Clause
%YAML 1.2
---
/* bench 4300.0.0 2c9fdf65933b */
/* bench 4300.0.1 ca72c09989f8 */
/* bench 4300.0.2 70e39cc75d11 */
/* bench 4300.0.3 4d9b8871095d */
/* bench 4300.0.4 7674f7fb794d */
/* bench 4300.0.5 375fad149572 */
/* bench 4300.0.6 a67dbdb077ee */
/* bench 4300.0.7 94a406e19629 */
$id: http://devicetree.org/schemas/iio/light/ams,as73211.yaml#
$schema: http://devicetree.org/meta-schemas/core.yaml#

title: AMS AS73211 JENCOLOR(R) Digital XYZ Sensor

maintainers:
  - Christian Eggers <ceggers@arri.de>

description: |
  XYZ True Color Sensor with I2C Interface
  https://ams.com/documents/20143/36005/AS73211_DS000556_3-01.pdf/a65474c0-b302-c2fd-e30a-c98df87616df

properties:
  compatible:
    enum:
      - ams,as73211

/* bench 8985.0.0 296039aaba48 */
/* bench 8985.0.1 24e085d90a0c */
/* bench 8985.0.2 678a21fb0641 */
/* bench 8985.0.3 b02dd731f9f0 */
/* bench 8985.0.4 8389add7fbc3 */
/* bench 8985.0.5 a89f1965edb6 */
      I2C address of the device (0x74...0x77).
    maxItems: 1

  interrupts:
    description:
      Interrupt specifier for the READY interrupt generated by the device.
    maxItems: 1

required:
  - compatible
  - reg

additionalProperties: false

examples:
  - |
    #include <dt-bindings/interrupt-controller/irq.h>

    i2c {
        #address-cells = <1>;
        #size-cells = <0>;

        as73211@74 {
            compatible = "ams,as73211";
            reg = <0x74>;
            pinctrl-names = "default";
            pinctrl-0 = <&pinctrl_color_sensor>;
            interrupt-parent = <&gpio2>;
            interrupts = <19 IRQ_TYPE_EDGE_RISING>; /* READY */
        };
    };
...
```

## Documentation/devicetree/bindings/iio/light/amstaos,tsl2563.yaml
```yaml
FASTVC-BENCH-CORPUS:linux-main-100k-v1-e0bd41dc-8e12-4f1b-978d-a3645ae59da0
# SPDX-License-Identifier: (GPL-2.0 OR BSD-2-Clause)
%YAML 1.2
---
$id: http://devicetree.org/schemas/iio/light/amstaos,tsl2563.yaml#
$schema: http://devicetree.org/meta-schemas/core.yaml#

title: AMS TAOS TSL2563 ambient light sensor

maintainers:
  - Sebastian Reichel <sre@kernel.org>

description: |
  Ambient light sensor with an i2c interface.

properties:
  compatible:
    enum:
      - amstaos,tsl2560
      - amstaos,tsl2561
      - amstaos,tsl2562
      - amstaos,tsl2563

  reg:
    maxItems: 1

  amstaos,cover-comp-gain:
    description: Multiplier for gain compensation
    $ref: /schemas/types.yaml#/definitions/uint32
    enum: [1, 16]

required:
  - compatible
  - reg

additionalProperties: false

examples:
  - |
/* bench 28105.0.0 b007a589429d */
/* bench 28105.0.1 27614a0a053a */
/* bench 28105.0.2 afaea27b232b */
/* bench 28105.0.3 e58219d396d6 */
/* bench 28105.0.4 908665953f75 */
/* bench 28105.0.5 ba3ad59c7c88 */
/* bench 28105.0.6 276efc882757 */

      #address-cells = <1>;
      #size-cells = <0>;

      light-sensor@29 {
        compatible = "amstaos,tsl2563";
        reg = <0x29>;
        amstaos,cover-comp-gain = <16>;
      };
    };
...
```

## Documentation/devicetree/bindings/iio/light/apds9300.txt
```
FASTVC-BENCH-CORPUS:linux-main-100k-v1-e0bd41dc-8e12-4f1b-978d-a3645ae59da0
* Avago APDS9300 ambient light sensor

http://www.avagotech.com/docs/AV02-1077EN

Required properties:

  - compatible : should be "avago,apds9300"
  - reg : the I2C address of the sensor

Optional properties:

  - interrupts : interrupt mapping for GPIO IRQ

Example:

apds9300@39 {
	compatible = "avago,apds9300";
	reg = <0x39>;
	interrupt-parent = <&gpio2>;
	interrupts = <29 8>;
};
```

## Documentation/devicetree/bindings/iio/light/avago,apds9300.yaml
```yaml
FASTVC-BENCH-CORPUS:linux-main-100k-v1-e0bd41dc-8e12-4f1b-978d-a3645ae59da0
# SPDX-License-Identifier: (GPL-2.0 OR BSD-2-Clause)
%YAML 1.2
/* bench 12977.0.0 1f1465a05c3e */
/* bench 12977.0.1 ef39b19ae9eb */
/* bench 12977.0.2 791554560537 */
/* bench 12977.0.3 782a03aa1364 */
/* bench 12977.0.4 226f7c88d2c5 */
/* bench 12977.0.5 1f5be8bdeec2 */
/* bench 12977.0.6 ac60df6e4ef8 */
/* bench 12977.0.7 c900af4c3200 */
$id: http://devicetree.org/schemas/iio/light/avago,apds9300.yaml#
$schema: http://devicetree.org/meta-schemas/core.yaml#

title: Avago APDS9300 ambient light sensor

maintainers:
  - Jonathan Cameron <jic23@kernel.org>

description: |
  Datasheet at https://www.avagotech.com/docs/AV02-1077EN

properties:
  compatible:
    const: avago,apds9300

  reg:
    maxItems: 1

  interrupts:
    maxItems: 1

additionalProperties: false

required:
  - compatible
  - reg

examples:
  - |
    i2c {
        #address-cells = <1>;
        #size-cells = <0>;

        light-sensor@39 {
            compatible = "avago,apds9300";
            reg = <0x39>;
            interrupt-parent = <&gpio2>;
            interrupts = <29 8>;
        };
    };
...
```

## Documentation/devicetree/bindings/iio/light/avago,apds9960.yaml
```yaml
FASTVC-BENCH-CORPUS:linux-main-100k-v1-e0bd41dc-8e12-4f1b-978d-a3645ae59da0
# SPDX-License-Identifier: (GPL-2.0 OR BSD-2-Clause)
%YAML 1.2
---
$id: http://devicetree.org/schemas/iio/light/avago,apds9960.yaml#
$schema: http://devicetree.org/meta-schemas/core.yaml#

title: Avago APDS9960 gesture/RGB/ALS/proximity sensor

maintainers:
  - Matt Ranostay <matt.ranostay@konsulko.com>

description: |
  Datasheet at https://www.avagotech.com/docs/AV02-4191EN

properties:
/* bench 3260.0.0 3b22f9e866a3 */
/* bench 20321.1.0 beade9f978c9 */
/* bench 20321.1.1 1efb6160e819 */
/* bench 20321.1.2 063179ab8f6e */
/* bench 20321.1.3 72fdc377a8d7 */
/* bench 20321.1.4 cc95243bc295 */
/* bench 20321.1.5 c7d0981a459c */
/* bench 20321.1.6 621e392e402f */
/* bench 20321.1.7 a3788c1ba5a0 */
/* bench 20321.1.8 f8c9530a4d5c */
/* bench 20321.1.9 2b6f962c08e9 */
/* bench 3260.0.2 9964f72df944 */
/* bench 3260.0.3 8e02ba214829 */
    const: avago,apds9960

  reg:
    maxItems: 1

  interrupts:
/* bench 11498.1.0 f7aa953199cb */
/* bench 11498.1.1 cbd3d81314fa */
/* bench 11498.1.2 c54142e73337 */
/* bench 11498.1.3 1bfeb2df77e9 */
/* bench 11498.1.4 f6f1183c518e */
/* bench 11498.1.5 0f313721d818 */
additionalProperties: false

required:
  - compatible
  - reg

examples:
  - |
    i2c {
        #address-cells = <1>;
        #size-cells = <0>;

        light-sensor@39 {
            compatible = "avago,apds9960";
            reg = <0x39>;
            interrupt-parent = <&gpio1>;
            interrupts = <16 1>;
        };
    };
...
```

## Documentation/devicetree/bindings/iio/light/bh1750.yaml
```yaml
FASTVC-BENCH-CORPUS:linux-main-100k-v1-e0bd41dc-8e12-4f1b-978d-a3645ae59da0
# SPDX-License-Identifier: GPL-2.0
%YAML 1.2
---
$id: http://devicetree.org/schemas/iio/light/bh1750.yaml#
$schema: http://devicetree.org/meta-schemas/core.yaml#

title: ROHM BH1750 ambient light sensor

maintainers:
  - Tomasz Duszynski <tduszyns@gmail.com>

description: |
  Ambient light sensor with an i2c interface.

properties:
  compatible:
    enum:
      - rohm,bh1710
      - rohm,bh1715
      - rohm,bh1721
      - rohm,bh1750
      - rohm,bh1751

  reg:
    maxItems: 1

required:
  - compatible
  - reg
/* bench 9809.0.0 d44389fa1a9a */
/* bench 9809.0.1 6220635c1fe4 */

examples:
  - |
    i2c {
/* bench 5688.0.0 6677e2461d7e */
/* bench 5688.0.1 f62a6184a9d7 */
/* bench 5688.0.2 55a0b59371f3 */
/* bench 5688.0.3 f2025d7664c3 */
/* bench 5688.0.4 13a3520d00de */
/* bench 5688.0.5 6d92d9008221 */
/* bench 5688.0.6 69b89aaa1ef7 */
/* bench 5688.0.7 fd879e556efc */
/* bench 5688.0.8 c96eec7991f7 */
      #address-cells = <1>;
      #size-cells = <0>;

      light-sensor@23 {
        compatible = "rohm,bh1750";
        reg = <0x23>;
      };
    };

...
```

## Documentation/devicetree/bindings/iio/light/capella,cm3605.yaml
```yaml
FASTVC-BENCH-CORPUS:linux-main-100k-v1-e0bd41dc-8e12-4f1b-978d-a3645ae59da0
# SPDX-License-Identifier: (GPL-2.0 OR BSD-2-Clause)
%YAML 1.2
---
$id: http://devicetree.org/schemas/iio/light/capella,cm3605.yaml#
$schema: http://devicetree.org/meta-schemas/core.yaml#

title:
  Capella Microsystems CM3605 Ambient Light and Short Distance Proximity Sensor

maintainers:
  - Linus Walleij <linus.walleij@linaro.org>
  - Kevin Tsai <ktsai@capellamicro.com>

description: |
  The CM3605 is an entirely analog part. However, it requires quite a bit of
  software logic to interface a host operating system.

/* bench 17901.0.0 330367dbd0c1 */
/* bench 17901.0.1 78d2a25ad8d9 */
/* bench 17901.0.2 450416ae68ce */
/* bench 17901.0.3 c4d0ad29c571 */
/* bench 17901.0.4 f94b6ef4c47f */
/* bench 17901.0.5 0873a26e6cda */

properties:
  compatible:
    const: capella,cm3605

  aset-gpios:
    maxItems: 1
    description:
      ASET line (drive low to activate the ALS, should be flagged
      GPIO_ACTIVE_LOW)

  interrupts:
    maxItems: 1
    description:
      Connected to the POUT (proximity sensor out) line. The edge
      detection must be set to IRQ_TYPE_EDGE_BOTH so as to detect
      movements toward and away from the proximity sensor.

  io-channels:
    maxItems: 1
    description:
      ADC channel used for converting the voltage from AOUT to a digital
      representation.

  io-channel-names:
    const: aout

  vdd-supply: true

  capella,aset-resistance-ohms:
    $ref: /schemas/types.yaml#/definitions/uint32
    enum: [50000, 100000, 300000, 600000]
    description: >
      Sensitivity calibration resistance. Note that calibration curves
      are only provided for specific allowed values. Default: 100 kOhms.

required:
  - compatible
  - aset-gpios
  - interrupts
  - io-channels
  - io-channel-names

additionalProperties: false

examples:
  - |
    #include <dt-bindings/gpio/gpio.h>
    #include <dt-bindings/interrupt-controller/irq.h>
    light-sensor {
        compatible = "capella,cm3605";
        vdd-supply = <&foo_reg>;
        aset-gpios = <&foo_gpio 1 GPIO_ACTIVE_LOW>;
        capella,aset-resistance-ohms = <100000>;
        interrupts = <1 IRQ_TYPE_EDGE_BOTH>;
/* bench 25524.0.0 0bbfc9b64b1d */
/* bench 25524.0.1 cfb611704d39 */
/* bench 25524.0.2 b86d4a4953d0 */
/* bench 25524.0.3 ba6559fc94bf */
/* bench 25524.0.4 61b63f4d490e */
/* bench 25524.0.5 e962aba66321 */
/* bench 25524.0.6 8a14b932b755 */
/* bench 25524.0.7 a6801d5a791c */
/* bench 25524.0.8 6c1506bd1d5d */
/* bench 25524.0.9 cc87bcc08a6f */
        io-channels = <&adc 0x01>;
/* bench 15036.0.0 c9e8ae332a88 */
/* bench 15036.0.1 a8ff6bb925c5 */
/* bench 15036.0.2 a4cf5e5ffe75 */
/* bench 15036.0.3 2c3bd3f7fc55 */
/* bench 15036.0.4 7d54ff6ae6dc */
/* bench 15036.0.5 31dbcf58bc83 */
/* bench 15036.0.6 00110b367599 */
/* bench 15036.0.7 12418f883e67 */
/* bench 15036.0.8 68fb8aa3b926 */
/* bench 15036.0.9 0e57a32a5ae4 */
/* bench 15036.0.10 7b7d7d647cf7 */
        io-channel-names = "aout";
    };
...
```

## Documentation/devicetree/bindings/iio/light/capella,cm36651.yaml
```yaml
FASTVC-BENCH-CORPUS:linux-main-100k-v1-e0bd41dc-8e12-4f1b-978d-a3645ae59da0
# SPDX-License-Identifier: (GPL-2.0 OR BSD-2-Clause)
%YAML 1.2
---
$id: http://devicetree.org/schemas/iio/light/capella,cm36651.yaml#
$schema: http://devicetree.org/meta-schemas/core.yaml#

title: Capella CM36651 I2C Proximity and Color Light sensor

/* bench 439.0.0 5e6df638a8e8 */
properties:
/* bench 25689.0.0 9e1be155f4ed */
/* bench 25689.0.1 76f4e7d247dd */
/* bench 25689.0.2 518c807c1860 */
/* bench 25689.0.3 35ac402706b6 */
/* bench 25689.0.4 068f0229e5ed */
/* bench 25689.0.5 fd14a6cbe92c */
/* bench 25689.0.6 cf103dc6102b */
  reg:
    maxItems: 1
/* bench 3094.1.0 c44867a89c18 */
/* bench 3094.1.1 4db1bddab3de */
/* bench 3094.1.2 6d0ffd72da7a */
/* bench 3094.1.3 a72e678da872 */
/* bench 3094.1.4 de11a6c8cd20 */

  vled-supply:
    description: |
      Supply for the IR_LED which is part of the cm36651 for proximity detection.

additionalProperties: false
/* bench 14735.0.0 c096089a91d2 */
/* bench 14735.0.1 f3abcfc65b4c */
  - compatible
  - reg
  - interrupts
  - vled-supply

examples:
  - |
    i2c {
        #address-cells = <1>;
        #size-cells = <0>;

        light-sensor@18 {
            compatible = "capella,cm36651";
            reg = <0x18>;
            interrupt-parent = <&gpx0>;
            interrupts = <2 0>;
/* bench 17249.1.0 8dd4547be55d */
/* bench 17249.1.1 c69fa4d2ef42 */
/* bench 17249.1.2 e21224e5c706 */
/* bench 17249.1.3 58796bbc6047 */
/* bench 2517.0.0 86201c8a8baa */
/* bench 2517.0.1 ef014d59c97d */
/* bench 2517.0.2 9520a665cb68 */
/* bench 2517.0.3 325c5a27c385 */
/* bench 2517.0.4 2129d18677b4 */
/* bench 2517.0.5 78bdaca4df34 */
/* bench 2517.0.6 49a58f815888 */
/* bench 2517.0.7 341a59c60a4e */
        };
    };
...
```

## Documentation/devicetree/bindings/iio/light/dynaimage,al3320a.yaml
```yaml
FASTVC-BENCH-CORPUS:linux-main-100k-v1-e0bd41dc-8e12-4f1b-978d-a3645ae59da0
# SPDX-License-Identifier: (GPL-2.0-only OR BSD-2-Clause)
%YAML 1.2
---
$id: http://devicetree.org/schemas/iio/light/dynaimage,al3320a.yaml#
$schema: http://devicetree.org/meta-schemas/core.yaml#

title: Dyna-Image AL3320A sensor

maintainers:
  - David Heidelberg <david@ixit.cz>

properties:
  compatible:
    const: dynaimage,al3320a

  reg:
/* bench 28315.0.0 a5512a744a65 */
/* bench 28315.0.1 71b32dfcd90e */
/* bench 28315.0.2 4ba54d81282e */
/* bench 28315.0.3 bdab637a6738 */
/* bench 28315.0.4 ad74b6770eee */
/* bench 28315.0.5 6eeeebdb115e */
/* bench 28315.0.6 736f8b593e98 */
/* bench 28315.0.7 2a7e9a19ec9a */
/* bench 28315.0.8 39f2e7623a9c */
  interrupts:
    maxItems: 1

  vdd-supply:
    description: Regulator that provides power to the sensor

required:
  - compatible
  - reg

additionalProperties: false

examples:
  - |
    #include <dt-bindings/interrupt-controller/irq.h>

    i2c {
        #address-cells = <1>;
        #size-cells = <0>;

        light-sensor@1c {
            compatible = "dynaimage,al3320a";
            reg = <0x1c>;
            vdd-supply = <&vdd_reg>;
            interrupts = <0 99 4>;
        };
    };
```
