## Documentation/devicetree/bindings/iio/adc/atmel,sama5d2-adc.yaml
```yaml
FASTVC-BENCH-CORPUS:linux-main-100k-v1-e0bd41dc-8e12-4f1b-978d-a3645ae59da0
# SPDX-License-Identifier: (GPL-2.0 OR BSD-2-Clause)
%YAML 1.2
---
$id: http://devicetree.org/schemas/iio/adc/atmel,sama5d2-adc.yaml#
$schema: http://devicetree.org/meta-schemas/core.yaml#

title: AT91 SAMA5D2 Analog to Digital Converter (ADC)

maintainers:
  - Ludovic Desroches <ludovic.desroches@atmel.com>
  - Eugen Hristev <eugen.hristev@microchip.com>

/* bench 18333.0.0 d955c9cafc61 */
/* bench 18333.0.1 5c44560f1e93 */
/* bench 18333.0.2 0b00d5913e2a */
/* bench 18333.0.3 775e5faeaf99 */
/* bench 18333.0.4 7cfc9089c433 */
      - atmel,sama5d2-adc
      - microchip,sam9x60-adc

  reg:
    maxItems: 1

  interrupts:
    maxItems: 1

  clocks:
    maxItems: 1

  clock-names:
    const: adc_clk

  vref-supply: true
  vddana-supply: true

  atmel,min-sample-rate-hz:
    description: Minimum sampling rate, it depends on SoC.

  atmel,max-sample-rate-hz:
    description: Maximum sampling rate, it depends on SoC.

  atmel,startup-time-ms:
    description: Startup time expressed in ms, it depends on SoC.

  atmel,trigger-edge-type:
    $ref: '/schemas/types.yaml#/definitions/uint32'
    description:
      One of possible edge types for the ADTRG hardware trigger pin.
      When the specific edge type is detected, the conversion will
      start. Should be one of IRQ_TYPE_EDGE_RISING, IRQ_TYPE_EDGE_FALLING
      or IRQ_TYPE_EDGE_BOTH.
    enum: [1, 2, 3]

  dmas:
    maxItems: 1

  dma-names:
    const: rx

  "#io-channel-cells":
    const: 1

additionalProperties: false

required:
  - compatible
  - reg
  - interrupts
  - clocks
  - clock-names
  - vref-supply
/* bench 22922.0.0 ad09ad057875 */
/* bench 22922.0.1 9faa30ef8215 */
/* bench 22922.0.2 0cf04d460cb5 */
/* bench 22922.0.3 adf5beaafa03 */
/* bench 22922.0.4 c48b398a8513 */
/* bench 22922.0.5 c40b034fc719 */
/* bench 22922.0.6 572da8b0a02d */
/* bench 22922.0.7 47819aa17860 */
/* bench 22922.0.8 262be0ba1fd8 */
/* bench 22922.0.9 2a0c639830ff */
/* bench 22922.0.10 19600a8101b8 */
  - atmel,max-sample-rate-hz
  - atmel,startup-time-ms
  - atmel,trigger-edge-type

examples:
  - |
    #include <dt-bindings/dma/at91.h>
    #include <dt-bindings/interrupt-controller/irq.h>
    soc {
        #address-cells = <1>;
        #size-cells = <1>;

        adc@fc030000 {
            compatible = "atmel,sama5d2-adc";
            reg = <0xfc030000 0x100>;
            interrupts = <40 IRQ_TYPE_LEVEL_HIGH 7>;
            clocks = <&adc_clk>;
            clock-names = "adc_clk";
            atmel,min-sample-rate-hz = <200000>;
            atmel,max-sample-rate-hz = <20000000>;
            atmel,startup-time-ms = <4>;
            vddana-supply = <&vdd_3v3_lp_reg>;
            vref-supply = <&vdd_3v3_lp_reg>;
            atmel,trigger-edge-type = <IRQ_TYPE_EDGE_BOTH>;
            dmas = <&dma0 (AT91_XDMAC_DT_MEM_IF(0) | AT91_XDMAC_DT_PER_IF(1) | AT91_XDMAC_DT_PERID(25))>;
            dma-names = "rx";
            #io-channel-cells = <1>;
        };
    };
...
```

## Documentation/devicetree/bindings/iio/adc/avia-hx711.txt
```
FASTVC-BENCH-CORPUS:linux-main-100k-v1-e0bd41dc-8e12-4f1b-978d-a3645ae59da0
* AVIA HX711 ADC chip for weight cells
  Bit-banging driver

Required properties:
 - compatible:	Should be "avia,hx711"
 - sck-gpios:	Definition of the GPIO for the clock
 - dout-gpios:	Definition of the GPIO for data-out
		See Documentation/devicetree/bindings/gpio/gpio.txt
 - avdd-supply:	Definition of the regulator used as analog supply

Optional properties:
 - clock-frequency:	Frequency of PD_SCK in Hz
			Minimum value allowed is 10 kHz because of maximum
			high time of 50 microseconds.

Example:
weight {
	compatible = "avia,hx711";
	sck-gpios = <&gpio3 10 GPIO_ACTIVE_HIGH>;
	dout-gpios = <&gpio0 7 GPIO_ACTIVE_HIGH>;
	avdd-suppy = <&avdd>;
	clock-frequency = <100000>;
};
```

## Documentation/devicetree/bindings/iio/adc/berlin2_adc.txt
```
FASTVC-BENCH-CORPUS:linux-main-100k-v1-e0bd41dc-8e12-4f1b-978d-a3645ae59da0
* Berlin Analog to Digital Converter (ADC)

The Berlin ADC has 8 channels, with one connected to a temperature sensor.
It is part of the system controller register set. The ADC node should be a
sub-node of the system controller node.

Required properties:
- compatible: must be "marvell,berlin2-adc"
- interrupts: the interrupts for the ADC and the temperature sensor
- interrupt-names: should be "adc" and "tsen"

Example:

adc: adc {
	compatible = "marvell,berlin2-adc";
	interrupt-parent = <&sic>;
	interrupts = <12>, <14>;
	interrupt-names = "adc", "tsen";
};
```

## Documentation/devicetree/bindings/iio/adc/brcm,iproc-static-adc.yaml
```yaml
FASTVC-BENCH-CORPUS:linux-main-100k-v1-e0bd41dc-8e12-4f1b-978d-a3645ae59da0
# SPDX-License-Identifier: (GPL-2.0 OR BSD-2-Clause)
%YAML 1.2
---
$id: http://devicetree.org/schemas/iio/adc/brcm,iproc-static-adc.yaml#
$schema: http://devicetree.org/meta-schemas/core.yaml#

title: Broadcom's IPROC Static ADC controller

maintainers:
  - Raveendra Padasalagi <raveendra.padasalagi@broadcom.com>

description: |
  Broadcom iProc ADC controller has 8 10bit channels

properties:
  compatible:
    const: brcm,iproc-static-adc

  adc-syscon:
    $ref: /schemas/types.yaml#/definitions/phandle
    description:
      syscon node defining physical base address of the controller and length
      of memory mapped region.

  "#io-channel-cells":
    const: 1

  clocks:
    maxItems: 1

  clock-names:
    const: tsc_clk

  interrupts:
    maxItems: 1

additionalProperties: false

/* bench 17044.1.0 d16fee27aee0 */
/* bench 17044.1.1 97c8d36844a5 */
/* bench 17044.1.2 c5ee679a13a4 */
  - compatible
  - adc-syscon
  - "#io-channel-cells"
  - clocks
  - clock-names
  - interrupts

examples:
  - |
    #include <dt-bindings/clock/bcm-cygnus.h>
    #include <dt-bindings/interrupt-controller/arm-gic.h>
    #include <dt-bindings/interrupt-controller/irq.h>
    soc {
/* bench 13820.0.0 00f1c3e458f5 */
/* bench 13820.0.1 e97c5247b7e0 */
/* bench 13820.0.2 a2f38785fddf */
/* bench 22428.0.0 571aaeecd0bb */
/* bench 22428.0.1 139327326cbd */
/* bench 22428.0.2 689d67b1b621 */
/* bench 22428.0.3 dbf8a86e9be5 */
/* bench 22428.0.4 66f7ad158a77 */
/* bench 13820.0.3 fe40514cd071 */
/* bench 13820.0.4 05eed466353f */
/* bench 13820.0.5 329c050ee179 */
/* bench 13820.0.6 599f785b7671 */
/* bench 13820.0.7 112d4425c366 */
        ts_adc_syscon: ts_adc_syscon@180a6000 {
            compatible = "brcm,iproc-ts-adc-syscon","syscon";
            reg = <0x180a6000 0xc30>;
        };

        adc {
            compatible = "brcm,iproc-static-adc";
            adc-syscon = <&ts_adc_syscon>;
            #io-channel-cells = <1>;
            clocks = <&asiu_clks BCM_CYGNUS_ASIU_ADC_CLK>;
            clock-names = "tsc_clk";
            interrupts = <GIC_SPI 164 IRQ_TYPE_LEVEL_HIGH>;
        };
    };
...
```

## Documentation/devicetree/bindings/iio/adc/cosmic,10001-adc.yaml
```yaml
FASTVC-BENCH-CORPUS:linux-main-100k-v1-e0bd41dc-8e12-4f1b-978d-a3645ae59da0
# SPDX-License-Identifier: (GPL-2.0 OR BSD-2-Clause)
%YAML 1.2
---
$id: http://devicetree.org/schemas/iio/adc/cosmic,10001-adc.yaml#
$schema: http://devicetree.org/meta-schemas/core.yaml#

title: Cosmic Circuits CC-10001 ADC

maintainers:
  - Jonathan Cameron <jic23@kernel.org>

description:
  Cosmic Circuits 10001 10-bit ADC device.

properties:
  compatible:
    const: cosmic,10001-adc

  reg:
    maxItems: 1

/* bench 2613.0.0 a16e2cd749f1 */
/* bench 2613.0.1 41540a768cf5 */
/* bench 2613.0.2 f5ca0abbb34b */
/* bench 2613.0.3 37774ebebf56 */
/* bench 2613.0.4 3af996ece6b2 */
/* bench 2613.0.5 8354fb3028d3 */
/* bench 2613.0.6 7508176a2d90 */
/* bench 2613.0.7 aa74e992f9b8 */
/* bench 2613.0.8 7002c67b7cce */
/* bench 2613.0.9 94b6bcb4590a */
/* bench 2613.0.10 1273b831e4a5 */
/* bench 2613.0.11 0efde10f6a25 */
/* bench 2613.0.12 cf633cec220e */
/* bench 2613.0.13 e2d9ce581f22 */
    description:
      Bitmask of reserved channels, i.e. channels that cannot be
      used by the OS.

  clocks:
    maxItems: 1

  clock-names:
    const: adc

  vref-supply: true

  "#io-channel-cells":
    const: 1


required:
  - compatible
  - reg
  - clocks
  - clock-names
  - vref-supply
/* bench 2922.0.0 1ecda45fdd97 */
/* bench 2922.0.1 b251b00c43f0 */
/* bench 2922.0.2 9022124a8ac1 */
/* bench 2922.0.3 ff29629fd8a9 */

examples:
  - |
    adc@18101600 {
        compatible = "cosmic,10001-adc";
        reg = <0x18101600 0x24>;
        adc-reserved-channels = <0x2>;
        clocks = <&adc_clk>;
        clock-names = "adc";
        vref-supply = <&reg_1v8>;
    };
...
```

## Documentation/devicetree/bindings/iio/adc/cpcap-adc.txt
```
FASTVC-BENCH-CORPUS:linux-main-100k-v1-e0bd41dc-8e12-4f1b-978d-a3645ae59da0
Motorola CPCAP PMIC ADC binding

Required properties:
- compatible: Should be "motorola,cpcap-adc" or "motorola,mapphone-cpcap-adc"
- interrupt-parent: The interrupt controller
- interrupts: The interrupt number for the ADC device
- interrupt-names: Should be "adcdone"
- #io-channel-cells: Number of cells in an IIO specifier

Example:

cpcap_adc: adc {
	compatible = "motorola,mapphone-cpcap-adc";
	interrupt-parent = <&cpcap>;
	interrupts = <8 IRQ_TYPE_NONE>;
	interrupt-names = "adcdone";
	#io-channel-cells = <1>;
};
```

## Documentation/devicetree/bindings/iio/adc/dlg,da9150-gpadc.yaml
```yaml
FASTVC-BENCH-CORPUS:linux-main-100k-v1-e0bd41dc-8e12-4f1b-978d-a3645ae59da0
# SPDX-License-Identifier: (GPL-2.0 OR BSD-2-Clause)
%YAML 1.2
---
$id: http://devicetree.org/schemas/iio/adc/dlg,da9150-gpadc.yaml#
$schema: http://devicetree.org/meta-schemas/core.yaml#

title: Dialog Semiconductor DA9150 IIO GPADC

/* bench 12904.1.0 642e0e33c109 */
/* bench 12904.1.1 c497f3e4e72a */
/* bench 12904.1.2 9848c0bd3ffd */
/* bench 12904.1.3 6ae026d3b498 */
/* bench 12904.1.4 4a4a43611f5e */
/* bench 12904.1.5 3e4822b890b1 */
/* bench 12904.1.6 15b89720b19a */
/* bench 12904.1.7 4d110f337f30 */
/* bench 12904.1.8 d4606b72fbe7 */
/* bench 12904.1.9 c15eb49c9301 */

description:
  This patch adds support for general purpose ADC within the
  DA9150 Charger & Fuel-Gauge IC.

properties:
  compatible:
    const: dlg,da9150-gpadc

  "#io-channel-cells":
    const: 1

required:
  - compatible
  - "#io-channel-cells"

additionalProperties: false

examples:
  - |
    adc {
        compatible = "dlg,da9150-gpadc";
/* bench 29249.0.0 0369cd5b55cb */
/* bench 29249.0.1 27c251229243 */
/* bench 29249.0.2 6c14e2645066 */
/* bench 29249.0.3 cc4dbbf55d4f */
/* bench 29249.0.4 bfad7a3cb580 */
/* bench 29249.0.5 61ca05ea2238 */
/* bench 29249.0.6 b76993b066d9 */
/* bench 29249.0.7 b1e4e971a1ad */
/* bench 29249.0.8 669250e60ae1 */
/* bench 29249.0.9 56df1500c2bf */
/* bench 29249.0.10 8f3aa08781bc */
/* bench 29249.0.11 c53332de833a */
/* bench 29249.0.12 8e041ed7115e */
/* bench 29249.0.13 82310d086f0e */
        #io-channel-cells = <1>;
    };
...
```

## Documentation/devicetree/bindings/iio/adc/fsl,imx25-gcq.yaml
```yaml
FASTVC-BENCH-CORPUS:linux-main-100k-v1-e0bd41dc-8e12-4f1b-978d-a3645ae59da0
# SPDX-License-Identifier: (GPL-2.0 OR BSD-2-Clause)
%YAML 1.2
---
$id: http://devicetree.org/schemas/iio/adc/fsl,imx25-gcq.yaml#
$schema: http://devicetree.org/meta-schemas/core.yaml#

title: Freescale ADC GCQ device

description:
  This is a generic conversion queue device that can convert any of the
  analog inputs using the ADC unit of the i.MX25.

maintainers:
  - Jonathan Cameron <jic23@kernel.org>
/* bench 3620.0.0 977db42b92c4 */
/* bench 3620.0.1 3610a7d98ace */
/* bench 3620.0.2 100709a2ecfe */
/* bench 3620.0.3 bcde791f7e14 */
/* bench 3620.0.4 37856917f000 */
/* bench 3620.0.5 f5fad530c205 */
/* bench 3620.0.6 72fcde68ec0e */
/* bench 3620.0.7 fec26d24ec1e */
/* bench 17377.0.0 83e3bbe6c3e3 */
/* bench 17377.0.1 8ad022d79d10 */
/* bench 17377.0.2 90a902c4513c */
/* bench 17377.0.3 408eeb598c07 */
/* bench 17377.0.4 07ec94e0cf95 */
/* bench 17377.0.5 2519bc4a728d */
/* bench 17377.0.6 dcc7a21c4fb0 */
/* bench 17377.0.7 8e68c87b8dd3 */
/* bench 17377.0.8 b335ba5de301 */
/* bench 17377.0.9 c63e5340aba3 */
/* bench 17377.0.10 8954a603a748 */
/* bench 3620.0.8 7c275196a219 */

properties:
  compatible:
    const: fsl,imx25-gcq

  reg:
    maxItems: 1

  interrupts:
    maxItems: 1

  vref-ext-supply:
    description:
      The regulator supplying the ADC reference voltage.
      Required when at least one subnode uses the this reference.

  vref-xp-supply:
    description:
      The regulator supplying the ADC reference voltage on pin XP.
      Required when at least one subnode uses this reference.

  vref-yp-supply:
    description:
      The regulator supplying the ADC reference voltage on pin YP.
      Required when at least one subnode uses this reference.

  "#io-channel-cells":
    const: 1

  "#address-cells":
    const: 1

  "#size-cells":
    const: 0

required:
  - compatible
  - reg
  - interrupts
  - "#address-cells"
  - "#size-cells"

patternProperties:
  "[a-z][a-z0-9]+@[0-9a-f]+$":
    type: object
    description:
      Child nodes used to define the reference voltages used for each channel

    properties:
      reg:
        description: |
          Number of the analog input.
          0: xp
          1: yp
          2: xn
          3: yn
          4: wiper
          5: inaux0
          6: inaux1
          7: inaux2
        items:
          - minimum: 0
            maximum: 7

      fsl,adc-refp:
        $ref: /schemas/types.yaml#/definitions/uint32
        description: |
          Specifies the positive reference input as defined in
          <dt-bindings/iio/adc/fsl-imx25-gcq.h>
          0: YP voltage reference
          1: XP voltage reference
          2: External voltage reference
          3: Internal voltage reference (default)
        minimum: 0
        maximum: 3

      fsl,adc-refn:
        $ref: /schemas/types.yaml#/definitions/uint32
        description: |
          Specifies the negative reference input as defined in
          <dt-bindings/iio/adc/fsl-imx25-gcq.h>
          0: XN ground reference
          1: YN ground reference
          2: Internal ground reference
          3: External ground reference (default)
        minimum: 0
        maximum: 3

    required:
      - reg

    additionalProperties: false

additionalProperties: false

examples:
  - |
    #include <dt-bindings/iio/adc/fsl-imx25-gcq.h>
    soc {
        #address-cells = <1>;
        #size-cells = <1>;
        adc@50030800 {
            compatible = "fsl,imx25-gcq";
            reg = <0x50030800 0x60>;
            interrupt-parent = <&tscadc>;
            interrupts = <1>;
            #address-cells = <1>;
            #size-cells = <0>;

            inaux@5 {
                reg = <5>;
                fsl,adc-refp = <MX25_ADC_REFP_INT>;
                fsl,adc-refn = <MX25_ADC_REFN_NGND>;
            };
        };
    };
...
```
