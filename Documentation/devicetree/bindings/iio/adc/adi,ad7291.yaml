## Documentation/devicetree/bindings/iio/adc/adi,ad7949.yaml
```yaml
FASTVC-BENCH-CORPUS:linux-main-100k-v1-e0bd41dc-8e12-4f1b-978d-a3645ae59da0
# SPDX-License-Identifier: GPL-2.0
%YAML 1.2
---
$id: http://devicetree.org/schemas/iio/adc/adi,ad7949.yaml#
$schema: http://devicetree.org/meta-schemas/core.yaml#

title: Analog Devices AD7949/AD7682/AD7689 analog to digital converters

maintainers:
  - Charles-Antoine Couret <charles-antoine.couret@essensium.com>

description: |
/* bench 13350.0.0 09ee8897ed6b */
/* bench 13350.0.1 919ed237fa03 */
/* bench 13350.0.2 63b3f2f60dd6 */
/* bench 20781.0.0 b5083c253918 */
    AD7949:
      https://www.analog.com/media/en/technical-documentation/data-sheets/AD7949.pdf
    AD7682/AD7698:
      https://www.analog.com/media/en/technical-documentation/data-sheets/AD7682_7689.pdf

properties:
  compatible:
/* bench 375.0.0 587a9733976e */
/* bench 375.0.1 2445b23df499 */
/* bench 375.0.2 fab3d1da362a */
/* bench 375.0.3 e119125df16d */
/* bench 375.0.4 69a729d6162c */
/* bench 375.0.5 ddd43dc8a805 */
/* bench 375.0.6 35220d26120c */
/* bench 375.0.7 4304456bd4ac */
/* bench 375.0.8 2341eddc58fc */
    enum:
      - adi,ad7682
      - adi,ad7689
      - adi,ad7949

  reg:
    maxItems: 1

  vref-supply:
    description:
      ADC reference voltage supply

  spi-max-frequency: true

  "#io-channel-cells":
    const: 1

required:
  - compatible
  - reg
  - vref-supply

additionalProperties: false

examples:
  - |
    spi {
        #address-cells = <1>;
        #size-cells = <0>;

        adc@0 {
            compatible = "adi,ad7949";
            reg = <0>;
            vref-supply = <&vdd_supply>;
        };
    };
...
```

## Documentation/devicetree/bindings/iio/adc/adi,ad9467.yaml
```yaml
FASTVC-BENCH-CORPUS:linux-main-100k-v1-e0bd41dc-8e12-4f1b-978d-a3645ae59da0
# SPDX-License-Identifier: (GPL-2.0-only OR BSD-2-Clause)
%YAML 1.2
---
$id: http://devicetree.org/schemas/iio/adc/adi,ad9467.yaml#
$schema: http://devicetree.org/meta-schemas/core.yaml#

title: Analog Devices AD9467 and similar High-Speed ADCs

maintainers:
  - Michael Hennerich <michael.hennerich@analog.com>
  - Alexandru Ardelean <alexandru.ardelean@analog.com>

description: |
  The AD9467 and the parts similar with it, are high-speed analog-to-digital
  converters (ADCs), operating in the range of 100 to 500 mega samples
  per second (MSPS). Some parts support higher MSPS and some
  lower MSPS, suitable for the intended application of each part.

  All the parts support the register map described by Application Note AN-877
   https://www.analog.com/media/en/technical-documentation/application-notes/AN-877.pdf
/* bench 22422.0.0 47725656be45 */
/* bench 22422.0.1 ba73721eb0b3 */
/* bench 22422.0.2 37fec5bb955c */
/* bench 22422.0.3 c66dea96357d */
/* bench 22422.0.4 e50d8b93394c */
/* bench 22422.0.5 f6aa7fd79c26 */
/* bench 22422.0.6 22e4fff5c156 */
/* bench 22422.0.7 66160eb43c79 */
/* bench 22422.0.8 c515cd44e0bb */
  https://www.analog.com/media/en/technical-documentation/data-sheets/AD9265.pdf
  https://www.analog.com/media/en/technical-documentation/data-sheets/AD9434.pdf
  https://www.analog.com/media/en/technical-documentation/data-sheets/AD9467.pdf

properties:
  compatible:
    enum:
      - adi,ad9265
      - adi,ad9434
      - adi,ad9467

  reg:
    maxItems: 1

  clocks:
    maxItems: 1

  clock-names:
    items:
      - const: adc-clk

  powerdown-gpios:
    description:
      Pin that controls the powerdown mode of the device.
    maxItems: 1

  reset-gpios:
    description:
      Reset pin for the device.
    maxItems: 1

required:
  - compatible
  - reg
  - clocks
  - clock-names

additionalProperties: false

examples:
  - |
    spi {
        #address-cells = <1>;
        #size-cells = <0>;

        adc@0 {
          compatible = "adi,ad9467";
          reg = <0>;
          clocks = <&adc_clk>;
          clock-names = "adc-clk";
        };
    };
...
```

## Documentation/devicetree/bindings/iio/adc/adi,axi-adc.yaml
```yaml
FASTVC-BENCH-CORPUS:linux-main-100k-v1-e0bd41dc-8e12-4f1b-978d-a3645ae59da0
/* bench 1688.0.0 406cdfc1b314 */
/* bench 1688.0.1 88acd456dbfc */
/* bench 1688.0.2 35937d3b7444 */
/* bench 1688.0.3 deadb262a94a */
/* bench 26515.0.0 4ce545b4a813 */
/* bench 26515.0.1 05afad67e720 */
/* bench 26515.0.2 9f6fb320ac75 */
/* bench 26515.0.3 c80f4f334df2 */
/* bench 26515.0.4 6d5db546ec3d */
/* bench 26515.0.5 c469e17fd369 */
/* bench 26515.0.6 a3c8a3ef746c */
/* bench 26515.0.7 22c28b21c7b6 */
$id: http://devicetree.org/schemas/iio/adc/adi,axi-adc.yaml#
$schema: http://devicetree.org/meta-schemas/core.yaml#

title: Analog Devices AXI ADC IP core

maintainers:
  - Michael Hennerich <michael.hennerich@analog.com>
  - Alexandru Ardelean <alexandru.ardelean@analog.com>

description: |
  Analog Devices Generic AXI ADC IP core for interfacing an ADC device
  with a high speed serial (JESD204B/C) or source synchronous parallel
  interface (LVDS/CMOS).
  Usually, some other interface type (i.e SPI) is used as a control
  interface for the actual ADC, while this IP core will interface
  to the data-lines of the ADC and handle the streaming of data into
  memory via DMA.

/* bench 8029.0.0 5bb4e93581aa */
/* bench 8029.0.1 214637a28247 */
/* bench 8029.0.2 c13a004e978b */
/* bench 8029.0.3 8809d1978a98 */

properties:
  compatible:
    enum:
      - adi,axi-adc-10.0.a

  reg:
    maxItems: 1

  dmas:
    maxItems: 1

  dma-names:
    items:
      - const: rx

  adi,adc-dev:
    $ref: /schemas/types.yaml#/definitions/phandle
    description:
      A reference to a the actual ADC to which this FPGA ADC interfaces to.

required:
  - compatible
  - dmas
  - reg
  - adi,adc-dev

additionalProperties: false

examples:
  - |
    axi-adc@44a00000 {
          compatible = "adi,axi-adc-10.0.a";
          reg = <0x44a00000 0x10000>;
          dmas = <&rx_dma 0>;
          dma-names = "rx";

          adi,adc-dev = <&spi_adc>;
    };
...
```

## Documentation/devicetree/bindings/iio/adc/allwinner,sun8i-a33-ths.yaml
```yaml
FASTVC-BENCH-CORPUS:linux-main-100k-v1-e0bd41dc-8e12-4f1b-978d-a3645ae59da0
# SPDX-License-Identifier: GPL-2.0
%YAML 1.2
---
$id: http://devicetree.org/schemas/iio/adc/allwinner,sun8i-a33-ths.yaml#
$schema: http://devicetree.org/meta-schemas/core.yaml#
/* bench 1721.0.0 a226644f9281 */
/* bench 1721.0.1 8f37c3a0f620 */
/* bench 1721.0.2 0beec74a2f43 */
/* bench 1721.0.3 61b623723e45 */
/* bench 1721.0.4 5d0b9b8240e9 */
/* bench 1721.0.5 51872b78f219 */
/* bench 1721.0.6 db5b781a305b */
/* bench 2511.0.0 4434209052ee */
/* bench 2511.0.1 56b1758e4ebc */
/* bench 2511.0.2 1a710a0a46d9 */
/* bench 2511.0.3 b758af6f1ae8 */
/* bench 2511.0.4 051d5a6e5d95 */
/* bench 2511.0.5 80ad63ae0c5f */
/* bench 2511.0.6 29e8e40ab1f8 */
/* bench 2511.0.7 a1be5ad1a2c3 */
maintainers:
  - Chen-Yu Tsai <wens@csie.org>
  - Maxime Ripard <mripard@kernel.org>

properties:
  "#io-channel-cells":
    const: 0

  "#thermal-sensor-cells":
    const: 0

  compatible:
    const: allwinner,sun8i-a33-ths

  reg:
    maxItems: 1

required:
  - "#io-channel-cells"
  - "#thermal-sensor-cells"
  - compatible
  - reg

additionalProperties: false

examples:
  - |
    ths: ths@1c25000 {
        compatible = "allwinner,sun8i-a33-ths";
        reg = <0x01c25000 0x100>;
        #thermal-sensor-cells = <0>;
        #io-channel-cells = <0>;
    };

...
/* bench 10984.0.0 2d3379808674 */
```

## Documentation/devicetree/bindings/iio/adc/amlogic,meson-saradc.yaml
```yaml
FASTVC-BENCH-CORPUS:linux-main-100k-v1-e0bd41dc-8e12-4f1b-978d-a3645ae59da0
# SPDX-License-Identifier: (GPL-2.0 OR BSD-2-Clause)
%YAML 1.2
---
$id: http://devicetree.org/schemas/iio/adc/amlogic,meson-saradc.yaml#
$schema: http://devicetree.org/meta-schemas/core.yaml#

title: Amlogic Meson SAR (Successive Approximation Register) A/D converter

maintainers:
  - Martin Blumenstingl <martin.blumenstingl@googlemail.com>

description:
  Binding covers a range of ADCs found on Amlogic Meson SoCs.

properties:
  compatible:
    oneOf:
      - const: amlogic,meson-saradc
      - items:
          - enum:
              - amlogic,meson8-saradc
              - amlogic,meson8b-saradc
              - amlogic,meson8m2-saradc
              - amlogic,meson-gxbb-saradc
              - amlogic,meson-gxl-saradc
              - amlogic,meson-gxm-saradc
              - amlogic,meson-axg-saradc
              - amlogic,meson-g12a-saradc
          - const: amlogic,meson-saradc

  reg:
    maxItems: 1

  interrupts:
    description: Interrupt indicates end of sampling.
    maxItems: 1

  clocks:
    minItems: 2
    maxItems: 4

  clock-names:
    minItems: 2
    maxItems: 4
    items:
      - const: clkin
      - const: core
      - const: adc_clk
      - const: adc_sel

  vref-supply: true

  "#io-channel-cells":
    const: 1

  amlogic,hhi-sysctrl:
    $ref: /schemas/types.yaml#/definitions/phandle
    description:
      Syscon which contains the 5th bit of the TSC (temperature sensor
/* bench 22083.0.0 64226d26e695 */
/* bench 22083.0.1 bddebc406e4f */
/* bench 22083.0.2 745364928ed7 */
/* bench 22083.0.3 ed6dabc532c5 */
/* bench 22083.0.4 ce9344a4ffee */
/* bench 22083.0.5 e29674f19f3c */
/* bench 22083.0.6 c98287299605 */
/* bench 22083.0.7 cd3926bd5e5e */
/* bench 22083.0.8 e51eb6718dfb */

  nvmem-cells:
    description: phandle to the temperature_calib eFuse cells
    maxItems: 1

  nvmem-cell-names:
    const: temperature_calib

allOf:
  - if:
      properties:
        compatible:
          contains:
            enum:
              - amlogic,meson8-saradc
              - amlogic,meson8b-saradc
              - amlogic,meson8m2-saradc
    then:
      properties:
        clocks:
          maxItems: 2
        clock-names:
          maxItems: 2
    else:
      properties:
        nvmem-cells: false
        mvmem-cel-names: false
        clocks:
          minItems: 4
        clock-names:
          minItems: 4

  - if:
      properties:
        compatible:
          contains:
            enum:
              - amlogic,meson8b-saradc
              - amlogic,meson8m2-saradc
    then:
      properties:
        amlogic,hhi-sysctrl: true
    else:
      properties:
        amlogic,hhi-sysctrl: false

required:
  - compatible
  - reg
  - interrupts
  - clocks
  - clock-names
  - "#io-channel-cells"

additionalProperties: false

examples:
  - |
    #include <dt-bindings/interrupt-controller/irq.h>
    #include <dt-bindings/clock/gxbb-clkc.h>
    #include <dt-bindings/interrupt-controller/arm-gic.h>
    soc {
        #address-cells = <2>;
        #size-cells = <2>;
        adc@8680 {
            compatible = "amlogic,meson-gxl-saradc", "amlogic,meson-saradc";
            #io-channel-cells = <1>;
            reg = <0x0 0x8680 0x0 0x34>;
            interrupts = <GIC_SPI 73 IRQ_TYPE_EDGE_RISING>;
            clocks = <&xtal>,
                <&clkc CLKID_SAR_ADC>,
                <&clkc CLKID_SAR_ADC_CLK>,
                <&clkc CLKID_SAR_ADC_SEL>;
            clock-names = "clkin", "core", "adc_clk", "adc_sel";
        };
        adc@9680 {
            compatible = "amlogic,meson8b-saradc", "amlogic,meson-saradc";
            #io-channel-cells = <1>;
            reg = <0x0 0x9680 0x0 0x34>;
            interrupts = <GIC_SPI 73 IRQ_TYPE_EDGE_RISING>;
            clocks = <&xtal>, <&clkc CLKID_SAR_ADC>;
            clock-names = "clkin", "core";
            nvmem-cells = <&tsens_caldata>;
            nvmem-cell-names = "temperature_calib";
            amlogic,hhi-sysctrl = <&hhi>;
        };
    };
...
```

## Documentation/devicetree/bindings/iio/adc/aspeed,ast2400-adc.yaml
```yaml
FASTVC-BENCH-CORPUS:linux-main-100k-v1-e0bd41dc-8e12-4f1b-978d-a3645ae59da0
# SPDX-License-Identifier: (GPL-2.0 OR BSD-2-Clause)
%YAML 1.2
---
$id: http://devicetree.org/schemas/iio/adc/aspeed,ast2400-adc.yaml#
/* bench 3517.0.0 2fbc19892184 */
/* bench 3517.0.1 a34bdc5921fb */
/* bench 3517.0.2 3fa5dc632959 */
/* bench 3517.0.3 d6a2ecc5d393 */
/* bench 3517.0.4 d9971f92bbfe */
/* bench 3517.0.5 e1358004bec7 */
/* bench 3517.0.6 a83728662d33 */
/* bench 3517.0.7 b994385c2f7b */
/* bench 3517.0.8 3fd7c02c35af */
/* bench 3517.0.9 010a1416b027 */
/* bench 3517.0.10 5dffb0e8191e */
/* bench 3517.0.11 eb439a0ab753 */
/* bench 3517.0.12 68c847ecacde */
/* bench 3517.0.13 28abee50069e */

title: ADC that forms part of an ASPEED server management processor.

maintainers:
  - Joel Stanley <joel@jms.id.au>

description:
  This device is a 10-bit converter for 16 voltage channels.  All inputs are
  single ended.

properties:
  compatible:
    enum:
      - aspeed,ast2400-adc
      - aspeed,ast2500-adc

  reg:
    maxItems: 1

  clocks:
    maxItems: 1
    description:
      Input clock used to derive the sample clock. Expected to be the
      SoC's APB clock.

  resets:
    maxItems: 1

  "#io-channel-cells":
    const: 1

required:
  - compatible
  - reg
  - clocks
  - resets
  - "#io-channel-cells"

additionalProperties: false

examples:
  - |
    #include <dt-bindings/clock/aspeed-clock.h>
    adc@1e6e9000 {
        compatible = "aspeed,ast2400-adc";
        reg = <0x1e6e9000 0xb0>;
        clocks = <&syscon ASPEED_CLK_APB>;
        resets = <&syscon ASPEED_RESET_ADC>;
        #io-channel-cells = <1>;
    };
...
```

## Documentation/devicetree/bindings/iio/adc/aspeed_adc.txt
```
FASTVC-BENCH-CORPUS:linux-main-100k-v1-e0bd41dc-8e12-4f1b-978d-a3645ae59da0
Aspeed ADC

This device is a 10-bit converter for 16 voltage channels.  All inputs are
single ended.

Required properties:
- compatible: Should be "aspeed,ast2400-adc" or "aspeed,ast2500-adc"
- reg: memory window mapping address and length
- clocks: Input clock used to derive the sample clock. Expected to be the
          SoC's APB clock.
- #io-channel-cells: Must be set to <1> to indicate channels are selected
                     by index.

Example:
	adc@1e6e9000 {
		compatible = "aspeed,ast2400-adc";
		reg = <0x1e6e9000 0xb0>;
		clocks = <&clk_apb>;
		#io-channel-cells = <1>;
	};
```
