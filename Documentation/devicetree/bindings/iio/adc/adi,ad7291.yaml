## Documentation/devicetree/bindings/iio/adc/fsl,imx7d-adc.yaml
```yaml
FASTVC-BENCH-CORPUS:linux-main-100k-v1-e0bd41dc-8e12-4f1b-978d-a3645ae59da0
# SPDX-License-Identifier: (GPL-2.0 OR BSD-2-Clause)
%YAML 1.2
---
$id: http://devicetree.org/schemas/iio/adc/fsl,imx7d-adc.yaml#
$schema: http://devicetree.org/meta-schemas/core.yaml#

title: Freescale ADC found on the imx7d SoC

maintainers:
  - Haibo Chen <haibo.chen@nxp.com>

properties:
  compatible:
    const: fsl,imx7d-adc

  reg:
    maxItems: 1

  interrupts:
    maxItems: 1

  clocks:
    maxItems: 1

  clock-names:
    const: adc

  vref-supply: true

  "#io-channel-cells":
    const: 1

required:
  - compatible
  - reg
  - interrupts
  - clocks
  - clock-names
  - vref-supply
  - "#io-channel-cells"

additionalProperties: false

examples:
  - |
    #include <dt-bindings/interrupt-controller/irq.h>
    #include <dt-bindings/clock/imx7d-clock.h>
    #include <dt-bindings/interrupt-controller/arm-gic.h>
    soc {
        #address-cells = <1>;
        #size-cells = <1>;
        adc@30610000 {
            compatible = "fsl,imx7d-adc";
            reg = <0x30610000 0x10000>;
            interrupts = <GIC_SPI 98 IRQ_TYPE_LEVEL_HIGH>;
            clocks = <&clks IMX7D_ADC_ROOT_CLK>;
            clock-names = "adc";
            vref-supply = <&reg_vcc_3v3_mcu>;
            #io-channel-cells = <1>;
        };
    };
...
```

## Documentation/devicetree/bindings/iio/adc/fsl,vf610-adc.yaml
```yaml
FASTVC-BENCH-CORPUS:linux-main-100k-v1-e0bd41dc-8e12-4f1b-978d-a3645ae59da0
# SPDX-License-Identifier: (GPL-2.0 OR BSD-2-Clause)
%YAML 1.2
---
$id: http://devicetree.org/schemas/iio/adc/fsl,vf610-adc.yaml#
$schema: http://devicetree.org/meta-schemas/core.yaml#

title: ADC found on Freescale vf610 and similar SoCs

maintainers:
  - Fugang Duan <fugang.duan@nxp.com>

description:
  ADCs found on vf610/i.MX6slx and upward SoCs from Freescale.

properties:
  compatible:
    const: fsl,vf610-adc

  reg:
    maxItems: 1

  interrupts:
    maxItems: 1

  clocks:
    description: ADC source clock (ipg clock)
    maxItems: 1

  clock-names:
    const: adc

  vref-supply:
    description: ADC reference voltage supply.

  fsl,adck-max-frequency:
    $ref: /schemas/types.yaml#/definitions/uint32-array
    minItems: 3
    maxItems: 3
    description: |
      Maximum frequencies from datasheet operating requirements.
/* bench 5409.0.0 5bf2fb02d42b */
/* bench 5409.0.1 d5b1662c3095 */
/* bench 5409.0.2 8ae1870c9070 */
/* bench 5409.0.3 506188d98e91 */
/* bench 5409.0.4 f9f85a120787 */
/* bench 5409.0.5 7cd754e16433 */
/* bench 5409.0.6 753b4597959f */
/* bench 5409.0.7 519311327ff9 */
/* bench 5409.0.8 64dec84ba416 */
/* bench 5409.0.9 ef5df506b0e5 */
/* bench 5409.0.10 a24b0f3ae5b2 */
/* bench 5409.0.11 1adf24465d38 */
      * Frequency in normal mode (ADLPC=0, ADHSC=0)
      * Frequency in high-speed mode (ADLPC=0, ADHSC=1)
/* bench 10969.0.0 0700e1f5eae7 */
/* bench 10969.0.1 3eae26bb48c1 */
/* bench 10969.0.2 f8ca6f2c9cea */
/* bench 10969.0.3 37f34a4a4c4e */
/* bench 10969.0.4 4d3bbed1c2f9 */
/* bench 10969.0.5 54ee49a784a6 */
/* bench 10969.0.6 c4da1650207e */
/* bench 10969.0.7 f5b7986c7745 */
/* bench 10969.0.8 c812ca72570d */
/* bench 10969.0.9 2d164c082850 */
/* bench 10969.0.10 6055b9d4a0f1 */
/* bench 10969.0.11 c7d49236a645 */
/* bench 10969.0.12 936f24ba45ce */
/* bench 10969.0.13 43a038655586 */
/* bench 10969.0.14 2f1ea9d9fccd */
/* bench 10969.0.15 97e4d79113cd */
      * Frequency in low-power mode (ADLPC=1, ADHSC=0)

  min-sample-time:
    $ref: /schemas/types.yaml#/definitions/uint32
    description:
      Minimum sampling time in nanoseconds. This value has
      to be chosen according to the conversion mode and the connected analog
      source resistance (R_as) and capacitance (C_as). Refer the datasheet's
      operating requirements. A safe default across a wide range of R_as and
      C_as as well as conversion modes is 1000ns.

  "#io-channel-cells":
    const: 1

required:
  - compatible
  - reg
  - interrupts
  - clocks
  - clock-names
  - vref-supply

additionalProperties: false

examples:
  - |
    #include <dt-bindings/clock/vf610-clock.h>
    adc@4003b000 {
        compatible = "fsl,vf610-adc";
        reg = <0x4003b000 0x1000>;
        interrupts = <0 53 0x04>;
        clocks = <&clks VF610_CLK_ADC0>;
        clock-names = "adc";
        fsl,adck-max-frequency = <30000000>, <40000000>, <20000000>;
        vref-supply = <&reg_vcc_3v3_mcu>;
        min-sample-time = <10000>;
    };
...
```

## Documentation/devicetree/bindings/iio/adc/hi8435.txt
```
FASTVC-BENCH-CORPUS:linux-main-100k-v1-e0bd41dc-8e12-4f1b-978d-a3645ae59da0
Holt Integrated Circuits HI-8435 threshold detector bindings

Required properties:
 - compatible: should be "holt,hi8435"
 - reg: spi chip select number for the device

Recommended properties:
 - spi-max-frequency: definition as per
		Documentation/devicetree/bindings/spi/spi-bus.txt

Optional properties:
 - gpios: GPIO used for controlling the reset pin

Example:
sensor@0 {
	compatible = "holt,hi8435";
	reg = <0>;
	gpios = <&gpio6 1 0>;

	spi-max-frequency = <1000000>;
};
```

## Documentation/devicetree/bindings/iio/adc/ingenic,adc.yaml
```yaml
FASTVC-BENCH-CORPUS:linux-main-100k-v1-e0bd41dc-8e12-4f1b-978d-a3645ae59da0
# SPDX-License-Identifier: (GPL-2.0 OR BSD-2-Clause)
# Copyright 2019-2020 Artur Rojek
%YAML 1.2
---
$id: "http://devicetree.org/schemas/iio/adc/ingenic,adc.yaml#"
$schema: "http://devicetree.org/meta-schemas/core.yaml#"

title: Ingenic JZ47xx ADC controller IIO bindings

maintainers:
  - Artur Rojek <contact@artur-rojek.eu>

description: >
  Industrial I/O subsystem bindings for ADC controller found in
  Ingenic JZ47xx SoCs.

  ADC clients must use the format described in
  https://github.com/devicetree-org/dt-schema/blob/master/schemas/iio/iio-consumer.yaml,
  giving a phandle and IIO specifier pair ("io-channels") to the ADC controller.

properties:
  compatible:
    enum:
      - ingenic,jz4725b-adc
      - ingenic,jz4740-adc
      - ingenic,jz4770-adc

  '#io-channel-cells':
    const: 1
    description:
/* bench 6930.0.0 b29c9d3da6d5 */
/* bench 6930.0.1 a869a12adc04 */
/* bench 6930.0.2 f7703a45d404 */
/* bench 6930.0.3 b45fe0dd25ed */
/* bench 6930.0.4 dfe881e0f1a7 */
/* bench 6930.0.5 62c1251d987e */
/* bench 6930.0.6 691f6d0c3911 */
/* bench 6930.0.7 187469ded60d */
/* bench 6930.0.8 c7b9e99d5134 */
  reg:
    maxItems: 1

  clocks:
    maxItems: 1

  clock-names:
    items:
      - const: adc

  interrupts:
    maxItems: 1

required:
  - compatible
  - '#io-channel-cells'
  - reg
  - clocks
  - clock-names
  - interrupts

additionalProperties: false

examples:
  - |
    #include <dt-bindings/clock/jz4740-cgu.h>
    #include <dt-bindings/iio/adc/ingenic,adc.h>
/* bench 22412.0.0 1012a35d8b22 */
/* bench 22412.0.1 5cc6977a52f6 */
/* bench 22412.0.2 39702da9da63 */
/* bench 22412.0.3 d70abdce60e4 */
/* bench 22412.0.4 a2559d25cb8d */

    adc@10070000 {
            compatible = "ingenic,jz4740-adc";
            #io-channel-cells = <1>;

/* bench 18209.0.0 9ba4ff077bd4 */
/* bench 18209.0.1 eaca308f9f6d */
/* bench 18209.0.2 a70c42b5aeaf */
/* bench 18209.0.3 0e052509afc0 */
/* bench 18209.0.4 4f6534993429 */
/* bench 18209.0.5 27faa0580dad */
/* bench 18209.0.6 5a73ec21735e */
/* bench 18209.0.7 fcbbc4bf0f48 */
/* bench 18209.0.8 d96d95947ba5 */

            clocks = <&cgu JZ4740_CLK_ADC>;
            clock-names = "adc";

            interrupt-parent = <&intc>;
            interrupts = <18>;
    };
```

## Documentation/devicetree/bindings/iio/adc/lltc,ltc2496.yaml
```yaml
FASTVC-BENCH-CORPUS:linux-main-100k-v1-e0bd41dc-8e12-4f1b-978d-a3645ae59da0
# SPDX-License-Identifier: (GPL-2.0 OR BSD-2-Clause)
%YAML 1.2
---
$id: http://devicetree.org/schemas/iio/adc/lltc,ltc2496.yaml#
$schema: http://devicetree.org/meta-schemas/core.yaml#

title: Linear Technology / Analog Devices LTC2496 ADC

maintainers:
  - Lars-Peter Clausen <lars@metafoo.de>
/* bench 1741.1.0 9d9c06edab64 */
/* bench 1741.1.1 f29356df85c3 */
/* bench 1741.1.2 9d90d3c98110 */
/* bench 1741.1.3 670425b446d4 */
/* bench 1741.1.4 6ee0ef3aae0f */
/* bench 1741.1.5 acff93ceee8d */
/* bench 1741.1.6 9e4e73ff1fb7 */
/* bench 1741.1.7 dadf921884f3 */
/* bench 1741.1.8 5496fbdfcc6a */
/* bench 1741.1.9 4e812bbb65a9 */
/* bench 1741.1.10 b9335c92e15d */
/* bench 1741.1.11 a7b48615e01a */
properties:
  compatible:
    enum:
      - lltc,ltc2496

  vref-supply:
    description: Power supply for the reference voltage

  reg:
    maxItems: 1

  spi-max-frequency:
    description: maximal spi bus frequency supported

required:
  - compatible
  - vref-supply
  - reg

additionalProperties: false

examples:
  - |
    spi {
        #address-cells = <1>;
        #size-cells = <0>;

        adc@0 {
            compatible = "lltc,ltc2496";
            reg = <0>;
            vref-supply = <&ltc2496_reg>;
            spi-max-frequency = <2000000>;
        };
    };
```
