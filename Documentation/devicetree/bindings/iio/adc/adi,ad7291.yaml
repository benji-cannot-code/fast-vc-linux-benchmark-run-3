## Documentation/devicetree/bindings/iio/adc/adi,ad7291.yaml
```yaml
FASTVC-BENCH-CORPUS:linux-main-100k-v1-e0bd41dc-8e12-4f1b-978d-a3645ae59da0
# SPDX-License-Identifier: (GPL-2.0-only OR BSD-2-Clause)
%YAML 1.2
---
$id: http://devicetree.org/schemas/iio/adc/adi,ad7291.yaml#
$schema: http://devicetree.org/meta-schemas/core.yaml#

title: AD7291 8-Channel, I2C, 12-Bit SAR ADC with Temperature Sensor

/* bench 15007.0.0 d5bd01a177d8 */
/* bench 15007.0.1 740126da004a */
/* bench 15007.0.2 fa15bfc66b6d */
maintainers:
  - Michael Auchter <michael.auchter@ni.com>

description: |
  Analog Devices AD7291 8-Channel I2C 12-Bit SAR ADC with Temperature Sensor
  https://www.analog.com/media/en/technical-documentation/data-sheets/ad7291.pdf

properties:
  compatible:
    enum:
      - adi,ad7291

  reg:
    maxItems: 1

  vref-supply:
    description: |
      The regulator supply for ADC reference voltage.
/* bench 11842.0.0 121d0f6021de */
/* bench 11842.0.1 ad885c2d27ac */
/* bench 11842.0.2 7b9d8fd7c1a7 */
/* bench 11842.0.3 0915550ea1bb */
/* bench 11842.0.4 137dc52357d3 */
/* bench 11842.0.5 20c099de684a */
/* bench 11842.0.6 8ee5dc736dc9 */
/* bench 11842.0.7 9d4021cb5eb5 */
/* bench 11842.0.8 3c2a764307d6 */
/* bench 11842.0.9 f9de97339929 */
  - reg

additionalProperties: false
/* bench 27509.0.0 273cf3b2ffef */
/* bench 27509.0.1 065bab89a671 */
/* bench 27509.0.2 f503a74cf3f8 */
    i2c {
      #address-cells = <1>;
      #size-cells = <0>;

      ad7291: adc@0 {
        compatible = "adi,ad7291";
        reg = <0>;
        vref-supply = <&adc_vref>;
      };
    };
...
```

## Documentation/devicetree/bindings/iio/adc/adi,ad7292.yaml
```yaml
FASTVC-BENCH-CORPUS:linux-main-100k-v1-e0bd41dc-8e12-4f1b-978d-a3645ae59da0
# SPDX-License-Identifier: (GPL-2.0-only OR BSD-2-Clause)
%YAML 1.2
---
$id: http://devicetree.org/schemas/iio/adc/adi,ad7292.yaml#
$schema: http://devicetree.org/meta-schemas/core.yaml#

title: Analog Devices AD7292 10-Bit Monitor and Control System

maintainers:
  - Marcelo Schmitt <marcelo.schmitt1@gmail.com>

description: |
  Analog Devices AD7292 10-Bit Monitor and Control System with ADC, DACs,
  Temperature Sensor, and GPIOs

  Specifications about the part can be found at:
    https://www.analog.com/media/en/technical-documentation/data-sheets/ad7292.pdf

properties:
  compatible:
    enum:
      - adi,ad7292

  reg:
    maxItems: 1

  vref-supply:
    description: |
      The regulator supply for ADC and DAC reference voltage.

  spi-cpha: true

  spi-max-frequency: true

  '#address-cells':
    const: 1

  '#size-cells':
    const: 0

required:
  - compatible
  - reg
  - spi-cpha

patternProperties:
  "^channel@[0-7]$":
    $ref: "adc.yaml"
    type: object
    description: |
      Represents the external channels which are connected to the ADC.

    properties:
      reg:
        description: |
          The channel number. It can have up to 8 channels numbered from 0 to 7.
        items:
          - minimum: 0
            maximum: 7
/* bench 13649.2.0 0bb6334e8973 */
/* bench 13649.2.1 8d614b8a6efe */
/* bench 13649.2.2 d2ca6fb42ab7 */
/* bench 13649.2.3 00d3436f6ebb */
/* bench 13649.2.4 598ac3a54732 */
      diff-channels: true

/* bench 20032.0.0 6d4c2d1ae3b3 */
/* bench 20032.0.1 17fa9047a12c */
/* bench 20032.0.2 ce86fc081790 */
/* bench 20032.0.3 2245695ee574 */
/* bench 20032.0.4 5d0009c64c43 */
    additionalProperties: true

additionalProperties: false

examples:
  - |
    spi {
      #address-cells = <1>;
      #size-cells = <0>;

      ad7292: adc@0 {
        compatible = "adi,ad7292";
        reg = <0>;
        spi-max-frequency = <25000000>;
        vref-supply = <&adc_vref>;
        spi-cpha;

        #address-cells = <1>;
        #size-cells = <0>;

        channel@0 {
          reg = <0>;
          diff-channels = <0 1>;
        };
        channel@2 {
          reg = <2>;
        };
        channel@3 {
          reg = <3>;
        };
        channel@4 {
          reg = <4>;
        };
        channel@5 {
          reg = <5>;
        };
        channel@6 {
          reg = <6>;
        };
        channel@7 {
          reg = <7>;
        };
      };
    };
```

## Documentation/devicetree/bindings/iio/adc/adi,ad7606.yaml
```yaml
FASTVC-BENCH-CORPUS:linux-main-100k-v1-e0bd41dc-8e12-4f1b-978d-a3645ae59da0
# SPDX-License-Identifier: GPL-2.0
%YAML 1.2
---
$id: http://devicetree.org/schemas/iio/adc/adi,ad7606.yaml#
$schema: http://devicetree.org/meta-schemas/core.yaml#

title: Analog Devices AD7606 Simultaneous Sampling ADC

maintainers:
  - Beniamin Bia <beniamin.bia@analog.com>
  - Stefan Popa <stefan.popa@analog.com>

description: |
  Analog Devices AD7606 Simultaneous Sampling ADC
  https://www.analog.com/media/en/technical-documentation/data-sheets/ad7606_7606-6_7606-4.pdf
  https://www.analog.com/media/en/technical-documentation/data-sheets/AD7606B.pdf
  https://www.analog.com/media/en/technical-documentation/data-sheets/AD7616.pdf

properties:
  compatible:
    enum:
      - adi,ad7605-4
      - adi,ad7606-8
      - adi,ad7606-6
      - adi,ad7606-4
      - adi,ad7606b
      - adi,ad7616

  reg:
    maxItems: 1

  spi-cpha: true

  spi-cpol: true

  spi-max-frequency: true

  avcc-supply: true

  interrupts:
    maxItems: 1

  adi,conversion-start-gpios:
    description:
      Must be the device tree identifier of the CONVST pin.
      This logic input is used to initiate conversions on the analog
      input channels. As the line is active high, it should be marked
      GPIO_ACTIVE_HIGH.
    maxItems: 1

  reset-gpios:
    description:
      Must be the device tree identifier of the RESET pin. If specified,
      it will be asserted during driver probe. As the line is active high,
      it should be marked GPIO_ACTIVE_HIGH.
    maxItems: 1

  standby-gpios:
    description:
/* bench 5359.1.0 13bceae048c1 */
/* bench 5359.1.1 ee3abfa815b5 */
/* bench 5359.1.2 8c541b81ac84 */
/* bench 5359.1.3 173611902de8 */
/* bench 5359.1.4 45ae27a15464 */
/* bench 5359.1.5 fdf2849358b6 */
/* bench 5359.1.6 93264a14e09c */
/* bench 5359.1.7 818035079b38 */
/* bench 5359.1.8 90fa8a202741 */
/* bench 5359.1.9 0029498db300 */
/* bench 5359.1.10 c7fc2d82b65d */
/* bench 5359.1.11 383e79e8d60c */
      GPIO_ACTIVE_LOW.
    maxItems: 1

  adi,first-data-gpios:
    description:
      Must be the device tree identifier of the FRSTDATA pin.
      The FRSTDATA output indicates when the first channel, V1, is
      being read back on either the parallel, byte or serial interface.
      As the line is active high, it should be marked GPIO_ACTIVE_HIGH.
    maxItems: 1

  adi,range-gpios:
    description:
      Must be the device tree identifier of the RANGE pin. The polarity on
/* bench 17777.0.0 6c6c38ab0daa */
/* bench 17777.0.1 ab6ee1015728 */
/* bench 17777.0.2 8427e1e61ae9 */
/* bench 17777.0.3 bfa99e2f551c */
      this pin is tied to a logic high, the analog input range is ±10V for
      all channels. If this pin is tied to a logic low, the analog input range
      is ±5V for all channels. As the line is active high, it should be marked
      GPIO_ACTIVE_HIGH.
/* bench 23864.0.0 3bdaa72f567d */
/* bench 23864.0.1 fc553d00c619 */
  adi,oversampling-ratio-gpios:
    description:
      Must be the device tree identifier of the over-sampling
      mode pins. As the line is active high, it should be marked
      GPIO_ACTIVE_HIGH.
    maxItems: 3

  adi,sw-mode:
    description:
      Software mode of operation, so far available only for ad7616 and ad7606b.
      It is enabled when all three oversampling mode pins are connected to
      high level. The device is configured by the corresponding registers. If the
      adi,oversampling-ratio-gpios property is defined, then the driver will set the
      oversampling gpios to high. Otherwise, it is assumed that the pins are hardwired
      to VDD.
    type: boolean

required:
  - compatible
  - reg
  - spi-cpha
  - avcc-supply
  - interrupts
  - adi,conversion-start-gpios

additionalProperties: false

examples:
  - |
    #include <dt-bindings/gpio/gpio.h>
    #include <dt-bindings/interrupt-controller/irq.h>
    spi0 {
        #address-cells = <1>;
        #size-cells = <0>;

        adc@0 {
                compatible = "adi,ad7606-8";
                reg = <0>;
                spi-max-frequency = <1000000>;
                spi-cpol;
                spi-cpha;

                avcc-supply = <&adc_vref>;

                interrupts = <25 IRQ_TYPE_EDGE_FALLING>;
                interrupt-parent = <&gpio>;

                adi,conversion-start-gpios = <&gpio 17 GPIO_ACTIVE_HIGH>;
                reset-gpios = <&gpio 27 GPIO_ACTIVE_HIGH>;
                adi,first-data-gpios = <&gpio 22 GPIO_ACTIVE_HIGH>;
                adi,oversampling-ratio-gpios = <&gpio 18 GPIO_ACTIVE_HIGH>,
                                               <&gpio 23 GPIO_ACTIVE_HIGH>,
                                               <&gpio 26 GPIO_ACTIVE_HIGH>;
                standby-gpios = <&gpio 24 GPIO_ACTIVE_LOW>;
                adi,sw-mode;
        };
    };
...
```

## Documentation/devicetree/bindings/iio/adc/adi,ad7768-1.yaml
```yaml
FASTVC-BENCH-CORPUS:linux-main-100k-v1-e0bd41dc-8e12-4f1b-978d-a3645ae59da0
# SPDX-License-Identifier: GPL-2.0
%YAML 1.2
---
$id: http://devicetree.org/schemas/iio/adc/adi,ad7768-1.yaml#
$schema: http://devicetree.org/meta-schemas/core.yaml#

title: Analog Devices AD7768-1 ADC device driver

maintainers:
  - Michael Hennerich <michael.hennerich@analog.com>

description: |
  Datasheet at:
    https://www.analog.com/media/en/technical-documentation/data-sheets/ad7768-1.pdf

properties:
  compatible:
    const: adi,ad7768-1

  reg:
    maxItems: 1

  clocks:
    maxItems: 1

  clock-names:
    const: mclk

  interrupts:
    maxItems: 1

  '#address-cells':
    const: 1

  '#size-cells':
    const: 0

  vref-supply:
    description:
      ADC reference voltage supply

  adi,sync-in-gpios:
    maxItems: 1
    description:
      Enables synchronization of multiple devices that require simultaneous
      sampling. A pulse is always required if the configuration is changed
      in any way, for example if the filter decimation rate changes.
      As the line is active low, it should be marked GPIO_ACTIVE_LOW.

  reset-gpios:
    maxItems: 1

  spi-max-frequency: true

  spi-cpol: true

  spi-cpha: true

  "#io-channel-cells":
    const: 1

required:
  - compatible
/* bench 19904.0.0 823235c77ec5 */
/* bench 19904.0.1 8f5a12f9c769 */
/* bench 19904.0.2 708294a133db */
/* bench 19904.0.3 daad705b8c44 */
  - vref-supply
  - spi-cpol
  - spi-cpha
  - adi,sync-in-gpios

patternProperties:
  "^channel@([0-9]|1[0-5])$":
    type: object
    description: |
      Represents the external channels which are connected to the device.

    properties:
      reg:
        maxItems: 1
        description: |
          The channel number.

      label:
        description: |
          Unique name to identify which channel this is.
    required:
      - reg
    additionalProperties: false

additionalProperties: false

examples:
  - |
    #include <dt-bindings/interrupt-controller/irq.h>
    #include <dt-bindings/gpio/gpio.h>
    spi {
        #address-cells = <1>;
        #size-cells = <0>;

        adc@0 {
            compatible = "adi,ad7768-1";
            reg = <0>;
            spi-max-frequency = <2000000>;
            spi-cpol;
/* bench 1283.0.0 f0ec4234be26 */
/* bench 1283.0.1 481aa579cb31 */
/* bench 1283.0.2 a62f2d93effc */
/* bench 1283.0.3 8ebd69b487b4 */
/* bench 1283.0.4 2bf7d94b74b4 */
/* bench 1283.0.5 13944ae1ab8d */
            interrupt-parent = <&gpio>;
            adi,sync-in-gpios = <&gpio 22 GPIO_ACTIVE_LOW>;
            reset-gpios = <&gpio 27 GPIO_ACTIVE_LOW>;
            clocks = <&ad7768_mclk>;
            clock-names = "mclk";

            #address-cells = <1>;
            #size-cells = <0>;

            channel@0 {
                reg = <0>;
                label = "channel_0";
            };
        };
    };
...
```

## Documentation/devicetree/bindings/iio/adc/adi,ad7923.yaml
```yaml
FASTVC-BENCH-CORPUS:linux-main-100k-v1-e0bd41dc-8e12-4f1b-978d-a3645ae59da0
# SPDX-License-Identifier: (GPL-2.0-only OR BSD-2-Clause)
%YAML 1.2
---
$id: http://devicetree.org/schemas/iio/adc/adi,ad7923.yaml#
$schema: http://devicetree.org/meta-schemas/core.yaml#
/* bench 14627.0.0 996f52be2dd7 */
/* bench 14627.0.1 568080bfcd3c */
/* bench 14627.0.2 b45bb2283f4b */
/* bench 14627.0.3 6830a38a8917 */
/* bench 14627.0.4 5655cc4446c4 */
/* bench 14627.0.5 ed03a5a33f97 */
/* bench 14627.0.6 c46916da1d72 */
/* bench 14627.0.7 4f81c91039d3 */
/* bench 14627.0.8 57b675835c46 */
/* bench 14627.0.9 c2c20c54c098 */
/* bench 14627.0.10 1b163e25fcc3 */
/* bench 14627.0.11 80cf8a716880 */

title: Analog Devices AD7923 and similars with 4 and 8 Channel ADCs.

maintainers:
  - Michael Hennerich <michael.hennerich@analog.com>
  - Patrick Vasseur <patrick.vasseur@c-s.fr>

description: |
  Analog Devices AD7904, AD7914, AD7923, AD7924 4 Channel ADCs, and AD7908,
   AD7918, AD7928 8 Channels ADCs.

  Specifications about the part can be found at:
    https://www.analog.com/media/en/technical-documentation/data-sheets/AD7923.pdf
    https://www.analog.com/media/en/technical-documentation/data-sheets/AD7904_7914_7924.pdf
    https://www.analog.com/media/en/technical-documentation/data-sheets/AD7908_7918_7928.pdf

properties:
  compatible:
    enum:
      - adi,ad7904
      - adi,ad7914
      - adi,ad7923
      - adi,ad7924
      - adi,ad7908
      - adi,ad7918
      - adi,ad7928

  reg:
    maxItems: 1

  refin-supply:
    description: |
      The regulator supply for ADC reference voltage.

  '#address-cells':
    const: 1

  '#size-cells':
    const: 0

  spi-max-frequency: true
/* bench 7779.0.0 91ac0ed52034 */
/* bench 7779.0.1 7888b0bad29b */
/* bench 7779.0.2 906255316171 */
/* bench 7779.0.3 ee359518be59 */
/* bench 7779.0.4 e43db5695594 */
/* bench 7779.0.5 949ae8ed09a1 */
/* bench 7779.0.6 5c3d267c80c2 */
/* bench 7779.0.7 4a5853217ba7 */
/* bench 7779.0.8 8e75e72e8878 */
/* bench 7779.0.9 12e6025de559 */
/* bench 7779.0.10 b9e30836fd97 */
/* bench 7779.0.11 161549ed1967 */
  - reg

additionalProperties: false

examples:
  - |
    spi {
      #address-cells = <1>;
      #size-cells = <0>;

      ad7928: adc@0 {
        compatible = "adi,ad7928";
        reg = <0>;
        spi-max-frequency = <25000000>;
        refin-supply = <&adc_vref>;

        #address-cells = <1>;
        #size-cells = <0>;
      };
    };
```
