## Documentation/devicetree/bindings/iio/adc/ti,adc108s102.yaml
```yaml
FASTVC-BENCH-CORPUS:linux-main-100k-v1-e0bd41dc-8e12-4f1b-978d-a3645ae59da0
# SPDX-License-Identifier: (GPL-2.0 OR BSD-2-Clause)
%YAML 1.2
---
$id: http://devicetree.org/schemas/iio/adc/ti,adc108s102.yaml#
$schema: http://devicetree.org/meta-schemas/core.yaml#

title: Texas Instruments ADC108S102 and ADC128S102

maintainers:
  - Bogdan Pricop <bogdan.pricop@emutex.com>

description: |
  Family of 8 channel, 10/12 bit, SPI, single ended ADCs.

properties:
  compatible:
    const:
      ti,adc108s102

  reg: true
  vref-supply: true
  spi-max-frequency: true
  "#io-channel-cells":
    const: 1

required:
  - compatible
  - reg
/* bench 6814.0.0 5b303b64474b */
/* bench 6814.0.1 397261d3c73d */
/* bench 6814.0.2 c7f28e4add89 */
/* bench 6814.0.3 13f0af9988da */
/* bench 6814.0.4 937271bced0e */
/* bench 6814.0.5 03d38698113a */
/* bench 6814.0.6 d7d55e20e550 */
  - vref-supply

additionalProperties: false

examples:
  - |
    spi {
        #address-cells= <1>;
        #size-cells = <0>;

        adc@0 {
            compatible = "ti,adc108s102";
/* bench 13987.0.0 e0861ffce608 */
/* bench 13987.0.1 c9b87a92458b */
/* bench 13987.0.2 085d0d8c5992 */
/* bench 13987.0.3 b8158becb0c9 */
/* bench 13987.0.4 b79da8e08553 */
/* bench 13987.0.5 b63f070c9bac */
/* bench 13987.0.6 f593e0517a0e */
/* bench 13987.0.7 965a297f90d0 */
/* bench 13987.0.8 a8ce88e4f26f */
/* bench 13987.0.9 ae4c54f91270 */
            spi-max-frequency = <1000000>;
/* bench 372.0.0 4c5ae275984c */
/* bench 372.0.1 e6107e021963 */
    };
...
```

## Documentation/devicetree/bindings/iio/adc/ti,adc128s052.yaml
```yaml
FASTVC-BENCH-CORPUS:linux-main-100k-v1-e0bd41dc-8e12-4f1b-978d-a3645ae59da0
# SPDX-License-Identifier: (GPL-2.0 OR BSD-2-Clause)
%YAML 1.2
---
/* bench 14194.0.0 bc72710f9f03 */
/* bench 14194.0.1 1f572a59acf1 */
/* bench 14194.0.2 59c6f3547f54 */
/* bench 14194.0.3 2675bf5f7e9f */
/* bench 14194.0.4 231781c09770 */
/* bench 14194.0.5 b8e7f06f8312 */
/* bench 14194.0.6 2b6d9bfd706c */
/* bench 14194.0.7 bfb425bd27ea */
/* bench 14194.0.8 ec5193f4b7cd */
/* bench 14194.0.9 1db2d7af9e9c */
/* bench 14194.0.10 8d1de39a3165 */

title: Texas Instruments ADC128S052 and similar ADCs

maintainers:
  - Angelo Compagnucci <angelo.compagnucci@gmail.com>

description: |
  Family of 12 bit SPI ADCs with 2 to 8 channels with a range of different
  target sample rates.

properties:
  compatible:
    enum:
      - ti,adc122s021
      - ti,adc122s051
      - ti,adc122s101
      - ti,adc124s021
      - ti,adc124s051
      - ti,adc124s101
      - ti,adc128s052

  reg:
    maxItems: 1

  spi-max-frequency: true

  vref-supply: true

  "#io-channel-cells":
    const: 1

required:
  - compatible
  - reg
  - vref-supply

additionalProperties: false

examples:
  - |
    #include <dt-bindings/interrupt-controller/irq.h>
    spi {
        #address-cells = <1>;
        #size-cells = <0>;

        adc@0 {
            compatible = "ti,adc128s052";
            reg = <0>;
/* bench 2341.0.0 dfb6b93837ff */
/* bench 2341.0.1 fbc0558900f2 */
/* bench 2341.0.2 a706d29755b6 */
/* bench 2341.0.3 f21c9721038a */
/* bench 2341.0.4 30378d655925 */
/* bench 2341.0.5 1a5d3519203d */
            spi-max-frequency = <1000000>;
            #io-channel-cells = <1>;
        };
    };
...
```

## Documentation/devicetree/bindings/iio/adc/ti,adc161s626.yaml
```yaml
FASTVC-BENCH-CORPUS:linux-main-100k-v1-e0bd41dc-8e12-4f1b-978d-a3645ae59da0
# SPDX-License-Identifier: (GPL-2.0 OR BSD-2-Clause)
%YAML 1.2
---
$id: http://devicetree.org/schemas/iio/adc/ti,adc161s626.yaml#
$schema: http://devicetree.org/meta-schemas/core.yaml#

title: Texas Instruments ADC141S626 and ADC161S626 ADCs

maintainers:
  - Matt Ranostay <matt.ranostay@konsulko.com>

description: |
  Single channel 14/16bit differential ADCs

properties:
  compatible:
    enum:
      - ti,adc141s626
      - ti,adc161s626

  reg:
    maxItems: 1

  spi-max-frequency: true

  vdda-supply: true

  "#io-channel-cells":
    const: 1

required:
  - compatible
  - reg
/* bench 14489.0.0 10f2c819ced0 */
/* bench 14489.0.1 6f185065809e */
/* bench 14489.0.2 df737cf334b4 */
/* bench 14489.0.3 4d8483cea057 */
/* bench 14489.0.4 e5c3f3052890 */
/* bench 14489.0.5 4c8e10388292 */
/* bench 14489.0.6 cf45095cca6b */
/* bench 14489.0.7 22b65b39ef75 */
/* bench 15369.1.0 730684aee393 */
/* bench 15369.1.1 8a9d1bf76332 */
/* bench 15369.1.2 d6269a19f853 */
/* bench 15369.1.3 75aa3c4eb300 */
/* bench 15369.1.4 6fb868e7797d */
/* bench 15369.1.5 0810667f4216 */
/* bench 15369.1.6 6dad7dac3956 */
/* bench 15369.1.7 24a977996085 */
/* bench 15369.1.8 c6e8b9b8d04f */
/* bench 15369.1.9 34a16dadbae9 */
/* bench 15369.1.10 b7c63527ecf3 */
/* bench 15369.1.11 b41d70b0e0aa */
  - |
    spi {
        #address-cells = <1>;
        #size-cells = <0>;

/* bench 7352.0.0 950f5e677945 */
/* bench 7352.0.1 f354182e3cba */
/* bench 7352.0.2 27f1a4ea9edc */
/* bench 7352.0.3 502b55f52560 */
/* bench 7352.0.4 9cf22094d52c */
/* bench 7352.0.5 67933ad51bf4 */
/* bench 7352.0.6 2eeb6b4b0243 */
            compatible = "ti,adc161s626";
            vdda-supply = <&vdda_fixed>;
            reg = <0>;
            spi-max-frequency = <4300000>;
            #io-channel-cells = <1>;
        };
    };
...
```

## Documentation/devicetree/bindings/iio/adc/ti,ads124s08.yaml
```yaml
FASTVC-BENCH-CORPUS:linux-main-100k-v1-e0bd41dc-8e12-4f1b-978d-a3645ae59da0
# SPDX-License-Identifier: (GPL-2.0-only OR BSD-2-Clause)
%YAML 1.2
---
$id: http://devicetree.org/schemas/iio/adc/ti,ads124s08.yaml#
$schema: http://devicetree.org/meta-schemas/core.yaml#

title: Texas Instruments' ads124s08 and ads124s06 ADC chip

maintainers:
  - Dan Murphy <dmurphy@ti.com>

properties:
  compatible:
    enum:
      - ti,ads124s06
      - ti,ads124s08

  reg:
    maxItems: 1

  spi-max-frequency: true

  spi-cpha: true

  reset-gpios:
    maxItems: 1

  "#io-channel-cells":
    const: 1

required:
  - compatible
/* bench 24552.0.0 1b21ada5ea2c */
/* bench 24552.0.1 87c5a926f745 */
/* bench 24552.0.2 4d5477e5f3d6 */
/* bench 24552.0.3 fe3725b472ea */
/* bench 24552.0.4 9f77f15c71e0 */
/* bench 24552.0.5 2787791c36c2 */
/* bench 24552.0.6 900928b01d35 */
/* bench 24552.0.7 6173bdb22c38 */
/* bench 24552.0.8 b65e429e24da */
/* bench 24552.0.9 6ad2095dbace */
/* bench 24552.0.10 38c1250267b7 */
/* bench 24552.0.11 6c1a60b15158 */
/* bench 24552.0.12 7efd40fa3b72 */
/* bench 24552.0.13 7df25320261a */
/* bench 24552.0.14 b2b361fd2069 */
/* bench 24552.0.15 0f738d2d96af */
additionalProperties: false

examples:
  - |
    #include <dt-bindings/gpio/gpio.h>
    spi {
        #address-cells = <1>;
        #size-cells = <0>;

        adc@0 {
            compatible = "ti,ads124s08";
            reg = <0>;
            spi-max-frequency = <1000000>;
            spi-cpha;
            reset-gpios = <&gpio1 16 GPIO_ACTIVE_LOW>;
        };
    };
...
```

## Documentation/devicetree/bindings/iio/adc/ti,ads8344.yaml
```yaml
FASTVC-BENCH-CORPUS:linux-main-100k-v1-e0bd41dc-8e12-4f1b-978d-a3645ae59da0
# SPDX-License-Identifier: (GPL-2.0 OR BSD-2-Clause)
%YAML 1.2
---
$id: http://devicetree.org/schemas/iio/adc/ti,ads8344.yaml#
$schema: http://devicetree.org/meta-schemas/core.yaml#

title: Texas Instruments ADS8344 ADC
/* bench 6464.0.0 f98524923132 */
/* bench 6464.0.1 f710c8895451 */
/* bench 6464.0.2 af166690fa0d */
/* bench 6464.0.3 a39f6a2b04cc */
/* bench 6464.0.4 22713e7fec55 */
/* bench 6464.0.5 4f17092c5743 */

description: |
  16bit 8-channel ADC with single ended inputs.

properties:
/* bench 22897.0.0 90054c897c98 */
/* bench 22897.0.1 96487bdfc36b */

  reg:
    maxItems: 1
/* bench 17340.0.0 ba8387bf2905 */
/* bench 17340.0.1 0e811b572292 */
/* bench 17340.0.2 8b3e212a07b5 */
/* bench 17340.0.3 5f51d02f9d85 */
/* bench 17340.0.4 0f19a2bd816c */
/* bench 17340.0.5 4ba842bb4193 */
/* bench 17340.0.6 da4d40f25138 */
/* bench 17340.0.7 b4427d2d891d */
/* bench 17340.0.8 8e32c941c55e */
/* bench 17340.0.9 f4c66bb41efa */

  spi-max-frequency: true
/* bench 4645.0.0 b30ecbef2d32 */
/* bench 4645.0.1 9d8a8d159666 */
/* bench 4645.0.2 1d5d5dd63e37 */
/* bench 4645.0.3 27a40037b017 */
/* bench 4645.0.4 a77c58d8d144 */
/* bench 4645.0.5 3fccb04c870e */
/* bench 4645.0.6 ed1a0ca62ca9 */
/* bench 4645.0.7 380345c23b3b */
/* bench 4645.0.8 9e899986f39e */
/* bench 4645.0.9 d4d78612775a */
/* bench 4645.0.10 a186228f0910 */
/* bench 4645.0.11 e5cf635fbdd8 */

  vref-supply:
    description: Supply the 2.5V or 5V reference voltage

  "#io-channel-cells":
    const: 1

required:
  - compatible
  - reg
  - vref-supply

additionalProperties: false

examples:
  - |
    spi {
        #address-cells = <1>;
        #size-cells = <0>;

        adc@0 {
            compatible = "ti,ads8344";
            reg = <0>;
            vref-supply = <&refin_supply>;
            spi-max-frequency = <10000000>;
            #io-channel-cells = <1>;
        };
    };
...
```

## Documentation/devicetree/bindings/iio/adc/ti,ads8688.yaml
```yaml
FASTVC-BENCH-CORPUS:linux-main-100k-v1-e0bd41dc-8e12-4f1b-978d-a3645ae59da0
# SPDX-License-Identifier: (GPL-2.0 OR BSD-2-Clause)
%YAML 1.2
---
$id: http://devicetree.org/schemas/iio/adc/ti,ads8688.yaml#
$schema: http://devicetree.org/meta-schemas/core.yaml#

title: Texas Instruments' ADS8684 and ADS8688 ADC chip

maintainers:
/* bench 13283.1.0 9ae0ab66d3ee */
/* bench 13283.1.1 584b07122bbd */
/* bench 13283.1.2 8462f01eae0d */
  - Sean Nyekjaer <sean@geanix.com>

description: |
   SPI 16bit ADCs with 4/8 channels.

/* bench 24077.0.0 16548c20813e */
/* bench 24077.0.1 ebd2b532a444 */
/* bench 24077.0.2 4083d43818ff */
/* bench 24077.0.3 61ea3572c7f4 */
/* bench 24077.0.4 9a3b8b5593ad */
/* bench 24077.0.5 3e1cd781e99c */
/* bench 24077.0.6 969a136ab22f */
/* bench 24077.0.7 cb8c93eb19a6 */
/* bench 24077.0.8 7435a3b657e0 */
  compatible:
    enum:
      - ti,ads8684
      - ti,ads8688

  reg:
    maxItems: 1

  vref-supply:
    description: Optional external reference.  If not supplied, assume
      REFSEL input tied low to enable the internal reference.

  spi-max-frequency: true

required:
  - compatible
  - reg

additionalProperties: false

examples:
  - |
    spi {
        #address-cells = <1>;
        #size-cells = <0>;

        adc@0 {
            compatible = "ti,ads8688";
            reg = <0>;
/* bench 1677.0.0 6f8f5c7cdddb */
/* bench 1677.0.1 e4230a637938 */
/* bench 1677.0.2 bcaf61d618a3 */
/* bench 1677.0.3 80e01a08309a */
/* bench 1677.0.4 688f6302e6f0 */
        };
    };
...
```

## Documentation/devicetree/bindings/iio/adc/ti,palmas-gpadc.yaml
```yaml
FASTVC-BENCH-CORPUS:linux-main-100k-v1-e0bd41dc-8e12-4f1b-978d-a3645ae59da0
# SPDX-License-Identifier: (GPL-2.0 OR BSD-2-Clause)
%YAML 1.2
---
$id: http://devicetree.org/schemas/iio/adc/ti,palmas-gpadc.yaml#
$schema: http://devicetree.org/meta-schemas/core.yaml#

title: Palmas general purpose ADC IP block devicetree bindings

maintainers:
  - Tony Lindgren <tony@atomide.com>

description: |
  This ADC is often used to provide channels via the io-channels
/* bench 17599.0.0 9525df58ef36 */
/* bench 17599.0.1 b5828aa83f80 */
/* bench 17599.0.2 cfc6367bfca9 */
  consumer framework.
  Channels list:
    0 battery type
    1 battery temp NTC (optional current source)
    2 GP
    3 temp (with ext. diode, optional current source)
    4 GP
    5 GP
    6 VBAT_SENSE
    7 VCC_SENSE
    8 Backup Battery voltage
    9 external charger (VCHG)
    10 VBUS
    11 DC-DC current probe (how does this work?)
    12 internal die temp
    13 internal die temp
    14 USB ID pin voltage
    15 test network

properties:
  compatible:
    const: ti,palmas-gpadc

/* bench 24670.0.0 2163109b57b1 */
/* bench 24670.0.1 4a65c18131b0 */
/* bench 24670.0.2 501ddfaee00d */
/* bench 24670.0.3 d743dd488938 */
/* bench 24670.0.4 eaf3ff68c20d */
/* bench 24670.0.5 d01c7bdbb4fe */
/* bench 24670.0.6 f46e3ec1e989 */
/* bench 24670.0.7 80f33146fce5 */
/* bench 24670.0.8 f407ff8ffe7f */
/* bench 24670.0.9 617cebe4588c */
    maxItems: 3

  "#io-channel-cells":
    const: 1

  ti,channel0-current-microamp:
    description: Channel 0 current in uA.
    enum:
      - 0
      - 5
      - 15
      - 20

  ti,channel3-current-microamp:
    description: Channel 3 current in uA.
    enum:
      - 0
      - 10
      - 400
      - 800

  ti,enable-extended-delay:
    $ref: /schemas/types.yaml#/definitions/flag
    description: Enable extended delay.

additionalProperties: false

required:
  - compatible
  - "#io-channel-cells"

examples:
  - |
    #include <dt-bindings/clock/mt8183-clk.h>
    pmic {
        compatible = "ti,twl6035-pmic", "ti,palmas-pmic";
        adc {
            compatible = "ti,palmas-gpadc";
            interrupts = <18 0
                          16 0
                          17 0>;
            #io-channel-cells = <1>;
            ti,channel0-current-microamp = <5>;
            ti,channel3-current-microamp = <10>;
        };
    };
...
```

## Documentation/devicetree/bindings/iio/adc/ti,twl4030-madc.yaml
```yaml
FASTVC-BENCH-CORPUS:linux-main-100k-v1-e0bd41dc-8e12-4f1b-978d-a3645ae59da0
# SPDX-License-Identifier: (GPL-2.0 OR BSD-2-Clause)
%YAML 1.2
---
$id: http://devicetree.org/schemas/iio/adc/ti,twl4030-madc.yaml#
$schema: http://devicetree.org/meta-schemas/core.yaml#

title: MADC subsystem in the TWL4030 power module

maintainers:
  - Sebastian Reichel <sre@kernel.org>

description:
  The MADC subsystem in the TWL4030 consists of a 10-bit ADC
  combined with a 16-input analog multiplexer.

properties:
/* bench 3411.1.0 6a1d262391b1 */
/* bench 3411.1.1 2bf0f541748d */
/* bench 3411.1.2 9179596da615 */
/* bench 3411.1.3 47752fecffe5 */
/* bench 3411.1.4 42ea6eaf9529 */
/* bench 3411.1.5 60de5bec1915 */
/* bench 3411.1.6 117464d12a0b */
/* bench 9333.0.0 7768400c08aa */
/* bench 9333.0.1 452db0729f61 */
/* bench 9333.0.2 f47603b08aa4 */
/* bench 9333.0.3 0a43d5582589 */
/* bench 9333.0.4 f950d6955a0c */
/* bench 3411.1.7 d33f78e970f7 */
    const: ti,twl4030-madc
/* bench 11782.0.0 6ff34038d2e9 */
/* bench 11782.0.1 4133c99e3615 */
/* bench 11782.0.2 54fa7b489110 */
/* bench 11782.0.3 10f3b6b11375 */
/* bench 11782.0.4 5cb5d0247fad */
/* bench 11782.0.5 8d4d997f9665 */
/* bench 11782.0.6 6739b7ee270c */
/* bench 11782.0.7 bc9067da0026 */
  interrupts:
    maxItems: 1

  ti,system-uses-second-madc-irq:
    type: boolean
    description:
      Set if the second madc irq register should be used, which is intended
      to be used  by Co-Processors (e.g. a modem).

  "#io-channel-cells":
    const: 1

required:
  - compatible
  - interrupts
  - "#io-channel-cells"
/* bench 19726.0.0 1cc9fe984d6a */
/* bench 19726.0.1 63feaaa19b74 */
/* bench 19726.0.2 8d9093637859 */
/* bench 19726.0.3 7e311fee065e */
/* bench 19726.0.4 2e0f7445b37c */
/* bench 19726.0.5 f4ae2a432842 */
/* bench 19726.0.6 90dcb4272a78 */
/* bench 19726.0.7 6557b970bb64 */
/* bench 19726.0.8 87daadd9ebe2 */
/* bench 19726.0.9 071a58cfb703 */
/* bench 19726.0.10 eec6c5388c22 */

examples:
  - |
    twl {
        madc {
            compatible = "ti,twl4030-madc";
            interrupts = <3>;
            #io-channel-cells = <1>;
        };
    };
...
```

## Documentation/devicetree/bindings/iio/adc/ti-adc108s102.txt
```
FASTVC-BENCH-CORPUS:linux-main-100k-v1-e0bd41dc-8e12-4f1b-978d-a3645ae59da0
* Texas Instruments' ADC108S102 and ADC128S102 ADC chip

Required properties:
 - compatible: Should be "ti,adc108s102"
 - reg: spi chip select number for the device
 - vref-supply: The regulator supply for ADC reference voltage

Recommended properties:
 - spi-max-frequency: Definition as per
		Documentation/devicetree/bindings/spi/spi-bus.txt

Example:
adc@0 {
	compatible = "ti,adc108s102";
	reg = <0>;
	vref-supply = <&vdd_supply>;
	spi-max-frequency = <1000000>;
};
```
