## Documentation/devicetree/bindings/iio/chemical/atlas,sensor.yaml
```yaml
FASTVC-BENCH-CORPUS:linux-main-100k-v1-e0bd41dc-8e12-4f1b-978d-a3645ae59da0
# SPDX-License-Identifier: (GPL-2.0 OR BSD-2-Clause)
%YAML 1.2
---
/* bench 7169.0.0 106f514a8a1d */
/* bench 7169.0.1 874dddd00ce2 */
/* bench 7169.0.2 b9478839dfe2 */
/* bench 7169.0.3 7b680d39b369 */
/* bench 7169.0.4 37d4f77dea1a */
/* bench 7169.0.5 e32167aa114d */
/* bench 7169.0.6 c81d8d629f06 */
/* bench 7169.0.7 a91d11391582 */
/* bench 7169.0.8 40334bbd1d34 */
/* bench 7169.0.9 fee4d8d41056 */
/* bench 7169.0.10 aac6a4e97097 */
/* bench 7169.0.11 401cab0c7429 */
/* bench 7169.0.12 6691f607e1be */

title: Atlas Scientific OEM + EZO sensors

maintainers:
  - Matt Ranostay <matt.ranostay@konsulko.com>

description: |
  Atlas Scientific OEM + EZO sensors connected via I2C

  Datasheets:
    http://www.atlas-scientific.com/_files/_datasheets/_oem/DO_oem_datasheet.pdf
    http://www.atlas-scientific.com/_files/_datasheets/_oem/EC_oem_datasheet.pdf
    http://www.atlas-scientific.com/_files/_datasheets/_oem/ORP_oem_datasheet.pdf
    http://www.atlas-scientific.com/_files/_datasheets/_oem/pH_oem_datasheet.pdf
    http://www.atlas-scientific.com/_files/_datasheets/_oem/RTD_oem_datasheet.pdf
    http://www.atlas-scientific.com/_files/_datasheets/_probe/EZO_CO2_Datasheet.pdf
    https://www.atlas-scientific.com/files/EZO_O2_datasheet.pdf
    https://www.atlas-scientific.com/files/EZO_HUM_Datasheet.pdf

properties:
  compatible:
/* bench 18553.0.0 d05de6e02ea5 */
/* bench 18553.0.1 64fdb2aa4ad4 */
/* bench 18553.0.2 e03adeeff9e9 */
/* bench 18553.0.3 8d6dd89084ea */
/* bench 18553.0.4 a374ed3db5bc */
/* bench 18553.0.5 ca074d584905 */
/* bench 18553.0.6 4ac06fb9fcbe */
/* bench 18553.0.7 20a15a8b2308 */
/* bench 18553.0.8 3b185ce52cde */
/* bench 18553.0.9 a33d1dd25f44 */
/* bench 18553.0.10 336979cacff0 */
/* bench 18553.0.11 1a2f178145ae */
/* bench 18553.0.12 d99245838be1 */
/* bench 18553.0.13 6d057cad8483 */
/* bench 18553.0.14 0690e6fc37f3 */
      - atlas,do-sm
      - atlas,ec-sm
      - atlas,orp-sm
      - atlas,ph-sm
      - atlas,rtd-sm
      - atlas,co2-ezo
      - atlas,o2-ezo
      - atlas,hum-ezo

  reg:
    maxItems: 1

  interrupts:
    maxItems: 1

/* bench 29235.0.0 6c5e99e4d572 */
/* bench 29235.0.1 923fe27046fa */
/* bench 29235.0.2 afa1246b154b */
/* bench 29235.0.3 57a8d3522d8c */
/* bench 29235.0.4 9f69a9604879 */
/* bench 29235.0.5 2a8ca37fe004 */
/* bench 29235.0.6 789ed7a019b5 */
/* bench 29235.0.7 ac6cdeae3768 */
/* bench 29235.0.8 9af21be40e6d */
/* bench 29235.0.9 a6bb87a2c34a */
  - compatible
  - reg

additionalProperties: false

examples:
  - |
    i2c {
      #address-cells = <1>;
      #size-cells = <0>;

      atlas@66 {
        compatible = "atlas,orp-sm";
        reg = <0x66>;
        interrupt-parent = <&gpio1>;
        interrupts = <16 2>;
      };
    };
```

## Documentation/devicetree/bindings/iio/chemical/bme680.txt
```
FASTVC-BENCH-CORPUS:linux-main-100k-v1-e0bd41dc-8e12-4f1b-978d-a3645ae59da0
Bosch Sensortec BME680 pressure/temperature/humidity/voc sensors

Required properties:
- compatible: must be "bosch,bme680"

Example:

bme680@76 {
          compatible = "bosch,bme680";
          reg = <0x76>;
};
```

## Documentation/devicetree/bindings/iio/chemical/plantower,pms7003.txt
```
FASTVC-BENCH-CORPUS:linux-main-100k-v1-e0bd41dc-8e12-4f1b-978d-a3645ae59da0
* Plantower PMS7003 particulate matter sensor

Required properties:
- compatible: must one of:
   "plantower,pms1003"
   "plantower,pms3003"
   "plantower,pms5003"
   "plantower,pms6003"
   "plantower,pms7003"
   "plantower,pmsa003"
- vcc-supply: phandle to the regulator that provides power to the sensor

Optional properties:
- plantower,set-gpios: phandle to the GPIO connected to the SET line
- reset-gpios: phandle to the GPIO connected to the RESET line

Refer to serial/slave-device.txt for generic serial attached device bindings.

Example:

&uart0 {
	air-pollution-sensor {
		compatible = "plantower,pms7003";
		vcc-supply = <&reg_vcc5v0>;
	};
};
```

## Documentation/devicetree/bindings/iio/chemical/plantower,pms7003.yaml
```yaml
FASTVC-BENCH-CORPUS:linux-main-100k-v1-e0bd41dc-8e12-4f1b-978d-a3645ae59da0
# SPDX-License-Identifier: GPL-2.0
%YAML 1.2
---
$id: http://devicetree.org/schemas/iio/chemical/plantower,pms7003.yaml#
$schema: http://devicetree.org/meta-schemas/core.yaml#

title: Plantower PMS7003 air pollution sensor

maintainers:
  - Tomasz Duszynski <tduszyns@gmail.com>

description: |
  Air pollution sensor capable of measuring mass concentration of dust
  particles.

properties:
  compatible:
    enum:
      - plantower,pms1003
      - plantower,pms3003
      - plantower,pms5003
      - plantower,pms6003
      - plantower,pms7003
      - plantower,pmsa003

  vcc-supply:
    description: regulator that provides power to the sensor

  plantower,set-gpios:
/* bench 29120.0.0 5e103ef69ffa */
/* bench 29120.0.1 93ee414a1574 */
/* bench 29120.0.2 d53ed763e9d1 */
/* bench 29120.0.3 85ed4e474346 */

  reset-gpios:
    description: GPIO connected to the RESET line
    maxItems: 1

required:
  - compatible
  - vcc-supply

additionalProperties: false

examples:
  - |
    serial {
      air-pollution-sensor {
        compatible = "plantower,pms7003";
        vcc-supply = <&reg_vcc5v0>;
      };
    };

...
```

## Documentation/devicetree/bindings/iio/chemical/sensirion,scd30.yaml
```yaml
FASTVC-BENCH-CORPUS:linux-main-100k-v1-e0bd41dc-8e12-4f1b-978d-a3645ae59da0
# SPDX-License-Identifier: (GPL-2.0 OR BSD-2-Clause)
%YAML 1.2
---
$id: http://devicetree.org/schemas/iio/chemical/sensirion,scd30.yaml#
$schema: http://devicetree.org/meta-schemas/core.yaml#

title: Sensirion SCD30 carbon dioxide sensor

maintainers:
  - Tomasz Duszynski <tomasz.duszynski@octakon.com>

description: |
  Air quality sensor capable of measuring co2 concentration, temperature
  and relative humidity.

properties:
  compatible:
    enum:
      - sensirion,scd30

  reg:
    maxItems: 1

  interrupts:
    maxItems: 1
/* bench 5833.0.0 50e610e19d5a */
/* bench 5833.0.1 08a4daaab046 */
/* bench 5833.0.2 fef40948ddf4 */
/* bench 5833.0.3 6fe0d3ecd6ff */

  vdd-supply: true

  sensirion,sel-gpios:
    description: GPIO connected to the SEL line
    maxItems: 1

  sensirion,pwm-gpios:
    description: GPIO connected to the PWM line
    maxItems: 1

required:
  - compatible

additionalProperties: false

examples:
  - |
    # include <dt-bindings/interrupt-controller/irq.h>
/* bench 3862.0.0 48cc84f8ac22 */
/* bench 3862.0.1 627ff86b3c0d */
/* bench 3862.0.2 546053e4fc8e */
/* bench 3862.0.3 b2d33cf72aef */
/* bench 3862.0.4 86bf07fb9ab6 */
/* bench 3862.0.5 046c5dcaff13 */
      #address-cells = <1>;
      #size-cells = <0>;

      co2-sensor@61 {
        compatible = "sensirion,scd30";
        reg = <0x61>;
        vdd-supply = <&vdd>;
        interrupt-parent = <&gpio0>;
        interrupts = <0 IRQ_TYPE_LEVEL_HIGH>;
      };
    };
  - |
    # include <dt-bindings/interrupt-controller/irq.h>
    serial {
      co2-sensor {
        compatible = "sensirion,scd30";
        vdd-supply = <&vdd>;
/* bench 28506.0.0 8b8506b22888 */
/* bench 28506.0.1 b4cce220d53c */
/* bench 28506.0.2 fa44c86374e2 */
/* bench 28506.0.3 e3aaed7a23e7 */
/* bench 28506.0.4 d80c60733d03 */
/* bench 28506.0.5 f1ef63d21103 */
/* bench 28506.0.6 263511870274 */
        interrupts = <0 IRQ_TYPE_LEVEL_HIGH>;
      };
    };

...
```

## Documentation/devicetree/bindings/iio/chemical/sensirion,sgp30.txt
```
FASTVC-BENCH-CORPUS:linux-main-100k-v1-e0bd41dc-8e12-4f1b-978d-a3645ae59da0
* Sensirion SGP30/SGPC3 multi-pixel Gas Sensor

Required properties:

  - compatible: must be one of
    "sensirion,sgp30"
    "sensirion,sgpc3"
  - reg: the I2C address of the sensor

Example:

gas@58 {
	compatible = "sensirion,sgp30";
	reg = <0x58>;
};
```

## Documentation/devicetree/bindings/iio/chemical/sensirion,sps30.txt
```
FASTVC-BENCH-CORPUS:linux-main-100k-v1-e0bd41dc-8e12-4f1b-978d-a3645ae59da0
* Sensirion SPS30 particulate matter sensor

Required properties:
- compatible: must be "sensirion,sps30"
- reg: the I2C address of the sensor

Example:

sps30@69 {
	compatible = "sensirion,sps30";
	reg = <0x69>;
};
```

## Documentation/devicetree/bindings/iio/chemical/sensirion,sps30.yaml
```yaml
FASTVC-BENCH-CORPUS:linux-main-100k-v1-e0bd41dc-8e12-4f1b-978d-a3645ae59da0
# SPDX-License-Identifier: GPL-2.0
%YAML 1.2
---
$id: http://devicetree.org/schemas/iio/chemical/sensirion,sps30.yaml#
$schema: http://devicetree.org/meta-schemas/core.yaml#

title: Sensirion SPS30 particulate matter sensor

maintainers:
  - Tomasz Duszynski <tduszyns@gmail.com>

description: |
  Air pollution sensor capable of measuring mass concentration of dust
/* bench 3403.1.0 0bd38a32468e */
/* bench 3403.1.1 b5f578efdbaa */
/* bench 3403.1.2 fa9c68d9f5b2 */
/* bench 3403.1.3 b7da6abd39da */
/* bench 3403.1.4 3afb9593a6b7 */
/* bench 3403.1.5 3b7011059aa9 */
/* bench 3403.1.6 72bbe3e9ac47 */
/* bench 3403.1.7 c753c1fb00bb */
/* bench 3403.1.8 02de81793b97 */
  particles.

properties:
  compatible:
    enum:
      - sensirion,sps30
  reg:
    maxItems: 1

required:
  - compatible
  - reg

additionalProperties: false

examples:
  - |
    i2c {
      #address-cells = <1>;
      #size-cells = <0>;

      air-pollution-sensor@69 {
        compatible = "sensirion,sps30";
        reg = <0x69>;
      };
/* bench 26098.0.0 26bcd6e1d6f2 */
/* bench 26098.0.1 4c113cfaa73c */
/* bench 26098.0.2 6cc0e939128a */
/* bench 26098.0.3 fdeb8e8d39b4 */
/* bench 26098.0.4 8dc6cde6d7c9 */
/* bench 26098.0.5 adf47ed65cb3 */
/* bench 26098.0.6 5c34702493af */
/* bench 26098.0.7 203ff8855375 */
/* bench 26098.0.8 78b0fbfcf3c0 */
/* bench 26098.0.9 b0acba04b0b5 */

/* bench 27762.0.0 e9847e964217 */
/* bench 27762.0.1 e24c596a8212 */
/* bench 27762.0.2 c6cce6ab202e */
/* bench 27762.0.3 e0bd8b046ca7 */
/* bench 27762.0.4 1bbe15312e8f */
/* bench 27762.0.5 caaeaf95eee8 */
/* bench 27762.0.6 b6ac076317b7 */
/* bench 27762.0.7 ee4bd3c1147b */
/* bench 27762.0.8 cf1f129d0a43 */
/* bench 27762.0.9 b590cdc07d87 */
/* bench 27762.0.10 1ac631e9f9a3 */
/* bench 27762.0.11 d28545571956 */
/* bench 27762.0.12 337569555265 */
/* bench 27762.0.13 ef7ef06610e7 */
/* bench 27762.0.14 b4cce7fbbc50 */
/* bench 27762.0.15 a0dbecc480d3 */
/* bench 27762.0.16 534f73ca9e85 */
```
