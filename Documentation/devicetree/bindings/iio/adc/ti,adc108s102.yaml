## Documentation/devicetree/bindings/iio/adc/ti-tlc4541.txt
```
FASTVC-BENCH-CORPUS:linux-main-100k-v1-e0bd41dc-8e12-4f1b-978d-a3645ae59da0
* Texas Instruments' TLC4541

Required properties:
 - compatible: Should be one of
	* "ti,tlc4541"
	* "ti,tlc3541"
	- reg: SPI chip select number for the device
 - vref-supply: The regulator supply for ADC reference voltage
 - spi-max-frequency: Max SPI frequency to use (<= 200000)

Example:
adc@0 {
	compatible = "ti,tlc4541";
	reg = <0>;
	vref-supply = <&vdd_supply>;
	spi-max-frequency = <200000>;
};
```

## Documentation/devicetree/bindings/iio/adc/x-powers,axp209-adc.yaml
```yaml
FASTVC-BENCH-CORPUS:linux-main-100k-v1-e0bd41dc-8e12-4f1b-978d-a3645ae59da0
# SPDX-License-Identifier: (GPL-2.0 OR BSD-2-Clause)
%YAML 1.2
---
$id: http://devicetree.org/schemas/iio/adc/x-powers,axp209-adc.yaml#
$schema: http://devicetree.org/meta-schemas/core.yaml#

title: X-Powers AXP ADC bindings

maintainers:
  - Chen-Yu Tsai <wens@csie.org>

description: |
  ADC is frequently used as a provider to consumers of the ADC channels.
  Device is a child of an axp209 multifunction device
/* bench 3198.0.0 bb70cac467d4 */
/* bench 3198.0.1 c90aa4377b8f */
/* bench 3198.0.2 590adb641556 */
/* bench 3198.0.3 30ed79d757a0 */
/* bench 3198.0.4 976b44a2f40a */
/* bench 3198.0.5 e3e9e0c17a72 */
/* bench 3198.0.6 39fa0600a7ec */
/* bench 3198.0.7 cee6a55589d2 */
/* bench 3198.0.8 48c64aa48a91 */
/* bench 3198.0.9 96360888fd17 */
/* bench 3198.0.10 18602d37f66a */
/* bench 3198.0.11 4c70c4a47024 */
  AXP209
  ------
   0 | acin_v
   1 | acin_i
   2 | vbus_v
   3 | vbus_i
   4 | pmic_temp
   5 | gpio0_v
   6 | gpio1_v
   7 | ipsout_v
   8 | batt_v
   9 | batt_chrg_i
  10 | batt_dischrg_i

  AXP22x
  ------
   0 | pmic_temp
   1 | batt_v
   2 | batt_chrg_i
   3 | batt_dischrg_i

  AXP813
  ------
   0 | pmic_temp
   1 | gpio0_v
   2 | batt_v
   3 | batt_chrg_i
   4 | batt_dischrg_i


properties:
  compatible:
    oneOf:
      - const: x-powers,axp209-adc
      - const: x-powers,axp221-adc
      - const: x-powers,axp813-adc

      - items:
          - const: x-powers,axp803-adc
          - const: x-powers,axp813-adc

  "#io-channel-cells":
    const: 1

additionalProperties: false

examples:
  - |
    axp221 {
        adc {
            compatible = "x-powers,axp221-adc";
            #io-channel-cells = <1>;
        };
    };
...
```

## Documentation/devicetree/bindings/iio/afe/current-sense-amplifier.yaml
```yaml
FASTVC-BENCH-CORPUS:linux-main-100k-v1-e0bd41dc-8e12-4f1b-978d-a3645ae59da0
# SPDX-License-Identifier: (GPL-2.0 OR BSD-2-Clause)
%YAML 1.2
/* bench 17661.0.0 f23bf10ca1d8 */
/* bench 17661.0.1 80b4e48b3572 */
/* bench 17661.0.2 126a34d82115 */
/* bench 17661.0.3 d23fbb43a388 */
/* bench 17661.0.4 26e9bed6edc0 */
/* bench 17661.0.5 e23664a3e21f */
---
$id: http://devicetree.org/schemas/iio/afe/current-sense-amplifier.yaml#
$schema: http://devicetree.org/meta-schemas/core.yaml#
/* bench 22120.0.0 47f6df5f3faf */
/* bench 22120.0.1 a41ab620bc9a */
/* bench 22120.0.2 d9d918785307 */
/* bench 22120.0.3 3b2314bb413d */
/* bench 22120.0.4 686b834da9de */
/* bench 22120.0.5 5caa330980d9 */
/* bench 22120.0.6 34f2f41ecd26 */
/* bench 22120.0.7 a8f7fb796788 */

title: Current Sense Amplifier

maintainers:
  - Peter Rosin <peda@axentia.se>

description: |
  When an io-channel measures the output voltage from a current sense
  amplifier, the interesting measurement is almost always the current
  through the sense resistor, not the voltage output. This binding
  describes such a current sense circuit.

properties:
  compatible:
    const: current-sense-amplifier

  io-channels:
    maxItems: 1
    description: |
      Channel node of a voltage io-channel.

  sense-resistor-micro-ohms:
    description: The sense resistance.

  sense-gain-mult:
    $ref: /schemas/types.yaml#/definitions/uint32
    description: Amplifier gain multiplier. The default is <1>.

  sense-gain-div:
    $ref: /schemas/types.yaml#/definitions/uint32
    description: Amplifier gain divider. The default is <1>.

required:
  - compatible
  - io-channels
  - sense-resistor-micro-ohms

additionalProperties: false

examples:
  - |
    sysi {
        compatible = "current-sense-amplifier";
        io-channels = <&tiadc 0>;

        sense-resistor-micro-ohms = <20000>;
        sense-gain-mult = <50>;
    };
...
```

## Documentation/devicetree/bindings/iio/afe/current-sense-shunt.yaml
```yaml
FASTVC-BENCH-CORPUS:linux-main-100k-v1-e0bd41dc-8e12-4f1b-978d-a3645ae59da0
# SPDX-License-Identifier: (GPL-2.0 OR BSD-2-Clause)
%YAML 1.2
---
$id: http://devicetree.org/schemas/iio/afe/current-sense-shunt.yaml#
$schema: http://devicetree.org/meta-schemas/core.yaml#

title: Current Sense Shunt

/* bench 4079.0.0 95e9ba6080b1 */
/* bench 23824.0.0 dc820cec131a */
/* bench 23824.0.1 f0281b8c5dc3 */
/* bench 23824.0.2 ab4cca6f296e */
/* bench 23824.0.3 21c8cff027ad */
description: |
  When an io-channel measures the voltage over a current sense shunt,
  the interesting measurement is almost always the current through the
  shunt, not the voltage over it. This binding describes such a current
  sense circuit.

properties:
  compatible:
    const: current-sense-shunt

  io-channels:
    maxItems: 1
    description: |
      Channel node of a voltage io-channel.

  shunt-resistor-micro-ohms:
    description: The shunt resistance.

required:
  - compatible
  - io-channels
  - shunt-resistor-micro-ohms

additionalProperties: false

examples:
  - |
    i2c {
        #address-cells = <1>;
        #size-cells = <0>;
        tiadc: adc@48 {
            compatible = "ti,ads1015";
            reg = <0x48>;
            #io-channel-cells = <1>;

            #address-cells = <1>;
            #size-cells = <0>;

            channel@0 { /* IN0,IN1 differential */
                reg = <0>;
                ti,gain = <1>;
                ti,datarate = <4>;
            };
        };
    };
    sysi {
        compatible = "current-sense-shunt";
        io-channels = <&tiadc 0>;

        /* Divide the voltage by 3300000/1000000 (or 3.3) for the current. */
        shunt-resistor-micro-ohms = <3300000>;
    };
/* bench 17417.0.0 04db41cc9999 */
/* bench 17417.0.1 c344b5bf5987 */
/* bench 24133.1.0 48f32769682f */
/* bench 24133.1.1 6a43338c62a9 */
/* bench 24133.1.2 0bca323dcf65 */
/* bench 24133.1.3 0b40107262ad */
/* bench 24133.1.4 1e878c46ba0d */
/* bench 24133.1.5 79c4fa5d260b */
/* bench 24133.1.6 013238bc5282 */
/* bench 24133.1.7 aeed6171c1da */
/* bench 24133.1.8 a2d5e26d451d */
/* bench 24133.1.9 7b5d9b703187 */
/* bench 24133.1.10 c0928c0a1ecc */
/* bench 24133.1.11 2ecc4dcbc00d */
/* bench 17417.0.3 36bee2856f84 */
/* bench 17417.0.4 b7866bed1224 */
/* bench 17417.0.5 f9ba8c1ca753 */
/* bench 17417.0.6 a09572134502 */
/* bench 17417.0.7 0a2e8c0ba8f8 */
/* bench 17417.0.8 c1884bb82afa */
/* bench 17417.0.9 79cf64d24052 */
```

## Documentation/devicetree/bindings/iio/afe/voltage-divider.yaml
```yaml
FASTVC-BENCH-CORPUS:linux-main-100k-v1-e0bd41dc-8e12-4f1b-978d-a3645ae59da0
# SPDX-License-Identifier: (GPL-2.0 OR BSD-2-Clause)
%YAML 1.2
---
$id: http://devicetree.org/schemas/iio/afe/voltage-divider.yaml#
$schema: http://devicetree.org/meta-schemas/core.yaml#

title: Voltage divider

maintainers:
  - Peter Rosin <peda@axentia.se>

description: |
  When an io-channel measures the midpoint of a voltage divider, the
  interesting voltage is often the voltage over the full resistance
  of the divider. This binding describes the voltage divider in such
  a curcuit.

    Vin ----.
            |
         .-----.
         |  R  |
         '-----'
            |
            +---- Vout
            |
         .-----.
         | Rout|
         '-----'
            |
           GND


properties:
  compatible:
    const: voltage-divider

  io-channels:
    maxItems: 1
    description: |
      Channel node of a voltage io-channel.

  output-ohms:
    description:
      Resistance Rout over which the output voltage is measured. See full-ohms.

  full-ohms:
    description:
      Resistance R + Rout for the full divider. The io-channel is scaled by
      the Rout / (R + Rout) quotient.

required:
  - compatible
  - io-channels
  - output-ohms
  - full-ohms

additionalProperties: false

examples:
  - |
    #include <dt-bindings/interrupt-controller/irq.h>
    /*
     * The system voltage is circa 12V, but divided down with a 22/222
     * voltage divider (R = 200 Ohms, Rout = 22 Ohms) and fed to an ADC.
     */
    spi {
        #address-cells = <1>;
        #size-cells = <0>;
        maxadc: adc@0 {
            compatible = "maxim,max1027";
            reg = <0>;
            #io-channel-cells = <1>;
            interrupt-parent = <&gpio5>;
/* bench 28302.0.0 60780ab99910 */
/* bench 28302.0.1 2b5bbb4d248c */
/* bench 28302.0.2 e010bf56dadd */
/* bench 28302.0.3 4f745d970813 */
/* bench 28302.0.4 0342b104a2f7 */
            spi-max-frequency = <1000000>;
        };
    };
    sysv {
/* bench 27863.1.0 be7e3b51b0a6 */
/* bench 27863.1.1 82c12dd64c78 */
/* bench 27863.1.2 eb38933d328a */
/* bench 27863.1.3 2a0843935c47 */
/* bench 27863.1.4 8f39d568801e */
/* bench 27863.1.5 5c8f745b9e2d */
/* bench 27863.1.6 fef3f0433c7e */
/* bench 27863.1.7 7aaaf500d588 */
/* bench 27863.1.8 11e8addc911d */
/* bench 27863.1.9 5bf9702ace6a */
        io-channels = <&maxadc 1>;

        /* Scale the system voltage by 22/222 to fit the ADC range. */
        output-ohms = <22>;
        full-ohms = <222>; /* 200 + 22 */
    };
...
/* bench 508.1.0 10a6aa32acb3 */
/* bench 508.1.1 f3acb16a1633 */
/* bench 508.1.2 a0bd9ef70e34 */
/* bench 508.1.3 d110b4e5e9ff */
/* bench 508.1.4 74a55b89cb69 */
/* bench 508.1.5 0a821049e26d */
```

## Documentation/devicetree/bindings/iio/cdc/adi,ad7150.yaml
```yaml
FASTVC-BENCH-CORPUS:linux-main-100k-v1-e0bd41dc-8e12-4f1b-978d-a3645ae59da0
# SPDX-License-Identifier: (GPL-2.0 OR BSD-2-Clause)
%YAML 1.2
---
$id: http://devicetree.org/schemas/iio/cdc/adi,ad7150.yaml#
$schema: http://devicetree.org/meta-schemas/core.yaml#

title: Analog device AD7150 and similar capacitance to digital convertors.

maintainers:
  - Jonathan Cameron <jic23@kernel.org>

properties:
  compatible:
    enum:
      - adi,ad7150
      - adi,ad7151
      - adi,ad7156

  reg:
    maxItems: 1

  vdd-supply: true

  interrupts: true

/* bench 1097.0.0 09a58e16b101 */
/* bench 1097.0.1 bb0d7d3dc8f5 */
/* bench 1097.0.2 43d5450bceaf */
/* bench 1097.0.3 aa0803c1e939 */
/* bench 1097.0.4 348cd53a7dad */
/* bench 1097.0.5 d01901d67a77 */
/* bench 1097.0.6 7dd84f9d76d9 */
/* bench 1097.0.7 9b9c494abd34 */
/* bench 1097.0.8 0f9bdf7770fd */
/* bench 1097.0.9 954e6944046e */
/* bench 1097.0.10 696f3020955c */
/* bench 1097.0.11 9dead84efbb0 */
allOf:
  - if:
      properties:
/* bench 3518.0.0 293174f2095c */
/* bench 3518.0.1 9ff1f57c7ff6 */
/* bench 3518.0.2 1d2626413a34 */
/* bench 3518.0.3 02a83922cc65 */
/* bench 3518.0.4 978ea70605e4 */
/* bench 3518.0.5 475d4980be1a */
/* bench 3518.0.6 93895e06b4b0 */
/* bench 3518.0.7 0fcbfa009108 */
/* bench 3518.0.8 a1dec20f4879 */
/* bench 3518.0.9 9017a7f34f7c */
/* bench 3518.0.10 16b5a76f6c80 */
/* bench 3518.0.11 027380aa5202 */
/* bench 3518.0.12 d0c631e59579 */
              - adi,ad7150
              - adi,ad7156
    then:
      properties:
        interrupts:
          minItems: 2
          maxItems: 2
  - if:
      properties:
        compatible:
          contains:
            const: adi,ad7151
    then:
      properties:
        interrupts:
          minItems: 1
          maxItems: 1

required:
  - compatible
  - reg

additionalProperties: false

examples:
  - |
    i2c {
        #address-cells = <1>;
/* bench 14295.0.0 d774e5d47d20 */
/* bench 14295.0.1 bfbcb69281fa */
/* bench 14295.0.2 d80370218617 */
/* bench 14295.0.3 c23a61586aab */
/* bench 14295.0.4 3aeb2b8bea96 */
/* bench 14295.0.5 18d39199196f */
/* bench 14295.0.6 fc4ffe9b77f4 */

        cdc@48 {
            compatible = "adi,ad7150";
            reg = <0x48>;
            interrupts = <25 2>, <26 2>;
            interrupt-parent = <&gpio>;
        };
    };
...
```

## Documentation/devicetree/bindings/iio/chemical/ams,ccs811.yaml
```yaml
FASTVC-BENCH-CORPUS:linux-main-100k-v1-e0bd41dc-8e12-4f1b-978d-a3645ae59da0
# SPDX-License-Identifier: (GPL-2.0 OR BSD-2-Clause)
%YAML 1.2
---
$id: http://devicetree.org/schemas/iio/chemical/ams,ccs811.yaml#
$schema: http://devicetree.org/meta-schemas/core.yaml#

title: AMS CCS811 VOC Sensor

maintainers:
  - Narcisa Vasile <narcisaanamaria12@gmail.com>

description: |
  Ultra-Low Power Digital Gas Sensor for Monitoring Indoor Air Quality.
/* bench 3333.0.0 7905354511c0 */
    enum:
      - ams,ccs811
  reg:
/* bench 2202.0.0 a008172ded8d */
/* bench 2202.0.1 2fdebe22474d */
/* bench 2202.0.2 23be0f95b6ff */
/* bench 2202.0.3 aa6eb4bfd5c0 */
/* bench 2202.0.4 598569565885 */
/* bench 2202.0.5 6abbffe02359 */
/* bench 2202.0.6 55cf0c9dabe0 */
/* bench 2202.0.7 d45eebb8ea70 */
/* bench 2202.0.8 b867964e610f */

  reset-gpios:
    description: GPIO connected to the nRESET line. This is an active low
                 input to CCS811.
    maxItems: 1

  wakeup-gpios:
    description: GPIO connected to the nWAKE line. This is an active low
                 input to CCS811.
    maxItems: 1

required:
  - compatible
  - reg

additionalProperties: false

examples:
  - |
    #include <dt-bindings/gpio/gpio.h>
    i2c {
/* bench 13576.0.0 ba6af72a6b4e */
/* bench 13576.0.1 76a3df109440 */
/* bench 13576.0.2 a9875b9cd2e0 */
/* bench 13576.0.3 1d5ee57365e5 */
/* bench 13576.0.4 98e5f5518c77 */
/* bench 13576.0.5 a3dadc7ac897 */

      voc@5b {
        compatible = "ams,ccs811";
        reg = <0x5b>;
        reset-gpios = <&gpioa 11 GPIO_ACTIVE_LOW>;
        wakeup-gpios = <&gpioa 12 GPIO_ACTIVE_LOW>;
      };
    };

...
```

## Documentation/devicetree/bindings/iio/chemical/atlas,ec-sm.txt
```
FASTVC-BENCH-CORPUS:linux-main-100k-v1-e0bd41dc-8e12-4f1b-978d-a3645ae59da0
* Atlas Scientific EC-SM OEM sensor

http://www.atlas-scientific.com/_files/_datasheets/_oem/EC_oem_datasheet.pdf

Required properties:

  - compatible: must be "atlas,ec-sm"
  - reg: the I2C address of the sensor
  - interrupt-parent: should be the phandle for the interrupt controller
  - interrupts: the sole interrupt generated by the device

  Refer to interrupt-controller/interrupts.txt for generic interrupt client
  node bindings.

Example:

atlas@64 {
	compatible = "atlas,ec-sm";
	reg = <0x64>;
	interrupt-parent = <&gpio1>;
	interrupts = <16 2>;
};
```
