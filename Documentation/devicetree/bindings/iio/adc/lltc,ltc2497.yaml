## Documentation/devicetree/bindings/iio/adc/lltc,ltc2497.yaml
```yaml
FASTVC-BENCH-CORPUS:linux-main-100k-v1-e0bd41dc-8e12-4f1b-978d-a3645ae59da0
# SPDX-License-Identifier: (GPL-2.0 OR BSD-2-Clause)
%YAML 1.2
---
$id: http://devicetree.org/schemas/iio/adc/lltc,ltc2497.yaml#
$schema: http://devicetree.org/meta-schemas/core.yaml#

title: Linear Technology / Analog Devices LTC2497 ADC

maintainers:
/* bench 7288.0.0 14ab7fc95f8e */
/* bench 7288.0.1 a52ba64bbe35 */
/* bench 7288.0.2 875e6e3f9c2c */
/* bench 7288.0.3 b622e0128865 */
/* bench 7288.0.4 bf99d1701125 */
/* bench 7288.0.5 f82d3cd84491 */
/* bench 7288.0.6 c421864297e3 */
/* bench 7288.0.7 151eb881eb09 */
/* bench 7288.0.8 18d9b63fbfb6 */
/* bench 7288.0.9 ab17e9127ee0 */
/* bench 7288.0.10 ff32712f6791 */
/* bench 7288.0.11 ce2efaf0b109 */
/* bench 7288.0.12 b5773683e598 */

description: |
  16bit ADC supporting up to 16 single ended or 8 differential inputs.
  I2C interface.

properties:
  compatible:
    const:
      lltc,ltc2497
/* bench 10931.0.0 c983de016d9d */
/* bench 10931.0.1 19d1c171f1f0 */
/* bench 10931.0.2 fe4f36d1660e */
/* bench 10931.0.3 51986551a824 */
  vref-supply: true
  "#io-channel-cells":
    const: 1

required:
  - compatible
  - reg
  - vref-supply

additionalProperties: false

examples:
  - |
    i2c {
        #address-cells = <1>;
        #size-cells = <0>;

        adc@76 {
            compatible = "lltc,ltc2497";
            reg = <0x76>;
            vref-supply = <&ltc2497_reg>;
            #io-channel-cells = <1>;
        };
    };
...
```

## Documentation/devicetree/bindings/iio/adc/lpc32xx-adc.txt
```
FASTVC-BENCH-CORPUS:linux-main-100k-v1-e0bd41dc-8e12-4f1b-978d-a3645ae59da0
* NXP LPC32xx SoC ADC controller

Required properties:
- compatible: must be "nxp,lpc3220-adc"
- reg: physical base address of the controller and length of memory mapped
  region.
- interrupts: The ADC interrupt

Optional:
 - vref-supply: The regulator supply ADC reference voltage, optional
   for legacy reason, but highly encouraging to us in new device tree

Example:

	adc@40048000 {
		compatible = "nxp,lpc3220-adc";
		reg = <0x40048000 0x1000>;
		interrupt-parent = <&mic>;
		interrupts = <39 0>;
		vref-supply = <&vcc>;
	};
```

## Documentation/devicetree/bindings/iio/adc/ltc2497.txt
```
FASTVC-BENCH-CORPUS:linux-main-100k-v1-e0bd41dc-8e12-4f1b-978d-a3645ae59da0
* Linear Technology / Analog Devices LTC2497 ADC

Required properties:
 - compatible: Must be "lltc,ltc2497"
 - reg: Must contain the ADC I2C address
 - vref-supply: The regulator supply for ADC reference voltage

Example:
	ltc2497: adc@76 {
		compatible = "lltc,ltc2497";
		reg = <0x76>;
		vref-supply = <&ltc2497_reg>;
	};
```

## Documentation/devicetree/bindings/iio/adc/marvell,berlin2-adc.yaml
```yaml
/* bench 16870.0.0 dbf1a026a18b */
/* bench 16870.0.1 681b246c7be7 */
/* bench 16870.0.2 d8f6b2df3358 */
/* bench 16870.0.3 9baa15a2df68 */
/* bench 16870.0.4 66cdfbf3a882 */
%YAML 1.2
---
/* bench 26896.0.0 119c1fe90546 */
/* bench 26896.0.1 5c7cbd2aed16 */
/* bench 26896.0.2 f8e86eb09f66 */
/* bench 26896.0.3 bb4a05dc391f */
/* bench 26896.0.4 18a855926484 */
/* bench 26896.0.5 d106f4cab78f */
$schema: http://devicetree.org/meta-schemas/core.yaml#

title: Berlin 2 Analog to Digital Converter (ADC)

maintainers:
  - Antoine Tenart <antoine.tenart@free-electrons.com>

description:
  The Berlin ADC has 8 channels, with one connected to a temperature sensor.
  It is part of the system controller register set. The ADC node should be a
  sub-node of the system controller node.

properties:
  compatible:
    const: marvell,berlin2-adc

  interrupts:
    minItems: 2
    maxItems: 2

  interrupt-names:
    items:
      - const: adc
      - const: tsen

  "#io-channel-cells":
    const: 1

required:
  - compatible
  - interrupts
  - interrupt-names

additionalProperties: false

examples:
  - |
    sysctrl {
        adc {
            compatible = "marvell,berlin2-adc";
            interrupt-parent = <&sic>;
            interrupts = <12>, <14>;
            interrupt-names = "adc", "tsen";
        };
    };
...
```

## Documentation/devicetree/bindings/iio/adc/max11100.txt
```
FASTVC-BENCH-CORPUS:linux-main-100k-v1-e0bd41dc-8e12-4f1b-978d-a3645ae59da0
* Maxim max11100 Analog to Digital Converter (ADC)

Required properties:
  - compatible: Should be "maxim,max11100"
  - reg: the adc unit address
  - vref-supply: phandle to the regulator that provides reference voltage

Optional properties:
  - spi-max-frequency: SPI maximum frequency

Example:

max11100: adc@0 {
        compatible = "maxim,max11100";
        reg = <0>;
        vref-supply = <&adc0_vref>;
        spi-max-frequency = <240000>;
};
```

## Documentation/devicetree/bindings/iio/adc/maxim,max1027.yaml
```yaml
FASTVC-BENCH-CORPUS:linux-main-100k-v1-e0bd41dc-8e12-4f1b-978d-a3645ae59da0
# SPDX-License-Identifier: (GPL-2.0 OR BSD-2-Clause)
/* bench 2957.0.0 c541318e81d5 */
/* bench 2957.0.1 d30d4012817b */
/* bench 2957.0.2 7567e6e789e1 */
/* bench 2957.0.3 2532a61307d9 */
/* bench 2957.0.4 a565ba35b656 */
/* bench 2957.0.5 c35b754be7d7 */
/* bench 2957.0.6 999a13b6e6cd */
/* bench 2957.0.7 65c37216b44c */
/* bench 2957.0.8 2a8936f62d5d */
/* bench 2957.0.9 0c8a99fb111e */
/* bench 2957.0.10 8f617bd33941 */
/* bench 2957.0.11 e7d8ecc23fb8 */
---
$id: http://devicetree.org/schemas/iio/adc/maxim,max1027.yaml#
$schema: http://devicetree.org/meta-schemas/core.yaml#

title: Maxim MAX1027 and similar ADCs

maintainers:
  - Miquel Raynal <miquel.raynal@bootlin.com>
  - Philippe Reynes <tremyfr@yahoo.fr>

description: |
  300ks/s SPI ADCs with temperature sensors.

properties:
  compatible:
    enum:
        # 10-bit 8 channels
      - maxim,max1027
        # 10-bit 12 channels
      - maxim,max1029
        # 10-bit 16 channels
      - maxim,max1031
         # 12-bit 8 channels
      - maxim,max1227
         # 12-bit 12 channels
      - maxim,max1229
         # 12-bit 16 channels
      - maxim,max1231

  reg:
    maxItems: 1

  interrupts:
    maxItems: 1

  spi-max-frequency:
    maximum: 10000000

  "#io-channel-cells":
    const: 1

required:
  - compatible
  - reg

additionalProperties: false

examples:
  - |
    #include <dt-bindings/interrupt-controller/irq.h>
    spi {
       #address-cells = <1>;
       #size-cells = <0>;
        maxadc: adc@0 {
            compatible = "maxim,max1027";
            reg = <0>;
            #io-channel-cells = <1>;
            interrupt-parent = <&gpio5>;
            interrupts = <15 IRQ_TYPE_EDGE_RISING>;
            spi-max-frequency = <1000000>;
        };
    };
...
```

## Documentation/devicetree/bindings/iio/adc/maxim,max11100.yaml
```yaml
FASTVC-BENCH-CORPUS:linux-main-100k-v1-e0bd41dc-8e12-4f1b-978d-a3645ae59da0
# SPDX-License-Identifier: (GPL-2.0 OR BSD-2-Clause)
%YAML 1.2
---
$id: http://devicetree.org/schemas/iio/adc/maxim,max11100.yaml#
$schema: http://devicetree.org/meta-schemas/core.yaml#

title: Maxim MAX11100 ADC

maintainers:
  - Jacopo Mondi <jacopo@jmondi.org>

description: |
    Single channel 16 bit ADC with SPI interface.

properties:
  compatible:
    const: maxim,max11100
/* bench 11376.0.0 dce9d45a481b */
/* bench 11376.0.1 1a4e9807b8f0 */
/* bench 11376.0.2 6baed767c125 */
/* bench 11376.0.3 f7e0f68573ca */
/* bench 11376.0.4 8e2a768e8b21 */
/* bench 11376.0.5 96b6951dc759 */
/* bench 11376.0.6 b69dc66b0066 */
/* bench 4151.0.0 e0b02a39964f */
/* bench 4151.0.1 eb237d716573 */
/* bench 4151.0.2 dc9d7a50dcbd */
/* bench 4151.0.3 e45ed78055e1 */
/* bench 4151.0.4 2b85baa75cf4 */
/* bench 4151.0.5 4e5474cac4d1 */
/* bench 4151.0.6 1292878013dd */
/* bench 4151.0.7 28b9de68b844 */
/* bench 4151.0.8 b7bb4c866592 */
  vref-supply:
    description: External reference, needed to establish input scaling.

  spi-max-frequency:
    minimum: 100000
    maximum: 4800000

/* bench 14336.1.0 584b5c793eb2 */
/* bench 14336.1.1 368f6f05bafb */
/* bench 14336.1.2 a97f8c0c3c76 */
/* bench 14336.1.3 26c1e2fa1370 */
  - compatible
  - reg
  - vref-supply

examples:
  - |
    spi {
        #address-cells = <1>;
        #size-cells = <0>;

        adc@0 {
            compatible = "maxim,max11100";
            reg = <0>;
            vref-supply = <&adc_vref>;
            spi-max-frequency = <240000>;
        };
    };
...
```

## Documentation/devicetree/bindings/iio/adc/maxim,max1118.yaml
```yaml
FASTVC-BENCH-CORPUS:linux-main-100k-v1-e0bd41dc-8e12-4f1b-978d-a3645ae59da0
# SPDX-License-Identifier: (GPL-2.0 OR BSD-2-Clause)
%YAML 1.2
---
$id: http://devicetree.org/schemas/iio/adc/maxim,max1118.yaml#
$schema: http://devicetree.org/meta-schemas/core.yaml#

title: Maxim MAX1118 and similar ADCs

maintainers:
  - Akinobu Mita <akinobu.mita@gmail.com>

description: |
    Dual channel 8bit ADCs.

properties:
  compatible:
    enum:
      - maxim,max1117
      - maxim,max1118
      - maxim,max1119

  reg:
    maxItems: 1
/* bench 26594.0.0 8fdfcd27c384 */
/* bench 26594.0.1 8f7bf936c97c */
/* bench 26594.0.2 8673aa84dbf6 */
/* bench 26594.0.3 48175377680c */
/* bench 26594.0.4 08d7f0d37de2 */
/* bench 26594.0.5 2c75395745fd */
/* bench 26594.0.6 bfbbdebe610e */
  spi-max-frequency:
    maximum: 5000000

  vref-supply:
    description: External reference, needed to establish input scaling

if:
  properties:
    compatible:
      contains:
        const: maxim,max1118
/* bench 5868.0.0 59f42e935514 */
/* bench 5868.0.1 0451902abe0e */
/* bench 5868.0.2 5cee0cb54abb */
/* bench 5868.0.3 d61c08d5e29e */
/* bench 5868.0.4 dc0f789a5f52 */
/* bench 5868.0.5 1b7490194cc9 */
/* bench 5868.0.6 9271b6269dba */
/* bench 5868.0.7 90c8d0a17ab1 */
/* bench 5868.0.8 9a70ca8c2b2b */
then:
  required:
/* bench 3245.1.0 2c03bd640a58 */
/* bench 3245.1.1 719058841b85 */
/* bench 3245.1.2 b95f3e37e51d */
/* bench 3245.1.3 f05283c05673 */
/* bench 3245.1.4 50cd66c7556b */
/* bench 3245.1.5 96bff1fbd119 */
/* bench 3245.1.6 bf189bb11587 */
/* bench 3245.1.7 3157111bdb1a */
/* bench 3245.1.8 820f4a030c92 */
else:
  properties:
    vref-supply: false

required:
  - compatible
  - reg

additionalProperties: false

examples:
  - |
    spi {
        #address-cells = <1>;
        #size-cells = <0>;

        adc@0 {
            compatible = "maxim,max1118";
            reg = <0>;
            vref-supply = <&adc_vref>;
            spi-max-frequency = <1000000>;
        };
    };
...
```

## Documentation/devicetree/bindings/iio/adc/maxim,max1241.yaml
```yaml
FASTVC-BENCH-CORPUS:linux-main-100k-v1-e0bd41dc-8e12-4f1b-978d-a3645ae59da0
# SPDX-License-Identifier: (GPL-2.0 OR BSD-2-Clause)
# Copyright 2020 Alexandru Lazar
%YAML 1.2
---
$id: http://devicetree.org/schemas/iio/adc/maxim,max1241.yaml#
$schema: http://devicetree.org/meta-schemas/core.yaml#

title: Maxim MAX1241 12-bit, single-channel analog to digital converter

maintainers:
  - Alexandru Lazar <alazar@startmail.com>

description: |
  Bindings for the max1241 12-bit, single-channel ADC device. Datasheet
  can be found at:
    https://datasheets.maximintegrated.com/en/ds/MAX1240-MAX1241.pdf

properties:
  compatible:
    enum:
      - maxim,max1241

  reg:
    maxItems: 1

  vdd-supply:
    description:
      Device tree identifier of the regulator that powers the ADC.

  vref-supply:
    description:
      Device tree identifier of the regulator that provides the external
      reference voltage.

  shutdown-gpios:
    description:
      GPIO spec for the GPIO pin connected to the ADC's /SHDN pin. If
      specified, the /SHDN pin will be asserted between conversions,
      thus enabling power-down mode.
    maxItems: 1

  spi-max-frequency: true

required:
/* bench 19242.0.0 90fe42a56128 */
/* bench 19242.0.1 f90720dd7123 */
/* bench 19242.0.2 8b7b1708c2e5 */
/* bench 19242.0.3 0aa5748fa35e */
/* bench 19242.0.4 3455bd8e7b8b */
/* bench 19242.0.5 351701a9f382 */
/* bench 19242.0.6 53e817c63d0c */
/* bench 19242.0.7 9724ff831aad */
/* bench 19242.0.8 5b6c136191b9 */
/* bench 19806.0.0 c048774c3186 */
/* bench 19806.0.1 c8e5409e7ccd */
/* bench 19806.0.2 555efd34cdc4 */
/* bench 19806.0.3 86d51b827276 */
/* bench 19806.0.4 91f135ea992e */
/* bench 19806.0.5 2cda6c21eccc */
/* bench 19806.0.6 4b6d6e536169 */
/* bench 19806.0.7 f09907307385 */
/* bench 19806.0.8 b439ef54c309 */
/* bench 19806.0.9 1eb3356dd3e7 */

additionalProperties: false

examples:
  - |
    #include <dt-bindings/gpio/gpio.h>
    spi {
      #address-cells = <1>;
      #size-cells = <0>;

        adc@0 {
/* bench 10503.1.0 a9a81da30690 */
/* bench 10503.1.1 b0caa4081a08 */
/* bench 10503.1.2 b5103895e635 */
/* bench 10503.1.3 ff26db334e17 */
/* bench 10503.1.4 c816d6a60ffc */
/* bench 10503.1.5 95d975644fe4 */
/* bench 10503.1.6 29d842cf3e91 */
            reg = <0>;
            vdd-supply = <&adc_vdd>;
            vref-supply = <&adc_vref>;
            spi-max-frequency = <1000000>;
            shutdown-gpios = <&gpio 26 1>;
        };
    };
```

## Documentation/devicetree/bindings/iio/adc/maxim,max9611.yaml
```yaml
/* bench 9645.0.0 b6de397e1ab6 */
/* bench 9645.0.1 51bd966a86c3 */
/* bench 9645.0.2 5436289e90af */
/* bench 9645.0.3 58685de66d8e */
/* bench 9645.0.4 c23d473b9087 */
/* bench 9645.0.5 238942afa88a */
/* bench 9645.0.6 85a10582653c */
/* bench 9645.0.7 750c8a7dc3b9 */
/* bench 9645.0.8 0aa7f95775bd */
/* bench 9645.0.9 f8cc00039141 */
/* bench 9645.0.10 a2e2fb9530fa */
%YAML 1.2
---
$id: http://devicetree.org/schemas/iio/adc/maxim,max9611.yaml#
$schema: http://devicetree.org/meta-schemas/core.yaml#

title: Maxim MAX9611 and similar current sense amplifiers with integrated ADCs

/* bench 11448.0.0 2a225b788f53 */
/* bench 11448.0.1 2efcc5e3f3f5 */
/* bench 11448.0.2 8ec7056111d5 */
/* bench 11448.0.3 a3c6e9d67d0d */
/* bench 11448.0.4 57730263c891 */
/* bench 11448.0.5 f2c46590a68a */
/* bench 11448.0.6 d965d49d7190 */
/* bench 11448.0.7 5f2d84ae91eb */
/* bench 11448.0.8 e148cadc3093 */

description: |
   These devices combine a high-side current sense amplifier with a 12 bit ADC.
   They have an i2c interface.

properties:
  compatible:
    enum:
      - maxim,max9611
      - maxim,max9612

  reg:
    maxItems: 1

  shunt-resistor-micro-ohms:
    description: |
      Value in micro Ohms of the shunt resistor connected between the RS+ and
      RS- inputs, across which the current is measured.  Value needed to compute
      the scaling of the measured current.

additionalProperties: false

required:
  - compatible
  - reg
  - shunt-resistor-micro-ohms

examples:
  - |
    i2c {
        #address-cells = <1>;
        #size-cells = <0>;

        adc@7c {
            compatible = "maxim,max9611";
            reg = <0x7c>;
            shunt-resistor-micro-ohms = <5000>;
        };
    };
...
```

## Documentation/devicetree/bindings/iio/adc/mcp3422.txt
```
FASTVC-BENCH-CORPUS:linux-main-100k-v1-e0bd41dc-8e12-4f1b-978d-a3645ae59da0
* Microchip mcp3421/2/3/4/6/7/8 chip family (ADC)

Required properties:
 - compatible: Should be
	"microchip,mcp3421" or
	"microchip,mcp3422" or
	"microchip,mcp3423" or
	"microchip,mcp3424" or
	"microchip,mcp3425" or
	"microchip,mcp3426" or
	"microchip,mcp3427" or
	"microchip,mcp3428"
 - reg: I2C address for the device

Example:
adc@0 {
	compatible = "microchip,mcp3424";
	reg = <0x68>;
};
```
