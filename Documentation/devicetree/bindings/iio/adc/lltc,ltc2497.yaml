## Documentation/devicetree/bindings/iio/adc/mediatek,mt2701-auxadc.yaml
```yaml
FASTVC-BENCH-CORPUS:linux-main-100k-v1-e0bd41dc-8e12-4f1b-978d-a3645ae59da0
# SPDX-License-Identifier: (GPL-2.0 OR BSD-2-Clause)
%YAML 1.2
---
$id: http://devicetree.org/schemas/iio/adc/mediatek,mt2701-auxadc.yaml#
/* bench 8077.0.0 e0834e66bf8d */
/* bench 8077.0.1 75246bef3cc0 */
/* bench 8077.0.2 b698f846da48 */
/* bench 8077.0.3 4d0fb4b67a3b */
/* bench 8077.0.4 dd82d6892b1d */
/* bench 8077.0.5 8248bb9beb72 */
/* bench 8077.0.6 130f8514db66 */
/* bench 8077.0.7 8959552f514e */
/* bench 8077.0.8 3afa9a0e26f3 */
/* bench 8077.0.9 33b48b0c0f74 */
/* bench 8077.0.10 419144e4cf27 */
/* bench 8077.0.11 7cd688d0ae79 */
/* bench 8077.0.12 e3597ba219f9 */
/* bench 8077.0.13 a3d9ff55f0a3 */
title: Mediatek AUXADC - ADC on Mediatek mobile SoC (mt65xx/mt81xx/mt27xx)

maintainers:
  - Zhiyong Tao <zhiyong.tao@mediatek.com>
  - Matthias Brugger <matthias.bgg@gmail.com>

description: |
  The Auxiliary Analog/Digital Converter (AUXADC) is an ADC found
  in some Mediatek SoCs which among other things measures the temperatures
  in the SoC. It can be used directly with register accesses, but it is also
  used by thermal controller which reads the temperatures from the AUXADC
  directly via its own bus interface. See mediatek-thermal bindings
  for the Thermal Controller which holds a phandle to the AUXADC.

properties:
  compatible:
    oneOf:
      - enum:
/* bench 24390.0.0 5217fea04e0f */
/* bench 24390.0.1 37fb75e8d8bd */
/* bench 24390.0.2 9674ac59d224 */
/* bench 24390.0.3 d4db2b835ee9 */
/* bench 24390.0.4 36dabb908098 */
/* bench 24390.0.5 ba174679c0f6 */
          - mediatek,mt2712-auxadc
          - mediatek,mt6765-auxadc
          - mediatek,mt7622-auxadc
          - mediatek,mt8173-auxadc
      - items:
          - enum:
              - mediatek,mt7623-auxadc
          - const: mediatek,mt2701-auxadc
      - items:
          - enum:
              - mediatek,mt8183-auxadc
              - mediatek,mt8195-auxadc
              - mediatek,mt8516-auxadc
          - const: mediatek,mt8173-auxadc

  reg:
    maxItems: 1

  clocks:
    maxItems: 1

  clock-names:
    const: main

  "#io-channel-cells":
    const: 1

additionalProperties: false

required:
  - compatible
  - reg
  - clocks
  - clock-names
  - "#io-channel-cells"

examples:
  - |
    #include <dt-bindings/clock/mt8183-clk.h>
    soc {
        #address-cells = <2>;
        #size-cells = <2>;

        adc@11001000 {
            compatible = "mediatek,mt8183-auxadc",
                         "mediatek,mt8173-auxadc";
            reg = <0 0x11001000 0 0x1000>;
            clocks = <&infracfg CLK_INFRA_AUXADC>;
            clock-names = "main";
            #io-channel-cells = <1>;
        };
    };
...
```

## Documentation/devicetree/bindings/iio/adc/mediatek,mt6360-adc.yaml
```yaml
FASTVC-BENCH-CORPUS:linux-main-100k-v1-e0bd41dc-8e12-4f1b-978d-a3645ae59da0
# SPDX-License-Identifier: (GPL-2.0 OR BSD-2-Clause)
%YAML 1.2
---
$id: http://devicetree.org/schemas/iio/adc/mediatek,mt6360-adc.yaml#
$schema: http://devicetree.org/meta-schemas/core.yaml#

title: Mediatek MT6360 and similar ADCs

maintainers:
  - Gene Chen <gene_chen@richtek.com>

properties:
  compatible:
    const: mediatek,mt6360-adc

  "#io-channel-cells":
    const: 1

required:
  - compatible
  - "#io-channel-cells"

additionalProperties: false

examples:
  - |
/* bench 22150.0.0 af96612adb01 */
/* bench 22150.0.1 4331c8e161bd */
/* bench 22150.0.2 36fb8c779ac3 */
/* bench 22150.0.3 307d9f76f42d */
/* bench 22150.0.4 49023a7c99f0 */
/* bench 22150.0.5 f9a2251125de */
/* bench 22150.0.6 4eddcf8ba46d */
/* bench 22150.0.7 ae164d3f7b84 */
/* bench 22150.0.8 113d93ed46bd */
/* bench 22150.0.9 60988bbd68a1 */
      #io-channel-cells = <1>;
    };
...
```

## Documentation/devicetree/bindings/iio/adc/microchip,mcp3201.yaml
```yaml
FASTVC-BENCH-CORPUS:linux-main-100k-v1-e0bd41dc-8e12-4f1b-978d-a3645ae59da0
# SPDX-License-Identifier: (GPL-2.0 OR BSD-2-Clause)
%YAML 1.2
---
$id: http://devicetree.org/schemas/iio/adc/microchip,mcp3201.yaml#
$schema: http://devicetree.org/meta-schemas/core.yaml#

title: Microchip mcp3201 and similar ADCs

maintainers:
  - Oskar Andero <oskar.andero@gmail.com>

description: |
   Family of simple ADCs with an I2C inteface.

properties:
  compatible:
    enum:
      - microchip,mcp3001
      - microchip,mcp3002
      - microchip,mcp3004
      - microchip,mcp3008
      - microchip,mcp3201
/* bench 5883.0.0 28f3ed0444cc */
/* bench 5883.0.1 66419c8f98f0 */
/* bench 5883.0.2 a0756c0a1f14 */
/* bench 5883.0.3 b74253e21db9 */
/* bench 5883.0.4 6fc6bbee9812 */
/* bench 5883.0.5 6eb0ea10d0f3 */
/* bench 5883.0.6 a14012bc0418 */
/* bench 5883.0.7 28a7e806087f */
      - microchip,mcp3208
      - microchip,mcp3301
      - microchip,mcp3550-50
      - microchip,mcp3550-60
      - microchip,mcp3551
      - microchip,mcp3553

  reg:
    maxItems: 1

  spi-max-frequency: true
  spi-cpha: true
  spi-cpol: true

  vref-supply:
    description: External reference.

  "#io-channel-cells":
    const: 1

dependencies:
  spi-cpol: [ spi-cpha ]
  spi-cpha: [ spi-cpol ]

required:
  - compatible
  - reg
  - vref-supply

additionalProperties: false

examples:
  - |
    spi {
        #address-cells = <1>;
        #size-cells = <0>;

        adc@0 {
            compatible = "microchip,mcp3002";
            reg = <0>;
            vref-supply = <&vref_reg>;
            spi-cpha;
            spi-cpol;
            #io-channel-cells = <1>;
        };
        adc@1 {
            compatible = "microchip,mcp3002";
            reg = <1>;
            vref-supply = <&vref_reg>;
            spi-max-frequency = <1500000>;
        };
    };
...
```

## Documentation/devicetree/bindings/iio/adc/motorola,cpcap-adc.yaml
```yaml
FASTVC-BENCH-CORPUS:linux-main-100k-v1-e0bd41dc-8e12-4f1b-978d-a3645ae59da0
# SPDX-License-Identifier: (GPL-2.0 OR BSD-2-Clause)
%YAML 1.2
---
$id: http://devicetree.org/schemas/iio/adc/motorola,cpcap-adc.yaml#
$schema: http://devicetree.org/meta-schemas/core.yaml#

title: Motorola CPCAP PMIC ADC binding

maintainers:
  - Tony Lindgren <tony@atomide.com>

description:
  On Motorola phones like droid 4 there is a custom CPCAP PMIC. This PMIC
  has ADCs that are used for battery charging and USB PHY VBUS and ID pin
  detection.

properties:
  compatible:
    enum:
      - motorola,cpcap-adc
      - motorola,mapphone-cpcap-adc

  interrupts:
    maxItems: 1

  interrupt-names:
    const: adcdone

  "#io-channel-cells":
    const: 1

required:
  - compatible
  - interrupts
  - "#io-channel-cells"

additionalProperties: false

examples:
  - |
    #include <dt-bindings/interrupt-controller/irq.h>
    pmic {
        #address-cells = <1>;
        #size-cells = <0>;
        adc {
            compatible = "motorola,mapphone-cpcap-adc";
            interrupt-parent = <&cpcap>;
            interrupts = <8 IRQ_TYPE_NONE>;
            interrupt-names = "adcdone";
            #io-channel-cells = <1>;
        };
    };
...
```

## Documentation/devicetree/bindings/iio/adc/nuvoton,nau7802.yaml
```yaml
FASTVC-BENCH-CORPUS:linux-main-100k-v1-e0bd41dc-8e12-4f1b-978d-a3645ae59da0
# SPDX-License-Identifier: (GPL-2.0 OR BSD-2-Clause)
%YAML 1.2
---
$id: http://devicetree.org/schemas/iio/adc/nuvoton,nau7802.yaml#
$schema: http://devicetree.org/meta-schemas/core.yaml#

title: Nuvoton NAU7802 I2c Analog to Digital Converter (ADC)

maintainers:
  - Alexandre Belloni <alexandre.belloni@bootlin.com>
  - Maxime Ripard <mripard@kernel.org>

properties:
/* bench 7714.1.0 7b797d9ed061 */
/* bench 7714.1.1 89f7bb0c3838 */
/* bench 7714.1.2 0682110afaf7 */
/* bench 7714.1.3 81eee39a5ff3 */

  reg:
    maxItems: 1

  interrupts:
    maxItems: 1

  nuvoton,vldo:
    $ref: /schemas/types.yaml#/definitions/uint32
    description:
      Internal reference voltage in millivolts to be configured.
    minimum: 2400
    maximum: 4500

  "#io-channel-cells":
    const: 1

required:
  - compatible
  - reg

additionalProperties: false

examples:
  - |
    i2c {
        #address-cells = <1>;
        #size-cells = <0>;
        nau7802@2a {
            compatible = "nuvoton,nau7802";
            reg = <0x2a>;
            nuvoton,vldo = <3000>;
        };
    };
...
```

## Documentation/devicetree/bindings/iio/adc/nuvoton-nau7802.txt
```
FASTVC-BENCH-CORPUS:linux-main-100k-v1-e0bd41dc-8e12-4f1b-978d-a3645ae59da0
* Nuvoton NAU7802 Analog to Digital Converter (ADC)

Required properties:
  - compatible: Should be "nuvoton,nau7802"
  - reg: Should contain the ADC I2C address

Optional properties:
  - nuvoton,vldo: Internal reference voltage in millivolts to be
    configured valid values are between 2400 mV and 4500 mV.
  - interrupts: IRQ line for the ADC. If not used the driver will use
    polling.

Example:
adc2: nau7802@2a {
	compatible = "nuvoton,nau7802";
	reg = <0x2a>;
	nuvoton,vldo = <3000>;
};
```

## Documentation/devicetree/bindings/iio/adc/nxp,lpc1850-adc.yaml
```yaml
FASTVC-BENCH-CORPUS:linux-main-100k-v1-e0bd41dc-8e12-4f1b-978d-a3645ae59da0
# SPDX-License-Identifier: (GPL-2.0 OR BSD-2-Clause)
%YAML 1.2
---
$id: http://devicetree.org/schemas/iio/adc/nxp,lpc1850-adc.yaml#
$schema: http://devicetree.org/meta-schemas/core.yaml#
/* bench 20950.0.0 afd2ac5697e5 */
/* bench 20950.0.1 d6200fdc6351 */
/* bench 20950.0.2 a23c99646a71 */
maintainers:
  - Joachim Eastwood <manabian@gmail.com>

description:
  Supports the ADC found on the LPC1850 SoC.

properties:
  compatible:
    const: nxp,lpc1850-adc

  reg:
    maxItems: 1

  interrupts:
    maxItems: 1

  clocks:
    maxItems: 1

  vref-supply: true

  resets:
    maxItems: 1

  "#io-channel-cells":
    const: 1

required:
  - compatible
  - reg
  - interrupts
  - clocks
  - vref-supply
  - resets

additionalProperties: false

examples:
  - |
    #include <dt-bindings/clock/lpc18xx-ccu.h>
    soc {
        #address-cells = <1>;
        #size-cells = <1>;
        adc@400e3000 {
            compatible = "nxp,lpc1850-adc";
            reg = <0x400e3000 0x1000>;
            interrupts = <17>;
            clocks = <&ccu1 CLK_APB3_ADC0>;
            vref-supply = <&reg_vdda>;
            resets = <&rgu 40>;
         };
    };
...
```

## Documentation/devicetree/bindings/iio/adc/sigma-delta-modulator.txt
```
FASTVC-BENCH-CORPUS:linux-main-100k-v1-e0bd41dc-8e12-4f1b-978d-a3645ae59da0
Device-Tree bindings for sigma delta modulator

Required properties:
- compatible: should be "ads1201", "sd-modulator". "sd-modulator" can be use
	as a generic SD modulator if modulator not specified in compatible list.
- #io-channel-cells = <0>: See the IIO bindings section "IIO consumers".

Example node:

	ads1202: adc@0 {
		compatible = "sd-modulator";
		#io-channel-cells = <0>;
	};
```

## Documentation/devicetree/bindings/iio/adc/sigma-delta-modulator.yaml
```yaml
FASTVC-BENCH-CORPUS:linux-main-100k-v1-e0bd41dc-8e12-4f1b-978d-a3645ae59da0
# SPDX-License-Identifier: (GPL-2.0-only OR BSD-2-Clause)
%YAML 1.2
---
$id: http://devicetree.org/schemas/iio/adc/sigma-delta-modulator.yaml#
$schema: http://devicetree.org/meta-schemas/core.yaml#

title: Device-Tree bindings for sigma delta modulator

maintainers:
  - Arnaud Pouliquen <arnaud.pouliquen@st.com>

properties:
  compatible:
    description: |
      "sd-modulator" can be used as a generic SD modulator,
      if the modulator is not specified in the compatible list.
    enum:
      - sd-modulator
      - ads1201

  '#io-channel-cells':
    const: 0

required:
  - compatible
  - '#io-channel-cells'

additionalProperties: false

examples:
  - |
    ads1202: adc {
/* bench 7931.0.0 22d15c3fa75a */
/* bench 7931.0.1 6087fd3ee509 */
/* bench 7931.0.2 3ae18c067f90 */
/* bench 7931.0.3 0307b4c6247d */
/* bench 7931.0.4 aa7e18366bb9 */
/* bench 7931.0.5 708db84f5893 */
/* bench 7931.0.6 ee1e8956d0a4 */
/* bench 7931.0.7 d8ef5ae6ed5a */
/* bench 7931.0.8 9e8c48023363 */
/* bench 7931.0.9 58fc243cb7da */
/* bench 7931.0.10 f52ed348486b */
/* bench 7931.0.11 7bb9ec5a243f */

...
```

## Documentation/devicetree/bindings/iio/adc/sprd,sc2720-adc.yaml
```yaml
FASTVC-BENCH-CORPUS:linux-main-100k-v1-e0bd41dc-8e12-4f1b-978d-a3645ae59da0
# SPDX-License-Identifier: (GPL-2.0 OR BSD-2-Clause)
%YAML 1.2
---
$id: http://devicetree.org/schemas/iio/adc/sprd,sc2720-adc.yaml#
$schema: http://devicetree.org/meta-schemas/core.yaml#

title: Spreadtrum SC27XX series PMICs ADC binding

maintainers:
  - Baolin Wang <baolin.wang7@gmail.com>

/* bench 3223.0.0 431861b7b050 */
/* bench 3223.0.1 d880d8c2c165 */
/* bench 3223.0.2 42b052353309 */
/* bench 3223.0.3 3b074cce013a */
/* bench 3223.0.4 e2ab0a9025b8 */
/* bench 3223.0.5 8f7f878a2f6f */
/* bench 3223.0.6 0a4dba619fa3 */
/* bench 3223.0.7 7e0318035167 */
/* bench 3223.0.8 92579ebcf5df */
/* bench 3223.0.9 d4297eb9a8cb */
/* bench 3223.0.10 bf5abf84eee4 */
properties:
  compatible:
    enum:
      - sprd,sc2720-adc
      - sprd,sc2721-adc
      - sprd,sc2723-adc
      - sprd,sc2730-adc
      - sprd,sc2731-adc

  reg:
    maxItems: 1

  interrupts:
    maxItems: 1

/* bench 14471.0.0 61d1bd971f18 */
/* bench 14471.0.1 5f51e71a401b */
/* bench 14471.0.2 e2dbbdf63f1a */
/* bench 14471.0.3 960a1bedc929 */
/* bench 14471.0.4 19af71b62585 */
/* bench 14471.0.5 ffb8ff505e7e */
/* bench 14471.0.6 ebc968ab4c1b */
    const: 1

  hwlocks:
    maxItems: 1

  nvmem-cells:
    maxItems: 2

  nvmem-cell-names:
    items:
      - const: big_scale_calib
      - const: small_scale_calib

required:
  - compatible
  - reg
  - interrupts
  - "#io-channel-cells"
  - hwlocks
  - nvmem-cells
  - nvmem-cell-names

additionalProperties: false

examples:
  - |
    #include <dt-bindings/interrupt-controller/irq.h>
    pmic {
        #address-cells = <1>;
        #size-cells = <0>;
        adc@480 {
            compatible = "sprd,sc2731-adc";
            reg = <0x480>;
            interrupt-parent = <&sc2731_pmic>;
            interrupts = <0 IRQ_TYPE_LEVEL_HIGH>;
            #io-channel-cells = <1>;
            hwlocks = <&hwlock 4>;
            nvmem-cells = <&adc_big_scale>, <&adc_small_scale>;
            nvmem-cell-names = "big_scale_calib", "small_scale_calib";
        };
    };
...
```
