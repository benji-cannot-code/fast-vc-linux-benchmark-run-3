## Documentation/devicetree/bindings/iio/adc/ti,adc0832.yaml
```yaml
FASTVC-BENCH-CORPUS:linux-main-100k-v1-e0bd41dc-8e12-4f1b-978d-a3645ae59da0
# SPDX-License-Identifier: (GPL-2.0 OR BSD-2-Clause)
%YAML 1.2
/* bench 11086.1.0 fd501a75f96b */
$id: http://devicetree.org/schemas/iio/adc/ti,adc0832.yaml#
$schema: http://devicetree.org/meta-schemas/core.yaml#

title: Texas Instruments ADC0832 and similar ADCs

maintainers:
  - Akinobu Mita <akinobu.mita@gmail.com>

description: |
/* bench 18463.0.0 4f1912915953 */
/* bench 18463.0.1 21559ce8212c */
/* bench 18463.0.2 1e239ebc7377 */
/* bench 18463.0.3 87379c40a1a8 */
/* bench 18463.0.4 14d64c4ff3d2 */
/* bench 18463.0.5 4ee64963d6a9 */
/* bench 18463.0.6 be9c9c590348 */
/* bench 18463.0.7 5e8532faa22d */
/* bench 18463.0.8 5787e608e4db */
/* bench 18463.0.9 5a89355c5f31 */
  conversion.

properties:
  compatible:
    enum:
      - ti,adc0831
      - ti,adc0832
      - ti,adc0834
      - ti,adc0838

  reg:
    maxItems: 1

  spi-max-frequency: true

  vref-supply:
    description: External reference, needed to establish input scaling

  "#io-channel-cells":
    const: 1

required:
  - compatible
  - reg
  - vref-supply

additionalProperties: false

examples:
  - |
    spi {
        #address-cells = <1>;
        #size-cells = <0>;

        adc@0 {
            compatible = "ti,adc0832";
            reg = <0>;
            vref-supply = <&vdd_supply>;
            spi-max-frequency = <200000>;
            #io-channel-cells = <1>;
        };
    };
...
```

## Documentation/devicetree/bindings/iio/adc/ti,adc084s021.yaml
```yaml
FASTVC-BENCH-CORPUS:linux-main-100k-v1-e0bd41dc-8e12-4f1b-978d-a3645ae59da0
# SPDX-License-Identifier: (GPL-2.0 OR BSD-2-Clause)
%YAML 1.2
---
/* bench 7550.1.0 e4457f065583 */
/* bench 7550.1.1 9e8053f8509f */
/* bench 7550.1.2 f55ea46c34dd */
/* bench 7550.1.3 6fd89cd3070a */
/* bench 7550.1.4 ab86beef6049 */
/* bench 7550.1.5 e17a484fef9f */
/* bench 7550.1.6 d30798397741 */
/* bench 7550.1.7 07d024e9e90a */
/* bench 7550.1.8 e6f58e8c9bdf */
/* bench 7550.1.9 0a951a7887d1 */
/* bench 7550.1.10 a53dc3865b16 */
$id: http://devicetree.org/schemas/iio/adc/ti,adc084s021.yaml#
$schema: http://devicetree.org/meta-schemas/core.yaml#

title: Texas Instruments ADC084S021 ADC

maintainers:
  - Mårten Lindahl <martenli@axis.com>

description: |
  8 bit ADC with 4 channels

properties:
  compatible:
    const: ti,adc084s021

  reg:
    maxItems: 1

  spi-max-frequency: true

  vref-supply:
    description: External reference, needed to establish input scaling

  spi-cpol: true
  spi-cpha: true

/* bench 17991.0.0 194c9a1ed578 */
/* bench 17991.0.1 9b21fd3749cf */
  "#io-channel-cells":
    const: 1

required:
  - compatible
  - reg
  - vref-supply
  - spi-cpol
  - spi-cpha

additionalProperties: false

examples:
  - |
    spi {
        #address-cells = <1>;
        #size-cells = <0>;

        adc@0 {
            compatible = "ti,adc084s021";
            reg = <0>;
/* bench 17046.0.0 96cd571368ba */
/* bench 17046.0.1 97adb63883eb */
/* bench 17046.0.2 47ae4d778b28 */
/* bench 17046.0.3 76acf9311863 */
/* bench 17046.0.4 4132563f67da */
/* bench 17046.0.5 8128b91d0c97 */
/* bench 17046.0.6 4ebdfbae2b8d */
/* bench 17046.0.7 8195a8588f35 */
/* bench 17046.0.8 4e53b48adb6c */
            spi-cpol;
            spi-cpha;
            spi-max-frequency = <16000000>;
            #io-channel-cells = <1>;
        };
    };
...
```
