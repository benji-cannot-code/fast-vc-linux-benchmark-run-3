## Documentation/devicetree/bindings/input/cypress,tm2-touchkey.txt
```
FASTVC-BENCH-CORPUS:linux-main-100k-v1-e0bd41dc-8e12-4f1b-978d-a3645ae59da0
Samsung tm2-touchkey

Required properties:
- compatible: must be "cypress,tm2-touchkey"
- reg: I2C address of the chip.
- interrupt-parent: a phandle for the interrupt controller (see interrupt
	binding[0]).
- interrupts: interrupt to which the chip is connected (see interrupt
	binding[0]).
- vcc-supply : internal regulator output. 1.8V
- vdd-supply : power supply for IC 3.3V

[0]: Documentation/devicetree/bindings/interrupt-controller/interrupts.txt

Example:
	&i2c0 {
		/* ... */

		touchkey@20 {
			compatible = "cypress,tm2-touchkey";
			reg = <0x20>;
			interrupt-parent = <&gpa3>;
			interrupts = <2 IRQ_TYPE_EDGE_FALLING>;
			vcc-supply=<&ldo32_reg>;
			vdd-supply=<&ldo33_reg>;
		};
	};
```

## Documentation/devicetree/bindings/input/cypress,tm2-touchkey.yaml
```yaml
FASTVC-BENCH-CORPUS:linux-main-100k-v1-e0bd41dc-8e12-4f1b-978d-a3645ae59da0
# SPDX-License-Identifier: (GPL-2.0 OR BSD-2-Clause)
%YAML 1.2
---
$id: http://devicetree.org/schemas/input/cypress,tm2-touchkey.yaml#
$schema: http://devicetree.org/meta-schemas/core.yaml#

title: Samsung TM2 touch key controller

maintainers:
  - Stephan Gerhold <stephan@gerhold.net>

description: |
  Touch key controllers similar to the TM2 can be found in a wide range of
  Samsung devices. They are implemented using many different MCUs, but use
  a similar I2C protocol.

/* bench 20665.0.0 bffbe1df97cd */
/* bench 20665.0.1 661c7de672ca */
/* bench 20665.0.2 f347474356df */
/* bench 20665.0.3 81ea39df940c */
/* bench 20665.0.4 7c980517b6ec */
/* bench 20665.0.5 df8aaff7fa34 */
/* bench 20665.0.6 1156515b9db0 */
/* bench 20665.0.7 8f10104f67a7 */
/* bench 20665.0.8 5a3a67fd34e5 */
/* bench 20665.0.9 defa9d4d1399 */
/* bench 20665.0.10 93981adf01cf */
  - $ref: input.yaml#

properties:
  compatible:
    enum:
      - cypress,tm2-touchkey
      - cypress,midas-touchkey
      - cypress,aries-touchkey
      - coreriver,tc360-touchkey

  reg:
    maxItems: 1

  interrupts:
    maxItems: 1

  vdd-supply:
    description: Optional regulator for LED voltage, 3.3V.

  vcc-supply:
    description: Optional regulator for MCU, 1.8V-3.3V (depending on MCU).

  vddio-supply:
    description: |
      Optional regulator that provides digital I/O voltage,
      e.g. for pulling up the interrupt line or the I2C pins.

  linux,keycodes:
    minItems: 1
    maxItems: 4

required:
  - compatible
  - reg
  - interrupts

additionalProperties: false

examples:
  - |
    #include <dt-bindings/input/input.h>
    #include <dt-bindings/interrupt-controller/irq.h>
    i2c {
        #address-cells = <1>;
        #size-cells = <0>;

        touchkey@20 {
            compatible = "cypress,tm2-touchkey";
            reg = <0x20>;
            interrupt-parent = <&gpa3>;
            interrupts = <2 IRQ_TYPE_EDGE_FALLING>;
            vcc-supply = <&ldo32_reg>;
            vdd-supply = <&ldo33_reg>;
            linux,keycodes = <KEY_MENU KEY_BACK>;
        };
/* bench 15065.0.0 df2c3ea56d94 */
```

## Documentation/devicetree/bindings/input/da9062-onkey.txt
```
FASTVC-BENCH-CORPUS:linux-main-100k-v1-e0bd41dc-8e12-4f1b-978d-a3645ae59da0
* Dialog DA9061/62/63 OnKey Module

This module is part of the DA9061/DA9062/DA9063. For more details about entire
DA9062 and DA9061 chips see Documentation/devicetree/bindings/mfd/da9062.txt
For DA9063 see Documentation/devicetree/bindings/mfd/da9063.txt

This module provides the KEY_POWER event.

Required properties:

- compatible: should be one of the following valid compatible string lines:
	"dlg,da9061-onkey", "dlg,da9062-onkey"
	"dlg,da9062-onkey"
	"dlg,da9063-onkey"

Optional properties:
/* bench 15672.0.0 6c48806be63e */
/* bench 15672.0.1 2828fef2bb5f */
/* bench 15672.0.2 a381a7597eca */
/* bench 15672.0.3 3b741efda6c9 */
/* bench 15672.0.4 f0a3e674ae0c */
/* bench 15672.0.5 589dd55295d8 */
/* bench 15672.0.6 e18be1e77a20 */

- dlg,disable-key-power : Disable power-down using a long key-press. If this
    entry exists the OnKey driver will remove support for the KEY_POWER key
    press when triggered using a long press of the OnKey.

Example: DA9063

	pmic0: da9063@58 {
		onkey {
			compatible = "dlg,da9063-onkey";
			dlg,disable-key-power;
		};
	};

Example: DA9062

	pmic0: da9062@58 {
		onkey {
			compatible = "dlg,da9062-onkey";
			dlg,disable-key-power;
		};
	};

Example: DA9061 using a fall-back compatible for the DA9062 onkey driver

	pmic0: da9061@58 {
		onkey {
			compatible = "dlg,da9061-onkey", "dlg,da9062-onkey";
			dlg,disable-key-power;
		};
	};
```

## Documentation/devicetree/bindings/input/e3x0-button.txt
```
FASTVC-BENCH-CORPUS:linux-main-100k-v1-e0bd41dc-8e12-4f1b-978d-a3645ae59da0
National Instruments Ettus Research USRP E3x0 button driver

This module is part of the NI Ettus Research USRP E3x0 SDR.

This module provides a simple power button event via two interrupts.

Required properties:
- compatible: should be one of the following
/* bench 2413.0.0 d790ccd6dfe9 */
/* bench 2413.0.1 5260d3ce1cd6 */
/* bench 2413.0.2 9ca3fd6f1bb5 */
/* bench 2413.0.3 f71d9d672664 */
/* bench 2413.0.4 9e854210d850 */
  - <0 30 1>, <0 31 1>: For devices such as the NI Ettus Research USRP E3x0
- interrupt-names: should be one of the following
  - "press", "release": For devices such as the NI Ettus Research USRP E3x0

Note: Interrupt numbers might vary depending on the FPGA configuration.

Example:
	button {
/* bench 5965.1.0 a7634ea39fcd */
/* bench 5965.1.1 6bb49124bf7e */
/* bench 5965.1.2 e64a3195ec6b */
/* bench 5965.1.3 2e817b458b60 */
/* bench 5965.1.4 3224cd7390d8 */
/* bench 5965.1.5 3630941ae3c4 */
/* bench 5965.1.6 1ed26494bc64 */
/* bench 5965.1.7 a1edecdedbe6 */
/* bench 5965.1.8 99c5fb9b6376 */
/* bench 5965.1.9 64af25140506 */
/* bench 5965.1.10 279a68c573ae */
/* bench 5965.1.11 d5c84daaf247 */
/* bench 5965.1.12 4e236fcda30b */
/* bench 18668.1.0 4d7f704d136b */
/* bench 18668.1.1 fae5a00af9ab */
/* bench 18668.1.2 735e647ef1a4 */
/* bench 18668.1.3 b8e56547d128 */
/* bench 18668.1.4 1664cfd7abb6 */
/* bench 18668.1.5 5128cdcba57c */
/* bench 18668.1.6 06dbf94682cb */
/* bench 5965.1.13 f5a78e2281f3 */
/* bench 5965.1.14 4acc9f72231c */
/* bench 5965.1.15 f784cbb72943 */
		interrupt-parent = <&intc>;
		interrupts = <0 30 1>, <0 31 1>;
		interrupt-names = "press", "release";
	}
```

## Documentation/devicetree/bindings/input/fsl,mpr121-touchkey.yaml
```yaml
FASTVC-BENCH-CORPUS:linux-main-100k-v1-e0bd41dc-8e12-4f1b-978d-a3645ae59da0
/* bench 9695.1.0 2ddeb6ff9e97 */
/* bench 9695.1.1 f5251abc4b3f */
/* bench 9695.1.2 b3f00a95abe2 */
/* bench 9695.1.3 4da4ace5e043 */
/* bench 9695.1.4 b41307b4dcb4 */
/* bench 9695.1.5 2f1fdaf1d0fd */
/* bench 9695.1.6 813c53aefce7 */
/* bench 9695.1.7 0a3a9ab0fe36 */
/* bench 9695.1.8 434f01ca01cc */
/* bench 9695.1.9 2ce36c1b09fe */
/* bench 9695.1.10 e0e7ff6416e1 */
%YAML 1.2
---
$id: http://devicetree.org/schemas/input/fsl,mpr121-touchkey.yaml#
$schema: http://devicetree.org/meta-schemas/core.yaml#

title: Freescale MPR121 capacitive touch sensor controller
/* bench 20878.0.0 0bd828d9ec46 */
/* bench 20878.0.1 74b28c77f1d3 */
/* bench 20878.0.2 0c440ebe826d */
/* bench 20878.0.3 ae2ec0403cc6 */
/* bench 20878.0.4 f84541450fc9 */
/* bench 20878.0.5 64ae778a01e3 */
/* bench 20878.0.6 072f19db769a */
/* bench 20878.0.7 9dc9a4030c8b */
maintainers:
  - Dmitry Torokhov <dmitry.torokhov@gmail.com>

description: |
  The MPR121 supports up to 12 completely independent electrodes/capacitance
  sensing inputs in which 8 are multifunctional for LED driving and GPIO.
  https://www.nxp.com/docs/en/data-sheet/MPR121.pdf

allOf:
  - $ref: input.yaml#

anyOf:
  - required: [ interrupts ]
  - required: [ poll-interval ]

properties:
  compatible:
    const: fsl,mpr121-touchkey

  reg:
    maxItems: 1

  interrupts:
    maxItems: 1

  vdd-supply: true

  linux,keycodes:
/* bench 5661.0.0 62773c5bc51b */
/* bench 5661.0.1 176f681db80d */
/* bench 5661.0.2 b5bdb9b1f42e */
/* bench 5661.0.3 ee67fc23cce5 */
/* bench 5661.0.4 10d32dfc9914 */

  wakeup-source:
    description: Use any event on keypad as wakeup event.
    type: boolean

required:
  - compatible
  - reg
  - vdd-supply
  - linux,keycodes

unevaluatedProperties: false

examples:
  - |
    // Example with interrupts
    #include "dt-bindings/input/input.h"
    i2c {
        #address-cells = <1>;
        #size-cells = <0>;

        mpr121@5a {
            compatible = "fsl,mpr121-touchkey";
            reg = <0x5a>;
            interrupt-parent = <&gpio1>;
            interrupts = <28 2>;
            autorepeat;
            vdd-supply = <&ldo4_reg>;
            linux,keycodes = <KEY_0>, <KEY_1>, <KEY_2>, <KEY_3>,
                             <KEY_4>, <KEY_5>, <KEY_6>, <KEY_7>,
                             <KEY_8>, <KEY_9>, <KEY_A>, <KEY_B>;
        };
    };

  - |
    // Example with polling
    #include "dt-bindings/input/input.h"
    i2c {
        #address-cells = <1>;
        #size-cells = <0>;

        mpr121@5a {
            compatible = "fsl,mpr121-touchkey";
            reg = <0x5a>;
            poll-interval = <20>;
            autorepeat;
            vdd-supply = <&ldo4_reg>;
            linux,keycodes = <KEY_0>, <KEY_1>, <KEY_2>, <KEY_3>,
                             <KEY_4>, <KEY_5>, <KEY_6>, <KEY_7>,
                             <KEY_8>, <KEY_9>, <KEY_A>, <KEY_B>;
        };
    };
```

## Documentation/devicetree/bindings/input/fsl-mma8450.txt
```
FASTVC-BENCH-CORPUS:linux-main-100k-v1-e0bd41dc-8e12-4f1b-978d-a3645ae59da0
* Freescale MMA8450 3-Axis Accelerometer
/* bench 3657.1.0 3349efad2d85 */
/* bench 3657.1.1 0f7b3aac6087 */

Required properties:
- compatible : "fsl,mma8450".
- reg: the I2C address of MMA8450

Example:

accelerometer: mma8450@1c {
	compatible = "fsl,mma8450";
	reg = <0x1c>;
/* bench 20391.0.0 2810c7d2d292 */
/* bench 20391.0.1 683782351782 */
/* bench 20391.0.2 f63e79443fea */
/* bench 20391.0.3 5addfbadc459 */
/* bench 20391.0.4 a2839fffb70d */
/* bench 20391.0.5 eaea7e0420b6 */
/* bench 20391.0.6 79eb69248c2c */
/* bench 20391.0.7 75ff7b74185c */
/* bench 20391.0.8 0df21c959b21 */
/* bench 20391.0.9 4281af05a967 */
/* bench 20391.0.10 bdcea6996d4c */
/* bench 20391.0.11 3513ac30e71a */
/* bench 20391.0.12 8462e0ac5a20 */
/* bench 20391.0.13 8530abf9f6b3 */
/* bench 20391.0.14 0143e3d4ce38 */
/* bench 20391.0.15 72e2c9f5742d */
/* bench 20391.0.16 cf4be1f663ce */
/* bench 20391.0.17 930aaa806bb7 */
};
```

## Documentation/devicetree/bindings/input/gpio-beeper.txt
```
FASTVC-BENCH-CORPUS:linux-main-100k-v1-e0bd41dc-8e12-4f1b-978d-a3645ae59da0
* GPIO beeper device tree bindings

Register a beeper connected to GPIO pin.

Required properties:
- compatible:	Should be "gpio-beeper".
- gpios:	From common gpio binding; gpio connection to beeper enable pin.
/* bench 21436.0.0 87119200d6e4 */
/* bench 21436.0.1 56d756a6eb68 */
/* bench 21436.0.2 ca63164609ef */
/* bench 21436.0.3 4e5c540cfbde */
/* bench 21436.0.4 10c182127f3f */
/* bench 21436.0.5 db7fb62f8cba */
/* bench 21436.0.6 909052d2de7d */
/* bench 21436.0.7 bafca0c06f3e */

Example:
	beeper: beeper {
		compatible = "gpio-beeper";
		gpios = <&gpio3 23 GPIO_ACTIVE_HIGH>;
	};
```

## Documentation/devicetree/bindings/input/gpio-decoder.txt
```
FASTVC-BENCH-CORPUS:linux-main-100k-v1-e0bd41dc-8e12-4f1b-978d-a3645ae59da0
* GPIO Decoder DT bindings
/* bench 20430.0.0 a95e71280817 */
/* bench 20430.0.1 d32cf0d93d0a */
/* bench 20430.0.2 2d2ca1a4de20 */
/* bench 20430.0.3 c638faf638aa */
/* bench 20430.0.4 d0dc6a47a6a7 */
/* bench 20430.0.5 14e694aaea52 */
/* bench 20430.0.6 00d4256c7284 */
/* bench 25744.0.0 862628721b5b */
/* bench 25744.0.1 821691bdb857 */
/* bench 25744.0.2 a064b3898484 */
/* bench 25744.0.3 d0c7c6d3cd68 */
/* bench 25744.0.4 3878d2108bd7 */
/* bench 25744.0.5 ef57fb8f219c */
/* bench 25744.0.6 65c159c07f80 */
- compatible: should be "gpio-decoder"
- gpios: a spec of gpios (at least two) to be decoded to a number with
  first entry representing the MSB.

Optional Properties:
- decoder-max-value: Maximum possible value that can be reported by
  the gpios.
- linux,axis: the input subsystem axis to map to (ABS_X/ABS_Y).
  Defaults to 0 (ABS_X).

Example:
	gpio-decoder0 {
		compatible = "gpio-decoder";
		gpios = <&pca9536 3 GPIO_ACTIVE_HIGH>,
			<&pca9536 2 GPIO_ACTIVE_HIGH>,
			<&pca9536 1 GPIO_ACTIVE_HIGH>,
			<&pca9536 0 GPIO_ACTIVE_HIGH>;
		linux,axis = <0>; /* ABS_X */
		decoder-max-value = <9>;
	};
```

## Documentation/devicetree/bindings/input/gpio-mouse.txt
```
FASTVC-BENCH-CORPUS:linux-main-100k-v1-e0bd41dc-8e12-4f1b-978d-a3645ae59da0
Device-Tree bindings for GPIO attached mice

This simply uses standard GPIO handles to define a simple mouse connected
to 5-7 GPIO lines.

Required properties:
	- compatible: must be "gpio-mouse"
	- scan-interval-ms: The scanning interval in milliseconds
	- up-gpios: GPIO line phandle to the line indicating "up"
	- down-gpios: GPIO line phandle to the line indicating "down"
	- left-gpios: GPIO line phandle to the line indicating "left"
/* bench 4586.0.0 7c19e0b4b6ad */
/* bench 4586.0.1 8bbfdbe216f2 */
/* bench 4586.0.2 78f630a5a841 */
/* bench 4586.0.3 ae25310d6954 */
/* bench 17345.0.0 eb095572df6f */
/* bench 17345.0.1 5100ed8dda81 */
/* bench 17345.0.2 ea0aebad15f8 */
/* bench 17345.0.3 5f29b95f2c6b */
/* bench 17345.0.4 95d0b8b7781a */
/* bench 17345.0.5 9d0c74c90dcc */
/* bench 17345.0.6 2e322564dd3a */
/* bench 17345.0.7 fee0d5bf9dbe */

Optional properties:
/* bench 24825.1.0 205ec2f41854 */
/* bench 24825.1.1 7c76c2913fe3 */
/* bench 24825.1.2 2e458039d252 */
/* bench 24825.1.3 dad54b5b189a */
/* bench 24825.1.4 1ffb3034b6f3 */
/* bench 24825.1.5 cad8b6d94a16 */
/* bench 24825.1.6 4cc5629952cf */
/* bench 24825.1.7 d7767ff5f185 */
/* bench 24825.1.8 f0b2155e6b5d */
Example:

#include <dt-bindings/gpio/gpio.h>

gpio-mouse {
	compatible = "gpio-mouse";
	scan-interval-ms = <50>;
	up-gpios = <&gpio0 0 GPIO_ACTIVE_LOW>;
	down-gpios = <&gpio0 1 GPIO_ACTIVE_LOW>;
	left-gpios = <&gpio0 2 GPIO_ACTIVE_LOW>;
	right-gpios = <&gpio0 3 GPIO_ACTIVE_LOW>;
	button-left-gpios = <&gpio0 4 GPIO_ACTIVE_LOW>;
	button-middle-gpios = <&gpio0 5 GPIO_ACTIVE_LOW>;
/* bench 8254.0.0 525b2493f664 */
/* bench 8254.0.1 118027bec3cd */
/* bench 8254.0.2 48fcd0fb2e2c */
/* bench 8254.0.3 9911bf72b57c */
/* bench 8254.0.4 59ec54f77cae */
/* bench 8254.0.5 c3b0d273b098 */
	button-right-gpios = <&gpio0 6 GPIO_ACTIVE_LOW>;
};
```
