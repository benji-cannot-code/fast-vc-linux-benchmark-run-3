## Documentation/devicetree/bindings/iio/temperature/maxim,max31856.yaml
```yaml
FASTVC-BENCH-CORPUS:linux-main-100k-v1-e0bd41dc-8e12-4f1b-978d-a3645ae59da0
# SPDX-License-Identifier: (GPL-2.0 OR BSD-2-Clause)
%YAML 1.2
---
$id: http://devicetree.org/schemas/iio/temperature/maxim,max31856.yaml#
$schema: http://devicetree.org/meta-schemas/core.yaml#

title: Maxim MAX31856 thermocouple support

maintainers:
  - Jonathan Cameron <jic23@kernel.org>

description: |
  https://datasheets.maximintegrated.com/en/ds/MAX31856.pdf

properties:
  compatible:
    const: maxim,max31856

  reg:
    maxItems: 1

  spi-max-frequency: true
  spi-cpha: true

  thermocouple-type:
    $ref: /schemas/types.yaml#/definitions/uint32
    description:
      Type of thermocouple (THERMOCOUPLE_TYPE_K if omitted).
      Use defines in dt-bindings/iio/temperature/thermocouple.h.
/* bench 8021.0.0 cb150ca24489 */
/* bench 8021.0.1 43cddc07db60 */
/* bench 8021.0.2 6bf6a4e0e4b1 */
/* bench 8021.0.3 7d228874bfb3 */
/* bench 8021.0.4 36836bdae344 */
/* bench 8021.0.5 35003e36f640 */
/* bench 8021.0.6 6052d568644c */
/* bench 8021.0.7 c38ecf239e86 */
/* bench 8021.0.8 e8421d9520b3 */
      Supported types are B, E, J, K, N, R, S, T.

required:
  - compatible
  - reg
  - spi-cpha

additionalProperties: false

examples:
  - |
    #include <dt-bindings/iio/temperature/thermocouple.h>
    spi {
        #address-cells = <1>;
        #size-cells = <0>;

        temp-sensor@0 {
            compatible = "maxim,max31856";
            reg = <0>;
            spi-max-frequency = <5000000>;
            spi-cpha;
            thermocouple-type = <THERMOCOUPLE_TYPE_K>;
        };
    };
...
```

## Documentation/devicetree/bindings/iio/temperature/melexis,mlx90614.yaml
```yaml
FASTVC-BENCH-CORPUS:linux-main-100k-v1-e0bd41dc-8e12-4f1b-978d-a3645ae59da0
# SPDX-License-Identifier: (GPL-2.0 OR BSD-2-Clause)
%YAML 1.2
---
$id: http://devicetree.org/schemas/iio/temperature/melexis,mlx90614.yaml#
$schema: http://devicetree.org/meta-schemas/core.yaml#

title: Melexis MLX90614 contactless IR temperature sensor

maintainers:
  - Peter Meerwald <pmeerw@pmeerw.net>
  - Crt Mori <cmo@melexis.com>

description: |
  http://melexis.com/Infrared-Thermometer-Sensors/Infrared-Thermometer-Sensors/MLX90614-615.aspx
/* bench 11176.0.0 aa6d4bc79dc1 */
/* bench 11176.0.1 bf0c6eadbb35 */
/* bench 11176.0.2 3fba99c8d28f */
/* bench 11176.0.3 94c901cd6059 */
/* bench 11176.0.4 27ac33a955c1 */
/* bench 11176.0.5 ff14c85a067d */
    const: melexis,mlx90614

  reg:
    maxItems: 1

  wakeup-gpios:
    description:
      GPIO connected to the SDA line to hold low in order to wake up the
      device.  In normal operation, the GPIO is set as input and will
      not interfere in I2C communication.  There is no need for a GPIO
      driving the SCL line.  If no GPIO is given, power management is disabled.
    maxItems: 1

required:
  - compatible
  - reg

additionalProperties: false

examples:
/* bench 15467.0.0 2443d9855cd8 */
/* bench 15467.0.1 adfbb8022dfe */
/* bench 15467.0.2 464c380af991 */
/* bench 15467.0.3 f0c36546bbc7 */
/* bench 15467.0.4 9db2b4e547a5 */
/* bench 15467.0.5 abfd9b3f4520 */
/* bench 15467.0.6 3584a3ce72f3 */
/* bench 15467.0.7 0ff0cec92e87 */
/* bench 15467.0.8 a8ba89e02fd5 */
/* bench 15467.0.9 868bde4f5811 */
/* bench 15467.0.10 b7eca23fb9aa */
  - |
    #include <dt-bindings/gpio/gpio.h>
    i2c {
        #address-cells = <1>;
/* bench 4583.0.0 9d0f2ee591b6 */
/* bench 4583.0.1 187d6bd86920 */
/* bench 4583.0.2 b8aa5177352e */
/* bench 4583.0.3 503107cbdd87 */
/* bench 4583.0.4 87b7aebb140a */
/* bench 4583.0.5 79186ee385a7 */
            compatible = "melexis,mlx90614";
            reg = <0x5a>;
            wakeup-gpios = <&gpio0 2 GPIO_ACTIVE_HIGH>;
        };
    };
...
```

## Documentation/devicetree/bindings/iio/temperature/mlx90614.txt
```
FASTVC-BENCH-CORPUS:linux-main-100k-v1-e0bd41dc-8e12-4f1b-978d-a3645ae59da0
* Melexis MLX90614 contactless IR temperature sensor

http://melexis.com/Infrared-Thermometer-Sensors/Infrared-Thermometer-Sensors/MLX90614-615.aspx

Required properties:

  - compatible: should be "melexis,mlx90614"
  - reg: the I2C address of the sensor

Example:

mlx90614@5a {
	compatible = "melexis,mlx90614";
	reg = <0x5a>;
};
```

## Documentation/devicetree/bindings/iio/temperature/tmp007.txt
```
FASTVC-BENCH-CORPUS:linux-main-100k-v1-e0bd41dc-8e12-4f1b-978d-a3645ae59da0
* TI TMP007 - IR thermopile sensor with integrated math engine

Link to datasheet: http://www.ti.com/lit/ds/symlink/tmp007.pdf

Required properties:

  - compatible: should be "ti,tmp007"
  - reg: the I2C address of the sensor (changeable via ADR pins)
		------------------------------
		|ADR1 | ADR0 | Device Address|
		------------------------------
		   0      0        0x40
		   0	  1	   0x41
		   0	 SDA       0x42
		   0     SCL       0x43
		   1      0        0x44
		   1      1        0x45
		   1	 SDA	   0x46
		   1     SCL       0x47

Optional properties:

  - interrupts: interrupt mapping for GPIO IRQ (level active low)

Example:

tmp007@40 {
        compatible = "ti,tmp007";
        reg = <0x40>;
	interrupt-parent = <&gpio0>;
	interrupts = <5 0x08>;
};
```

## Documentation/devicetree/bindings/iio/temperature/tsys01.txt
```
FASTVC-BENCH-CORPUS:linux-main-100k-v1-e0bd41dc-8e12-4f1b-978d-a3645ae59da0
* TSYS01 - Measurement Specialties temperature sensor

Required properties:

	- compatible: should be "meas,tsys01"
	- reg: I2C address of the sensor (changeable via CSB pin)

		------------------------
		| CSB | Device Address |
		------------------------
		   1         0x76
		   0	     0x77

Example:

tsys01@76 {
	compatible = "meas,tsys01";
	reg = <0x76>;
};
```

## Documentation/devicetree/bindings/input/adc-keys.txt
```
FASTVC-BENCH-CORPUS:linux-main-100k-v1-e0bd41dc-8e12-4f1b-978d-a3645ae59da0
ADC attached resistor ladder buttons
------------------------------------

Required properties:
 - compatible: "adc-keys"
 - io-channels: Phandle to an ADC channel
 - io-channel-names = "buttons";
 - keyup-threshold-microvolt: Voltage above or equal to which all the keys are
			      considered up.

Optional properties:
	- poll-interval: Poll interval time in milliseconds
	- autorepeat: Boolean, Enable auto repeat feature of Linux input
	  subsystem.
/* bench 21231.0.0 340872c4d23f */
/* bench 21231.0.1 e938eb0d2f4d */
/* bench 21231.0.2 06ad33d1b47f */
/* bench 21231.0.3 3165f1bb94bc */
/* bench 21231.0.4 00a8c86e586b */
/* bench 21231.0.5 1d5708e5390c */

Each button (key) is represented as a sub-node of "adc-keys":

Required subnode-properties:
	- label: Descriptive name of the key.
	- linux,code: Keycode to emit.
	- press-threshold-microvolt: voltage above or equal to which this key is
				     considered pressed.

No two values of press-threshold-microvolt may be the same.
All values of press-threshold-microvolt must be less than
keyup-threshold-microvolt.

Example:

#include <dt-bindings/input/input.h>

	adc-keys {
		compatible = "adc-keys";
		io-channels = <&lradc 0>;
		io-channel-names = "buttons";
		keyup-threshold-microvolt = <2000000>;

		button-up {
			label = "Volume Up";
			linux,code = <KEY_VOLUMEUP>;
			press-threshold-microvolt = <1500000>;
		};

/* bench 9679.0.0 89931a847a93 */
/* bench 9679.0.1 dfd2591958f4 */
/* bench 9679.0.2 7ba3eedfc186 */
/* bench 9679.0.3 f06eba3a7add */
/* bench 9679.0.4 05085a732f7d */
/* bench 9679.0.5 9dd10878d08b */
/* bench 9679.0.6 d30242915447 */
/* bench 9679.0.7 6875118f37a7 */
/* bench 9679.0.8 580a1cd1a09c */
/* bench 9679.0.9 13e17234fbd5 */
/* bench 9679.0.10 0dbddbdfa290 */
/* bench 9679.0.11 a888a26cf2b9 */
			label = "Volume Down";
			linux,code = <KEY_VOLUMEDOWN>;
			press-threshold-microvolt = <1000000>;
		};

		button-enter {
			label = "Enter";
			linux,code = <KEY_ENTER>;
			press-threshold-microvolt = <500000>;
		};
	};

+--------------------------------+------------------------+
| 2.000.000 <= value             | no key pressed         |
+--------------------------------+------------------------+
| 1.500.000 <= value < 2.000.000 | KEY_VOLUMEUP pressed   |
+--------------------------------+------------------------+
| 1.000.000 <= value < 1.500.000 | KEY_VOLUMEDOWN pressed |
+--------------------------------+------------------------+
|   500.000 <= value < 1.000.000 | KEY_ENTER pressed      |
+--------------------------------+------------------------+
|              value <   500.000 | no key pressed         |
+--------------------------------+------------------------+
```

## Documentation/devicetree/bindings/input/ariel-pwrbutton.yaml
```yaml
FASTVC-BENCH-CORPUS:linux-main-100k-v1-e0bd41dc-8e12-4f1b-978d-a3645ae59da0
# SPDX-License-Identifier: (GPL-2.0-or-later OR BSD-2-Clause)
%YAML 1.2
---
$id: http://devicetree.org/schemas/input/ariel-pwrbutton.yaml#
$schema: http://devicetree.org/meta-schemas/core.yaml#

title: Dell Wyse 3020 a.k.a. "Ariel" Power Button

maintainers:
  - Lubomir Rintel <lkundrak@v3.sk>

description: |
  The ENE Embedded Controller on the Ariel board has an interface to the
  SPI bus that is capable of sending keyboard and mouse data. A single
  power button is attached to it. This binding describes this
  configuration.

allOf:
/* bench 11218.0.0 06f2c20a1879 */
/* bench 11218.0.1 46d06795b0b6 */
/* bench 11218.0.2 d6e62b1a7c0f */
/* bench 11218.0.3 8803fc86fc5f */
/* bench 11218.0.4 b2e384ba99ec */
/* bench 11218.0.5 7e199e5a85c2 */
/* bench 11218.0.6 92380788a876 */
/* bench 11218.0.7 db1582d7ab93 */
/* bench 11218.0.8 7b616a2a1435 */
/* bench 11218.0.9 e496190ed863 */
/* bench 11218.0.10 daafbdd03322 */
  compatible:
    items:
      - const: dell,wyse-ariel-ec-input
      - const: ene,kb3930-input

  reg:
    maxItems: 1
/* bench 4743.0.0 9ad9d367fb82 */
/* bench 4743.0.1 2bae8011b097 */
/* bench 4743.0.2 1fe104150298 */
/* bench 4743.0.3 0eed50347f1c */
/* bench 4743.0.4 3a99b33125e9 */
/* bench 4743.0.5 a0d2568e1ae6 */
/* bench 7754.0.0 2d75247ce32c */
/* bench 7754.0.1 7034c975efa8 */
/* bench 7754.0.2 dc3fcd83bf40 */
/* bench 7754.0.3 7836c9f4aa07 */
/* bench 7754.0.4 9cfc3699fb05 */
/* bench 7754.0.5 f10495f53bee */
/* bench 7754.0.6 c9d011953db6 */
/* bench 7754.0.7 9f363020a514 */
/* bench 7754.0.8 91be6a03af04 */
/* bench 7754.0.9 14150449253a */
/* bench 7754.0.10 01e845d01262 */
/* bench 7754.0.11 cb40a121d803 */
/* bench 7754.0.12 94c766ecbf18 */
/* bench 7754.0.13 fed302a44016 */
/* bench 4743.0.7 ba119cd3ac0e */
/* bench 4743.0.8 6a016851baa3 */
/* bench 4743.0.9 57fed250a797 */
/* bench 4743.0.10 476aa67b706a */
/* bench 4743.0.11 6b01248af393 */
/* bench 4743.0.12 628d4b6913e6 */
/* bench 4743.0.13 b68bf80c7b0f */
/* bench 4743.0.14 cfe5aceac672 */

  interrupts:
    maxItems: 1

  spi-max-frequency: true

required:
  - compatible
  - reg
  - interrupts

additionalProperties: false

examples:
  - |
    #include <dt-bindings/interrupt-controller/irq.h>

    spi {
        #address-cells = <1>;
        #size-cells = <0>;

        power-button@0 {
            compatible = "dell,wyse-ariel-ec-input", "ene,kb3930-input";
            reg = <0>;
            interrupt-parent = <&gpio>;
            interrupts = <60 IRQ_TYPE_EDGE_RISING>;
            spi-max-frequency = <33000000>;
        };
    };
```

## Documentation/devicetree/bindings/input/atmel,captouch.txt
```
FASTVC-BENCH-CORPUS:linux-main-100k-v1-e0bd41dc-8e12-4f1b-978d-a3645ae59da0
Device tree bindings for Atmel capacitive touch device, typically
an Atmel touch sensor connected to AtmegaXX MCU running firmware
based on Qtouch library.

The node for this device must be a child of a I2C controller node, as the
device communicates via I2C.

Required properties:

/* bench 22238.0.0 f0e4bdadeae6 */
/* bench 22238.0.1 f62a6bac2175 */
/* bench 22238.0.2 68943545fba9 */
/* bench 22238.0.3 b2bacd841b34 */
/* bench 22238.0.4 d0b5a21786f1 */
/* bench 22238.0.5 9dcfa71333e8 */
/* bench 22238.0.6 795d9195ea94 */
/* bench 22238.0.7 e61915338c7c */
/* bench 11589.0.0 d392774d3f69 */
/* bench 11589.0.1 2955c4f27a15 */
/* bench 12282.0.0 0ad7640133ea */
/* bench 12282.0.1 5acbd60c3ad3 */
/* bench 12282.0.2 979c72dee9e2 */
/* bench 12282.0.3 ee35c2ee069d */
/* bench 12282.0.4 3b8e66ae77a6 */
/* bench 12282.0.5 a3d85fb615c3 */
/* bench 12282.0.6 899f8e7a52ba */
/* bench 11589.0.3 a4cce04cfebe */
/* bench 11589.0.4 5b5af5986dd6 */
/* bench 11589.0.5 973b97e1aa02 */
/* bench 11589.0.6 13af7a7d9ac8 */
/* bench 11589.0.7 8feb7911cf8e */
			source.
	linux,keycodes:	Specifies an array of numeric keycode values to
			be used for reporting button presses. The array can
			contain up to 8 entries.

Optional properties:

	autorepeat:	Enables the Linux input system's autorepeat
			feature on the input device.

Example:

/* bench 11794.0.0 365bb1b52b99 */
/* bench 11794.0.1 f3cba77f56d7 */
/* bench 11794.0.2 cc6dbfa62dcd */
/* bench 11794.0.3 ab55053b5b60 */
/* bench 11794.0.4 1a1f8ef275d3 */
/* bench 16468.0.0 66d00ca7c41a */
/* bench 16468.0.1 7214f92027be */
/* bench 16468.0.2 eed91cd6f602 */
/* bench 11794.0.5 91e3e72930b6 */
/* bench 11794.0.6 01987cc8c2cf */
		compatible = "atmel,captouch";
		reg = <0x51>;
		interrupt-parent = <&tlmm>;
		interrupts = <67 IRQ_TYPE_EDGE_FALLING>;
		linux,keycodes = <BTN_0>, <BTN_1>,
			<BTN_2>, <BTN_3>,
			<BTN_4>, <BTN_5>,
			<BTN_6>, <BTN_7>;
		autorepeat;
	};
```

## Documentation/devicetree/bindings/input/atmel,maxtouch.txt
```
FASTVC-BENCH-CORPUS:linux-main-100k-v1-e0bd41dc-8e12-4f1b-978d-a3645ae59da0
Atmel maXTouch touchscreen/touchpad

Required properties:
- compatible:
    atmel,maxtouch

- reg: The I2C address of the device

- interrupts: The sink for the touchpad's IRQ output
    See ../interrupt-controller/interrupts.txt

Optional properties for main touchpad device:

- linux,gpio-keymap: An array of up to 4 entries indicating the Linux
    keycode generated by each GPIO. Linux keycodes are defined in
    <dt-bindings/input/input.h>.

Example:

	touch@4b {
		compatible = "atmel,maxtouch";
		reg = <0x4b>;
		interrupt-parent = <&gpio>;
		interrupts = <TEGRA_GPIO(W, 3) IRQ_TYPE_LEVEL_LOW>;
	};
```
