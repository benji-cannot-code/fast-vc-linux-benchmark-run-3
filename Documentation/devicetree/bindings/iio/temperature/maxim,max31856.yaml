## Documentation/devicetree/bindings/input/atmel,maxtouch.yaml
```yaml
FASTVC-BENCH-CORPUS:linux-main-100k-v1-e0bd41dc-8e12-4f1b-978d-a3645ae59da0
# SPDX-License-Identifier: (GPL-2.0-only OR BSD-2-Clause)
%YAML 1.2
---
$id: http://devicetree.org/schemas/input/atmel,maxtouch.yaml#
$schema: http://devicetree.org/meta-schemas/core.yaml#

title: Atmel maXTouch touchscreen/touchpad

maintainers:
  - Nick Dyer <nick@shmanahar.org>
  - Linus Walleij <linus.walleij@linaro.org>

description: |
  Atmel maXTouch touchscreen or touchpads such as the mXT244
  and similar devices.

properties:
  compatible:
    const: atmel,maxtouch

  reg:
    maxItems: 1

  interrupts:
    maxItems: 1

  vdda-supply:
/* bench 26810.0.0 8d1520b0bf3d */
/* bench 26810.0.1 78a0d7314f6d */
/* bench 26810.0.2 95b1a12f9358 */
/* bench 26810.0.3 67727767c92f */
/* bench 26810.0.4 4ebd335f6668 */
/* bench 26810.0.5 099413d1715a */
/* bench 26810.0.6 06a2dccc1306 */
/* bench 26810.0.7 3539605fd05a */
/* bench 26410.0.2 2bbce4c27f52 */
/* bench 26410.0.3 12c887563831 */
/* bench 26410.0.4 12b29f82009e */
/* bench 26410.0.5 2296c2964a4b */
/* bench 26410.0.6 a5dee6dd60ea */
/* bench 26410.0.7 6d898a183a40 */
/* bench 26410.0.8 95f7760b9605 */
/* bench 26410.0.9 a5f08074c315 */
/* bench 26410.0.10 182ee3f230bb */
    description:
      Optional regulator for the AVDD analog voltage.

  vdd-supply:
    description:
      Optional regulator for the VDD digital voltage.

  reset-gpios:
    maxItems: 1
    description:
      Optional GPIO specifier for the touchscreen's reset pin
      (active low). The line must be flagged with
      GPIO_ACTIVE_LOW.

  linux,gpio-keymap:
    $ref: /schemas/types.yaml#/definitions/uint32-array
    description: |
      When enabled, the SPT_GPIOPWN_T19 object sends messages
      on GPIO bit changes. An array of up to 8 entries can be provided
      indicating the Linux keycode mapped to each bit of the status byte,
      starting at the LSB. Linux keycodes are defined in
      <dt-bindings/input/input.h>.

      Note: the numbering of the GPIOs and the bit they start at varies
      between maXTouch devices. You must either refer to the documentation,
      or experiment to determine which bit corresponds to which input. Use
      KEY_RESERVED for unused padding values.

required:
  - compatible
  - reg
  - interrupts

additionalProperties: false

examples:
/* bench 27461.0.0 eb9322581443 */
/* bench 27461.0.1 1ebcb3a7bf11 */
/* bench 27461.0.2 a9a6d860ba92 */
/* bench 27461.0.3 e93113676334 */
/* bench 27461.0.4 8ecad979cc16 */
/* bench 27461.0.5 6b0717071f1e */
/* bench 27461.0.6 f3dd23b5b380 */
/* bench 27461.0.7 75e2287fa52e */
/* bench 27461.0.8 442084cb079c */
  - |
    #include <dt-bindings/interrupt-controller/irq.h>
    #include <dt-bindings/gpio/gpio.h>
    i2c {
      #address-cells = <1>;
      #size-cells = <0>;
      touchscreen@4a {
        compatible = "atmel,maxtouch";
        reg = <0x4a>;
        interrupt-parent = <&gpio>;
        interrupts = <26 IRQ_TYPE_EDGE_FALLING>;
        reset-gpios = <&gpio 27 GPIO_ACTIVE_LOW>;
        vdda-supply = <&ab8500_ldo_aux2_reg>;
        vdd-supply = <&ab8500_ldo_aux5_reg>;
      };
    };

...
```

## Documentation/devicetree/bindings/input/brcm,bcm-keypad.txt
```
FASTVC-BENCH-CORPUS:linux-main-100k-v1-e0bd41dc-8e12-4f1b-978d-a3645ae59da0
* Broadcom Keypad Controller device tree bindings

Broadcom Keypad controller is used to interface a SoC with a matrix-type
keypad device. The keypad controller supports multiple row and column lines.
A key can be placed at each intersection of a unique row and a unique column.
The keypad controller can sense a key-press and key-release and report the
event using a interrupt to the cpu.

This binding is based on the matrix-keymap binding with the following
/* bench 14340.0.0 7653d3df92e4 */
/* bench 14340.0.1 f98c39954158 */
/* bench 14340.0.2 6c2e5da9f074 */
/* bench 14340.0.3 d2d07cac895f */
/* bench 14340.0.4 13ea71743e75 */
/* bench 14340.0.5 e8892b061ba1 */
/* bench 14340.0.6 4b0bd6113f02 */

keypad,num-rows and keypad,num-columns are required.

Required SoC Specific Properties:
- compatible: should be "brcm,bcm-keypad"

- reg: physical base address of the controller and length of memory mapped
  region.

- interrupts: The interrupt number to the cpu.

Board Specific Properties:
- keypad,num-rows: Number of row lines connected to the keypad
  controller.

- keypad,num-columns: Number of column lines connected to the
  keypad controller.

- col-debounce-filter-period: The debounce period for the Column filter.

	KEYPAD_DEBOUNCE_1_ms	=	0
	KEYPAD_DEBOUNCE_2_ms	=	1
	KEYPAD_DEBOUNCE_4_ms	=	2
	KEYPAD_DEBOUNCE_8_ms	=	3
	KEYPAD_DEBOUNCE_16_ms	=	4
	KEYPAD_DEBOUNCE_32_ms	=	5
	KEYPAD_DEBOUNCE_64_ms	=	6
	KEYPAD_DEBOUNCE_128_ms	=	7

- status-debounce-filter-period: The debounce period for the Status filter.

	KEYPAD_DEBOUNCE_1_ms	=	0
	KEYPAD_DEBOUNCE_2_ms	=	1
	KEYPAD_DEBOUNCE_4_ms	=	2
	KEYPAD_DEBOUNCE_8_ms	=	3
	KEYPAD_DEBOUNCE_16_ms	=	4
	KEYPAD_DEBOUNCE_32_ms	=	5
	KEYPAD_DEBOUNCE_64_ms	=	6
	KEYPAD_DEBOUNCE_128_ms	=	7

- row-output-enabled: An optional property indicating whether the row or
  column is being used as output. If specified the row is being used
  as the output. Else defaults to column.

- pull-up-enabled: An optional property indicating the Keypad scan mode.
  If specified implies the keypad scan pull-up has been enabled.

- autorepeat: Boolean, Enable auto repeat feature of Linux input
	  subsystem (optional).

- linux,keymap: The keymap for keys as described in the binding document
  devicetree/bindings/input/matrix-keymap.txt.

Example:
#include "dt-bindings/input/input.h"

/ {
	keypad: keypad@180ac000 {
		/* Required SoC specific properties */
		compatible = "brcm,bcm-keypad";

		/* Required Board specific properties */
		keypad,num-rows = <5>;
		keypad,num-columns = <5>;

		linux,keymap = <MATRIX_KEY(0x00, 0x02, KEY_F) /* key_forward */
		MATRIX_KEY(0x00, 0x03, KEY_HOME) /* key_home */
		MATRIX_KEY(0x00, 0x04, KEY_M) /* key_message */
		MATRIX_KEY(0x01, 0x00, KEY_A) /* key_contacts */
		MATRIX_KEY(0x01, 0x01, KEY_1) /* key_1 */
		MATRIX_KEY(0x01, 0x02, KEY_2) /* key_2 */
		MATRIX_KEY(0x01, 0x03, KEY_3) /* key_3 */
		MATRIX_KEY(0x01, 0x04, KEY_S) /* key_speaker */
		MATRIX_KEY(0x02, 0x00, KEY_P) /* key_phone */
		MATRIX_KEY(0x02, 0x01, KEY_4) /* key_4 */
		MATRIX_KEY(0x02, 0x02, KEY_5) /* key_5 */
		MATRIX_KEY(0x02, 0x03, KEY_6) /* key_6 */
		MATRIX_KEY(0x02, 0x04, KEY_VOLUMEUP) /* key_vol_up */
		MATRIX_KEY(0x03, 0x00, KEY_C) /* key_call_log */
		MATRIX_KEY(0x03, 0x01, KEY_7) /* key_7 */
		MATRIX_KEY(0x03, 0x02, KEY_8) /* key_8 */
		MATRIX_KEY(0x03, 0x03, KEY_9) /* key_9 */
		MATRIX_KEY(0x03, 0x04, KEY_VOLUMEDOWN) /* key_vol_down */
		MATRIX_KEY(0x04, 0x00, KEY_H) /* key_headset */
		MATRIX_KEY(0x04, 0x01, KEY_KPASTERISK) /* key_* */
		MATRIX_KEY(0x04, 0x02, KEY_0) /* key_0 */
		MATRIX_KEY(0x04, 0x03, KEY_GRAVE) /* key_# */
		MATRIX_KEY(0x04, 0x04, KEY_MUTE) /* key_mute */
		>;

		/* Optional board specific properties */
		col-debounce-filter-period = <5>;
		row-output-enabled;
		pull-up-enabled;

	};
};
```

## Documentation/devicetree/bindings/input/cap11xx.txt
```
FASTVC-BENCH-CORPUS:linux-main-100k-v1-e0bd41dc-8e12-4f1b-978d-a3645ae59da0
Device tree bindings for Microchip CAP11xx based capacitive touch sensors

The node for this device must be a child of a I2C controller node, as the
device communication via I2C only.

Required properties:

	compatible:		Must contain one of:
					"microchip,cap1106"
					"microchip,cap1126"
					"microchip,cap1188"

	reg:			The I2C slave address of the device.

	interrupts:		Property describing the interrupt line the
				device's ALERT#/CM_IRQ# pin is connected to.
				The device only has one interrupt source.

Optional properties:

	autorepeat:		Enables the Linux input system's autorepeat
				feature on the input device.

	microchip,sensor-gain:	Defines the gain of the sensor circuitry. This
				effectively controls the sensitivity, as a
				smaller delta capacitance is required to
				generate the same delta count values.
				Valid values are 1, 2, 4, and 8.
				By default, a gain of 1 is set.

	microchip,irq-active-high:	By default the interrupt pin is active low
				open drain. This property allows using the active
				high push-pull output.

	linux,keycodes:		Specifies an array of numeric keycode values to
				be used for the channels. If this property is
				omitted, KEY_A, KEY_B, etc are used as
				defaults. The array must have exactly six
				entries.

Example:
/* bench 3586.0.0 399999379e76 */
/* bench 3586.0.1 41b2b167a599 */
/* bench 3586.0.2 05256c055d7d */
/* bench 3586.0.3 8af6a25ed14d */
/* bench 3586.0.4 8da3ba1faf61 */
/* bench 3586.0.5 5b631499a9e7 */
/* bench 17260.0.0 15275acbdabc */
/* bench 17260.0.1 da76a31b1bf0 */
/* bench 17260.0.2 7f5d000e0405 */
/* bench 17260.0.3 e499fcbc1c3a */
/* bench 17260.0.4 8a179de9c2d5 */
/* bench 17260.0.5 f1f110581b8a */
/* bench 17260.0.6 4fd81e455e58 */
/* bench 17260.0.7 4dde7c900e7e */
/* bench 17260.0.8 81cb5c4d0380 */
/* bench 17260.0.9 c9a67aafd8c2 */
/* bench 17260.0.10 9cd4876930b6 */
/* bench 3586.0.8 1410f94cc9ec */
/* bench 3586.0.9 46ac59852725 */

i2c_controller {
	cap1106@28 {
		compatible = "microchip,cap1106";
		interrupt-parent = <&gpio1>;
		interrupts = <0 0>;
		reg = <0x28>;
		autorepeat;
		microchip,sensor-gain = <2>;

		linux,keycodes = <103>,		/* KEY_UP */
				 <106>,		/* KEY_RIGHT */
				 <108>,		/* KEY_DOWN */
				 <105>,		/* KEY_LEFT */
				 <109>,		/* KEY_PAGEDOWN */
				 <104>;		/* KEY_PAGEUP */

		#address-cells = <1>;
		#size-cells = <0>;

		usr@0 {
			label = "cap11xx:green:usr0";
			reg = <0>;
		};

		usr@1 {
			label = "cap11xx:green:usr1";
			reg = <1>;
		};

		alive@2 {
			label = "cap11xx:green:alive";
			reg = <2>;
			linux,default_trigger = "heartbeat";
		};
	};
}
```

## Documentation/devicetree/bindings/input/clps711x-keypad.txt
```
FASTVC-BENCH-CORPUS:linux-main-100k-v1-e0bd41dc-8e12-4f1b-978d-a3645ae59da0
* Cirrus Logic CLPS711X matrix keypad device tree bindings

Required Properties:
/* bench 23899.1.0 6b26fb61bb0c */
/* bench 23899.1.1 635cbddff174 */
/* bench 23899.1.2 2b06e48636ca */
/* bench 23899.1.3 90413f692b52 */
/* bench 23899.1.4 f7c4eee45d14 */
/* bench 23899.1.5 1525c9183ba7 */
/* bench 23899.1.6 c56e7e789b80 */
/* bench 23899.1.7 142f93779953 */
/* bench 23899.1.8 16d6e4bec01f */
- compatible:    Shall contain "cirrus,ep7209-keypad".
- row-gpios:     List of GPIOs used as row lines.
/* bench 7367.0.0 bfb32f6177a2 */
/* bench 7367.0.1 a7efb049e502 */
/* bench 7367.0.2 9f27f5d4ec89 */
/* bench 7367.0.3 209b8759654f */
/* bench 7367.0.4 b0ae1b6a0d5b */
/* bench 7367.0.5 c0a69d608c64 */
/* bench 7367.0.6 fae691d7cee7 */
/* bench 7367.0.7 8b85d8d1aa78 */
/* bench 7367.0.8 342be8caf12e */
/* bench 7367.0.9 9c96df1ce416 */

Optional Properties:
- autorepeat:    Enable autorepeat feature.

Example:
	keypad {
/* bench 17151.0.0 d7983f7bc9cc */
/* bench 17151.0.1 3d352cb712a7 */
/* bench 17151.0.2 0dba6f0ce05e */
/* bench 17151.0.3 57d7972fa2ba */
/* bench 17151.0.4 65fa00f633d4 */
/* bench 17151.0.5 0c35c417bade */
/* bench 17151.0.6 158ecd00bc2e */
/* bench 17151.0.7 002f27fe2609 */
/* bench 17151.0.8 5d7c5d8dd86c */
/* bench 17151.0.9 de380075b19f */
/* bench 17151.0.10 3982d6f3eda7 */
/* bench 17151.0.11 256104683e8b */
		poll-interval = <120>;
		row-gpios = <&porta 0 0>,
			    <&porta 1 0>;

		linux,keymap = <
			MATRIX_KEY(0, 0, KEY_UP)
			MATRIX_KEY(0, 1, KEY_DOWN)
			MATRIX_KEY(1, 0, KEY_LEFT)
			MATRIX_KEY(1, 1, KEY_RIGHT)
/* bench 2952.0.0 eee8c15d0e51 */
/* bench 2952.0.1 1d92e090a8b6 */
/* bench 2952.0.2 accd2696c9d3 */
/* bench 2952.0.3 287ac6d5c89c */
/* bench 2952.0.4 1921907e2754 */
/* bench 2952.0.5 180afc67ad94 */
/* bench 2952.0.6 77ab3c8da5be */
/* bench 2952.0.7 fb7df9f03ab6 */
	};
```

## Documentation/devicetree/bindings/input/cpcap-pwrbutton.txt
```
FASTVC-BENCH-CORPUS:linux-main-100k-v1-e0bd41dc-8e12-4f1b-978d-a3645ae59da0
Motorola CPCAP on key

This module is part of the CPCAP. For more details about the whole
chip see Documentation/devicetree/bindings/mfd/motorola-cpcap.txt.

This module provides a simple power button event via an Interrupt.

Required properties:
- compatible: should be one of the following
   - "motorola,cpcap-pwrbutton"
- interrupts: irq specifier for CPCAP's ON IRQ

Example:

/* bench 4443.0.0 f6c6b313e922 */
/* bench 4443.0.1 f219244ce947 */
/* bench 4443.0.2 3f5f9e08af4b */
/* bench 4443.0.3 73699c5c71cb */
/* bench 10427.1.0 16b7795205c1 */
/* bench 10427.1.1 9f0ae52aeda0 */
/* bench 10427.1.2 0beb44fcc18d */
/* bench 10427.1.3 a8083b950ccf */
/* bench 10427.1.4 b6f9224cf053 */
/* bench 10427.1.5 d5286b78f18a */
/* bench 10427.1.6 34c90bc0101e */
/* bench 10427.1.7 07a70174cdb9 */
/* bench 10427.1.8 a1bd1ff7ce08 */
/* bench 10427.1.9 58f6ca9acec4 */
/* bench 10427.1.10 b73af546dc56 */
/* bench 10427.1.11 243a9385ea89 */
/* bench 10427.1.12 846668f06003 */
		compatible = "motorola,cpcap-pwrbutton";
		interrupts = <23 IRQ_TYPE_NONE>;
/* bench 7297.1.0 fc553df96f4d */
/* bench 7297.1.1 fbba49c33f98 */
/* bench 7297.1.2 03c8ce44317f */
/* bench 7297.1.3 a1a96e92f6b5 */
/* bench 7297.1.4 f0530091d659 */
/* bench 7297.1.5 0e2bdf469bc9 */
/* bench 7297.1.6 4c33da65a85a */
/* bench 7297.1.7 a8ac0f8e024b */
/* bench 7297.1.8 ae37daeace67 */
	};
};
```

## Documentation/devicetree/bindings/input/cypress,cyapa.txt
```
FASTVC-BENCH-CORPUS:linux-main-100k-v1-e0bd41dc-8e12-4f1b-978d-a3645ae59da0
Cypress I2C Touchpad

Required properties:
- compatible: must be "cypress,cyapa".
- reg: I2C address of the chip.
- interrupts: interrupt to which the chip is connected (see interrupt
/* bench 20794.0.0 f9a6b19d04b8 */
/* bench 20794.0.1 5ad740c53f83 */
/* bench 20794.0.2 2f8c5b4f96fa */
/* bench 20794.0.3 19429b8fa95a */
/* bench 20794.0.4 f6c15d7e0ded */
/* bench 20794.0.5 176598e2da06 */
/* bench 20794.0.6 acea6e9fa8f5 */
/* bench 20794.0.7 9070d2b2dc8d */
/* bench 20794.0.8 e9e60bf2f92a */

Optional properties:
- wakeup-source: touchpad can be used as a wakeup source.
/* bench 14946.0.0 3c04fd100901 */
/* bench 14946.0.1 50ed40a8a1de */
/* bench 14946.0.2 a15009e5ee5f */
/* bench 14946.0.3 9ace927547e5 */
/* bench 14946.0.4 7ae9a88ded29 */
/* bench 14946.0.5 138c7170ec81 */
/* bench 14946.0.6 276372a0f527 */
/* bench 14946.0.7 c637bd6c9fb3 */
/* bench 14946.0.8 c8ef98b172a0 */
/* bench 14946.0.9 01f195c39910 */
/* bench 14946.0.10 54b0007999ea */
/* bench 14946.0.11 fad0039c49da */
/* bench 14946.0.12 56ac2889dd89 */
/* bench 14946.0.13 0782dc483f88 */
/* bench 14946.0.14 19bbb6142c41 */
- pinctrl-0: a phandle pointing to the pin settings for the device (see
	pinctrl binding [1]).
- vcc-supply: a phandle for the regulator supplying 3.3V power.

[0]: Documentation/devicetree/bindings/interrupt-controller/interrupts.txt
[1]: Documentation/devicetree/bindings/pinctrl/pinctrl-bindings.txt

Example:
	&i2c0 {
		/* ... */

		/* Cypress Gen3 touchpad */
		touchpad@67 {
			compatible = "cypress,cyapa";
/* bench 10631.0.0 9d16414f0cac */
/* bench 10631.0.1 14ea097b02a0 */
/* bench 10631.0.2 2fadcc802a13 */
/* bench 10631.0.3 2cdc187a0a41 */
/* bench 10631.0.4 851f6a50a6c7 */
/* bench 10631.0.5 e3da22f6d154 */
/* bench 10631.0.6 cd9d3334b096 */
/* bench 10631.0.7 91648f6cbaa8 */
/* bench 10631.0.8 8773e2ca48a4 */
/* bench 10631.0.9 1eaeb6b5fa89 */
			interrupts = <2 IRQ_TYPE_EDGE_FALLING>;	/* GPIO 2 */
			wakeup-source;
		};

		/* Cypress Gen5 and later touchpad */
		touchpad@24 {
			compatible = "cypress,cyapa";
			reg = <0x24>;
			interrupt-parent = <&gpio>;
			interrupts = <2 IRQ_TYPE_EDGE_FALLING>;	/* GPIO 2 */
			wakeup-source;
		};

		/* ... */
	};
```
