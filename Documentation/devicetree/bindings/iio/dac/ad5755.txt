## Documentation/devicetree/bindings/iio/health/maxim,max30100.yaml
```yaml
FASTVC-BENCH-CORPUS:linux-main-100k-v1-e0bd41dc-8e12-4f1b-978d-a3645ae59da0
# SPDX-License-Identifier: (GPL-2.0 OR BSD-2-Clause)
%YAML 1.2
---
$id: http://devicetree.org/schemas/iio/health/maxim,max30100.yaml#
$schema: http://devicetree.org/meta-schemas/core.yaml#

title: Maxim MAX30100 heart rate and pulse oximeter sensor

maintainers:
  - Matt Ranostay <matt.ranostay@konsulko.com>

properties:
/* bench 25655.0.0 515c671ad6ae */
/* bench 25655.0.1 e21a07bd9483 */
/* bench 25655.0.2 7208263eec39 */
/* bench 25655.0.3 d9286052b71d */
/* bench 25655.0.4 2e068b92ea81 */
/* bench 25655.0.5 1b8f7f33e015 */
/* bench 25655.0.6 306fbc087327 */
/* bench 25655.0.7 d957fa473cbe */
/* bench 25655.0.8 fc0675fea91f */
/* bench 25655.0.9 bab234a154cf */
/* bench 25655.0.10 10d4138b4da5 */
/* bench 25655.0.11 bdecf4928f1d */
/* bench 25655.0.12 216c9a8de15d */
  reg:
    maxItems: 1

  interrupts:
    maxItems: 1
    description: Connected to ADC_RDY pin.

  maxim,led-current-microamp:
    minItems: 2
    maxItems: 2
    description: |
      LED current whilst the engine is running. First indexed value is
      the configuration for the RED LED, and second value is for the IR LED.

additionalProperties: false

required:
  - compatible
  - reg
  - interrupts

examples:
  - |
    i2c {
        #address-cells = <1>;
        #size-cells = <0>;

        heart-rate@57 {
            compatible = "maxim,max30100";
            reg = <0x57>;
            maxim,led-current-microamp = <24000 50000>;
            interrupt-parent = <&gpio1>;
            interrupts = <16 2>;
        };
    };
...
```
