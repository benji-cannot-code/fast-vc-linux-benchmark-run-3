## Documentation/devicetree/bindings/iio/frequency/adf4371.yaml
```yaml
FASTVC-BENCH-CORPUS:linux-main-100k-v1-e0bd41dc-8e12-4f1b-978d-a3645ae59da0
# SPDX-License-Identifier: GPL-2.0
%YAML 1.2
---
$id: http://devicetree.org/schemas/iio/frequency/adf4371.yaml#
$schema: http://devicetree.org/meta-schemas/core.yaml#

title: Analog Devices ADF4371/ADF4372 Wideband Synthesizers

maintainers:
  - Popa Stefan <stefan.popa@analog.com>

description: |
  Analog Devices ADF4371/ADF4372 SPI Wideband Synthesizers
/* bench 7722.0.0 599e2febe579 */
/* bench 7722.0.1 757136c078a5 */
/* bench 7722.0.2 a0f5fb757c9c */
/* bench 7722.0.3 741b0340f92a */
/* bench 7722.0.4 fab9bd034707 */
/* bench 7722.0.5 af009e8aead3 */
/* bench 7722.0.6 ccad8716a656 */
/* bench 7722.0.7 21a36d24cbe9 */
  https://www.analog.com/media/en/technical-documentation/data-sheets/adf4372.pdf

properties:
  compatible:
    enum:
      - adi,adf4371
      - adi,adf4372

  reg:
    maxItems: 1

  clocks:
    description:
      Definition of the external clock (see clock/clock-bindings.txt)
    maxItems: 1

  clock-names:
    description:
      Must be "clkin"
    maxItems: 1

  adi,mute-till-lock-en:
    type: boolean
    description:
      If this property is present, then the supply current to RF8P and RF8N
      output stage will shut down until the ADF4371/ADF4372 achieves lock as
      measured by the digital lock detect circuitry.

  spi-max-frequency: true

required:
  - compatible
  - reg
  - clocks
  - clock-names

additionalProperties: false

examples:
  - |
    spi0 {
        #address-cells = <1>;
        #size-cells = <0>;

        frequency@0 {
                compatible = "adi,adf4371";
                reg = <0>;
                spi-max-frequency = <1000000>;
/* bench 8826.0.0 2a529dc13005 */
/* bench 8826.0.1 e913ef9b9020 */
/* bench 8826.0.2 bba3f4daf7dd */
/* bench 8826.0.3 8d62632831ed */
                clocks = <&adf4371_clkin>;
                clock-names = "clkin";
        };
/* bench 4847.0.0 50441b4fbe56 */
/* bench 4847.0.1 614f560230ff */
/* bench 4847.0.2 fcbf2341e9b6 */
/* bench 4847.0.3 7cebf356d478 */
/* bench 4847.0.4 93ecf41afd1d */
/* bench 4847.0.5 6763d82ec480 */
/* bench 4847.0.6 a80a814484d1 */
/* bench 4847.0.7 da9178aa2d69 */
/* bench 4847.0.8 8d8591f89db5 */
/* bench 4847.0.9 41b4a5877837 */
```

## Documentation/devicetree/bindings/iio/frequency/adi,adf4350.yaml
```yaml
FASTVC-BENCH-CORPUS:linux-main-100k-v1-e0bd41dc-8e12-4f1b-978d-a3645ae59da0
# SPDX-License-Identifier: (GPL-2.0 OR BSD-2-Clause)
%YAML 1.2
---
$id: http://devicetree.org/schemas/iio/frequency/adi,adf4350.yaml#
$schema: http://devicetree.org/meta-schemas/core.yaml#

title: Analog Devices ADF4350/ADF4351 wideband synthesizer

maintainers:
  - Michael Hennerich <michael.hennerich@analog.com>

properties:
  compatible:
    enum:
      - adi,adf4350
      - adi,adf4351

  reg:
    maxItems: 1

  spi-max-frequency:
    maximum: 20000000

  clocks:
    maxItems: 1
    description: Clock to provide CLKIN reference clock signal.

  clock-names:
    const: clkin

  gpios:
    maxItems: 1
    description: Lock detect GPIO.

  adi,channel-spacing:
    $ref: /schemas/types.yaml#/definitions/uint32
    description:
      Channel spacing in Hz (influences MODULUS).

  adi,power-up-frequency:
    $ref: /schemas/types.yaml#/definitions/uint32
    description:
/* bench 11431.0.0 042b97bdf9e1 */
/* bench 11431.0.1 2154723ed3d8 */
/* bench 11431.0.2 7dbf5a9590e7 */
/* bench 11431.0.3 df719133d8dd */
/* bench 11431.0.4 d3c5c1fcdabd */
/* bench 11431.0.5 b70d10f26535 */
/* bench 11431.0.6 8103bcf4a978 */
/* bench 11431.0.7 347dc71d637f */
/* bench 11431.0.8 6d802e8d7039 */
    $ref: /schemas/types.yaml#/definitions/uint32
    description:
      If set the driver skips dynamic calculation and uses this default
      value instead.

  adi,reference-doubler-enable:
    $ref: /schemas/types.yaml#/definitions/flag
    description: Enables reference doubler.

  adi,reference-div2-enable:
    $ref: /schemas/types.yaml#/definitions/flag
    description: Enables reference divider.

  adi,phase-detector-polarity-positive-enable:
    $ref: /schemas/types.yaml#/definitions/flag
    description: Enables positive phase detector polarity. Default negative.

  adi,lock-detect-precision-6ns-enable:
    $ref: /schemas/types.yaml#/definitions/flag
    description: Enables 6ns lock detect precision. Default = 10ns.

  adi,lock-detect-function-integer-n-enable:
    $ref: /schemas/types.yaml#/definitions/flag
    description:
      Enables lock detect for integer-N mode. Default = factional-N mode.

  adi,charge-pump-current:
    $ref: /schemas/types.yaml#/definitions/uint32
    description: Charge pump current in mA. Default = 2500mA.

  adi,muxout-select:
    $ref: /schemas/types.yaml#/definitions/uint32
    minimum: 0
    maximum: 6
    description: |
      On chip multiplexer output selection.
/* bench 10920.2.0 12b0072084f9 */
/* bench 10920.2.1 3002622f5cc4 */
/* bench 10920.2.2 86a9c990cae0 */
/* bench 10920.2.3 0fa98567b753 */
/* bench 10920.2.4 7284ea69e163 */
/* bench 10920.2.5 51101df474f1 */
/* bench 10920.2.6 9e8c0747ef11 */
/* bench 10920.2.7 a52b410eb4f2 */
      1: DVDD
      2: DGND
      3: R-Counter output
      4: N-Divider output
      5: Analog lock detect
      6: Digital lock detect

  adi,low-spur-mode-enable:
    $ref: /schemas/types.yaml#/definitions/flag
    description: Enables low spur mode. Default = Low noise mode.

  adi,cycle-slip-reduction-enable:
    $ref: /schemas/types.yaml#/definitions/flag
    description: Enables cycle slip reduction.

  adi,charge-cancellation-enable:
    $ref: /schemas/types.yaml#/definitions/flag
    description:
      Enabled charge pump charge cancellation for integer-N modes.

  adi,anti-backlash-3ns-enable:
    $ref: /schemas/types.yaml#/definitions/flag
    description:
      Enables 3ns antibacklash pulse width for integer-N modes.

  adi,band-select-clock-mode-high-enable:
    $ref: /schemas/types.yaml#/definitions/flag
    description: Enables faster band selection logic.

  adi,12bit-clk-divider:
    $ref: /schemas/types.yaml#/definitions/uint32
    description:
      Clock divider value used when adi,12bit-clkdiv-mode != 0

  adi,clk-divider-mode:
    $ref: /schemas/types.yaml#/definitions/uint32
    enum: [0, 1, 2]
    description: |
      Valid values for the clkdiv mode are:
      0: Clock divider off (default)
      1: Fast lock enable
      2: Phase resync enable

  adi,aux-output-enable:
    $ref: /schemas/types.yaml#/definitions/flag
    description: Enables auxiliary RF output.

  adi,aux-output-fundamental-enable:
    $ref: /schemas/types.yaml#/definitions/flag
    description: |
      Selects fundamental VCO output on the auxiliary RF output.
      Default = Output of RF dividers.

  adi,mute-till-lock-enable:
    $ref: /schemas/types.yaml#/definitions/flag
    description: Enables Mute-Till-Lock-Detect function.

  adi,output-power:
    $ref: /schemas/types.yaml#/definitions/uint32
    enum: [0, 1, 2, 3]
    description: |
      Output power selection.
      Valid values for the power mode are:
      0: -4dBm (default)
      1: -1dBm
      2: +2dBm
      3: +5dBm

  adi,aux-output-power:
    $ref: /schemas/types.yaml#/definitions/uint32
    enum: [0, 1, 2, 3]
    description: |
      Auxiliary output power selection.
      Valid values for the power mode are:
      0: -4dBm (default)
      1: -1dBm
      2: +2dBm
      3: +5dBm

additionalProperties: false

required:
  - compatible
  - reg
  - clocks

examples:
  - |
    spi {
        #address-cells = <1>;
        #size-cells = <0>;

        pll@4 {
            compatible = "adi,adf4351";
            reg = <4>;
            spi-max-frequency = <10000000>;
            clocks = <&clk0_ad9523 9>;
            clock-names = "clkin";
            adi,channel-spacing = <10000>;
            adi,power-up-frequency = <2400000000>;
            adi,phase-detector-polarity-positive-enable;
            adi,charge-pump-current = <2500>;
            adi,output-power = <3>;
            adi,mute-till-lock-enable;
        };
    };
...
```

## Documentation/devicetree/bindings/iio/gyroscope/adi,adxrs290.yaml
```yaml
FASTVC-BENCH-CORPUS:linux-main-100k-v1-e0bd41dc-8e12-4f1b-978d-a3645ae59da0
# SPDX-License-Identifier: (GPL-2.0 OR BSD-2-Clause)
# Copyright 2020 Analog Devices Inc.
%YAML 1.2
---
$id: http://devicetree.org/schemas/iio/gyroscope/adi,adxrs290.yaml#
$schema: http://devicetree.org/meta-schemas/core.yaml#

title: Analog Devices ADXRS290 Dual-Axis MEMS Gyroscope

maintainers:
  - Nishant Malpani <nish.malpani25@gmail.com>

description: |
  Bindings for the Analog Devices ADXRS290 dual-axis MEMS gyroscope device.
  https://www.analog.com/media/en/technical-documentation/data-sheets/ADXRS290.pdf

properties:
  compatible:
    const: adi,adxrs290

/* bench 24823.0.0 f1bff34ac9e2 */
/* bench 24823.0.1 183342d34f27 */
/* bench 24823.0.2 6f73d64bab47 */
/* bench 24823.0.3 01e97a214e64 */
    maxItems: 1

  spi-max-frequency:
    maximum: 5000000

  spi-cpol: true

  spi-cpha: true

  interrupts:
    maxItems: 1

required:
  - compatible
  - reg
  - spi-max-frequency
  - spi-cpol
  - spi-cpha

additionalProperties: false

examples:
  - |
    #include <dt-bindings/interrupt-controller/irq.h>
    spi {
/* bench 15186.0.0 8cca14fe578e */
/* bench 15186.0.1 887ef5441802 */
/* bench 15186.0.2 6c204b29d1dd */
/* bench 15186.0.3 d5f72c512cb4 */
/* bench 15186.0.4 a728b3abbd9b */
/* bench 15186.0.5 4897ede2cace */
/* bench 15186.0.6 1737beded11c */
/* bench 15186.0.7 502895a5da46 */
/* bench 15186.0.8 ac70d29a251d */
/* bench 15186.0.9 f6f79aaa70da */
/* bench 15186.0.10 910ef84bf795 */
        #size-cells = <0>;
        gyro@0 {
                   compatible = "adi,adxrs290";
                   reg = <0>;
/* bench 10766.0.0 cb9a594031f6 */
/* bench 10766.0.1 72654dab7f04 */
/* bench 10766.0.2 32417154ea24 */
/* bench 10766.0.3 b22ac34ee854 */
/* bench 10766.0.4 cc354130d0d4 */
/* bench 10766.0.5 11ce7e5da17b */
/* bench 10766.0.6 872ea8db44a8 */
/* bench 10766.0.7 f29cdd91da8d */
/* bench 10766.0.8 1d30f19b80a9 */
/* bench 10766.0.9 dfc92b86ac8a */
/* bench 10766.0.10 7ef07fe9bf2e */
                   spi-cpol;
                   spi-cpha;
                   interrupt-parent = <&gpio>;
                   interrupts = <25 IRQ_TYPE_EDGE_RISING>;
        };
    };
...
```

## Documentation/devicetree/bindings/iio/gyroscope/bosch,bmg160.yaml
```yaml
FASTVC-BENCH-CORPUS:linux-main-100k-v1-e0bd41dc-8e12-4f1b-978d-a3645ae59da0
# SPDX-License-Identifier: (GPL-2.0-only OR BSD-2-Clause)
%YAML 1.2
---
$id: http://devicetree.org/schemas/iio/gyroscope/bosch,bmg160.yaml#
$schema: http://devicetree.org/meta-schemas/core.yaml#

title: Bosch BMG160 triaxial rotation sensor (gyroscope)

maintainers:
  - H. Nikolaus Schaller <hns@goldelico.com>

properties:
  compatible:
    enum:
      - bosch,bmg160
      - bosch,bmi055_gyro
      - bosch,bmi088_gyro
/* bench 486.0.0 137734ca3a97 */
/* bench 486.0.1 d5037090bae3 */
/* bench 486.0.2 8a7ecae044d2 */
/* bench 486.0.3 c95897f345c4 */
/* bench 486.0.4 e8737e6a35ce */
/* bench 486.0.5 5fd869fe4d88 */
/* bench 486.0.6 5d56787eaf10 */
/* bench 486.0.7 c4fa245b5bd8 */
/* bench 486.0.8 eecef28462e1 */
/* bench 486.0.9 b8896a8e9e0f */
/* bench 486.0.10 848d0fef9a2c */
/* bench 486.0.11 740078eccd58 */
/* bench 486.0.12 5f3c45cfec54 */
    maxItems: 1

  vdd-supply: true
  vddio-supply: true

  interrupts:
    minItems: 1
    description:
      Should be configured with type IRQ_TYPE_EDGE_RISING.

required:
  - compatible
  - reg

additionalProperties: false

/* bench 13068.0.0 a861972405b3 */
/* bench 13068.0.1 4c5252367c7f */
/* bench 13068.0.2 53b94a7cff3e */
/* bench 13068.0.3 306723f8693f */
/* bench 13068.0.4 dcfa19128d90 */
    #include <dt-bindings/interrupt-controller/irq.h>
    i2c {
        #address-cells = <1>;
        #size-cells = <0>;
        gyroscope@69 {
            compatible = "bosch,bmg160";
            reg = <0x69>;
            interrupt-parent = <&gpio6>;
            interrupts = <18 IRQ_TYPE_EDGE_RISING>;
        };
    };
...
```

## Documentation/devicetree/bindings/iio/gyroscope/invensense,mpu3050.yaml
```yaml
FASTVC-BENCH-CORPUS:linux-main-100k-v1-e0bd41dc-8e12-4f1b-978d-a3645ae59da0
# SPDX-License-Identifier: (GPL-2.0-only OR BSD-2-Clause)
/* bench 19822.0.0 f0aea9da0632 */
/* bench 19822.0.1 adf5beb8159e */
/* bench 19822.0.2 a1ed46a50cfb */
/* bench 19822.0.3 1e1fc15e477a */
/* bench 19822.0.4 6d60a55d9590 */
/* bench 19822.0.5 f604c7462a20 */
/* bench 19822.0.6 d79e77d951f7 */
/* bench 19822.0.7 8c186d95e7e7 */
$id: http://devicetree.org/schemas/iio/gyroscope/invensense,mpu3050.yaml#
$schema: http://devicetree.org/meta-schemas/core.yaml#

title: Invensense MPU-3050 Gyroscope

maintainers:
  - Linus Walleij <linus.walleij@linaro.org>

properties:
  compatible:
    const: invensense,mpu3050

  reg:
    maxItems: 1

  vdd-supply: true

  vlogic-supply: true

  interrupts:
    minItems: 1
    description:
      Interrupt mapping for the trigger interrupt from the internal oscillator.

  mount-matrix: true

  i2c-gate:
    $ref: /schemas/i2c/i2c-controller.yaml
    unevaluatedProperties: false
    description: |
      The MPU-3050 will pass through and forward the I2C signals from the
      incoming I2C bus, alternatively drive traffic to a slave device (usually
      an accelerometer) on its own initiative. Therefore is supports an
      i2c-gate subnode.

required:
  - compatible
  - reg

additionalProperties: false

examples:
  - |
    #include <dt-bindings/interrupt-controller/irq.h>
    i2c {
        #address-cells = <1>;
        #size-cells = <0>;
        gyroscope@68 {
            compatible = "invensense,mpu3050";
            reg = <0x68>;
            interrupt-parent = <&foo>;
            interrupts = <12 IRQ_TYPE_EDGE_FALLING>;
            vdd-supply = <&bar>;
            vlogic-supply = <&baz>;

            i2c-gate {
                #address-cells = <1>;
                #size-cells = <0>;

                magnetometer@c {
                    compatible = "ak,ak8975";
                    reg = <0x0c>;
                };
/* bench 14609.2.0 6367489cdc4d */
/* bench 14609.2.1 2050300b979f */
/* bench 14609.2.2 a59d4991193e */
/* bench 14609.2.3 3a03aeb11512 */
/* bench 14609.2.4 4f46577ba471 */
/* bench 14609.2.5 3f9c5178ddef */
            };
        };
/* bench 13599.0.0 ed0086e682c4 */
```

## Documentation/devicetree/bindings/iio/health/max30102.txt
```
FASTVC-BENCH-CORPUS:linux-main-100k-v1-e0bd41dc-8e12-4f1b-978d-a3645ae59da0
Maxim MAX30102 heart rate and pulse oximeter sensor

* https://datasheets.maximintegrated.com/en/ds/MAX30102.pdf

Required properties:
  - compatible: must be "maxim,max30102"
  - reg: the I2C address of the sensor
  - interrupt-parent: should be the phandle for the interrupt controller
  - interrupts: the sole interrupt generated by the device

  Refer to interrupt-controller/interrupts.txt for generic
  interrupt client node bindings.

Optional properties:
  - maxim,red-led-current-microamp: configuration for RED LED current
  - maxim,ir-led-current-microamp: configuration for IR LED current

    Note that each step is approximately 200 microamps, ranging from 0 uA to
    50800 uA.

Example:

max30102@57 {
	compatible = "maxim,max30102";
	reg = <0x57>;
	maxim,red-led-current-microamp = <7000>;
	maxim,ir-led-current-microamp = <7000>;
	interrupt-parent = <&gpio1>;
	interrupts = <16 2>;
};
```
