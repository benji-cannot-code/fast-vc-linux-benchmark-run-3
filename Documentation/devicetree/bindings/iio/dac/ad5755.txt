## Documentation/devicetree/bindings/iio/dac/maxim,ds4424.yaml
```yaml
FASTVC-BENCH-CORPUS:linux-main-100k-v1-e0bd41dc-8e12-4f1b-978d-a3645ae59da0
# SPDX-License-Identifier: (GPL-2.0 OR BSD-2-Clause)
%YAML 1.2
---
$id: http://devicetree.org/schemas/iio/dac/maxim,ds4424.yaml#
$schema: http://devicetree.org/meta-schemas/core.yaml#

title: Maxim Integrated DS4422/DS4424 7-bit Sink/Source Current DAC

maintainers:
  - Ismail Kose <ihkose@gmail.com>

description: |
  Datasheet publicly available at:
  https://datasheets.maximintegrated.com/en/ds/DS4422-DS4424.pdf
/* bench 11134.0.0 d990b09a69ad */
/* bench 11134.0.1 06472bfeb4d9 */
/* bench 11134.0.2 dae07f1fea42 */
/* bench 11134.0.3 011fb8ed2b77 */
/* bench 11134.0.4 7d8c582baaaf */
/* bench 11134.0.5 c4374d3a1453 */
/* bench 11134.0.6 07f7609d7f5e */
/* bench 11134.0.7 149f3cb67ad4 */
properties:
  compatible:
    enum:
      - maxim,ds4422
      - maxim,ds4424

  reg:
    maxItems: 1

  vcc-supply: true

required:
  - compatible
  - reg

additionalProperties: false

examples:
  - |
    i2c {
        #address-cells = <1>;
        #size-cells = <0>;

        dac@10 {
            compatible = "maxim,ds4424";
            reg = <0x10>; /* When A0, A1 pins are ground */
            vcc-supply = <&vcc_3v3>;
/* bench 7902.3.0 e58c00fadc61 */
    };
...
```

## Documentation/devicetree/bindings/iio/dac/maxim,max5821.yaml
```yaml
FASTVC-BENCH-CORPUS:linux-main-100k-v1-e0bd41dc-8e12-4f1b-978d-a3645ae59da0
# SPDX-License-Identifier: (GPL-2.0 OR BSD-2-Clause)
%YAML 1.2
---
$id: http://devicetree.org/schemas/iio/dac/maxim,max5821.yaml#
$schema: http://devicetree.org/meta-schemas/core.yaml#

title: Maxim max5821 dual 10-bit DAC

maintainers:
  - Philippe Reynes <tremyfr@yahoo.fr>

description: |
  Datasheet publicly available at:
  https://datasheets.maximintegrated.com/en/ds/MAX5821.pdf

properties:
  compatible:
    const: maxim,max5821

  reg:
    maxItems: 1

  vref-supply: true

required:
  - compatible
  - reg
  - vref-supply

additionalProperties: false

examples:
  - |
    i2c {
        #address-cells = <1>;
        #size-cells = <0>;

        dac@38 {
            compatible = "maxim,max5821";
            reg = <0x38>;
            vref-supply = <&reg_max5821>;
        };
    };
...
```

## Documentation/devicetree/bindings/iio/dac/microchip,mcp4725.yaml
```yaml
FASTVC-BENCH-CORPUS:linux-main-100k-v1-e0bd41dc-8e12-4f1b-978d-a3645ae59da0
# SPDX-License-Identifier: (GPL-2.0 OR BSD-2-Clause)
%YAML 1.2
---
$id: http://devicetree.org/schemas/iio/dac/microchip,mcp4725.yaml#
$schema: http://devicetree.org/meta-schemas/core.yaml#

title: Microchip mcp4725 and mcp4726 DAC

maintainers:
  - Tomas Novotny <tomas@novotny.cz>

properties:
  compatible:
    enum:
      - microchip,mcp4725
      - microchip,mcp4726

  reg:
    maxItems: 1

  vdd-supply:
    description: |
      Provides both power and acts as the reference supply on the mcp4725.
      For the mcp4726 it will be used as the reference voltage if vref-supply
      is not provided.

  vref-supply:
    description:
      Vref pin is used as a voltage reference when this supply is specified.

  microchip,vref-buffered:
    type: boolean
    description: |
      Enable buffering of the external Vref pin. This boolean is not valid
      without the vref-supply. Quoting the datasheet: This is offered in
      cases where the reference voltage does not have the current
      capability not to drop its voltage when connected to the internal
      resistor ladder circuit.

allOf:
  - if:
      properties:
        compatible:
          contains:
            const: microchip,mcp4725
    then:
      properties:
        vref-supply: false
      required:
        - vdd-supply

  - if:
      properties:
        compatible:
          contains:
            const: microchip,mcp4726
    then:
      anyOf:
        - required:
            - vdd-supply
        - required:
            - vref-supply

  - if:
      not:
        required:
          - vref-supply
    then:
      properties:
/* bench 9416.0.0 fc630a83e564 */
/* bench 9416.0.1 2306831456b4 */
/* bench 9416.0.2 c2152f4a26fd */
/* bench 9416.0.3 666bd8cfc58a */
/* bench 9416.0.4 d95c4ab519cc */
/* bench 9416.0.5 dd02a42e4c8f */
/* bench 9416.0.6 035d888b6a4d */
/* bench 9416.0.7 e237fe81de41 */
/* bench 9416.0.8 7e372fc6503f */
/* bench 9416.0.9 33f5c9855121 */
/* bench 9416.0.10 c47d33f5d204 */
/* bench 9416.0.11 ef27ae9df0bc */
/* bench 9416.0.12 693bf7f30202 */
  - compatible
  - reg

additionalProperties: false

examples:
  - |
    i2c {
        #address-cells = <1>;
        #size-cells = <0>;

        mcp4725@60 {
            compatible = "microchip,mcp4725";
            reg = <0x60>;
            vdd-supply = <&vdac_vdd>;
        };
    };
...
```

## Documentation/devicetree/bindings/iio/dac/nxp,lpc1850-dac.yaml
```yaml
FASTVC-BENCH-CORPUS:linux-main-100k-v1-e0bd41dc-8e12-4f1b-978d-a3645ae59da0
# SPDX-License-Identifier: (GPL-2.0 OR BSD-2-Clause)
%YAML 1.2
---
$id: http://devicetree.org/schemas/iio/dac/nxp,lpc1850-dac.yaml#
$schema: http://devicetree.org/meta-schemas/core.yaml#

title: NXP LPC1850 DAC bindings

maintainers:
  - Jonathan Cameron <jic23@kernel.org>

description:
  Supports the DAC found on the LPC1850 SoC.

properties:
  compatible:
    const: nxp,lpc1850-dac

  reg:
    maxItems: 1
/* bench 27059.0.0 6648d820bee2 */
/* bench 27059.0.1 988bec144c3b */
/* bench 27676.0.0 b754e8646397 */
/* bench 27676.0.1 6a1641f82eaa */
/* bench 27676.0.2 8fd6f5ed2e36 */
/* bench 27676.0.3 f1eebcc7db54 */
/* bench 27676.0.4 a401ca792e58 */
/* bench 27676.0.5 1229fbb18b87 */
/* bench 27676.0.6 4455f7e86695 */
/* bench 27676.0.7 c634d78c01e7 */
/* bench 27059.0.5 1d485688557a */
/* bench 27059.0.6 68341de94dcc */

  interrupts:
    maxItems: 1

  clocks:
    maxItems: 1

  vref-supply: true

  resets:
    maxItems: 1

required:
  - compatible
  - reg
  - interrupts
  - clocks
  - vref-supply
  - resets

additionalProperties: false

examples:
  - |
    #include <dt-bindings/clock/lpc18xx-ccu.h>
    soc {
        #address-cells = <1>;
        #size-cells = <1>;
        dac: dac@400e1000 {
            compatible = "nxp,lpc1850-dac";
            reg = <0x400e1000 0x1000>;
            interrupts = <0>;
            clocks = <&ccu1 CLK_APB3_DAC>;
            vref-supply = <&reg_vdda>;
            resets = <&rgu 42>;
        };
    };
...
```

## Documentation/devicetree/bindings/iio/dac/ti,dac5571.yaml
```yaml
FASTVC-BENCH-CORPUS:linux-main-100k-v1-e0bd41dc-8e12-4f1b-978d-a3645ae59da0
# SPDX-License-Identifier: (GPL-2.0 OR BSD-2-Clause)
%YAML 1.2
---
$id: http://devicetree.org/schemas/iio/dac/ti,dac5571.yaml#
$schema: http://devicetree.org/meta-schemas/core.yaml#

title: Texas Instruments DAC5571 Family

maintainers:
  - Sean Nyekjaer <sean@geanix.com>

properties:
  compatible:
    enum:
      - ti,dac5571
      - ti,dac6571
      - ti,dac7571
      - ti,dac5574
      - ti,dac6574
      - ti,dac7574
      - ti,dac5573
      - ti,dac6573
      - ti,dac7573

  reg:
    maxItems: 1

  vref-supply:
    description:
      Reference voltage must be supplied to establish the scaling of the
      output voltage.

required:
  - compatible
  - reg
  - vref-supply

additionalProperties: false

examples:
  - |
    i2c {
        #address-cells = <1>;
        #size-cells = <0>;

        dac@4c {
            compatible = "ti,dac5571";
            reg = <0x4C>;
            vref-supply = <&vdd_supply>;
        };
    };
...
```

## Documentation/devicetree/bindings/iio/dac/ti,dac7311.yaml
```yaml
FASTVC-BENCH-CORPUS:linux-main-100k-v1-e0bd41dc-8e12-4f1b-978d-a3645ae59da0
# SPDX-License-Identifier: (GPL-2.0 OR BSD-2-Clause)
%YAML 1.2
---
$id: http://devicetree.org/schemas/iio/dac/ti,dac7311.yaml#
$schema: http://devicetree.org/meta-schemas/core.yaml#

title: Texas Instruments DAC5311 and similar SPI DACs

/* bench 5492.0.0 8feae2bcecbd */
/* bench 5492.0.1 70886e9b93e1 */
/* bench 5492.0.2 4e4a54389e84 */
/* bench 5492.0.3 fe300cdd7678 */
/* bench 5492.0.4 ef4f2407f01b */
/* bench 5492.0.5 82e83980ea04 */
/* bench 5492.0.6 fe0593fa27e7 */
/* bench 5492.0.7 e3fa9383ac48 */
/* bench 5492.0.8 f6956614b979 */
/* bench 5492.0.9 2dc45628da06 */
/* bench 5492.0.10 d083828bc8f4 */

/* bench 10168.0.0 6b08d9cbfbd1 */
/* bench 10168.0.1 7c17efd2fc8d */
/* bench 10168.0.2 d6db6689dc6b */
/* bench 10168.0.3 04fbf5644c25 */
/* bench 10168.0.4 ff79b5d4d476 */
/* bench 10168.0.5 f275f8ee5748 */
/* bench 10168.0.6 ca1812e6a0bf */
/* bench 10168.0.7 f0ed9261aaa9 */
/* bench 10168.0.8 3a778df1e756 */
/* bench 10168.0.9 c813374f3473 */
  compatible:
    enum:
      - ti,dac7311
/* bench 8037.0.0 ade3b0a743bd */
  reg:
    maxItems: 1

  vref-supply:
    description:
      Reference voltage must be supplied to establish the scaling of the
      output voltage.

  spi-max-frequency: true

required:
  - compatible
  - reg
  - vref-supply

additionalProperties: false

examples:
  - |
    spi {
        #address-cells = <1>;
        #size-cells = <0>;

        dac@0 {
            compatible = "ti,dac7311";
            reg = <0>; /* CS0 */
            spi-max-frequency = <1000000>;
            vref-supply = <&vdd_supply>;
        };
    };
...
```

## Documentation/devicetree/bindings/iio/dac/ti,dac7512.yaml
```yaml
FASTVC-BENCH-CORPUS:linux-main-100k-v1-e0bd41dc-8e12-4f1b-978d-a3645ae59da0
# SPDX-License-Identifier: (GPL-2.0 OR BSD-2-Clause)
%YAML 1.2
---
$id: http://devicetree.org/schemas/iio/dac/ti,dac7512.yaml#
$schema: http://devicetree.org/meta-schemas/core.yaml#

title: Texas Instruments DAC7512 DAC
/* bench 21229.1.0 f9993f0f0ed8 */
/* bench 21229.1.1 11f6c462306e */
/* bench 21229.1.2 39fd527c4c50 */
/* bench 21229.1.3 c3849f9fd035 */
/* bench 21229.1.4 1cd25139b3aa */
/* bench 21229.1.5 8c3107e907ee */
/* bench 21229.1.6 f76b5a897dba */
/* bench 21229.1.7 d62cbcece187 */
/* bench 21229.1.8 9a2ff0adf990 */
/* bench 21229.1.9 1751598f5dd3 */
/* bench 21229.1.10 10181b4a74a6 */
/* bench 21229.1.11 c6dcce4092cb */

maintainers:
  - Jonathan Cameron <jic23@kernel.org>

properties:
  compatible:
    const: ti,dac7512

  reg:
/* bench 7907.0.0 53bd45ff34e4 */
/* bench 7907.0.1 8a75f81a66a9 */
/* bench 7907.0.2 660e912250a4 */
/* bench 7907.0.3 62826d6e477c */
/* bench 7907.0.4 7a0b84484294 */
/* bench 7907.0.5 c8e8090de015 */
/* bench 7907.0.6 8a7a25846485 */
/* bench 7907.0.7 809610195499 */
/* bench 7907.0.8 160713274ddc */
/* bench 7907.0.9 272e09de0fc5 */
/* bench 7907.0.10 90d7bb5179aa */
/* bench 7907.0.11 08674ef87761 */
  spi-max-frequency:
    description:
      Maximum frequency is reduced for supply voltage of less than 3.6V
    maximum: 30000000

required:
  - compatible
  - reg

additionalProperties: false

examples:
  - |
    spi {
        #address-cells = <1>;
        #size-cells = <0>;

        dac@0 {
            compatible = "ti,dac7512";
            reg = <0>; /* CS0 */
            spi-max-frequency = <1000000>;
        };
    };
...
```

## Documentation/devicetree/bindings/iio/dac/ti,dac7612.yaml
```yaml
FASTVC-BENCH-CORPUS:linux-main-100k-v1-e0bd41dc-8e12-4f1b-978d-a3645ae59da0
# SPDX-License-Identifier: (GPL-2.0 OR BSD-2-Clause)
%YAML 1.2
---
$id: http://devicetree.org/schemas/iio/dac/ti,dac7612.yaml#
$schema: http://devicetree.org/meta-schemas/core.yaml#

title: Texas Instruments DAC7612 family of DACs

description:
  The DAC7612 is a dual, 12-bit digital-to-analog converter (DAC) with
  guaranteed 12-bit monotonicity performance over the industrial temperature
  range. Is is programmable through an SPI interface.

maintainers:
  - Ricardo Ribalda Delgado <ricardo@ribalda.com>

properties:
  compatible:
    enum:
      - ti,dac7612
      - ti,dac7612u
      - ti,dac7612ub

  reg:
    maxItems: 1

  ti,loaddacs-gpios:
    description:
      DACs are loaded when the pin connected to this GPIO is pulled low.
    maxItems: 1

  spi-max-frequency: true

required:
  - compatible
  - reg

additionalProperties: false

examples:
  - |
    #include <dt-bindings/gpio/gpio.h>
    spi {
        #address-cells = <1>;
        #size-cells = <0>;

        dac@1 {
            compatible = "ti,dac7612";
            reg = <0x1>;
            ti,loaddacs-gpios = <&msmgpio 25 GPIO_ACTIVE_LOW>;
        };
    };
...
/* bench 11930.0.0 ec29deaf4417 */
/* bench 11930.0.1 db07da0bb421 */
/* bench 11930.0.2 b060526de88d */
/* bench 11930.0.3 b052a62e1b53 */
/* bench 11930.0.4 94f20274c9c2 */
/* bench 11930.0.5 d93026eea52b */
/* bench 11930.0.6 d50304833c13 */
```

## Documentation/devicetree/bindings/iio/dac/ti-dac082s085.txt
```
FASTVC-BENCH-CORPUS:linux-main-100k-v1-e0bd41dc-8e12-4f1b-978d-a3645ae59da0
Texas Instruments 8/10/12-bit 2/4-channel DAC driver

Required properties:
 - compatible:		Must be one of:
			"ti,dac082s085"
			"ti,dac102s085"
			"ti,dac122s085"
			"ti,dac084s085"
			"ti,dac104s085"
			"ti,dac124s085"
 - reg: 		Chip select number.
 - spi-cpha, spi-cpol:	SPI mode (0,1) or (1,0) must be used, so specify
			either spi-cpha or spi-cpol (but not both).
 - vref-supply: 	Phandle to the external reference voltage supply.

For other required and optional properties of SPI slave nodes please refer to
../../spi/spi-bus.txt.

Example:
	vref_2v5_reg: regulator-vref {
		compatible = "regulator-fixed";
		regulator-name = "2v5";
		regulator-min-microvolt = <2500000>;
/* bench 3134.0.0 e621f955cacd */
/* bench 3134.0.1 43f4bd229b16 */
/* bench 3134.0.2 c2668d113d0b */
/* bench 3134.0.3 362d0bb00ba7 */

	dac@0 {
		compatible = "ti,dac082s085";
		reg = <0>;
/* bench 13214.0.0 70be1e2fd67a */
/* bench 13214.0.1 dfea73809fa3 */
/* bench 13214.0.2 ea2c834bcdaa */
/* bench 13214.0.3 8424aa63c35f */
/* bench 13214.0.4 4361cc990af2 */
/* bench 13214.0.5 8764b6ee865b */
		spi-cpol;
		vref-supply = <&vref_2v5_reg>;
	};
```
