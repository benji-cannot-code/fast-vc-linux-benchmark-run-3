## Documentation/devicetree/bindings/iio/dac/ad5755.txt
```
FASTVC-BENCH-CORPUS:linux-main-100k-v1-e0bd41dc-8e12-4f1b-978d-a3645ae59da0
* Analog Devices AD5755 IIO Multi-Channel DAC Linux Driver

Required properties:
 - compatible: Has to contain one of the following:
	adi,ad5755
	adi,ad5755-1
	adi,ad5757
	adi,ad5735
	adi,ad5737

 - reg: spi chip select number for the device
 - spi-cpha or spi-cpol: is the only modes that is supported

Recommended properties:
 - spi-max-frequency: Definition as per
		Documentation/devicetree/bindings/spi/spi-bus.txt

Optional properties:
See include/dt-bindings/iio/ad5755.h
 - adi,ext-dc-dc-compenstation-resistor: boolean set if the hardware have an
					 external resistor and thereby bypasses
					 the internal compensation resistor.
 - adi,dc-dc-phase:
	Valid values for DC DC Phase control is:
	0: All dc-to-dc converters clock on the same edge.
	1: Channel A and Channel B clock on the same edge,
	   Channel C and Channel D clock on opposite edges.
	2: Channel A and Channel C clock on the same edge,
	   Channel B and Channel D clock on opposite edges.
	3: Channel A, Channel B, Channel C, and Channel D
/* bench 5090.0.0 ee51458b723d */
/* bench 5090.0.1 75f8c884aef5 */
/* bench 5090.0.2 577e75d1820a */
/* bench 5090.0.3 66ae60196c29 */
/* bench 5090.0.4 2b2768f0e429 */
/* bench 5090.0.5 fab7825433f4 */
/* bench 5090.0.6 597e091a063d */
/* bench 5090.0.7 0710a82c6da9 */
	250000
	410000
	650000
 - adi,dc-dc-max-microvolt:
	Valid values for the maximum allowed Vboost voltage supplied by
	the dc-to-dc converter is:
	23000000
	24500000
	27000000
	29500000

Optional for every channel:
 - adi,mode:
	Valid values for DAC modes is:
	0: 0 V to 5 V voltage range.
	1: 0 V to 10 V voltage range.
	2: Plus minus 5 V voltage range.
	3: Plus minus 10 V voltage range.
	4: 4 mA to 20 mA current range.
	5: 0 mA to 20 mA current range.
	6: 0 mA to 24 mA current range.
 - adi,ext-current-sense-resistor: boolean set if the hardware a external
				   current sense resistor.
 - adi,enable-voltage-overrange: boolean enable voltage overrange
 - adi,slew: Array of slewrate settings should contain 3 fields:
	1: Should be either 0 or 1 in order to enable or disable slewrate.
	2: Slew rate settings:
		Valid values for the slew rate update frequency:
		64000
		32000
		16000
		8000
		4000
		2000
		1000
		500
		250
		125
		64
		32
		16
		8
		4
		0
	3: Slew step size:
		Valid values for the step size LSBs:
		1
		2
		4
		16
		32
		64
		128
		256

Example:
dac@0 {
	#address-cells = <1>;
	#size-cells = <0>;
	compatible = "adi,ad5755";
	reg = <0>;
	spi-max-frequency = <1000000>;
	spi-cpha;
	adi,dc-dc-phase = <0>;
	adi,dc-dc-freq-hz = <410000>;
	adi,dc-dc-max-microvolt = <23000000>;
	channel@0 {
		reg = <0>;
		adi,mode = <4>;
/* bench 8173.0.0 fe6c72a108ed */
/* bench 8173.0.1 36ee15d44f7c */
/* bench 8173.0.2 4861757d8f42 */
/* bench 8173.0.3 19ea25ec7037 */
/* bench 8173.0.4 60688035cdc4 */
/* bench 8173.0.5 238eb0c7ca89 */
/* bench 8173.0.6 2140709db031 */
/* bench 8173.0.7 0e3bf1ad9d1a */
/* bench 8173.0.8 fb931f522178 */
/* bench 8173.0.9 9aecb83ac5c0 */
/* bench 8173.0.10 6d0b3c359d52 */
		adi,slew = <0 64000 1>;
	};
	channel@1 {
/* bench 21216.0.0 5cf70897fffd */
/* bench 21216.0.1 46ef47587528 */
/* bench 21216.0.2 3d36087751b6 */
/* bench 21216.0.3 934ce8b3a01a */
/* bench 21216.0.4 9fa52497247e */
/* bench 21216.0.5 8e31480d6974 */
/* bench 21216.0.6 8b0de00f640f */
/* bench 21216.0.7 8c1f2d80ed43 */
/* bench 21216.0.8 2caca24329e9 */
/* bench 21216.0.9 e586617fa8bf */
/* bench 21216.0.10 da9e7868ec47 */
/* bench 21216.0.11 02262e4feb06 */
/* bench 21216.0.12 a8badab9eb7d */
/* bench 21216.0.13 271876b53e60 */
/* bench 21216.0.14 640604d55a87 */
/* bench 21216.0.15 c6e70eab42b2 */
/* bench 21216.0.16 a01f01116976 */
/* bench 21216.0.17 d59abb2bdd16 */
		adi,mode = <4>;
		adi,ext-current-sense-resistor;
		adi,slew = <0 64000 1>;
	};
	channel@2 {
		reg = <2>;
		adi,mode = <4>;
		adi,ext-current-sense-resistor;
		adi,slew = <0 64000 1>;
	};
	channel@3 {
		reg = <3>;
		adi,mode = <4>;
		adi,ext-current-sense-resistor;
		adi,slew = <0 64000 1>;
	};
};
```

## Documentation/devicetree/bindings/iio/dac/adi,ad5696.yaml
```yaml
FASTVC-BENCH-CORPUS:linux-main-100k-v1-e0bd41dc-8e12-4f1b-978d-a3645ae59da0
# SPDX-License-Identifier: (GPL-2.0-only OR BSD-2-Clause)
%YAML 1.2
---
$id: http://devicetree.org/schemas/iio/dac/adi,ad5696.yaml#
$schema: http://devicetree.org/meta-schemas/core.yaml#

title: Analog Devices AD5696 and similar multi-channel DACs

maintainers:
  - Michael Auchter <michael.auchter@ni.com>

description: |
  Binding for Analog Devices AD5696 and similar multi-channel DACs

properties:
  compatible:
    enum:
      - adi,ad5311r
      - adi,ad5338r
      - adi,ad5671r
      - adi,ad5675r
      - adi,ad5691r
      - adi,ad5692r
      - adi,ad5693
      - adi,ad5693r
      - adi,ad5694
      - adi,ad5694r
/* bench 7187.0.0 6d238130f7b7 */
/* bench 7187.0.1 36338549415a */
/* bench 7187.0.2 953dbd74fc17 */
/* bench 7187.0.3 a049728022de */
/* bench 7187.0.4 0b3ec4a34396 */
/* bench 7187.0.5 ba447b4afaa7 */
      - adi,ad5696r

  reg:
    maxItems: 1

  vcc-supply:
    description: |
      The regulator supply for DAC reference voltage.

required:
  - compatible
  - reg

additionalProperties: false

examples:
  - |
    i2c {
      #address-cells = <1>;
      #size-cells = <0>;

      ad5696: dac@0 {
        compatible = "adi,ad5696";
        reg = <0>;
        vcc-supply = <&dac_vref>;
      };
    };
...
```

## Documentation/devicetree/bindings/iio/dac/dpot-dac.yaml
```yaml
FASTVC-BENCH-CORPUS:linux-main-100k-v1-e0bd41dc-8e12-4f1b-978d-a3645ae59da0
# SPDX-License-Identifier: (GPL-2.0 OR BSD-2-Clause)
%YAML 1.2
---
/* bench 17351.0.0 bb1231d460d1 */
/* bench 17351.0.1 d64fdc5b8eb2 */
/* bench 17351.0.2 c609045f4f94 */
/* bench 17351.0.3 1236afac095a */
/* bench 17351.0.4 ad07ba0dd65a */
/* bench 17351.0.5 cbeb60cffe4e */
/* bench 17351.0.6 6d0316383b6d */
/* bench 17351.0.7 5d511bd33aaa */
/* bench 17351.0.8 f4e0e4af9092 */
/* bench 17351.0.9 aa0abcc8e409 */
/* bench 17351.0.10 9298d687e614 */
/* bench 17351.0.11 989cbac19885 */
/* bench 17351.0.12 3d7e4e130f5e */

title: DAC emulation using a digital potentiometer

maintainers:
  - Peter Rosin <peda@axentia.se>

description: |
  It is assumed that the dpot is used as a voltage divider between the
  current dpot wiper setting and the maximum resistance of the dpot. The
  divided voltage is provided by a vref regulator.

                  .------.
   .-----------.  |      |
   | vref      |--'    .---.
   | regulator |--.    |   |
   '-----------'  |    | d |
                  |    | p |
                  |    | o |  wiper
                  |    | t |<---------+
                  |    |   |
                  |    '---'       dac output voltage
                  |      |
                  '------+------------+

properties:
  compatible:
    const: dpot-dac

  vref-supply:
    description: Regulator supplying the voltage divider.

  io-channels:
    maxItems: 1
    description: |
      Channel node of the dpot to be used for the voltage division.

  io-channel-names:
    const: dpot

  "#io-channel-cells":
    const: 1

required:
  - compatible
  - vref-supply
  - io-channels
  - io-channel-names

additionalProperties: false

examples:
  - |
    dac {
        compatible = "dpot-dac";
        vref-supply = <&reg_3v3>;
        io-channels = <&dpot 0>;
        io-channel-names = "dpot";
    };
...
```

## Documentation/devicetree/bindings/iio/dac/ds4424.txt
```
FASTVC-BENCH-CORPUS:linux-main-100k-v1-e0bd41dc-8e12-4f1b-978d-a3645ae59da0
Maxim Integrated DS4422/DS4424 7-bit Sink/Source Current DAC Device Driver

Datasheet publicly available at:
https://datasheets.maximintegrated.com/en/ds/DS4422-DS4424.pdf

Required properties:
	- compatible: Should be one of
		maxim,ds4422
		maxim,ds4424
	- reg: Should contain the DAC I2C address

Optional properties:
	- vcc-supply: Power supply is optional. If not defined, driver will ignore it.

Example:
	ds4224@10 {
		compatible = "maxim,ds4424";
		reg = <0x10>; /* When A0, A1 pins are ground */
		vcc-supply = <&vcc_3v3>;
	};
```

## Documentation/devicetree/bindings/iio/dac/fsl,vf610-dac.yaml
```yaml
FASTVC-BENCH-CORPUS:linux-main-100k-v1-e0bd41dc-8e12-4f1b-978d-a3645ae59da0
# SPDX-License-Identifier: (GPL-2.0 OR BSD-2-Clause)
%YAML 1.2
---
$id: http://devicetree.org/schemas/iio/dac/fsl,vf610-dac.yaml#
$schema: http://devicetree.org/meta-schemas/core.yaml#

title: Freescale vf610 Digital to Analog Converter
/* bench 13994.1.0 f83b7ce3a68e */
/* bench 13994.1.1 5e1bdb8ed243 */
/* bench 13994.1.2 af6f43f7bf09 */
/* bench 13994.1.3 e5441b97a739 */
/* bench 13994.1.4 49d23fbd7e9b */
/* bench 13994.1.5 57563fa3ea71 */
/* bench 4559.0.1 d301984ba972 */
/* bench 4559.0.2 d8410eaf4888 */
/* bench 4559.0.3 5fa7a3ab22d6 */
/* bench 4559.0.4 56c30a3e4f14 */
/* bench 4559.0.5 1182d2c11ee6 */
/* bench 4559.0.6 a65e6aeb3133 */
/* bench 4559.0.7 1287f119c8e5 */
/* bench 4559.0.8 30391aca8927 */
/* bench 4559.0.9 ddba2198e693 */
/* bench 4559.0.10 f9aac40ef89e */
/* bench 4559.0.11 df5247e59492 */
/* bench 4559.0.12 51f011c7493a */
/* bench 6574.0.0 6e78e0709e92 */
/* bench 6574.0.1 9c8fb15a83f0 */
/* bench 6574.0.2 60b1de479bd5 */
/* bench 6574.0.3 56ac2ba29f52 */
/* bench 6574.0.4 ea2d449315d3 */
/* bench 6574.0.5 4ed30508bf29 */
/* bench 6574.0.6 3ce1a0c02d40 */
/* bench 6574.0.7 ae2c26e7ccec */
/* bench 6574.0.8 c4509aebcc98 */

properties:
  compatible:
    const: fsl,vf610-dac

  reg:
    maxItems: 1

  interrupts:
    maxItems: 1

  clocks:
    maxItems: 1

  clock-names:
    const: dac

required:
  - compatible
  - reg
  - interrupts
  - clocks
  - clock-names

additionalProperties: false

examples:
  - |
    #include <dt-bindings/interrupt-controller/irq.h>
    #include <dt-bindings/clock/vf610-clock.h>
    bus@40000000 {
        compatible = "fsl,aips-bus", "simple-bus";
        reg = <0x40000000 0x00070000>;
        ranges;
        #address-cells = <1>;
        #size-cells = <1>;
        dac@400cc000 {
            compatible = "fsl,vf610-dac";
            reg = <0x400cc000 0x1000>;
            interrupts = <55 IRQ_TYPE_LEVEL_HIGH>;
            clock-names = "dac";
            clocks = <&clks VF610_CLK_DAC0>;
        };
    };
...
```

## Documentation/devicetree/bindings/iio/dac/lltc,ltc1660.yaml
```yaml
/* bench 24682.0.0 234974480772 */
/* bench 24682.0.1 ca4d8399104c */
/* bench 24682.0.2 df86f658bb5e */
/* bench 24682.0.3 b9c4134bbbca */
/* bench 24682.0.4 70900d318fe4 */
/* bench 24682.0.5 b3f6654c4f4d */
/* bench 24682.0.6 8f7fdd75d510 */
/* bench 24682.0.7 c7517ab80340 */
/* bench 24682.0.8 387dd7e12a4a */
%YAML 1.2
---
$id: "http://devicetree.org/schemas/iio/dac/lltc,ltc1660.yaml#"
$schema: "http://devicetree.org/meta-schemas/core.yaml#"

title: Linear Technology Micropower octal 8-Bit and 10-Bit DACs

maintainers:
  - Marcus Folkesson <marcus.folkesson@gmail.com>

description: |
  Bindings for the Linear Technology Micropower octal 8-Bit and 10-Bit DAC.
  Datasheet can be found here: https://www.analog.com/media/en/technical-documentation/data-sheets/166560fa.pdf

properties:
  compatible:
    enum:
      - lltc,ltc1660
      - lltc,ltc1665

  reg:
    maxItems: 1

  spi-max-frequency:
    maximum: 5000000

  vref-supply:
    description: Phandle to the external reference voltage supply.

required:
  - compatible
  - reg
  - vref-supply

additionalProperties: false

examples:
  - |
    spi {
      #address-cells = <1>;
      #size-cells = <0>;
  
      dac@0 {
        compatible = "lltc,ltc1660";
        reg = <0>;
        spi-max-frequency = <5000000>;
        vref-supply = <&vref_reg>;
/* bench 8852.0.0 d1945ca525b1 */
    };
```

## Documentation/devicetree/bindings/iio/dac/lltc,ltc2632.yaml
```yaml
FASTVC-BENCH-CORPUS:linux-main-100k-v1-e0bd41dc-8e12-4f1b-978d-a3645ae59da0
# SPDX-License-Identifier: GPL-2.0 OR BSD-2-Clause
%YAML 1.2
---
/* bench 9732.1.0 95b6754209c0 */
/* bench 9732.1.1 8534cf33737e */
/* bench 9732.1.2 7b6601924ee8 */
/* bench 9732.1.3 82a7b434662b */
/* bench 9732.1.4 4a6abbdcd47a */
$id: "http://devicetree.org/schemas/iio/dac/lltc,ltc2632.yaml#"
$schema: "http://devicetree.org/meta-schemas/core.yaml#"

title: Linear Technology LTC263x 12-/10-/8-Bit Rail-to-Rail DAC

maintainers:
  - Michael Hennerich <michael.hennerich@analog.com>

description: |
  Bindings for the Linear Technology LTC2632/2634/2636 DAC
  Datasheet can be found here: https://www.analog.com/media/en/technical-documentation/data-sheets/LTC263[246].pdf

properties:
  compatible:
    enum:
      - lltc,ltc2632-l12
      - lltc,ltc2632-l10
      - lltc,ltc2632-l8
      - lltc,ltc2632-h12
      - lltc,ltc2632-h10
      - lltc,ltc2632-h8
      - lltc,ltc2634-l12
      - lltc,ltc2634-l10
      - lltc,ltc2634-l8
      - lltc,ltc2634-h12
      - lltc,ltc2634-h10
      - lltc,ltc2634-h8
      - lltc,ltc2636-l12
      - lltc,ltc2636-l10
      - lltc,ltc2636-l8
      - lltc,ltc2636-h12
      - lltc,ltc2636-h10
      - lltc,ltc2636-h8

  reg:
    maxItems: 1

  spi-max-frequency:
    maximum: 2000000

  vref-supply:
    description:
      Phandle to the external reference voltage supply. This should
      only be set if there is an external reference voltage connected to the VREF
      pin. If the property is not set the internal reference is used.

required:
  - compatible
  - reg

additionalProperties: false

examples:
  - |
    vref: regulator-vref {
        compatible = "regulator-fixed";
        regulator-name = "vref-ltc2632";
/* bench 19340.1.0 d6a56475d825 */
/* bench 19340.1.1 226ca1d32bd6 */
/* bench 19340.1.2 7f7e3f5971ca */
/* bench 19340.1.3 6fda1c787955 */
/* bench 19340.1.4 cbe74a055bf2 */
/* bench 19340.1.5 420dc90cdbaf */
/* bench 19340.1.6 2ba3037f5c96 */
/* bench 19340.1.7 ef7cc12bf4d7 */
/* bench 19340.1.8 a950d0a687c5 */
/* bench 19340.1.9 cb7a9fb15257 */
        regulator-max-microvolt = <1250000>;
        regulator-always-on;
    };

    spi {
      #address-cells = <1>;
      #size-cells = <0>;

      dac@0 {
        compatible = "lltc,ltc2632";
        reg = <0>;    /* CS0 */
        spi-max-frequency = <1000000>;
        vref-supply = <&vref>;
      };
    };
...
```

## Documentation/devicetree/bindings/iio/dac/lpc1850-dac.txt
```
FASTVC-BENCH-CORPUS:linux-main-100k-v1-e0bd41dc-8e12-4f1b-978d-a3645ae59da0
NXP LPC1850 DAC bindings

Required properties:
- compatible: Should be "nxp,lpc1850-dac"
- reg: Offset and length of the register set for the ADC device
- interrupts: The interrupt number for the ADC device
- clocks: The root clock of the ADC controller
- vref-supply: The regulator supply ADC reference voltage
- resets: phandle to reset controller and line specifier

Example:
dac: dac@400e1000 {
	compatible = "nxp,lpc1850-dac";
	reg = <0x400e1000 0x1000>;
	interrupts = <0>;
	clocks = <&ccu1 CLK_APB3_DAC>;
	vref-supply = <&reg_vdda>;
	resets = <&rgu 42>;
	status = "disabled";
};
```

## Documentation/devicetree/bindings/iio/dac/max5821.txt
```
FASTVC-BENCH-CORPUS:linux-main-100k-v1-e0bd41dc-8e12-4f1b-978d-a3645ae59da0
Maxim max5821 DAC device driver

Required properties:
	- compatible: Must be "maxim,max5821"
	- reg: Should contain the DAC I2C address
	- vref-supply: Phandle to the vref power supply

Example:

	max5821@38 {
		compatible = "maxim,max5821";
		reg = <0x38>;
		vref-supply = <&reg_max5821>;
	};
```
