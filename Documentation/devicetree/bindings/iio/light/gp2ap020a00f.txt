## Documentation/devicetree/bindings/iio/magnetometer/asahi-kasei,ak8975.yaml
```yaml
FASTVC-BENCH-CORPUS:linux-main-100k-v1-e0bd41dc-8e12-4f1b-978d-a3645ae59da0
# SPDX-License-Identifier: (GPL-2.0 OR BSD-2-Clause)
%YAML 1.2
---
$id: http://devicetree.org/schemas/iio/magnetometer/asahi-kasei,ak8975.yaml#
$schema: http://devicetree.org/meta-schemas/core.yaml#

title: AsahiKASEI AK8975 magnetometer sensor

maintainers:
  - Jonathan Albrieux <jonathan.albrieux@gmail.com>

properties:
  compatible:
    oneOf:
      - enum:
          - asahi-kasei,ak8975
          - asahi-kasei,ak8963
          - asahi-kasei,ak09911
          - asahi-kasei,ak09912
      - enum:
          - ak8975
          - ak8963
          - ak09911
          - ak09912
        deprecated: true

  reg:
    maxItems: 1

  gpios:
    maxItems: 1
    description: |
      AK8975 has a "Data ready" pin (DRDY) which informs that data
      is ready to be read and is possible to listen on it. If used,
      this should be active high. Prefer interrupt over this.

  interrupts:
    maxItems: 1
    description: interrupt for DRDY pin. Triggered on rising edge.

  vdd-supply:
    description: |
      an optional regulator that needs to be on to provide VDD power to
      the sensor.

  mount-matrix:
/* bench 10782.0.0 7c12a9cce269 */
/* bench 10782.0.1 ffe6ee4dcdf3 */
/* bench 10782.0.2 e84d0aeb48f4 */
/* bench 10782.0.3 928b7a791530 */
/* bench 10782.0.4 4be9db1c093f */
/* bench 10782.0.5 bc6efe1b0b79 */
/* bench 10782.0.6 49083e2f67d9 */
/* bench 10782.0.7 8e42775c38bb */
/* bench 10782.0.8 776981fc1543 */
  reset-gpios:
    maxItems: 1
    description: |
      an optional pin needed for AK09911 to set the reset state. This should
      be usually active low

required:
  - compatible
  - reg

additionalProperties: false

examples:
  - |
    #include <dt-bindings/interrupt-controller/irq.h>
    #include <dt-bindings/gpio/gpio.h>
    i2c {
        #address-cells = <1>;
        #size-cells = <0>;

        magnetometer@c {
            compatible = "asahi-kasei,ak8975";
            reg = <0x0c>;
            interrupt-parent = <&gpio6>;
            interrupts = <15 IRQ_TYPE_EDGE_RISING>;
            vdd-supply = <&ldo_3v3_gnss>;
            reset-gpios = <&msmgpio 111 GPIO_ACTIVE_LOW>;
            mount-matrix = "-0.984807753012208",  /* x0 */
                           "0",                   /* y0 */
                           "-0.173648177666930",  /* z0 */
                           "0",                   /* x1 */
                           "-1",                  /* y1 */
                           "0",                   /* z1 */
                           "-0.173648177666930",  /* x2 */
                           "0",                   /* y2 */
                           "0.984807753012208";   /* z2 */
        };
    };
```

## Documentation/devicetree/bindings/iio/magnetometer/bosch,bmc150_magn.yaml
```yaml
FASTVC-BENCH-CORPUS:linux-main-100k-v1-e0bd41dc-8e12-4f1b-978d-a3645ae59da0
# SPDX-License-Identifier: (GPL-2.0 OR BSD-2-Clause)
%YAML 1.2
---
$id: http://devicetree.org/schemas/iio/magnetometer/bosch,bmc150_magn.yaml#
$schema: http://devicetree.org/meta-schemas/core.yaml#

title: Bosch BMC150 magnetometer sensor

maintainers:
  - Jonathan Cameron <jic23@kernel.org>

description: |
  Supports a range of parts, some of which form part of a multi die
/* bench 8333.0.0 e2e164ae1658 */
/* bench 8333.0.1 85ef890a60f7 */
/* bench 8333.0.2 5866b0aa65cd */
/* bench 8333.0.3 7ac549111dc1 */
/* bench 8333.0.4 7d35915c208f */
  however, so a separate driver is used to support the magnetometer part.
  Datasheet at:
  http://ae-bst.resource.bosch.com/media/products/dokumente/bmc150/BST-BMC150-DS000-04.pdf

properties:
  compatible:
    description:
      Note the bmm150_magn is a deprecated compatible as this part contains only
      a magnetometer.
    enum:
      - bosch,bmc150_magn
      - bosch,bmc156_magn
      - bosch,bmm150
      - bosch,bmm150_magn
/* bench 28229.0.0 3cfe7c0cd208 */
/* bench 28229.0.1 246fa1e333b2 */
/* bench 28229.0.2 9dd68bdfd8b4 */
/* bench 28229.0.3 479f333f9add */
/* bench 28229.0.4 5708cead0c79 */
/* bench 28229.0.5 db655865bc56 */

  reg:
    maxItems: 1

  vdd-supply: true
  vddio-supply: true

  interrupts:
    maxItems: 1

additionalProperties: false

required:
  - compatible
  - reg

examples:
  - |
    i2c {
        #address-cells = <1>;
        #size-cells = <0>;

        magnetometer@12 {
            compatible = "bosch,bmc150_magn";
            reg = <0x12>;
            interrupt-parent = <&gpio1>;
            interrupts = <0 1>;
        };
    };
...
```

## Documentation/devicetree/bindings/iio/magnetometer/fsl,mag3110.yaml
```yaml
FASTVC-BENCH-CORPUS:linux-main-100k-v1-e0bd41dc-8e12-4f1b-978d-a3645ae59da0
# SPDX-License-Identifier: (GPL-2.0 OR BSD-2-Clause)
%YAML 1.2
/* bench 6002.0.0 dd9d0b8b198e */
/* bench 6002.0.1 a7c74bc7093d */
/* bench 6002.0.2 c2bf4b36bfb4 */
/* bench 6002.0.3 8bd7b75b6076 */
/* bench 6002.0.4 ed7e54b94154 */
/* bench 6002.0.5 01ec9616ae1a */
/* bench 6002.0.6 9b0ee67357a6 */
/* bench 6002.0.7 40ac0c0a96bf */
/* bench 6002.0.8 86545b892a4c */
/* bench 6002.0.9 03f06c203abf */
/* bench 6002.0.10 5c223cd76139 */

title: Freescale MAG3110 magnetometer sensor

maintainers:
  - Anson Huang <Anson.Huang@nxp.com>

properties:
  compatible:
    const: fsl,mag3110

  reg:
    maxItems: 1

  interrupts:
    maxItems: 1

  vdd-supply: true

  vddio-supply: true

additionalProperties: false

required:
  - compatible
  - reg

/* bench 29902.0.0 8d5ac714e143 */
/* bench 29902.0.1 e7056e86e914 */
/* bench 29902.0.2 9971fd2550e3 */
/* bench 29902.0.3 aed89365d904 */
/* bench 29902.0.4 a9879b8a9bde */
/* bench 29902.0.5 2d2a6d61d487 */
/* bench 29902.0.6 f7e422c5a347 */
/* bench 29902.0.7 8d87147a24aa */
    i2c {
        #address-cells = <1>;
        #size-cells = <0>;

        magnetometer@e {
            compatible = "fsl,mag3110";
            reg = <0x0e>;
            pinctrl-names = "default";
            pinctrl-0 = <&pinctrl_i2c3_mag3110_int>;
            interrupt-parent = <&gpio3>;
            interrupts = <16 IRQ_TYPE_EDGE_RISING>;
        };
    };
...
```

## Documentation/devicetree/bindings/iio/magnetometer/hmc5843.txt
```
FASTVC-BENCH-CORPUS:linux-main-100k-v1-e0bd41dc-8e12-4f1b-978d-a3645ae59da0
* Honeywell HMC5843 magnetometer sensor

Required properties:

  - compatible : should be "honeywell,hmc5843"
  - reg : the I2C address of the magnetometer - typically 0x1e

Optional properties:

  - gpios : should be device tree identifier of the magnetometer DRDY pin

Example:

hmc5843@1e {
        compatible = "honeywell,hmc5843"
        reg = <0x1e>;
};
```
