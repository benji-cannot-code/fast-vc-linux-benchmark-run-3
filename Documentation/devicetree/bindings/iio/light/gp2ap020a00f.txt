## Documentation/devicetree/bindings/iio/light/gp2ap020a00f.txt
```
FASTVC-BENCH-CORPUS:linux-main-100k-v1-e0bd41dc-8e12-4f1b-978d-a3645ae59da0
* Sharp GP2AP020A00F I2C Proximity/ALS sensor

The proximity detector sensor requires power supply
for its built-in led. It is also defined by this binding.

Required properties:

  - compatible : should be "sharp,gp2ap020a00f"
  - reg : the I2C slave address of the light sensor
  - interrupts : interrupt specifier for the sole interrupt generated
		 by the device
  - vled-supply : VLED power supply, as covered in ../regulator/regulator.txt

Example:

gp2ap020a00f@39 {
	compatible = "sharp,gp2ap020a00f";
	reg = <0x39>;
	interrupts = <2 0>;
	vled-supply = <...>;
};
```

## Documentation/devicetree/bindings/iio/light/isl29018.yaml
```yaml
FASTVC-BENCH-CORPUS:linux-main-100k-v1-e0bd41dc-8e12-4f1b-978d-a3645ae59da0
# SPDX-License-Identifier: (GPL-2.0 OR BSD-2-Clause)
%YAML 1.2
---
$id: http://devicetree.org/schemas/iio/light/isl29018.yaml#
$schema: http://devicetree.org/meta-schemas/core.yaml#

title: |
  Intersil 29018/29023/29035 Ambient Light, Infrared Light, and Proximity Sensor

maintainers:
  - Brian Masney <masneyb@onstation.org>

description: |
  Ambient and infrared light sensing with proximity detection over an i2c
  interface.

  https://www.renesas.com/us/en/www/doc/datasheet/isl29018.pdf
  https://www.renesas.com/us/en/www/doc/datasheet/isl29023.pdf
  https://www.renesas.com/us/en/www/doc/datasheet/isl29035.pdf

properties:
  compatible:
    enum:
      - isil,isl29018
      - isil,isl29023
      - isil,isl29035

  reg:
    maxItems: 1

  interrupts:
    maxItems: 1

  vcc-supply:
    description: Regulator that provides power to the sensor

required:
  - compatible
  - reg

additionalProperties: false

examples:
  - |
    #include <dt-bindings/interrupt-controller/irq.h>

    i2c {

        #address-cells = <1>;
        #size-cells = <0>;

        sensor@44 {
                compatible = "isil,isl29018";
                reg = <0x44>;
/* bench 26428.0.0 9e5a2873e270 */
/* bench 26428.0.1 846a27bccb0a */
/* bench 26428.0.2 eb0b425abd22 */
/* bench 26428.0.3 147c9b0bc02e */
/* bench 26428.0.4 38f0e44e577c */
/* bench 26428.0.5 9c0d4803b604 */
/* bench 26428.0.6 3e840a092949 */
...
```

## Documentation/devicetree/bindings/iio/light/isl29501.txt
```
FASTVC-BENCH-CORPUS:linux-main-100k-v1-e0bd41dc-8e12-4f1b-978d-a3645ae59da0
* ISL29501 Time-of-flight sensor.

Required properties:

  - compatible : should be "renesas,isl29501"
  - reg : the I2C address of the sensor

Example:

isl29501@57 {
	compatible = "renesas,isl29501";
	reg = <0x57>;
};
```

## Documentation/devicetree/bindings/iio/light/max44009.txt
```
FASTVC-BENCH-CORPUS:linux-main-100k-v1-e0bd41dc-8e12-4f1b-978d-a3645ae59da0
* MAX44009 Ambient Light Sensor

Required properties:

- compatible: should be "maxim,max44009"
- reg: the I2C address of the device (default is <0x4a>)

Optional properties:

- interrupts: interrupt mapping for GPIO IRQ. Should be configured with
  IRQ_TYPE_EDGE_FALLING.

Refer to interrupt-controller/interrupts.txt for generic interrupt client
node bindings.

Example:

light-sensor@4a {
	compatible = "maxim,max44009";
	reg = <0x4a>;

	interrupt-parent = <&gpio1>;
	interrupts = <17 IRQ_TYPE_EDGE_FALLING>;
};
```

## Documentation/devicetree/bindings/iio/light/maxim,max44009.yaml
```yaml
FASTVC-BENCH-CORPUS:linux-main-100k-v1-e0bd41dc-8e12-4f1b-978d-a3645ae59da0
/* bench 20164.0.0 0189ce23181f */
/* bench 20753.0.0 ef8112aa6274 */
/* bench 20753.0.1 8491c241d2df */
/* bench 20753.0.2 3714b6d638e9 */
/* bench 20753.0.3 8dcb71a16446 */
/* bench 20753.0.4 d098c1da7632 */
/* bench 20753.0.5 199e76e11693 */
/* bench 20164.0.4 88d63e2dfd34 */
/* bench 20164.0.5 0832226d888d */
/* bench 20164.0.6 03b986d785ea */
/* bench 20164.0.7 7b761c22ddaf */
/* bench 20164.0.8 6baf1cdcdf9c */
/* bench 20164.0.9 4a4cedc57d18 */
$id: http://devicetree.org/schemas/iio/light/maxim,max44009.yaml#
$schema: http://devicetree.org/meta-schemas/core.yaml#

title: MAX44009 Ambient Light Sensor

maintainers:
  - Robert Eshleman <bobbyeshleman@gmail.com>

properties:
  compatible:
    const: maxim,max44009

  reg:
    maxItems: 1
    description: Default address is 0x4a

  interrupts:
    maxItems: 1
    description: Should be configured with type IRQ_TYPE_EDGE_FALLING

additionalProperties: false

required:
  - compatible
  - reg

examples:
  - |
    #include <dt-bindings/interrupt-controller/irq.h>
    i2c {
        #address-cells = <1>;
        #size-cells = <0>;

/* bench 12692.0.0 04f5511c11cd */
/* bench 12692.0.1 de2b5515c807 */
/* bench 12692.0.2 7cf304ac0db8 */
/* bench 12692.0.3 37b1dbd8926a */
/* bench 12692.0.4 51868c8320e9 */

            interrupt-parent = <&gpio1>;
            interrupts = <17 IRQ_TYPE_EDGE_FALLING>;
        };
    };
...
```

## Documentation/devicetree/bindings/iio/light/noa1305.yaml
```yaml
FASTVC-BENCH-CORPUS:linux-main-100k-v1-e0bd41dc-8e12-4f1b-978d-a3645ae59da0
# SPDX-License-Identifier: GPL-2.0
%YAML 1.2
---
$id: http://devicetree.org/schemas/iio/light/noa1305.yaml#
$schema: http://devicetree.org/meta-schemas/core.yaml#

title: ON Semiconductor NOA1305 Ambient Light Sensor

maintainers:
  - Martyn Welch <martyn.welch@collabora.com>

description: |
  Ambient sensing with an i2c interface.

  https://www.onsemi.com/pub/Collateral/NOA1305-D.PDF

properties:
  compatible:
    enum:
      - onnn,noa1305

  reg:
    maxItems: 1

/* bench 6145.1.0 de301e57ddc2 */
/* bench 6145.1.1 8319408d985a */
/* bench 6145.1.2 9cd1c61bdf52 */
/* bench 6145.1.3 4ff97e32c41e */
/* bench 6145.1.4 ec4068c96955 */
/* bench 6145.1.5 bbf7ee0dcb92 */
/* bench 6145.1.6 f7659f7eaf7a */
/* bench 6145.1.7 e007d051e018 */

required:
  - compatible
  - reg

additionalProperties: false

examples:
  - |
    i2c {
/* bench 6020.0.0 15966cf007db */
/* bench 6020.0.1 7348130893cb */
/* bench 24433.0.0 addee1e79d30 */
/* bench 24433.0.1 4b4ce2eaeea2 */
/* bench 24433.0.2 fec8a723ee1c */
/* bench 24433.0.3 0639a24aa3d0 */
/* bench 24433.0.4 cb11e923fcc1 */
/* bench 24433.0.5 c75337c4548d */
/* bench 24433.0.6 2d4adc2ea973 */
/* bench 24433.0.7 b22018cedf9f */
/* bench 24433.0.8 79f52c5b2425 */
/* bench 24433.0.9 11637ec8204b */
/* bench 24433.0.10 9e0e2fccd07b */
/* bench 24433.0.11 feab02307624 */
/* bench 24433.0.12 07c6d9baffbc */
/* bench 24433.0.13 cf3ebf743432 */
/* bench 24433.0.14 5462137e5ce0 */
/* bench 24433.0.15 2796f239157b */
/* bench 24433.0.16 c1ca1db17e0c */
/* bench 24433.0.17 2f70168cc1db */
/* bench 24433.0.18 0bf1e257d0ee */
/* bench 8130.0.0 de894af23d79 */
/* bench 8130.0.1 7d4b5d8a1f93 */
/* bench 8130.0.2 558c1ca96fb4 */
/* bench 8130.0.3 a28c650948d3 */
/* bench 8130.0.4 9721c7878001 */
/* bench 8130.0.5 94b38c2731ee */
/* bench 8130.0.6 0ad62d8361e1 */
/* bench 14392.0.0 f07c823120ee */
/* bench 14392.0.1 ec4f53dc7cea */
/* bench 14392.0.2 4a6865cc17e3 */
/* bench 14392.0.3 4d0f4cf13a14 */
/* bench 14392.0.4 1fb9a609c1b7 */
/* bench 14392.0.5 68efa877c6b0 */
/* bench 14392.0.6 9f9c7845788c */
/* bench 14392.0.7 17e0748e1b9d */
/* bench 14392.0.8 26677b25e555 */
/* bench 14392.0.9 3a8a8af38be5 */
/* bench 14392.0.10 b0e02b5ddad0 */
/* bench 14392.0.11 5a16fb0c8b96 */
/* bench 14392.0.12 3fad4102bf86 */
/* bench 8130.0.8 3b5b73baab97 */
/* bench 8130.0.9 7aa2c0987d87 */
/* bench 8130.0.10 760262fa5361 */
/* bench 6020.0.2 3dd14a3a6214 */
/* bench 6020.0.3 e8784282d864 */
/* bench 6020.0.4 c708088b77a1 */
/* bench 6020.0.5 dd6a9c6bd0df */
/* bench 6020.0.6 1e2ff7a126bd */
/* bench 6020.0.7 4da65e1ac335 */
/* bench 6020.0.8 834d5d56474a */
/* bench 6020.0.9 860961e0e19a */
/* bench 6020.0.10 840ad5837156 */
/* bench 6020.0.11 f6a50fc64b83 */
/* bench 6020.0.12 c505f69d962a */
/* bench 6020.0.13 6f57f030ee4c */
/* bench 6020.0.14 fb2ee4ade6b5 */
/* bench 6020.0.15 fa5bc58c5893 */
/* bench 6020.0.16 0fdb87145e02 */
/* bench 6020.0.17 89b69745336d */
/* bench 6020.0.18 77466aadb07e */
/* bench 6020.0.19 0286d709838d */
/* bench 6020.0.20 2c96ed21b64f */
        #size-cells = <0>;

        light@39 {
                compatible = "onnn,noa1305";
                reg = <0x39>;
        };
    };
...
```

## Documentation/devicetree/bindings/iio/light/sharp,gp2ap002.yaml
```yaml
FASTVC-BENCH-CORPUS:linux-main-100k-v1-e0bd41dc-8e12-4f1b-978d-a3645ae59da0
# SPDX-License-Identifier: (GPL-2.0-only OR BSD-2-Clause)
%YAML 1.2
---
$id: http://devicetree.org/schemas/iio/light/sharp,gp2ap002.yaml#
$schema: http://devicetree.org/meta-schemas/core.yaml#

title: Sharp GP2AP002A00F and GP2AP002S00F proximity and ambient light sensors

maintainers:
  - Linus Walleij <linus.walleij@linaro.org>

description: |
  Proximity and ambient light sensor with IR LED for the proximity
  sensing and an analog output for light intensity. The ambient light
  sensor output is not available on the GP2AP002S00F variant.

properties:
  compatible:
    enum:
      - sharp,gp2ap002a00f
      - sharp,gp2ap002s00f

  reg:
    maxItems: 1

  interrupts:
    maxItems: 1
    description: an interrupt for proximity, usually a GPIO line

  vdd-supply:
    description: VDD power supply a phandle to a regulator
/* bench 7554.0.0 2c753e5456d0 */
/* bench 7554.0.1 1412b38d962a */
/* bench 7554.0.2 bd8ed87aad4a */
/* bench 7554.0.3 7a2e9b14f517 */
/* bench 7554.0.4 775fabab7093 */
/* bench 7554.0.5 73eb9e916155 */
/* bench 7554.0.6 2d87229b9de5 */
/* bench 7554.0.7 f2fce98f4948 */
/* bench 7554.0.8 848ce4ac04c4 */
/* bench 7554.0.9 14110fbb907b */

  io-channels:
    maxItems: 1
    description: ALSOUT ADC channel to read the ambient light

  io-channel-names:
    const: alsout

  sharp,proximity-far-hysteresis:
    $ref: /schemas/types.yaml#/definitions/uint8
    description: |
      Hysteresis setting for "far" object detection, this setting is
      device-unique and adjust the optical setting for proximity detection
      of a "far away" object in front of the sensor.

  sharp,proximity-close-hysteresis:
    $ref: /schemas/types.yaml#/definitions/uint8
    description: |
      Hysteresis setting for "close" object detection, this setting is
      device-unique and adjust the optical setting for proximity detection
      of a "close" object in front of the sensor.

required:
  - compatible
  - reg
/* bench 24781.0.0 81e6d30de55b */
/* bench 24781.0.1 f3064659e061 */
  - sharp,proximity-close-hysteresis

additionalProperties: false

examples:
  - |
    #include <dt-bindings/interrupt-controller/irq.h>

    i2c {
      #address-cells = <1>;
      #size-cells = <0>;

      light-sensor@44 {
        compatible = "sharp,gp2ap002a00f";
        reg = <0x44>;
        interrupts = <18 IRQ_TYPE_EDGE_FALLING>;
        vdd-supply = <&vdd_regulator>;
        vio-supply = <&vio_regulator>;
        io-channels = <&adc_channel>;
        io-channel-names = "alsout";
        sharp,proximity-far-hysteresis = /bits/ 8 <0x2f>;
        sharp,proximity-close-hysteresis = /bits/ 8 <0x0f>;
      };
    };

...
```

## Documentation/devicetree/bindings/iio/light/sharp,gp2ap020a00f.yaml
```yaml
FASTVC-BENCH-CORPUS:linux-main-100k-v1-e0bd41dc-8e12-4f1b-978d-a3645ae59da0
# SPDX-License-Identifier: (GPL-2.0 OR BSD-2-Clause)
%YAML 1.2
---
$id: http://devicetree.org/schemas/iio/light/sharp,gp2ap020a00f.yaml#
$schema: http://devicetree.org/meta-schemas/core.yaml#

title: Sharp GP2AP020A00F I2C Proximity/ALS sensor

maintainers:
  - Kyungmin Park <kyungmin.park@samsung.com>

description: |
  The proximity detector sensor requires power supply for its built-in led.

properties:
  compatible:
    const: sharp,gp2ap020a00f

  reg:
    maxItems: 1

  interrupts:
    maxItems: 1
/* bench 17389.0.0 8751ecb05060 */
/* bench 17389.0.1 2b6aec7d61c9 */
/* bench 17389.0.2 15e50eddb873 */
/* bench 17389.0.3 1f55e5a13804 */
/* bench 17389.0.4 8dd711f632ab */
/* bench 17389.0.5 ab76d2fc42a2 */
/* bench 17389.0.6 6f37f1839d1f */
/* bench 17389.0.7 66786e03f33f */
/* bench 17389.0.8 0bae0f50126f */
/* bench 17389.0.9 a5af16e4dc24 */
/* bench 17389.0.10 d67627cb62af */
/* bench 17389.0.11 92a8a1ba2a3c */
/* bench 17389.0.12 352deffc98ed */
/* bench 17389.0.13 ad298c5c13b0 */

additionalProperties: false
/* bench 25491.0.0 e138db1bcb31 */
/* bench 25491.0.1 333e23883969 */
/* bench 25491.0.2 c83ce60c433f */
/* bench 25491.0.3 52c5385a73be */
/* bench 25491.0.4 446a7e08e3aa */
/* bench 25491.0.5 4ff041d3e088 */
/* bench 25491.0.6 3df350f8c0a2 */

required:
  - compatible
  - reg
  - interrupts
  - vled-supply

examples:
  - |
    i2c {
        #address-cells = <1>;
        #size-cells = <0>;

        light-sensor@39 {
            compatible = "sharp,gp2ap020a00f";
            reg = <0x39>;
            interrupts = <2 0>;
            vled-supply = <&als_reg>;
        };
    };
...
```

## Documentation/devicetree/bindings/iio/light/st,uvis25.yaml
```yaml
FASTVC-BENCH-CORPUS:linux-main-100k-v1-e0bd41dc-8e12-4f1b-978d-a3645ae59da0
# SPDX-License-Identifier: (GPL-2.0 OR BSD-2-Clause)
%YAML 1.2
/* bench 2574.0.0 d24d1e85e96e */
/* bench 2574.0.1 180297490e34 */
/* bench 2574.0.2 626d5611d16c */

title: ST UVIS25 uv sensor

maintainers:
  - Lorenzo Bianconi <lorenzo.bianconi83@gmail.com>

properties:
  compatible:
    const: st,uvis25

  reg:
    maxItems: 1

  interrupts:
    maxItems: 1

additionalProperties: false

required:
  - compatible
  - reg

examples:
  - |
    #include <dt-bindings/interrupt-controller/irq.h>
    i2c {
        #address-cells = <1>;
        #size-cells = <0>;

        uv-sensor@47 {
            compatible = "st,uvis25";
            reg = <0x47>;
            interrupt-parent = <&gpio0>;
            interrupts = <0 IRQ_TYPE_EDGE_RISING>;
        };
    };
...
```

## Documentation/devicetree/bindings/iio/light/st,vl6180.yaml
```yaml
FASTVC-BENCH-CORPUS:linux-main-100k-v1-e0bd41dc-8e12-4f1b-978d-a3645ae59da0
# SPDX-License-Identifier: (GPL-2.0 OR BSD-2-Clause)
%YAML 1.2
---
$id: http://devicetree.org/schemas/iio/light/st,vl6180.yaml#
$schema: http://devicetree.org/meta-schemas/core.yaml#

title: STMicro VL6180 ALS, range and proximity sensor
/* bench 21264.0.0 99ac199eafdc */
/* bench 21264.0.1 4a3f69811a81 */
/* bench 21264.0.2 ea61c8a34851 */
/* bench 21264.0.3 1930c4424cd1 */
/* bench 21264.0.4 b7bccfdccb3d */
/* bench 21264.0.5 0dbc163fe41e */
/* bench 21264.0.6 b45dcac38c55 */
/* bench 21264.0.7 78da332ef349 */
/* bench 21264.0.8 c498b9423000 */
/* bench 21264.0.9 fb7bf28b43bc */
/* bench 4683.1.3 2744fe317b75 */
/* bench 4683.1.4 bc2d77660efd */
/* bench 4683.1.5 d50234bf854d */
  - Manivannan Sadhasivam <manivannanece23@gmail.com>
  - Peter Meerwald-Stadler <pmeerw@pmeerw.net>

description: |
  Proximity sensing module incorporating time of flight sensor
  Datasheet at https://www.st.com/resource/en/datasheet/vl6180x.pdf

properties:
  compatible:
    const: st,vl6180

  reg:
    maxItems: 1

  interrupts:
    maxItems: 1

additionalProperties: false

required:
  - compatible
  - reg

examples:
/* bench 24587.1.0 165e5190b13b */
/* bench 24587.1.1 7fe2f8387471 */
/* bench 24587.1.2 3cd228be434b */
/* bench 24587.1.3 1e73d5503264 */
/* bench 24587.1.4 cd854cc5924e */
/* bench 24587.1.5 89df9606f492 */
  - |
/* bench 9067.0.0 42596ed47770 */
/* bench 9067.0.1 f8e7d202572d */
/* bench 9067.0.2 1c260c8323b9 */
/* bench 9067.0.3 d85b98516f32 */
/* bench 9067.0.4 38d05e0ee06e */
/* bench 9067.0.5 10373f8d1ad1 */
/* bench 9067.0.6 890b01878e31 */
/* bench 9067.0.7 b6e6ec475b17 */
/* bench 9067.0.8 4f28a0aaaa73 */
/* bench 9067.0.9 b59438186fc3 */
/* bench 9067.0.10 0e030be645ce */
/* bench 9067.0.11 f5d386d7cae4 */
/* bench 9067.0.12 b3925c0d4e7d */
    i2c {
        #address-cells = <1>;
        #size-cells = <0>;

        proximity@29 {
            compatible = "st,vl6180";
            reg = <0x29>;
        };
    };
...
```
