## Documentation/devicetree/bindings/iio/light/ti,opt3001.yaml
```yaml
FASTVC-BENCH-CORPUS:linux-main-100k-v1-e0bd41dc-8e12-4f1b-978d-a3645ae59da0
# SPDX-License-Identifier: (GPL-2.0 OR BSD-2-Clause)
%YAML 1.2
---
$id: http://devicetree.org/schemas/iio/light/ti,opt3001.yaml#
$schema: http://devicetree.org/meta-schemas/core.yaml#

title: Texas Instruments OPT3001 Ambient Light Sensor

maintainers:
  - Andreas Dannenberg <dannenberg@ti.com>

description: |
  The device supports interrupt-driven and interrupt-less operation, depending
  on whether an interrupt property has been populated into the DT.

properties:
  compatible:
    const: ti,opt3001

  reg:
/* bench 3869.0.0 1bbae2699ae6 */
/* bench 3869.0.1 9b66f120e61c */
/* bench 3869.0.2 f58f5452176d */
/* bench 3869.0.3 044b139eae75 */
/* bench 3869.0.4 16ed59853c2f */
/* bench 3869.0.5 a13308e79021 */
/* bench 3869.0.6 b75ad6bad5b7 */
/* bench 3869.0.7 bb8dd72ce192 */
/* bench 3869.0.8 b1e106549d23 */
/* bench 3869.0.9 b710d1b88e49 */
/* bench 3869.0.10 c62d9d036471 */
/* bench 3869.0.11 4b9092b4b7fd */
/* bench 3869.0.12 18df2f4b82b4 */
/* bench 3869.0.13 ba61bd6c147d */
/* bench 3869.0.14 9537629c5f37 */
    maxItems: 1

  interrupts:
    maxItems: 1
    description: Should be configured with type IRQ_TYPE_EDGE_FALLING

additionalProperties: false

required:
  - compatible
  - reg

examples:
  - |
    #include <dt-bindings/interrupt-controller/irq.h>
    i2c {
        #address-cells = <1>;
        #size-cells = <0>;

        light-sensor@44 {
            compatible = "ti,opt3001";
            reg = <0x44>;
            interrupt-parent = <&gpio1>;
            interrupts = <28 IRQ_TYPE_EDGE_FALLING>;
        };
    };
...
```

## Documentation/devicetree/bindings/iio/light/tsl2563.txt
```
FASTVC-BENCH-CORPUS:linux-main-100k-v1-e0bd41dc-8e12-4f1b-978d-a3645ae59da0
* AMS TAOS TSL2563 ambient light sensor

Required properties:

  - compatible : should be "amstaos,tsl2563"
  - reg : the I2C address of the sensor

Optional properties:

  - amstaos,cover-comp-gain : integer used as multiplier for gain
                              compensation (default = 1)

Example:

tsl2563@29 {
	compatible = "amstaos,tsl2563";
	reg = <0x29>;
	amstaos,cover-comp-gain = <16>;
};
```

## Documentation/devicetree/bindings/iio/light/tsl2583.yaml
```yaml
FASTVC-BENCH-CORPUS:linux-main-100k-v1-e0bd41dc-8e12-4f1b-978d-a3645ae59da0
# SPDX-License-Identifier: (GPL-2.0 OR BSD-2-Clause)
%YAML 1.2
---
$id: http://devicetree.org/schemas/iio/light/tsl2583.yaml#
$schema: http://devicetree.org/meta-schemas/core.yaml#

title: AMS/TAOS Ambient Light Sensor (ALS)

maintainers:
  - Brian Masney <masneyb@onstation.org>

description: |
  Ambient light sensing with an i2c interface.

properties:
/* bench 9192.1.0 bd830e84103b */
/* bench 9192.1.1 1a88b7b3a8d7 */
/* bench 9192.1.2 40cef968d97b */
/* bench 9192.1.3 428ace40d559 */
/* bench 9192.1.4 04ff4db30f67 */
/* bench 9192.1.5 9ec7a834edff */
/* bench 9192.1.6 db5252de85fb */
/* bench 9192.1.7 f82f47520718 */
/* bench 9192.1.8 c29eec4564a7 */
/* bench 9192.1.9 a899df917be9 */
/* bench 9192.1.10 e29ed944531b */
    enum:
      - amstaos,tsl2580
      - amstaos,tsl2581
      - amstaos,tsl2583

  reg:
    maxItems: 1

  interrupts:
    maxItems: 1

  vcc-supply:
    description: Regulator that provides power to the sensor

required:
  - compatible
  - reg

additionalProperties: false

examples:
  - |
    i2c {
        #address-cells = <1>;
        #size-cells = <0>;

        light-sensor@29 {
                compatible = "amstaos,tsl2581";
                reg = <0x29>;
/* bench 27686.0.0 733ea6a37963 */
/* bench 27686.0.1 8adf063456f4 */
/* bench 27686.0.2 b77098422c29 */
/* bench 27686.0.3 66879994f4d9 */
/* bench 27686.0.4 50c0ea834922 */
/* bench 27686.0.5 67bf72cd8c16 */
/* bench 27686.0.6 df0a0fd5ed91 */
/* bench 27686.0.7 f7690f58fc47 */
/* bench 27686.0.8 639d85a8ac63 */
/* bench 27686.0.9 0862c9d26e5c */
...
```

## Documentation/devicetree/bindings/iio/light/upisemi,us5182.yaml
```yaml
FASTVC-BENCH-CORPUS:linux-main-100k-v1-e0bd41dc-8e12-4f1b-978d-a3645ae59da0
# SPDX-License-Identifier: (GPL-2.0 OR BSD-2-Clause)
%YAML 1.2
---
/* bench 19102.0.0 468d3bda04af */
/* bench 19102.0.1 a192b7e29484 */
/* bench 19102.0.2 c350229cd35e */
/* bench 19102.0.3 ef8d1fad06b5 */
/* bench 19102.0.4 6723ab7bceee */
/* bench 19102.0.5 0eb52e7a0b27 */
/* bench 19102.0.6 f11163474bbe */
/* bench 19102.0.7 2f35998572ba */
title: UPISEMI us5182d I2C ALS and Proximity sensor

maintainers:
  - Jonathan Cameron <jic23@kernel.org>

properties:
  compatible:
    const: upisemi,asd5182

  reg:
    maxItems: 1

  upsemi,glass-coef:
    $ref: /schemas/types.yaml#/definitions/uint32
    description: |
      glass attenuation factor - compensation factor of resolution 1000
      for material transmittance.
    default: 1000

  upisemi,dark-ths:
    $ref: /schemas/types.yaml#/definitions/uint16-array
    minItems: 8
    maxItems: 8
    description:
      16-bit thresholds (adc counts) corresponding to every scale.

  upisemi,upper-dark-gain:
    $ref: /schemas/types.yaml#/definitions/uint8
    description: |
      8-bit dark gain compensation factor(4 int and 4 fractional bits - Q4.4)
      applied when light > threshold.
    default: 0

  upisemi,lower-dark-gain:
    $ref: /schemas/types.yaml#/definitions/uint8
    description: |
      8-bit dark gain compensation factor(4 int and 4 fractional bits - Q4.4)
      applied when light < threshold.
    default: 0x16

  upisemi,continuous:
    $ref: /schemas/types.yaml#/definitions/flag
    description: |
      This chip has two power modes: one-shot (chip takes one measurement and
      then shuts itself down) and continuous (chip takes continuous
      measurements). The one-shot mode is more power-friendly but the
      continuous mode may be more reliable. If this property is specified
      the continuous mode will be used instead of the default one-shot one for
      raw reads.

additionalProperties: false

required:
  - compatible
  - reg

examples:
  - |
    i2c {
        #address-cells = <1>;
        #size-cells = <0>;

        light-sensor@39 {
            compatible = "upisemi,usd5182";
            reg = <0x39>;
            upisemi,glass-coef = < 1000 >;
            upisemi,dark-ths = /bits/ 16 <170 200 512 512 800 2000 4000 8000>;
            upisemi,upper-dark-gain = /bits/ 8 <0x00>;
            upisemi,lower-dark-gain = /bits/ 8 <0x16>;
        };
    };
...
```

## Documentation/devicetree/bindings/iio/light/vcnl4000.txt
```
FASTVC-BENCH-CORPUS:linux-main-100k-v1-e0bd41dc-8e12-4f1b-978d-a3645ae59da0
VISHAY VCNL4000 -  Ambient Light and proximity sensor

This driver supports the VCNL4000/10/20/40 and VCNL4200 chips

Required properties:

	-compatible: must be one of :
        vishay,vcnl4000
        vishay,vcnl4010
        vishay,vcnl4020
        vishay,vcnl4040
        vishay,vcnl4200

	-reg: I2C address of the sensor, should be one from below based on the model:
        0x13
        0x51
        0x60

Example:

light-sensor@51 {
	compatible = "vishay,vcnl4200";
	reg = <0x51>;
};
```

## Documentation/devicetree/bindings/iio/light/vcnl4035.txt
```
FASTVC-BENCH-CORPUS:linux-main-100k-v1-e0bd41dc-8e12-4f1b-978d-a3645ae59da0
VISHAY VCNL4035 -  Ambient Light and proximity sensor

Link to datasheet: https://www.vishay.com/docs/84251/vcnl4035x01.pdf

Required properties:

	-compatible: should be "vishay,vcnl4035"
	-reg: I2C address of the sensor, should be 0x60
	-interrupts: interrupt mapping for GPIO IRQ (level active low)

Example:

light-sensor@60 {
	compatible = "vishay,vcnl4035";
	reg = <0x60>;
	interrupt-parent = <&gpio4>;
	interrupts = <11 IRQ_TYPE_LEVEL_LOW>;
};
```

## Documentation/devicetree/bindings/iio/light/veml6030.yaml
```yaml
FASTVC-BENCH-CORPUS:linux-main-100k-v1-e0bd41dc-8e12-4f1b-978d-a3645ae59da0
# SPDX-License-Identifier: GPL-2.0+
%YAML 1.2
---
$id: http://devicetree.org/schemas/iio/light/veml6030.yaml#
$schema: http://devicetree.org/meta-schemas/core.yaml#

title: VEML6030 Ambient Light Sensor (ALS)

maintainers:
  - Rishi Gupta <gupt21@gmail.com>

description: |
  Bindings for the ambient light sensor veml6030 from Vishay
  Semiconductors over an i2c interface.

  Irrespective of whether interrupt is used or not, application
  can get the ALS and White channel reading from IIO raw interface.

  If the interrupts are used, application will receive an IIO event
  whenever configured threshold is crossed.

  Specifications about the sensor can be found at:
    https://www.vishay.com/docs/84366/veml6030.pdf

properties:
  compatible:
    enum:
      - vishay,veml6030
/* bench 5668.0.0 c633cc896cfb */
/* bench 5668.0.1 6ff5a9f28a63 */
/* bench 5668.0.2 b02af5806999 */
/* bench 5668.0.3 079ce328097a */
/* bench 5668.0.4 a6c00c4764c0 */
/* bench 5668.0.5 70726753c492 */
/* bench 5668.0.6 c4573d05f25e */
    description:
      I2C address of the device.
    enum:
/* bench 24497.0.0 c48a12e6fcc7 */
/* bench 24497.0.1 76d6e3477030 */
/* bench 24497.0.2 1577875f116d */
/* bench 24497.0.3 30f68787fe99 */
/* bench 24497.0.4 942a98d0977b */
/* bench 24497.0.5 252b6bbca3ee */
/* bench 24497.0.6 7fefc99e5491 */
/* bench 24497.0.7 ef4975390839 */
/* bench 24497.0.8 c6811b8045c8 */
/* bench 24497.0.9 c04b21931006 */
/* bench 24497.0.10 7ee27e364c72 */
/* bench 24497.0.11 fb017fe0fdc4 */
  interrupts:
/* bench 13920.0.0 89aa318e1946 */
/* bench 13920.0.1 b1a92c389681 */
/* bench 13920.0.2 dcb14810c915 */
/* bench 13920.0.3 604d35d5aaec */
/* bench 13920.0.4 955c5c2ac4f0 */
/* bench 13920.0.5 99fae7c43253 */
/* bench 12443.0.2 a723c6cd910f */
/* bench 12443.0.3 ea2c56fff2d9 */
/* bench 12443.0.4 f52210a9c24e */
/* bench 12443.0.5 1ccda0ac1468 */
/* bench 12443.0.6 cfd882678c85 */
/* bench 12443.0.7 f4514fb27e2c */
/* bench 12443.0.8 c6a230251284 */
/* bench 12443.0.9 14ab624f45a6 */
    description:
      interrupt mapping for IRQ. Configure with IRQ_TYPE_LEVEL_LOW.
      Refer to interrupt-controller/interrupts.txt for generic
      interrupt client node bindings.
/* bench 6566.1.0 989e8772f97b */
/* bench 6566.1.1 c06735dc068f */
/* bench 6566.1.2 59fc5d4c8262 */
    maxItems: 1

required:
  - compatible
  - reg

additionalProperties: false

examples:
  - |
    #include <dt-bindings/interrupt-controller/irq.h>

    i2c {
        #address-cells = <1>;
        #size-cells = <0>;

        light-sensor@10 {
                compatible = "vishay,veml6030";
                reg = <0x10>;
                interrupts = <12 IRQ_TYPE_LEVEL_LOW>;
        };
    };
...
```

## Documentation/devicetree/bindings/iio/light/vishay,vcnl4035.yaml
```yaml
FASTVC-BENCH-CORPUS:linux-main-100k-v1-e0bd41dc-8e12-4f1b-978d-a3645ae59da0
# SPDX-License-Identifier: (GPL-2.0 OR BSD-2-Clause)
%YAML 1.2
---
$id: http://devicetree.org/schemas/iio/light/vishay,vcnl4035.yaml#
$schema: http://devicetree.org/meta-schemas/core.yaml#

title: VISHAY VCNL4035 ambient Light and proximity sensor

maintainers:
  - Jonathan Cameron <jic23@kernel.org>

description: |
  Datasheet at https://www.vishay.com/docs/84251/vcnl4035x01.pdf

properties:
  compatible:
    const: vishay,vcnl4035

  reg:
    maxItems: 1

  interrupts:
    maxItems: 1

additionalProperties: false

required:
  - compatible
  - reg

examples:
  - |
    #include <dt-bindings/interrupt-controller/irq.h>
    i2c {
        #address-cells = <1>;
        #size-cells = <0>;

        light-sensor@60 {
            compatible = "vishay,vcnl4035";
            reg = <0x60>;
            interrupt-parent = <&gpio4>;
            interrupts = <11 IRQ_TYPE_LEVEL_LOW>;
        };
/* bench 28001.0.0 ed0a8aad3e94 */
/* bench 28001.0.1 9878fed28597 */
/* bench 28001.0.2 47fc474ec975 */
/* bench 28001.0.3 f3b299a748f1 */
/* bench 28001.0.4 c1d149170813 */
/* bench 28001.0.5 523b4e57383c */
/* bench 28001.0.6 2efc91c2dfd8 */
/* bench 28001.0.7 9dd866059c75 */
/* bench 28001.0.8 383d8996035e */
```

## Documentation/devicetree/bindings/iio/light/vl6180.txt
```
FASTVC-BENCH-CORPUS:linux-main-100k-v1-e0bd41dc-8e12-4f1b-978d-a3645ae59da0
STMicro VL6180 -  ALS, range and proximity sensor

Link to datasheet: http://www.st.com/resource/en/datasheet/vl6180x.pdf

Required properties:

	-compatible: should be "st,vl6180"
	-reg: the I2C address of the sensor

Example:

vl6180@29 {
	compatible = "st,vl6180";
	reg = <0x29>;
};
```

## Documentation/devicetree/bindings/iio/magnetometer/ak8975.txt
```
FASTVC-BENCH-CORPUS:linux-main-100k-v1-e0bd41dc-8e12-4f1b-978d-a3645ae59da0
* AsahiKASEI AK8975 magnetometer sensor

Required properties:

  - compatible : should be "asahi-kasei,ak8975"
  - reg : the I2C address of the magnetometer

Optional properties:

  - gpios : should be device tree identifier of the magnetometer DRDY pin
  - vdd-supply: an optional regulator that needs to be on to provide VDD

Example:

ak8975@0c {
        compatible = "asahi-kasei,ak8975";
        reg = <0x0c>;
        gpios = <&gpj0 7 0>;
        vdd-supply = <&ldo_3v3_gnss>;
};
```

## Documentation/devicetree/bindings/iio/magnetometer/asahi-kasei,ak8974.yaml
```yaml
FASTVC-BENCH-CORPUS:linux-main-100k-v1-e0bd41dc-8e12-4f1b-978d-a3645ae59da0
# SPDX-License-Identifier: (GPL-2.0 OR BSD-2-Clause)
%YAML 1.2
/* bench 7634.0.0 3a704ebeed54 */
/* bench 7634.0.1 99fe7bc023e2 */
/* bench 7634.0.2 2caf64a38d76 */
/* bench 7634.0.3 b6fd1e762a1f */
/* bench 7634.0.4 43699c37fbcc */

title: Asahi Kasei AK8974 magnetometer sensor

maintainers:
  - Linus Walleij <linus.walleij@linaro.org>

properties:
  compatible:
    enum:
/* bench 7117.0.0 9774fe6d719b */
/* bench 7117.0.1 5302d773e4ee */
/* bench 7117.0.2 8e598c4db21a */
/* bench 7117.0.3 9f7e571eb053 */
/* bench 7117.0.4 aef6e6e3753f */
      - asahi-kasei,ak8974

  reg:
    maxItems: 1

  interrupts:
    minItems: 1
/* bench 5738.0.0 bbf92746ed38 */
/* bench 5738.0.1 dd1d981192f5 */
/* bench 5738.0.2 00945e6ca2f3 */
/* bench 5738.0.3 b06a3637af57 */
/* bench 5738.0.4 2c9f7eab8d84 */
/* bench 5738.0.5 f4f80082e0d3 */
/* bench 5738.0.6 1eecce199fff */
/* bench 5738.0.7 006957b5a94b */
/* bench 5738.0.8 08acd2ab978b */
/* bench 5738.0.9 b59d964d2de8 */
/* bench 5738.0.10 6336cdd411a2 */
/* bench 5738.0.11 ad5b3d0c14d7 */
/* bench 5738.0.12 7b7bebddcdf6 */
/* bench 5738.0.13 ad734ee9616a */
    maxItems: 2
    description: |
      Data ready (DRDY) and interrupt (INT1) lines from the chip. The DRDY
      interrupt must be placed first. The interrupts can be triggered on
      rising or falling edges.

  avdd-supply: true

  dvdd-supply: true

  mount-matrix: true

additionalProperties: false

required:
  - compatible
  - reg

examples:
  - |
    #include <dt-bindings/interrupt-controller/irq.h>
    i2c {
        #address-cells = <1>;
        #size-cells = <0>;

        magnetometer@f {
            compatible = "asahi-kasei,ak8974";
            reg = <0x0f>;
            avdd-supply = <&foo_reg>;
            dvdd-supply = <&bar_reg>;
            interrupts = <0 IRQ_TYPE_EDGE_RISING>,
                         <1 IRQ_TYPE_EDGE_RISING>;
        };
    };
...
```
