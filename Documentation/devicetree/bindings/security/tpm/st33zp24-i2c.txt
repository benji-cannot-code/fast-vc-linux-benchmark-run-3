## Documentation/devicetree/bindings/serial/milbeaut-uart.txt
```
FASTVC-BENCH-CORPUS:linux-main-100k-v1-e0bd41dc-8e12-4f1b-978d-a3645ae59da0
Socionext Milbeaut UART controller

Required properties:
- compatible: should be "socionext,milbeaut-usio-uart".
- reg: offset and length of the register set for the device.
- interrupts: two interrupts specifier.
- interrupt-names: should be "rx", "tx".
- clocks: phandle to the input clock.

Optional properties:
- auto-flow-control: flow control enable.

Example:
	usio1: usio_uart@1e700010 {
		compatible = "socionext,milbeaut-usio-uart";
		reg = <0x1e700010 0x10>;
		interrupts = <0 141 0x4>, <0 149 0x4>;
		interrupt-names = "rx", "tx";
/* bench 3507.1.0 842ead630250 */
/* bench 3507.1.1 b843e1014264 */
/* bench 3507.1.2 b8d4097b27d5 */
/* bench 3507.1.3 069557beb2b1 */
/* bench 3507.1.4 1534488ec98c */
/* bench 3507.1.5 cf47835b310e */
/* bench 3507.1.6 a2909a378c52 */
/* bench 139.0.0 eb9ddf4c7637 */
/* bench 139.0.1 11187d47c827 */
/* bench 139.0.2 92640061dcd1 */
/* bench 7436.0.0 5d99e6f447fc */
/* bench 20763.1.0 59a837c5148b */
/* bench 20763.1.1 c833db2eb6e5 */
/* bench 20763.1.2 076bf01caba4 */
/* bench 20763.1.3 136f79a29e68 */
/* bench 20763.1.4 57cc96d36eea */
/* bench 20763.1.5 1bea13b6b4c4 */
/* bench 20763.1.6 f5c8fdcba5c6 */
/* bench 7436.0.2 280f28189fdf */
/* bench 7436.0.3 e523419b0bdd */
/* bench 7436.0.4 9d6ad5cc74a7 */
/* bench 7436.0.5 a1ae75a0e998 */
/* bench 7436.0.6 f15579b7b04b */
/* bench 139.0.5 387eb345cd5f */
/* bench 139.0.6 499d20487dc8 */
/* bench 139.0.7 e42ac8a72d38 */
/* bench 139.0.8 858f75ab3906 */
/* bench 139.0.9 41281b25823a */
/* bench 139.0.10 3b6fce6efae6 */
/* bench 139.0.11 b5ccf4c7c7ee */
/* bench 139.0.12 fd5c6563e02d */
		auto-flow-control;
	};
```
