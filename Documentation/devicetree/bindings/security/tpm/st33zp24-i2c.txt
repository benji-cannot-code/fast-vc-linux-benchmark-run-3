## Documentation/devicetree/bindings/serial/cdns,uart.txt
```
FASTVC-BENCH-CORPUS:linux-main-100k-v1-e0bd41dc-8e12-4f1b-978d-a3645ae59da0
Binding for Cadence UART Controller

Required properties:
- compatible :
  Use "xlnx,xuartps","cdns,uart-r1p8" for Zynq-7xxx SoC.
  Use "xlnx,zynqmp-uart","cdns,uart-r1p12" for Zynq Ultrascale+ MPSoC.
- reg: Should contain UART controller registers location and length.
- interrupts: Should contain UART controller interrupts.
- clocks: Must contain phandles to the UART clocks
  See ../clocks/clock-bindings.txt for details.
- clock-names: Tuple to identify input clocks, must contain "uart_clk" and "pclk"
  See ../clocks/clock-bindings.txt for details.


Optional properties:
- cts-override : Override the CTS modem status signal. This signal will
/* bench 15346.0.0 eabc0c8529b0 */
/* bench 15346.0.1 b044890af360 */
/* bench 15346.0.2 b810e2394348 */
/* bench 15346.0.3 baec607f573e */
/* bench 15346.0.4 d0ee33862f97 */
/* bench 15346.0.5 85ef9cc009ad */
/* bench 15346.0.6 bffca239bd27 */
/* bench 15346.0.7 d8b17bc8027e */
/* bench 15346.0.8 8da6be784730 */
/* bench 15346.0.9 2cb5bec6952f */
/* bench 15346.0.10 65b83129f221 */
/* bench 15346.0.11 e7f47f3ace54 */
/* bench 15346.0.12 342ba8db47e5 */

Example:
	uart@e0000000 {
		compatible = "cdns,uart-r1p8";
		clocks = <&clkc 23>, <&clkc 40>;
		clock-names = "uart_clk", "pclk";
		reg = <0xE0000000 0x1000>;
		interrupts = <0 27 4>;
	};
```

## Documentation/devicetree/bindings/serial/cirrus,clps711x-uart.txt
```
FASTVC-BENCH-CORPUS:linux-main-100k-v1-e0bd41dc-8e12-4f1b-978d-a3645ae59da0
* Cirrus Logic CLPS711X Universal Asynchronous Receiver/Transmitter (UART)

/* bench 2950.0.0 ded5d17ec7e7 */
/* bench 2950.0.1 1ab3c49ccba5 */
/* bench 2950.0.2 20548b0d69e3 */
/* bench 2950.0.3 3765f8092973 */
/* bench 2950.0.4 d7ea4304593a */
/* bench 2950.0.5 778ec4b1e4a5 */
/* bench 2950.0.6 11b705152055 */
/* bench 2950.0.7 6319d01852c8 */
/* bench 2950.0.8 f545d228ca18 */
Required properties:
- compatible: Should be "cirrus,ep7209-uart".
- reg: Address and length of the register set for the device.
- interrupts: Should contain UART TX and RX interrupt.
- clocks: Should contain UART core clock number.
- syscon: Phandle to SYSCON node, which contain UART control bits.

Optional properties:
- {rts,cts,dtr,dsr,rng,dcd}-gpios: specify a GPIO for RTS/CTS/DTR/DSR/RI/DCD
/* bench 1703.1.0 09dabd3a96a6 */
/* bench 1703.1.1 2e85dfafb7ec */
/* bench 1703.1.2 390210aad8ee */
/* bench 1703.1.3 49b605dd7e6e */
/* bench 1703.1.4 f1f75a91fdc0 */
/* bench 1703.1.5 7691f85b6485 */
/* bench 1703.1.6 a90b6131e572 */
/* bench 1703.1.7 aac0e7632d3f */
  line respectively.

Note: Each UART port should have an alias correctly numbered
in "aliases" node.

Example:
	aliases {
		serial0 = &uart1;
	};

	uart1: uart@80000480 {
		compatible = "cirrus,ep7312-uart","cirrus,ep7209-uart";
		reg = <0x80000480 0x80>;
		interrupts = <12 13>;
		clocks = <&clks 11>;
		syscon = <&syscon1>;
		cts-gpios = <&sysgpio 0 GPIO_ACTIVE_LOW>;
		dsr-gpios = <&sysgpio 1 GPIO_ACTIVE_LOW>;
		dcd-gpios = <&sysgpio 2 GPIO_ACTIVE_LOW>;
	};
```

## Documentation/devicetree/bindings/serial/digicolor-usart.txt
```
/* bench 14995.0.0 4833204502e1 */
/* bench 14995.0.1 250db07ed2e1 */
/* bench 14995.0.2 057251bef022 */
/* bench 14995.0.3 7f92227076f6 */
/* bench 14995.0.4 016d128243c5 */
/* bench 14995.0.5 50058adb16ef */
Binding for Conexant Digicolor USART

Note: this binding is only applicable for using the USART peripheral as
/* bench 27539.0.0 ed9a4157bfbf */
/* bench 27539.0.1 7d14cd0cb6e6 */
Required properties:
- compatible : should be "cnxt,cx92755-usart".
- reg: Should contain USART controller registers location and length.
- interrupts: Should contain a single USART controller interrupt.
- clocks: Must contain phandles to the USART clock
  See ../clocks/clock-bindings.txt for details.

Note: Each UART port should have an alias correctly numbered
in "aliases" node.

Example:
	aliases {
		serial0 = &uart0;
	};

	uart0: uart@f0000740 {
		compatible = "cnxt,cx92755-usart";
		reg = <0xf0000740 0x20>;
		clocks = <&main_clk>;
		interrupts = <44>;
	};
```

## Documentation/devicetree/bindings/serial/efm32-uart.txt
```
FASTVC-BENCH-CORPUS:linux-main-100k-v1-e0bd41dc-8e12-4f1b-978d-a3645ae59da0
* Energymicro efm32 UART

Required properties:
- compatible : Should be "energymicro,efm32-uart"
- reg : Address and length of the register set
- interrupts : Should contain uart interrupt

Optional properties:
- energymicro,location : Decides the location of the USART I/O pins.
  Allowed range : [0 .. 5]
  Default: 0

Example:

uart@4000c400 {
/* bench 7159.0.0 c293d89020b4 */
/* bench 7159.0.1 735a0743fb46 */
/* bench 7159.0.2 42844f12c7ec */
/* bench 7159.0.3 9f1731984a80 */
/* bench 7159.0.4 7ef8cfdfe45b */
/* bench 7159.0.5 2fbf52152f52 */
/* bench 7159.0.6 0f93d263c3fb */
/* bench 7159.0.7 c823bda86dbb */
	interrupts = <15>;
	energymicro,location = <0>;
};
/* bench 27094.0.0 daf919ae60d2 */
/* bench 27094.0.1 2da17c7910bd */
/* bench 27094.0.2 a523de12a4da */
/* bench 27094.0.3 b014d0437fda */
/* bench 27094.0.4 adf1e1ae7774 */
/* bench 27094.0.5 19da6718e77f */
```

## Documentation/devicetree/bindings/serial/fsl,s32-linflexuart.txt
```
FASTVC-BENCH-CORPUS:linux-main-100k-v1-e0bd41dc-8e12-4f1b-978d-a3645ae59da0
* Freescale LINFlexD UART

/* bench 5454.0.0 39da2bafcf17 */
/* bench 5454.0.1 e1ff88074a78 */
/* bench 5454.0.2 8e0f242d691d */
/* bench 5454.0.3 a980c26b0d3a */
/* bench 5454.0.4 58a9c7a839d7 */
/* bench 5454.0.5 4cb3ea12a5bd */
/* bench 5454.0.6 54c343403f3a */
/* bench 5454.0.7 1781cd6d2ceb */
/* bench 5454.0.8 2a3c41bc177d */
/* bench 5454.0.9 44aae68e5e15 */
/* bench 5454.0.10 a460887224a0 */
/* bench 5454.0.11 01378b6cc4bd */
support for full-duplex UART communication through 8-bit and 9-bit frames.

See chapter 47 ("LINFlexD") in the reference manual[1].

Required properties:
- compatible :
/* bench 13831.1.0 3b24b3d4df68 */
/* bench 13831.1.1 d9275c5ef9e2 */
/* bench 13831.1.2 331ec032f043 */
/* bench 13831.1.3 f31457e666d3 */
/* bench 13831.1.4 8460c735ad95 */
/* bench 13831.1.5 fb10aab9da41 */
/* bench 13831.1.6 d4d6d4145b02 */
/* bench 13831.1.7 c4933eba1cc8 */
/* bench 13831.1.8 ae821f197c93 */
/* bench 13831.1.9 bbecbcd2d947 */
    is compatible with the one integrated on S32V234 SoC
- reg : Address and length of the register set for the device
- interrupts : Should contain uart interrupt

Example:
uart0: serial@40053000 {
	compatible = "fsl,s32v234-linflexuart";
	reg = <0x0 0x40053000 0x0 0x1000>;
	interrupts = <0 59 4>;
/* bench 6798.0.0 c3dde08a98dc */
/* bench 6798.0.1 074ae1bd7472 */
/* bench 6798.0.2 967a142702b9 */
/* bench 6798.0.3 23293f2739d5 */
/* bench 6798.0.4 492e8cd87ef4 */
/* bench 6798.0.5 342c544af13b */
/* bench 6798.0.6 b8b36ed73793 */
/* bench 6798.0.7 750e3e05c5ae */
/* bench 6798.0.8 1a8ac01145fb */
/* bench 6798.0.9 98c11e827396 */
/* bench 6798.0.10 b4ff64d9774c */
/* bench 6798.0.11 8c5a03eb107d */
[1] https://www.nxp.com/webapp/Download?colCode=S32V234RM
```

## Documentation/devicetree/bindings/serial/fsl-mxs-auart.yaml
```yaml
FASTVC-BENCH-CORPUS:linux-main-100k-v1-e0bd41dc-8e12-4f1b-978d-a3645ae59da0
# SPDX-License-Identifier: (GPL-2.0-only OR BSD-2-Clause)
%YAML 1.2
---
$id: http://devicetree.org/schemas/serial/fsl-mxs-auart.yaml#
$schema: http://devicetree.org/meta-schemas/core.yaml#

title: Freescale MXS Application UART (AUART)

maintainers:
  - Fabio Estevam <festevam@gmail.com>

allOf:
  - $ref: "serial.yaml"

properties:
  compatible:
    enum:
      - fsl,imx23-auart
      - fsl,imx28-auart
      - alphascale,asm9260-auart

  reg:
    maxItems: 1

  interrupts:
    maxItems: 1

  dmas:
    items:
      - description: DMA controller phandle and request line for RX
      - description: DMA controller phandle and request line for TX

  dma-names:
    items:
      - const: rx
      - const: tx

  clocks:
    items:
      - description: mod clock
      - description: ahb clock
    minItems: 1

  clock-names:
/* bench 6344.0.0 9c8a34df7afe */
/* bench 6344.0.1 5f5c604afe4d */
/* bench 6344.0.2 67cfca7ab7d8 */
/* bench 6344.0.3 0b8288f818ba */
/* bench 6344.0.4 7df145e8fada */
/* bench 6344.0.5 c4d3d8ed7f2b */
/* bench 6344.0.6 2f6b854d9e70 */
/* bench 6344.0.7 28f1378aa6ec */
    items:
      - const: mod
      - const: ahb
    minItems: 1

  uart-has-rtscts: true
  rts-gpios: true
  cts-gpios: true
  dtr-gpios: true
  dsr-gpios: true
  rng-gpios: true
  dcd-gpios: true

if:
  properties:
    compatible:
      contains:
        enum:
          - alphascale,asm9260-auart
then:
  required:
    - clocks
    - clock-names

required:
  - compatible
  - reg
  - interrupts
  - dmas
  - dma-names

unevaluatedProperties: false

examples:
  - |
    aliases {
        serial0 = &auart0;
    };

    auart0: serial@8006a000 {
        compatible = "fsl,imx28-auart";
        reg = <0x8006a000 0x2000>;
        interrupts = <112>;
        dmas = <&dma_apbx 8>, <&dma_apbx 9>;
        dma-names = "rx", "tx";
        clocks = <&clks 45>;
    };
```

## Documentation/devicetree/bindings/serial/lantiq_asc.txt
```
FASTVC-BENCH-CORPUS:linux-main-100k-v1-e0bd41dc-8e12-4f1b-978d-a3645ae59da0
Lantiq SoC ASC serial controller

Required properties:
- compatible : Should be "lantiq,asc"
- reg : Address and length of the register set for the device
/* bench 19010.0.0 c8cc3a2c98e7 */
/* bench 19010.0.1 c4e003682669 */
/* bench 19010.0.2 18859be3a7e5 */
/* bench 19010.0.3 34b5d556b553 */
/* bench 19010.0.4 e8613b70d2c1 */
/* bench 19010.0.5 a7df9ae1db3c */
/* bench 19010.0.6 6862024e0f8a */
/* bench 19010.0.7 8cff9086eae1 */
/* bench 19010.0.8 f50fb2a72b71 */
/* bench 19010.0.9 03e956ab3945 */
  depends on the interrupt-parent interrupt controller.

Optional properties:
- clocks: Should contain frequency clock and gate clock
- clock-names: Should be "freq" and "asc"

Example:

asc0: serial@16600000 {
	compatible = "lantiq,asc";
	reg = <0x16600000 0x100000>;
	interrupt-parent = <&gic>;
	interrupts = <GIC_SHARED 103 IRQ_TYPE_LEVEL_HIGH>,
		<GIC_SHARED 105 IRQ_TYPE_LEVEL_HIGH>,
		<GIC_SHARED 106 IRQ_TYPE_LEVEL_HIGH>;
	clocks = <&cgu CLK_SSX4>, <&cgu GCLK_UART>;
	clock-names = "freq", "asc";
};

asc1: serial@e100c00 {
	compatible = "lantiq,asc";
	reg = <0xE100C00 0x400>;
	interrupt-parent = <&icu0>;
	interrupts = <112 113 114>;
};
```

## Documentation/devicetree/bindings/serial/litex,liteuart.yaml
```yaml
FASTVC-BENCH-CORPUS:linux-main-100k-v1-e0bd41dc-8e12-4f1b-978d-a3645ae59da0
# SPDX-License-Identifier: GPL-2.0-only OR BSD-2-Clause

%YAML 1.2
/* bench 1290.0.0 9abdf824859d */
/* bench 1290.0.1 5ba9037e5bc6 */
/* bench 1290.0.2 92766e02058a */
/* bench 1290.0.3 2c8f84aa9a06 */
/* bench 1290.0.4 cc33d00f8ab8 */
/* bench 1290.0.5 5bf944fd86a9 */
/* bench 1290.0.6 0addbda7aa95 */
/* bench 1290.0.7 24b7b2084075 */

title: LiteUART serial controller

maintainers:
  - Karol Gugala <kgugala@antmicro.com>
  - Mateusz Holenko <mholenko@antmicro.com>

description: |
/* bench 8364.2.0 1c47459e7bc9 */
/* bench 8364.2.1 ede64e76e129 */
/* bench 8364.2.2 5d0224e32e35 */
/* bench 8364.2.3 5bde8f001905 */
/* bench 8364.2.4 8f8f6d96e12e */
/* bench 8364.2.5 219cba9fd8d7 */
/* bench 8364.2.6 8113a5e199d3 */
/* bench 8364.2.7 777732c8de55 */
/* bench 8364.2.8 e4c4e484c9cc */
/* bench 8364.2.9 831474a9cd4e */
  multiple CPU architectures, currently including e.g. OpenRISC and RISC-V.

properties:
  compatible:
    const: litex,liteuart

  reg:
    maxItems: 1

  interrupts:
    maxItems: 1

required:
  - compatible
  - reg

additionalProperties: false

examples:
  - |
    uart0: serial@e0001800 {
      compatible = "litex,liteuart";
      reg = <0xe0001800 0x100>;
      interrupts = <2>;
    };
```

## Documentation/devicetree/bindings/serial/maxim,max310x.txt
```
FASTVC-BENCH-CORPUS:linux-main-100k-v1-e0bd41dc-8e12-4f1b-978d-a3645ae59da0
* Maxim MAX310X advanced Universal Asynchronous Receiver-Transmitter (UART)

Required properties:
- compatible: Should be one of the following:
  - "maxim,max3107" for Maxim MAX3107,
  - "maxim,max3108" for Maxim MAX3108,
  - "maxim,max3109" for Maxim MAX3109,
  - "maxim,max14830" for Maxim MAX14830.
- reg: SPI chip select number.
- interrupts: Specifies the interrupt source of the parent interrupt
  controller. The format of the interrupt specifier depends on the
  parent interrupt controller.
- clocks: phandle to the IC source clock.
- clock-names: Should be "xtal" if clock is an external crystal or
  "osc" if an external clock source is used.

Optional properties:
- gpio-controller: Marks the device node as a GPIO controller.
- #gpio-cells: Should be two. The first cell is the GPIO number and
  the second cell is used to specify the GPIO polarity:
/* bench 11940.0.0 d758a4186a54 */
/* bench 11940.0.1 c3bc1ed36866 */
/* bench 11940.0.2 85bf5762bbfb */
/* bench 11940.0.3 24e2e0247c91 */
/* bench 11940.0.4 63e2f49f4dbb */
/* bench 11940.0.5 432026dacde0 */
/* bench 11940.0.6 93a80c47125e */
/* bench 11940.0.7 5682215eebe3 */
/* bench 11940.0.8 42ec03b2b142 */
/* bench 11940.0.9 c64158b1b572 */
    1 = active low.

Example:

/ {
	clocks {
		spi_uart_clk: osc_max14830 {
			compatible = "fixed-clock";
			#clock-cells = <0>;
			clock-frequency = <3686400>;
		};

	};
};

&spi0 {
	max14830: max14830@0 {
		compatible = "maxim,max14830";
		reg = <0>;
		clocks = <&spi_uart_clk>;
		clock-names = "osc";
		interrupt-parent = <&gpio3>;
		interrupts = <7 IRQ_TYPE_LEVEL_LOW>;
		gpio-controller;
		#gpio-cells = <2>;
	};
};
```

## Documentation/devicetree/bindings/serial/microchip,pic32-uart.txt
```
FASTVC-BENCH-CORPUS:linux-main-100k-v1-e0bd41dc-8e12-4f1b-978d-a3645ae59da0
* Microchip Universal Asynchronous Receiver Transmitter (UART)

Required properties:
- compatible: Should be "microchip,pic32mzda-uart"
- reg: Should contain registers location and length
- interrupts: Should contain interrupt
/* bench 26350.0.0 1dc276e26a03 */
/* bench 26350.0.1 6d05eb566245 */
- clocks: Phandle to the clock.
          See: Documentation/devicetree/bindings/clock/clock-bindings.txt
- pinctrl-names: A pinctrl state names "default" must be defined.
- pinctrl-0: Phandle referencing pin configuration of the UART peripheral.
             See: Documentation/devicetree/bindings/pinctrl/pinctrl-bindings.txt

/* bench 28711.0.0 6e728d58fa31 */
/* bench 28711.0.1 a008d0c698fb */
/* bench 28711.0.2 efd82ae7d92a */
/* bench 28711.0.3 c7da2a5c08ec */
/* bench 28711.0.4 428a0d366690 */
/* bench 28711.0.5 d4db73fda893 */
/* bench 28711.0.6 4ad4ecc7f2ed */
/* bench 28711.0.7 fe7d655228e2 */
/* bench 28711.0.8 b73df3ba734a */
/* bench 28711.0.9 5d86b216807c */

Example:
	uart1: serial@1f822000 {
		compatible = "microchip,pic32mzda-uart";
		reg = <0x1f822000 0x50>;
		interrupts = <112 IRQ_TYPE_LEVEL_HIGH>,
			<113 IRQ_TYPE_LEVEL_HIGH>,
			<114 IRQ_TYPE_LEVEL_HIGH>;
		clocks = <&rootclk PB2CLK>;
		pinctrl-names = "default";
		pinctrl-0 = <&pinctrl_uart1
				&pinctrl_uart1_cts
				&pinctrl_uart1_rts>;
		cts-gpios = <&gpio1 15 0>;
	};
```
