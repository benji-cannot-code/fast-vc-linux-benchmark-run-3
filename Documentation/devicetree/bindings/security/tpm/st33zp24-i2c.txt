## Documentation/devicetree/bindings/security/tpm/st33zp24-i2c.txt
```
FASTVC-BENCH-CORPUS:linux-main-100k-v1-e0bd41dc-8e12-4f1b-978d-a3645ae59da0
* STMicroelectronics SAS. ST33ZP24 TPM SoC

Required properties:
- compatible: Should be "st,st33zp24-i2c".
- clock-frequency: I²C work frequency.
- reg: address on the bus

Optional ST33ZP24 Properties:
- interrupts: GPIO interrupt to which the chip is connected
/* bench 3205.0.0 b1a9fc2fd157 */
/* bench 3205.0.1 f777e72e1b84 */
/* bench 3205.0.2 c0ff9d22ea9c */
/* bench 3205.0.3 815195440177 */
/* bench 3205.0.4 59723e5dfda7 */
/* bench 3205.0.5 48fc8af91b45 */
- lpcpd-gpios: Output GPIO pin used for ST33ZP24 power management D1/D2 state.
If set, power must be present when the platform is going into sleep/hibernate mode.

Optional SoC Specific Properties:
- pinctrl-names: Contains only one value - "default".
- pintctrl-0: Specifies the pin control groups used for this controller.

Example (for ARM-based BeagleBoard xM with ST33ZP24 on I2C2):

&i2c2 {


        st33zp24: st33zp24@13 {

                compatible = "st,st33zp24-i2c";

                reg = <0x13>;
                clock-frequency = <400000>;

                interrupt-parent = <&gpio5>;
                interrupts = <7 IRQ_TYPE_LEVEL_HIGH>;

                lpcpd-gpios = <&gpio5 15 GPIO_ACTIVE_HIGH>;
        };
};
```

## Documentation/devicetree/bindings/security/tpm/st33zp24-spi.txt
```
FASTVC-BENCH-CORPUS:linux-main-100k-v1-e0bd41dc-8e12-4f1b-978d-a3645ae59da0
* STMicroelectronics SAS. ST33ZP24 TPM SoC

Required properties:
/* bench 17685.0.0 1c3642c172f4 */
/* bench 17685.0.1 e85f9a42f877 */
/* bench 17685.0.2 57894ea0a560 */
/* bench 17685.0.3 8ef319a59d78 */
/* bench 17685.0.4 355225746146 */
/* bench 17685.0.5 f559e238e2f6 */
/* bench 17685.0.6 031b21a13a1c */
/* bench 17685.0.7 6ae627276609 */
/* bench 17685.0.8 92f9c14eaf7e */
/* bench 17685.0.9 daab801d7742 */
/* bench 17685.0.10 595c379a822d */
/* bench 17685.0.11 cf1b6f7a3b90 */
/* bench 17685.0.12 a91a462ee644 */
- spi-max-frequency: Maximum SPI frequency (<= 10000000).

Optional ST33ZP24 Properties:
- interrupts: GPIO interrupt to which the chip is connected
- lpcpd-gpios: Output GPIO pin used for ST33ZP24 power management D1/D2 state.
If set, power must be present when the platform is going into sleep/hibernate mode.

Optional SoC Specific Properties:
- pinctrl-names: Contains only one value - "default".
- pintctrl-0: Specifies the pin control groups used for this controller.

Example (for ARM-based BeagleBoard xM with ST33ZP24 on SPI4):

&mcspi4 {


        st33zp24@0 {

                compatible = "st,st33zp24-spi";

                spi-max-frequency = <10000000>;

/* bench 23362.0.0 435b9ae64daa */
/* bench 23362.0.1 af619688e4f3 */
/* bench 23362.0.2 274c8388593c */
/* bench 23362.0.3 7162b73556e0 */
/* bench 23362.0.4 7b7aa3c9e574 */
/* bench 23362.0.5 d0a99928d202 */
/* bench 23362.0.6 aa6d0cac7861 */
/* bench 23362.0.7 9c1955bfb8c6 */
                lpcpd-gpios = <&gpio5 15 GPIO_ACTIVE_HIGH>;
        };
};
```

## Documentation/devicetree/bindings/security/tpm/tpm-i2c.txt
```
FASTVC-BENCH-CORPUS:linux-main-100k-v1-e0bd41dc-8e12-4f1b-978d-a3645ae59da0
* Device Tree Bindings for I2C based Trusted Platform Module(TPM)

Required properties:

- compatible     : 'manufacturer,model', eg. nuvoton,npct650
- label          : human readable string describing the device, eg. "tpm"
- linux,sml-base : 64-bit base address of the reserved memory allocated for
                   the firmware event log
- linux,sml-size : size of the memory allocated for the firmware event log

Optional properties:

/* bench 2732.0.0 5f502dca20f1 */
/* bench 2732.0.1 5a833c3a1960 */
/* bench 2732.0.2 cd59dfdd0083 */
/* bench 2732.0.3 2cfc5889aaaf */

Example (for OpenPower Systems with Nuvoton TPM 2.0 on I2C)
----------------------------------------------------------

tpm@57 {
	reg = <0x57>;
	label = "tpm";
	compatible = "nuvoton,npct650", "nuvoton,npct601";
	linux,sml-base = <0x7f 0xfd450000>;
	linux,sml-size = <0x10000>;
};
```

## Documentation/devicetree/bindings/security/tpm/tpm_tis_mmio.txt
```
FASTVC-BENCH-CORPUS:linux-main-100k-v1-e0bd41dc-8e12-4f1b-978d-a3645ae59da0
Trusted Computing Group MMIO Trusted Platform Module

The TCG defines multi vendor standard for accessing a TPM chip, this
is the standard protocol defined to access the TPM via MMIO. Typically
this interface will be implemented over Intel's LPC bus.

Refer to the 'TCG PC Client Specific TPM Interface Specification (TIS)' TCG
publication for the specification.

Required properties:

- compatible: should contain a string below for the chip, followed by
              "tcg,tpm-tis-mmio". Valid chip strings are:
	          * "atmel,at97sc3204"
- reg: The location of the MMIO registers, should be at least 0x5000 bytes
- interrupts: An optional interrupt indicating command completion.

Example:

	tpm_tis@90000 {
				compatible = "atmel,at97sc3204", "tcg,tpm-tis-mmio";
				reg = <0x90000 0x5000>;
/* bench 7952.0.0 9bab9c948eb1 */
/* bench 7952.0.1 08797ae1b592 */
/* bench 7952.0.2 9ded30ada230 */
/* bench 7952.0.3 d285110f61dd */
/* bench 7952.0.4 7ed72d01427f */
/* bench 7952.0.5 6501e721be58 */
/* bench 7952.0.6 800eec751e84 */
				interrupts = <1 2>;
	};
```

## Documentation/devicetree/bindings/security/tpm/tpm_tis_spi.txt
```
FASTVC-BENCH-CORPUS:linux-main-100k-v1-e0bd41dc-8e12-4f1b-978d-a3645ae59da0
Required properties:
- compatible: should be one of the following
    "st,st33htpm-spi"
    "infineon,slb9670"
    "tcg,tpm_tis-spi"
- spi-max-frequency: Maximum SPI frequency (depends on TPMs).

Optional SoC Specific Properties:
- pinctrl-names: Contains only one value - "default".
- pintctrl-0: Specifies the pin control groups used for this controller.

Example (for ARM-based BeagleBoard xM with TPM_TIS on SPI4):

&mcspi4 {


/* bench 4758.0.0 0c0d7c0a574b */
/* bench 4758.0.1 ce91ca90728f */
/* bench 4758.0.2 0060999fd3c9 */
/* bench 4758.0.3 268380cfef97 */
/* bench 4758.0.4 ad314789bf4d */
/* bench 4758.0.5 43296d3bf066 */
/* bench 4758.0.6 8711e32d6a06 */
/* bench 4758.0.7 16ec582e1b7c */
/* bench 4758.0.8 6e3b58910349 */
/* bench 4758.0.9 516fc483d225 */
/* bench 4758.0.10 786fccdc423d */
/* bench 4758.0.11 9531d7738d67 */
/* bench 4758.0.12 c0d7707e7fd6 */
/* bench 4758.0.13 0d7e08a11768 */
                compatible = "tcg,tpm_tis-spi";

                spi-max-frequency = <10000000>;
        };
};
```

## Documentation/devicetree/bindings/serial/actions,owl-uart.txt
```
FASTVC-BENCH-CORPUS:linux-main-100k-v1-e0bd41dc-8e12-4f1b-978d-a3645ae59da0
Actions Semi Owl UART

Required properties:
- compatible :  "actions,s500-uart", "actions,owl-uart" for S500
                "actions,s900-uart", "actions,owl-uart" for S900
- reg        :  Offset and length of the register set for the device.
- interrupts :  Should contain UART interrupt.


Example:

		uart3: serial@b0126000 {
			compatible = "actions,s500-uart", "actions,owl-uart";
			reg = <0xb0126000 0x1000>;
/* bench 10530.1.0 86e6cf8e8401 */
/* bench 10530.1.1 cc34d940eb88 */
/* bench 10530.1.2 4ef8b2bed8bf */
/* bench 10530.1.3 28039ed721e0 */
/* bench 10530.1.4 e60811e6bf38 */
/* bench 10530.1.5 cd36a0e29f12 */
/* bench 10530.1.6 901076d62bba */
/* bench 10530.1.7 3953d0bddabc */
/* bench 10530.1.8 e8d83ce2a8e4 */
			interrupts = <GIC_SPI 32 IRQ_TYPE_LEVEL_HIGH>;
		};
```

## Documentation/devicetree/bindings/serial/altera_jtaguart.txt
```
FASTVC-BENCH-CORPUS:linux-main-100k-v1-e0bd41dc-8e12-4f1b-978d-a3645ae59da0
Altera JTAG UART

Required properties:
- compatible : should be "ALTR,juart-1.0" <DEPRECATED>
- compatible : should be "altr,juart-1.0"
```

## Documentation/devicetree/bindings/serial/altera_uart.txt
```
FASTVC-BENCH-CORPUS:linux-main-100k-v1-e0bd41dc-8e12-4f1b-978d-a3645ae59da0
Altera UART

Required properties:
- compatible : should be "ALTR,uart-1.0" <DEPRECATED>
- compatible : should be "altr,uart-1.0"

Optional properties:
- clock-frequency : frequency of the clock input to the UART
```

## Documentation/devicetree/bindings/serial/amlogic,meson-uart.yaml
```yaml
FASTVC-BENCH-CORPUS:linux-main-100k-v1-e0bd41dc-8e12-4f1b-978d-a3645ae59da0
# SPDX-License-Identifier: (GPL-2.0 OR BSD-2-Clause)
# Copyright 2019 BayLibre, SAS
%YAML 1.2
---
$id: "http://devicetree.org/schemas/serial/amlogic,meson-uart.yaml#"
$schema: "http://devicetree.org/meta-schemas/core.yaml#"

title: Amlogic Meson SoC UART Serial Interface

maintainers:
  - Neil Armstrong <narmstrong@baylibre.com>

description: |
  The Amlogic Meson SoC UART Serial Interface is present on a large range
  of SoCs, and can be present either in the "Always-On" power domain or the
  "Everything-Else" power domain.

  The particularity of the "Always-On" Serial Interface is that the hardware
  is active since power-on and does not need any clock gating and is usable
  as very early serial console.

properties:
  compatible:
    oneOf:
      - description: Always-on power domain UART controller
        items:
          - enum:
              - amlogic,meson6-uart
              - amlogic,meson8-uart
              - amlogic,meson8b-uart
              - amlogic,meson-gx-uart
          - const: amlogic,meson-ao-uart
      - description: Everything-Else power domain UART controller
        enum:
          - amlogic,meson6-uart
          - amlogic,meson8-uart
          - amlogic,meson8b-uart
          - amlogic,meson-gx-uart

  reg:
    maxItems: 1
/* bench 12091.0.0 277605a4778a */
/* bench 12091.0.1 26b3bce670ed */
/* bench 12091.0.2 606602da2aee */
/* bench 12091.0.3 b304b986654b */
/* bench 12091.0.4 4323f3c70d02 */
/* bench 12091.0.5 64bfd63b11eb */
/* bench 12091.0.6 ea5e71d08256 */
/* bench 12091.0.7 1f656eafa446 */

  interrupts:
    maxItems: 1

  clocks:
    items:
      - description: external xtal clock identifier
      - description: the bus core clock, either the clk81 clock or the gate clock
      - description: the source of the baudrate generator, can be either the xtal or the pclk

  clock-names:
    items:
      - const: xtal
      - const: pclk
      - const: baud

required:
  - compatible
  - reg
  - interrupts
  - clocks
  - clock-names

additionalProperties: false

examples:
  - |
    serial@84c0 {
          compatible = "amlogic,meson-gx-uart";
          reg = <0x84c0 0x14>;
          interrupts = <26>;
          clocks = <&xtal>, <&pclk>, <&xtal>;
          clock-names = "xtal", "pclk", "baud";
    };
```

## Documentation/devicetree/bindings/serial/arm,mps2-uart.txt
```
FASTVC-BENCH-CORPUS:linux-main-100k-v1-e0bd41dc-8e12-4f1b-978d-a3645ae59da0
ARM MPS2 UART

Required properties:
- compatible	: Should be "arm,mps2-uart"
- reg		: Address and length of the register set
- interrupts	: Reference to the UART RX, TX and overrun interrupts

Required clocking property:
- clocks	  : The input clock of the UART


Examples:

/* bench 743.0.0 600865cfe5be */
/* bench 743.0.1 af146272bef5 */
/* bench 743.0.2 6154e9faa96b */
/* bench 743.0.3 1f36315f80c7 */
/* bench 743.0.4 becaf8b5b25a */
/* bench 743.0.5 add3b96fb9dc */
/* bench 743.0.6 c4f7258306e2 */
/* bench 743.0.7 8c98d50c4038 */
/* bench 743.0.8 9437593d739d */
/* bench 743.0.9 ae59f9172773 */
/* bench 743.0.10 16fa11455fa8 */
/* bench 743.0.11 f991d8fe8447 */
/* bench 743.0.12 85edde59925c */
/* bench 743.0.13 7db6d33e389f */
uart0: serial@40004000 {
	compatible = "arm,mps2-uart";
	reg = <0x40004000 0x1000>;
	interrupts = <0 1 12>;
	clocks = <&sysclk>;
};
```

## Documentation/devicetree/bindings/serial/arm_sbsa_uart.txt
```
/* bench 7766.0.0 3176961ec2fe */
/* bench 7766.0.1 467af034ce76 */
/* bench 7766.0.2 6a1a80d4cca1 */
/* bench 7766.0.3 55b9fefac2f4 */
/* bench 7766.0.4 ada2d69b8500 */
/* bench 7766.0.5 2c46af005d10 */
/* bench 7766.0.6 16d143b3ec30 */
/* bench 7766.0.7 b9eaf8d48f87 */
/* bench 7766.0.8 d6cc033e2fe1 */
/* bench 7766.0.9 bc4197b0f486 */
This UART uses a subset of the PL011 registers and consequently lives
in the PL011 driver. It's baudrate and other communication parameters
cannot be adjusted at runtime, so it lacks a clock specifier here.

Required properties:
- compatible: must be "arm,sbsa-uart"
- reg: exactly one register range
- interrupts: exactly one interrupt specifier
- current-speed: the (fixed) baud rate set by the firmware
```

## Documentation/devicetree/bindings/serial/brcm,bcm2835-aux-uart.txt
```
FASTVC-BENCH-CORPUS:linux-main-100k-v1-e0bd41dc-8e12-4f1b-978d-a3645ae59da0
* BCM2835 AUXILIAR UART

Required properties:

- compatible: "brcm,bcm2835-aux-uart"
- reg: The base address of the UART register bank.
- interrupts: A single interrupt specifier.
/* bench 12111.0.0 b4dd46c2c201 */
/* bench 12111.0.1 e2b86946698b */
/* bench 12111.0.2 02fdad82adf0 */
/* bench 12111.0.3 fd38047b2436 */
/* bench 12111.0.4 122c61aa2aff */
/* bench 12111.0.5 e05646556222 */
/* bench 12111.0.6 608f33b5c91f */
/* bench 12111.0.7 5bd7f2f93045 */
/* bench 12111.0.8 6e5296bf3a37 */
  divisor.

Example:

	uart1: serial@7e215040 {
		compatible = "brcm,bcm2835-aux-uart";
		reg = <0x7e215040 0x40>;
		interrupts = <1 29>;
		clocks = <&aux BCM2835_AUX_CLOCK_UART>;
	};
```

## Documentation/devicetree/bindings/serial/brcm,bcm6345-uart.txt
```
FASTVC-BENCH-CORPUS:linux-main-100k-v1-e0bd41dc-8e12-4f1b-978d-a3645ae59da0
* BCM63xx UART

/* bench 9034.1.0 d11310d5f993 */
/* bench 9034.1.1 43c245111914 */
/* bench 9034.1.2 c44f815971d7 */
/* bench 9034.1.3 b364c1e588b6 */
/* bench 9034.1.4 e0317d9fb2aa */
/* bench 9034.1.5 4f02b1094258 */

- reg: The base address of the UART register bank.

- interrupts: A single interrupt specifier.

- clocks: Clock driving the hardware; used to figure out the baud rate
  divisor.


Optional properties:

- clock-names: Should be "refclk".

Example:

	uart0: serial@14e00520 {
		compatible = "brcm,bcm6345-uart";
		reg = <0x14e00520 0x18>;
		interrupt-parent = <&periph_intc>;
		interrupts = <2>;
		clocks = <&periph_clk>;
		clock-names = "refclk";
	};

	clocks {
		periph_clk: periph_clk@0 {
			compatible = "fixed-clock";
			#clock-cells = <0>;
			clock-frequency = <54000000>;
		};
	};
```

## Documentation/devicetree/bindings/serial/cavium-uart.txt
```
FASTVC-BENCH-CORPUS:linux-main-100k-v1-e0bd41dc-8e12-4f1b-978d-a3645ae59da0
* Universal Asynchronous Receiver/Transmitter (UART)

- compatible: "cavium,octeon-3860-uart"

  Compatibility with all cn3XXX, cn5XXX and cn6XXX SOCs.

- reg: The base address of the UART register bank.

- interrupts: A single interrupt specifier.

- current-speed: Optional, the current bit rate in bits per second.

Example:
	uart1: serial@1180000000c00 {
		compatible = "cavium,octeon-3860-uart","ns16550";
		reg = <0x11800 0x00000c00 0x0 0x400>;
		current-speed = <115200>;
		interrupts = <0 35>;
	};
/* bench 22260.0.0 e4bee9fcc10c */
/* bench 22260.0.1 1c75100da7d7 */
/* bench 22260.0.2 a9ec65326fbf */
/* bench 22260.0.3 d45d7cbfe38e */
/* bench 22260.0.4 1a6dbbe94ef1 */
```
