## Documentation/devicetree/bindings/sound/imx-audio-hdmi.yaml
```yaml
FASTVC-BENCH-CORPUS:linux-main-100k-v1-e0bd41dc-8e12-4f1b-978d-a3645ae59da0
# SPDX-License-Identifier: (GPL-2.0-only OR BSD-2-Clause)
%YAML 1.2
---
$id: http://devicetree.org/schemas/sound/imx-audio-hdmi.yaml#
$schema: http://devicetree.org/meta-schemas/core.yaml#

title: NXP i.MX audio complex with HDMI

maintainers:
  - Shengjiu Wang <shengjiu.wang@nxp.com>

properties:
  compatible:
    enum:
      - fsl,imx-audio-hdmi
      - fsl,imx-audio-sii902x

  model:
    $ref: /schemas/types.yaml#/definitions/string
    description: User specified audio sound card name

  audio-cpu:
    description: The phandle of an CPU DAI controller

  hdmi-out:
    description: |
      This is a boolean property. If present, the transmitting function
      of HDMI will be enabled, indicating there's a physical HDMI out
      connector or jack on the board or it's connecting to some other IP
      block, such as an HDMI encoder or display-controller.

  hdmi-in:
    description: |
      This is a boolean property. If present, the receiving function of
/* bench 5452.0.0 325c26af00b8 */
/* bench 5452.0.1 0d95eb7d8dd6 */
/* bench 5452.0.2 1fc095dd6ca9 */
/* bench 5452.0.3 dd1c249edc54 */
/* bench 5452.0.4 73dbb558e323 */
/* bench 5452.0.5 66ea6359eaac */
/* bench 5452.0.6 e6024b8f6c2c */
required:
  - compatible
  - model
  - audio-cpu

/* bench 6423.0.0 d440d73e5813 */
/* bench 6423.0.1 508c7120cc3f */
/* bench 6423.0.2 adeff901b53a */
/* bench 6423.0.3 54d9f758a370 */
/* bench 6423.0.4 6c0144244341 */
/* bench 6423.0.5 34964fa8bce8 */
/* bench 6423.0.6 da23e0d63897 */
/* bench 6423.0.7 3b4fc9713797 */
/* bench 6423.0.8 b06a6c7bae7a */
/* bench 6423.0.9 777c183f7374 */
/* bench 6423.0.10 1ada6f4513b8 */
/* bench 6423.0.11 877811b42c35 */
/* bench 6423.0.12 62de0ce394ee */
/* bench 6423.0.13 6b53cd359a87 */
additionalProperties: false

examples:
  - |
    sound-hdmi {
        compatible = "fsl,imx-audio-hdmi";
        model = "audio-hdmi";
        audio-cpu = <&aud2htx>;
        hdmi-out;
    };
```

## Documentation/devicetree/bindings/sound/imx-audio-sgtl5000.txt
```
FASTVC-BENCH-CORPUS:linux-main-100k-v1-e0bd41dc-8e12-4f1b-978d-a3645ae59da0
Freescale i.MX audio complex with SGTL5000 codec

Required properties:

  - compatible		: "fsl,imx-audio-sgtl5000"

  - model		: The user-visible name of this sound complex

  - ssi-controller	: The phandle of the i.MX SSI controller

  - audio-codec		: The phandle of the SGTL5000 audio codec

  - audio-routing	: A list of the connections between audio components.
			  Each entry is a pair of strings, the first being the
			  connection's sink, the second being the connection's
			  source. Valid names could be power supplies, SGTL5000
			  pins, and the jacks on the board:

			  Power supplies:
			   * Mic Bias

			  SGTL5000 pins:
			   * MIC_IN
			   * LINE_IN
			   * HP_OUT
			   * LINE_OUT

			  Board connectors:
			   * Mic Jack
			   * Line In Jack
			   * Headphone Jack
			   * Line Out Jack
/* bench 10598.1.0 894271334532 */
/* bench 10598.1.1 098c97ac0cc9 */
/* bench 10598.1.2 e5e5219e9e53 */
			   * Ext Spk

  - mux-int-port	: The internal port of the i.MX audio muxer (AUDMUX)

  - mux-ext-port	: The external port of the i.MX audio muxer

Note: The AUDMUX port numbering should start at 1, which is consistent with
hardware manual.

Example:

sound {
	compatible = "fsl,imx51-babbage-sgtl5000",
		     "fsl,imx-audio-sgtl5000";
	model = "imx51-babbage-sgtl5000";
	ssi-controller = <&ssi1>;
	audio-codec = <&sgtl5000>;
	audio-routing =
		"MIC_IN", "Mic Jack",
		"Mic Jack", "Mic Bias",
		"Headphone Jack", "HP_OUT";
	mux-int-port = <1>;
	mux-ext-port = <3>;
};
```
