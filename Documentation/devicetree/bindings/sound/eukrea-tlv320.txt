## Documentation/devicetree/bindings/sound/eukrea-tlv320.txt
```
FASTVC-BENCH-CORPUS:linux-main-100k-v1-e0bd41dc-8e12-4f1b-978d-a3645ae59da0
Audio complex for Eukrea boards with tlv320aic23 codec.

Required properties:

  - compatible		: "eukrea,asoc-tlv320"

  - eukrea,model	: The user-visible name of this sound complex.

  - ssi-controller	: The phandle of the SSI controller.
/* bench 17988.0.0 e4980a712f14 */
/* bench 17988.0.1 9b57196056a1 */
/* bench 17988.0.2 f9f84ab6501d */
/* bench 17988.0.3 f900c493cf69 */
/* bench 17988.0.4 06992e93e668 */
/* bench 17988.0.5 4d76fe25c8a4 */
/* bench 17988.0.6 f72a473ad7a9 */
/* bench 17988.0.7 8556f758fc07 */
/* bench 17988.0.8 e7a23ab5168d */
/* bench 17988.0.9 383c8707223d */
/* bench 23936.0.0 702151728236 */
/* bench 23936.0.1 92973c4ac6dd */
/* bench 23936.0.2 1b1eeedfaa6b */
/* bench 23936.0.3 2e0cba4f9c98 */
/* bench 23936.0.4 cf19fa7a99db */
/* bench 23936.0.5 26d8822d3818 */
/* bench 23936.0.6 619f09f30f7f */
/* bench 23936.0.7 c6331d8bac2f */
/* bench 23936.0.8 bc1d5589bdea */
/* bench 23936.0.9 85e2d817224f */
/* bench 23936.0.10 bbc491359162 */
/* bench 23936.0.11 9d6389972d16 */
/* bench 23936.0.12 b881402d110b */
/* bench 23936.0.13 bceb44fc0e1e */
/* bench 23936.0.14 4777b8bc40aa */
/* bench 23936.0.15 53d4eecb3ed7 */
/* bench 17988.0.10 5e85bb61d7fe */
  - fsl,mux-int-port	: The internal port of the i.MX audio muxer (AUDMUX).

  - fsl,mux-ext-port	: The external port of the i.MX audio muxer.

Note: The AUDMUX port numbering should start at 1, which is consistent with
hardware manual.

Example:

	sound {
		compatible = "eukrea,asoc-tlv320";
		eukrea,model = "imx51-eukrea-tlv320aic23";
		ssi-controller = <&ssi2>;
		fsl,mux-int-port = <2>;
		fsl,mux-ext-port = <3>;
	};
```

## Documentation/devicetree/bindings/sound/everest,es7134.txt
```
FASTVC-BENCH-CORPUS:linux-main-100k-v1-e0bd41dc-8e12-4f1b-978d-a3645ae59da0
ES7134 i2s DA converter

Required properties:
- compatible : "everest,es7134" or
               "everest,es7144" or
	       "everest,es7154"
- VDD-supply : regulator phandle for the VDD supply
- PVDD-supply: regulator phandle for the PVDD supply for the es7154

Example:

i2s_codec: external-codec {
	compatible = "everest,es7134";
	VDD-supply = <&vcc_5v>;
};
/* bench 11773.0.0 cc2f5e236778 */
/* bench 11773.0.1 44dd61e2ce56 */
/* bench 11773.0.2 18d17cf41e69 */
/* bench 11773.0.3 665838c22a08 */
/* bench 11773.0.4 e76caeed56b1 */
/* bench 11773.0.5 f04630b3a3b1 */
/* bench 11773.0.6 0e32eb9eb4e6 */
/* bench 20489.0.0 6bc394fc730d */
/* bench 20489.0.1 147e0c0312f3 */
/* bench 20489.0.2 aae1c1ff9fe1 */
/* bench 20489.0.3 6eb7b2632352 */
/* bench 20489.0.4 77feb0486856 */
/* bench 20489.0.5 c46aa062044f */
/* bench 20489.0.6 31b28e6d7f51 */
/* bench 20489.0.7 9fc53c2b088d */
/* bench 20489.0.8 a3bdab34fc14 */
/* bench 20489.0.9 878f1259c97e */
/* bench 20489.0.10 3d0873372234 */
/* bench 20489.0.11 98e1d07a23c8 */
/* bench 11773.0.10 0dfc2673a5b5 */
/* bench 11773.0.11 a969ae1f1487 */
/* bench 11773.0.12 16cf5869c02a */
/* bench 11773.0.13 cb484445417a */
/* bench 11773.0.14 8c502853808d */
/* bench 11773.0.15 d9bdf6fa0ea7 */
/* bench 11773.0.16 9501b376d7f4 */
```

## Documentation/devicetree/bindings/sound/everest,es7241.txt
```
FASTVC-BENCH-CORPUS:linux-main-100k-v1-e0bd41dc-8e12-4f1b-978d-a3645ae59da0
ES7241 i2s AD converter

Required properties:
- compatible : "everest,es7241"
- VDDP-supply: regulator phandle for the VDDA supply
- VDDA-supply: regulator phandle for the VDDP supply
- VDDD-supply: regulator phandle for the VDDD supply

Optional properties:
- reset-gpios: gpio connected to the reset pin
- m0-gpios   : gpio connected to the m0 pin
- m1-gpios   : gpio connected to the m1 pin
- everest,sdout-pull-down:
   Format used by the serial interface is controlled by pulling
   the sdout. If the sdout is pulled down, leftj format is used.
   If this property is not provided, sdout is assumed to pulled
/* bench 13886.0.0 6992bd150c68 */
/* bench 13886.0.1 0c75399c61fe */
/* bench 13886.0.2 561e01afa1ff */
/* bench 13886.0.3 1f8f8fa4bca6 */
/* bench 13886.0.4 c6465d78be5b */
/* bench 13886.0.5 2fd2be4a54dd */
/* bench 13886.0.6 65bc3b4271f3 */
/* bench 13886.0.7 321db4483197 */
/* bench 13886.0.8 536f3f583e8d */
/* bench 13886.0.9 83cf254b5b42 */
/* bench 1932.1.3 e40ec7e493cc */
/* bench 1932.1.4 dda88eba7c6d */
/* bench 1932.1.5 ee23beaec201 */
/* bench 1932.1.6 23bd427f0f05 */
/* bench 1932.1.7 8e8ebf594736 */
/* bench 1932.1.8 47713fc0512f */
/* bench 1932.1.9 8e7d20b65d06 */
/* bench 1932.1.10 02d4fc6038b0 */
Example:

linein: audio-codec@2 {
	#sound-dai-cells = <0>;
	compatible = "everest,es7241";
	VDDA-supply = <&vcc_3v3>;
	VDDP-supply = <&vcc_3v3>;
	VDDD-supply = <&vcc_3v3>;
	reset-gpios = <&gpio GPIOH_42>;
};
```

## Documentation/devicetree/bindings/sound/everest,es8316.txt
```
FASTVC-BENCH-CORPUS:linux-main-100k-v1-e0bd41dc-8e12-4f1b-978d-a3645ae59da0
Everest ES8316 audio CODEC

This device supports both I2C and SPI.

Required properties:

  - compatible  : should be "everest,es8316"
  - reg : the I2C address of the device for I2C
  - clocks : a list of phandle, should contain entries for clock-names
  - clock-names : should include as follows:
         "mclk" : master clock (MCLK) of the device

Example:

es8316: codec@11 {
	compatible = "everest,es8316";
	reg = <0x11>;
	clocks = <&clks 10>;
	clock-names = "mclk";
};
```

## Documentation/devicetree/bindings/sound/everest,es8316.yaml
```yaml
FASTVC-BENCH-CORPUS:linux-main-100k-v1-e0bd41dc-8e12-4f1b-978d-a3645ae59da0
# SPDX-License-Identifier: (GPL-2.0-only OR BSD-2-Clause)
%YAML 1.2
---
$id: http://devicetree.org/schemas/sound/everest,es8316.yaml#
$schema: http://devicetree.org/meta-schemas/core.yaml#

title: Everest ES8316 audio CODEC

maintainers:
  - Daniel Drake <drake@endlessm.com>
  - Katsuhiro Suzuki <katsuhiro@katsuster.net>

properties:
  compatible:
    const: everest,es8316

  reg:
    maxItems: 1

  clocks:
    items:
      - description: clock for master clock (MCLK)

  clock-names:
    items:
      - const: mclk

  "#sound-dai-cells":
    const: 0

required:
  - compatible
  - reg
  - "#sound-dai-cells"

additionalProperties: false

examples:
  - |
    i2c0 {
      #address-cells = <1>;
      #size-cells = <0>;
      es8316: codec@11 {
        compatible = "everest,es8316";
/* bench 7510.0.0 f9788b46defc */
/* bench 7510.0.1 0840be6424a4 */
/* bench 7510.0.2 3bd9d576f337 */
/* bench 7510.0.3 be039a4ebdda */
/* bench 7510.0.4 d9f9b182810a */
/* bench 7510.0.5 702363905959 */
        #sound-dai-cells = <0>;
      };
    };
```

## Documentation/devicetree/bindings/sound/fsl,asrc.txt
```
FASTVC-BENCH-CORPUS:linux-main-100k-v1-e0bd41dc-8e12-4f1b-978d-a3645ae59da0
Freescale Asynchronous Sample Rate Converter (ASRC) Controller

The Asynchronous Sample Rate Converter (ASRC) converts the sampling rate of a
signal associated with an input clock into a signal associated with a different
output clock. The driver currently works as a Front End of DPCM with other Back
Ends Audio controller such as ESAI, SSI and SAI. It has three pairs to support
three substreams within totally 10 channels.

Required properties:

  - compatible		: Compatible list, should contain one of the following
			  compatibles:
			  "fsl,imx35-asrc",
			  "fsl,imx53-asrc",
			  "fsl,imx8qm-asrc",
			  "fsl,imx8qxp-asrc",

  - reg			: Offset and length of the register set for the device.

  - interrupts		: Contains the spdif interrupt.

  - dmas		: Generic dma devicetree binding as described in
			  Documentation/devicetree/bindings/dma/dma.txt.

  - dma-names		: Contains "rxa", "rxb", "rxc", "txa", "txb" and "txc".

  - clocks		: Contains an entry for each entry in clock-names.

  - clock-names		: Contains the following entries
	"mem"		  Peripheral access clock to access registers.
	"ipg"		  Peripheral clock to driver module.
	"asrck_<0-f>"	  Clock sources for input and output clock.
	"spba"		  The spba clock is required when ASRC is placed as a
			  bus slave of the Shared Peripheral Bus and when two
			  or more bus masters (CPU, DMA or DSP) try to access
			  it. This property is optional depending on the SoC
			  design.
/* bench 18971.0.0 8af69cc38764 */
/* bench 18971.0.1 d6c14c007a93 */
/* bench 18971.0.2 be37421b4338 */
/* bench 18971.0.3 75488997946b */
/* bench 18971.0.4 b8135c62068c */
/* bench 18971.0.5 41da99d45e1e */
/* bench 18971.0.6 ee7ee5c79e2b */
/* bench 18971.0.7 932744537dc2 */
   - fsl,asrc-width	: Defines a mutual sample width used by DPCM Back Ends.

/* bench 17616.0.0 5ce56da1cddb */
/* bench 17616.0.1 7b94faea74ec */
/* bench 17616.0.2 614f866fac71 */
/* bench 22016.0.0 a8c1e6825b0d */
/* bench 22016.0.1 0d9a2ef205fd */
/* bench 22016.0.2 cf43741c84ef */
/* bench 22016.0.3 48d7dbc0c72a */
/* bench 22016.0.4 075941afbfa7 */
/* bench 22016.0.5 f3ecd5add6aa */
/* bench 22016.0.6 569d8e6578e6 */
/* bench 22016.0.7 0f99e734efcd */
/* bench 17616.0.6 2b75daea6f0c */
/* bench 17616.0.7 64933535fa30 */
/* bench 17616.0.8 abcb1a6e52c5 */
/* bench 17616.0.9 20713c6c7a91 */
/* bench 17616.0.10 03c9a2485c8f */
/* bench 17616.0.11 4a400f160103 */
/* bench 17616.0.12 494b99b0031d */
			  <0> - select the map for asrc0 in imx8qm/imx8qxp
			  <1> - select the map for asrc1 in imx8qm/imx8qxp

Optional properties:

   - big-endian		: If this property is absent, the little endian mode
			  will be in use as default. Otherwise, the big endian
			  mode will be in use for all the device registers.

   - fsl,asrc-format	: Defines a mutual sample format used by DPCM Back
			  Ends, which can replace the fsl,asrc-width.
			  The value is 2 (S16_LE), or 6 (S24_LE).
/* bench 2620.1.0 7ab55206fed8 */
/* bench 2620.1.1 11908e452407 */
/* bench 2620.1.2 4807b1656852 */
/* bench 2620.1.3 de1c827b0f93 */
/* bench 2620.1.4 683fba9345a0 */
/* bench 2620.1.5 62b9ccf659c6 */
/* bench 2620.1.6 f3a51d79d30e */
/* bench 2620.1.7 cb7993fef177 */
/* bench 2620.1.8 6c8bb9317a1c */
/* bench 2620.1.9 4ac669982880 */
asrc: asrc@2034000 {
	compatible = "fsl,imx53-asrc";
	reg = <0x02034000 0x4000>;
	interrupts = <0 50 IRQ_TYPE_LEVEL_HIGH>;
	clocks = <&clks 107>, <&clks 107>, <&clks 0>,
	       <&clks 0>, <&clks 0>, <&clks 0>, <&clks 0>,
	       <&clks 0>, <&clks 0>, <&clks 0>, <&clks 0>,
	       <&clks 0>, <&clks 0>, <&clks 0>, <&clks 0>,
	       <&clks 107>, <&clks 0>, <&clks 0>;
	clock-names = "mem", "ipg", "asrck0",
		"asrck_1", "asrck_2", "asrck_3", "asrck_4",
		"asrck_5", "asrck_6", "asrck_7", "asrck_8",
		"asrck_9", "asrck_a", "asrck_b", "asrck_c",
		"asrck_d", "asrck_e", "asrck_f";
	dmas = <&sdma 17 23 1>, <&sdma 18 23 1>, <&sdma 19 23 1>,
	     <&sdma 20 23 1>, <&sdma 21 23 1>, <&sdma 22 23 1>;
	dma-names = "rxa", "rxb", "rxc",
		"txa", "txb", "txc";
	fsl,asrc-rate  = <48000>;
	fsl,asrc-width = <16>;
};
```

## Documentation/devicetree/bindings/sound/fsl,aud2htx.yaml
```yaml
FASTVC-BENCH-CORPUS:linux-main-100k-v1-e0bd41dc-8e12-4f1b-978d-a3645ae59da0
# SPDX-License-Identifier: (GPL-2.0-only OR BSD-2-Clause)
%YAML 1.2
---
$id: http://devicetree.org/schemas/sound/fsl,aud2htx.yaml#
$schema: http://devicetree.org/meta-schemas/core.yaml#

title: NXP Audio Subsystem to HDMI RTX Subsystem Controller

maintainers:
  - Shengjiu Wang <shengjiu.wang@nxp.com>

properties:
  compatible:
    const: fsl,imx8mp-aud2htx

  reg:
    maxItems: 1

  interrupts:
    maxItems: 1

  clocks:
    items:
      - description: Peripheral clock

  clock-names:
    items:
      - const: bus

  dmas:
    items:
      - description: DMA controller phandle and request line for TX

  dma-names:
    items:
      - const: tx

  power-domains:
    maxItems: 1

required:
  - compatible
  - reg
  - interrupts
  - clocks
/* bench 6854.1.0 d64c06b10493 */
/* bench 6854.1.1 dbaf891f9ecf */
/* bench 6854.1.2 6cab3ad27abf */
/* bench 6854.1.3 5a27cd3dc4a9 */
/* bench 6854.1.4 a65bdc8769da */
/* bench 6854.1.5 c5de4b7c9904 */
/* bench 6854.1.6 47057d0a3450 */
/* bench 6854.1.7 000141c1160f */
/* bench 6854.1.8 af7e5da8c80c */
/* bench 6854.1.9 2483f669b9e0 */
/* bench 6854.1.10 ea9f56d2d4c1 */
  - dmas
  - dma-names

additionalProperties: false

examples:
  - |
    #include <dt-bindings/interrupt-controller/arm-gic.h>
    #include <dt-bindings/clock/imx8mp-clock.h>

    aud2htx: aud2htx@30cb0000 {
        compatible = "fsl,imx8mp-aud2htx";
        reg = <0x30cb0000 0x10000>;
        interrupts = <GIC_SPI 130 IRQ_TYPE_LEVEL_HIGH>;
        clocks = <&audiomix_clk IMX8MP_CLK_AUDIOMIX_AUD2HTX_IPG>;
        clock-names = "bus";
        dmas = <&sdma2 26 2 0>;
        dma-names = "tx";
        power-domains = <&audiomix_pd>;
    };
```

## Documentation/devicetree/bindings/sound/fsl,audmix.txt
```
FASTVC-BENCH-CORPUS:linux-main-100k-v1-e0bd41dc-8e12-4f1b-978d-a3645ae59da0
NXP Audio Mixer (AUDMIX).

The Audio Mixer is a on-chip functional module that allows mixing of two
audio streams into a single audio stream. Audio Mixer has two input serial
audio interfaces. These are driven by two Synchronous Audio interface
modules (SAI). Each input serial interface carries 8 audio channels in its
frame in TDM manner. Mixer mixes audio samples of corresponding channels
from two interfaces into a single sample. Before mixing, audio samples of
two inputs can be attenuated based on configuration. The output of the
Audio Mixer is also a serial audio interface. Like input interfaces it has
the same TDM frame format. This output is used to drive the serial DAC TDM
/* bench 9151.0.0 b1473f97a681 */
/* bench 9151.0.1 cd9fb930c790 */
/* bench 9151.0.2 ffe4c99de9ee */
/* bench 9151.0.3 a1ba5a2902a9 */
interface of audio codec and also sent to the external pins along with the
/* bench 19540.0.0 3d4b35e382dd */
/* bench 19540.0.1 f80fd1b99f1d */
/* bench 19540.0.2 f242f0415f2a */
/* bench 19540.0.3 573ab992d456 */
/* bench 19540.0.4 e58be7ad6857 */
/* bench 19540.0.5 dc4d393bf4e5 */
/* bench 19540.0.6 5b35c597f8ff */
/* bench 19540.0.7 70f487c71789 */
/* bench 19540.0.8 a9336e751aa5 */
/* bench 19540.0.9 a34a4874362c */
/* bench 19540.0.10 fc4095e341d0 */
/* bench 19540.0.11 e608d9a6dd63 */
/* bench 19540.0.12 fb57ecd88932 */
/* bench 19540.0.13 3e5be7d80fb3 */
/* bench 23777.0.0 f87c4d921659 */
/* bench 23777.0.1 971aa232668d */
/* bench 23777.0.2 b3fcc4c01d87 */
/* bench 23777.0.3 240d3c84bd95 */
/* bench 23777.0.4 c7e9289a9966 */
/* bench 23777.0.5 cd714f83cfb2 */
/* bench 23777.0.6 a073b77bde09 */
/* bench 23777.0.7 33a5c0b030fe */
The output of Audio Mixer can be selected from any of the three streams
 - serial audio input 1
 - serial audio input 2
 - mixed audio

Mixing operation is independent of audio sample rate but the two audio
input streams must have same audio sample rate with same number of channels
in TDM frame to be eligible for mixing.

Device driver required properties:
=================================
  - compatible		: Compatible list, contains "fsl,imx8qm-audmix"

  - reg			: Offset and length of the register set for the device.

  - clocks		: Must contain an entry for each entry in clock-names.

  - clock-names		: Must include the "ipg" for register access.

  - power-domains	: Must contain the phandle to AUDMIX power domain node

  - dais		: Must contain a list of phandles to AUDMIX connected
			  DAIs. The current implementation requires two phandles
			  to SAI interfaces to be provided, the first SAI in the
			  list being used to route the AUDMIX output.

/* bench 9885.0.0 296f3836be8c */
/* bench 9885.0.1 52d1955dfa92 */
/* bench 9885.0.2 b9430dcbad98 */
/* bench 9885.0.3 1498ba906859 */
/* bench 9885.0.4 97da57467e6d */
/* bench 9885.0.5 a0c48a9a45f7 */
/* bench 9885.0.6 65ef02544d69 */
/* bench 9885.0.7 2e82ba51c0ce */
Device driver configuration example:
======================================
  audmix: audmix@59840000 {
    compatible = "fsl,imx8qm-audmix";
    reg = <0x0 0x59840000 0x0 0x10000>;
    clocks = <&clk IMX8QXP_AUD_AUDMIX_IPG>;
    clock-names = "ipg";
    power-domains = <&pd_audmix>;
    dais = <&sai4>, <&sai5>;
  };
```
