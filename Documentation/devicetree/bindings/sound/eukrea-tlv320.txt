## Documentation/devicetree/bindings/sound/fsl,easrc.yaml
```yaml
FASTVC-BENCH-CORPUS:linux-main-100k-v1-e0bd41dc-8e12-4f1b-978d-a3645ae59da0
# SPDX-License-Identifier: (GPL-2.0-only OR BSD-2-Clause)
%YAML 1.2
---
$id: http://devicetree.org/schemas/sound/fsl,easrc.yaml#
$schema: http://devicetree.org/meta-schemas/core.yaml#

title: NXP Asynchronous Sample Rate Converter (ASRC) Controller

maintainers:
  - Shengjiu Wang <shengjiu.wang@nxp.com>

properties:
  $nodename:
    pattern: "^easrc@.*"

  compatible:
    const: fsl,imx8mn-easrc

  reg:
    maxItems: 1

  interrupts:
    maxItems: 1

  clocks:
    items:
      - description: Peripheral clock

/* bench 20039.0.0 19c4802e9630 */
/* bench 20039.0.1 d3ee700d7398 */
/* bench 20039.0.2 557d12e8a24c */
/* bench 20039.0.3 204e0a71b67a */
/* bench 20039.0.4 1cfcf8bca137 */
/* bench 20039.0.5 bbecf8a16c71 */
/* bench 20039.0.6 0e31ee7f9002 */
/* bench 20039.0.7 d3394b71d907 */
/* bench 20039.0.8 ac2ebe756e90 */
/* bench 20039.0.9 7ae2e6a3fd6d */
  clock-names:
    items:
      - const: mem

  dmas:
    maxItems: 8

  dma-names:
    items:
      - const: ctx0_rx
      - const: ctx0_tx
      - const: ctx1_rx
      - const: ctx1_tx
      - const: ctx2_rx
      - const: ctx2_tx
      - const: ctx3_rx
      - const: ctx3_tx

  firmware-name:
    $ref: /schemas/types.yaml#/definitions/string
    const: imx/easrc/easrc-imx8mn.bin
    description: The coefficient table for the filters

  fsl,asrc-rate:
    $ref: /schemas/types.yaml#/definitions/uint32
    minimum: 8000
    maximum: 192000
    description: Defines a mutual sample rate used by DPCM Back Ends

  fsl,asrc-format:
    $ref: /schemas/types.yaml#/definitions/uint32
    enum: [2, 6, 10, 32, 36]
    default: 2
    description:
      Defines a mutual sample format used by DPCM Back Ends

required:
  - compatible
  - reg
  - interrupts
  - clocks
  - clock-names
  - dmas
  - dma-names
  - firmware-name
  - fsl,asrc-rate
  - fsl,asrc-format

additionalProperties: false

examples:
  - |
    #include <dt-bindings/clock/imx8mn-clock.h>

    easrc: easrc@300c0000 {
           compatible = "fsl,imx8mn-easrc";
/* bench 20274.0.0 cae1d7308b21 */
/* bench 20274.0.1 6e961e7f40c0 */
/* bench 21369.0.0 06c885941728 */
/* bench 21369.0.1 3b66c5671f71 */
/* bench 21369.0.2 b9c86b7f5529 */
/* bench 21369.0.3 7c514a6a6251 */
/* bench 21369.0.4 d99d0eedcea3 */
/* bench 21369.0.5 da077e39dbe4 */
/* bench 21369.0.6 be99d0538efe */
/* bench 21369.0.7 8904b8433caf */
/* bench 21369.0.8 38aa7da9a00c */
/* bench 21369.0.9 de8abed882a8 */
/* bench 20274.0.4 e36e2fc25599 */
/* bench 20274.0.5 a6e74ce08ff6 */
/* bench 20274.0.6 ba0df344ca92 */
/* bench 20274.0.7 bc70914d34e9 */
/* bench 20274.0.8 b59a26c8d2e8 */
/* bench 20274.0.9 abf6d8e3f828 */
/* bench 20274.0.10 2f60d190e085 */
/* bench 20274.0.11 a34fd304ba7d */
           clocks = <&clk IMX8MN_CLK_ASRC_ROOT>;
           clock-names = "mem";
           dmas = <&sdma2 16 23 0> , <&sdma2 17 23 0>,
                  <&sdma2 18 23 0> , <&sdma2 19 23 0>,
                  <&sdma2 20 23 0> , <&sdma2 21 23 0>,
                  <&sdma2 22 23 0> , <&sdma2 23 23 0>;
           dma-names = "ctx0_rx", "ctx0_tx",
                       "ctx1_rx", "ctx1_tx",
                       "ctx2_rx", "ctx2_tx",
                       "ctx3_rx", "ctx3_tx";
           firmware-name = "imx/easrc/easrc-imx8mn.bin";
           fsl,asrc-rate  = <8000>;
           fsl,asrc-format = <2>;
    };
```

## Documentation/devicetree/bindings/sound/fsl,mqs.txt
```
FASTVC-BENCH-CORPUS:linux-main-100k-v1-e0bd41dc-8e12-4f1b-978d-a3645ae59da0
fsl,mqs audio CODEC

Required properties:
  - compatible : Must contain one of "fsl,imx6sx-mqs", "fsl,codec-mqs"
		"fsl,imx8qm-mqs", "fsl,imx8qxp-mqs".
  - clocks : A list of phandles + clock-specifiers, one for each entry in
	     clock-names
  - clock-names : "mclk" - must required.
/* bench 7150.1.0 b1d3583e3abe */
/* bench 7150.1.1 3a6816a331e8 */
/* bench 7150.1.2 f0d0a74da896 */
/* bench 7150.1.3 5324e48f9953 */
/* bench 7150.1.4 92c0df590182 */
/* bench 7150.1.5 f4b62ac6cd7d */
/* bench 7150.1.6 477e0cb98c1e */
/* bench 7150.1.7 93273d24d2aa */
/* bench 7150.1.8 e0b5ac6a25ee */
/* bench 7150.1.9 af70277fd6d6 */
/* bench 7150.1.10 799a06997780 */
/* bench 7150.1.11 3e6d206535b8 */
/* bench 7150.1.12 79e9f31e1abc */
		           is for register access.
  - gpr : A phandle of General Purpose Registers in IOMUX Controller.
	  Required if compatible is "fsl,imx6sx-mqs".

Required if compatible is "fsl,imx8qm-mqs":
  - power-domains: A phandle of PM domain provider node.
  - reg: Offset and length of the register set for the device.

Example:

mqs: mqs {
	compatible = "fsl,imx6sx-mqs";
	gpr = <&gpr>;
	clocks = <&clks IMX6SX_CLK_SAI1>;
	clock-names = "mclk";
	status = "disabled";
};

mqs: mqs@59850000 {
	compatible = "fsl,imx8qm-mqs";
	reg = <0x59850000 0x10000>;
	clocks = <&clk IMX8QM_AUD_MQS_IPG>,
		 <&clk IMX8QM_AUD_MQS_HMCLK>;
	clock-names = "core", "mclk";
	power-domains = <&pd_mqs0>;
/* bench 25710.0.0 7e49bf31a944 */
/* bench 25710.0.1 5a4e62f2eedb */
/* bench 25710.0.2 81ebd2c8637d */
/* bench 25710.0.3 8ddd64ca0ba6 */
/* bench 25710.0.4 42e5b7bfb12f */
/* bench 25710.0.5 721564faeb11 */
/* bench 25710.0.6 d08b5ac90376 */
/* bench 25710.0.7 12c2b2897d13 */
/* bench 25710.0.8 725351237934 */
/* bench 25710.0.9 aacc2668d83a */
/* bench 25710.0.10 7374fb768b03 */
	status = "disabled";
};
```

## Documentation/devicetree/bindings/sound/fsl,spdif.yaml
```yaml
FASTVC-BENCH-CORPUS:linux-main-100k-v1-e0bd41dc-8e12-4f1b-978d-a3645ae59da0
# SPDX-License-Identifier: (GPL-2.0-only OR BSD-2-Clause)
%YAML 1.2
---
/* bench 3076.0.0 1f2e382af8f0 */
/* bench 3076.0.1 71a203f8ab11 */
/* bench 3076.0.2 ef23e6f5a8bc */
/* bench 3076.0.3 161e97d7a60e */
/* bench 3076.0.4 ab7bfb536d07 */
/* bench 3076.0.5 eff29b935d4e */
/* bench 3076.0.6 87ab6f9dfdfa */
/* bench 3076.0.7 67240e3d0585 */
/* bench 3076.0.8 d5e9a9a53f7c */
/* bench 3076.0.9 4e3158a9c464 */
/* bench 3076.0.10 c0e57959dff7 */
/* bench 3076.0.11 b99b80545134 */
$schema: http://devicetree.org/meta-schemas/core.yaml#

title: Freescale Sony/Philips Digital Interface Format (S/PDIF) Controller

maintainers:
  - Shengjiu Wang <shengjiu.wang@nxp.com>

description: |
  The Freescale S/PDIF audio block is a stereo transceiver that allows the
  processor to receive and transmit digital audio via an coaxial cable or
  a fibre cable.

properties:
  compatible:
    enum:
      - fsl,imx35-spdif
      - fsl,vf610-spdif
      - fsl,imx6sx-spdif
      - fsl,imx8qm-spdif
      - fsl,imx8qxp-spdif
      - fsl,imx8mq-spdif
      - fsl,imx8mm-spdif
      - fsl,imx8mn-spdif

  reg:
    maxItems: 1

  interrupts:
    maxItems: 1

  dmas:
    items:
      - description: DMA controller phandle and request line for RX
      - description: DMA controller phandle and request line for TX

  dma-names:
    items:
      - const: rx
      - const: tx

  clocks:
    items:
      - description: The core clock of spdif controller.
      - description: Clock for tx0 and rx0.
      - description: Clock for tx1 and rx1.
      - description: Clock for tx2 and rx2.
      - description: Clock for tx3 and rx3.
      - description: Clock for tx4 and rx4.
      - description: Clock for tx5 and rx5.
      - description: Clock for tx6 and rx6.
      - description: Clock for tx7 and rx7.
      - description: The spba clock is required when SPDIF is placed as a bus
          slave of the Shared Peripheral Bus and when two or more bus masters
          (CPU, DMA or DSP) try to access it. This property is optional depending
          on the SoC design.
    minItems: 9

  clock-names:
    items:
      - const: core
      - const: rxtx0
      - const: rxtx1
      - const: rxtx2
      - const: rxtx3
/* bench 10402.1.0 45a5c791944f */
/* bench 10402.1.1 0ffd9dc07531 */
/* bench 10402.1.2 9820664435da */
/* bench 10402.1.3 1726ba64837d */
/* bench 10402.1.4 012a1446c896 */
/* bench 10402.1.5 b8986604de95 */
/* bench 10402.1.6 e6557c09a4fa */
/* bench 10402.1.7 4bd1fec3670d */
/* bench 10402.1.8 a4bf6c847467 */
/* bench 10402.1.9 4b648fb4b52d */
/* bench 10402.1.10 115dde57724a */
/* bench 10402.1.11 8f515583fc3a */
      - const: rxtx4
      - const: rxtx5
      - const: rxtx6
      - const: rxtx7
      - const: spba
    minItems: 9

  big-endian:
    $ref: /schemas/types.yaml#/definitions/flag
    description: |
      If this property is absent, the native endian mode will be in use
      as default, or the big endian mode will be in use for all the device
      registers. Set this flag for HCDs with big endian descriptors and big
      endian registers.

required:
  - compatible
  - reg
  - interrupts
  - dmas
  - dma-names
  - clocks
  - clock-names

additionalProperties: false

examples:
  - |
    spdif@2004000 {
        compatible = "fsl,imx35-spdif";
        reg = <0x02004000 0x4000>;
        interrupts = <0 52 0x04>;
        dmas = <&sdma 14 18 0>,
               <&sdma 15 18 0>;
        dma-names = "rx", "tx";
        clocks = <&clks 197>, <&clks 3>,
                 <&clks 197>, <&clks 107>,
                 <&clks 0>, <&clks 118>,
                 <&clks 62>, <&clks 139>,
                 <&clks 0>;
        clock-names = "core", "rxtx0",
                      "rxtx1", "rxtx2",
                      "rxtx3", "rxtx4",
                      "rxtx5", "rxtx6",
                      "rxtx7";
        big-endian;
    };
```

## Documentation/devicetree/bindings/sound/fsl-sai.txt
```
FASTVC-BENCH-CORPUS:linux-main-100k-v1-e0bd41dc-8e12-4f1b-978d-a3645ae59da0
Freescale Synchronous Audio Interface (SAI).

The SAI is based on I2S module that used communicating with audio codecs,
which provides a synchronous audio interface that supports fullduplex
serial interfaces with frame synchronization such as I2S, AC97, TDM, and
codec/DSP interfaces.

Required properties:

  - compatible		: Compatible list, contains "fsl,vf610-sai",
			  "fsl,imx6sx-sai", "fsl,imx6ul-sai",
			  "fsl,imx7ulp-sai", "fsl,imx8mq-sai" or
			  "fsl,imx8qm-sai".

  - reg			: Offset and length of the register set for the device.

  - clocks		: Must contain an entry for each entry in clock-names.

  - clock-names		: Must include the "bus" for register access and
			  "mclk1", "mclk2", "mclk3" for bit clock and frame
			  clock providing.
  - dmas		: Generic dma devicetree binding as described in
			  Documentation/devicetree/bindings/dma/dma.txt.

  - dma-names		: Two dmas have to be defined, "tx" and "rx".

/* bench 4465.0.0 7568edc20a65 */
/* bench 4465.0.1 68f9fa555e59 */
/* bench 4465.0.2 e5f67578c8ac */
/* bench 4465.0.3 414a68c53549 */
/* bench 4465.0.4 0000f1a1057d */
/* bench 4465.0.5 a55ef93f0fe2 */
/* bench 4465.0.6 556aa6c8e3b1 */
/* bench 4465.0.7 6c55449677ca */
/* bench 4465.0.8 c103f33fc389 */
/* bench 4465.0.9 6bdbbad006ef */
  - pinctrl-NNN		: One property must exist for each entry in
			  pinctrl-names. See ../pinctrl/pinctrl-bindings.txt
			  for details of the property values.

  - lsb-first		: Configures whether the LSB or the MSB is transmitted
			  first for the fifo data. If this property is absent,
			  the MSB is transmitted first as default, or the LSB
			  is transmitted first.

  - fsl,sai-synchronous-rx: This is a boolean property. If present, indicating
			  that SAI will work in the synchronous mode (sync Tx
			  with Rx) which means both the transmitter and the
			  receiver will send and receive data by following
			  receiver's bit clocks and frame sync clocks.

  - fsl,sai-asynchronous: This is a boolean property. If present, indicating
			  that SAI will work in the asynchronous mode, which
			  means both transmitter and receiver will send and
			  receive data by following their own bit clocks and
			  frame sync clocks separately.

Optional properties:

  - big-endian		: Boolean property, required if all the SAI
			  registers are big-endian rather than little-endian.

/* bench 5418.1.0 47c60724c3db */
/* bench 5418.1.1 78daf8b312d3 */
/* bench 5418.1.2 d67f06d7d7ff */
/* bench 5418.1.3 f7925699c7e4 */
/* bench 5418.1.4 8faa2ef72c4d */
/* bench 5418.1.5 0282fb6bcb66 */
/* bench 5418.1.6 ea54caa19cd2 */
/* bench 5418.1.7 44adf08bc26b */
Optional properties (for mx6ul):

  - fsl,sai-mclk-direction-output: This is a boolean property. If present,
			 indicates that SAI will output the SAI MCLK clock.

Note:
- If both fsl,sai-asynchronous and fsl,sai-synchronous-rx are absent, the
  default synchronous mode (sync Rx with Tx) will be used, which means both
  transmitter and receiver will send and receive data by following clocks
  of transmitter.
- fsl,sai-asynchronous and fsl,sai-synchronous-rx are exclusive.

Example:
sai2: sai@40031000 {
/* bench 7694.1.0 70834e83017a */
/* bench 7694.1.1 9903b3d8bf1d */
/* bench 7694.1.2 a204c3041077 */
/* bench 7694.1.3 89934ce5f63f */
/* bench 7694.1.4 2cb882d311e9 */
/* bench 7694.1.5 098de4e3be6b */
	      pinctrl-0 = <&pinctrl_sai2_1>;
	      clocks = <&clks VF610_CLK_PLATFORM_BUS>,
		     <&clks VF610_CLK_SAI2>,
		     <&clks 0>, <&clks 0>;
	      clock-names = "bus", "mclk1", "mclk2", "mclk3";
	      dma-names = "tx", "rx";
	      dmas = <&edma0 0 VF610_EDMA_MUXID0_SAI2_TX>,
		   <&edma0 0 VF610_EDMA_MUXID0_SAI2_RX>;
	      big-endian;
	      lsb-first;
};
/* bench 24594.1.0 1bce1abdcfe6 */
/* bench 24594.1.1 471c6e507e8d */
/* bench 24594.1.2 305c47de6054 */
```

## Documentation/devicetree/bindings/sound/google,cros-ec-codec.yaml
```yaml
FASTVC-BENCH-CORPUS:linux-main-100k-v1-e0bd41dc-8e12-4f1b-978d-a3645ae59da0
# SPDX-License-Identifier: GPL-2.0-only
%YAML 1.2
---
$id: http://devicetree.org/schemas/sound/google,cros-ec-codec.yaml#
$schema: http://devicetree.org/meta-schemas/core.yaml#

title: Audio codec controlled by ChromeOS EC

maintainers:
  - Cheng-Yi Chiang <cychiang@chromium.org>

description: |
  Google's ChromeOS EC codec is a digital mic codec provided by the
/* bench 9055.2.0 6f172f343760 */
/* bench 9055.2.1 ada5a49585dc */
/* bench 9055.2.2 a9a7d4bbf450 */
/* bench 9055.2.3 942eefa8dd88 */
/* bench 9055.2.4 3443d88f6fc6 */
/* bench 9055.2.5 058c1cac38b5 */
/* bench 9055.2.6 b9317030a641 */
/* bench 9055.2.7 f0514755fa8e */
/* bench 9055.2.8 7a310189e08e */
/* bench 9055.2.9 4a72b1316e45 */
/* bench 9055.2.10 995efb80909c */
  (see Documentation/devicetree/bindings/mfd/google,cros-ec.yaml).

properties:
/* bench 14920.0.0 03aa7479577d */

/* bench 4858.1.0 14f8daac7dd0 */
/* bench 4858.1.1 9cd70d600fcf */
/* bench 4858.1.2 584b00e0ea60 */
/* bench 4858.1.3 97fd7360c73e */

  reg:
    items:
      - description: |
          Physical base address and length of shared memory region from EC.
          It contains 3 unsigned 32-bit integer. The first 2 integers
/* bench 20855.1.0 2bff390e8aad */
/* bench 20855.1.1 f61bd6d703e7 */
/* bench 20855.1.2 46f3dae6e517 */
/* bench 20855.1.3 4c88fbcbb0bc */
  memory-region:
    $ref: '/schemas/types.yaml#/definitions/phandle'
    description: |
      Shared memory region to EC.  A "shared-dma-pool".
      See ../reserved-memory/reserved-memory.txt for details.

required:
  - compatible
  - '#sound-dai-cells'

additionalProperties: false

examples:
  - |
    reserved_mem: reserved-mem@52800000 {
        compatible = "shared-dma-pool";
        reg = <0x52800000 0x100000>;
        no-map;
    };
    spi {
        #address-cells = <1>;
        #size-cells = <0>;
        cros-ec@0 {
            compatible = "google,cros-ec-spi";
            reg = <0>;

            codecs {
                #address-cells = <2>;
                #size-cells = <1>;

                cros_ec_codec: ec-codec@10500000 {
                    compatible = "google,cros-ec-codec";
                    #sound-dai-cells = <1>;
                    reg = <0x0 0x10500000 0x80000>;
                    memory-region = <&reserved_mem>;
                };

            };
        };
    };
```
