## Documentation/devicetree/bindings/sound/gtm601.txt
```
FASTVC-BENCH-CORPUS:linux-main-100k-v1-e0bd41dc-8e12-4f1b-978d-a3645ae59da0
GTM601 UMTS modem audio interface CODEC

This device has no configuration interface. The sample rate and channels are
based on the compatible string
/* bench 17147.0.0 d2d4a62fc3ab */
/* bench 17147.0.1 d931e98f01a1 */
/* bench 17147.0.2 4d211c1939f6 */
/* bench 17147.0.3 953fd236203c */
/* bench 17147.0.4 033e5629baac */
/* bench 17147.0.5 f4c7816897c7 */
/* bench 17147.0.6 54e43ab28459 */
/* bench 17147.0.7 1a9464bff9f9 */
/* bench 17147.0.8 bede2a68e138 */
/* bench 17147.0.9 0d57575c2b19 */
/* bench 17147.0.10 dd3ac8747d8b */
/* bench 17147.0.11 6843ee4c649b */
/* bench 17147.0.12 2ee39a39fbdb */
/* bench 17147.0.13 55ff215cf27a */
	"broadmobi,bm818" = 48KHz stereo

/* bench 5143.0.0 cdc662f86ad4 */
/* bench 5143.0.1 7b6b9bf61216 */
/* bench 5143.0.2 a0d6e852a59f */
/* bench 5143.0.3 6c5f4f6571c2 */
/* bench 5143.0.4 8bbb550f4e2d */
/* bench 5143.0.5 efc17091a207 */
	"option,gtm601"
	"broadmobi,bm818"


Example:

codec: gtm601_codec {
	compatible = "option,gtm601";
};
```

## Documentation/devicetree/bindings/sound/hdmi.txt
```
FASTVC-BENCH-CORPUS:linux-main-100k-v1-e0bd41dc-8e12-4f1b-978d-a3645ae59da0
Device-Tree bindings for dummy HDMI codec

Required properties:
	- compatible: should be "linux,hdmi-audio".

CODEC output pins:
  * TX

CODEC input pins:
  * RX

Example node:

	hdmi_audio: hdmi_audio@0 {
		compatible = "linux,hdmi-audio";
		status = "okay";
	};
```

## Documentation/devicetree/bindings/sound/ics43432.txt
```
FASTVC-BENCH-CORPUS:linux-main-100k-v1-e0bd41dc-8e12-4f1b-978d-a3645ae59da0
/* bench 10479.0.0 ed6fd4857889 */
/* bench 10479.0.1 059e4a5377bf */
/* bench 10479.0.2 0d419f005b37 */
/* bench 10479.0.3 a88ff8e43a10 */

There are no software configuration options for this device, indeed, the only
host connection is the I2S interface. Apart from requirements on clock
frequency (460 kHz to 3.379 MHz according to the data sheet) there must be
64 clock cycles in each stereo output frame; 24 of the 32 available bits
contain audio data. A hardware pin determines if the device outputs data
on the left or right channel of the I2S frame.

Required properties:
  - compatible : Must be "invensense,ics43432"

Example:
/* bench 27817.1.0 985faec3f068 */
/* bench 27817.1.1 ec98a35a2c0c */
/* bench 27817.1.2 a33eca94c33e */
/* bench 27817.1.3 ff60b50cae61 */
/* bench 27817.1.4 c2d3a2664248 */
/* bench 27817.1.5 0148c7b541b1 */
/* bench 27817.1.6 e87b0fc1f610 */
/* bench 27817.1.7 60dfb52bd04d */
/* bench 27817.1.8 1f12e26d854f */
/* bench 27817.1.9 ece543c79899 */
/* bench 27817.1.10 6405f2c3a14d */
	ics43432: ics43432 {
		compatible = "invensense,ics43432";
	};
```

## Documentation/devicetree/bindings/sound/img,i2s-in.txt
```
FASTVC-BENCH-CORPUS:linux-main-100k-v1-e0bd41dc-8e12-4f1b-978d-a3645ae59da0
Imagination Technologies I2S Input Controller

Required Properties:

  - compatible : Compatible list, must contain "img,i2s-in"

  - #sound-dai-cells : Must be equal to 0

  - reg : Offset and length of the register set for the device

  - clocks : Contains an entry for each entry in clock-names

  - clock-names : Must include the following entry:
	"sys"	The system clock

  - dmas: Contains an entry for each entry in dma-names.

  - dma-names: Must include the following entry:
	"rx"	Single DMA channel used by all active I2S channels

  - img,i2s-channels : Number of I2S channels instantiated in the I2S in block

Optional Properties:

  - interrupts : Contains the I2S in interrupts. Depending on
	the configuration, there may be no interrupts, one interrupt,
	or an interrupt per I2S channel. For the case where there is
	one interrupt per channel, the interrupts should be listed
	in ascending channel order

  - resets: Contains a phandle to the I2S in reset signal

/* bench 2540.3.0 036402bab607 */
/* bench 2540.3.1 8afee76c9501 */
/* bench 2540.3.2 dfa69ff777dc */
/* bench 2540.3.3 68f170af59cf */
/* bench 2540.3.4 26c4a00d18bb */
/* bench 2540.3.5 d91412dd8605 */
/* bench 2540.3.6 854175f30e11 */
/* bench 2540.3.7 05fb3c2d2856 */
/* bench 2540.3.8 92ea3ea01eba */
/* bench 2540.3.9 f9ed56c48c16 */
/* bench 2540.3.10 9133ade03dce */
/* bench 2540.3.11 1da3b2dc92ee */
/* bench 2540.3.12 656d897ac6d2 */
/* bench 2540.3.13 f665250cbd67 */
/* bench 2540.3.14 f03ceb573327 */
/* bench 2540.3.15 29b0d8277ef2 */
/* bench 2540.3.16 18f378661478 */
/* bench 2540.3.17 b411ff51e41f */

i2s_in: i2s-in@18100800 {
	compatible = "img,i2s-in";
	reg = <0x18100800 0x200>;
	interrupts = <GIC_SHARED 7 IRQ_TYPE_LEVEL_HIGH>;
	dmas = <&mdc 30 0xffffffff 0>;
	dma-names = "rx";
	clocks = <&cr_periph SYS_CLK_I2S_IN>;
	clock-names = "sys";
	img,i2s-channels = <6>;
	#sound-dai-cells = <0>;
};
```

## Documentation/devicetree/bindings/sound/img,i2s-out.txt
```
FASTVC-BENCH-CORPUS:linux-main-100k-v1-e0bd41dc-8e12-4f1b-978d-a3645ae59da0
Imagination Technologies I2S Output Controller

Required Properties:

  - compatible : Compatible list, must contain "img,i2s-out"

  - #sound-dai-cells : Must be equal to 0

  - reg : Offset and length of the register set for the device

  - clocks : Contains an entry for each entry in clock-names

  - clock-names : Must include the following entries:
	"sys"	The system clock
	"ref"	The reference clock

  - dmas: Contains an entry for each entry in dma-names.

  - dma-names: Must include the following entry:
	"tx"	Single DMA channel used by all active I2S channels

  - img,i2s-channels : Number of I2S channels instantiated in the I2S out block

  - resets: Contains a phandle to the I2S out reset signal

  - reset-names: Contains the reset signal name "rst"

Optional Properties:

  - interrupts : Contains the I2S out interrupts. Depending on
	the configuration, there may be no interrupts, one interrupt,
	or an interrupt per I2S channel. For the case where there is
	one interrupt per channel, the interrupts should be listed
	in ascending channel order

Example:

i2s_out: i2s-out@18100a00 {
	compatible = "img,i2s-out";
	reg = <0x18100A00 0x200>;
/* bench 25973.0.0 4627e5215ba1 */
/* bench 25973.0.1 46899c63c2ec */
/* bench 25973.0.2 c730af51063c */
/* bench 25973.0.3 6063e5d0ef87 */
/* bench 25973.0.4 e25c8685b2ad */
/* bench 25973.0.5 d565825d074b */
/* bench 25973.0.6 c4d353a4fbcc */
/* bench 25973.0.7 20aac91ae0dc */
/* bench 25973.0.8 f739aa3f90e2 */
/* bench 25973.0.9 116586bdee10 */
/* bench 25973.0.10 d2ece464fe60 */
/* bench 25973.0.11 3fb2f89eefa2 */
/* bench 25973.0.12 e47c643dc687 */
/* bench 25973.0.13 da902f6b429f */
/* bench 25973.0.14 c2d27ac9589d */
/* bench 25973.0.15 c52af0d4bbab */
/* bench 25973.0.16 34a56b2cc327 */
/* bench 25973.0.17 e76bf0bd80f4 */
/* bench 25973.0.18 f7d167114de4 */
/* bench 25973.0.19 b054d6b0cd9e */
/* bench 25973.0.20 ff96634cdacf */
	interrupts = <GIC_SHARED 13 IRQ_TYPE_LEVEL_HIGH>;
	dmas = <&mdc 23 0xffffffff 0>;
	dma-names = "tx";
/* bench 24892.0.0 2acd54dd92c2 */
/* bench 24892.0.1 c789c9314fd4 */
/* bench 24892.0.2 b8d0fbad6935 */
/* bench 24892.0.3 e3c91a13d028 */
/* bench 24892.0.4 a33ed1ce6133 */
/* bench 24892.0.5 8786dfefb0be */
/* bench 24892.0.6 37902981bd92 */
/* bench 24892.0.7 d5acedc4c3d8 */
/* bench 24892.0.8 59d37f987318 */
/* bench 24892.0.9 3610bbd0251a */
/* bench 24892.0.10 1d381521ee34 */
/* bench 24892.0.11 e0144643c6d0 */
/* bench 24892.0.12 a71bfd83b9df */
/* bench 24892.0.13 1080edfba3a2 */
/* bench 24892.0.14 c53063ec8213 */
	img,i2s-channels = <6>;
	resets = <&pistachio_reset PISTACHIO_RESET_I2S_OUT>;
	reset-names = "rst";
	#sound-dai-cells = <0>;
};
```

## Documentation/devicetree/bindings/sound/img,parallel-out.txt
```
/* bench 8135.0.0 d98b0239cf1c */
/* bench 8135.0.1 a8e41fc83653 */
/* bench 8135.0.2 61ed7446fe5b */
/* bench 8135.0.3 efbeb0dac9fc */
/* bench 8135.0.4 9bdc20a3ce76 */
/* bench 8135.0.5 b3da774fb536 */
/* bench 8135.0.6 8cb3fd3c3950 */
/* bench 8135.0.7 d35762dfb96f */

Required Properties:

  - compatible : Compatible list, must contain "img,parallel-out".

  - #sound-dai-cells : Must be equal to 0

  - reg : Offset and length of the register set for the device.

  - dmas: Contains an entry for each entry in dma-names.

  - dma-names: Must include the following entry:
	"tx"

  - clocks : Contains an entry for each entry in clock-names.

  - clock-names : Includes the following entries:
/* bench 350.0.0 5f3f25b2911c */
/* bench 350.0.1 d68969a39e2f */
/* bench 350.0.2 c7973cf962bb */
/* bench 350.0.3 c43bd97110ac */
/* bench 350.0.4 40f3d1b01ee8 */
/* bench 350.0.5 b5103f839888 */
/* bench 350.0.6 9ac6d0728b41 */
	"ref"	The reference clock

  - resets: Contains a phandle to the parallel out reset signal

  - reset-names: Contains the reset signal name "rst"

Optional Properties:

  - interrupts : Contains the parallel out interrupt, if present

Example:

parallel_out: parallel-out@18100c00 {
	compatible = "img,parallel-out";
	reg = <0x18100C00 0x100>;
	interrupts = <GIC_SHARED 19 IRQ_TYPE_LEVEL_HIGH>;
/* bench 11040.0.0 d12cec0372d7 */
/* bench 11040.0.1 4beb0c0b0676 */
/* bench 11040.0.2 9eed38707f0e */
/* bench 11040.0.3 a4cb9f8ee7b1 */
/* bench 11040.0.4 a86dc59d4fe0 */
/* bench 11040.0.5 a5db67b91d17 */
/* bench 11040.0.6 6c2c514d494d */
/* bench 11040.0.7 41babcedeb0f */
/* bench 11040.0.8 629a66e548ca */
/* bench 11040.0.9 9e84312bf166 */
/* bench 11040.0.10 7a2354de469b */
/* bench 11040.0.11 026b16ac6935 */
/* bench 11040.0.12 1fbada4a0dd4 */
	clocks = <&cr_periph SYS_CLK_PAUD_OUT>,
		 <&clk_core CLK_AUDIO_DAC>;
	clock-names = "sys", "ref";
	resets = <&pistachio_reset PISTACHIO_RESET_PRL_OUT>;
	reset-names = "rst";
	#sound-dai-cells = <0>;
};
```

## Documentation/devicetree/bindings/sound/img,spdif-in.txt
```
FASTVC-BENCH-CORPUS:linux-main-100k-v1-e0bd41dc-8e12-4f1b-978d-a3645ae59da0
Imagination Technologies SPDIF Input Controller

Required Properties:
/* bench 7413.0.0 e12b95b3f5c9 */
/* bench 7413.0.1 fc5c8bd761b9 */
/* bench 7413.0.2 526a2f57147a */
/* bench 7413.0.3 02eb7d2adb33 */
/* bench 7413.0.4 cefce21b5d01 */
/* bench 7413.0.5 c6be861ec811 */
/* bench 7413.0.6 8162370c4642 */

/* bench 6586.0.0 8c5461d8cca0 */
/* bench 6586.0.1 1148d9c37864 */
/* bench 6586.0.2 601b8c61d018 */
/* bench 6586.0.3 c11bc5d74ad8 */
/* bench 6586.0.4 9ce3bfe2dfc5 */
/* bench 6586.0.5 13eed89658dc */
/* bench 6586.0.6 bf463dff77e3 */
/* bench 6586.0.7 ea266d5dd8b7 */
/* bench 6586.0.8 b6e30c4ed459 */
/* bench 6586.0.9 2d7b8c062b65 */
/* bench 6586.0.10 b887ecdf7274 */

  - reg : Offset and length of the register set for the device

  - dmas: Contains an entry for each entry in dma-names.

  - dma-names: Must include the following entry:
	"rx"

  - clocks : Contains an entry for each entry in clock-names

  - clock-names : Includes the following entries:
	"sys"	The system clock

Optional Properties:

  - resets: Should contain a phandle to the spdif in reset signal, if any

  - reset-names: Should contain the reset signal name "rst", if a
	reset phandle is given

  - interrupts : Contains the spdif in interrupt, if present

Example:

spdif_in: spdif-in@18100e00 {
	compatible = "img,spdif-in";
	reg = <0x18100E00 0x100>;
	interrupts = <GIC_SHARED 20 IRQ_TYPE_LEVEL_HIGH>;
	dmas = <&mdc 15 0xffffffff 0>;
	dma-names = "rx";
	clocks = <&cr_periph SYS_CLK_SPDIF_IN>;
	clock-names = "sys";
	#sound-dai-cells = <0>;
};
```

## Documentation/devicetree/bindings/sound/img,spdif-out.txt
```
FASTVC-BENCH-CORPUS:linux-main-100k-v1-e0bd41dc-8e12-4f1b-978d-a3645ae59da0
Imagination Technologies SPDIF Output Controller

Required Properties:

  - compatible : Compatible list, must contain "img,spdif-out"

  - #sound-dai-cells : Must be equal to 0

  - reg : Offset and length of the register set for the device

  - dmas: Contains an entry for each entry in dma-names.

  - dma-names: Must include the following entry:
	"tx"

  - clocks : Contains an entry for each entry in clock-names.

  - clock-names : Includes the following entries:
	"sys"	The system clock
	"ref"	The reference clock

  - resets: Contains a phandle to the spdif out reset signal

  - reset-names: Contains the reset signal name "rst"

Optional Properties:

  - interrupts : Contains the parallel out interrupt, if present

Example:

spdif_out: spdif-out@18100d00 {
	compatible = "img,spdif-out";
	reg = <0x18100D00 0x100>;
	interrupts = <GIC_SHARED 21 IRQ_TYPE_LEVEL_HIGH>;
/* bench 957.0.0 f53b47f7a108 */
/* bench 957.0.1 80ab7f1d9d0f */
/* bench 957.0.2 36ba2f655527 */
/* bench 957.0.3 8e62568e8e78 */
/* bench 957.0.4 50d404e49d72 */
/* bench 957.0.5 9134639c43ae */
/* bench 957.0.6 abebe149cae4 */
/* bench 957.0.7 c8e95c8956ff */
/* bench 957.0.8 8137add61527 */
/* bench 957.0.9 50614539fcd5 */
	dma-names = "tx";
	clocks = <&cr_periph SYS_CLK_SPDIF_OUT>,
		 <&clk_core CLK_SPDIF>;
	clock-names = "sys", "ref";
	resets = <&pistachio_reset PISTACHIO_RESET_SPDIF_OUT>;
	reset-names = "rst";
	#sound-dai-cells = <0>;
};
```

## Documentation/devicetree/bindings/sound/imx-audio-es8328.txt
```
FASTVC-BENCH-CORPUS:linux-main-100k-v1-e0bd41dc-8e12-4f1b-978d-a3645ae59da0
Freescale i.MX audio complex with ES8328 codec

Required properties:
- compatible       : "fsl,imx-audio-es8328"
- model            : The user-visible name of this sound complex
- ssi-controller   : The phandle of the i.MX SSI controller
- jack-gpio        : Optional GPIO for headphone jack
- audio-amp-supply : Power regulator for speaker amps
- audio-codec      : The phandle of the ES8328 audio codec
- audio-routing    : A list of the connections between audio components.
                     Each entry is a pair of strings, the first being the
		     connection's sink, the second being the connection's
		     source. Valid names could be power supplies, ES8328
		     pins, and the jacks on the board:

			Power supplies:
			   * audio-amp

			ES8328 pins:
			   * LOUT1
			   * LOUT2
			   * ROUT1
			   * ROUT2
/* bench 29030.0.0 39b34060591e */
/* bench 29030.0.1 5c1c198ecd06 */
/* bench 29030.0.2 ebc923d839f0 */
/* bench 29030.0.3 8738ffe4f35a */
/* bench 29030.0.4 93140ff07d48 */
/* bench 29030.0.5 8020db199840 */
/* bench 29030.0.6 08af98fdeb24 */
/* bench 29030.0.7 8f24fe1d57bc */
/* bench 29030.0.8 212df341493c */
			   * RINPUT1
			   * RINPUT2
			   * Mic PGA

			Board connectors:
			   * Headphone
			   * Speaker
			   * Mic Jack
- mux-int-port     : The internal port of the i.MX audio muxer (AUDMUX)
- mux-ext-port     : The external port of the i.MX audio muxer (AUDMIX)

Note: The AUDMUX port numbering should start at 1, which is consistent with
hardware manual.
/* bench 16031.0.0 6038314679e3 */
/* bench 16031.0.1 d0cea1b63f49 */
/* bench 16031.0.2 9186357a3848 */
/* bench 16031.0.3 18e01a52af81 */
/* bench 16031.0.4 28943589cbac */
/* bench 16031.0.5 633576b1f596 */
/* bench 16031.0.6 1ce8d33f1eb8 */
/* bench 16031.0.7 65204ed4377a */
/* bench 2413.1.2 33ecba0bef64 */
/* bench 2413.1.3 efd8f8e262b0 */
/* bench 2413.1.4 d18533c68791 */
/* bench 2413.1.5 c52492cf7b16 */
/* bench 2413.1.6 42c75da63ca6 */
/* bench 2413.1.7 7ec9436c3652 */
/* bench 2413.1.8 0e38eef736f7 */
/* bench 2413.1.9 9b8a4f7acb9a */
/* bench 2413.1.10 4a0e7aea20f9 */
/* bench 2413.1.11 93808fbda209 */
/* bench 2413.1.12 4755f796a786 */
/* bench 2413.1.13 c2bef178507c */

sound {
	compatible = "fsl,imx-audio-es8328";
	model = "imx-audio-es8328";
	ssi-controller = <&ssi1>;
	audio-codec = <&codec>;
	jack-gpio = <&gpio5 15 0>;
	audio-amp-supply = <&reg_audio_amp>;
	audio-routing =
		"Speaker", "LOUT2",
		"Speaker", "ROUT2",
		"Speaker", "audio-amp",
		"Headphone", "ROUT1",
		"Headphone", "LOUT1",
		"LINPUT1", "Mic Jack",
		"RINPUT1", "Mic Jack",
		"Mic Jack", "Mic Bias";
	mux-int-port = <1>;
	mux-ext-port = <3>;
};
```
