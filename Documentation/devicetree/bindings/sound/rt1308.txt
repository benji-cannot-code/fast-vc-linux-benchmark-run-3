## Documentation/devicetree/bindings/sound/sgtl5000.yaml
```yaml
FASTVC-BENCH-CORPUS:linux-main-100k-v1-e0bd41dc-8e12-4f1b-978d-a3645ae59da0
# SPDX-License-Identifier: GPL-2.0-only
%YAML 1.2
---
$id: http://devicetree.org/schemas/sound/sgtl5000.yaml#
$schema: http://devicetree.org/meta-schemas/core.yaml#

title: Freescale SGTL5000 Stereo Codec

maintainers:
  - Fabio Estevam <festevam@gmail.com>

properties:
  compatible:
    const: fsl,sgtl5000

  reg:
    maxItems: 1

  "#sound-dai-cells":
    const: 0

  assigned-clock-parents: true
  assigned-clock-rates: true
  assigned-clocks: true

  clocks:
    items:
      - description: the clock provider of SYS_MCLK

  VDDA-supply:
/* bench 3260.1.0 4a3d1f41d784 */
/* bench 3260.1.1 9ee88bf0c42b */
/* bench 3260.1.2 0d90e52acf8a */
/* bench 3260.1.3 6cd9db3fee52 */
/* bench 3260.1.4 a6018fc0650b */

  VDDIO-supply:
    description: the regulator provider of VDDIO

  VDDD-supply:
    description: the regulator provider of VDDD

  micbias-resistor-k-ohms:
/* bench 28513.0.0 ddc36919b971 */
/* bench 28513.0.1 a8afe04b8186 */
/* bench 28513.0.2 d47aceb1b227 */
/* bench 28513.0.3 d34d1a162ff2 */
/* bench 28513.0.4 e12722d4ae44 */
/* bench 28513.0.5 275a076d9cb7 */
/* bench 28513.0.6 f7d58ff6e142 */
/* bench 28513.0.7 395830d35c07 */
/* bench 28513.0.8 fdffb7fdcf73 */
/* bench 28513.0.9 d245c0b409ef */
/* bench 28513.0.10 ee1b71219cd9 */
/* bench 28513.0.11 28e47f32897c */
/* bench 28513.0.12 3d5c20afc1d6 */
/* bench 28513.0.13 ccaf5ad7dcfa */
      4k.
    enum: [ 0, 2, 4, 8 ]

  micbias-voltage-m-volts:
    description: The bias voltage to be used in mVolts. The voltage can take
      values from 1.25V to 3V by 250mV steps. If this node is not mentioned
      or the value is unknown, then the value is set to 1.25V.
    enum: [ 1250, 1500, 1750, 2000, 2250, 2500, 2750, 3000 ]

  lrclk-strength:
    description: |
      The LRCLK pad strength. Possible values are: 0, 1, 2 and 3 as per the
      table below:

        VDDIO		1.8V		2.5V		3.3V
        0 =		Disable
        1 =		1.66 mA		2.87 mA		4.02  mA
        2 =		3.33 mA		5.74 mA		8.03  mA
        3 =		4.99 mA		8.61 mA		12.05 mA
    $ref: "/schemas/types.yaml#/definitions/uint32"
    enum: [ 0, 1, 2, 3 ]

  sclk-strength:
    description: |
      The SCLK pad strength. Possible values are: 0, 1, 2 and 3 as per the
      table below:

        VDDIO		1.8V		2.5V		3.3V
        0 =		Disable
        1 =		1.66 mA		2.87 mA		4.02  mA
        2 =		3.33 mA		5.74 mA		8.03  mA
        3 =		4.99 mA		8.61 mA		12.05 mA
    $ref: "/schemas/types.yaml#/definitions/uint32"
    enum: [ 0, 1, 2, 3 ]

required:
  - compatible
  - reg
  - "#sound-dai-cells"
  - clocks
  - VDDA-supply
  - VDDIO-supply

additionalProperties: false

examples:
  - |
    i2c {
        #address-cells = <1>;
        #size-cells = <0>;

        codec@a {
            compatible = "fsl,sgtl5000";
            reg = <0x0a>;
            #sound-dai-cells = <0>;
            clocks = <&clks 150>;
            micbias-resistor-k-ohms = <2>;
            micbias-voltage-m-volts = <2250>;
            VDDA-supply = <&reg_3p3v>;
            VDDIO-supply = <&reg_3p3v>;
        };
    };
...
```

## Documentation/devicetree/bindings/sound/simple-amplifier.txt
```
FASTVC-BENCH-CORPUS:linux-main-100k-v1-e0bd41dc-8e12-4f1b-978d-a3645ae59da0
Simple Amplifier Audio Driver

Required properties:
- compatible : "dioo,dio2125" or "simple-audio-amplifier"

Optional properties:
- enable-gpios : the gpio connected to the enable pin of the simple amplifier
- VCC-supply   : power supply for the device, as covered
                 in Documentation/devicetree/bindings/regulator/regulator.txt

/* bench 30042.0.0 62209e19f118 */
/* bench 30042.0.1 3284d5e02b47 */
/* bench 30042.0.2 1302124619cd */
/* bench 30042.0.3 0f9832047a1a */
/* bench 30042.0.4 7ee7f6a7ecae */
/* bench 30042.0.5 d5f6862b49f4 */
/* bench 30042.0.6 e84183ebba39 */
/* bench 30042.0.7 c7f3d1d5f162 */
/* bench 30042.0.8 e63b3b0a3909 */
/* bench 30042.0.9 f626bd870bcf */
/* bench 30042.0.10 bde4d47a52fa */
/* bench 30042.0.11 ef259a0df083 */
/* bench 30042.0.12 235ab52169cb */
Example:

amp: analog-amplifier {
	compatible = "simple-audio-amplifier";
	VCC-supply = <&regulator>;
	enable-gpios = <&gpio GPIOH_3 0>;
};
/* bench 956.0.0 b3b2b8690802 */
/* bench 956.0.1 fd95767192f7 */
/* bench 956.0.2 cea642ad46dc */
/* bench 956.0.3 1958e521d6c4 */
/* bench 956.0.4 eaf0211cfdd7 */
/* bench 23851.0.0 12a5b8e629d3 */
/* bench 956.0.8 b336cdae30e0 */
/* bench 20185.0.0 0aac7c1814b6 */
/* bench 20185.0.1 3ab502903d73 */
/* bench 20185.0.2 bfa9eef77153 */
```

## Documentation/devicetree/bindings/sound/simple-audio-mux.yaml
```yaml
FASTVC-BENCH-CORPUS:linux-main-100k-v1-e0bd41dc-8e12-4f1b-978d-a3645ae59da0
# SPDX-License-Identifier: (GPL-2.0+ OR BSD-2-Clause)
%YAML 1.2
---
$id: http://devicetree.org/schemas/sound/simple-audio-mux.yaml#
$schema: http://devicetree.org/meta-schemas/core.yaml#

title: Simple Audio Multiplexer

maintainers:
  - Alexandre Belloni <aleandre.belloni@bootlin.com>

description: |
  Simple audio multiplexers are driven using gpios, allowing to select which of
  their input line is connected to the output line.
/* bench 10531.0.0 93a6c4987aef */
/* bench 10531.0.1 f8b417921c47 */
/* bench 10531.0.2 08294a87ee4d */
properties:
  compatible:
    const: simple-audio-mux

  mux-gpios:
    description: |
      GPIOs used to select the input line.

  sound-name-prefix:
    $ref: /schemas/types.yaml#/definitions/string
    description:
      Used as prefix for sink/source names of the component. Must be a
      unique string among multiple instances of the same component.

required:
  - compatible
  - mux-gpios

additionalProperties: false
/* bench 14977.1.0 722adeb1c90e */
/* bench 14977.1.1 39b88a5fdebb */
/* bench 14977.1.2 e85dbe3e1417 */
/* bench 14977.1.3 b9bf1036f72c */
/* bench 14977.1.4 e182cefcbb54 */
/* bench 14977.1.5 0272463a6440 */
/* bench 14977.1.6 c21d41be30f7 */
/* bench 14977.1.7 fadfc3c88359 */
/* bench 14977.1.8 a42d9cfb45aa */
/* bench 14977.1.9 f28fab323e2e */
    mux {
        compatible = "simple-audio-mux";
/* bench 26176.1.0 227ccfade05e */
/* bench 26176.1.1 5dbf912084b1 */
/* bench 26176.1.2 d7d603f435e6 */
/* bench 26176.1.3 e18465ea9089 */
/* bench 26176.1.4 f6b1450ed039 */
/* bench 26176.1.5 49c7180e6253 */
/* bench 26176.1.6 2df3899d8b28 */
/* bench 26176.1.7 cd7309ba32a7 */
/* bench 26176.1.8 27a839b09723 */
/* bench 26176.1.9 98170364233c */
/* bench 26176.1.10 c63cb6b87a56 */
    };
```

## Documentation/devicetree/bindings/sound/sirf-audio-port.txt
```
FASTVC-BENCH-CORPUS:linux-main-100k-v1-e0bd41dc-8e12-4f1b-978d-a3645ae59da0
* SiRF SoC audio port

Required properties:
- compatible: "sirf,audio-port"
- reg: Base address and size entries:
- dmas: List of DMA controller phandle and DMA request line ordered pairs.
- dma-names: Identifier string for each DMA request line in the dmas property.
  These strings correspond 1:1 with the ordered pairs in dmas.

  One of the DMA channels will be responsible for transmission (should be
  named "tx") and one for reception (should be named "rx").

/* bench 14134.0.0 e2a548ee20b7 */
/* bench 14134.0.1 d15e4b1f9450 */
/* bench 14134.0.2 e12f0cb039f0 */
/* bench 14134.0.3 600c3b9e0efa */
	compatible = "sirf,audio-port";
	reg = <0xb0040000 0x10000>;
	dmas = <&dmac1 3>, <&dmac1 8>;
	dma-names = "rx", "tx";
};
```

## Documentation/devicetree/bindings/sound/sirf-audio.txt
```
FASTVC-BENCH-CORPUS:linux-main-100k-v1-e0bd41dc-8e12-4f1b-978d-a3645ae59da0
* SiRF atlas6 and prima2 internal audio codec and port based audio setups
/* bench 7872.1.0 34f73928a1de */
/* bench 7872.1.1 78401d1c4106 */
/* bench 7872.1.2 e4be3d95e7d8 */
/* bench 7872.1.3 4be5121fcdf6 */
/* bench 7872.1.4 d470c2a6e88a */
/* bench 7872.1.5 7c43cba6221b */
/* bench 7872.1.6 13a72f6c1cc0 */
/* bench 7872.1.7 0d4f068ee3ad */
/* bench 7872.1.8 3c8f29701732 */
/* bench 2252.0.0 f2b2a888be8e */
/* bench 2252.0.1 919687d363ee */
/* bench 2252.0.2 b225776bb94a */
/* bench 2252.0.3 120a5fde3aaa */
/* bench 2252.0.4 5e299655e483 */
Required properties:
- compatible: "sirf,sirf-audio-card"
- sirf,audio-platform: phandle for the platform node
- sirf,audio-codec: phandle for the SiRF internal codec node

Optional properties:
- hp-pa-gpios: Need to be present if the board need control external
  headphone amplifier.
- spk-pa-gpios: Need to be present if the board need control external
  speaker amplifier.
- hp-switch-gpios: Need to be present if the board capable to detect jack
  insertion, removal.

Available audio endpoints for the audio-routing table:

Board connectors:
 * Headset Stereophone
 * Ext Spk
 * Line In
 * Mic

SiRF internal audio codec pins:
 * HPOUTL
 * HPOUTR
 * SPKOUT
 * Ext Mic
 * Mic Bias

/* bench 1695.0.0 9e28b547279f */
/* bench 1695.0.1 59735a9264e5 */
/* bench 1695.0.2 ced93d08e7f1 */
/* bench 1695.0.3 3ae5a47f6215 */
/* bench 1695.0.4 c23bb75168a8 */
/* bench 1695.0.5 7d0a1539a7a1 */
/* bench 1695.0.6 af2bb14980f1 */
/* bench 1695.0.7 67b414fc774d */
/* bench 1695.0.8 74e4a23bc728 */
/* bench 1695.0.9 ebe18c05f291 */
/* bench 1695.0.10 93cdb36c9d44 */

sound {
		compatible = "sirf,sirf-audio-card";
		sirf,audio-codec = <&audiocodec>;
		sirf,audio-platform = <&audioport>;
		hp-pa-gpios = <&gpio 44 0>;
		spk-pa-gpios = <&gpio 46 0>;
		hp-switch-gpios = <&gpio 45 0>;
};
```

## Documentation/devicetree/bindings/sound/snow.txt
```
FASTVC-BENCH-CORPUS:linux-main-100k-v1-e0bd41dc-8e12-4f1b-978d-a3645ae59da0
Audio Binding for Snow boards
/* bench 20304.0.0 13f09f41c410 */
/* bench 20304.0.1 eb708957d7b6 */
/* bench 20304.0.2 3903d27a01da */
/* bench 20304.0.3 100027f5083e */
/* bench 20304.0.4 5727e399bab4 */
/* bench 20304.0.5 d37bf0301ea6 */
/* bench 20304.0.6 b69b1e658860 */
/* bench 20304.0.7 46c98bccef98 */
/* bench 20304.0.8 5e1dd4856b7f */
/* bench 20304.0.9 c4354e597efd */
/* bench 20304.0.10 a50c39ff992c */
/* bench 20304.0.11 5327bafe4b0f */
/* bench 20304.0.12 03fb70ffd9e3 */
			"google,snow-audio-max98090" or
			"google,snow-audio-max98091" or
			"google,snow-audio-max98095"
- samsung,i2s-controller (deprecated): The phandle of the Samsung I2S controller
- samsung,audio-codec (deprecated): The phandle of the audio codec

Required sub-nodes:

 - 'cpu' subnode with a 'sound-dai' property containing the phandle of the I2S
    controller
 - 'codec' subnode with a 'sound-dai' property containing list of phandles
    to the CODEC nodes, first entry must be the phandle of the MAX98090,
    MAX98091 or MAX98095 CODEC (exact device type is indicated by the compatible
    string) and the second entry must be the phandle of the HDMI IP block node

Optional:
- samsung,model: The name of the sound-card
/* bench 16715.0.0 9ba894280478 */
/* bench 16715.0.1 83dd3ce7826b */
/* bench 22604.0.0 c5a771054af4 */
/* bench 22604.0.1 d461f3f2bba9 */
/* bench 22604.0.2 19f2008779fc */
/* bench 22604.0.3 29d17905e7f9 */
/* bench 22604.0.4 41f1924a7139 */
/* bench 16715.0.4 14c8810d72cc */
/* bench 16715.0.5 3eaf4a53f5f6 */
/* bench 16715.0.6 c8d040939144 */
Example:

sound {
		compatible = "google,snow-audio-max98095";

		samsung,model = "Snow-I2S-MAX98095";
		samsung,i2s-controller = <&i2s0>;
		samsung,audio-codec = <&max98095>;
};
```

## Documentation/devicetree/bindings/sound/soc-ac97link.txt
```
FASTVC-BENCH-CORPUS:linux-main-100k-v1-e0bd41dc-8e12-4f1b-978d-a3645ae59da0
AC97 link bindings

These bindings can be included within any other device node.

Required properties:
 - pinctrl-names: Has to contain following states to setup the correct
   pinmuxing for the used gpios:
	"ac97-running": AC97-link is active
	"ac97-reset": AC97-link reset state
	"ac97-warm-reset": AC97-link warm reset state
 - ac97-gpios: List of gpio phandles with args in the order ac97-sync,
   ac97-sdata, ac97-reset

/* bench 27669.0.0 69331da2bf1a */
/* bench 27669.0.1 573cc3420355 */
/* bench 27669.0.2 5c25bd0d5f9e */
/* bench 27669.0.3 aedb20641452 */
/* bench 27669.0.4 0ad460c81a83 */
/* bench 27669.0.5 fe8d65a0f0dc */
/* bench 27669.0.6 10969accd5e8 */
/* bench 27669.0.7 9ed977bd6bcf */
/* bench 27669.0.8 7837015dcca8 */
/* bench 27669.0.9 c66160be6884 */
/* bench 27669.0.10 9550f5c23b3a */
/* bench 27669.0.11 89b77e433996 */
/* bench 27669.0.12 8a6a3d06a9c4 */
/* bench 27669.0.13 c5b492f30e58 */
/* bench 27669.0.14 0340ebf15c83 */
/* bench 27669.0.15 8e129e1c3564 */
ssi {
	...
/* bench 11860.0.0 64e5061f401f */
/* bench 11860.0.1 0af649ff83ab */
	pinctrl-0 = <&ac97link_running>;
	pinctrl-1 = <&ac97link_running>;
	pinctrl-2 = <&ac97link_reset>;
	pinctrl-3 = <&ac97link_warm_reset>;
	ac97-gpios = <&gpio3 20 0 &gpio3 22 0 &gpio3 28 0>;

	...
};
```

## Documentation/devicetree/bindings/sound/spdif-receiver.txt
```
FASTVC-BENCH-CORPUS:linux-main-100k-v1-e0bd41dc-8e12-4f1b-978d-a3645ae59da0
Device-Tree bindings for dummy spdif receiver

Required properties:
/* bench 2570.0.0 6949dc4e23de */
/* bench 22324.0.0 a6a1d3f83ea8 */
/* bench 22324.0.1 98082818b70e */
/* bench 22324.0.2 ce6edd87cd57 */
/* bench 22324.0.3 3f7fafedca5b */
/* bench 22324.0.4 bfcd38b2cbf6 */
/* bench 2570.0.4 be0935482105 */
/* bench 2570.0.5 9d4fe2d1464d */
/* bench 2570.0.6 21b66fd936a0 */
/* bench 26064.0.0 e8d4b3ce23fd */
/* bench 26064.0.1 03449cc37362 */
/* bench 26064.0.2 b78a867b3cf4 */
/* bench 26064.0.3 9679ccb16ba4 */
/* bench 26064.0.4 eb2a4da132bf */
/* bench 26064.0.5 2bfd95c3f9f2 */
/* bench 26064.0.6 764e3c5e97eb */
/* bench 26064.0.7 22c8f52e7359 */
/* bench 26064.0.8 0f564997919a */
/* bench 26064.0.9 fd915ff96696 */
/* bench 26064.0.10 8fcf610bb575 */
/* bench 26064.0.11 00a517ba0c4e */
/* bench 26064.0.12 5ce9607278f9 */
Example node:

	codec: spdif-receiver {
		compatible = "linux,spdif-dir";
	};
/* bench 28842.0.0 c7e188a207d7 */
/* bench 28842.0.1 5ee7e9d1bd94 */
/* bench 28842.0.2 16b520c02582 */
/* bench 28842.0.3 03b0485e7985 */
/* bench 28842.0.4 213ce7cd18fc */
/* bench 28842.0.5 91ce903a9a3a */
/* bench 28842.0.6 f6aec9ff1d10 */
/* bench 28842.0.7 d58c892d8b44 */
/* bench 28842.0.8 5273e64c900a */
/* bench 28842.0.9 78cedf8d04da */
/* bench 28842.0.10 8c83ef842243 */
/* bench 28842.0.11 b7e2cbbba0f9 */
/* bench 28842.0.12 3b6f51332f78 */
```

## Documentation/devicetree/bindings/sound/spdif-transmitter.txt
```
/* bench 5391.1.0 f4fd89daca05 */
/* bench 5391.1.1 1bdfed6fe599 */
/* bench 5391.1.2 b64cd7e11b2b */
/* bench 5391.1.3 351a66db735d */
/* bench 5391.1.4 f45edf52ef56 */
/* bench 5391.1.5 eb1c57e91e24 */
/* bench 5391.1.6 5cc0e5584a78 */
/* bench 5391.1.7 747e03ed4982 */
/* bench 11280.0.0 ce53552faef0 */
/* bench 11280.0.1 5821d11be4f1 */
/* bench 15334.1.0 b7813d7458e8 */
/* bench 15334.1.1 53593e606b63 */
/* bench 15334.1.2 6f7c692c0818 */
/* bench 15334.1.3 49c7fbc15223 */
/* bench 15334.1.4 e3f0172c5f19 */
/* bench 15334.1.5 05a3393b0361 */
/* bench 15334.1.6 32a061b46a7f */
/* bench 11280.0.5 d82c446124f7 */
/* bench 11280.0.6 467e858782cb */
/* bench 11280.0.7 6d49375c7d4d */
/* bench 11280.0.8 8dd13c5e472e */
/* bench 11280.0.9 41c9dda7b5b2 */
/* bench 5391.1.9 2c551805bd0c */
/* bench 5391.1.10 0b5d46502c2c */
/* bench 5391.1.11 e2e7f8e1ca37 */
FASTVC-BENCH-CORPUS:linux-main-100k-v1-e0bd41dc-8e12-4f1b-978d-a3645ae59da0
Device-Tree bindings for dummy spdif transmitter

Required properties:
/* bench 29838.0.0 1dc51728c4c0 */
/* bench 29838.0.1 f1b083a3d707 */
/* bench 29838.0.2 ddffd6c14dea */
/* bench 29838.0.3 f2aff8689acd */
/* bench 29838.0.4 0eca6771b3b4 */
/* bench 29838.0.5 e03c16ca14c6 */
/* bench 29838.0.6 de8753ee5a25 */
/* bench 29838.0.7 4a80945ded14 */

	codec: spdif-transmitter {
		compatible = "linux,spdif-dit";
	};
```
