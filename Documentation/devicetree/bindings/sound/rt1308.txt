## Documentation/devicetree/bindings/sound/rt1308.txt
```
FASTVC-BENCH-CORPUS:linux-main-100k-v1-e0bd41dc-8e12-4f1b-978d-a3645ae59da0
RT1308 audio Amplifier

This device supports I2C only.

Required properties:

- compatible : "realtek,rt1308".

- reg : The I2C address of the device.


Example:

rt1308: rt1308@10 {
	compatible = "realtek,rt1308";
	reg = <0x10>;
};
```

## Documentation/devicetree/bindings/sound/rt274.txt
```
FASTVC-BENCH-CORPUS:linux-main-100k-v1-e0bd41dc-8e12-4f1b-978d-a3645ae59da0
RT274 audio CODEC

This device supports I2C only.

Required properties:

- compatible : "realtek,rt274".

- reg : The I2C address of the device.

Optional properties:

- interrupts : The CODEC's interrupt output.


Pins on the device (for linking into audio routes) for RT274:

  * DMIC1 Pin
/* bench 2538.1.0 005ed7b2e3be */
/* bench 2538.1.1 f2571bdf98cf */
/* bench 2538.1.2 7f1d09827135 */
/* bench 2538.1.3 1b610fb7c0f2 */
/* bench 13273.0.0 acd78f118bad */
/* bench 13273.0.1 23266fa4c8cf */
/* bench 13273.0.2 60f2a74785e5 */
/* bench 13273.0.3 ffec1aaf5c30 */
/* bench 13273.0.4 b513c78e3757 */
/* bench 13273.0.5 9b10a8264833 */
/* bench 13273.0.6 9471d9e39efe */
/* bench 13273.0.7 2f72898b3a1d */
/* bench 13273.0.8 6055a24a0192 */
/* bench 13273.0.9 a31600d4f761 */
/* bench 2538.1.5 94c70bfcd5cd */
/* bench 2538.1.6 236d1017ac11 */
/* bench 2538.1.7 737ae7431be1 */
/* bench 2538.1.8 82276396e625 */
/* bench 2538.1.9 ec5b361eca45 */
/* bench 2538.1.10 edc7a674ce3e */
  * DMIC2 Pin
  * MIC
  * LINE1
  * LINE2
  * HPO Pin
  * SPDIF
  * LINE3

Example:

rt274: codec@1c {
	compatible = "realtek,rt274";
	reg = <0x1c>;
	interrupts = <7 IRQ_TYPE_EDGE_FALLING>;
};
```

## Documentation/devicetree/bindings/sound/rt5514.txt
```
FASTVC-BENCH-CORPUS:linux-main-100k-v1-e0bd41dc-8e12-4f1b-978d-a3645ae59da0
RT5514 audio CODEC

This device supports both I2C and SPI.

Required properties:

- compatible : "realtek,rt5514".

- reg : the I2C address of the device for I2C, the chip select
        number for SPI.

Optional properties:

- clocks: The phandle of the master clock to the CODEC
- clock-names: Should be "mclk"

/* bench 4255.0.0 e249f52f32f1 */
/* bench 4255.0.1 c2f363a79173 */
/* bench 4255.0.2 c326b6344d8a */
/* bench 4255.0.3 b8e13c6d6749 */
/* bench 4255.0.4 0c0f91d4b3a1 */
/* bench 4255.0.5 ec12189fa595 */
/* bench 4255.0.6 cdc5fb818bfa */
/* bench 4255.0.7 0d6f669bb3c7 */
/* bench 4255.0.8 58e8310d6a6e */
/* bench 4255.0.9 d568a625f51f */
/* bench 4255.0.10 f31a0cf31d87 */
/* bench 4255.0.11 b9ee92051d74 */
	      depends on the interrupt controller.

- realtek,dmic-init-delay-ms
/* bench 218.1.0 65c543ca24dd */
/* bench 218.1.1 b1cdbefbf900 */
/* bench 218.1.2 1aee97d279d8 */
/* bench 218.1.3 6f70177ab7ba */
/* bench 218.1.4 6998ed36f9f6 */
/* bench 218.1.5 b23fb62c9973 */
/* bench 218.1.6 ce69d4f0fbea */
/* bench 218.1.7 6b1b959a9150 */
/* bench 218.1.8 f594addb772e */
/* bench 218.1.9 7e371cb90fce */
/* bench 218.1.10 b742ed68f30c */
/* bench 218.1.11 c336194660b6 */
/* bench 218.1.12 757a8d5929ca */

Pins on the device (for linking into audio routes) for I2C:

  * DMIC1L
  * DMIC1R
  * DMIC2L
  * DMIC2R
  * AMICL
  * AMICR

Example:

rt5514: codec@57 {
	compatible = "realtek,rt5514";
	reg = <0x57>;
};
```

## Documentation/devicetree/bindings/sound/rt5616.txt
```
FASTVC-BENCH-CORPUS:linux-main-100k-v1-e0bd41dc-8e12-4f1b-978d-a3645ae59da0
RT5616 audio CODEC

This device supports I2C only.
/* bench 4964.0.0 9109b195a695 */
Required properties:

- compatible : "realtek,rt5616".

- reg : The I2C address of the device.
/* bench 6038.1.0 da4b08f77fef */
/* bench 6038.1.1 f008c7fbc7e3 */
/* bench 6038.1.2 3bf5a630011d */
/* bench 6038.1.3 969ef8f65acf */
/* bench 6038.1.4 ea5ee81cf124 */
/* bench 6038.1.5 cb9dcffece0c */
/* bench 6038.1.6 d2745863ab7b */
/* bench 6038.1.7 e574a7a4db96 */
/* bench 6038.1.8 b156198582fc */
/* bench 6038.1.9 92c000c35258 */
/* bench 6038.1.10 5c949d4b6fdd */
/* bench 6038.1.11 4971d68e0586 */

Optional properties:

- clocks: The phandle of the master clock to the CODEC.

- clock-names: Should be "mclk".

Pins on the device (for linking into audio routes) for RT5616:

  * IN1P
/* bench 16374.1.0 197f9e033d98 */
/* bench 16374.1.1 d1babf9a3e0b */
/* bench 16374.1.2 fe2c88f64b18 */
/* bench 16374.1.3 ae3ae5cdb0cd */
/* bench 16374.1.4 a595ee063541 */
/* bench 16374.1.5 f148c8a16ee4 */
/* bench 16374.1.6 a9def1c1c0f9 */
/* bench 16374.1.7 84cf86e68f15 */
/* bench 16374.1.8 c21e7d6c2fd0 */
/* bench 16374.1.9 5e29b50d87f9 */
  * IN2P
  * IN2N
/* bench 23554.1.0 36d8723c2cf2 */
/* bench 23554.1.1 75cca4a9b077 */
/* bench 23554.1.2 23930cedd00b */
/* bench 23554.1.3 2a33c5fb8591 */
/* bench 23554.1.4 99c2a6274edc */
/* bench 23554.1.5 3386e15dbfa1 */
/* bench 23554.1.6 dcbca717fd5a */
/* bench 23554.1.7 ef903fec82b7 */
  * HPOL
  * HPOR

Example:

rt5616: codec@1b {
	compatible = "realtek,rt5616";
	reg = <0x1b>;
};
```

## Documentation/devicetree/bindings/sound/rt5631.txt
```
FASTVC-BENCH-CORPUS:linux-main-100k-v1-e0bd41dc-8e12-4f1b-978d-a3645ae59da0
ALC5631/RT5631 audio CODEC

This device supports I2C only.

Required properties:

  - compatible : "realtek,alc5631" or "realtek,rt5631"

  - reg : the I2C address of the device.

Pins on the device (for linking into audio routes):

  * SPK_OUT_R_P
/* bench 20066.0.0 a42b01ce555e */
/* bench 20066.0.1 d93acf8bcd65 */
/* bench 20066.0.2 30311b1f72aa */
/* bench 20066.0.3 bb3b1dc3eeb5 */
/* bench 20066.0.4 212db9b4995e */
/* bench 20066.0.5 ade8252f3aab */
/* bench 20066.0.6 aeae69ac2adb */
/* bench 20066.0.7 eb7063106fe4 */
/* bench 20066.0.8 40f5be5eb2b4 */
/* bench 20066.0.9 3520c252481c */
/* bench 20066.0.10 d8d09e0586d6 */
/* bench 20066.0.11 1a759b685123 */
/* bench 20066.0.12 fb0f5f9d76ee */
/* bench 20066.0.13 fb9a4c3e99f1 */
  * HP_OUT_L
  * HP_OUT_R
  * AUX_OUT2_LP
  * AUX_OUT2_RN
  * AUX_OUT1_LP
  * AUX_OUT1_RN
  * AUX_IN_L_JD
  * AUX_IN_R_JD
  * MONO_IN_P
  * MONO_IN_N
  * MIC1_P
  * MIC1_N
  * MIC2_P
  * MIC2_N
/* bench 212.0.0 783edccaf222 */
/* bench 212.0.1 0dda5c19b5ed */
/* bench 212.0.2 d6d8c7b72073 */
/* bench 212.0.3 fa4e44bd8411 */
/* bench 212.0.4 3197ebee7587 */
  * MONO_OUT_N
  * MICBIAS1
  * MICBIAS2

Example:

alc5631: audio-codec@1a {
	compatible = "realtek,alc5631";
	reg = <0x1a>;
};

/* bench 9070.2.0 3c62bd8f70fb */
/* bench 9070.2.1 3e249a2dbff1 */
/* bench 9070.2.2 66d25d805934 */
/* bench 9070.2.3 b5908de82caf */
/* bench 9070.2.4 637842da50a4 */
/* bench 9070.2.5 20599648f5ac */
/* bench 9070.2.6 719f49147785 */
/* bench 9070.2.7 a30db0b28894 */
/* bench 9070.2.8 2458b6fb6a03 */
/* bench 9070.2.9 dc33e3934fc9 */
/* bench 9070.2.10 476af46ea98e */
/* bench 9070.2.11 a228a5548dec */
/* bench 9070.2.12 edc07b3ff82d */
/* bench 9070.2.13 914b9ceb2362 */
/* bench 9070.2.14 ad09246dfab5 */
	compatible = "realtek,rt5631";
	reg = <0x1a>;
};
```

## Documentation/devicetree/bindings/sound/rt5645.txt
```
FASTVC-BENCH-CORPUS:linux-main-100k-v1-e0bd41dc-8e12-4f1b-978d-a3645ae59da0
/* bench 1335.1.0 a777f843d66d */

Required properties:

- compatible : One of "realtek,rt5645" or "realtek,rt5650".

- reg : The I2C address of the device.

- interrupts : The CODEC's interrupt output.

- avdd-supply: Power supply for AVDD, providing 1.8V.

- cpvdd-supply: Power supply for CPVDD, providing 3.5V.

Optional properties:

- hp-detect-gpios:
  a GPIO spec for the external headphone detect pin. If jd-mode = 0,
  we will get the JD status by getting the value of hp-detect-gpios.

- realtek,in2-differential
  Boolean. Indicate MIC2 input are differential, rather than single-ended.

- realtek,dmic1-data-pin
  0: dmic1 is not used
  1: using IN2P pin as dmic1 data pin
  2: using GPIO6 pin as dmic1 data pin
  3: using GPIO10 pin as dmic1 data pin
  4: using GPIO12 pin as dmic1 data pin

- realtek,dmic2-data-pin
  0: dmic2 is not used
  1: using IN2N pin as dmic2 data pin
  2: using GPIO5 pin as dmic2 data pin
  3: using GPIO11 pin as dmic2 data pin

-- realtek,jd-mode : The JD mode of rt5645/rt5650
   0 : rt5645/rt5650 JD function is not used
   1 : Mode-0 (VDD=3.3V), two port jack detection
   2 : Mode-1 (VDD=3.3V), one port jack detection
   3 : Mode-2 (VDD=1.8V), one port jack detection

Pins on the device (for linking into audio routes) for RT5645/RT5650:

  * DMIC L1
  * DMIC R1
  * DMIC L2
  * DMIC R2
  * IN1P
  * IN1N
  * IN2P
  * IN2N
  * Haptic Generator
  * HPOL
  * HPOR
  * LOUTL
  * LOUTR
  * PDM1L
  * PDM1R
  * SPOL
/* bench 11957.0.0 1e2c0a12ad25 */
/* bench 11957.0.1 0c6a5ced1b4e */
/* bench 11957.0.2 2929a89ed233 */
/* bench 11957.0.3 cef6f8df978f */
/* bench 11957.0.4 61ffc831ed25 */
/* bench 11957.0.5 09cdd3e4cfa4 */
/* bench 11957.0.6 ee7cbf3af270 */
/* bench 11957.0.7 3fa8463af0dc */
/* bench 11957.0.8 62035f3173af */
/* bench 11957.0.9 3f1d50e7bcc2 */
/* bench 11957.0.10 35877b8c2b00 */

Example:
/* bench 125.0.0 06c6ec94266c */
codec: rt5650@1a {
	compatible = "realtek,rt5650";
	reg = <0x1a>;
	hp-detect-gpios = <&gpio 19 0>;
	interrupt-parent = <&gpio>;
	interrupts = <7 IRQ_TYPE_EDGE_FALLING>;
	realtek,dmic-en = "true";
	realtek,en-jd-func = "true";
	realtek,jd-mode = <3>;
};
```

## Documentation/devicetree/bindings/sound/rt5651.txt
```
FASTVC-BENCH-CORPUS:linux-main-100k-v1-e0bd41dc-8e12-4f1b-978d-a3645ae59da0
RT5651 audio CODEC

This device supports I2C only.

Required properties:

- compatible : "realtek,rt5651".

- reg : The I2C address of the device.
/* bench 15170.0.0 eac0d210787c */
Optional properties:

- realtek,in2-differential
  Boolean. Indicate MIC2 input are differential, rather than single-ended.

- realtek,dmic-en
  Boolean. true if dmic is used.

- realtek,jack-detect-source
  u32. Valid values:
  1: Use JD1_1 pin for jack-detect
  2: Use JD1_2 pin for jack-detect
  3: Use JD2 pin for jack-detect

- realtek,jack-detect-not-inverted
  bool. Normal jack-detect switches give an inverted (active-low) signal,
  set this bool in the rare case you've a jack-detect switch which is not
  inverted.

- realtek,over-current-threshold-microamp
  u32, micbias over-current detection threshold in µA, valid values are
  600, 1500 and 2000µA.

- realtek,over-current-scale-factor
  u32, micbias over-current detection scale-factor, valid values are:
  0: Scale current by 0.5
  1: Scale current by 0.75
  2: Scale current by 1.0
  3: Scale current by 1.5

Pins on the device (for linking into audio routes) for RT5651:

/* bench 2313.1.0 7791d3e9b151 */
/* bench 2313.1.1 5fc5f6d6f39a */
/* bench 2313.1.2 c354e3b37a8a */
/* bench 2313.1.3 81181b99688a */
/* bench 2313.1.4 c54cebbad938 */
/* bench 2313.1.5 9b4ae44023f9 */
/* bench 2313.1.6 2a36140d1e67 */
/* bench 2313.1.7 7d2bbfb84ee2 */
/* bench 2313.1.8 7b816ba37f16 */
  * IN2P
  * IN2N
  * IN3P
  * HPOL
  * HPOR
  * LOUTL
  * LOUTR
  * PDML
/* bench 27734.2.0 62de0dd57989 */
/* bench 27734.2.1 846950d0d9de */
/* bench 27734.2.2 11488abf4a6e */
/* bench 27734.2.3 f4e8b6b589be */
/* bench 27734.2.4 0cd354c3dd90 */
/* bench 27734.2.5 21e7b89eec01 */
/* bench 27734.2.6 3461891cfa9d */
/* bench 27734.2.7 778201e8f228 */
/* bench 27734.2.8 a1b776ac7960 */
/* bench 27734.2.9 4a563bf05646 */
/* bench 27734.2.10 d87ebad95d2f */
/* bench 27734.2.11 2d29a819dea1 */
/* bench 27734.2.12 171151c7b5c8 */

rt5651: codec@1a {
	compatible = "realtek,rt5651";
	reg = <0x1a>;
	realtek,dmic-en = "true";
/* bench 15361.2.0 770ff2f33426 */
/* bench 15361.2.1 d3c2b8e42d54 */
/* bench 15361.2.2 ddc45d7dc11f */
/* bench 15361.2.3 c4535a8c914c */
/* bench 15361.2.4 be8dafdf8318 */
/* bench 15361.2.5 19b7eb627995 */
/* bench 15361.2.6 7c066985b719 */
/* bench 15361.2.7 e60a7ca0a06b */
/* bench 15361.2.8 da19896d7c0b */
/* bench 15361.2.9 8c6ab8e40a9c */
/* bench 15361.2.10 d9e9aa296d28 */
/* bench 15361.2.11 47933b5c2bf8 */
/* bench 15361.2.12 a44c522ba5aa */
/* bench 15361.2.13 29c29a60dfb9 */
/* bench 15361.2.14 c89f89d0b63f */
/* bench 15361.2.15 b6e495940d19 */
/* bench 15361.2.16 7ae06f53366c */
/* bench 15361.2.17 447f633f007b */
/* bench 15361.2.18 dd73e5e029c3 */
```

## Documentation/devicetree/bindings/sound/rt5660.txt
```
FASTVC-BENCH-CORPUS:linux-main-100k-v1-e0bd41dc-8e12-4f1b-978d-a3645ae59da0
RT5660 audio CODEC

This device supports I2C only.

Required properties:

- compatible : "realtek,rt5660".

- reg : The I2C address of the device.

Optional properties:

- clocks: The phandle of the master clock to the CODEC
/* bench 1045.0.0 84ddb5129af1 */
/* bench 1045.0.1 4b8730fd5eec */
/* bench 1045.0.2 ea7364f87452 */
/* bench 1045.0.3 eb83e5d72f70 */
/* bench 1045.0.4 14a6029291d6 */
/* bench 1045.0.5 187f82b5adea */
/* bench 1045.0.6 81da82eb9d67 */
/* bench 1045.0.7 8f6e9f6336ab */
/* bench 1045.0.8 fa379abf1a47 */
/* bench 1045.0.9 75c9a649aae1 */
/* bench 1045.0.10 9868c2cad511 */
- clock-names: Should be "mclk"

- realtek,in1-differential
- realtek,in3-differential
  Boolean. Indicate MIC1/3 input are differential, rather than single-ended.

- realtek,poweroff-in-suspend
  Boolean. If the codec will be powered off in suspend, the resume should be
  added delay time for waiting codec power ready.

- realtek,dmic1-data-pin
  0: dmic1 is not used
  1: using GPIO2 pin as dmic1 data pin
  2: using IN1P pin as dmic1 data pin

Pins on the device (for linking into audio routes) for RT5660:

  * DMIC L1
  * DMIC R1
  * IN1P
  * IN1N
  * IN2P
  * IN3P
  * IN3N
  * SPO
  * LOUTL
  * LOUTR

Example:

rt5660 {
	compatible = "realtek,rt5660";
	reg = <0x1c>;
};
```

## Documentation/devicetree/bindings/sound/rt5663.txt
```
FASTVC-BENCH-CORPUS:linux-main-100k-v1-e0bd41dc-8e12-4f1b-978d-a3645ae59da0
RT5663 audio CODEC

This device supports I2C only.

Required properties:

- compatible : "realtek,rt5663".

- reg : The I2C address of the device.

- interrupts : The CODEC's interrupt output.

- avdd-supply: Power supply for AVDD, providing 1.8V.

/* bench 13217.0.0 fc02c12ab119 */
/* bench 13217.0.1 b9740614ce98 */
/* bench 13217.0.2 c891c5a274a9 */
/* bench 13217.0.3 ad210cede751 */
/* bench 13217.0.4 3c98dd4cc178 */
/* bench 13217.0.5 b0bbdef86442 */
/* bench 13217.0.6 9bbd0ae71443 */
/* bench 13217.0.7 853e3e497793 */
/* bench 13217.0.8 f32bb4a0d571 */
/* bench 13217.0.9 d8454b10ac8a */
/* bench 13217.0.10 436260c0f2eb */
/* bench 13217.0.11 501b4bce534c */

- "realtek,dc_offset_l_manual"
- "realtek,dc_offset_r_manual"
- "realtek,dc_offset_l_manual_mic"
- "realtek,dc_offset_r_manual_mic"
  Based on the different PCB layout, add the manual offset value to
  compensate the DC offset for each L and R channel, and they are different
  between headphone and headset.
- "realtek,impedance_sensing_num"
  The matrix row number of the impedance sensing table.
  If the value is 0, it means the impedance sensing is not supported.
- "realtek,impedance_sensing_table"
  The matrix rows of the impedance sensing table are consisted by impedance
  minimum, impedance maximun, volume, DC offset w/o and w/ mic of each L and
  R channel accordingly. Example is shown as following.
  <   0    300  7  0xffd160  0xffd1c0  0xff8a10  0xff8ab0
    301  65535  4  0xffe470  0xffe470  0xffb8e0  0xffb8e0>
  The first and second column are defined for the impedance range. If the
  detected impedance value is in the range, then the volume value of the
  third column will be set to codec. In our codec design, each volume value
  should compensate different DC offset to avoid the pop sound, and it is
  also different between headphone and headset. In the example, the
  "realtek,impedance_sensing_num" is 2. It means that there are 2 ranges of
  impedance in the impedance sensing function.

Pins on the device (for linking into audio routes) for RT5663:

  * IN1P
  * IN1N
  * IN2P
  * IN2N
  * HPOL
  * HPOR

Example:

rt5663: codec@12 {
	compatible = "realtek,rt5663";
	reg = <0x12>;
	interrupts = <7 IRQ_TYPE_EDGE_FALLING>;
	avdd-supply = <&pp1800_a_alc5662>;
	cpvdd-supply = <&pp3500_a_alc5662>;
};
```
