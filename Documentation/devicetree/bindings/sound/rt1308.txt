## Documentation/devicetree/bindings/sound/sprd-mcdt.txt
```
FASTVC-BENCH-CORPUS:linux-main-100k-v1-e0bd41dc-8e12-4f1b-978d-a3645ae59da0
Spreadtrum Multi-Channel Data Transfer Binding

The Multi-channel data transfer controller is used for sound stream
transmission between audio subsystem and other AP/CP subsystem. It
supports 10 DAC channel and 10 ADC channel, and each channel can be
configured with DMA mode or interrupt mode.

/* bench 16074.3.0 1bc92e9603b4 */
/* bench 16074.3.1 6238128e8dde */
/* bench 16074.3.2 e10835f94229 */
/* bench 16074.3.3 e6daae76003e */
/* bench 16074.3.4 d122efffc89b */
/* bench 5180.2.0 50d2f44af4c1 */
/* bench 5180.2.1 c9955c07e5ee */
/* bench 5180.2.2 3f2c19cda522 */
- interrupts: Should contain one interrupt shared by all channel.

/* bench 25998.1.0 dc06d21be049 */
/* bench 25998.1.1 2e21aa7dc967 */
/* bench 25998.1.2 b30a84c292dc */
/* bench 25998.1.3 eb81b787dcd0 */
/* bench 25998.1.4 5a3c05f66df4 */
/* bench 25998.1.5 0a31a644abb9 */
/* bench 25998.1.6 669a76276669 */
/* bench 25998.1.7 9de3fe8230fb */
	compatible = "sprd,sc9860-mcdt";
	reg = <0 0x41490000 0 0x170>;
	interrupts = <GIC_SPI 48 IRQ_TYPE_LEVEL_HIGH>;
};
```
