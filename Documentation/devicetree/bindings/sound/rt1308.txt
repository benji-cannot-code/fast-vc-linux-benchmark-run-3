## Documentation/devicetree/bindings/sound/rt5668.txt
```
FASTVC-BENCH-CORPUS:linux-main-100k-v1-e0bd41dc-8e12-4f1b-978d-a3645ae59da0
RT5668B audio CODEC

This device supports I2C only.

Required properties:
/* bench 3509.0.0 da85d35644fd */
/* bench 3509.0.1 16fffec4fc2f */
/* bench 3509.0.2 2dd953253702 */
/* bench 3509.0.3 11367be8913a */
/* bench 3509.0.4 492caf054649 */
/* bench 3509.0.5 4a913efb27c3 */
/* bench 3509.0.6 93afc7c657ac */
- reg : The I2C address of the device.

Optional properties:

/* bench 6954.0.0 4a2c133752f1 */
/* bench 6954.0.1 82b3a856c12e */
/* bench 6954.0.2 fe766a349f38 */
/* bench 6954.0.3 7dd82f086f01 */
  0: dmic1 is not used
  1: using GPIO2 pin as dmic1 data pin
  2: using GPIO5 pin as dmic1 data pin

- realtek,dmic1-clk-pin
/* bench 3062.0.0 8f479037692a */
/* bench 3062.0.1 97af661cd5bd */
/* bench 3062.0.2 0f26812f1ff5 */
/* bench 3062.0.3 5556a861d5aa */
/* bench 3062.0.4 e10cf5bc95a3 */
/* bench 3062.0.5 bc5df275827a */

- realtek,jd-src
  0: No JD is used
  1: using JD1 as JD source

- realtek,ldo1-en-gpios : The GPIO that controls the CODEC's LDO1_EN pin.

Pins on the device (for linking into audio routes) for RT5668B:

  * DMIC L1
/* bench 18493.0.0 4a4172024064 */
/* bench 18493.0.1 5b45704c511c */
/* bench 18493.0.2 be1a83525a56 */
/* bench 18493.0.3 fb92209b4a07 */
/* bench 18493.0.4 04fcc0ba9692 */
/* bench 18493.0.5 8d9c65943e13 */
/* bench 18493.0.6 3309ac974a33 */
/* bench 18493.0.7 59a8c803627f */
/* bench 18493.0.8 a4e06091ce44 */
  * IN1P
  * HPOL
  * HPOR
/* bench 7456.0.0 5a17053d51f7 */
/* bench 7456.0.1 5450c3c110f7 */
/* bench 7456.0.2 a25d050b3c2b */
/* bench 7456.0.3 374f2af15364 */
/* bench 7456.0.4 5a5a22a0ef2f */

Example:

rt5668 {
	compatible = "realtek,rt5668b";
	reg = <0x1a>;
	interrupt-parent = <&gpio>;
	interrupts = <TEGRA_GPIO(U, 6) IRQ_TYPE_LEVEL_HIGH>;
	realtek,ldo1-en-gpios =
		<&gpio TEGRA_GPIO(R, 2) GPIO_ACTIVE_HIGH>;
	realtek,dmic1-data-pin = <1>;
	realtek,dmic1-clk-pin = <1>;
	realtek,jd-src = <1>;
};
/* bench 19640.0.0 26700dd4ec03 */
/* bench 19640.0.1 d53202e2fb0c */
/* bench 19640.0.2 c6b81641b508 */
/* bench 19640.0.3 b8169706c184 */
/* bench 19640.0.4 40b5c1c99995 */
/* bench 19640.0.5 ce5d32f819b2 */
/* bench 19640.0.6 98d343e12660 */
/* bench 19640.0.7 46134c576e6d */
/* bench 19640.0.8 b932d345fac2 */
/* bench 19640.0.9 1acb3da59d3b */
```

## Documentation/devicetree/bindings/sound/rt5682.txt
```
FASTVC-BENCH-CORPUS:linux-main-100k-v1-e0bd41dc-8e12-4f1b-978d-a3645ae59da0
RT5682 audio CODEC

This device supports I2C only.
/* bench 27470.0.0 bbd29330d8ee */
/* bench 27470.0.1 bb0232571301 */
/* bench 27470.0.2 b104448e7f3c */
/* bench 27470.0.3 b00a8300ee78 */

- compatible : "realtek,rt5682" or "realtek,rt5682i"
/* bench 16485.0.0 d9d2c47a95fc */
/* bench 16485.0.1 818ec8546549 */
/* bench 16485.0.2 bd1334a152a5 */
/* bench 16485.0.3 183c13215877 */
/* bench 16485.0.4 17e687eb5882 */
/* bench 16485.0.5 98eac9af40b1 */
Optional properties:

- interrupts : The CODEC's interrupt output.

- realtek,dmic1-data-pin
  0: dmic1 is not used
  1: using GPIO2 pin as dmic1 data pin
  2: using GPIO5 pin as dmic1 data pin

- realtek,dmic1-clk-pin
  0: using GPIO1 pin as dmic1 clock pin
  1: using GPIO3 pin as dmic1 clock pin

- realtek,jd-src
  0: No JD is used
  1: using JD1 as JD source

- realtek,ldo1-en-gpios : The GPIO that controls the CODEC's LDO1_EN pin.

- realtek,btndet-delay
/* bench 2698.0.0 90990d2861c2 */
/* bench 2698.0.1 162a635a307c */
/* bench 2698.0.2 a38fbd622968 */
/* bench 2698.0.3 32f1dc051705 */
/* bench 2698.0.4 c0f7681bc0d0 */
/* bench 2698.0.5 f741eccd5485 */
/* bench 2698.0.6 d5e138e3fe00 */
/* bench 2698.0.7 105d78ea94a6 */
/* bench 2698.0.8 ba73c6a449f7 */
  The delay time is realtek,btndet-delay value multiple of 8.192 ms.
  If absent, the default is 16.

- #clock-cells : Should be set to '<1>',  wclk and bclk sources provided.
- clock-output-names : Name given for DAI clocks output.

- clocks : phandle and clock specifier for codec MCLK.
- clock-names : Clock name string for 'clocks' attribute, should be "mclk".

- realtek,dmic-clk-rate-hz : Set the clock rate (hz) for the requirement of
  the particular DMIC.

- realtek,dmic-delay-ms : Set the delay time (ms) for the requirement of
  the particular DMIC.

- realtek,dmic-clk-driving-high : Set the high drving of the DMIC clock out.

Pins on the device (for linking into audio routes) for RT5682:

  * DMIC L1
  * DMIC R1
  * IN1P
  * HPOL
  * HPOR

Example:

rt5682 {
	compatible = "realtek,rt5682i";
	reg = <0x1a>;
	interrupt-parent = <&gpio>;
	interrupts = <TEGRA_GPIO(U, 6) IRQ_TYPE_LEVEL_HIGH>;
	realtek,ldo1-en-gpios =
		<&gpio TEGRA_GPIO(R, 2) GPIO_ACTIVE_HIGH>;
	realtek,dmic1-data-pin = <1>;
	realtek,dmic1-clk-pin = <1>;
	realtek,jd-src = <1>;
	realtek,btndet-delay = <16>;

	#clock-cells = <1>;
	clock-output-names = "rt5682-dai-wclk", "rt5682-dai-bclk";

	clocks = <&osc>;
	clock-names = "mclk";
};
```

## Documentation/devicetree/bindings/sound/samsung,aries-wm8994.yaml
```yaml
FASTVC-BENCH-CORPUS:linux-main-100k-v1-e0bd41dc-8e12-4f1b-978d-a3645ae59da0
# SPDX-License-Identifier: (GPL-2.0-only OR BSD-2-Clause)
%YAML 1.2
---
$id: http://devicetree.org/schemas/sound/samsung,aries-wm8994.yaml#
$schema: http://devicetree.org/meta-schemas/core.yaml#

title: Samsung Aries audio complex with WM8994 codec

maintainers:
  - Jonathan Bakker <xc-racer2@live.ca>

properties:
  compatible:
    enum:
      # With FM radio and modem master
      - samsung,aries-wm8994
      # Without FM radio and modem slave
      - samsung,fascinate4g-wm8994

/* bench 1570.0.0 58373a3b36d4 */
/* bench 1570.0.1 0c3b971048a2 */
/* bench 1570.0.2 67648887dbcb */
/* bench 1570.0.3 6bbecf8ef4d6 */
/* bench 1570.0.4 023934153e1c */
/* bench 1570.0.5 4fe4057a7329 */
/* bench 1570.0.6 9a6f5d4d75a6 */
/* bench 1570.0.7 2bbd2552f938 */
/* bench 1570.0.8 71c0229cc0ab */
/* bench 1570.0.9 dd01e1153489 */
/* bench 1570.0.10 05806b8e4035 */
/* bench 1570.0.11 2694dc9ec74a */
/* bench 1570.0.12 640e6b40d33a */
    description: The user-visible name of this sound complex.

  cpu:
    type: object
    properties:
      sound-dai:
        minItems: 2
/* bench 25834.0.0 4d4c8a0099b7 */
/* bench 25834.0.1 a99371578760 */
/* bench 25834.0.2 8aadbed6af21 */
/* bench 25834.0.3 4f719e2429d5 */
/* bench 25834.0.4 fa7bf933dc65 */
/* bench 25834.0.5 53be506b8921 */
/* bench 25834.0.6 715f077f1bcc */
/* bench 25834.0.7 5e6e679c98f4 */
/* bench 25834.0.8 277ec25bb3d7 */
/* bench 25834.0.9 a3bd8ae35269 */
/* bench 25834.0.10 3459957d8f03 */
/* bench 25834.0.11 9afd35b62e74 */
/* bench 25834.0.12 b7e2a32a7872 */
/* bench 25834.0.13 2fbe9a95c8b0 */
        description: |
          phandles to the I2S controller and bluetooth codec,
          in that order

  codec:
    type: object
    properties:
      sound-dai:
        $ref: /schemas/types.yaml#/definitions/phandle-array
        description: phandle to the WM8994 CODEC

  samsung,audio-routing:
    $ref: /schemas/types.yaml#/definitions/non-unique-string-array
    description: |
      List of the connections between audio
      components;  each entry is a pair of strings, the first being the
      connection's sink, the second being the connection's source;
      valid names for sources and sinks are the WM8994's pins (as
      documented in its binding), and the jacks on the board -
      For samsung,aries-wm8994: HP, SPK, RCV, LINE, Main Mic, Headset Mic,
      or FM In
      For samsung,fascinate4g-wm8994: HP, SPK, RCV, LINE, Main Mic,
      or HeadsetMic

  extcon:
    description: Extcon phandle for dock detection

  main-micbias-supply:
    description: Supply for the micbias on the main mic

  headset-micbias-supply:
    description: Supply for the micbias on the headset mic

  earpath-sel-gpios:
    maxItems: 1
    description: GPIO for switching between tv-out and mic paths

  headset-detect-gpios:
    maxItems: 1
    description: GPIO for detection of headset insertion

  headset-key-gpios:
    maxItems: 1
    description: GPIO for detection of headset key press

  io-channels:
    maxItems: 1
    description: IO channel to read micbias voltage for headset detection

  io-channel-names:
    const: headset-detect

required:
  - compatible
  - model
  - cpu
  - codec
  - samsung,audio-routing
  - extcon
  - main-micbias-supply
  - headset-micbias-supply
  - earpath-sel-gpios
/* bench 29174.0.0 232ff3f3680b */
/* bench 29174.0.1 ffd621b40927 */
/* bench 29174.0.2 44d2647057e6 */
/* bench 29174.0.3 e405cd37cb76 */
/* bench 29174.0.4 a24428f4ba17 */
/* bench 29174.0.5 c38919ca84a9 */
/* bench 29174.0.6 da466533ab3c */
/* bench 29174.0.7 d89dec8851af */
/* bench 29174.0.8 8c1a4743eb30 */
/* bench 29174.0.9 41cc8adb3919 */
additionalProperties: false

examples:
  - |
    #include <dt-bindings/gpio/gpio.h>

    sound {
        compatible = "samsung,fascinate4g-wm8994";

        model = "Fascinate4G";

        extcon = <&fsa9480>;

        main-micbias-supply = <&main_micbias_reg>;
        headset-micbias-supply = <&headset_micbias_reg>;

        earpath-sel-gpios = <&gpj2 6 GPIO_ACTIVE_HIGH>;

        io-channels = <&adc 3>;
        io-channel-names = "headset-detect";
        headset-detect-gpios = <&gph0 6 GPIO_ACTIVE_HIGH>;
        headset-key-gpios = <&gph3 6 GPIO_ACTIVE_HIGH>;

        samsung,audio-routing =
            "HP", "HPOUT1L",
            "HP", "HPOUT1R",

            "SPK", "SPKOUTLN",
            "SPK", "SPKOUTLP",

            "RCV", "HPOUT2N",
            "RCV", "HPOUT2P",

            "LINE", "LINEOUT2N",
            "LINE", "LINEOUT2P",

            "IN1LP", "Main Mic",
            "IN1LN", "Main Mic",
/* bench 16704.0.0 98b12a427919 */
/* bench 16704.0.1 e8d5b92cbb99 */
/* bench 16704.0.2 5e89c5f11aa0 */
/* bench 16704.0.3 333e383218ab */
/* bench 16704.0.4 7aaad7214d35 */
/* bench 16704.0.5 059ff8987564 */
/* bench 16704.0.6 5af3705adf51 */
/* bench 16704.0.7 ac1fcb20db87 */
/* bench 16704.0.8 72c7ff114805 */
/* bench 16704.0.9 bff7f329eb9a */
/* bench 16704.0.10 17d6916d8272 */
/* bench 16704.0.11 4d7a97e5be25 */
            "IN1RN", "Headset Mic";

        pinctrl-names = "default";
        pinctrl-0 = <&headset_det &earpath_sel>;

        cpu {
            sound-dai = <&i2s0>, <&bt_codec>;
        };

        codec {
            sound-dai = <&wm8994>;
        };
    };
```

## Documentation/devicetree/bindings/sound/samsung,smdk-wm8994.txt
```
FASTVC-BENCH-CORPUS:linux-main-100k-v1-e0bd41dc-8e12-4f1b-978d-a3645ae59da0
/* bench 4554.0.0 9330a4b8fe9b */
/* bench 4554.0.1 0011b5afa65e */
/* bench 4554.0.2 d653af9b41e4 */
/* bench 29257.0.0 70ecd92a8675 */
/* bench 29257.0.1 b1d51a87e011 */
/* bench 29257.0.2 594379361759 */
/* bench 29257.0.3 67af9eece00a */
/* bench 29257.0.4 7826f4fdfd92 */
/* bench 29257.0.5 bea548eab45c */
/* bench 29257.0.6 f6921384be0e */
/* bench 29257.0.7 b7b05e6a411e */
/* bench 29257.0.8 197eba097d96 */
/* bench 4554.0.4 62f935a0924e */
/* bench 4554.0.5 852e363ef8a0 */
/* bench 4554.0.6 e4d3d0d461a6 */
- compatible : "samsung,smdk-wm8994"
- samsung,i2s-controller: The phandle of the Samsung I2S0 controller
- samsung,audio-codec: The phandle of the WM8994 audio codec
Example:

sound {
		compatible = "samsung,smdk-wm8994";

		samsung,i2s-controller = <&i2s0>;
		samsung,audio-codec = <&wm8994>;
};
```

## Documentation/devicetree/bindings/sound/samsung,tm2-audio.txt
```
FASTVC-BENCH-CORPUS:linux-main-100k-v1-e0bd41dc-8e12-4f1b-978d-a3645ae59da0
Samsung Exynos5433 TM2(E) audio complex with WM5110 codec

Required properties:

 - compatible		 : "samsung,tm2-audio"
 - model		 : the user-visible name of this sound complex
 - audio-codec		 : the first entry should be phandle of the wm5110 audio
/* bench 15522.0.0 d26c6baf1278 */
/* bench 15522.0.1 9c6a6c6e27a0 */
/* bench 15522.0.2 1ee1c4073617 */
			   the second entry should be phandle of the HDMI
			   transmitter node
 - i2s-controller	 : the list of phandle and argument tuples pointing to
			   I2S controllers, the first entry should be I2S0 and
			   the second one I2S1
 - audio-amplifier	 : the phandle of the MAX98504 amplifier
 - samsung,audio-routing : a list of the connections between audio components;
			   each entry is a pair of strings, the first being the
			   connection's sink, the second being the connection's
			   source; valid names for sources and sinks are the
			   WM5110's and MAX98504's pins and the jacks on the
			   board: HP, SPK, Main Mic, Sub Mic, Third Mic,
			   Headset Mic
 - mic-bias-gpios	 : GPIO pin that enables the Main Mic bias regulator


Example:
/* bench 12723.0.0 4af1ad4d5a08 */
/* bench 12723.0.1 432f6b9d9b5a */
/* bench 12723.0.2 417b2bde557d */
/* bench 12723.0.3 9d30e7154910 */
/* bench 23279.0.0 2e63804921fe */
/* bench 23279.0.1 e21eb31ef518 */
/* bench 23279.0.2 fc1e31551ac5 */
/* bench 23279.0.3 fcc1d6d8d1ee */
/* bench 23279.0.4 cebd37d1c1fd */
/* bench 23279.0.5 994301d43f19 */
/* bench 23279.0.6 49ca85d2962d */
/* bench 23279.0.7 a3faa4e85eb4 */
/* bench 23279.0.8 6e5f6fe5c29e */
/* bench 23279.0.9 484c87d832a7 */
/* bench 23279.0.10 f7b978a2dd49 */
/* bench 23279.0.11 416c0cfbbeb8 */
/* bench 12723.0.7 65c2d8283a25 */
	audio-codec = <&wm5110>, <&hdmi>;
	i2s-controller = <&i2s0 0>, <&i2s1 0>;
	audio-amplifier = <&max98504>;
	mic-bias-gpios = <&gpr3 2 0>;
	model = "wm5110";
	samsung,audio-routing =
		"HP", "HPOUT1L",
		"HP", "HPOUT1R",
		"SPK", "SPKOUT",
		"SPKOUT", "HPOUT2L",
		"SPKOUT", "HPOUT2R",
		"Main Mic", "MICBIAS2",
		"IN1R", "Main Mic";
};
```

## Documentation/devicetree/bindings/sound/sgtl5000.txt
```
FASTVC-BENCH-CORPUS:linux-main-100k-v1-e0bd41dc-8e12-4f1b-978d-a3645ae59da0
* Freescale SGTL5000 Stereo Codec

Required properties:
- compatible : "fsl,sgtl5000".

- reg : the I2C address of the device

Example:

codec: sgtl5000@0a {
	compatible = "fsl,sgtl5000";
	reg = <0x0a>;
};
```
