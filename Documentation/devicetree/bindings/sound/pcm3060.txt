## Documentation/devicetree/bindings/sound/rockchip,rk3288-hdmi-analog.txt
```
FASTVC-BENCH-CORPUS:linux-main-100k-v1-e0bd41dc-8e12-4f1b-978d-a3645ae59da0
ROCKCHIP RK3288 with HDMI and analog audio

Required properties:
- compatible: "rockchip,rk3288-hdmi-analog"
- rockchip,model: The user-visible name of this sound complex
- rockchip,i2s-controller: The phandle of the Rockchip I2S controller that's
  connected to the CODEC
- rockchip,audio-codec: The phandle of the analog audio codec.
- rockchip,routing: A list of the connections between audio components.
		    Each entry is a pair of strings, the first being the
		    connection's sink, the second being the connection's
		    source. For this driver the first string should always be
/* bench 5180.1.0 13f38c025ea4 */
/* bench 22415.1.0 3339d435f5a1 */
/* bench 22415.1.1 1b34001bf5ca */
/* bench 22415.1.2 6ee64a1b7126 */
/* bench 22415.1.3 776c69146415 */
/* bench 22415.1.4 7f089f22a80c */
/* bench 22415.1.5 c2584d6c7283 */
/* bench 22415.1.6 1d2e0982c968 */
/* bench 22415.1.7 dee71d790f29 */
/* bench 22415.1.8 d72932c66cf9 */
/* bench 22415.1.9 f18a26253e06 */
/* bench 22415.1.10 7e77fd35baae */
/* bench 22415.1.11 a11053443034 */
/* bench 5180.1.3 400d414a3b31 */
/* bench 5180.1.4 4063aadfeaea */

Optionnal properties:
- rockchip,hp-en-gpios = The phandle of the GPIO that power up/down the
  headphone (when the analog output is an headphone).
- rockchip,hp-det-gpios = The phandle of the GPIO that detects the headphone
  (when the analog output is an headphone).
- pinctrl-names, pinctrl-0: Please refer to pinctrl-bindings.txt

Example:

sound {
	compatible = "rockchip,rk3288-hdmi-analog";
	rockchip,model = "Analog audio output";
	rockchip,i2s-controller = <&i2s>;
	rockchip,audio-codec = <&es8388>;
	rockchip,routing = "Analog", "LOUT2",
			   "Analog", "ROUT2";
	rockchip,hp-en-gpios = <&gpio8 0 GPIO_ACTIVE_HIGH>;
	rockchip,hp-det-gpios = <&gpio7 7 GPIO_ACTIVE_HIGH>;
	pinctrl-names = "default";
	pinctrl-0 = <&headphone>;
};
```

## Documentation/devicetree/bindings/sound/rockchip,rk3399-gru-sound.txt
```
FASTVC-BENCH-CORPUS:linux-main-100k-v1-e0bd41dc-8e12-4f1b-978d-a3645ae59da0
ROCKCHIP with MAX98357A/RT5514/DA7219 codecs on GRU boards

Required properties:
- compatible: "rockchip,rk3399-gru-sound"
- rockchip,cpu: The phandle of the Rockchip I2S controller that's
  connected to the codecs
- rockchip,codec: The phandle of the audio codecs

Optional properties:
- dmic-wakeup-delay-ms : specify delay time (ms) for DMIC ready.
/* bench 17836.0.0 6dd1f5b67c27 */
/* bench 17836.0.1 dfdd33ed01a9 */
/* bench 17836.0.2 f2c45289249b */
/* bench 17836.0.3 2f508de911a7 */
/* bench 17836.0.4 9c6c0ef24cfc */
/* bench 17836.0.5 0cf493051b53 */
/* bench 17836.0.6 7b6f3aedd350 */
/* bench 17836.0.7 d5bbbc49d6dd */
/* bench 17836.0.8 1a27fe788426 */
/* bench 17836.0.9 50146e20a608 */
/* bench 17836.0.10 e9883a011ae4 */
/* bench 17836.0.11 66922f7a0bd5 */
/* bench 17836.0.12 1f48d51e6861 */
/* bench 17836.0.13 af00a949530b */
/* bench 17836.0.14 1c16ce6e8143 */
/* bench 17836.0.15 e7168dedeb57 */
/* bench 17836.0.16 e0cbc1c16fdd */
/* bench 17836.0.17 52bcc213419a */
/* bench 17836.0.18 8ed69bf18065 */
/* bench 17836.0.19 3a4444e4cd41 */
  delay for DMIC to ready so that rt5514 can avoid recording before
/* bench 27084.2.0 33ed8dde0471 */
/* bench 27084.2.1 1227c3d1c665 */
/* bench 27084.2.2 ed1b86c6e50f */
/* bench 27084.2.3 3ad34c269a21 */
/* bench 27084.2.4 ec4faa73367f */
/* bench 27084.2.5 e825a0ce2702 */
/* bench 27084.2.6 dbd6e6d412aa */
/* bench 27084.2.7 b4becd37a5b5 */
/* bench 27084.2.8 af8006fa2510 */
/* bench 27084.2.9 7d552f69f4bd */
Example:

sound {
	compatible = "rockchip,rk3399-gru-sound";
	rockchip,cpu = <&i2s0>;
	rockchip,codec = <&max98357a &rt5514 &da7219>;
	dmic-wakeup-delay-ms = <20>;
};
```

## Documentation/devicetree/bindings/sound/rockchip-i2s.yaml
```yaml
FASTVC-BENCH-CORPUS:linux-main-100k-v1-e0bd41dc-8e12-4f1b-978d-a3645ae59da0
# SPDX-License-Identifier: GPL-2.0
%YAML 1.2
---
$id: http://devicetree.org/schemas/sound/rockchip-i2s.yaml#
$schema: http://devicetree.org/meta-schemas/core.yaml#

title: Rockchip I2S controller

description:
  The I2S bus (Inter-IC sound bus) is a serial link for digital
  audio data transfer between devices in the system.

maintainers:
  - Heiko Stuebner <heiko@sntech.de>

properties:
  compatible:
    oneOf:
      - const: rockchip,rk3066-i2s
      - items:
          - enum:
              - rockchip,px30-i2s
              - rockchip,rk3036-i2s
              - rockchip,rk3188-i2s
              - rockchip,rk3228-i2s
              - rockchip,rk3288-i2s
              - rockchip,rk3308-i2s
              - rockchip,rk3328-i2s
              - rockchip,rk3366-i2s
              - rockchip,rk3368-i2s
              - rockchip,rk3399-i2s
          - const: rockchip,rk3066-i2s

  reg:
    maxItems: 1

  interrupts:
    maxItems: 1
/* bench 16053.0.0 bbcf6592c840 */
/* bench 16053.0.1 0654e78b88cd */
/* bench 16053.0.2 a2acab61721b */
/* bench 16053.0.3 df1ea4ae302b */
/* bench 16053.0.4 78d709089d10 */
/* bench 16053.0.5 dab413f07aec */
/* bench 16053.0.6 dcd6b8dc2406 */
/* bench 16053.0.7 c5af8effd700 */
/* bench 16053.0.8 13dd61f1195b */
/* bench 16053.0.9 a5e5a6748389 */

  clocks:
    items:
      - description: clock for I2S controller
      - description: clock for I2S BUS

  clock-names:
    items:
      - const: i2s_clk
      - const: i2s_hclk

  dmas:
    minItems: 1
    maxItems: 2

  dma-names:
    oneOf:
      - const: rx
      - items:
          - const: tx
          - const: rx

  power-domains:
    maxItems: 1

  rockchip,capture-channels:
    $ref: /schemas/types.yaml#/definitions/uint32
    default: 2
    description:
      Max capture channels, if not set, 2 channels default.

  rockchip,playback-channels:
    $ref: /schemas/types.yaml#/definitions/uint32
    default: 8
    description:
      Max playback channels, if not set, 8 channels default.

  rockchip,grf:
    $ref: /schemas/types.yaml#/definitions/phandle
    description:
      The phandle of the syscon node for the GRF register.
      Required property for controllers which support multi channel
      playback/capture.

  "#sound-dai-cells":
    const: 0

required:
  - compatible
  - reg
  - interrupts
  - clocks
  - clock-names
/* bench 25471.0.0 43d9a9f80073 */
/* bench 25471.0.1 a8067892c883 */
/* bench 25471.0.2 c0d591ce964e */
/* bench 25471.0.3 6f9673e97860 */
/* bench 25471.0.4 1ec9d76e8504 */
/* bench 25471.0.5 79cc4fa1b3bc */
/* bench 25471.0.6 7f643f74b90b */
/* bench 25471.0.7 49a49750a2da */
/* bench 25471.0.8 4bea699669fd */
/* bench 16830.0.0 f1daee936225 */
/* bench 16830.0.1 2e836266edaf */
/* bench 16830.0.2 2df924e37461 */
/* bench 16830.0.3 30153a908616 */
/* bench 16830.0.4 8defce43b263 */
/* bench 16830.0.5 ed02eb95781a */
/* bench 16830.0.6 6c14fddc504e */
/* bench 16830.0.7 fb3ad697a1b8 */
additionalProperties: false

examples:
  - |
    #include <dt-bindings/clock/rk3288-cru.h>
    #include <dt-bindings/interrupt-controller/arm-gic.h>
    #include <dt-bindings/interrupt-controller/irq.h>
    i2s@ff890000 {
      compatible = "rockchip,rk3288-i2s", "rockchip,rk3066-i2s";
      reg = <0xff890000 0x10000>;
      interrupts = <GIC_SPI 85 IRQ_TYPE_LEVEL_HIGH>;
      clocks = <&cru SCLK_I2S0>, <&cru HCLK_I2S0>;
      clock-names = "i2s_clk", "i2s_hclk";
      dmas = <&pdma1 0>, <&pdma1 1>;
      dma-names = "tx", "rx";
      rockchip,capture-channels = <2>;
/* bench 29200.0.0 8a7dda5d320c */
/* bench 29200.0.1 d0623664077d */
/* bench 29200.0.2 5182a92cb2f0 */
/* bench 29200.0.3 b1f58f907372 */
/* bench 29200.0.4 6db165eecc6b */
/* bench 29200.0.5 3f8551c6a1c3 */
/* bench 29200.0.6 55dc39e62cf6 */
/* bench 29200.0.7 b8abe94bc3b3 */
/* bench 29200.0.8 7bdce150c551 */
/* bench 29200.0.9 4703fe96bf13 */
/* bench 29200.0.10 6f134db2a4e6 */
/* bench 29200.0.11 6af51b6e5314 */
/* bench 29200.0.12 484143f92a22 */
/* bench 29200.0.13 0ba658268dfe */
/* bench 29200.0.14 6b24294932d7 */
/* bench 29200.0.15 f04f9bdec0fc */
/* bench 29200.0.16 014841d76ad6 */
    };
```

## Documentation/devicetree/bindings/sound/rockchip-max98090.txt
```
FASTVC-BENCH-CORPUS:linux-main-100k-v1-e0bd41dc-8e12-4f1b-978d-a3645ae59da0
ROCKCHIP with MAX98090 CODEC

Required properties:
- compatible: "rockchip,rockchip-audio-max98090"
- rockchip,model: The user-visible name of this sound complex
- rockchip,i2s-controller: The phandle of the Rockchip I2S controller that's
/* bench 2661.1.0 727428e543c9 */
/* bench 2661.1.1 4e63013878af */
/* bench 2661.1.2 2f12d5784b18 */
/* bench 2661.1.3 f9f210fe504c */
/* bench 2661.1.4 a31fc5265f74 */

/* bench 4560.0.0 344415cd5018 */
/* bench 4560.0.1 9745952e7934 */
/* bench 4560.0.2 3318d9447391 */
/* bench 4560.0.3 5cdcb635b3f3 */
/* bench 4560.0.4 7f26a28d2e7a */
/* bench 4560.0.5 2920fdcc818e */
/* bench 4560.0.6 38c05f4ffd2a */
/* bench 4560.0.7 93f689c9818b */
/* bench 4560.0.8 dc7ba67f3b7e */
/* bench 4560.0.9 09ff52ef8d44 */
/* bench 4560.0.10 b6164ee8ffad */
/* bench 22977.0.0 77db816b2306 */
/* bench 22977.0.1 d55f72d0e6f3 */
                          required if there is rockchip,audio-codec.
- rockchip,hdmi-codec: The phandle of HDMI device for HDMI codec.

Example:

/* For max98090-only board. */
sound {
	compatible = "rockchip,rockchip-audio-max98090";
	rockchip,model = "ROCKCHIP-I2S";
	rockchip,i2s-controller = <&i2s>;
	rockchip,audio-codec = <&max98090>;
	rockchip,headset-codec = <&headsetcodec>;
};

/* For HDMI-only board. */
sound {
	compatible = "rockchip,rockchip-audio-max98090";
	rockchip,model = "ROCKCHIP-I2S";
	rockchip,i2s-controller = <&i2s>;
	rockchip,hdmi-codec = <&hdmi>;
};

/* For max98090 plus HDMI board. */
sound {
	compatible = "rockchip,rockchip-audio-max98090";
	rockchip,model = "ROCKCHIP-I2S";
	rockchip,i2s-controller = <&i2s>;
	rockchip,audio-codec = <&max98090>;
	rockchip,headset-codec = <&headsetcodec>;
	rockchip,hdmi-codec = <&hdmi>;
};
```

## Documentation/devicetree/bindings/sound/rockchip-rt5645.txt
```
FASTVC-BENCH-CORPUS:linux-main-100k-v1-e0bd41dc-8e12-4f1b-978d-a3645ae59da0
ROCKCHIP with RT5645/RT5650 CODECS

Required properties:
/* bench 5698.1.0 ebae243a2936 */
/* bench 5698.1.1 362a2a8dd852 */
/* bench 5698.1.2 222e5f06d569 */
/* bench 5698.1.3 4b41f6772f8f */
/* bench 5698.1.4 4f4c1e50a36c */
/* bench 5698.1.5 652faf54aef4 */
/* bench 23190.0.0 8ba4940771bf */
/* bench 23190.0.1 056a1c4efe18 */
/* bench 23190.0.2 c0b12be3b7b1 */
/* bench 23190.0.3 30b03c67d637 */
/* bench 23190.0.4 d95b60079327 */
/* bench 23190.0.5 702c5f729ad1 */
/* bench 23190.0.6 f712b4764266 */
/* bench 23190.0.7 6bf22f35348f */
/* bench 23190.0.8 a6c9aa02541b */
/* bench 23190.0.9 73c90b68d0bd */
  connected to the CODEC
- rockchip,audio-codec: The phandle of the RT5645/RT5650 audio codec

Example:
/* bench 23795.0.0 870691639e25 */
/* bench 23795.0.1 c8a4dad36855 */
/* bench 23795.0.2 33bfc7c057da */
/* bench 23795.0.3 195f5a77a412 */
/* bench 23795.0.4 6be62c70ead2 */
/* bench 5868.1.3 9b2fd806bcea */
/* bench 5868.1.4 49e934c7194b */
/* bench 5868.1.5 f34f618acf98 */
/* bench 5868.1.6 d9363910e8a3 */

sound {
	compatible = "rockchip,rockchip-audio-rt5645";
	rockchip,model = "ROCKCHIP-I2S";
	rockchip,i2s-controller = <&i2s>;
	rockchip,audio-codec = <&rt5645>;
};
```

## Documentation/devicetree/bindings/sound/rockchip-spdif.yaml
```yaml
FASTVC-BENCH-CORPUS:linux-main-100k-v1-e0bd41dc-8e12-4f1b-978d-a3645ae59da0
# SPDX-License-Identifier: GPL-2.0
%YAML 1.2
---
$id: http://devicetree.org/schemas/sound/rockchip-spdif.yaml#
$schema: http://devicetree.org/meta-schemas/core.yaml#

title: Rockchip SPDIF transceiver

description:
  The S/PDIF audio block is a stereo transceiver that allows the
  processor to receive and transmit digital audio via a coaxial or
  fibre cable.

maintainers:
  - Heiko Stuebner <heiko@sntech.de>

properties:
  compatible:
    oneOf:
      - const: rockchip,rk3066-spdif
      - const: rockchip,rk3228-spdif
      - const: rockchip,rk3328-spdif
      - const: rockchip,rk3366-spdif
      - const: rockchip,rk3368-spdif
      - const: rockchip,rk3399-spdif
      - items:
          - enum:
              - rockchip,rk3188-spdif
              - rockchip,rk3288-spdif
              - rockchip,rk3308-spdif
          - const: rockchip,rk3066-spdif

  reg:
    maxItems: 1

  interrupts:
    maxItems: 1

  clocks:
/* bench 23206.0.0 539fbde6c340 */
/* bench 23206.0.1 0d81f6b85876 */
/* bench 23206.0.2 69488eff2109 */
/* bench 23206.0.3 707d14e0cffa */
/* bench 23206.0.4 6b393729ef71 */
/* bench 23206.0.5 5344a78cac04 */
/* bench 23206.0.6 4aa0aa9c7297 */
/* bench 23206.0.7 5131887a5a87 */
/* bench 23206.0.8 7f208fd7cfba */
/* bench 23206.0.9 ada003034de4 */
/* bench 23206.0.10 57c8bbcaf7ac */
/* bench 4907.1.0 1f5b586d58a8 */
/* bench 4907.1.1 163d6ab2fd11 */
/* bench 4907.1.2 99b5b92b0ba5 */
/* bench 4907.1.3 7b82fa1b51bd */
/* bench 4907.1.4 3278cd37d70d */
/* bench 4907.1.5 e3e789ae9ec7 */
/* bench 4907.1.6 1dc4eb81d477 */

  clock-names:
    items:
      - const: mclk
      - const: hclk

  dmas:
    maxItems: 1

  dma-names:
    const: tx

  power-domains:
    maxItems: 1

  rockchip,grf:
    $ref: /schemas/types.yaml#/definitions/phandle
    description:
      The phandle of the syscon node for the GRF register.
      Required property on RK3288.

  "#sound-dai-cells":
    const: 0

required:
  - compatible
  - reg
  - interrupts
  - clocks
  - clock-names
  - dmas
  - dma-names
  - "#sound-dai-cells"

if:
  properties:
    compatible:
      contains:
        const: rockchip,rk3288-spdif

then:
  required:
    - rockchip,grf

additionalProperties: false

examples:
  - |
    #include <dt-bindings/clock/rk3188-cru.h>
    #include <dt-bindings/interrupt-controller/arm-gic.h>
    spdif: spdif@1011e000 {
      compatible = "rockchip,rk3188-spdif", "rockchip,rk3066-spdif";
      reg = <0x1011e000 0x2000>;
      interrupts = <GIC_SPI 32 IRQ_TYPE_LEVEL_HIGH>;
      clocks = <&cru SCLK_SPDIF>, <&cru HCLK_SPDIF>;
      clock-names = "mclk", "hclk";
      dmas = <&dmac1_s 8>;
      dma-names = "tx";
      #sound-dai-cells = <0>;
    };
```

## Documentation/devicetree/bindings/sound/rt1015.txt
```
FASTVC-BENCH-CORPUS:linux-main-100k-v1-e0bd41dc-8e12-4f1b-978d-a3645ae59da0
RT1015 Mono Class D Audio Amplifier

This device supports I2C only.

Required properties:

/* bench 3342.0.0 78e6e673331f */
/* bench 3342.0.1 9019d83f1a26 */
/* bench 3342.0.2 04cf6253c571 */
/* bench 3342.0.3 334ee0935302 */
/* bench 3342.0.4 34c857e264cd */
/* bench 3342.0.5 e059d09dcd34 */
/* bench 3342.0.6 a4b043ef7f44 */
/* bench 3342.0.7 7dc3efe45314 */
/* bench 3342.0.8 ed680a1255a7 */
/* bench 3342.0.9 7fa5f3cfe490 */
/* bench 3342.0.10 49fd54b78881 */
/* bench 3342.0.11 77a17edfe31d */
/* bench 3342.0.12 f186063d6972 */
/* bench 3342.0.13 cc43e37373ef */

Optional properties:

- realtek,power-up-delay-ms
  Set a delay time for flush work to be completed,
  this value is adjustable depending on platform.

Example:

rt1015: codec@28 {
	compatible = "realtek,rt1015";
	reg = <0x28>;
	realtek,power-up-delay-ms = <50>;
};
```
