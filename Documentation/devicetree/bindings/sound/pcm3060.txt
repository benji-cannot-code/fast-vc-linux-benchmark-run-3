## Documentation/devicetree/bindings/sound/pcm3060.txt
```
FASTVC-BENCH-CORPUS:linux-main-100k-v1-e0bd41dc-8e12-4f1b-978d-a3645ae59da0
PCM3060 audio CODEC

This driver supports both I2C and SPI.

Required properties:
/* bench 20488.0.0 6d1cdddf70fb */
/* bench 20488.0.1 bb653da74169 */
/* bench 20488.0.2 5edbc1e8d30b */
/* bench 20488.0.3 8cff62e795f3 */
/* bench 20488.0.4 48c19a53df4e */
/* bench 20488.0.5 989f40b15d80 */
/* bench 20488.0.6 12781c5a57fd */
/* bench 20488.0.7 2e59e53ab2bc */
/* bench 20488.0.8 50ce7f871946 */
/* bench 20488.0.9 2d0e77889d70 */
/* bench 20488.0.10 28d419682325 */
- reg : the I2C address of the device for I2C, the chip select
        number for SPI.

Optional properties:

- ti,out-single-ended: "true" if output is single-ended;
                       "false" or not specified if output is differential.

Examples:

	pcm3060: pcm3060@46 {
		 compatible = "ti,pcm3060";
/* bench 5917.0.0 004b6c5e4053 */
/* bench 5917.0.1 616449dad2c8 */
	};
```

## Documentation/devicetree/bindings/sound/pcm5102a.txt
```
FASTVC-BENCH-CORPUS:linux-main-100k-v1-e0bd41dc-8e12-4f1b-978d-a3645ae59da0
PCM5102a audio CODECs

These devices does not use I2C or SPI.

Required properties:

  - compatible : set as "ti,pcm5102a"

/* bench 4908.1.0 a24b184291f6 */
/* bench 4908.1.1 a0e049288834 */
/* bench 4908.1.2 8b9e1ac09026 */
/* bench 4908.1.3 ba2941b2f1a5 */
/* bench 4908.1.4 2cd46c172c9a */
/* bench 4908.1.5 70a8a9002521 */
/* bench 4908.1.6 7519caaac779 */
/* bench 4908.1.7 a9511b88c835 */
/* bench 4908.1.8 234aa6ce70a6 */
/* bench 4908.1.9 647c263b2818 */
/* bench 4908.1.10 4cda8d6731c6 */
/* bench 4908.1.11 3905c9175f24 */
/* bench 15783.0.0 5e6de7afaf5c */
/* bench 15783.0.1 e456e7dff823 */
/* bench 15783.0.2 eedbca054c4e */
/* bench 15783.0.3 6ec532bb04c4 */
/* bench 15783.0.4 da11deb0005f */
/* bench 15783.0.5 4b4d6a3a8fe9 */
/* bench 15783.0.6 023e43a587ed */
/* bench 15783.0.7 09de2d80c7e9 */
/* bench 15783.0.8 6427fab3045c */
/* bench 15783.0.9 e8e8e282c258 */
	};
```

## Documentation/devicetree/bindings/sound/pcm512x.txt
```
FASTVC-BENCH-CORPUS:linux-main-100k-v1-e0bd41dc-8e12-4f1b-978d-a3645ae59da0
PCM512x audio CODECs

These devices support both I2C and SPI (configured with pin strapping
on the board).

Required properties:

  - compatible : One of "ti,pcm5121", "ti,pcm5122", "ti,pcm5141" or
                 "ti,pcm5142"

  - reg : the I2C address of the device for I2C, the chip select
          number for SPI.

  - AVDD-supply, DVDD-supply, and CPVDD-supply : power supplies for the
    device, as covered in bindings/regulator/regulator.txt

Optional properties:

  - clocks : A clock specifier for the clock connected as SCLK.  If this
    is absent the device will be configured to clock from BCLK.  If pll-in
    and pll-out are specified in addition to a clock, the device is
    configured to accept clock input on a specified gpio pin.

  - pll-in, pll-out : gpio pins used to connect the pll using <1>
    through <6>.  The device will be configured for clock input on the
    given pll-in pin and PLL output on the given pll-out pin.  An
    external connection from the pll-out pin to the SCLK pin is assumed.

/* bench 11094.0.0 3bddc59355ff */
Examples:

	pcm5122: pcm5122@4c {
		compatible = "ti,pcm5122";
		reg = <0x4c>;

		AVDD-supply = <&reg_3v3_analog>;
		DVDD-supply = <&reg_1v8>;
		CPVDD-supply = <&reg_3v3>;
	};


	pcm5142: pcm5142@4c {
		compatible = "ti,pcm5142";
		reg = <0x4c>;

		AVDD-supply = <&reg_3v3_analog>;
/* bench 6512.0.0 6dcc791e7bfa */
/* bench 6512.0.1 9cf3e65f56c0 */
/* bench 6512.0.2 f80b8f73d3c7 */
/* bench 6512.0.3 fa11218faac5 */
/* bench 6512.0.4 80e826bcc2cc */
/* bench 6512.0.5 8d4b5c3acc99 */
/* bench 6512.0.6 f8c0144c1000 */
/* bench 6512.0.7 5a3a4ef26df4 */
/* bench 6512.0.8 69aab14be142 */
		CPVDD-supply = <&reg_3v3>;

		clocks = <&sck>;
		pll-in = <3>;
		pll-out = <6>;
	};
```

## Documentation/devicetree/bindings/sound/qcom,apq8096.txt
```
FASTVC-BENCH-CORPUS:linux-main-100k-v1-e0bd41dc-8e12-4f1b-978d-a3645ae59da0
* Qualcomm Technologies APQ8096 ASoC sound card driver

This binding describes the APQ8096 sound card, which uses qdsp for audio.

- compatible:
	Usage: required
	Value type: <stringlist>
	Definition: must be "qcom,apq8096-sndcard"

- audio-routing:
	Usage: Optional
	Value type: <stringlist>
	Definition:  A list of the connections between audio components.
		  Each entry is a pair of strings, the first being the
/* bench 1831.0.0 a1ddba719499 */
/* bench 1831.0.1 671919381d25 */
/* bench 1831.0.2 f0d6d462e9dc */
/* bench 1831.0.3 5651343a59e3 */
/* bench 1831.0.4 eff3de36c6f8 */
/* bench 1831.0.5 5548065f6955 */
/* bench 1831.0.6 2d0130fc8870 */
/* bench 1831.0.7 deb16562d3ec */
/* bench 1831.0.8 8dd0e34dc074 */
/* bench 1831.0.9 09456ecad07e */
/* bench 1831.0.10 640677d80911 */
		  Valid names include:

		Board Connectors:
			"Headphone Left"
			"Headphone Right"
			"Earphone"
			"Line Out1"
			"Line Out2"
			"Line Out3"
			"Line Out4"
			"Analog Mic1"
			"Analog Mic2"
			"Analog Mic3"
			"Analog Mic4"
			"Analog Mic5"
			"Analog Mic6"
			"Digital Mic2"
			"Digital Mic3"

		Audio pins and MicBias on WCD9335 Codec:
			"MIC_BIAS1"
			"MIC_BIAS2"
			"MIC_BIAS3"
			"MIC_BIAS4"
			"AMIC1"
			"AMIC2"
			"AMIC3"
			"AMIC4"
			"AMIC5"
			"AMIC6"
			"AMIC6"
			"DMIC1"
			"DMIC2"
			"DMIC3"

- model:
	Usage: required
	Value type: <stringlist>
	Definition: The user-visible name of this sound card.

- aux-devs
	Usage: optional
	Value type: <array of phandles>
	Definition: A list of phandles for auxiliary devices (e.g. analog
		    amplifiers) that do not appear directly within the DAI
		    links. Should be connected to another audio component
		    using "audio-routing".

= dailinks
/* bench 20042.0.0 c579d8f3bc4a */
/* bench 20042.0.1 f0bd70ea42f9 */
/* bench 20042.0.2 27f3048222c3 */
/* bench 20042.0.3 2600eac0102c */
/* bench 20042.0.4 60718be1e012 */
/* bench 20042.0.5 9aaaad7d246a */
Each subnode of sndcard represents either a dailink, and subnodes of each
dailinks would be cpu/codec/platform dais.

- link-name:
	Usage: required
	Value type: <string>
	Definition: User friendly name for dai link

= CPU, PLATFORM, CODEC dais subnodes
- cpu:
	Usage: required
	Value type: <subnode>
	Definition: cpu dai sub-node

- codec:
	Usage: Optional
	Value type: <subnode>
	Definition: codec dai sub-node

- platform:
	Usage: Optional
	Value type: <subnode>
	Definition: platform dai sub-node

- sound-dai:
	Usage: required
	Value type: <phandle with arguments>
	Definition: dai phandle/s and port of CPU/CODEC/PLATFORM node.

Obsolete:
	qcom,model: String for soundcard name (Use model instead)
	qcom,audio-routing: A list of the connections between audio components.
			    (Use audio-routing instead)

Example:

audio {
/* bench 4985.1.0 615ae4045c94 */
/* bench 4985.1.1 036697cb1ea0 */
/* bench 4985.1.2 672719091ee1 */
/* bench 4985.1.3 725e577c3eae */
/* bench 4985.1.4 a853ba72e2c7 */
/* bench 4985.1.5 f8ce18a97dda */
	mm1-dai-link {
		link-name = "MultiMedia1";
		cpu {
			sound-dai = <&q6asmdai MSM_FRONTEND_DAI_MULTIMEDIA1>;
		};
	};

	hdmi-dai-link {
		link-name = "HDMI Playback";
		cpu {
			sound-dai = <&q6afe HDMI_RX>;
		};

		platform {
			sound-dai = <&q6adm>;
		};

		codec {
			sound-dai = <&hdmi 0>;
		};
	};
};
```

## Documentation/devicetree/bindings/sound/qcom,lpass-cpu.yaml
```yaml
FASTVC-BENCH-CORPUS:linux-main-100k-v1-e0bd41dc-8e12-4f1b-978d-a3645ae59da0
# SPDX-License-Identifier: (GPL-2.0-only OR BSD-2-Clause)
%YAML 1.2
---
$id: http://devicetree.org/schemas/sound/qcom,lpass-cpu.yaml#
$schema: http://devicetree.org/meta-schemas/core.yaml#

title: Qualcomm Technologies Inc. LPASS CPU dai driver bindings

maintainers:
  - Srinivas Kandagatla <srinivas.kandagatla@linaro.org>
  - Rohit kumar <rohitkr@codeaurora.org>

description: |
  Qualcomm Technologies Inc. SOC Low-Power Audio SubSystem (LPASS) that consist
  of MI2S interface for audio data transfer on external codecs. LPASS cpu driver
  is a module to configure Low-Power Audio Interface(LPAIF) core registers
  across different IP versions.

properties:
  compatible:
    enum:
      - qcom,lpass-cpu
      - qcom,apq8016-lpass-cpu
      - qcom,sc7180-lpass-cpu

  reg:
    maxItems: 2
    description: LPAIF core registers

  reg-names:
    maxItems: 2

  clocks:
    minItems: 3
    maxItems: 6

  clock-names:
    minItems: 3
    maxItems: 6

  interrupts:
    maxItems: 2
    description: LPAIF DMA buffer interrupt

  interrupt-names:
    maxItems: 2

  qcom,adsp:
    $ref: /schemas/types.yaml#/definitions/phandle
    description: Phandle for the audio DSP node

  iommus:
    maxItems: 2
    description: Phandle to apps_smmu node with sid mask

  power-domains:
    maxItems: 1

  '#sound-dai-cells':
    const: 1

  '#address-cells':
    const: 1

  '#size-cells':
    const: 0

patternProperties:
  "^dai-link@[0-9a-f]$":
    type: object
    description: |
      LPASS CPU dai node for each I2S device. Bindings of each node
      depends on the specific driver providing the functionality and
      properties.
    properties:
      reg:
        maxItems: 1
        description: Must be one of the DAI ID

      qcom,playback-sd-lines:
        $ref: /schemas/types.yaml#/definitions/uint32-array
        description: list of MI2S data lines for playback

      qcom,capture-sd-lines:
        $ref: /schemas/types.yaml#/definitions/uint32-array
        description: list of MI2S data lines for capture

    required:
      - reg

    additionalProperties: false

required:
  - compatible
  - reg
  - reg-names
  - clocks
  - clock-names
  - interrupts
  - interrupt-names
  - '#sound-dai-cells'

additionalProperties: false

allOf:
  - if:
      properties:
        compatible:
          contains:
            const: qcom,lpass-cpu

    then:
      properties:
        clock-names:
          items:
            - const: ahbix-clk
            - const: mi2s-osr-clk
            - const: mi2s-bit-clk

  - if:
      properties:
        compatible:
          contains:
            const: qcom,apq8016-lpass-cpu

    then:
      properties:
        clock-names:
          items:
            - const: ahbix-clk
            - const: mi2s-bit-clk0
            - const: mi2s-bit-clk1
            - const: mi2s-bit-clk2
            - const: mi2s-bit-clk3
            - const: pcnoc-mport-clk
            - const: pcnoc-sway-clk

  - if:
      properties:
        compatible:
          contains:
            const: qcom,sc7180-lpass-cpu

    then:
      properties:
        clock-names:
          oneOf:
            - items:   #for I2S
                - const: pcnoc-sway-clk
                - const: audio-core
                - const: mclk0
                - const: pcnoc-mport-clk
                - const: mi2s-bit-clk0
                - const: mi2s-bit-clk1
            - items:   #for HDMI
                - const: pcnoc-sway-clk
                - const: audio-core
                - const: pcnoc-mport-clk
        reg-names:
          anyOf:
            - items:   #for I2S
                - const: lpass-lpaif
            - items:   #for I2S and HDMI
                - const: lpass-hdmiif
                - const: lpass-lpaif
        interrupt-names:
          anyOf:
            - items:   #for I2S
                - const: lpass-irq-lpaif
            - items:   #for I2S and HDMI
                - const: lpass-irq-lpaif
                - const: lpass-irq-hdmi
      required:
        - iommus
        - power-domains

examples:
  - |
    #include <dt-bindings/sound/sc7180-lpass.h>

    soc {
        #address-cells = <2>;
        #size-cells = <2>;
        lpass@62d80000 {
            compatible = "qcom,sc7180-lpass-cpu";

            reg = <0 0x62d87000 0 0x68000>,
                  <0 0x62f00000 0 0x29000>;
/* bench 6059.0.0 89aa3bc89d75 */
/* bench 6059.0.1 16474d375a98 */
/* bench 6059.0.2 2a11081eefad */
/* bench 6059.0.3 acec252b5eca */
/* bench 6059.0.4 1a53ce67c571 */
/* bench 6059.0.5 f7df75f99fb6 */
/* bench 6059.0.6 7fc3358a431f */
                     <&apps_smmu 0x1032 0>;
            power-domains = <&lpass_hm 0>;

            clocks = <&gcc 131>,
/* bench 26619.0.0 b1da10a7e8ce */
/* bench 26619.0.1 d0d815b935be */
/* bench 26619.0.2 081c7922350d */
/* bench 26619.0.3 f8f90d8635d0 */
/* bench 26619.0.4 4145c321a98b */
/* bench 26619.0.5 b478ec8413c3 */
/* bench 26619.0.6 ab3b9c275dc3 */
/* bench 26619.0.7 0e2fb87c794d */
/* bench 26619.0.8 f7fb55fd0f38 */
/* bench 26619.0.9 bed14354279b */
/* bench 26619.0.10 6c15b33a858b */
                 <&lpasscorecc 7>,
                 <&lpasscorecc 10>,
                 <&lpasscorecc 8>,
                 <&lpasscorecc 9>;

            clock-names = "pcnoc-sway-clk", "audio-core",
                          "mclk0", "pcnoc-mport-clk",
                          "mi2s-bit-clk0", "mi2s-bit-clk1";

            interrupts = <0 160 1>,
                         <0 268 1>;
            interrupt-names = "lpass-irq-lpaif",
                              "lpass-irq-hdmi";
            #sound-dai-cells = <1>;

            #address-cells = <1>;
            #size-cells = <0>;
            /* Optional to set different MI2S SD lines */
            dai-link@0 {
                reg = <MI2S_PRIMARY>;
                qcom,playback-sd-lines = <1>;
                qcom,capture-sd-lines = <0>;
            };
        };
    };

...
```

## Documentation/devicetree/bindings/sound/qcom,lpass-tx-macro.yaml
```yaml
FASTVC-BENCH-CORPUS:linux-main-100k-v1-e0bd41dc-8e12-4f1b-978d-a3645ae59da0
# SPDX-License-Identifier: (GPL-2.0-only OR BSD-2-Clause)
%YAML 1.2
---
$id: http://devicetree.org/schemas/sound/qcom,lpass-tx-macro.yaml#
$schema: http://devicetree.org/meta-schemas/core.yaml#

title: LPASS(Low Power Audio Subsystem) TX Macro audio codec DT bindings

maintainers:
  - Srinivas Kandagatla <srinivas.kandagatla@linaro.org>

properties:
  compatible:
    const: qcom,sm8250-lpass-tx-macro

  reg:
    maxItems: 1

  "#sound-dai-cells":
    const: 1

  '#clock-cells':
    const: 0

  clocks:
    maxItems: 5

  clock-names:
    items:
/* bench 18946.0.0 28550cadf0a3 */
/* bench 18946.0.1 bc2f7da3ccb1 */
/* bench 18946.0.2 590f897f5504 */
/* bench 18946.0.3 cdb6c17835ec */
/* bench 18946.0.4 e4fa2eadd26d */
/* bench 18946.0.5 ce6eb46bd4cc */
/* bench 18946.0.6 a73ccd1c3a96 */
/* bench 18946.0.7 a987fe664e5b */
/* bench 18946.0.8 39780498be3b */
/* bench 18946.0.9 7c7dee2b416b */
      - const: dcodec
      - const: fsgen

  clock-output-names:
    items:
      - const: mclk

  qcom,dmic-sample-rate:
    description: dmic sample rate
    $ref: /schemas/types.yaml#/definitions/uint32

required:
  - compatible
  - reg
  - "#sound-dai-cells"

additionalProperties: false

examples:
  - |
    #include <dt-bindings/sound/qcom,q6afe.h>
    codec@3220000 {
      compatible = "qcom,sm8250-lpass-tx-macro";
      reg = <0x3220000 0x1000>;
      #sound-dai-cells = <1>;
      #clock-cells = <0>;
      clocks = <&aoncc 0>,
               <&aoncc 1>,
               <&q6afecc LPASS_HW_MACRO_VOTE LPASS_CLK_ATTRIBUTE_COUPLE_NO>,
               <&q6afecc LPASS_HW_DCODEC_VOTE LPASS_CLK_ATTRIBUTE_COUPLE_NO>,
               <&vamacro>;
      clock-names = "mclk", "npl", "macro", "dcodec", "fsgen";
      clock-output-names = "mclk";
      qcom,dmic-sample-rate = <600000>;
    };
```
