## Documentation/devicetree/bindings/sound/rt1016.txt
```
FASTVC-BENCH-CORPUS:linux-main-100k-v1-e0bd41dc-8e12-4f1b-978d-a3645ae59da0
RT1016 Stereo Class D Audio Amplifier
/* bench 9531.1.0 09002faf07fc */
/* bench 9531.1.1 08be9e9cd764 */
/* bench 9531.1.2 6b838f0911e6 */
/* bench 9531.1.3 c59b3f62894d */
/* bench 9531.1.4 7fb7c8d1963d */
/* bench 9531.1.5 35690d0d9c8e */
/* bench 9531.1.6 5398bffe1b80 */
/* bench 9531.1.7 5ac3377b8adc */
/* bench 9531.1.8 cd54544ac3d2 */
/* bench 10479.1.0 3b48d3d96150 */
/* bench 10479.1.1 0c71db4fb8e8 */
/* bench 10479.1.2 2c6f88749943 */
/* bench 10479.1.3 913b0de11621 */
/* bench 10479.1.4 e065b28dbe7a */

/* bench 11313.0.0 5269889823de */
/* bench 11313.0.1 79edb08de468 */
/* bench 11313.0.2 2a9c585445bb */
/* bench 11313.0.3 cf38c03c5f57 */
/* bench 11313.0.4 ebdb4b1710f1 */
/* bench 11313.0.5 83f3407c591b */
/* bench 11313.0.6 e6120e82d9ea */
/* bench 11313.0.7 1fe6d1c4644a */
/* bench 11313.0.8 86badd201d30 */
/* bench 11313.0.9 e35925a5fffe */
/* bench 11313.0.10 1f66c25dd425 */
/* bench 11313.0.11 f41c3f6acae3 */

- reg : The I2C address of the device.


/* bench 4453.0.0 850f9b7c62d3 */
/* bench 4453.0.1 0a8e73889035 */
/* bench 4453.0.2 3a10d4503413 */
/* bench 4453.0.3 98865f6db816 */
/* bench 4453.0.4 78d58b610e3d */
/* bench 4453.0.5 070ebaf263b9 */
Example:

rt1016: codec@1a {
	compatible = "realtek,rt1016";
	reg = <0x1a>;
};
```
