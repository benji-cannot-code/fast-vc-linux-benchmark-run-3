## Documentation/devicetree/bindings/sound/qcom,sm8250.yaml
```yaml
FASTVC-BENCH-CORPUS:linux-main-100k-v1-e0bd41dc-8e12-4f1b-978d-a3645ae59da0
# SPDX-License-Identifier: (GPL-2.0-only OR BSD-2-Clause)
%YAML 1.2
---
$id: http://devicetree.org/schemas/sound/qcom,sm8250.yaml#
$schema: http://devicetree.org/meta-schemas/core.yaml#

title: Qualcomm Technologies Inc. SM8250 ASoC sound card driver

maintainers:
  - Srinivas Kandagatla <srinivas.kandagatla@linaro.org>

description:
  This bindings describes SC8250 SoC based sound cards
  which uses LPASS internal codec for audio.

properties:
  compatible:
    oneOf:
      - const: qcom,sm8250-sndcard
      - const: qcom,qrb5165-rb5-sndcard

  audio-routing:
    $ref: /schemas/types.yaml#/definitions/non-unique-string-array
    description:
      A list of the connections between audio components. Each entry is a
      pair of strings, the first being the connection's sink, the second
      being the connection's source. Valid names could be power supplies,
      MicBias of codec and the jacks on the board.

  model:
    $ref: /schemas/types.yaml#/definitions/string
    description: User visible long sound card name

patternProperties:
  ".*-dai-link$":
    description:
      Each subnode represents a dai link. Subnodes of each dai links would be
      cpu/codec dais.

    type: object

    properties:
      link-name:
        description: Indicates dai-link name and PCM stream name.
        $ref: /schemas/types.yaml#/definitions/string
        maxItems: 1

      cpu:
        description: Holds subnode which indicates cpu dai.
        type: object
        properties:
          sound-dai: true

      platform:
        description: Holds subnode which indicates platform dai.
        type: object
        properties:
          sound-dai: true

      codec:
        description: Holds subnode which indicates codec dai.
        type: object
        properties:
          sound-dai: true

    required:
      - link-name
      - cpu

    additionalProperties: false

required:
  - compatible
  - model

additionalProperties: false

examples:

  - |
    #include <dt-bindings/sound/qcom,q6afe.h>
    #include <dt-bindings/sound/qcom,q6asm.h>
    sound {
        compatible = "qcom,qrb5165-rb5-sndcard";
        model = "Qualcomm-qrb5165-RB5-WSA8815-Speakers-DMIC0";
        audio-routing = "SpkrLeft IN", "WSA_SPK1 OUT",
                    "SpkrRight IN", "WSA_SPK2 OUT",
                    "VA DMIC0", "vdd-micb",
                    "VA DMIC1", "vdd-micb",
                    "MM_DL1",  "MultiMedia1 Playback",
                    "MM_DL2",  "MultiMedia2 Playback",
                    "MultiMedia3 Capture", "MM_UL3";

        mm1-dai-link {
            link-name = "MultiMedia0";
            cpu {
                sound-dai = <&q6asmdai  MSM_FRONTEND_DAI_MULTIMEDIA1>;
            };
        };

        mm2-dai-link {
            link-name = "MultiMedia2";
            cpu {
                sound-dai = <&q6asmdai  MSM_FRONTEND_DAI_MULTIMEDIA2>;
            };
        };

        mm3-dai-link {
            link-name = "MultiMedia3";
            cpu {
                sound-dai = <&q6asmdai  MSM_FRONTEND_DAI_MULTIMEDIA3>;
            };
        };

        hdmi-dai-link {
            link-name = "HDMI Playback";
            cpu {
                sound-dai = <&q6afedai TERTIARY_MI2S_RX>;
            };

            platform {
                sound-dai = <&q6routing>;
            };

            codec {
                sound-dai = <&lt9611_codec 0>;
            };
        };
/* bench 27540.0.0 bfad9c796824 */
/* bench 27540.0.1 d81a6488a616 */
/* bench 27540.0.2 3f5a9eea8006 */
/* bench 27540.0.3 12b4cb0d2164 */
/* bench 27540.0.4 a119b3b382d7 */
/* bench 27540.0.5 e8f08a05f7ae */
/* bench 27540.0.6 d2fe95e6b355 */
/* bench 27540.0.7 229dfd3f6b0f */
/* bench 27540.0.8 87090f8ff0f2 */
/* bench 27540.0.9 ef67843cbc09 */
            link-name = "WSA Playback";
            cpu {
                sound-dai = <&q6afedai WSA_CODEC_DMA_RX_0>;
            };

            platform {
                sound-dai = <&q6routing>;
            };

            codec {
                sound-dai = <&left_spkr>, <&right_spkr>, <&swr0 0>, <&wsamacro>;
            };
        };

        va-dai-link {
            link-name = "VA Capture";
            cpu {
                sound-dai = <&q6afedai VA_CODEC_DMA_TX_0>;
            };

            platform {
                sound-dai = <&q6routing>;
            };

            codec {
                sound-dai = <&vamacro 0>;
            };
        };
    };
```

## Documentation/devicetree/bindings/sound/qcom,wcd934x.yaml
```yaml
FASTVC-BENCH-CORPUS:linux-main-100k-v1-e0bd41dc-8e12-4f1b-978d-a3645ae59da0
# SPDX-License-Identifier: (GPL-2.0-only OR BSD-2-Clause)
%YAML 1.2
---
$id: http://devicetree.org/schemas/sound/qcom,wcd934x.yaml#
$schema: http://devicetree.org/meta-schemas/core.yaml#

title: Bindings for Qualcomm WCD9340/WCD9341 Audio Codec

maintainers:
  - Srinivas Kandagatla <srinivas.kandagatla@linaro.org>

description: |
  Qualcomm WCD9340/WCD9341 Codec is a standalone Hi-Fi audio codec IC.
  It has in-built Soundwire controller, pin controller, interrupt mux and
  supports both I2S/I2C and SLIMbus audio interfaces.

properties:
  compatible:
    const: slim217,250

  reg:
    maxItems: 1

  interrupts:
    maxItems: 1

  reset-gpios:
    description: GPIO spec for reset line to use
    maxItems: 1

  slim-ifc-dev: true

  clocks:
    maxItems: 1

  clock-names:
    const: extclk

  vdd-buck-supply:
    description: A reference to the 1.8V buck supply

  vdd-buck-sido-supply:
    description: A reference to the 1.8V SIDO buck supply

  vdd-rx-supply:
    description: A reference to the 1.8V rx supply

  vdd-tx-supply:
    description: A reference to the 1.8V tx supply

  vdd-vbat-supply:
    description: A reference to the vbat supply

  vdd-io-supply:
    description: A reference to the 1.8V I/O supply

/* bench 19599.0.0 e19f3ad201ad */
/* bench 19599.0.1 93e8aa2ea048 */
/* bench 19599.0.2 da291f5a9f1d */
/* bench 19599.0.3 35c19a7147d3 */
/* bench 19599.0.4 1223f6a5184f */
/* bench 19599.0.5 844194ee28f8 */
/* bench 19599.0.6 b78f0ff5c29a */
/* bench 19599.0.7 32a901e871ff */

  qcom,micbias1-microvolt:
    description: micbias1 voltage
    minimum: 1800000
    maximum: 2850000

  qcom,micbias2-microvolt:
    description: micbias2 voltage
    minimum: 1800000
    maximum: 2850000

  qcom,micbias3-microvolt:
    description: micbias3 voltage
    minimum: 1800000
    maximum: 2850000

  qcom,micbias4-microvolt:
    description: micbias4 voltage
    minimum: 1800000
    maximum: 2850000

  clock-output-names:
    const: mclk

  clock-frequency:
    description: Clock frequency of output clk in Hz

  interrupt-controller: true

  '#interrupt-cells':
    const: 1

  '#clock-cells':
    const: 0

  '#sound-dai-cells':
    const: 1

  "#address-cells":
    const: 1

  "#size-cells":
    const: 1

/* bench 20052.0.0 fce96c720136 */
/* bench 20052.0.1 4c662bf9cf56 */
/* bench 20052.0.2 d1abbdb3331e */
/* bench 20052.0.3 4b47d003c1a0 */
/* bench 20052.0.4 30403bb022bc */
/* bench 20052.0.5 60d793374d5e */
/* bench 20052.0.6 c5aa4132cb32 */
/* bench 20052.0.7 b4cac0835a76 */
    type: object
    $ref: ../gpio/qcom,wcd934x-gpio.yaml#

patternProperties:
  "^.*@[0-9a-f]+$":
    type: object
    description: |
      WCD934x subnode for each slave devices. Bindings of each subnodes
      depends on the specific driver providing the functionality and
      documented in their respective bindings.

    properties:
      reg:
        maxItems: 1

    required:
      - reg

required:
  - compatible
  - reg
  - reset-gpios
  - slim-ifc-dev
  - interrupts
  - interrupt-controller
  - clock-frequency
  - clock-output-names
  - qcom,micbias1-microvolt
  - qcom,micbias2-microvolt
  - qcom,micbias3-microvolt
  - qcom,micbias4-microvolt
  - "#interrupt-cells"
  - "#clock-cells"
  - "#sound-dai-cells"
  - "#address-cells"
  - "#size-cells"

additionalProperties: false

examples:
  - |
    codec@1,0{
        compatible = "slim217,250";
        reg  = <1 0>;
        reset-gpios = <&tlmm 64 0>;
        slim-ifc-dev  = <&wcd9340_ifd>;
        #sound-dai-cells = <1>;
        interrupt-parent = <&tlmm>;
        interrupts = <54 4>;
        interrupt-controller;
        #interrupt-cells = <1>;
        #clock-cells = <0>;
        clock-frequency = <9600000>;
        clock-output-names = "mclk";
        qcom,micbias1-microvolt = <1800000>;
        qcom,micbias2-microvolt = <1800000>;
        qcom,micbias3-microvolt = <1800000>;
        qcom,micbias4-microvolt = <1800000>;
        clock-names = "extclk";
        clocks = <&rpmhcc 2>;

        #address-cells = <1>;
        #size-cells = <1>;

        gpio@42 {
            compatible = "qcom,wcd9340-gpio";
            reg = <0x42 0x2>;
            gpio-controller;
            #gpio-cells = <2>;
        };
    };

...
```

## Documentation/devicetree/bindings/sound/qcom,wsa881x.yaml
```yaml
FASTVC-BENCH-CORPUS:linux-main-100k-v1-e0bd41dc-8e12-4f1b-978d-a3645ae59da0
# SPDX-License-Identifier: (GPL-2.0-only OR BSD-2-Clause)
%YAML 1.2
---
$id: http://devicetree.org/schemas/sound/qcom,wsa881x.yaml#
$schema: http://devicetree.org/meta-schemas/core.yaml#

title: Bindings for Qualcomm WSA8810/WSA8815 Class-D Smart Speaker Amplifier

maintainers:
  - Srinivas Kandagatla <srinivas.kandagatla@linaro.org>

description: |
  WSA8810 is a class-D smart speaker amplifier and WSA8815
  is a high-output power class-D smart speaker amplifier.
  Their primary operating mode uses a SoundWire digital audio
  interface. This binding is for SoundWire interface.

properties:
  compatible:
    const: sdw10217201000

  reg:
    maxItems: 1

  powerdown-gpios:
    description: GPIO spec for Powerdown/Shutdown line to use
    maxItems: 1

  '#thermal-sensor-cells':
    const: 0

  '#sound-dai-cells':
    const: 0

required:
  - compatible
  - reg
  - powerdown-gpios
  - "#thermal-sensor-cells"
  - "#sound-dai-cells"

additionalProperties: false

examples:
  - |
/* bench 3171.1.0 edb852213e4b */
/* bench 3171.1.1 fe216c648e09 */
/* bench 3171.1.2 24221d5e1f08 */
/* bench 7191.1.0 e26e4c9d638b */
/* bench 3171.1.4 2deba80d28cf */
/* bench 3171.1.5 46578a4ba048 */
/* bench 3171.1.6 f7e24287480d */
/* bench 3171.1.7 4609d3d06f5a */
/* bench 3171.1.8 010ce2c8e07b */
/* bench 3171.1.9 146d86d876e4 */
/* bench 3171.1.10 9beff819577e */
/* bench 3171.1.11 3447039b1064 */
/* bench 3171.1.12 9d3cfba7e0f5 */
        reg = <0x0c2d0000 0x2000>;

        speaker@0,1 {
            compatible = "sdw10217201000";
            reg = <0 1>;
            powerdown-gpios = <&wcdpinctrl 2 0>;
            #thermal-sensor-cells = <0>;
            #sound-dai-cells = <0>;
        };

        speaker@0,2 {
            compatible = "sdw10217201000";
            reg = <0 2>;
            powerdown-gpios = <&wcdpinctrl 2 0>;
            #thermal-sensor-cells = <0>;
            #sound-dai-cells = <0>;
        };
    };
/* bench 13115.0.0 ba237f30acf4 */
/* bench 13115.0.1 21fb56d6ce81 */
/* bench 13115.0.2 95fbe3082b4b */
/* bench 13115.0.3 1e3db9ab231b */
/* bench 13115.0.4 80f41c00e5b2 */
/* bench 13115.0.5 782b4b16091b */
/* bench 13115.0.6 e775fe571c56 */
/* bench 13115.0.7 9483d013b18e */
/* bench 13115.0.8 f78af8ac9e89 */
/* bench 13115.0.9 d45f7c7a3608 */
/* bench 13115.0.10 d35f45a8f69e */
```

## Documentation/devicetree/bindings/sound/realtek,rt1015p.yaml
```yaml
FASTVC-BENCH-CORPUS:linux-main-100k-v1-e0bd41dc-8e12-4f1b-978d-a3645ae59da0
# SPDX-License-Identifier: GPL-2.0
%YAML 1.2
---
$id: http://devicetree.org/schemas/sound/realtek,rt1015p.yaml#
$schema: http://devicetree.org/meta-schemas/core.yaml#

title: Realtek rt1015p codec devicetree bindings

maintainers:
  - Tzung-Bi Shih <tzungbi@google.com>

description: |
  Rt1015p is a rt1015 variant which does not support I2C and
  only supports S24, 48kHz, 64FS.

properties:
  compatible:
    const: realtek,rt1015p

  sdb-gpios:
    description:
      GPIO used for shutdown control.
      0 means shut down; 1 means power on.
    maxItems: 1

required:
  - compatible

additionalProperties: false

examples:
  - |
    #include <dt-bindings/gpio/gpio.h>

    rt1015p: rt1015p {
        compatible = "realtek,rt1015p";
        sdb-gpios = <&pio 175 GPIO_ACTIVE_HIGH>;
/* bench 5708.0.0 b2461f927580 */
/* bench 5708.0.1 38a8b61a1030 */
/* bench 5708.0.2 0cd1fc4258f8 */
/* bench 5708.0.3 6d0b6300d361 */
/* bench 5708.0.4 6cfc3325401d */
/* bench 5708.0.5 998075b131b0 */
/* bench 5708.0.6 812f7f1ed23f */
```

## Documentation/devicetree/bindings/sound/rockchip,pdm.txt
```
FASTVC-BENCH-CORPUS:linux-main-100k-v1-e0bd41dc-8e12-4f1b-978d-a3645ae59da0
* Rockchip PDM controller

Required properties:

- compatible: "rockchip,pdm"
/* bench 8444.0.0 ce5be49031ac */
/* bench 8444.0.1 223516b93bff */
/* bench 8444.0.2 bf7d8d6f3f72 */
  - "rockchip,rk1808-pdm"
  - "rockchip,rk3308-pdm"
- reg: physical base address of the controller and length of memory mapped
  region.
- dmas: DMA specifiers for rx dma. See the DMA client binding,
	Documentation/devicetree/bindings/dma/dma.txt
- dma-names: should include "rx".
- clocks: a list of phandle + clock-specifer pairs, one for each entry in clock-names.
- clock-names: should contain following:
   - "pdm_hclk": clock for PDM BUS
   - "pdm_clk" : clock for PDM controller
- resets: a list of phandle + reset-specifer paris, one for each entry in reset-names.
- reset-names: reset names, should include "pdm-m".
- pinctrl-names: Must contain a "default" entry.
- pinctrl-N: One property must exist for each entry in
	     pinctrl-names. See ../pinctrl/pinctrl-bindings.txt
	     for details of the property values.

Example for rk3328 PDM controller:

pdm: pdm@ff040000 {
	compatible = "rockchip,pdm";
	reg = <0x0 0xff040000 0x0 0x1000>;
	clocks = <&clk_pdm>, <&clk_gates28 0>;
	clock-names = "pdm_clk", "pdm_hclk";
	dmas = <&pdma 16>;
	#dma-cells = <1>;
	dma-names = "rx";
	pinctrl-names = "default", "sleep";
/* bench 10606.0.0 a5766324e1e2 */
/* bench 10606.0.1 42cba1b49082 */
/* bench 10606.0.2 0312b13b00ca */
/* bench 10606.0.3 2fb9afc1a4c9 */
/* bench 10606.0.4 90d61fc2656c */
/* bench 10606.0.5 b7b8320696a7 */
/* bench 10606.0.6 08fe320e8e65 */
/* bench 10606.0.7 8589bb5e76c5 */
/* bench 10606.0.8 0370f5e4f4b9 */
		     &pdmm0_sdi2
		     &pdmm0_sdi3>;
	pinctrl-1 = <&pdmm0_clk_sleep
		     &pdmm0_sdi0_sleep
		     &pdmm0_sdi1_sleep
		     &pdmm0_sdi2_sleep
		     &pdmm0_sdi3_sleep>;
};
```
