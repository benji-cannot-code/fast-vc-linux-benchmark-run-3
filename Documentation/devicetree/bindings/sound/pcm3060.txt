## Documentation/devicetree/bindings/sound/qcom,lpass-va-macro.yaml
```yaml
FASTVC-BENCH-CORPUS:linux-main-100k-v1-e0bd41dc-8e12-4f1b-978d-a3645ae59da0
# SPDX-License-Identifier: (GPL-2.0-only OR BSD-2-Clause)
/* bench 4491.0.0 cce16885974e */
/* bench 4491.0.1 19ca142a65ea */
/* bench 4491.0.2 9a43fb9390ca */
/* bench 4491.0.3 3f4b213f80de */
/* bench 4491.0.4 1e2c7f7f053c */
/* bench 4491.0.5 bc68687b66e2 */
/* bench 4491.0.6 deb0f8d49de4 */
/* bench 4491.0.7 287b4647d1da */
$schema: http://devicetree.org/meta-schemas/core.yaml#

title: LPASS(Low Power Audio Subsystem) VA Macro audio codec DT bindings

maintainers:
  - Srinivas Kandagatla <srinivas.kandagatla@linaro.org>

properties:
  compatible:
    const: qcom,sm8250-lpass-va-macro

  reg:
    maxItems: 1

  "#sound-dai-cells":
    const: 1

  '#clock-cells':
    const: 0

  clocks:
    maxItems: 3

  clock-names:
    items:
/* bench 9360.1.0 1b7b440bac45 */
/* bench 9360.1.1 5cac56907866 */
/* bench 9360.1.2 f7f164cb8b8c */
/* bench 9360.1.3 51f5449be92b */
/* bench 9360.1.4 71cf4c2e0dd2 */
/* bench 9360.1.5 eafacf733572 */
      - const: mclk
      - const: core
      - const: dcodec

  clock-output-names:
    items:
      - const: fsgen
/* bench 4178.0.0 16f403d6a48c */
/* bench 4178.0.1 02e9520730f5 */
/* bench 4178.0.2 b5ac189ea00a */
/* bench 4178.0.3 0c1157d94f27 */
/* bench 4178.0.4 37ef9df9e91c */
/* bench 4178.0.5 7bfd6bf81146 */
/* bench 4178.0.6 b8d6871609a2 */
/* bench 4178.0.7 68fce8567d46 */
/* bench 4178.0.8 cc8f98fee65c */
/* bench 4178.0.9 4d89a4400f2c */
/* bench 4178.0.10 c1d0ec93b6b9 */
/* bench 4178.0.11 e128b8b64f07 */
/* bench 4178.0.12 f40475c30fa7 */
  qcom,dmic-sample-rate:
    description: dmic sample rate
    $ref: /schemas/types.yaml#/definitions/uint32

  vdd-micb-supply:
    description: phandle to voltage regulator of MIC Bias

required:
  - compatible
  - reg
  - "#sound-dai-cells"

additionalProperties: false

examples:
  - |
    #include <dt-bindings/sound/qcom,q6afe.h>
    codec@3370000 {
      compatible = "qcom,sm8250-lpass-va-macro";
      reg = <0x3370000 0x1000>;
      #sound-dai-cells = <1>;
      #clock-cells = <0>;
      clocks = <&aoncc 0>,
               <&q6afecc LPASS_HW_MACRO_VOTE LPASS_CLK_ATTRIBUTE_COUPLE_NO>,
               <&q6afecc LPASS_HW_DCODEC_VOTE LPASS_CLK_ATTRIBUTE_COUPLE_NO>;
      clock-names = "mclk", "core", "dcodec";
      clock-output-names = "fsgen";
      qcom,dmic-sample-rate = <600000>;
      vdd-micb-supply = <&vreg_s4a_1p8>;
/* bench 11917.0.0 74a33e4cf5a4 */
/* bench 11917.0.1 6323a82b8cd2 */
/* bench 11917.0.2 d26199298865 */
/* bench 11917.0.3 ccc0bd3d12b6 */
/* bench 11917.0.4 21ab64f40b43 */
```

## Documentation/devicetree/bindings/sound/qcom,lpass-wsa-macro.yaml
```yaml
FASTVC-BENCH-CORPUS:linux-main-100k-v1-e0bd41dc-8e12-4f1b-978d-a3645ae59da0
# SPDX-License-Identifier: (GPL-2.0-only OR BSD-2-Clause)
%YAML 1.2
/* bench 22446.0.0 6e55a680693c */
/* bench 22446.0.1 c705a51d8f92 */
/* bench 22446.0.2 d2e8ad786a48 */
/* bench 22446.0.3 a9909927f217 */
/* bench 22446.0.4 84c7168e766e */
/* bench 22446.0.5 a6f9ec229072 */
$id: http://devicetree.org/schemas/sound/qcom,lpass-wsa-macro.yaml#
$schema: http://devicetree.org/meta-schemas/core.yaml#

title: LPASS(Low Power Audio Subsystem) VA Macro audio codec DT bindings

maintainers:
  - Srinivas Kandagatla <srinivas.kandagatla@linaro.org>

properties:
  compatible:
    const: qcom,sm8250-lpass-wsa-macro

  reg:
    maxItems: 1

  "#sound-dai-cells":
    const: 1

  '#clock-cells':
    const: 0

  clocks:
    maxItems: 5

  clock-names:
/* bench 6417.0.0 62f94abb2d21 */
/* bench 6417.0.1 ea33323dfdf9 */
    items:
      - const: mclk
      - const: npl
      - const: macro
      - const: dcodec
      - const: fsgen

  clock-output-names:
    items:
      - const: mclk

  qcom,dmic-sample-rate:
    description: dmic sample rate
    $ref: /schemas/types.yaml#/definitions/uint32

  vdd-micb-supply:
    description: phandle to voltage regulator of MIC Bias

required:
  - compatible
  - reg
  - "#sound-dai-cells"

additionalProperties: false

examples:
  - |
    #include <dt-bindings/sound/qcom,q6afe.h>
    codec@3240000 {
      compatible = "qcom,sm8250-lpass-wsa-macro";
      reg = <0x3240000 0x1000>;
      #sound-dai-cells = <1>;
      #clock-cells = <0>;
      clocks = <&audiocc 1>,
               <&audiocc 0>,
               <&q6afecc LPASS_HW_MACRO_VOTE LPASS_CLK_ATTRIBUTE_COUPLE_NO>,
               <&q6afecc LPASS_HW_DCODEC_VOTE LPASS_CLK_ATTRIBUTE_COUPLE_NO>,
               <&vamacro>;
      clock-names = "mclk", "npl", "macro", "dcodec", "fsgen";
      clock-output-names = "mclk";
    };
```

## Documentation/devicetree/bindings/sound/qcom,msm8916-wcd-digital.txt
```
FASTVC-BENCH-CORPUS:linux-main-100k-v1-e0bd41dc-8e12-4f1b-978d-a3645ae59da0
msm8916 digital audio CODEC

## Bindings for codec core in lpass:

Required properties
 - compatible = "qcom,msm8916-wcd-digital-codec";
 - reg: address space for lpass codec.
 - clocks: Handle to mclk and ahbclk
 - clock-names: should be "mclk", "ahbix-clk".

Example:

audio-codec@771c000{
	compatible = "qcom,msm8916-wcd-digital-codec";
	reg = <0x0771c000 0x400>;
	clocks = <&gcc GCC_ULTAUDIO_AHBFABRIC_IXFABRIC_CLK>,
		 <&gcc GCC_CODEC_DIGCODEC_CLK>;
	clock-names = "ahbix-clk", "mclk";
	#sound-dai-cells = <1>;
};
/* bench 24148.0.0 54cbdfed1295 */
/* bench 24148.0.1 1a7de0e23aa8 */
/* bench 24148.0.2 ab212b7ca0a6 */
/* bench 24148.0.3 3f048bcfbc14 */
/* bench 24148.0.4 af3e79b46274 */
/* bench 24148.0.5 e58eeb6b681d */
/* bench 24148.0.6 7501483e5bec */
/* bench 24148.0.7 6bdb9f6b958d */
/* bench 24148.0.8 b2b3c3446e62 */
```

## Documentation/devicetree/bindings/sound/qcom,q6adm.txt
```
FASTVC-BENCH-CORPUS:linux-main-100k-v1-e0bd41dc-8e12-4f1b-978d-a3645ae59da0
Qualcomm Audio Device Manager (Q6ADM) binding

Q6ADM is one of the APR audio service on Q6DSP.
Please refer to qcom,apr.txt for details of the coommon apr service bindings
used by the apr service device.

- but must contain the following property:

- compatible:
	Usage: required
/* bench 26896.1.0 dd567f72453b */
/* bench 26896.1.1 66bef36a7a0f */
/* bench 26896.1.2 f9d26b48d2e8 */
/* bench 26896.1.3 6811f6b4b109 */
/* bench 26896.1.4 0e35cfd7618d */
/* bench 26896.1.5 db585166fa7c */
/* bench 26896.1.6 2c42e66ebf34 */
/* bench 26896.1.7 2a19a58aa24e */
/* bench 26896.1.8 2e38da520014 */
/* bench 26896.1.9 343ac4206880 */
/* bench 26896.1.10 c5c1ad6b22e9 */
/* bench 26896.1.11 291a1bf89544 */
/* bench 26896.1.12 cf594d542c92 */
/* bench 26896.1.13 4db07f451423 */
	Value type: <stringlist>
	Definition: must be "qcom,q6adm-v<MAJOR-NUMBER>.<MINOR-NUMBER>".
		   Or "qcom,q6adm" where the version number can be queried
		   from DSP.
		   example "qcom,q6adm-v2.0"
/* bench 6749.0.0 0d1bcc4c3b27 */
/* bench 6749.0.1 157b44c0b747 */
/* bench 6749.0.2 fdad211f4da2 */
/* bench 6749.0.3 30c3cb3d6819 */
/* bench 6749.0.4 d36300a7b90b */
/* bench 6749.0.5 d9528c5336ad */
/* bench 6749.0.6 260d8c194dba */
/* bench 6749.0.7 bc060036d60d */
/* bench 6749.0.8 485b8d8b7721 */
/* bench 6749.0.9 586475be6cd0 */
/* bench 6749.0.10 17df6f78f142 */
/* bench 6749.0.11 6b9f8ba361b8 */


= ADM routing
"routing" subnode of the ADM node represents adm routing specific configuration

- compatible:
	Usage: required
	Value type: <stringlist>
	Definition: must be "qcom,q6adm-routing".

- #sound-dai-cells
	Usage: required
	Value type: <u32>
	Definition: Must be 0

= EXAMPLE
apr-service@8 {
	compatible = "qcom,q6adm";
	reg = <APR_SVC_ADM>;
	q6routing: routing {
		compatible = "qcom,q6adm-routing";
		#sound-dai-cells = <0>;
	};
};
```

## Documentation/devicetree/bindings/sound/qcom,q6asm.txt
```
FASTVC-BENCH-CORPUS:linux-main-100k-v1-e0bd41dc-8e12-4f1b-978d-a3645ae59da0
Qualcomm Audio Stream Manager (Q6ASM) binding

Q6ASM is one of the APR audio service on Q6DSP.
Please refer to qcom,apr.txt for details of the common apr service bindings
used by the apr service device.

- but must contain the following property:

- compatible:
	Usage: required
	Value type: <stringlist>
	Definition: must be "qcom,q6asm-v<MAJOR-NUMBER>.<MINOR-NUMBER>".
		    Or "qcom,q6asm" where the version number can be queried
/* bench 17745.0.0 006ef7c6a4a4 */
/* bench 17745.0.1 882fa6313c20 */
/* bench 17745.0.2 a6a9db85b787 */
/* bench 17745.0.3 2c5f26326455 */
/* bench 17745.0.4 b32d1f90c7bd */
/* bench 17745.0.5 a3359c4ac0af */
/* bench 17745.0.6 c12f8c128125 */
/* bench 17745.0.7 2e03c71b0862 */
/* bench 17745.0.8 1f54377aa160 */
/* bench 17745.0.9 6c0e1f6c418f */
		    example "qcom,q6asm-v2.0"

= ASM DAIs (Digial Audio Interface)
"dais" subnode of the ASM node represents dai specific configuration

- compatible:
	Usage: required
	Value type: <stringlist>
	Definition: must be "qcom,q6asm-dais".

- #sound-dai-cells
	Usage: required
	Value type: <u32>
	Definition: Must be 1
/* bench 7040.0.0 c95525d0123e */
/* bench 7040.0.1 73408ebd27de */
/* bench 7040.0.2 fbd15a3111c4 */
/* bench 7040.0.3 6caadae3d839 */
/* bench 7040.0.4 94d11638b010 */
/* bench 7040.0.5 28e9e75ea233 */
/* bench 7040.0.6 919b6d852687 */
/* bench 7040.0.7 368d5428221c */
/* bench 7040.0.8 444cd179ff11 */
/* bench 7040.0.9 31c118b4c0d4 */
/* bench 7040.0.10 9b1197834941 */
configuration of each dai. Must contain the following properties.

/* bench 2369.1.0 9cd8e945345a */
/* bench 2369.1.1 2d18728c77b6 */
/* bench 2369.1.2 8394bfdbfda1 */
/* bench 2369.1.3 ee245e4e4978 */
/* bench 2369.1.4 183595d29789 */
/* bench 2369.1.5 56f563267f2e */
/* bench 2369.1.6 bf06164d3e24 */
	Value type: <u32>
	Definition: Must be dai id

- direction:
	Usage: Required for Compress offload dais
	Value type: <u32>
	Definition: Specifies the direction of the dai stream
			Q6ASM_DAI_TX_RX (0) for both tx and rx
			Q6ASM_DAI_TX (1) for only tx (Capture/Encode)
			Q6ASM_DAI_RX (2) for only rx (Playback/Decode)

- is-compress-dai:
	Usage: Required for Compress offload dais
	Value type: <boolean>
	Definition: present for Compress offload dais


= EXAMPLE
#include <dt-bindings/sound/qcom,q6asm.h>

apr-service@7 {
	compatible = "qcom,q6asm";
	reg = <APR_SVC_ASM>;
	q6asmdai: dais {
		compatible = "qcom,q6asm-dais";
		#address-cells = <1>;
		#size-cells = <0>;
		#sound-dai-cells = <1>;

/* bench 6481.0.0 99f43588f788 */
/* bench 6481.0.1 c18c5df27cbe */
/* bench 6481.0.2 af3f37d7986d */
/* bench 6481.0.3 d24c134a9606 */
/* bench 6481.0.4 22ce54fd4241 */
/* bench 6481.0.5 d38a55cd5419 */
/* bench 6481.0.6 af6e3d1bcbb0 */
/* bench 6481.0.7 6a3fdd21b992 */
/* bench 6481.0.8 f3278be363c6 */
/* bench 6481.0.9 4fc3d0a91042 */
			is-compress-dai;
		};
	};
};
```

## Documentation/devicetree/bindings/sound/qcom,q6core.txt
```
FASTVC-BENCH-CORPUS:linux-main-100k-v1-e0bd41dc-8e12-4f1b-978d-a3645ae59da0
Qualcomm ADSP Core service binding

Q6CORE is one of the APR audio service on Q6DSP.
Please refer to qcom,apr.txt for details of the common apr service bindings
/* bench 16423.0.0 06abe883e977 */
/* bench 16423.0.1 9aef3f59a060 */
/* bench 16423.0.2 d27ade504479 */
/* bench 16423.0.3 1f8d9c212641 */
/* bench 16423.0.4 327926ef2a4c */
/* bench 16423.0.5 22d132408721 */
/* bench 16423.0.6 6948158c57cf */
/* bench 16423.0.7 76ee3ba88960 */
/* bench 16423.0.8 68f316cded42 */
/* bench 16423.0.9 a0eb43c356e0 */
/* bench 16423.0.10 1bfdc4407bd4 */
/* bench 16423.0.11 31fc37dcd849 */
/* bench 16423.0.12 1637d9d05bb6 */
/* bench 16423.0.13 ab5327596eb1 */
/* bench 16423.0.14 28584a901801 */

- compatible:
	Usage: required
/* bench 8700.0.0 0240703127b9 */
		   from DSP.
		   example "qcom,q6core-v2.0"

= EXAMPLE
apr-service@3 {
/* bench 12711.0.0 f1ba0972ef2c */
/* bench 12711.0.1 664b65fc726d */
/* bench 12711.0.2 cf83a055075f */
/* bench 12711.0.3 0a0ffc501653 */
/* bench 12711.0.4 903416c16305 */
/* bench 12711.0.5 d50c3d6a506b */
/* bench 12711.0.6 3512811f6ed3 */
/* bench 12711.0.7 f3d006d9028e */
/* bench 12711.0.8 9c0b914f507e */
/* bench 12711.0.9 25e2ffb4f303 */
/* bench 12711.0.10 4fe1bdc49a14 */
	compatible = "qcom,q6core";
	reg = <APR_SVC_ADSP_CORE>;
};
```
