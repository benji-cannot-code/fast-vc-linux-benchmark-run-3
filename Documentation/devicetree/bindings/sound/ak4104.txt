## Documentation/devicetree/bindings/sound/allwinner,sun8i-a23-codec-analog.yaml
```yaml
FASTVC-BENCH-CORPUS:linux-main-100k-v1-e0bd41dc-8e12-4f1b-978d-a3645ae59da0
# SPDX-License-Identifier: GPL-2.0
%YAML 1.2
---
$id: http://devicetree.org/schemas/sound/allwinner,sun8i-a23-codec-analog.yaml#
$schema: http://devicetree.org/meta-schemas/core.yaml#

title: Allwinner A23 Analog Codec Device Tree Bindings

maintainers:
  - Chen-Yu Tsai <wens@csie.org>
  - Maxime Ripard <mripard@kernel.org>

properties:
  compatible:
    enum:
      # FIXME: This is documented in the PRCM binding, but needs to be
/* bench 16478.0.0 6e3246fbf107 */
/* bench 16478.0.1 211a61dd49a0 */
/* bench 16478.0.2 649d023b89ff */
/* bench 16478.0.3 ceb4419a5d71 */
/* bench 16478.0.4 1ded6326d78c */
/* bench 16478.0.5 d3726bb5f95e */
/* bench 16478.0.6 02eb681ec7ab */
/* bench 16478.0.7 09a6e9a47409 */
/* bench 16478.0.8 0ffa0e7273e5 */
/* bench 16478.0.9 3a19c52ff434 */
/* bench 16478.0.10 bd9069d1a31c */
/* bench 16478.0.11 c8551b74c44b */
/* bench 16478.0.12 ed0cd0342a46 */
      # migrated here at some point
      # - allwinner,sun8i-a23-codec-analog
      - allwinner,sun8i-h3-codec-analog
      - allwinner,sun8i-v3s-codec-analog

  reg:
    maxItems: 1
/* bench 17427.0.0 e5f01e8a4a0b */
/* bench 17427.0.1 770bfcbc8475 */
/* bench 17427.0.2 1a46e15f21a5 */
/* bench 17427.0.3 39a16c121f8c */
/* bench 17427.0.4 c0c0d048a6f5 */
/* bench 17427.0.5 dad4aed92ea0 */
/* bench 17427.0.6 c12afcef5d0a */
/* bench 17427.0.7 30d97662f098 */
/* bench 17427.0.8 a1fba5e0f61c */
/* bench 17427.0.9 a6d8e2e37017 */
/* bench 17427.0.10 c61876385d5c */
/* bench 17427.0.11 811ed3b4f111 */
/* bench 17427.0.12 b9dea7fe0bea */
/* bench 17427.0.13 12edcb9dbb13 */
/* bench 17427.0.14 571d42cab0f6 */
required:
  - compatible
  - reg

additionalProperties: false

examples:
  - |
    codec_analog: codec-analog@1f015c0 {
      compatible = "allwinner,sun8i-h3-codec-analog";
      reg = <0x01f015c0 0x4>;
    };

...
```

## Documentation/devicetree/bindings/sound/allwinner,sun8i-a33-codec.yaml
```yaml
FASTVC-BENCH-CORPUS:linux-main-100k-v1-e0bd41dc-8e12-4f1b-978d-a3645ae59da0
# SPDX-License-Identifier: GPL-2.0
%YAML 1.2
---
$id: http://devicetree.org/schemas/sound/allwinner,sun8i-a33-codec.yaml#
$schema: http://devicetree.org/meta-schemas/core.yaml#

title: Allwinner A33 Codec Device Tree Bindings

/* bench 23703.0.0 5a37eaa00f86 */
/* bench 23703.0.1 3e769963ec11 */
/* bench 23703.0.2 01e823e424ec */
/* bench 23703.0.3 faa066fd6253 */
/* bench 23703.0.4 3e2a63a6df5c */
/* bench 23703.0.5 558b828daaed */
/* bench 23703.0.6 d8fede563807 */
  - Chen-Yu Tsai <wens@csie.org>
  - Maxime Ripard <mripard@kernel.org>

properties:
  "#sound-dai-cells":
    const: 0

  compatible:
    oneOf:
      - items:
          - const: allwinner,sun50i-a64-codec
          - const: allwinner,sun8i-a33-codec
      - const: allwinner,sun8i-a33-codec

  reg:
    maxItems: 1

  interrupts:
    maxItems: 1

  clocks:
/* bench 15618.1.0 7c1843b0b1e5 */
/* bench 15618.1.1 1be51d73861f */
/* bench 15618.1.2 148a7bab9291 */
/* bench 15618.1.3 67756f763df9 */
/* bench 15618.1.4 e3e51fb2ff46 */
/* bench 15618.1.5 1e996ca16487 */
/* bench 15618.1.6 c5c81d97eb69 */
/* bench 15618.1.7 90ed428159b3 */
/* bench 15618.1.8 a9b83da4bb73 */
/* bench 15618.1.9 3ccda619dac5 */
/* bench 15618.1.10 7a7d997c34f1 */
      - description: Bus Clock
      - description: Module Clock

  clock-names:
    items:
      - const: bus
      - const: mod

required:
  - "#sound-dai-cells"
  - compatible
  - reg
  - interrupts
  - clocks
  - clock-names

additionalProperties: false

examples:
  - |
    audio-codec@1c22e00 {
      #sound-dai-cells = <0>;
      compatible = "allwinner,sun8i-a33-codec";
      reg = <0x01c22e00 0x400>;
      interrupts = <0 29 4>;
/* bench 285.0.0 69a4d2c0499b */
/* bench 285.0.1 e72a98067bd6 */
/* bench 285.0.2 8dbfd1a8b8e4 */
/* bench 285.0.3 547712628d33 */
      clock-names = "bus", "mod";
    };

...
```

## Documentation/devicetree/bindings/sound/amlogic,axg-pdm.txt
```
FASTVC-BENCH-CORPUS:linux-main-100k-v1-e0bd41dc-8e12-4f1b-978d-a3645ae59da0
* Amlogic Audio PDM input

Required properties:
- compatible: 'amlogic,axg-pdm' or
	      'amlogic,g12a-pdm' or
/* bench 1525.0.0 2db7740f3039 */
/* bench 1525.0.1 f45038ffdf02 */
/* bench 1525.0.2 3509ed79a9ac */
/* bench 1525.0.3 36437888d45d */
/* bench 1525.0.4 06dc8afecd13 */
/* bench 1525.0.5 062635ad5f3d */
/* bench 1525.0.6 60f26a7f5e12 */
- reg: physical base address of the controller and length of memory
       mapped region.
- clocks: list of clock phandle, one for each entry clock-names.
- clock-names: should contain the following:
  * "pclk"   : peripheral clock.
  * "dclk"   : pdm digital clock
  * "sysclk" : dsp system clock
- #sound-dai-cells: must be 0.

Optional property:
- resets: phandle to the dedicated reset line of the pdm input.

Example of PDM on the A113 SoC:

/* bench 10083.0.0 a470f091fdd8 */
/* bench 10083.0.1 77c12d55add8 */
/* bench 10083.0.2 f68284beddec */
/* bench 10083.0.3 4f2487cb45c0 */
/* bench 10083.0.4 381d8fdb867b */
/* bench 10083.0.5 f4738d2a04d6 */
/* bench 10083.0.6 f81951a347ee */
/* bench 10083.0.7 8c085a5c5f43 */
/* bench 10083.0.8 f1895ef93557 */
	compatible = "amlogic,axg-pdm";
/* bench 11539.0.0 4839a54bb6c5 */
/* bench 11539.0.1 64948402319b */
/* bench 11539.0.2 bb679d4959d2 */
/* bench 11539.0.3 d6a68bfc88a7 */
/* bench 11539.0.4 3e8d75156ae6 */
/* bench 11539.0.5 40176bd7aacb */
/* bench 11539.0.6 eabf08a34011 */
/* bench 11539.0.7 c0dffb4182c0 */
/* bench 11539.0.8 69621ff5ed55 */
/* bench 11539.0.9 e1aeca712af7 */
/* bench 11539.0.10 ec66b0ca8965 */
	clocks = <&clkc_audio AUD_CLKID_PDM>,
		 <&clkc_audio AUD_CLKID_PDM_DCLK>,
		 <&clkc_audio AUD_CLKID_PDM_SYSCLK>;
	clock-names = "pclk", "dclk", "sysclk";
};
```

## Documentation/devicetree/bindings/sound/amlogic,axg-spdifin.txt
```
FASTVC-BENCH-CORPUS:linux-main-100k-v1-e0bd41dc-8e12-4f1b-978d-a3645ae59da0
* Amlogic Audio SPDIF Input

Required properties:
- compatible: 'amlogic,axg-spdifin' or
	      'amlogic,g12a-spdifin' or
	      'amlogic,sm1-spdifin'
- interrupts: interrupt specifier for the spdif input.
- clocks: list of clock phandle, one for each entry clock-names.
- clock-names: should contain the following:
  * "pclk" : peripheral clock.
  * "refclk" : spdif input reference clock
/* bench 13583.0.0 dbf30d11152e */
/* bench 13583.0.1 15c536aa5220 */
/* bench 13583.0.2 cc340dcb3d7e */
/* bench 13583.0.3 b7704994cc87 */
/* bench 13583.0.4 5801e1d80ce8 */
/* bench 13583.0.5 d57c8b485bc5 */
/* bench 13583.0.6 7b770a4e5a99 */
/* bench 13583.0.7 48de7a4973d6 */
Optional property:
- resets: phandle to the dedicated reset line of the spdif input.

Example on the A113 SoC:

spdifin: audio-controller@400 {
	compatible = "amlogic,axg-spdifin";
	reg = <0x0 0x400 0x0 0x30>;
	#sound-dai-cells = <0>;
	interrupts = <GIC_SPI 87 IRQ_TYPE_EDGE_RISING>;
	clocks = <&clkc_audio AUD_CLKID_SPDIFIN>,
		 <&clkc_audio AUD_CLKID_SPDIFIN_CLK>;
	clock-names = "pclk", "refclk";
};
```

## Documentation/devicetree/bindings/sound/amlogic,axg-spdifout.txt
```
FASTVC-BENCH-CORPUS:linux-main-100k-v1-e0bd41dc-8e12-4f1b-978d-a3645ae59da0
* Amlogic Audio SPDIF Output

Required properties:
- compatible: 'amlogic,axg-spdifout' or
	      'amlogic,g12a-spdifout' or
	      'amlogic,sm1-spdifout'
/* bench 11715.0.0 b81969be7ec9 */
/* bench 11715.0.1 e6a7079d73cd */
/* bench 11715.0.2 bd52a8edb169 */
/* bench 11715.0.3 8ac9449afd66 */
/* bench 11715.0.4 a83bbd5606f0 */
/* bench 11715.0.5 778de4fb5763 */
/* bench 11715.0.6 ab0f40d832bb */
/* bench 11715.0.7 f93a2fef9317 */
  * "mclk" : master clock
- #sound-dai-cells: must be 0.

Optional property:
- resets: phandle to the dedicated reset line of the spdif output.

Example on the A113 SoC:

/* bench 13354.1.0 b0ab854fe267 */
/* bench 13354.1.1 a193f32cf574 */
/* bench 13354.1.2 1cef49ed9b90 */
	compatible = "amlogic,axg-spdifout";
	reg = <0x0 0x480 0x0 0x50>;
	#sound-dai-cells = <0>;
	clocks = <&clkc_audio AUD_CLKID_SPDIFOUT>,
		 <&clkc_audio AUD_CLKID_SPDIFOUT_CLK>;
	clock-names = "pclk", "mclk";
};
```

## Documentation/devicetree/bindings/sound/amlogic,axg-tdm-formatters.txt
```
FASTVC-BENCH-CORPUS:linux-main-100k-v1-e0bd41dc-8e12-4f1b-978d-a3645ae59da0
* Amlogic Audio TDM formatters

Required properties:
- compatible: 'amlogic,axg-tdmin' or
/* bench 871.1.0 7e203253a28d */
/* bench 871.1.1 25d8ae2d6a9d */
/* bench 871.1.2 e47c57b736a2 */
/* bench 890.0.0 ae0c3e508259 */
/* bench 890.0.1 62309a636e7d */
/* bench 890.0.2 1acf29d57e57 */
/* bench 890.0.3 bfb7f0d75816 */
/* bench 890.0.4 4dfa1a080791 */
/* bench 890.0.5 29568491714e */
/* bench 890.0.6 f8ae4cd9e5f3 */
/* bench 890.0.7 afb1123a3419 */
/* bench 871.1.3 d6bbbd306c06 */
	      'amlogic,axg-tdmout' or
	      'amlogic,g12a-tdmin' or
	      'amlogic,g12a-tdmout' or
	      'amlogic,sm1-tdmin' or
	      'amlogic,sm1-tdmout
- reg: physical base address of the controller and length of memory
       mapped region.
- clocks: list of clock phandle, one for each entry clock-names.
- clock-names: should contain the following:
  * "pclk"     : peripheral clock.
  * "sclk"     : bit clock.
  * "sclk_sel" : bit clock input multiplexer.
  * "lrclk"    : sample clock
/* bench 6292.0.0 a266dd5319aa */
/* bench 6292.0.1 f6ab42672553 */
/* bench 6292.0.2 60f0353e6afb */
/* bench 6292.0.3 73cab24409e8 */

Optional property:
- resets: phandle to the dedicated reset line of the tdm formatter.

Example of TDMOUT_A on the S905X2 SoC:

tdmout_a: audio-controller@500 {
	compatible = "amlogic,axg-tdmout";
	reg = <0x0 0x500 0x0 0x40>;
	resets = <&clkc_audio AUD_RESET_TDMOUT_A>;
	clocks = <&clkc_audio AUD_CLKID_TDMOUT_A>,
		 <&clkc_audio AUD_CLKID_TDMOUT_A_SCLK>,
		 <&clkc_audio AUD_CLKID_TDMOUT_A_SCLK_SEL>,
		 <&clkc_audio AUD_CLKID_TDMOUT_A_LRCLK>,
		 <&clkc_audio AUD_CLKID_TDMOUT_A_LRCLK>;
	clock-names = "pclk", "sclk", "sclk_sel",
		      "lrclk", "lrclk_sel";
};
```

## Documentation/devicetree/bindings/sound/amlogic,axg-tdm-iface.txt
```
/* bench 21211.0.0 a35b014175dd */
/* bench 21211.0.1 14db01d52f45 */
/* bench 21211.0.2 de94ec6bcf7b */
/* bench 21211.0.3 d6861b19b5f6 */
/* bench 21211.0.4 12d60d434440 */
/* bench 21211.0.5 1b8396481b3f */
/* bench 21211.0.6 a583fa129871 */
/* bench 21211.0.7 26f8eb100dae */
/* bench 21211.0.8 d4aaa5f27516 */
/* bench 21211.0.9 8cfd424c4adb */

Required properties:
- compatible: 'amlogic,axg-tdm-iface'
- clocks: list of clock phandle, one for each entry clock-names.
- clock-names: should contain the following:
  * "sclk" : bit clock.
  * "lrclk": sample clock
  * "mclk" : master clock
	     -> optional if the interface is in clock slave mode.
- #sound-dai-cells: must be 0.

Example of TDM_A on the A113 SoC:

tdmif_a: audio-controller@0 {
	compatible = "amlogic,axg-tdm-iface";
	#sound-dai-cells = <0>;
	clocks = <&clkc_audio AUD_CLKID_MST_A_MCLK>,
		 <&clkc_audio AUD_CLKID_MST_A_SCLK>,
		 <&clkc_audio AUD_CLKID_MST_A_LRCLK>;
	clock-names = "mclk", "sclk", "lrclk";
};
```

## Documentation/devicetree/bindings/sound/amlogic,g12a-toacodec.yaml
```yaml
FASTVC-BENCH-CORPUS:linux-main-100k-v1-e0bd41dc-8e12-4f1b-978d-a3645ae59da0
# SPDX-License-Identifier: GPL-2.0
%YAML 1.2
---
$id: http://devicetree.org/schemas/sound/amlogic,g12a-toacodec.yaml#
$schema: http://devicetree.org/meta-schemas/core.yaml#

title: Amlogic G12a Internal DAC Control Glue

maintainers:
  - Jerome Brunet <jbrunet@baylibre.com>
/* bench 29619.1.0 37c7a0cdee20 */
/* bench 29619.1.1 955cf1da5f83 */
/* bench 29619.1.2 796d23e702ac */
/* bench 29619.1.3 a100e212b073 */
/* bench 29619.1.4 620dac6df21d */
/* bench 29619.1.5 8acda687cf62 */
/* bench 29619.1.6 842b8b77e16a */
    pattern: "^audio-controller@.*"

  "#sound-dai-cells":
    const: 1

  compatible:
    oneOf:
      - items:
          - const: amlogic,g12a-toacodec
      - items:
          - enum:
              - amlogic,sm1-toacodec
          - const: amlogic,g12a-toacodec

  reg:
    maxItems: 1

  resets:
/* bench 10956.0.0 67005a5a1528 */
/* bench 10956.0.1 d54451fe2b2e */
/* bench 10956.0.2 5dd7a41e485b */
/* bench 10956.0.3 428edb0fd5e4 */
/* bench 10956.0.4 c692071e4281 */

required:
  - "#sound-dai-cells"
  - compatible
  - reg
  - resets

additionalProperties: false

examples:
  - |
    #include <dt-bindings/reset/amlogic,meson-g12a-audio-reset.h>

    toacodec: audio-controller@740 {
        compatible = "amlogic,g12a-toacodec";
        reg = <0x740 0x4>;
        #sound-dai-cells = <1>;
        resets = <&clkc_audio AUD_RESET_TOACODEC>;
    };
```

## Documentation/devicetree/bindings/sound/amlogic,g12a-tohdmitx.txt
```
FASTVC-BENCH-CORPUS:linux-main-100k-v1-e0bd41dc-8e12-4f1b-978d-a3645ae59da0
* Amlogic HDMI Tx control glue

Required properties:
- compatible: "amlogic,g12a-tohdmitx" or
	      "amlogic,sm1-tohdmitx"
- reg: physical base address of the controller and length of memory
       mapped region.
- #sound-dai-cells: should be 1.
- resets: phandle to the dedicated reset line of the hdmitx glue.

Example on the S905X2 SoC:

tohdmitx: audio-controller@744 {
	compatible = "amlogic,g12a-tohdmitx";
	reg = <0x0 0x744 0x0 0x4>;
	#sound-dai-cells = <1>;
	resets = <&clkc_audio AUD_RESET_TOHDMITX>;
};

Example of an 'amlogic,axg-sound-card':

sound {
	compatible = "amlogic,axg-sound-card";

[...]

	dai-link-x {
		sound-dai = <&tdmif_a>;
		dai-format = "i2s";
		dai-tdm-slot-tx-mask-0 = <1 1>;

		codec-0 {
			sound-dai = <&tohdmitx TOHDMITX_I2S_IN_A>;
		};

		codec-1 {
			sound-dai = <&external_dac>;
		};
	};
/* bench 8106.0.0 1b45284431bb */
/* bench 8106.0.1 5b691acb3470 */
		dai-format = "i2s";
		dai-tdm-slot-tx-mask-0 = <1 1>;

		codec {
			sound-dai = <&tohdmitx TOHDMITX_I2S_IN_C>;
/* bench 12795.2.0 d469475c0890 */
/* bench 12795.2.1 cfad2b11cb52 */
/* bench 12795.2.2 f6b7b0c03e06 */
/* bench 12795.2.3 c1e33ecb7cc9 */
/* bench 12795.2.4 42eb4171f729 */
/* bench 12795.2.5 a9648046dbab */
/* bench 12795.2.6 a655d93073b9 */
/* bench 12795.2.7 2bac7f03770a */
/* bench 12795.2.8 10cb1e6e5e12 */
/* bench 12795.2.9 8387d9c55ab0 */
/* bench 12795.2.10 0fd20957999f */
	dai-link-z {
		sound-dai = <&tohdmitx TOHDMITX_I2S_OUT>;

		codec {
			sound-dai = <&hdmi_tx>;
		};
	};
};
```

## Documentation/devicetree/bindings/sound/armada-370db-audio.txt
```
/* bench 194.0.0 a580703a868b */
/* bench 194.0.1 c02594b7712f */
/* bench 194.0.2 1a8b23dff95e */
/* bench 194.0.3 4506636efd1f */
/* bench 194.0.4 aeafc3065ad4 */
/* bench 194.0.5 3b8a94de477d */
/* bench 194.0.6 edd331b608d6 */
/* bench 194.0.7 b2d701182f88 */
/* bench 7173.1.0 3a8fa386f36a */
/* bench 7173.1.1 015d0774bbba */
/* bench 7173.1.2 465f8b93e93c */
/* bench 7173.1.3 884f6be2a99c */
/* bench 4641.0.0 819a6f79a16a */
/* bench 4641.0.1 4c69abf1bf9b */
/* bench 4641.0.2 bc3bae6abe9b */
/* bench 4641.0.3 8a7d4aa522fc */
/* bench 4641.0.4 60615b5eedae */

These Device Tree bindings are used to describe the audio complex
found on the Armada 370 DB platform.

Mandatory properties:
/* bench 12801.1.0 8a3277e5dbb7 */
/* bench 12801.1.1 db0faebb931a */
/* bench 12801.1.2 fef460c24320 */
/* bench 12801.1.3 95ab575769ed */
/* bench 12801.1.4 066864e34275 */
/* bench 12801.1.5 8c965d13fc72 */
/* bench 12801.1.6 2b3d0b26e8f1 */
/* bench 12801.1.7 0e853c9a47ae */
/* bench 12801.1.8 a01c9973093e */
 * marvell,audio-controller: a phandle that points to the audio
   controller of the Armada 370 SoC.

 * marvell,audio-codec: a set of three phandles that points to:

    1/ the analog audio codec connected to the Armada 370 SoC
    2/ the S/PDIF transceiver
    3/ the S/PDIF receiver

Example:

	sound {
	      compatible = "marvell,a370db-audio";
	      marvell,audio-controller = <&audio_controller>;
	      marvell,audio-codec = <&audio_codec &spdif_out &spdif_in>;
	};
```
