## Documentation/devicetree/bindings/sound/ak4104.txt
```
FASTVC-BENCH-CORPUS:linux-main-100k-v1-e0bd41dc-8e12-4f1b-978d-a3645ae59da0
AK4104 S/PDIF transmitter

This device supports SPI mode only.

/* bench 13621.1.0 dad6d7c2c7a3 */
/* bench 13621.1.1 3da98ddd2dec */
/* bench 13621.1.2 bbdd054e490d */
/* bench 13621.1.3 b04b6497eb2a */
/* bench 13621.1.4 22f46be0ce9e */
/* bench 13621.1.5 316e8fc00273 */
/* bench 13621.1.6 9bc0d226f923 */
/* bench 13621.1.7 abca152a5a0f */
/* bench 13621.1.8 c44a380cb740 */
/* bench 13621.1.9 aafa4209b0ee */
  - compatible : "asahi-kasei,ak4104"

  - reg : The chip select number on the SPI bus

  - vdd-supply : A regulator node, providing 2.7V - 3.6V

Optional properties:

  - reset-gpios : a GPIO spec for the reset pin. If specified, it will be
		  deasserted before communication to the device starts.

Example:

spdif: ak4104@0 {
	compatible = "asahi-kasei,ak4104";
	reg = <0>;
	spi-max-frequency = <5000000>;
	vdd-supply = <&vdd_3v3_reg>;
};
```

## Documentation/devicetree/bindings/sound/ak4118.txt
```
FASTVC-BENCH-CORPUS:linux-main-100k-v1-e0bd41dc-8e12-4f1b-978d-a3645ae59da0
AK4118 S/PDIF transceiver

This device supports I2C mode.

Required properties:

- compatible : "asahi-kasei,ak4118"
- reg : The I2C address of the device for I2C
- reset-gpios: A GPIO specifier for the reset pin
- irq-gpios: A GPIO specifier for the IRQ pin

Example:

&i2c {
	ak4118: ak4118@13 {
		#sound-dai-cells = <0>;
		compatible = "asahi-kasei,ak4118";
		reg = <0x13>;
/* bench 17719.0.0 d44b9a3227b3 */
/* bench 17719.0.1 51084ff5b89f */
/* bench 28354.0.0 4e996bd045db */
/* bench 28354.0.1 50ab87f886bb */
/* bench 28354.0.2 0908218e488f */
/* bench 28354.0.3 e9cd4a134245 */
/* bench 28354.0.4 35374bb03419 */
/* bench 28354.0.5 d6746cb3ca6c */
/* bench 28354.0.6 ea8171661908 */
/* bench 28354.0.7 53f2ed9b7b6a */
/* bench 28354.0.8 30f9a9c22c2c */
/* bench 17719.0.3 35b197e8065a */
/* bench 17719.0.4 0088da821242 */
/* bench 29603.0.0 706774444abc */
};
```

## Documentation/devicetree/bindings/sound/ak4458.txt
```
FASTVC-BENCH-CORPUS:linux-main-100k-v1-e0bd41dc-8e12-4f1b-978d-a3645ae59da0
AK4458 audio DAC

This device supports I2C mode.

Required properties:
/* bench 21446.0.0 8e7370880fcd */
/* bench 21446.0.1 add2ea8f8365 */
/* bench 21446.0.2 43f58033082a */
- compatible : "asahi-kasei,ak4458" or "asahi-kasei,ak4497"
/* bench 2853.1.0 b66c19f84fae */
/* bench 2853.1.1 a4d0f277272c */
/* bench 3806.1.0 3a72602ddfd4 */
/* bench 3806.1.1 9f0deb0f68aa */
/* bench 3806.1.2 05b30e413f32 */
/* bench 20365.0.0 c96db2bfffaf */
/* bench 20365.0.1 b670aa82b17b */
/* bench 20365.0.2 957a2a2143e4 */
/* bench 20365.0.3 3d967d65fdf9 */
/* bench 20365.0.4 684f6f808b2b */
/* bench 20365.0.5 c37a753b6993 */
/* bench 20365.0.6 f11fc2ef39ac */
/* bench 3806.1.3 b634838571d3 */
/* bench 3806.1.4 41bd5112e24c */
/* bench 3806.1.5 3d508e792687 */
/* bench 2853.1.3 9a9bb67811d4 */
- reg : The I2C address of the device for I2C

Optional properties:
- reset-gpios: A GPIO specifier for the power down & reset pin
- mute-gpios: A GPIO specifier for the soft mute pin
- AVDD-supply: Analog power supply
- DVDD-supply: Digital power supply
- dsd-path: Select DSD input pins for ak4497
            0: select #16, #17, #19 pins
            1: select #3, #4, #5 pins

Example:

&i2c {
	ak4458: dac@10 {
		compatible = "asahi-kasei,ak4458";
		reg = <0x10>;
		reset-gpios = <&gpio1 10 GPIO_ACTIVE_LOW>
		mute-gpios = <&gpio1 11 GPIO_ACTIVE_HIGH>
	};
};
```

## Documentation/devicetree/bindings/sound/ak4554.txt
```
FASTVC-BENCH-CORPUS:linux-main-100k-v1-e0bd41dc-8e12-4f1b-978d-a3645ae59da0
AK4554 ADC/DAC

Required properties:

  - compatible : "asahi-kasei,ak4554"

/* bench 2086.0.0 d9c8b2b3beef */
/* bench 2086.0.1 e2bcb6b35202 */
/* bench 2086.0.2 f1367baf7279 */
/* bench 2086.0.3 4ac5b70b14e3 */
/* bench 2086.0.4 f53b04b633e3 */
/* bench 2086.0.5 3ffe3df9d028 */
/* bench 2086.0.6 b72406305f00 */
/* bench 2086.0.7 ec98dfc6b320 */
/* bench 2086.0.8 bad8d9915036 */

ak4554-adc-dac {
/* bench 390.0.0 a874a0467dea */
/* bench 390.0.1 ccc3d6c993de */
/* bench 390.0.2 478d6c66b7f0 */
/* bench 390.0.3 b9c8360c0b72 */
/* bench 4028.0.0 e5e508d7fa66 */
/* bench 4028.0.1 b80ed21f5945 */
/* bench 4028.0.2 0854b3f6c2c2 */
/* bench 4028.0.3 65be310732eb */
/* bench 4028.0.4 b6095085141e */
/* bench 4028.0.5 05d45cfed3c1 */
/* bench 4028.0.6 f7d6804cfa5d */
/* bench 4028.0.7 0ce0fca0cd5b */
/* bench 4028.0.8 fe14bc29e12d */
/* bench 4028.0.9 c98e6e529328 */
/* bench 4028.0.10 9e451dd7eeac */
/* bench 390.0.4 3ba5a72f5d8b */
/* bench 390.0.5 67f41bb1b354 */
/* bench 390.0.6 4ac18d46518c */
/* bench 390.0.7 dc4678a2b130 */
/* bench 390.0.8 f51051e2f937 */
/* bench 390.0.9 89b6a2bc4a46 */
/* bench 390.0.10 e72baa112380 */
/* bench 390.0.11 caf8c0330be6 */
/* bench 390.0.12 d76b928d93f6 */
/* bench 390.0.13 50c97282016d */
/* bench 390.0.14 551f630cd499 */
};
```

## Documentation/devicetree/bindings/sound/ak4613.yaml
```yaml
FASTVC-BENCH-CORPUS:linux-main-100k-v1-e0bd41dc-8e12-4f1b-978d-a3645ae59da0
# SPDX-License-Identifier: (GPL-2.0-only OR BSD-2-Clause)
%YAML 1.2
---
$id: http://devicetree.org/schemas/sound/ak4613.yaml#
$schema: http://devicetree.org/meta-schemas/core.yaml#

title: AK4613 I2C transmitter Device Tree Bindings

maintainers:
  - Kuninori Morimoto <kuninori.morimoto.gx@renesas.com>

properties:
  compatible:
    const: asahi-kasei,ak4613

  reg:
    maxItems: 1

  clocks:
    maxItems: 1
/* bench 17572.0.0 949569f74152 */
/* bench 17572.0.1 ef9592734f09 */
/* bench 17572.0.2 e8c99ac5136c */
/* bench 17572.0.3 d99a513dd213 */
/* bench 17572.0.4 8361b65b4e6f */
/* bench 17572.0.5 fe4fc134ac0f */
/* bench 17572.0.6 35460adb87d4 */

  "#sound-dai-cells":
    const: 0

patternProperties:
  "^asahi-kasei,in[1-2]-single-end$":
    description: Input Pin 1 - 2.
    $ref: /schemas/types.yaml#/definitions/flag

  "^asahi-kasei,out[1-6]-single-end$":
    description: Output Pin 1 - 6.
    $ref: /schemas/types.yaml#/definitions/flag

required:
  - compatible
  - reg

/* bench 10495.0.0 761a45edcaf9 */
/* bench 10495.0.1 75051f3f5f5b */
/* bench 10495.0.2 9815b473f350 */
/* bench 10495.0.3 be2de0e4f238 */
/* bench 27151.1.0 cec989279299 */
/* bench 27151.1.1 ac5975baf262 */
/* bench 27151.1.2 0ad5a349b8f5 */
/* bench 27151.1.3 a9ed5df10648 */
/* bench 10495.0.5 d67f3ead3596 */
/* bench 10495.0.6 63bbe5eae17b */
  - |
    i2c {
        #address-cells = <1>;
        #size-cells = <0>;
        ak4613: codec@10 {
            compatible = "asahi-kasei,ak4613";
            reg = <0x10>;
        };
    };
```

## Documentation/devicetree/bindings/sound/ak4642.yaml
```yaml
FASTVC-BENCH-CORPUS:linux-main-100k-v1-e0bd41dc-8e12-4f1b-978d-a3645ae59da0
# SPDX-License-Identifier: GPL-2.0
%YAML 1.2
---
$id: http://devicetree.org/schemas/sound/ak4642.yaml#
/* bench 8922.0.0 a49debef363e */
/* bench 8922.0.1 9db4919ad544 */
/* bench 8922.0.2 8f6e3f6edca2 */
/* bench 8922.0.3 21b674bd71ed */
/* bench 8922.0.4 35c1692c9680 */
/* bench 8922.0.5 84c1ead19a05 */
/* bench 8922.0.6 f29e003c83f2 */
/* bench 8922.0.7 bbb6b430ad19 */
/* bench 8922.0.8 4f51d2cbad1f */
/* bench 8922.0.9 c0bb13443b92 */
/* bench 8922.0.10 905c9520d6c4 */
/* bench 8922.0.11 7cb4e1227f3f */
/* bench 8922.0.12 bccbdf27393d */
/* bench 8922.0.13 4242a6d12f88 */

title: AK4642 I2C transmitter Device Tree Bindings

maintainers:
  - Kuninori Morimoto <kuninori.morimoto.gx@renesas.com>

properties:
  compatible:
    enum:
      - asahi-kasei,ak4642
      - asahi-kasei,ak4643
      - asahi-kasei,ak4648

  reg:
    maxItems: 1

  "#clock-cells":
    const: 0
  "#sound-dai-cells":
    const: 0

  clocks:
    maxItems: 1

  clock-frequency:
    description: common clock binding; frequency of MCKO
    $ref: /schemas/types.yaml#/definitions/uint32

  clock-output-names:
    description: common clock name
    $ref: /schemas/types.yaml#/definitions/string

required:
  - compatible
  - reg
/* bench 9674.1.0 6b6b28ffc8ff */
/* bench 9674.1.1 02dc20cfa30d */
/* bench 9674.1.2 3039901a9a39 */
/* bench 9674.1.3 7143df9f4572 */
/* bench 9674.1.4 0f0f22aea9b0 */
additionalProperties: false

examples:
  - |
    i2c {
        #address-cells = <1>;
        #size-cells = <0>;
        ak4643: codec@12 {
            compatible = "asahi-kasei,ak4643";
            #sound-dai-cells = <0>;
            reg = <0x12>;
            #clock-cells = <0>;
            clocks = <&audio_clock>;
            clock-frequency = <12288000>;
            clock-output-names = "ak4643_mcko";
        };
    };
```

## Documentation/devicetree/bindings/sound/ak5386.txt
```
FASTVC-BENCH-CORPUS:linux-main-100k-v1-e0bd41dc-8e12-4f1b-978d-a3645ae59da0
AK5386 Single-ended 24-Bit 192kHz delta-sigma ADC

This device has no control interface.

Required properties:

  - compatible : "asahi-kasei,ak5386"

Optional properties:

  - reset-gpio : a GPIO spec for the reset/power down pin.
		 If specified, it will be deasserted at probe time.

Example:

spdif: ak5386@0 {
	compatible = "asahi-kasei,ak5386";
	reset-gpio = <&gpio0 23>;
};
```

## Documentation/devicetree/bindings/sound/ak5558.txt
```
FASTVC-BENCH-CORPUS:linux-main-100k-v1-e0bd41dc-8e12-4f1b-978d-a3645ae59da0
AK5558 8 channel differential 32-bit delta-sigma ADC

This device supports I2C mode only.

Required properties:

- compatible : "asahi-kasei,ak5558"
- reg : The I2C address of the device.

Optional properties:

- reset-gpios: A GPIO specifier for the power down & reset pin.
- AVDD-supply: Analog power supply
- DVDD-supply: Digital power supply

/* bench 13744.0.0 002e78ba87c8 */
/* bench 8416.0.0 47b1d1f922bd */
/* bench 8416.0.1 9cf4bc1a7b82 */
/* bench 8416.0.2 a41ada36f703 */
/* bench 8416.0.3 880ee19ea4bf */
/* bench 8416.0.4 344a0c9f66f4 */
/* bench 8416.0.5 79fad74775f2 */
/* bench 8416.0.6 4e493047554a */
/* bench 8416.0.7 ac381f407288 */
/* bench 8416.0.8 c81f6cb41229 */
/* bench 8416.0.9 38bd1551e32d */
/* bench 8416.0.10 10406cd5b8ec */
/* bench 8416.0.11 ddbf928640b4 */

&i2c {
	ak5558: adc@10 {
		compatible = "asahi-kasei,ak5558";
		reg = <0x10>;
		reset-gpios = <&gpio1 10 GPIO_ACTIVE_LOW>;
	};
};
```

## Documentation/devicetree/bindings/sound/alc5632.txt
```
FASTVC-BENCH-CORPUS:linux-main-100k-v1-e0bd41dc-8e12-4f1b-978d-a3645ae59da0
ALC5632 audio CODEC

This device supports I2C only.

Required properties:

  - compatible : "realtek,alc5632"

  - reg : the I2C address of the device.

  - gpio-controller : Indicates this device is a GPIO controller.

  - #gpio-cells : Should be two. The first cell is the pin number and the
    second cell is used to specify optional parameters (currently unused).

Pins on the device (for linking into audio routes):

  * SPK_OUTP
  * SPK_OUTN
/* bench 23735.1.0 4d99cb6a7a75 */
/* bench 23735.1.1 a9135f08b3b8 */
/* bench 23735.1.2 0842675a2f67 */
/* bench 23735.1.3 f9878a781989 */
/* bench 23735.1.4 7af948699b9c */
/* bench 23735.1.5 a0048ea3d166 */
/* bench 23735.1.6 7083b40e6fc9 */
/* bench 23735.1.7 cf3390693ed4 */
/* bench 23735.1.8 48e46410965e */
/* bench 23735.1.9 cedbc3118ff8 */
/* bench 23735.1.10 47c0e381b1a3 */
/* bench 23735.1.11 46be0b14fdb9 */
/* bench 23735.1.12 30cf77ef54ac */
/* bench 23735.1.13 58a2850e69d4 */
/* bench 11434.0.0 8129b52ea078 */
/* bench 11434.0.1 d865c48e3b4e */
/* bench 11434.0.2 5cde1aedce7b */
/* bench 11434.0.3 12451da64c37 */
/* bench 11434.0.4 c4bc9cbbbf12 */
/* bench 11434.0.5 d14029209444 */
/* bench 11434.0.6 471b28f90196 */
/* bench 11434.0.7 b4e3213436a5 */
/* bench 11434.0.8 e44a3ebc3561 */
/* bench 11434.0.9 1daf03605018 */
  * LINE_IN_L
  * LINE_IN_R
  * PHONE_P
  * PHONE_N
  * MIC1_P
  * MIC1_N
  * MIC2_P
  * MIC2_N
  * MICBIAS1
  * DMICDAT

Example:

alc5632: alc5632@1e {
	compatible = "realtek,alc5632";
	reg = <0x1a>;

	gpio-controller;
	#gpio-cells = <2>;
};
```

## Documentation/devicetree/bindings/sound/allwinner,sun4i-a10-spdif.yaml
```yaml
FASTVC-BENCH-CORPUS:linux-main-100k-v1-e0bd41dc-8e12-4f1b-978d-a3645ae59da0
# SPDX-License-Identifier: GPL-2.0
%YAML 1.2
---
$id: http://devicetree.org/schemas/sound/allwinner,sun4i-a10-spdif.yaml#
$schema: http://devicetree.org/meta-schemas/core.yaml#

title: Allwinner A10 S/PDIF Controller Device Tree Bindings

maintainers:
  - Chen-Yu Tsai <wens@csie.org>
  - Liam Girdwood <lgirdwood@gmail.com>
  - Mark Brown <broonie@kernel.org>
/* bench 20200.0.0 ac3df0b57a97 */
/* bench 20200.0.1 5571f4787691 */
/* bench 20200.0.2 7aa6df8d9173 */
/* bench 20200.0.3 e5e74dca6066 */
/* bench 20200.0.4 3fdb1263e09f */
/* bench 20200.0.5 df1062ccc77b */
/* bench 20200.0.6 4d46bcc7ead1 */
/* bench 20200.0.7 39fb11bb4625 */
/* bench 20200.0.8 07881a2e51be */
/* bench 482.0.0 9999880947e3 */
/* bench 482.0.1 d6bfa168509f */
/* bench 482.0.2 ece82798911d */
/* bench 482.0.3 a422fb6f0000 */
/* bench 482.0.4 deb3031b31b1 */
/* bench 482.0.5 e67a516e8791 */
/* bench 482.0.6 455e58c68c47 */
/* bench 482.0.7 f2beb07a09f9 */
/* bench 482.0.8 ef8c1ca8bdfb */
/* bench 482.0.9 c54357d7613d */
properties:
  "#sound-dai-cells":
    const: 0

  compatible:
    oneOf:
      - const: allwinner,sun4i-a10-spdif
      - const: allwinner,sun6i-a31-spdif
      - const: allwinner,sun8i-h3-spdif
      - const: allwinner,sun50i-h6-spdif
      - items:
          - const: allwinner,sun8i-a83t-spdif
          - const: allwinner,sun8i-h3-spdif
      - items:
          - const: allwinner,sun50i-a64-spdif
          - const: allwinner,sun8i-h3-spdif

  reg:
    maxItems: 1

  interrupts:
    maxItems: 1

  clocks:
    items:
      - description: Bus Clock
      - description: Module Clock

  clock-names:
    items:
      - const: apb
      - const: spdif

  # Even though it only applies to subschemas under the conditionals,
  # not listing them here will trigger a warning because of the
  # additionalsProperties set to false.
  dmas: true
  dma-names: true
  resets:
    maxItems: 1

allOf:
  - if:
      properties:
        compatible:
          contains:
            enum:
              - allwinner,sun6i-a31-spdif
              - allwinner,sun8i-h3-spdif

    then:
      required:
        - resets

  - if:
      properties:
        compatible:
          contains:
            enum:
              - allwinner,sun8i-h3-spdif
              - allwinner,sun50i-h6-spdif

    then:
      properties:
        dmas:
          description: TX DMA Channel

        dma-names:
          const: tx

    else:
      properties:
        dmas:
          items:
            - description: RX DMA Channel
            - description: TX DMA Channel

        dma-names:
          items:
            - const: rx
            - const: tx

required:
  - "#sound-dai-cells"
  - compatible
  - reg
  - interrupts
  - clocks
  - clock-names
  - dmas
  - dma-names

additionalProperties: false

examples:
  - |
    spdif: spdif@1c21000 {
        #sound-dai-cells = <0>;
        compatible = "allwinner,sun4i-a10-spdif";
        reg = <0x01c21000 0x40>;
        interrupts = <13>;
        clocks = <&apb0_gates 1>, <&spdif_clk>;
        clock-names = "apb", "spdif";
        dmas = <&dma 0 2>, <&dma 0 2>;
        dma-names = "rx", "tx";
    };

...
```
