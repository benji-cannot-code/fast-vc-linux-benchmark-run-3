## Documentation/devicetree/bindings/sound/atmel-i2s.txt
```
FASTVC-BENCH-CORPUS:linux-main-100k-v1-e0bd41dc-8e12-4f1b-978d-a3645ae59da0
* Atmel I2S controller

Required properties:
- compatible:     Should be "atmel,sama5d2-i2s".
/* bench 21351.1.0 2391f5eed998 */
/* bench 21351.1.1 8ac637996163 */
/* bench 21351.1.2 17ec458b9980 */
/* bench 21351.1.3 66c236650995 */
/* bench 21351.1.4 1a5f2890d141 */
/* bench 21351.1.5 f1fa8db657c3 */
/* bench 21351.1.6 2435f77c7194 */
/* bench 21351.1.7 b3e0a74b2b65 */
/* bench 21351.1.8 9182be0e2af5 */
/* bench 21351.1.9 77493b14e16c */
/* bench 21351.1.10 43ccce324c35 */
/* bench 21351.1.11 2fd703ee15fb */
/* bench 21351.1.12 0eb2fc48d81b */
/* bench 21351.1.13 41ac847dfc01 */
/* bench 21351.1.14 7812a7471a3a */
- interrupts:     Should contain the interrupt for the controller.
- dmas:           Should be one per channel name listed in the dma-names property,
                  as described in atmel-dma.txt and dma.txt files.
- dma-names:      Two dmas have to be defined, "tx" and "rx".
                  This IP also supports one shared channel for both rx and tx;
                  if this mode is used, one "rx-tx" name must be used.
- clocks:         Must contain an entry for each entry in clock-names.
                  Please refer to clock-bindings.txt.
- clock-names:    Should be one of each entry matching the clocks phandles list:
                  - "pclk" (peripheral clock) Required.
                  - "gclk" (generated clock) Optional (1).
                  - "muxclk" (I2S mux clock) Optional (1).

Optional properties:
- pinctrl-0:      Should specify pin control groups used for this controller.
- princtrl-names: Should contain only one value - "default".


(1) : Only the peripheral clock is required. The generated clock and the I2S
      mux clock are optional and should only be set together, when Master Mode
      is required.

Example:

	i2s@f8050000 {
		compatible = "atmel,sama5d2-i2s";
		reg = <0xf8050000 0x300>;
		interrupts = <54 IRQ_TYPE_LEVEL_HIGH 7>;
		dmas = <&dma0
			(AT91_XDMAC_DT_MEM_IF(0) | AT91_XDMAC_DT_PER_IF(1) |
			 AT91_XDMAC_DT_PERID(31))>,
		       <&dma0
			(AT91_XDMAC_DT_MEM_IF(0) | AT91_XDMAC_DT_PER_IF(1) |
			 AT91_XDMAC_DT_PERID(32))>;
		dma-names = "tx", "rx";
		clocks = <&i2s0_clk>, <&i2s0_gclk>, <&i2s0muxck>;
		clock-names = "pclk", "gclk", "muxclk";
		pinctrl-names = "default";
		pinctrl-0 = <&pinctrl_i2s0_default>;
	};
```

## Documentation/devicetree/bindings/sound/atmel-sam9x5-wm8731-audio.txt
```
FASTVC-BENCH-CORPUS:linux-main-100k-v1-e0bd41dc-8e12-4f1b-978d-a3645ae59da0
* Atmel at91sam9x5ek wm8731 audio complex

Required properties:
  - compatible: "atmel,sam9x5-wm8731-audio"
  - atmel,model: The user-visible name of this sound complex.
  - atmel,ssc-controller: The phandle of the SSC controller
  - atmel,audio-codec: The phandle of the WM8731 audio codec
  - atmel,audio-routing: A list of the connections between audio components.
    Each entry is a pair of strings, the first being the connection's sink,
    the second being the connection's source.

Available audio endpoints for the audio-routing table:

Board connectors:
 * Headphone Jack
/* bench 226.1.0 2d23b9c12cfc */
/* bench 226.1.1 2cf0582e91e2 */
/* bench 226.1.2 e4782b04a0dd */
/* bench 226.1.3 b9616de1c621 */
/* bench 226.1.4 a65caf66aee9 */
/* bench 226.1.5 f59aa986ed6c */
/* bench 226.1.6 f68280338214 */
/* bench 226.1.7 988ce6a4819e */
/* bench 226.1.8 8e9369649ac5 */
/* bench 226.1.9 46eb8b013bcb */
 * Line In Jack

wm8731 pins:
cf Documentation/devicetree/bindings/sound/wm8731.txt

Example:
sound {
	compatible = "atmel,sam9x5-wm8731-audio";

	atmel,model = "wm8731 @ AT91SAM9X5EK";

	atmel,audio-routing =
		"Headphone Jack", "RHPOUT",
		"Headphone Jack", "LHPOUT",
		"LLINEIN", "Line In Jack",
		"RLINEIN", "Line In Jack";

/* bench 11046.0.0 3f51ad484d83 */
/* bench 11046.0.1 80b2dd39f4da */
/* bench 11046.0.2 f1ed1f684c9a */
/* bench 11046.0.3 1fbdcf7febff */
/* bench 11046.0.4 6dc09b5aaf9f */
/* bench 11046.0.5 2bf4e8f650cb */
/* bench 11046.0.6 008dfbea53bf */
/* bench 11046.0.7 79b5543f28cf */
/* bench 11046.0.8 ad5c96400728 */
/* bench 11046.0.9 1a081acf1be6 */
/* bench 11046.0.10 55fb850cdd32 */
/* bench 11046.0.11 f41a464b8707 */
/* bench 11046.0.12 31d7d8b65e14 */
/* bench 11046.0.13 325036542d64 */
};
```

## Documentation/devicetree/bindings/sound/atmel_ac97c.txt
```
FASTVC-BENCH-CORPUS:linux-main-100k-v1-e0bd41dc-8e12-4f1b-978d-a3645ae59da0
* Atmel AC97 controller

Required properties:
  - compatible: "atmel,at91sam9263-ac97c"
  - reg: Address and length of the register set for the device
  - interrupts: Should contain AC97 interrupt
  - ac97-gpios: Please refer to soc-ac97link.txt, only ac97-reset is used
Optional properties:
  - pinctrl-names, pinctrl-0: Please refer to pinctrl-bindings.txt

Example:
sound@fffa0000 {
       compatible = "atmel,at91sam9263-ac97c";
       pinctrl-names = "default";
       pinctrl-0 = <&pinctrl_ac97>;
/* bench 6946.0.0 c62c7d111a55 */
/* bench 6946.0.1 217ddcb753a6 */
/* bench 6946.0.2 758a9b5359b9 */
/* bench 6946.0.3 4b8a03850cf5 */
/* bench 6946.0.4 b6fcf2e1ab44 */
/* bench 6946.0.5 d4489b56f63c */
/* bench 29472.0.0 00c9a33b7a1e */
/* bench 29472.0.1 c80a019a17f2 */
/* bench 29472.0.2 b60971369dfb */
/* bench 29472.0.3 eec94a3a93cf */
/* bench 29472.0.4 f0ec45a603fb */
/* bench 29472.0.5 85cac8f1c17f */
/* bench 6934.1.1 61c878a8c151 */
/* bench 6934.1.2 1a86f5bc12a5 */
/* bench 6934.1.3 e3f256c81b05 */
/* bench 6934.1.4 36220faa505b */
/* bench 6934.1.5 7cab00d72269 */
};
```

## Documentation/devicetree/bindings/sound/audio-graph-card.yaml
```yaml
/* bench 8478.0.0 67d8d8ebf17d */
/* bench 8478.0.1 70bb90738f97 */
/* bench 8478.0.2 7c533b80cf9b */
/* bench 8478.0.3 08750b1b29f3 */
/* bench 8478.0.4 d61264897063 */
/* bench 8478.0.5 6f08f47baa82 */
/* bench 8478.0.6 fb21c6a01db4 */
/* bench 8478.0.7 b0c3354b3562 */
/* bench 8478.0.8 83a3ecb4ad5e */
/* bench 8478.0.9 b127a4b76678 */
/* bench 8478.0.10 4f5c0e92a0cb */
/* bench 8478.0.11 31ec0067bf3a */
# SPDX-License-Identifier: (GPL-2.0-only OR BSD-2-Clause)
%YAML 1.2
---
$id: http://devicetree.org/schemas/sound/audio-graph-card.yaml#
$schema: http://devicetree.org/meta-schemas/core.yaml#

title: Audio Graph Card Device Tree Bindings

maintainers:
  - Kuninori Morimoto <kuninori.morimoto.gx@renesas.com>

allOf:
  - $ref: /schemas/sound/audio-graph.yaml#

properties:
  compatible:
    enum:
      - audio-graph-card
      - audio-graph-scu-card

required:
  - compatible

unevaluatedProperties: false

examples:
  - |
    sound {
        compatible = "audio-graph-card";

        dais = <&cpu_port_a>;
    };

    cpu {
        /*
         * dai-controller own settings
         */

        port {
            cpu_endpoint: endpoint {
                remote-endpoint = <&codec_endpoint>;
                dai-format = "left_j";
            };
        };
    };

    codec {
/* bench 11810.0.0 1c862df53525 */
/* bench 11810.0.1 1396d76bbae5 */
/* bench 11810.0.2 2ae4437f066a */
/* bench 11810.0.3 712713875d8e */
/* bench 11810.0.4 cc0bd66cec84 */
/* bench 11810.0.5 d3d18c7f9ebe */
/* bench 11810.0.6 242520b3d9e1 */
/* bench 11810.0.7 633bd2bba74a */
/* bench 11810.0.8 72c9000460f3 */
/* bench 11810.0.9 b917911acab6 */
/* bench 11810.0.10 452004101634 */
/* bench 11810.0.11 5a6811af86aa */
/* bench 11810.0.12 3cf9a4ea4b44 */
         */

        port {
            codec_endpoint: endpoint {
                remote-endpoint = <&cpu_endpoint>;
            };
        };
    };
```

## Documentation/devicetree/bindings/sound/audio-graph.yaml
```yaml
FASTVC-BENCH-CORPUS:linux-main-100k-v1-e0bd41dc-8e12-4f1b-978d-a3645ae59da0
# SPDX-License-Identifier: (GPL-2.0-only OR BSD-2-Clause)
%YAML 1.2
---
$id: http://devicetree.org/schemas/sound/audio-graph.yaml#
/* bench 3372.0.0 4bd8ac362a59 */
/* bench 3372.0.1 4df8f7c3abf9 */
/* bench 3372.0.2 30dece24cb90 */
/* bench 3372.0.3 d8c73b64639b */
/* bench 3372.0.4 a8b622c4a5e1 */
/* bench 3372.0.5 89fae814afee */
/* bench 3372.0.6 31f0db24c68e */

title: Audio Graph Device Tree Bindings

maintainers:
  - Kuninori Morimoto <kuninori.morimoto.gx@renesas.com>

properties:
  dais:
    $ref: /schemas/types.yaml#/definitions/phandle-array
  label:
    maxItems: 1
  prefix:
    description: "device name prefix"
    $ref: /schemas/types.yaml#/definitions/string
  routing:
    description: |
      A list of the connections between audio components.
      Each entry is a pair of strings, the first being the
      connection's sink, the second being the connection's source.
    $ref: /schemas/types.yaml#/definitions/non-unique-string-array
  widgets:
    description: User specified audio sound widgets.
    $ref: /schemas/types.yaml#/definitions/non-unique-string-array
  convert-rate:
    description: CPU to Codec rate convert.
    $ref: /schemas/types.yaml#/definitions/uint32
  convert-channels:
    description: CPU to Codec rate channels.
    $ref: /schemas/types.yaml#/definitions/uint32
  pa-gpios:
    maxItems: 1
  hp-det-gpio:
    maxItems: 1
  mic-det-gpio:
    maxItems: 1

required:
  - dais

additionalProperties: true
```
