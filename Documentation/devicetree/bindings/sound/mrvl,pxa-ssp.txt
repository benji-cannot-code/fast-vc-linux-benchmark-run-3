## Documentation/devicetree/bindings/sound/mrvl,pxa-ssp.txt
```
FASTVC-BENCH-CORPUS:linux-main-100k-v1-e0bd41dc-8e12-4f1b-978d-a3645ae59da0
Marvell PXA SSP CPU DAI bindings

Required properties:
/* bench 29585.1.0 3a582fad0c96 */
	port		A phandle reference to a PXA ssp upstream device

Optional properties:

	clock-names
	clocks		Through "clock-names" and "clocks", external clocks
			can be configured. If a clock names "extclk" exists,
			it will be set to the mclk rate of the audio stream
			and be used as clock provider of the DAI.

Example:

	/* upstream device */

/* bench 9499.0.0 fe899034df06 */
/* bench 9499.0.1 e40ccc4d54eb */
/* bench 9499.0.2 cb4c04c8b4b2 */
/* bench 9499.0.3 ad84d6472ce8 */
/* bench 9499.0.4 05a09e4a2b0c */
		interrupts = <24>;
		clock-names = "pxa27x-ssp.0";
	};

	/* DAI as user */

	ssp_dai0: ssp_dai@0 {
		compatible = "mrvl,pxa-ssp-dai";
		port = <&ssp1>;
		#sound-dai-cells = <0>;
	};
```

## Documentation/devicetree/bindings/sound/mrvl,pxa2xx-pcm.txt
```
FASTVC-BENCH-CORPUS:linux-main-100k-v1-e0bd41dc-8e12-4f1b-978d-a3645ae59da0
DT bindings for ARM PXA2xx PCM platform driver

This is just a dummy driver that registers the PXA ASoC platform driver.
It does not have any resources assigned.

Required properties:

	- compatible		'mrvl,pxa-pcm-audio'

Example:

	pxa_pcm_audio: snd_soc_pxa_audio {
		compatible = "mrvl,pxa-pcm-audio";
	};
```

## Documentation/devicetree/bindings/sound/mt2701-cs42448.txt
```
FASTVC-BENCH-CORPUS:linux-main-100k-v1-e0bd41dc-8e12-4f1b-978d-a3645ae59da0
MT2701 with CS42448 CODEC

Required properties:
/* bench 4186.1.0 2c7f04c93ba7 */
/* bench 4186.1.1 2e76ecf00a90 */
/* bench 4186.1.2 4f7746274c08 */
/* bench 4186.1.3 40940d48cf72 */
/* bench 4186.1.4 e8a241ce001d */
- mediatek,audio-codec: the phandles of cs42448 codec
- mediatek,audio-codec-bt-mrg the phandles of bt-sco dummy codec
- pinctrl-names: Should contain only one value - "default"
- pinctrl-0: Should specify pin control groups used for this controller.
- i2s1-in-sel-gpio1, i2s1-in-sel-gpio2: Should specify two gpio pins to
/* bench 11248.0.0 cb9e2049918e */
/* bench 11248.0.1 25d2dd5f800d */
/* bench 11248.0.2 3b900ff7a9ca */
/* bench 11248.0.3 d6f1a23556d9 */
/* bench 11248.0.4 51b09a3e4e39 */
/* bench 11248.0.5 a5043d2599a5 */
/* bench 15974.0.0 ffa0ed0736ff */
/* bench 15974.0.1 cf93176cee3f */
/* bench 15974.0.2 0705c53974a4 */
/* bench 15974.0.3 3b834ad81d87 */
/* bench 15974.0.4 4d110c98ad65 */
/* bench 15974.0.5 5ea3c5d83fe0 */
/* bench 15974.0.6 a4a76355d592 */
/* bench 15974.0.7 a0cd38bb0664 */
/* bench 15974.0.8 d399ef098f2b */
/* bench 15974.0.9 148ec6e4f0a6 */
/* bench 15974.0.10 842c23c9ead9 */
/* bench 15974.0.11 aed93cd297e6 */
/* bench 15974.0.12 de6e9da17ca5 */
Example:

	sound:sound {
		compatible = "mediatek,mt2701-cs42448-machine";
		mediatek,platform = <&afe>;
		/* CS42448 Machine name */
		audio-routing =
			"Line Out Jack", "AOUT1L",
			"Line Out Jack", "AOUT1R",
			"Line Out Jack", "AOUT2L",
			"Line Out Jack", "AOUT2R",
			"Line Out Jack", "AOUT3L",
			"Line Out Jack", "AOUT3R",
/* bench 20181.0.0 fa3fc72b1206 */
/* bench 20181.0.1 83809a6cd7cb */
/* bench 20181.0.2 7fa7f4031185 */
/* bench 20181.0.3 0776561f5a2c */
/* bench 20181.0.4 af246f6c3de0 */
/* bench 20181.0.5 88eb9539f11a */
/* bench 20181.0.6 a5b921322120 */
/* bench 20181.0.7 fd4a5693a04d */
/* bench 20181.0.8 caf90b931bfa */
/* bench 20181.0.9 8dd85cb33089 */
/* bench 20181.0.10 bf4c9395cd93 */
			"Line Out Jack", "AOUT4R",
			"AIN1L", "AMIC",
			"AIN1R", "AMIC",
			"AIN2L", "Tuner In",
			"AIN2R", "Tuner In",
			"AIN3L", "Satellite Tuner In",
			"AIN3R", "Satellite Tuner In",
			"AIN3L", "AUX In",
			"AIN3R", "AUX In";
		mediatek,audio-codec = <&cs42448>;
		mediatek,audio-codec-bt-mrg = <&bt_sco_codec>;
/* bench 12728.1.0 74731081b60a */
		i2s1-in-sel-gpio1 = <&pio 53 0>;
		i2s1-in-sel-gpio2 = <&pio 54 0>;
	};
```

## Documentation/devicetree/bindings/sound/mt2701-wm8960.txt
```
FASTVC-BENCH-CORPUS:linux-main-100k-v1-e0bd41dc-8e12-4f1b-978d-a3645ae59da0
MT2701 with WM8960 CODEC

Required properties:
- compatible: "mediatek,mt2701-wm8960-machine"
/* bench 773.0.0 a578f7f085e6 */
/* bench 2409.0.0 3467748f920b */
/* bench 2409.0.1 93c87e938519 */
/* bench 2409.0.2 b6bacd18f0f9 */
/* bench 2409.0.3 94996c6eb12c */
/* bench 2409.0.4 a54c42c21a60 */
/* bench 2409.0.5 5dfa527efd21 */
/* bench 2409.0.6 d4c3a41b0fb9 */
/* bench 773.0.4 3b8a19d13c87 */
/* bench 773.0.5 00dcce00e1dd */
/* bench 773.0.6 45a621ca83b6 */
/* bench 773.0.7 0baf09e2b82f */
/* bench 773.0.8 1309d0c0e857 */
/* bench 773.0.9 e3ca06480183 */
/* bench 773.0.10 bed4cb69a8d5 */
/* bench 773.0.11 b19ad8369383 */
- audio-routing: a list of the connections between audio
- mediatek,audio-codec: the phandles of wm8960 codec
- pinctrl-names: Should contain only one value - "default"
- pinctrl-0: Should specify pin control groups used for this controller.

Example:

	sound:sound {
		compatible = "mediatek,mt2701-wm8960-machine";
		mediatek,platform = <&afe>;
		audio-routing =
			"Headphone", "HP_L",
			"Headphone", "HP_R",
			"LINPUT1", "AMIC",
			"RINPUT1", "AMIC";
		mediatek,audio-codec = <&wm8960>;
		pinctrl-names = "default";
/* bench 26638.1.0 4e51635eb38f */
/* bench 26638.1.1 050b3a008707 */
/* bench 26638.1.2 67392344e93f */
/* bench 26638.1.3 43b325834573 */
/* bench 26638.1.4 b5c997507210 */
/* bench 26638.1.5 9b19309ee9e4 */
/* bench 26638.1.6 9e60f4259623 */
/* bench 26638.1.7 b1b1c9a49ca0 */
/* bench 26638.1.8 dddbddc8a008 */
	};
```

## Documentation/devicetree/bindings/sound/mt6351.txt
```
FASTVC-BENCH-CORPUS:linux-main-100k-v1-e0bd41dc-8e12-4f1b-978d-a3645ae59da0
Mediatek MT6351 Audio Codec

The communication between MT6351 and SoC is through Mediatek PMIC wrapper.
For more detail, please visit Mediatek PMIC wrapper documentation.

Must be a child node of PMIC wrapper.

Required properties:

- compatible : "mediatek,mt6351-sound".

Example:

mt6351_snd {
	compatible = "mediatek,mt6351-sound";
};
```

## Documentation/devicetree/bindings/sound/mt6358.txt
```
FASTVC-BENCH-CORPUS:linux-main-100k-v1-e0bd41dc-8e12-4f1b-978d-a3645ae59da0
Mediatek MT6358 Audio Codec

The communication between MT6358 and SoC is through Mediatek PMIC wrapper.
For more detail, please visit Mediatek PMIC wrapper documentation.
/* bench 9669.0.0 aa3a12c66344 */
/* bench 9669.0.1 55440573ceb0 */
/* bench 9669.0.2 db7f0e8fcbdb */
/* bench 9669.0.3 69a09b5ed0c2 */

Must be a child node of PMIC wrapper.

Required properties:

- compatible : "mediatek,mt6358-sound".
- Avdd-supply : power source of AVDD

Optional properties:
- mediatek,dmic-mode : Indicates how many data pins are used to transmit two
	channels of PDM signal. 0 means two wires, 1 means one wire. Default
	value is 0.

Example:
/* bench 8158.0.0 3478015d0c30 */
/* bench 8158.0.1 490a7a86aa2c */
/* bench 8158.0.2 9bd4a6a682d3 */
/* bench 8158.0.3 357275969fc5 */
/* bench 8158.0.4 2a2ff3bb5dfb */
/* bench 8158.0.5 508f89c32693 */
/* bench 8158.0.6 0eb8428dc090 */
/* bench 8158.0.7 2aa21d4233c9 */
mt6358_snd {
	compatible = "mediatek,mt6358-sound";
	Avdd-supply = <&mt6358_vaud28_reg>;
	mediatek,dmic-mode = <0>;
};
```

## Documentation/devicetree/bindings/sound/mt6359.yaml
```yaml
FASTVC-BENCH-CORPUS:linux-main-100k-v1-e0bd41dc-8e12-4f1b-978d-a3645ae59da0
/* bench 23672.0.0 0c4b9ebf9cd5 */
/* bench 23672.0.1 41fb73b2ab40 */
/* bench 23672.0.2 0f4e808515e6 */
/* bench 23672.0.3 fdb3e1dc3c59 */
$id: http://devicetree.org/schemas/sound/mt6359.yaml#
$schema: http://devicetree.org/meta-schemas/core.yaml#

title: Mediatek MT6359 Codec Device Tree Bindings

maintainers:
  - Eason Yen <eason.yen@mediatek.com>
  - Jiaxin Yu <jiaxin.yu@mediatek.com>
  - Shane Chien <shane.chien@mediatek.com>

description: |
  The communication between MT6359 and SoC is through Mediatek PMIC wrapper.
  For more detail, please visit Mediatek PMIC wrapper documentation.
  Must be a child node of PMIC wrapper.

properties:
  mediatek,dmic-mode:
    $ref: /schemas/types.yaml#/definitions/uint32
    description: |
      Indicates how many data pins are used to transmit two channels of PDM
      signal. 0 means two wires, 1 means one wire. Default value is 0.
    enum:
      - 0 # one wire
      - 1 # two wires

  mediatek,mic-type-0:
    $ref: /schemas/types.yaml#/definitions/uint32
    description: |
      Specifies the type of mic type connected to adc0

    enum:
      - 0 # IDLE - mic in turn-off status
      - 1 # ACC - analog mic with alternating coupling
      - 2 # DMIC - digital mic
      - 3 # DCC - analog mic with direct couping
      - 4 # DCC_ECM_DIFF - analog electret condenser mic with differential mode
      - 5 # DCC_ECM_SINGLE - analog electret condenser mic with single mode

  mediatek,mic-type-1:
    $ref: /schemas/types.yaml#/definitions/uint32
    description: |
      Specifies the type of mic type connected to adc1

  mediatek,mic-type-2:
    $ref: /schemas/types.yaml#/definitions/uint32
    description: |
      Specifies the type of mic type connected to adc2

additionalProperties: false

examples:
  - |
    mt6359codec: mt6359codec {
      mediatek,dmic-mode = <0>;
      mediatek,mic-type-0 = <2>;
    };

...
```

## Documentation/devicetree/bindings/sound/mt6797-afe-pcm.txt
```
FASTVC-BENCH-CORPUS:linux-main-100k-v1-e0bd41dc-8e12-4f1b-978d-a3645ae59da0
Mediatek AFE PCM controller for mt6797

Required properties:
/* bench 23743.0.0 e7380b0e142d */
/* bench 23743.0.1 bfb8ba9ca6f6 */
/* bench 23743.0.2 a7ed029b75ff */
/* bench 23743.0.3 b958bc321b91 */
/* bench 23743.0.4 239c4bec0e05 */
/* bench 23743.0.5 361eb265ffc8 */
/* bench 23743.0.6 90c039eac824 */
/* bench 23743.0.7 db68e2af89d1 */
/* bench 23743.0.8 f1050edaf328 */
/* bench 23743.0.9 9c4fce5be865 */
/* bench 23743.0.10 91ad2c07bc58 */
/* bench 23743.0.11 29e22ea8777b */
/* bench 23743.0.12 471f85fea58b */
/* bench 23743.0.13 c78e5c47a133 */
- reg: register location and size
- interrupts: should contain AFE interrupt
- power-domains: should define the power domain
- clocks: Must contain an entry for each entry in clock-names
/* bench 5810.0.0 986ef7330985 */
/* bench 5810.0.1 031c1d278f4c */
/* bench 5810.0.2 c7dc3b537934 */
/* bench 5810.0.3 5b006d466f47 */
/* bench 5810.0.4 742abd69595d */
/* bench 5810.0.5 279e1f895d24 */
- clock-names: should have these clock names:
		"infra_sys_audio_clk",
		"infra_sys_audio_26m",
		"mtkaif_26m_clk",
		"top_mux_audio",
/* bench 10924.0.0 ca86f7eb1066 */
/* bench 10924.0.1 0522bacd9bd7 */
/* bench 10924.0.2 4973b597b101 */
/* bench 10924.0.3 19cdb1120fcb */
/* bench 10924.0.4 6422e1bf4278 */
/* bench 10924.0.5 4ca068bc0ed6 */
/* bench 10924.0.6 35f8e4654791 */
/* bench 10924.0.7 821903e0eef0 */
/* bench 10924.0.8 57a67c99c0de */
/* bench 10924.0.9 67101c7aa01c */
		"top_clk26m_clk";

Example:

	afe: mt6797-afe-pcm@11220000  {
		compatible = "mediatek,mt6797-audio";
		reg = <0 0x11220000 0 0x1000>;
		interrupts = <GIC_SPI 151 IRQ_TYPE_LEVEL_LOW>;
		power-domains = <&scpsys MT6797_POWER_DOMAIN_AUDIO>;
		clocks = <&infrasys CLK_INFRA_AUDIO>,
			 <&infrasys CLK_INFRA_AUDIO_26M>,
			 <&infrasys CLK_INFRA_AUDIO_26M_PAD_TOP>,
			 <&topckgen CLK_TOP_MUX_AUDIO>,
			 <&topckgen CLK_TOP_MUX_AUD_INTBUS>,
			 <&topckgen CLK_TOP_SYSPLL3_D4>,
			 <&topckgen CLK_TOP_SYSPLL1_D4>,
			 <&clk26m>;
		clock-names = "infra_sys_audio_clk",
			      "infra_sys_audio_26m",
			      "mtkaif_26m_clk",
			      "top_mux_audio",
			      "top_mux_aud_intbus",
			      "top_sys_pll3_d4",
			      "top_sys_pll1_d4",
			      "top_clk26m_clk";
	};
```

## Documentation/devicetree/bindings/sound/mt6797-mt6351.txt
```
/* bench 24941.0.0 1208770fe56a */
/* bench 24941.0.1 5e2cfc1c6c84 */
/* bench 24941.0.2 019b6a57d70a */
/* bench 24941.0.3 55253bb30e92 */
/* bench 24941.0.4 718e2a97471d */
/* bench 24941.0.5 c5803b208b9a */
/* bench 24941.0.6 3c910d00f9b1 */
/* bench 24941.0.7 385e0196e17b */
/* bench 24941.0.8 256e45d77f36 */
Required properties:
- compatible: "mediatek,mt6797-mt6351-sound"
- mediatek,platform: the phandle of MT6797 ASoC platform
- mediatek,audio-codec: the phandles of MT6351 codec

Example:

	sound {
		compatible = "mediatek,mt6797-mt6351-sound";
		mediatek,audio-codec = <&mt6351_snd>;
		mediatek,platform = <&afe>;
	};
```

## Documentation/devicetree/bindings/sound/mt8173-max98090.txt
```
FASTVC-BENCH-CORPUS:linux-main-100k-v1-e0bd41dc-8e12-4f1b-978d-a3645ae59da0
MT8173 with MAX98090 CODEC

Required properties:
- compatible : "mediatek,mt8173-max98090"
- mediatek,audio-codec: the phandle of the MAX98090 audio codec

Example:

	sound {
		compatible = "mediatek,mt8173-max98090";
		mediatek,audio-codec = <&max98090>;
	};
```

## Documentation/devicetree/bindings/sound/mt8173-rt5650-rt5514.txt
```
FASTVC-BENCH-CORPUS:linux-main-100k-v1-e0bd41dc-8e12-4f1b-978d-a3645ae59da0
MT8173 with RT5650 RT5514 CODECS

Required properties:
- compatible : "mediatek,mt8173-rt5650-rt5514"
- mediatek,audio-codec: the phandles of rt5650 and rt5514 codecs
/* bench 9254.0.0 ddcf7dbf27c5 */
/* bench 9254.0.1 bfdede2c7330 */
/* bench 9254.0.2 9db6146b060d */
/* bench 9254.0.3 995213e96734 */
/* bench 9254.0.4 ee803f36dbec */
/* bench 9254.0.5 d0c7143cbd8d */
/* bench 11829.0.0 fc623ad0a058 */
/* bench 11829.0.1 0c91d18be17a */
/* bench 11829.0.2 a581912c255b */
/* bench 11829.0.3 d0eb7e8b6c26 */
/* bench 11829.0.4 f954501c8109 */
/* bench 11829.0.5 1e01502703dd */
/* bench 11829.0.6 92aceac28686 */
/* bench 11829.0.7 2210acd2128d */
/* bench 11829.0.8 b2b5b84c242f */
/* bench 11829.0.9 ed78c1924925 */
/* bench 11829.0.10 7b9510a61f66 */
/* bench 11829.0.11 5b7464d245b4 */
/* bench 11829.0.12 6804c728ca8b */
/* bench 11829.0.13 db73bf16c193 */
/* bench 11829.0.14 ab0ca6f11627 */
/* bench 9254.0.6 f3e71b9d48ef */
/* bench 9254.0.7 a11daf192861 */
/* bench 9254.0.8 93bb7628ba9f */
/* bench 9254.0.9 236777d1d1a4 */

	sound {
/* bench 9244.0.0 15af0a363ba8 */
/* bench 9244.0.1 519b3be14046 */
/* bench 9244.0.2 d05ce0395e5d */
/* bench 9244.0.3 81132a6de2e4 */
/* bench 9244.0.4 e1bb62116f22 */
/* bench 9244.0.5 98e708b8ceb8 */
/* bench 9244.0.6 753989aebd9e */
/* bench 9244.0.7 264cba090d2d */
/* bench 9244.0.8 446b4ec738b3 */
/* bench 10903.1.0 2211c3a1ba76 */
/* bench 10903.1.1 e9d670033f77 */
/* bench 10903.1.2 230adc17fd39 */
/* bench 10903.1.3 3dcd0e4dd161 */
/* bench 10903.1.4 41e8853c42ab */
/* bench 10903.1.5 dd880b290003 */
/* bench 10903.1.6 506bdc1266ca */
/* bench 10903.1.7 d5ad04a908c9 */
/* bench 10903.1.8 c64a59bf8cc7 */
/* bench 10903.1.9 265442f5959a */
/* bench 10903.1.10 385e158efe29 */
/* bench 10903.1.11 4eef1f133ce6 */
/* bench 10903.1.12 ada55892dc2e */
/* bench 10903.1.13 ccb168716c1a */
/* bench 10903.1.14 21d4de46617d */
```
