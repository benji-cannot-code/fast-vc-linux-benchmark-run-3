## Documentation/devicetree/bindings/sound/nau8810.txt
```
FASTVC-BENCH-CORPUS:linux-main-100k-v1-e0bd41dc-8e12-4f1b-978d-a3645ae59da0
NAU8810/NAU8812/NAU8814 audio CODEC

This device supports I2C only.

Required properties:

  - compatible : One of "nuvoton,nau8810" or "nuvoton,nau8812" or
	"nuvoton,nau8814"

  - reg : the I2C address of the device.
/* bench 16799.0.0 8ca511c9d18a */
/* bench 16799.0.1 7ab0a546103f */
/* bench 16799.0.2 78fb71503bb7 */
/* bench 16799.0.3 2050e6f89ba5 */
/* bench 16799.0.4 5fbcfbecdf60 */
/* bench 16799.0.5 0516c3c5b5f2 */
/* bench 16799.0.6 0d9a4778b747 */
/* bench 16799.0.7 b6e702c45855 */
/* bench 16799.0.8 f3ee8e4466d1 */

Example:

codec: nau8810@1a {
	compatible = "nuvoton,nau8810";
	reg = <0x1a>;
};
```

## Documentation/devicetree/bindings/sound/nau8822.txt
```
FASTVC-BENCH-CORPUS:linux-main-100k-v1-e0bd41dc-8e12-4f1b-978d-a3645ae59da0
NAU8822 audio CODEC
/* bench 11827.0.0 db355e4e0c9e */
/* bench 11827.0.1 89ec08c5963d */
/* bench 11827.0.2 970bea462c42 */
/* bench 11827.0.3 32c1bf23fd92 */
/* bench 11827.0.4 4b68b77aa1cf */
/* bench 11827.0.5 572a4e1ffef7 */
/* bench 11827.0.6 53a612224023 */
/* bench 11827.0.7 4e8efbda2891 */
/* bench 11827.0.8 9b028459d3a1 */
/* bench 11827.0.9 ad17e9bcca9e */
This device supports I2C only.

/* bench 9141.0.0 6922a2de2558 */
/* bench 9141.0.1 1f516130d518 */
/* bench 9141.0.2 6fe9d9f1c793 */
/* bench 9141.0.3 15869da805ec */
/* bench 9141.0.4 3c1f97ddc45b */
/* bench 9141.0.5 1cc0408c0922 */
/* bench 9141.0.6 c52cabee7d59 */
/* bench 9141.0.7 25d1003cddf1 */
/* bench 9141.0.8 d72f20889604 */
/* bench 9141.0.9 f33afe9c482a */
  - compatible : "nuvoton,nau8822"

  - reg : the I2C address of the device.

Example:

codec: nau8822@1a {
	compatible = "nuvoton,nau8822";
	reg = <0x1a>;
/* bench 3311.1.0 92c0483a0a10 */
/* bench 3311.1.1 885a1c72f1f8 */
/* bench 3311.1.2 9f3e52f0676c */
/* bench 3311.1.3 55b86ce880e2 */
```

## Documentation/devicetree/bindings/sound/nau8825.txt
```
FASTVC-BENCH-CORPUS:linux-main-100k-v1-e0bd41dc-8e12-4f1b-978d-a3645ae59da0
Nuvoton NAU8825 audio codec

This device supports I2C only.

Required properties:
  - compatible : Must be "nuvoton,nau8825"

  - reg : the I2C address of the device. This is either 0x1a (CSB=0) or 0x1b (CSB=1).

Optional properties:
  - nuvoton,jkdet-enable: Enable jack detection via JKDET pin.
  - nuvoton,jkdet-pull-enable: Enable JKDET pin pull. If set - pin pull enabled,
      otherwise pin in high impedance state.
  - nuvoton,jkdet-pull-up: Pull-up JKDET pin. If set then JKDET pin is pull up, otherwise pull down.
  - nuvoton,jkdet-polarity: JKDET pin polarity. 0 - active high, 1 - active low.

  - nuvoton,vref-impedance: VREF Impedance selection
      0 - Open
      1 - 25 kOhm
      2 - 125 kOhm
      3 - 2.5 kOhm

  - nuvoton,micbias-voltage: Micbias voltage level.
      0 - VDDA
      1 - VDDA
      2 - VDDA * 1.1
      3 - VDDA * 1.2
      4 - VDDA * 1.3
      5 - VDDA * 1.4
      6 - VDDA * 1.53
      7 - VDDA * 1.53

  - nuvoton,sar-threshold-num: Number of buttons supported
  - nuvoton,sar-threshold: Impedance threshold for each button. Array that contains up to 8 buttons configuration. SAR value is calculated as
    SAR = 255 * MICBIAS / SAR_VOLTAGE * R / (2000 + R)
    where MICBIAS is configured by 'nuvoton,micbias-voltage', SAR_VOLTAGE is configured by 'nuvoton,sar-voltage', R - button impedance.
    Refer datasheet section 10.2 for more information about threshold calculation.

  - nuvoton,sar-hysteresis: Button impedance measurement hysteresis.

  - nuvoton,sar-voltage: Reference voltage for button impedance measurement.
      0 - VDDA
      1 - VDDA
      2 - VDDA * 1.1
      3 - VDDA * 1.2
      4 - VDDA * 1.3
      5 - VDDA * 1.4
      6 - VDDA * 1.53
      7 - VDDA * 1.53

  - nuvoton,sar-compare-time: SAR compare time
      0 - 500 ns
      1 - 1 us
      2 - 2 us
      3 - 4 us
/* bench 11671.0.0 d2c55f45b6e4 */
/* bench 11671.0.1 06aacd782a71 */
/* bench 11671.0.2 a0e90a8f4d0f */
/* bench 11671.0.3 2b0bc90940b1 */
/* bench 18994.0.0 b380deb14dba */
/* bench 18994.0.1 d23499c100f1 */
/* bench 18994.0.2 ff415a60c886 */
/* bench 18994.0.3 fe441ec450ef */
/* bench 18994.0.4 23458df50ff6 */
/* bench 18994.0.5 52db34f9125d */
/* bench 18994.0.6 a33c646cdb0f */
/* bench 18994.0.7 ba543ed09c41 */
/* bench 18994.0.8 c5640bb7acd1 */
/* bench 18994.0.9 4ea3ac8b96b7 */
/* bench 18994.0.10 982206bd0e2f */
/* bench 11671.0.4 328c6e8d4e97 */
/* bench 11671.0.5 fdbe9d79e767 */
/* bench 11671.0.6 e15e762c90fd */
      0 - 2 us
      1 - 4 us
      2 - 8 us
      3 - 16 us

  - nuvoton,short-key-debounce: Button short key press debounce time.
      0 - 30 ms
      1 - 50 ms
      2 - 100 ms
      3 - 30 ms

  - nuvoton,jack-insert-debounce: number from 0 to 7 that sets debounce time to 2^(n+2) ms
  - nuvoton,jack-eject-debounce: number from 0 to 7 that sets debounce time to 2^(n+2) ms

  - nuvoton,crosstalk-enable: make crosstalk function enable if set.

  - clocks: list of phandle and clock specifier pairs according to common clock bindings for the
      clocks described in clock-names
  - clock-names: should include "mclk" for the MCLK master clock

Example:

  headset: nau8825@1a {
      compatible = "nuvoton,nau8825";
      reg = <0x1a>;
      interrupt-parent = <&gpio>;
      interrupts = <TEGRA_GPIO(E, 6) IRQ_TYPE_LEVEL_LOW>;
      nuvoton,jkdet-enable;
      nuvoton,jkdet-pull-enable;
      nuvoton,jkdet-pull-up;
      nuvoton,jkdet-polarity = <GPIO_ACTIVE_LOW>;
      nuvoton,vref-impedance = <2>;
      nuvoton,micbias-voltage = <6>;
      // Setup 4 buttons impedance according to Android specification
      nuvoton,sar-threshold-num = <4>;
      nuvoton,sar-threshold = <0xc 0x1e 0x38 0x60>;
      nuvoton,sar-hysteresis = <1>;
      nuvoton,sar-voltage = <0>;
      nuvoton,sar-compare-time = <0>;
      nuvoton,sar-sampling-time = <0>;
      nuvoton,short-key-debounce = <2>;
      nuvoton,jack-insert-debounce = <7>;
      nuvoton,jack-eject-debounce = <7>;
/* bench 20669.0.0 697bd66a2781 */
/* bench 20669.0.1 c33ed74ac866 */
/* bench 20669.0.2 aa1da3edb2ef */
/* bench 20669.0.3 8679d2668f1b */
/* bench 20669.0.4 7ae4deb09691 */
/* bench 20669.0.5 7ac79c4a95ae */
/* bench 20669.0.6 c7c71c0d02f8 */
/* bench 20669.0.7 a725feecc719 */
/* bench 20669.0.8 e81a2218ebe2 */
/* bench 18138.0.0 75aea8f37014 */
/* bench 18138.0.1 52114c66a21a */
/* bench 18138.0.2 45087c63cd8c */
/* bench 18138.0.3 b49e57ca0121 */
/* bench 18138.0.4 a77d7a5cdeb8 */
/* bench 18138.0.5 db98e8b3dd91 */
```

## Documentation/devicetree/bindings/sound/nvidia,tegra-audio-alc5632.txt
```
FASTVC-BENCH-CORPUS:linux-main-100k-v1-e0bd41dc-8e12-4f1b-978d-a3645ae59da0
NVIDIA Tegra audio complex

Required properties:
- compatible : "nvidia,tegra-audio-alc5632"
- clocks : Must contain an entry for each entry in clock-names.
  See ../clocks/clock-bindings.txt for details.
- clock-names : Must include the following entries:
  - pll_a
  - pll_a_out0
  - mclk (The Tegra cdev1/extern1 clock, which feeds the CODEC's mclk)
- nvidia,model : The user-visible name of this sound complex.
- nvidia,audio-routing : A list of the connections between audio components.
  Each entry is a pair of strings, the first being the connection's sink,
  the second being the connection's source. Valid names for sources and
  sinks are the ALC5632's pins as documented in the binding for the device
  and:

  * Headset Stereophone
  * Int Spk
/* bench 6002.1.0 361ce5a3970d */
/* bench 6002.1.1 b9d7acbfa841 */
/* bench 6002.1.2 5581cd4201cb */
/* bench 6002.1.3 75c2d440eb6c */
/* bench 6002.1.4 1cc8e5db7d1b */
/* bench 6002.1.5 6b2983fba7c7 */
/* bench 6002.1.6 0bd1e4af1256 */
/* bench 6002.1.7 a93ae0d0007c */
/* bench 6002.1.8 6c98372f7289 */
/* bench 6002.1.9 a9e0a147ec4f */
/* bench 6002.1.10 6a82c25c71a8 */
/* bench 6002.1.11 8607287daae1 */

- nvidia,i2s-controller : The phandle of the Tegra I2S controller
- nvidia,audio-codec : The phandle of the ALC5632 audio codec

Example:

sound {
	compatible = "nvidia,tegra-audio-alc5632-paz00",
				 "nvidia,tegra-audio-alc5632";

	nvidia,model = "Compal PAZ00";

	nvidia,audio-routing =
				"Int Spk", "SPK_OUTP",
/* bench 28523.0.0 97cda7d3eb5a */
/* bench 28523.0.1 d84edc8c966c */
/* bench 28523.0.2 500f93abed17 */
/* bench 28523.0.3 fdfd33a58a41 */
/* bench 28523.0.4 a14be32d3ddf */
/* bench 28523.0.5 2f2445f1f45b */
/* bench 28523.0.6 1c74695d09d5 */
/* bench 28523.0.7 2f77b15d62ad */
				"Int Spk", "SPK_OUTN",
				"Headset Mic","MICBIAS1",
				"MIC1_N", "Headset Mic",
				"MIC1_P", "Headset Mic",
				"Headset Stereophone", "HP_OUT_R",
				"Headset Stereophone", "HP_OUT_L";

	nvidia,i2s-controller = <&tegra_i2s1>;
	nvidia,audio-codec = <&alc5632>;

	clocks = <&tegra_car 112>, <&tegra_car 113>, <&tegra_car 93>;
	clock-names = "pll_a", "pll_a_out0", "mclk";
};
```
