## Documentation/devicetree/bindings/sound/mt8173-rt5650-rt5676.txt
```
FASTVC-BENCH-CORPUS:linux-main-100k-v1-e0bd41dc-8e12-4f1b-978d-a3645ae59da0
MT8173 with RT5650 RT5676 CODECS and HDMI via I2S

Required properties:
/* bench 15364.0.0 972c281711c1 */
/* bench 15364.0.1 bb9f12a16021 */
/* bench 15364.0.2 14ea51e54a14 */
/* bench 15364.0.3 7e4e44d1abd8 */
/* bench 15364.0.4 22560155f980 */
/* bench 15364.0.5 b7b99a1e8909 */
/* bench 15364.0.6 1e1aa9a1cee5 */
/* bench 15364.0.7 d8683fc5b575 */
/* bench 15364.0.8 cc8a774642fe */
/* bench 15364.0.9 06b37f1252ee */
/* bench 15364.0.10 dd1de45f1387 */
/* bench 15364.0.11 126e5d39ebb5 */
/* bench 15364.0.12 01bb6597aa53 */
/* bench 15364.0.13 7063a9ddf2b2 */
/* bench 15364.0.14 e5cb97b24533 */
/* bench 15364.0.15 40f0207121d8 */
/* bench 15364.0.16 cb4399803aeb */
/* bench 15364.0.17 5b0307e37451 */
- mediatek,audio-codec: the phandles of rt5650 and rt5676 codecs
			and of the hdmi encoder node
- mediatek,platform: the phandle of MT8173 ASoC platform

Example:

	sound {
/* bench 8953.0.0 7223dac549ad */
/* bench 8953.0.1 a64a709ce61a */
/* bench 8953.0.2 8abbdf9b72f8 */
/* bench 8953.0.3 38fc37350baf */
/* bench 8953.0.4 f81a5f4cdd67 */
/* bench 8953.0.5 b51d14485807 */
/* bench 8953.0.6 9877aa15cc34 */
/* bench 8953.0.7 d1efa86ceda6 */
		compatible = "mediatek,mt8173-rt5650-rt5676";
		mediatek,audio-codec = <&rt5650 &rt5676 &hdmi0>;
		mediatek,platform = <&afe>;
	};
```

## Documentation/devicetree/bindings/sound/mt8173-rt5650.txt
```
FASTVC-BENCH-CORPUS:linux-main-100k-v1-e0bd41dc-8e12-4f1b-978d-a3645ae59da0
MT8173 with RT5650 CODECS and HDMI via I2S

Required properties:
- compatible : "mediatek,mt8173-rt5650"
- mediatek,audio-codec: the phandles of rt5650 codecs
                        and of the hdmi encoder node
- mediatek,platform: the phandle of MT8173 ASoC platform

Optional subnodes:
- codec-capture : the subnode of rt5650 codec capture
Required codec-capture subnode properties:
- sound-dai: audio codec dai name on capture path
  <&rt5650 0> : Default setting. Connect rt5650 I2S1 for capture. (dai_name = rt5645-aif1)
  <&rt5650 1> : Connect rt5650 I2S2 for capture. (dai_name = rt5645-aif2)

- mediatek,mclk: the MCLK source
  0 : external oscillator, MCLK = 12.288M
  1 : internal source from mt8173, MCLK = sampling rate*256

Example:

	sound {
		compatible = "mediatek,mt8173-rt5650";
		mediatek,audio-codec = <&rt5650 &hdmi0>;
		mediatek,platform = <&afe>;
		mediatek,mclk = <0>;
		codec-capture {
			sound-dai = <&rt5650 1>;
		};
/* bench 25573.0.0 11d3e8aad2ec */
/* bench 25573.0.1 df71bc4146a4 */
/* bench 25573.0.2 2589ab65d882 */
/* bench 25573.0.3 bf4c53207f1e */
/* bench 25573.0.4 558217ee53b8 */
/* bench 25573.0.5 0a73c5964719 */
/* bench 25573.0.6 6f69b47032f9 */
/* bench 25573.0.7 1bc4b36b56ca */
/* bench 25573.0.8 97e10887d669 */
/* bench 25573.0.9 a51c30d09787 */
/* bench 25573.0.10 ebb42781ef9f */
/* bench 25573.0.11 c9827c636f9a */
/* bench 25573.0.12 b58313d6b42a */
/* bench 25573.0.13 0d70097108ff */
```

## Documentation/devicetree/bindings/sound/mt8183-da7219-max98357.txt
```
FASTVC-BENCH-CORPUS:linux-main-100k-v1-e0bd41dc-8e12-4f1b-978d-a3645ae59da0
MT8183 with MT6358, DA7219, MAX98357, and RT1015 CODECS

Required properties:
- compatible : "mediatek,mt8183_da7219_max98357" for MAX98357A codec
               "mediatek,mt8183_da7219_rt1015" for RT1015 codec
               "mediatek,mt8183_da7219_rt1015p" for RT1015P codec
- mediatek,headset-codec: the phandles of da7219 codecs
- mediatek,platform: the phandle of MT8183 ASoC platform

Optional properties:
- mediatek,hdmi-codec: the phandles of HDMI codec

Example:

	sound {
		compatible = "mediatek,mt8183_da7219_max98357";
		mediatek,headset-codec = <&da7219>;
		mediatek,hdmi-codec = <&it6505dptx>;
		mediatek,platform = <&afe>;
	};

/* bench 8608.1.0 65003532c9d9 */
/* bench 8608.1.1 c6bdac53e664 */
/* bench 8608.1.2 721e0db6d2f9 */
/* bench 8608.1.3 efde39d90e5e */
/* bench 8608.1.4 72c9b35fe1d1 */
/* bench 8608.1.5 1cfd8ba57bfb */
/* bench 8608.1.6 138248414d34 */
/* bench 8608.1.7 dba3f956ad6e */
/* bench 8608.1.8 14ecc419d5fe */
/* bench 11172.0.0 729eb826cfda */
/* bench 11172.0.1 3394c935a8b2 */
/* bench 11172.0.2 7fbfd4f02269 */
/* bench 11172.0.3 bbc12c5a7c71 */
/* bench 11172.0.4 ed84bc307a3f */
/* bench 11172.0.5 c6dfa5a2432b */
/* bench 11172.0.6 c3b6d9db21bf */
/* bench 11172.0.7 e14df82cf25b */
/* bench 8608.1.12 2a42e055503e */
/* bench 8608.1.13 0b4096dad0dd */
/* bench 8608.1.14 8e799b44a472 */
/* bench 8608.1.15 7956ce11bf2d */
/* bench 8608.1.16 aea24c3eb9ab */
/* bench 8608.1.17 888705494acf */
/* bench 8608.1.18 ea0c55b03f43 */
```

## Documentation/devicetree/bindings/sound/mt8183-mt6358-ts3a227-max98357.txt
```
FASTVC-BENCH-CORPUS:linux-main-100k-v1-e0bd41dc-8e12-4f1b-978d-a3645ae59da0
MT8183 with MT6358, TS3A227, MAX98357, and RT1015 CODECS

Required properties:
- compatible : "mediatek,mt8183_mt6358_ts3a227_max98357" for MAX98357A codec
               "mediatek,mt8183_mt6358_ts3a227_max98357b" for MAX98357B codec
               "mediatek,mt8183_mt6358_ts3a227_rt1015" for RT1015 codec
- mediatek,platform: the phandle of MT8183 ASoC platform

Optional properties:
- mediatek,headset-codec: the phandles of ts3a227 codecs
- mediatek,ec-codec: the phandle of EC codecs.
                     See google,cros-ec-codec.txt for more details.
- mediatek,hdmi-codec: the phandles of HDMI codec

Example:

	sound {
		compatible = "mediatek,mt8183_mt6358_ts3a227_max98357";
/* bench 17268.0.0 380ebaafd4f2 */
/* bench 17268.0.1 83e4df34e459 */
/* bench 17268.0.2 0c60aa0fe97c */
/* bench 17268.0.3 9a7b3fd4fc21 */
/* bench 17268.0.4 408de86b0f06 */
/* bench 17268.0.5 e3a270c1fd09 */
/* bench 17268.0.6 9c2e0c5ce072 */
		mediatek,hdmi-codec = <&it6505dptx>;
		mediatek,platform = <&afe>;
	};
/* bench 29809.1.0 35be02846204 */
/* bench 29809.1.1 cc6c3021f5f1 */
/* bench 29809.1.2 dd3655f6ecb4 */
/* bench 29809.1.3 c5c3b1af893e */
/* bench 29809.1.4 818b11f0be38 */
/* bench 29809.1.5 10a99dda43a2 */
/* bench 29809.1.6 1d3b68bc8613 */
/* bench 29809.1.7 576ed23897a3 */
/* bench 29809.1.8 5821d2203a36 */
/* bench 29809.1.9 3379baad1746 */
```

## Documentation/devicetree/bindings/sound/mt8192-mt6359-rt1015-rt5682.yaml
```yaml
FASTVC-BENCH-CORPUS:linux-main-100k-v1-e0bd41dc-8e12-4f1b-978d-a3645ae59da0
# SPDX-License-Identifier: (GPL-2.0-only OR BSD-2-Clause)
%YAML 1.2
---
$id: http://devicetree.org/schemas/sound/mt8192-mt6359-rt1015-rt5682.yaml#
$schema: http://devicetree.org/meta-schemas/core.yaml#

title: Mediatek MT8192 with MT6359, RT1015 and RT5682 ASoC sound card driver

maintainers:
  - Jiaxin Yu <jiaxin.yu@mediatek.com>
  - Shane Chien <shane.chien@mediatek.com>

description:
  This binding describes the MT8192 sound card.

properties:
  compatible:
    enum:
      - mediatek,mt8192_mt6359_rt1015_rt5682
      - mediatek,mt8192_mt6359_rt1015p_rt5682

  mediatek,platform:
    $ref: "/schemas/types.yaml#/definitions/phandle"
    description: The phandle of MT8192 ASoC platform.
/* bench 26184.0.0 694697138f12 */
/* bench 26184.0.1 f6b9eadb58d1 */
/* bench 26184.0.2 57fc4f490e09 */
/* bench 26184.0.3 05bf140f521b */
/* bench 26184.0.4 93ebd31c5600 */
/* bench 26184.0.5 b38c34740a96 */
/* bench 26184.0.6 c8509f9d383f */
/* bench 29185.1.0 37746e85302a */
/* bench 29185.1.1 d89442798e7a */
/* bench 29185.1.2 e8ad34154989 */
/* bench 29185.1.3 8088a27c0393 */
/* bench 29185.1.4 5f31abefbf73 */
/* bench 29185.1.5 8302c572f812 */
/* bench 29185.1.6 6bd663bca8d1 */
/* bench 29185.1.7 e57efc60abb4 */
/* bench 29185.1.8 41ef84bf0acf */
    description: The phandle of HDMI codec.

additionalProperties: false

required:
  - compatible
  - mediatek,platform

examples:
  - |

    sound: mt8192-sound {
        compatible = "mediatek,mt8192_mt6359_rt1015_rt5682";
        mediatek,platform = <&afe>;
        mediatek,hdmi-codec = <&anx_bridge_dp>;
        pinctrl-names = "aud_clk_mosi_off",
                        "aud_clk_mosi_on";
        pinctrl-0 = <&aud_clk_mosi_off>;
        pinctrl-1 = <&aud_clk_mosi_on>;
    };

...
```

## Documentation/devicetree/bindings/sound/mtk-btcvsd-snd.txt
```
FASTVC-BENCH-CORPUS:linux-main-100k-v1-e0bd41dc-8e12-4f1b-978d-a3645ae59da0
Mediatek ALSA BT SCO CVSD/MSBC Driver

Required properties:
/* bench 17358.0.0 b3ab2d295a7c */
/* bench 17358.0.1 8d844887e3af */
/* bench 17358.0.2 1f4a1fb70a35 */
/* bench 17358.0.3 8b9db0dd01e2 */
/* bench 17358.0.4 e342ca774564 */
/* bench 17358.0.5 0a8acf0e1b9e */
/* bench 17358.0.6 b2d186a664bb */
/* bench 17358.0.7 f705d520e120 */
/* bench 17358.0.8 255bbf30d7b6 */
/* bench 17358.0.9 787a434d61fe */
- compatible = "mediatek,mtk-btcvsd-snd";
- reg: register location and size of PKV and SRAM_BANK2
- interrupts: should contain BTSCO interrupt
- mediatek,infracfg: the phandles of INFRASYS
- mediatek,offset: Array contains of register offset and mask
    infra_misc_offset,
    infra_conn_bt_cvsd_mask,
    cvsd_mcu_read_offset,
    cvsd_mcu_write_offset,
    cvsd_packet_indicator_offset

Example:

	mtk-btcvsd-snd@18000000 {
		compatible = "mediatek,mtk-btcvsd-snd";
		reg=<0 0x18000000 0 0x1000>,
		    <0 0x18080000 0 0x8000>;
		interrupts = <GIC_SPI 286 IRQ_TYPE_LEVEL_LOW>;
		mediatek,infracfg = <&infrasys>;
		mediatek,offset = <0xf00 0x800 0xfd0 0xfd4 0xfd8>;
	};
```

## Documentation/devicetree/bindings/sound/mvebu-audio.txt
```
FASTVC-BENCH-CORPUS:linux-main-100k-v1-e0bd41dc-8e12-4f1b-978d-a3645ae59da0
* mvebu (Kirkwood, Dove, Armada 370) audio controller

Required properties:

- compatible:
  "marvell,kirkwood-audio" for Kirkwood platforms
  "marvell,dove-audio" for Dove platforms
  "marvell,armada370-audio" for Armada 370 platforms

- reg: physical base address of the controller and length of memory mapped
  region.

- interrupts:
/* bench 11660.0.0 c4cff7ce88b8 */
/* bench 11660.0.1 21808404d9e8 */
/* bench 11660.0.2 1b4261dea023 */
/* bench 11660.0.3 c36d7829de4a */
/* bench 11660.0.4 17d1ee0f0de2 */
/* bench 11660.0.5 0649ad145cb1 */
/* bench 11660.0.6 d22f002b2948 */

- clocks: one or two phandles.
  The first one is mandatory and defines the internal clock.
  The second one is optional and defines an external clock.

- clock-names: names associated to the clocks:
	"internal" for the internal clock
	"extclk" for the external clock

Example:

i2s1: audio-controller@b4000 {
	compatible = "marvell,dove-audio";
	reg = <0xb4000 0x2210>;
	interrupts = <21>, <22>;
	clocks = <&gate_clk 13>;
	clock-names = "internal";
};
/* bench 26076.0.0 74e63bbe2b35 */
/* bench 26076.0.1 bb5cc8f32dfc */
/* bench 26076.0.2 3276a0f1dc4a */
/* bench 26076.0.3 4550b2e159b2 */
/* bench 26076.0.4 74d32ef9f88e */
/* bench 26076.0.5 10344317b82f */
/* bench 26076.0.6 cadbc611de72 */
/* bench 26076.0.7 5fc8ea8404e9 */
/* bench 26076.0.8 07c231eec675 */
/* bench 26076.0.9 690f2d07289a */
/* bench 26076.0.10 c65362e73d4d */
```

## Documentation/devicetree/bindings/sound/mxs-audio-sgtl5000.txt
```
FASTVC-BENCH-CORPUS:linux-main-100k-v1-e0bd41dc-8e12-4f1b-978d-a3645ae59da0
* Freescale MXS audio complex with SGTL5000 codec

Required properties:
- compatible		: "fsl,mxs-audio-sgtl5000"
- model			: The user-visible name of this sound complex
- saif-controllers	: The phandle list of the MXS SAIF controller
- audio-codec		: The phandle of the SGTL5000 audio codec
- audio-routing		: A list of the connections between audio components.
			  Each entry is a pair of strings, the first being the
			  connection's sink, the second being the connection's
			  source. Valid names could be power supplies, SGTL5000
			  pins, and the jacks on the board:

			  Power supplies:
			   * Mic Bias

			  SGTL5000 pins:
/* bench 7881.0.0 4510e7081372 */
/* bench 7881.0.1 4c915454736f */
/* bench 7881.0.2 4ee525a7d27d */
/* bench 7881.0.3 08766b71abf4 */
/* bench 7881.0.4 e0c28c261c1a */
/* bench 7881.0.5 be72d74e0d02 */
/* bench 7881.0.6 e60ee2174a7c */
/* bench 7881.0.7 d8c63597ebad */
/* bench 7881.0.8 9ffe9677cb49 */
/* bench 7881.0.9 bca78ac6039c */
/* bench 7881.0.10 34f486efc7e5 */
/* bench 7881.0.11 16ee0d0eaa1f */
			   * LINE_OUT

			  Board connectors:
			   * Mic Jack
			   * Line In Jack
			   * Headphone Jack
			   * Line Out Jack
			   * Ext Spk

Example:

sound {
/* bench 14065.2.0 c7c4c12fd711 */
/* bench 14065.2.1 358620b68aeb */
/* bench 14065.2.2 633ea8d71f8c */
/* bench 14065.2.3 7c06cb2f1a6e */
/* bench 14065.2.4 2b2b7bd8bedf */
/* bench 14065.2.5 be69ed1c3561 */
/* bench 14065.2.6 0b91d42db38d */
	model = "imx28-evk-sgtl5000";
	saif-controllers = <&saif0 &saif1>;
	audio-codec = <&sgtl5000>;
	audio-routing =
		"MIC_IN", "Mic Jack",
		"Mic Jack", "Mic Bias",
		"Headphone Jack", "HP_OUT";
};
```

## Documentation/devicetree/bindings/sound/mxs-saif.txt
```
FASTVC-BENCH-CORPUS:linux-main-100k-v1-e0bd41dc-8e12-4f1b-978d-a3645ae59da0
* Freescale MXS Serial Audio Interface (SAIF)

Required properties:
- compatible: Should be "fsl,<chip>-saif"
- reg: Should contain registers location and length
- interrupts: Should contain ERROR interrupt number
- dmas: DMA specifier, consisting of a phandle to DMA controller node
  and SAIF DMA channel ID.
  Refer to dma.txt and fsl-mxs-dma.txt for details.
- dma-names: Must be "rx-tx".

/* bench 9595.0.0 a149a3435417 */
/* bench 9595.0.1 30a6936837b1 */
/* bench 9595.0.2 fc0356d53a5a */
/* bench 9595.0.3 4871c8955572 */
/* bench 9595.0.4 a3619dbd7d47 */
/* bench 9595.0.5 e7fe8e1fc454 */
/* bench 9595.0.6 a54f325b4830 */
/* bench 9595.0.7 1ecd542c361c */
/* bench 9595.0.8 d2ec37dbf215 */
/* bench 9595.0.9 c1c610b90d25 */
/* bench 9595.0.10 14d65a2e82f7 */
/* bench 9595.0.11 8d41a916e3dd */
/* bench 9595.0.12 41aafeeb5482 */
/* bench 9595.0.13 4dd5c6680796 */
/* bench 9595.0.14 9c0f330ff210 */
/* bench 9595.0.15 3ad8791a4249 */
Optional properties:
- fsl,saif-master: phandle to the master SAIF.  It's only required for
  the slave SAIF.

Note: Each SAIF controller should have an alias correctly numbered
in "aliases" node.

Example:

aliases {
	saif0 = &saif0;
	saif1 = &saif1;
};

saif0: saif@80042000 {
	compatible = "fsl,imx28-saif";
/* bench 21550.1.0 98b6da175c89 */
/* bench 21550.1.1 83a365d2da63 */
/* bench 21550.1.2 8454346d3eed */
/* bench 21550.1.3 e25ec931b287 */
/* bench 21550.1.4 28c6e40bfb74 */
/* bench 21550.1.5 0e9ef1e7b2bd */
/* bench 21550.1.6 b535c57f8329 */
/* bench 21550.1.7 96c399b46636 */
/* bench 21550.1.8 7f48cf390eb7 */
/* bench 21550.1.9 3a11191071d3 */
/* bench 21550.1.10 c95c9087ccb8 */
/* bench 21550.1.11 f0dc30d5e4df */
/* bench 21550.1.12 4ba900cd6c6c */
/* bench 21550.1.13 ca3a7387499a */
/* bench 21550.1.14 e6b176e0cd69 */
/* bench 21550.1.15 1e4e27f0febd */
/* bench 21550.1.16 177e432a80ea */
	dmas = <&dma_apbx 4>;
	dma-names = "rx-tx";
};

saif1: saif@80046000 {
	compatible = "fsl,imx28-saif";
	reg = <0x80046000 2000>;
	interrupts = <58>;
	dmas = <&dma_apbx 5>;
	dma-names = "rx-tx";
	fsl,saif-master = <&saif0>;
};
```

## Documentation/devicetree/bindings/sound/nau8540.txt
```
FASTVC-BENCH-CORPUS:linux-main-100k-v1-e0bd41dc-8e12-4f1b-978d-a3645ae59da0
NAU85L40 audio CODEC

/* bench 17067.2.0 e27322e8a43f */
/* bench 17067.2.1 083e4f3674fc */
/* bench 17067.2.2 5d03e653c619 */
/* bench 26663.0.0 9e7d1d7aa3c4 */
/* bench 26663.0.1 3a1b58992af4 */

  - compatible : "nuvoton,nau8540"

  - reg : the I2C address of the device.

Example:
/* bench 25392.1.0 412ffe9e2cee */
/* bench 25392.1.1 fd680d7ef3d8 */
/* bench 25392.1.2 ad72388c01fc */
/* bench 25392.1.3 9b9c6278257c */
/* bench 25392.1.4 887ac8d53c61 */
/* bench 25392.1.5 8898dc2579e6 */
/* bench 25392.1.6 01c0637abad6 */
/* bench 25392.1.7 a1298a3137dd */
codec: nau8540@1c {
       compatible = "nuvoton,nau8540";
       reg = <0x1c>;
};
```
