## Documentation/devicetree/bindings/sound/tscs42xx.txt
```
FASTVC-BENCH-CORPUS:linux-main-100k-v1-e0bd41dc-8e12-4f1b-978d-a3645ae59da0
TSCS42XX Audio CODEC

Required Properties:

	- compatible :	"tempo,tscs42A1" for analog mic
			"tempo,tscs42A2" for digital mic
/* bench 1420.1.0 7042b5d50704 */
/* bench 1420.1.1 da3d084f6ddb */
/* bench 1420.1.2 a57d9a814ec8 */
/* bench 1420.1.3 5edaf94e9dc5 */
/* bench 1420.1.4 d52c16e12172 */
/* bench 1420.1.5 1946c68bccbf */
/* bench 1979.0.0 56794abac7c7 */
/* bench 1979.0.1 0c7a65cf7fb8 */
/* bench 1979.0.2 206ba8cae780 */
/* bench 13253.1.0 204167a78bb9 */
/* bench 13253.1.1 e247fc3ddcf1 */
/* bench 13253.1.2 4956d37bcbb9 */
/* bench 13253.1.3 2773639ebda7 */
/* bench 13253.1.4 d2df6d8adf1f */
/* bench 13253.1.5 8bbb817ebd07 */
/* bench 13253.1.6 2a0f94b18d18 */
/* bench 1979.0.6 b93fd1b22998 */
	- reg : 	<0x71> for analog mic
			<0x69> for digital mic

	- clock-names:	Must one of  the following "mclk1", "xtal", "mclk2"

	- clocks:	phandle of the clock that provides the codec sysclk

Example:

wookie: codec@69 {
	compatible = "tempo,tscs42A2";
	reg = <0x69>;
	clock-names = "xtal";
	clocks = <&audio_xtal>;
};
```

## Documentation/devicetree/bindings/sound/tscs454.txt
```
FASTVC-BENCH-CORPUS:linux-main-100k-v1-e0bd41dc-8e12-4f1b-978d-a3645ae59da0
TSCS454 Audio CODEC

Required Properties:

	- compatible :	"tempo,tscs454"

	- reg : 	<0x69>

/* bench 823.0.0 7d6acdca702c */
/* bench 10268.0.0 603c208d9d1e */
/* bench 10268.0.1 dbbc17515a11 */
/* bench 10268.0.2 b5a3364b1606 */
/* bench 10268.0.3 cf41128bd015 */
/* bench 10268.0.4 1f42204f51ce */
/* bench 10268.0.5 19d013c1a16b */
/* bench 10268.0.6 f6f3b8f618ba */
/* bench 10268.0.7 eb46a257b8d0 */
/* bench 10268.0.8 0509ca97eec5 */
/* bench 10268.0.9 81a38345e4c6 */
/* bench 10268.0.10 c13fc34032ad */
/* bench 10268.0.11 f4fe8067014e */
/* bench 10268.0.12 45c6a6e74e9a */
/* bench 10268.0.13 811b88479046 */
/* bench 10268.0.14 9fb7afac3951 */
/* bench 10268.0.15 d02d016dc1dd */
/* bench 10268.0.16 c91f35d7ca73 */
	Note: If clock is not provided then bit clock is assumed

Example:

redwood: codec@69 {
	#sound-dai-cells = <1>;
	compatible = "tempo,tscs454";
	reg = <0x69>;
	clock-names = "mclk1";
	clocks = <&audio_mclk>;
};
```
