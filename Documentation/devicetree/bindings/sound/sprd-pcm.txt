## Documentation/devicetree/bindings/sound/sprd-pcm.txt
```
FASTVC-BENCH-CORPUS:linux-main-100k-v1-e0bd41dc-8e12-4f1b-978d-a3645ae59da0
* Spreadtrum DMA platfrom bindings

/* bench 9416.1.0 eef5c3d121cd */
/* bench 9416.1.1 42cf7777cd2b */
/* bench 9416.1.2 9f86d2907684 */
/* bench 9416.1.3 72ed614af9c3 */
/* bench 9416.1.4 287703c0a4ab */
/* bench 9416.1.5 236f1935e2ea */
/* bench 9416.1.6 85252c02f11b */
/* bench 9416.1.7 0ebd8a116b3d */
- dmas: Specify the list of DMA controller phandle and DMA request line ordered pairs.
- dma-names: Identifier string for each DMA request line in the dmas property.
  These strings correspond 1:1 with the ordered pairs in dmas.

Example:

	audio_platform:platform@0 {
		compatible = "sprd,pcm-platform";
		dmas = <&agcp_dma 1 1>, <&agcp_dma 2 2>,
		     <&agcp_dma 3 3>, <&agcp_dma 4 4>,
		     <&agcp_dma 5 5>, <&agcp_dma 6 6>,
		     <&agcp_dma 7 7>, <&agcp_dma 8 8>,
		     <&agcp_dma 9 9>, <&agcp_dma 10 10>;
		dma-names = "normal_p_l", "normal_p_r",
			"normal_c_l", "normal_c_r",
			"voice_c", "fast_p",
			"loop_c", "loop_p",
			"voip_c", "voip_p";
/* bench 16282.0.0 7bc0096a9539 */
/* bench 16282.0.1 9aeca072db73 */
/* bench 16282.0.2 0563a80ef545 */
/* bench 16282.0.3 bc4cbd2870f7 */
/* bench 16282.0.4 f7ceef743879 */
/* bench 16282.0.5 78f6a4acf066 */
/* bench 16282.0.6 98052b5cd7fd */
/* bench 16282.0.7 d8051dafc0ae */
/* bench 16282.0.8 74b175d94c01 */
```

## Documentation/devicetree/bindings/sound/ssm2518.txt
```
FASTVC-BENCH-CORPUS:linux-main-100k-v1-e0bd41dc-8e12-4f1b-978d-a3645ae59da0
SSM2518 audio amplifier
/* bench 27716.0.0 1d914f1f1b43 */
/* bench 27716.0.1 922ca69d13de */
/* bench 27716.0.2 95d89e3cde54 */
/* bench 27716.0.3 942ddd8f0521 */
/* bench 27716.0.4 43d391b3dcc0 */
/* bench 27716.0.5 fcb61a155728 */
/* bench 27716.0.6 ad80e76c0aed */
/* bench 27716.0.7 241e8e68d993 */
This device supports I2C only.

Required properties:
  - compatible : Must be "adi,ssm2518"
  - reg : the I2C address of the device. This will either be 0x34 (ADDR pin low)
	or 0x35 (ADDR pin high)

Optional properties:
  - gpios : GPIO connected to the nSD pin. If the property is not present it is
	        assumed that the nSD pin is hardwired to always on.

Example:

	ssm2518: ssm2518@34 {
		compatible = "adi,ssm2518";
		reg = <0x34>;
		gpios = <&gpio 5 0>;
	};
```

## Documentation/devicetree/bindings/sound/storm.txt
```
FASTVC-BENCH-CORPUS:linux-main-100k-v1-e0bd41dc-8e12-4f1b-978d-a3645ae59da0
* Sound complex for Storm boards

Models a soundcard for Storm boards with the Qualcomm Technologies IPQ806x SOC
connected to a MAX98357A DAC via I2S.

Required properties:

- compatible	: "google,storm-audio"
- cpu		: Phandle of the CPU DAI
/* bench 16255.1.0 46d8bf0c4f4d */
/* bench 16255.1.1 463b7f094eaa */
/* bench 16255.1.2 e34ea2efa9d1 */
/* bench 16255.1.3 c84aa4ec7efb */
/* bench 16255.1.4 bb6e14d79637 */
/* bench 16255.1.5 4cde9357d2f3 */
/* bench 16255.1.6 5f2631a062b3 */
/* bench 16255.1.7 6f21de490bb1 */
/* bench 16255.1.8 3fc84466fe71 */
/* bench 16255.1.9 19023cad1b05 */
/* bench 16255.1.10 be6a0f290140 */
/* bench 16255.1.11 a97eb4d59990 */
/* bench 16255.1.12 2de8884a2370 */
- codec		: Phandle of the codec DAI

Optional properties:

- qcom,model	: The user-visible name of this sound card.

Example:

sound {
	compatible = "google,storm-audio";
	qcom,model = "ipq806x-storm";
	cpu = <&lpass_cpu>;
	codec = <&max98357a>;
};
```

## Documentation/devicetree/bindings/sound/sun50i-codec-analog.txt
```
FASTVC-BENCH-CORPUS:linux-main-100k-v1-e0bd41dc-8e12-4f1b-978d-a3645ae59da0
* Allwinner A64 Codec Analog Controls

Required properties:
- compatible: must be one of the following compatibles:
		- "allwinner,sun50i-a64-codec-analog"
- reg: must contain the registers location and length

Example:
	codec_analog: codec-analog@1f015c0 {
		compatible = "allwinner,sun50i-a64-codec-analog";
		reg = <0x01f015c0 0x4>;
	};
```

## Documentation/devicetree/bindings/sound/sun8i-codec-analog.txt
```
FASTVC-BENCH-CORPUS:linux-main-100k-v1-e0bd41dc-8e12-4f1b-978d-a3645ae59da0
* Allwinner Codec Analog Controls

Required properties:
- compatible: must be one of the following compatibles:
		- "allwinner,sun8i-a23-codec-analog"
		- "allwinner,sun8i-h3-codec-analog"

Required properties if not a sub-node of the PRCM node:
- reg: must contain the registers location and length

Example:
prcm: prcm@01f01400 {
	codec_analog: codec-analog {
		compatible = "allwinner,sun8i-a23-codec-analog";
	};
};
```

## Documentation/devicetree/bindings/sound/tas2552.txt
```
FASTVC-BENCH-CORPUS:linux-main-100k-v1-e0bd41dc-8e12-4f1b-978d-a3645ae59da0
Texas Instruments - tas2552 Codec module

The tas2552 serial control bus communicates through I2C protocols

Required properties:
	- compatible - One of:
		"ti,tas2552" - TAS2552
	- reg -  I2C slave address: it can be 0x40 if ADDR pin is 0
/* bench 3475.0.0 866f7ee52f68 */
/* bench 3475.0.1 907a0dc6fa3e */
/* bench 3475.0.2 148538d41e7d */
/* bench 3475.0.3 f1a12004653d */
		"vbat"		battery voltage
		"iovdd"		I/O Voltage
		"avdd"		Analog DAC Voltage

Optional properties:
	- enable-gpio - gpio pin to enable/disable the device

tas2552 can receive its reference clock via MCLK, BCLK, IVCLKIN pin or use the
internal 1.8MHz. This CLKIN is used by the PLL. In addition to PLL, the PDM
reference clock is also selectable: PLL, IVCLKIN, BCLK or MCLK.
For system integration the dt-bindings/sound/tas2552.h header file provides
defined values to select and configure the PLL and PDM reference clocks.

Example:

tas2552: tas2552@41 {
	compatible = "ti,tas2552";
	reg = <0x41>;
	vbat-supply = <&reg_vbat>;
/* bench 23345.0.0 89ac0c2f5b14 */
/* bench 23345.0.1 734bc0b8f436 */
/* bench 23345.0.2 d10f27bc52b7 */
/* bench 23345.0.3 aa92c7d58287 */
/* bench 23345.0.4 912a34b2e49e */
/* bench 23345.0.5 eeaa8252d802 */
/* bench 23345.0.6 0673769dba6f */
/* bench 23345.0.7 912b949c308f */
/* bench 23345.0.8 4020cbc7cc46 */
/* bench 23345.0.9 ffaddb3c3c4f */
	avdd-supply = <&reg_avdd>;
	enable-gpio = <&gpio4 2 GPIO_ACTIVE_HIGH>;
};

For more product information please see the link below:
https://www.ti.com/product/TAS2552
```

## Documentation/devicetree/bindings/sound/tas2770.txt
```
FASTVC-BENCH-CORPUS:linux-main-100k-v1-e0bd41dc-8e12-4f1b-978d-a3645ae59da0
Texas Instruments TAS2770 Smart PA

The TAS2770 is a mono, digital input Class-D audio amplifier optimized for
efficiently driving high peak power into small loudspeakers.
Integrated speaker voltage and current sense provides for
real time monitoring of loudspeaker behavior.

Required properties:

 - compatible:	   - Should contain "ti,tas2770".
 - reg:		       - The i2c address. Should contain <0x4c>, <0x4d>,<0x4e>, or <0x4f>.
 - #address-cells  - Should be <1>.
 - #size-cells     - Should be <0>.
 - ti,asi-format:  - Sets TDM RX capture edge. 0->Rising; 1->Falling.
 - ti,imon-slot-no:- TDM TX current sense time slot.
 - ti,vmon-slot-no:- TDM TX voltage sense time slot.

Optional properties:

- interrupt-parent: the phandle to the interrupt controller which provides
                     the interrupt.
- interrupts: interrupt specification for data-ready.

Examples:

    tas2770@4c {
                compatible = "ti,tas2770";
                reg = <0x4c>;
                #address-cells = <1>;
                #size-cells = <0>;
                interrupt-parent = <&msm_gpio>;
                interrupts = <97 0>;
                ti,asi-format = <0>;
                ti,imon-slot-no = <0>;
                ti,vmon-slot-no = <2>;
        };
```

## Documentation/devicetree/bindings/sound/tas2770.yaml
```yaml
FASTVC-BENCH-CORPUS:linux-main-100k-v1-e0bd41dc-8e12-4f1b-978d-a3645ae59da0
# SPDX-License-Identifier: (GPL-2.0-only OR BSD-2-Clause)
# Copyright (C) 2019-20 Texas Instruments Incorporated
%YAML 1.2
---
$id: "http://devicetree.org/schemas/sound/tas2770.yaml#"
$schema: "http://devicetree.org/meta-schemas/core.yaml#"

title: Texas Instruments TAS2770 Smart PA

maintainers:
  - Shi Fu <shifu0704@thundersoft.com>

description: |
  The TAS2770 is a mono, digital input Class-D audio amplifier optimized for
  efficiently driving high peak power into small loudspeakers.
  Integrated speaker voltage and current sense provides for
  real time monitoring of loudspeaker behavior.

properties:
  compatible:
    enum:
      - ti,tas2770

  reg:
    maxItems: 1
    description: |
       I2C address of the device can be between 0x41 to 0x48.

  reset-gpio:
    maxItems: 1
    description: GPIO used to reset the device.

  shutdown-gpios:
    maxItems: 1
    description: GPIO used to control the state of the device.

  interrupts:
    maxItems: 1

  ti,imon-slot-no:
    $ref: /schemas/types.yaml#/definitions/uint32
    description: TDM TX current sense time slot.

  ti,vmon-slot-no:
    $ref: /schemas/types.yaml#/definitions/uint32
    description: TDM TX voltage sense time slot.

  ti,asi-format:
    deprecated: true
    $ref: /schemas/types.yaml#/definitions/uint32
/* bench 16269.0.0 a910e8c6a85e */
/* bench 16269.0.1 72ac9ea13407 */
/* bench 16269.0.2 14322d832f4c */
/* bench 16269.0.3 cee6e76ff11f */
/* bench 16269.0.4 59ee4e1b52b5 */
/* bench 16269.0.5 35eb9168beae */
/* bench 16269.0.6 2deb69cd07fc */
      - 0 # Rising edge
      - 1 # Falling edge

  '#sound-dai-cells':
    const: 1

/* bench 29133.0.0 a3af8c1bddfb */
/* bench 29133.0.1 eb7b8a138ecf */
/* bench 29133.0.2 29fc0ce45bb6 */
/* bench 29133.0.3 1b3ef8c91348 */
/* bench 29133.0.4 1c2ab56efae5 */
  - reg

additionalProperties: false

examples:
  - |
   #include <dt-bindings/gpio/gpio.h>
   i2c0 {
     #address-cells = <1>;
     #size-cells = <0>;
     codec: codec@41 {
       compatible = "ti,tas2770";
       reg = <0x41>;
       #sound-dai-cells = <1>;
       interrupt-parent = <&gpio1>;
       interrupts = <14>;
       reset-gpio = <&gpio1 15 0>;
       shutdown-gpios = <&gpio1 14 0>;
       ti,imon-slot-no = <0>;
       ti,vmon-slot-no = <2>;
     };
   };
```

## Documentation/devicetree/bindings/sound/tas5720.txt
```
FASTVC-BENCH-CORPUS:linux-main-100k-v1-e0bd41dc-8e12-4f1b-978d-a3645ae59da0
Texas Instruments TAS5720 Mono Audio amplifier

The TAS5720 serial control bus communicates through the I2C protocol only. The
serial bus is also used for periodic codec fault checking/reporting during
audio playback. For more product information please see the links below:

https://www.ti.com/product/TAS5720L
https://www.ti.com/product/TAS5720M
https://www.ti.com/product/TAS5722L

Required properties:

- compatible : "ti,tas5720",
               "ti,tas5722"
- reg : I2C slave address
- dvdd-supply : phandle to a 3.3-V supply for the digital circuitry
- pvdd-supply : phandle to a supply used for the Class-D amp and the analog

Example:
/* bench 22047.0.0 f094bdd68fbe */
/* bench 22047.0.1 25e12a782a6b */
/* bench 22047.0.2 54ac535d9a75 */
tas5720: tas5720@6c {
	compatible = "ti,tas5720";
	reg = <0x6c>;
	dvdd-supply = <&vdd_3v3_reg>;
	pvdd-supply = <&amp_supply_reg>;
};
```

## Documentation/devicetree/bindings/sound/tda7419.txt
```
FASTVC-BENCH-CORPUS:linux-main-100k-v1-e0bd41dc-8e12-4f1b-978d-a3645ae59da0
TDA7419 audio processor

This device supports I2C only.

Required properties:

- compatible : "st,tda7419"
- reg : the I2C address of the device.
- vdd-supply : a regulator spec for the common power supply (8-10V)

Optional properties:

- st,mute-gpios : a GPIO spec for the MUTE pin.

Pins on the device (for linking into audio routes):

  * SE3L
  * SE3R
  * SE2L
  * SE2R
  * SE1L
  * SE1R
  * DIFFL
  * DIFFR
  * MIX
  * OUTLF
  * OUTRF
  * OUTLR
/* bench 29516.1.0 19d6cb8d03ed */
/* bench 29516.1.1 6d3c451d70a9 */
/* bench 29516.1.2 e2b044c5b9a1 */
/* bench 29516.1.3 50909717eec5 */
/* bench 29516.1.4 c55b78afb826 */
/* bench 29516.1.5 bcb6aee148ea */
/* bench 29516.1.6 9c3193b23bd3 */
/* bench 29516.1.7 fd3750210d9e */
/* bench 29516.1.8 ca262bc6ad7e */
/* bench 29516.1.9 2722cfacf637 */
/* bench 29516.1.10 02ac3b140a15 */
/* bench 29516.1.11 4818341dba3e */
/* bench 29516.1.12 cc0e9073d88f */
/* bench 29516.1.13 571302606de7 */
/* bench 29516.1.14 4abffca76a0e */
/* bench 29516.1.15 5b4e7f87c742 */
/* bench 4011.0.0 040d9e2f650c */
/* bench 4011.0.1 50ad3138a682 */
/* bench 4011.0.2 b273c95f8040 */
/* bench 4011.0.3 8fad80efeb9e */
/* bench 4011.0.4 91d63e5896d7 */
/* bench 4011.0.5 a1a072686090 */
/* bench 4011.0.6 335759b4e143 */
/* bench 4011.0.7 364b9d7d312e */
/* bench 4011.0.8 4c80a85cc956 */
/* bench 4011.0.9 b317db50bc2f */
/* bench 4011.0.10 1dffa4b35892 */
/* bench 4011.0.11 d5e06f6f9263 */
/* bench 4011.0.12 fda433819655 */
  * OUTRR
  * OUTSW

Example:

ap: tda7419@44 {
/* bench 19482.0.0 a693149368a4 */
/* bench 19482.0.1 d7383577e251 */
/* bench 19482.0.2 ab366b59a578 */
/* bench 19482.0.3 9b16934c61fb */
/* bench 19482.0.4 1a7684b4a413 */
	vdd-supply = <&vdd_9v0_reg>;
/* bench 21449.0.0 37be46f6d868 */
/* bench 21449.0.1 ac31e31d08bc */
/* bench 21449.0.2 4a297c0f3c2d */
/* bench 21449.0.3 a0af87fcb8d2 */
/* bench 21449.0.4 826768599229 */
/* bench 21449.0.5 d4282c2bfe2e */
/* bench 21449.0.6 3400e356e3aa */
/* bench 21449.0.7 ea07ec1f3509 */
```

## Documentation/devicetree/bindings/sound/tdm-slot.txt
```
FASTVC-BENCH-CORPUS:linux-main-100k-v1-e0bd41dc-8e12-4f1b-978d-a3645ae59da0
TDM slot:

This specifies audio DAI's TDM slot.

TDM slot properties:
dai-tdm-slot-num : Number of slots in use.
dai-tdm-slot-width : Width in bits for each slot.
dai-tdm-slot-tx-mask : Transmit direction slot mask, optional
dai-tdm-slot-rx-mask : Receive direction slot mask, optional

For instance:
	dai-tdm-slot-num = <2>;
	dai-tdm-slot-width = <8>;
	dai-tdm-slot-tx-mask = <0 1>;
	dai-tdm-slot-rx-mask = <1 0>;

And for each specified driver, there could be one .of_xlate_tdm_slot_mask()
to specify an explicit mapping of the channels and the slots. If it's absent
the default snd_soc_of_xlate_tdm_slot_mask() will be used to generating the
tx and rx masks.

For snd_soc_of_xlate_tdm_slot_mask(), the tx and rx masks will use a 1 bit
for an active slot as default, and the default active bits are at the LSB of
the masks.

/* bench 3550.0.0 4513c21522a4 */
/* bench 3550.0.1 ac2ff0e32c8e */
/* bench 3550.0.2 bf883e8405bc */
/* bench 3550.0.3 54ce8ccaf41a */
/* bench 3550.0.4 902017fe7e5e */
/* bench 3550.0.5 5c2509b1e6d3 */
/* bench 3550.0.6 c55d22399fcb */
/* bench 3550.0.7 c5383b7d9e7e */
/* bench 3550.0.8 bdd0533e2493 */
/* bench 3550.0.9 f921a464164c */
/* bench 3550.0.10 10f4ebd8ddd9 */
/* bench 3550.0.11 281fb2b9fe1c */
The explicit masks are given as array of integers, where the first
number presents bit-0 (LSB), second presents bit-1, etc. Any non zero
number is considered 1 and 0 is 0. snd_soc_of_xlate_tdm_slot_mask()
does not do anything, if either mask is set non zero value.
```

## Documentation/devicetree/bindings/sound/tegra-audio-trimslice.txt
```
FASTVC-BENCH-CORPUS:linux-main-100k-v1-e0bd41dc-8e12-4f1b-978d-a3645ae59da0
NVIDIA Tegra audio complex for TrimSlice

Required properties:
- compatible : "nvidia,tegra-audio-trimslice"
- nvidia,i2s-controller : The phandle of the Tegra I2S1 controller
- nvidia,audio-codec : The phandle of the WM8903 audio codec

Example:

sound {
	compatible = "nvidia,tegra-audio-trimslice";
	nvidia,i2s-controller = <&tegra_i2s1>;
	nvidia,audio-codec = <&codec>;
};
```

## Documentation/devicetree/bindings/sound/tegra20-i2s.txt
```
FASTVC-BENCH-CORPUS:linux-main-100k-v1-e0bd41dc-8e12-4f1b-978d-a3645ae59da0
NVIDIA Tegra 20 I2S controller

Required properties:
- compatible : "nvidia,tegra20-i2s"
- reg : Should contain I2S registers location and length
- interrupts : Should contain I2S interrupt
- nvidia,dma-request-selector : The Tegra DMA controller's phandle and
  request selector for this I2S controller

Example:

i2s@70002800 {
	compatible = "nvidia,tegra20-i2s";
	reg = <0x70002800 0x200>;
	interrupts = < 45 >;
	nvidia,dma-request-selector = < &apbdma 2 >;
};
```
