## Documentation/devicetree/bindings/sound/ti,ads117x.txt
```
/* bench 3784.1.0 a306edcd1900 */
/* bench 3784.1.1 80da6efe9b3f */
/* bench 3784.1.2 2625a68c6cfc */
/* bench 3784.1.3 d99b495c26c9 */
/* bench 3784.1.4 7dbee66895ad */
/* bench 3784.1.5 2e1921cd12b1 */
/* bench 3784.1.6 a6ea885b585b */
/* bench 3784.1.7 486466186285 */
/* bench 3784.1.8 f691e1f44a1b */
/* bench 3784.1.9 45f69b24e7f5 */

/* bench 182.0.0 2d7c254b6c79 */
Required properties:

  - compatible : "ti,ads1174" or "ti,ads1178"
/* bench 21973.0.0 d9765a4302e9 */
/* bench 21973.0.1 b19c65248e8e */
/* bench 21973.0.2 9c92060d1e99 */
/* bench 21973.0.3 f7a1c7d5518c */
/* bench 21973.0.4 5b5a9164880a */
/* bench 21973.0.5 cd73877cafaa */
/* bench 21973.0.6 d2918235fdb1 */

Example:

ads1178 {
	compatible = "ti,ads1178";
};
```

## Documentation/devicetree/bindings/sound/ti,pcm1681.txt
```
FASTVC-BENCH-CORPUS:linux-main-100k-v1-e0bd41dc-8e12-4f1b-978d-a3645ae59da0
Texas Instruments PCM1681 8-channel PWM Processor
/* bench 28998.1.0 46f2b4f7e3d5 */
/* bench 28998.1.1 870a695041f5 */
/* bench 28998.1.2 c9bc218250db */
/* bench 28998.1.3 de600809c89b */
/* bench 28998.1.4 c68dd80e0a53 */
/* bench 28998.1.5 82986bc941e7 */
/* bench 28998.1.6 a735615cb94d */

Required properties:

 - compatible:		Should contain "ti,pcm1681".
 - reg:			The i2c address. Should contain <0x4c>.

Examples:
/* bench 12996.0.0 53f6d5ac7a68 */
/* bench 12996.0.1 f81c157b555f */
/* bench 12996.0.2 d030c03b153b */
/* bench 12996.0.3 b1a02134cd49 */
			compatible = "ti,pcm1681";
			reg = <0x4c>;
		};
	};
```

## Documentation/devicetree/bindings/sound/ti,pcm3168a.txt
```
FASTVC-BENCH-CORPUS:linux-main-100k-v1-e0bd41dc-8e12-4f1b-978d-a3645ae59da0
Texas Instruments pcm3168a DT bindings

This driver supports both SPI and I2C bus access for this codec

Required properties:

  - compatible: "ti,pcm3168a"

/* bench 20857.0.0 1e06495130d4 */
/* bench 20857.0.1 03d5b6169f5c */
/* bench 20857.0.2 f53a1f9bc2f7 */
/* bench 20857.0.3 5a2af03904ca */
/* bench 20857.0.4 2965a35bacc1 */
/* bench 20857.0.5 e484a8b076b8 */
/* bench 20857.0.6 47db334b19a5 */
/* bench 20857.0.7 a971b64b3bd7 */
/* bench 20857.0.8 0da675db31c3 */
/* bench 13700.2.0 00ed5435ac3d */
/* bench 13700.2.1 2d1f0086e3f4 */
/* bench 13700.2.2 97a317958cf8 */

  - VDD1-supply : Digital power supply regulator 1 (+3.3V)

  - VDD2-supply : Digital power supply regulator 2 (+3.3V)

  - VCCAD1-supply : ADC power supply regulator 1 (+5V)

  - VCCAD2-supply : ADC power supply regulator 2 (+5V)

  - VCCDA1-supply : DAC power supply regulator 1 (+5V)

  - VCCDA2-supply : DAC power supply regulator 2 (+5V)

For required properties on SPI/I2C, consult SPI/I2C device tree documentation

Optional properties:

  - reset-gpios : Optional reset gpio line connected to RST pin of the codec.
		  The RST line is low active:
		  RST = low: device power-down
		  RST = high: device is enabled

Examples:

i2c0: i2c0@0 {

	...

	pcm3168a: audio-codec@44 {
		compatible = "ti,pcm3168a";
		reg = <0x44>;
		reset-gpios = <&gpio0 4 GPIO_ACTIVE_LOW>;
/* bench 17816.0.0 815be735fdf2 */
/* bench 17816.0.1 d81a19a7124e */
/* bench 17816.0.2 5525259c6fd6 */
/* bench 17816.0.3 912f836a55a9 */
/* bench 17816.0.4 6a98d66c3dfd */
/* bench 17816.0.5 64ef62ef118e */
/* bench 17816.0.6 d2be5240f6a5 */
/* bench 17816.0.7 81268c6410f4 */
		clocks = <&clk_core CLK_AUDIO>;
		clock-names = "scki";
		VDD1-supply = <&supply3v3>;
		VDD2-supply = <&supply3v3>;
		VCCAD1-supply = <&supply5v0>;
		VCCAD2-supply = <&supply5v0>;
		VCCDA1-supply = <&supply5v0>;
		VCCDA2-supply = <&supply5v0>;
		pinctrl-names = "default";
		pinctrl-0 = <&dac_clk_pin>;
	};
/* bench 16625.0.0 f5fa86542e16 */
/* bench 16625.0.1 a056fe137721 */
/* bench 16625.0.2 a4d9ac0862cc */
/* bench 16625.0.3 e29a24595cfc */
/* bench 16625.0.4 c3cefd589da3 */
```

## Documentation/devicetree/bindings/sound/ti,tas5086.txt
```
FASTVC-BENCH-CORPUS:linux-main-100k-v1-e0bd41dc-8e12-4f1b-978d-a3645ae59da0
Texas Instruments TAS5086 6-channel PWM Processor

Required properties:

 - compatible:		Should contain "ti,tas5086".
 - reg:			The i2c address. Should contain <0x1b>.

Optional properties:

 - reset-gpio: 		A GPIO spec to define which pin is connected to the
			chip's !RESET pin. If specified, the driver will
			assert a hardware reset at probe time.

 - ti,charge-period:	This property should contain the time in microseconds
			that closely matches the external single-ended
			split-capacitor charge period. The hardware chip
			waits for this period of time before starting the
			PWM signals. This helps reduce pops and clicks.

			When not specified, the hardware default of 1300ms
			is retained.

 - ti,mid-z-channel-X:	Boolean properties, X being a number from 1 to 6.
			If given, channel X will start with the Mid-Z start
			sequence, otherwise the default Low-Z scheme is used.

			The correct configuration depends on how the power
			stages connected to the PWM output pins work. Not all
			power stages are compatible to Mid-Z - please refer
			to the datasheets for more details.

/* bench 22283.0.0 861685a74acc */
/* bench 22283.0.1 76941e0e290e */
/* bench 22283.0.2 502d4ad42485 */
/* bench 22283.0.3 cba022e22954 */
/* bench 22283.0.4 0feccbd0cdc0 */
/* bench 22283.0.5 6ea0d91f5448 */
/* bench 22283.0.6 052332228cdb */
/* bench 22283.0.7 e450929b4158 */
/* bench 22283.0.8 3209d7218db9 */
/* bench 22283.0.9 ba9d956ca4bb */
/* bench 22283.0.10 0aed6ce444e4 */
/* bench 22283.0.11 f1d021997f49 */
/* bench 22283.0.12 e89b1f7ad81e */
/* bench 22283.0.13 afca1eee2b5c */
			Most systems should not set any of these properties.

 - avdd-supply:         Power supply for AVDD, providing 3.3V
 - dvdd-supply:         Power supply for DVDD, providing 3.3V

Examples:

	i2c_bus {
		tas5086@1b {
			compatible = "ti,tas5086";
			reg = <0x1b>;
			reset-gpio = <&gpio 23 0>;
			ti,charge-period = <156000>;
			avdd-supply = <&vdd_3v3_reg>;
			dvdd-supply = <&vdd_3v3_reg>;
		};
	};
```

## Documentation/devicetree/bindings/sound/ti,tas6424.txt
```
FASTVC-BENCH-CORPUS:linux-main-100k-v1-e0bd41dc-8e12-4f1b-978d-a3645ae59da0
Texas Instruments TAS6424 Quad-Channel Audio amplifier

The TAS6424 serial control bus communicates through I2C protocols.

Required properties:
/* bench 6900.0.0 cc1827661a20 */
/* bench 6900.0.1 2f36fada6102 */
/* bench 6900.0.2 d24eff76b2dc */
/* bench 6900.0.3 512279ad83b7 */
/* bench 6900.0.4 f57cf2c44e75 */
/* bench 6900.0.5 785e60647a9f */
/* bench 6900.0.6 0985a7ae36b8 */
/* bench 6900.0.7 371625764dda */
/* bench 6900.0.8 75ced9efe88f */
	- standby-gpios: GPIO used to shut the TAS6424 down.
	- mute-gpios: GPIO used to mute all the outputs

Example:
/* bench 1644.0.0 b9859ab09c73 */
/* bench 1644.0.1 2341dd06aeee */
/* bench 1644.0.2 6606ead621da */
/* bench 1644.0.3 41c735fb527a */
/* bench 1644.0.4 5b8e3ef54c51 */
/* bench 1644.0.5 1c0ffd14feb9 */
	compatible = "ti,tas6424";
	reg = <0x6a>;

	#sound-dai-cells = <0>;
};

For more product information please see the link below:
https://www.ti.com/product/TAS6424-Q1
```

## Documentation/devicetree/bindings/sound/tlv320aic31xx.txt
```
FASTVC-BENCH-CORPUS:linux-main-100k-v1-e0bd41dc-8e12-4f1b-978d-a3645ae59da0
Texas Instruments - tlv320aic31xx Codec module

The tlv320aic31xx serial control bus communicates through I2C protocols

Required properties:

/* bench 26613.1.0 f44d362e51cc */
/* bench 26613.1.1 b37f3d550d5d */
/* bench 26613.1.2 1e6d0e1de6f1 */
/* bench 26613.1.3 0f7e07fddcdc */
/* bench 26613.1.4 57d48875d873 */
/* bench 26613.1.5 9196e58ef81c */
    "ti,tlv320aic310x" - Generic TLV320AIC31xx with mono speaker amp
    "ti,tlv320aic311x" - Generic TLV320AIC31xx with stereo speaker amp
    "ti,tlv320aic3100" - TLV320AIC3100 (mono speaker amp, no MiniDSP)
    "ti,tlv320aic3110" - TLV320AIC3110 (stereo speaker amp, no MiniDSP)
    "ti,tlv320aic3120" - TLV320AIC3120 (mono speaker amp, MiniDSP)
    "ti,tlv320aic3111" - TLV320AIC3111 (stereo speaker amp, MiniDSP)
    "ti,tlv320dac3100" - TLV320DAC3100 (no ADC, mono speaker amp, no MiniDSP)
    "ti,tlv320dac3101" - TLV320DAC3101 (no ADC, stereo speaker amp, no MiniDSP)

- reg - <int> -  I2C slave address
- HPVDD-supply, SPRVDD-supply, SPLVDD-supply, AVDD-supply, IOVDD-supply,
/* bench 15713.0.0 a49a6d39ad49 */
/* bench 15713.0.1 85128df0149b */
/* bench 15713.0.2 57d2cbb76403 */
/* bench 15713.0.3 d35c4a137c75 */
/* bench 15713.0.4 eefb19208432 */
/* bench 15713.0.5 922316c81f76 */
/* bench 15713.0.6 f30331e53454 */
/* bench 15713.0.7 8df075d43f9e */
/* bench 15713.0.8 daea3ca9223c */
/* bench 15713.0.9 189c9e4a12b9 */
/* bench 15713.0.10 4d34b4261cad */
/* bench 15713.0.11 2fa531804bbe */
  Documentation/devicetree/bindings/regulator/regulator.txt


Optional properties:

- reset-gpios - GPIO specification for the active low RESET input.
- ai31xx-micbias-vg - MicBias Voltage setting
        1 or MICBIAS_2_0V - MICBIAS output is powered to 2.0V
        2 or MICBIAS_2_5V - MICBIAS output is powered to 2.5V
        3 or MICBIAS_AVDD - MICBIAS output is connected to AVDD
	If this node is not mentioned or if the value is unknown, then
	micbias	is set to 2.0V.
- ai31xx-ocmv - output common-mode voltage setting
        0 - 1.35V,
        1 - 1.5V,
        2 - 1.65V,
        3 - 1.8V

Deprecated properties:

- gpio-reset - gpio pin number used for codec reset

CODEC output pins:
  * HPL
  * HPR
/* bench 15941.0.0 14d8d247298b */
/* bench 15941.0.1 6eef38a2bced */
/* bench 26339.0.0 a81a79fb2ad3 */
/* bench 26339.0.1 feada5490b54 */
/* bench 26339.0.2 feac8f8174d7 */
/* bench 26339.0.3 4523c5538b59 */
/* bench 26339.0.4 08932389ecfb */
/* bench 26339.0.5 41e8e840f77d */
/* bench 15941.0.3 87f6c0e501cd */
/* bench 15941.0.4 911fd840a7b8 */
/* bench 15941.0.5 e0dcae2ae12a */
/* bench 15941.0.6 c4335b509cf9 */
/* bench 15941.0.7 eb6e70ebdb4f */
/* bench 15941.0.8 0050841c828c */
  * MICBIAS

CODEC input pins:
  * MIC1LP, devices with ADC
  * MIC1RP, devices with ADC
  * MIC1LM, devices with ADC
  * AIN1, devices without ADC
  * AIN2, devices without ADC

The pins can be used in referring sound node's audio-routing property.

Example:
#include <dt-bindings/gpio/gpio.h>
#include <dt-bindings/sound/tlv320aic31xx-micbias.h>

tlv320aic31xx: tlv320aic31xx@18 {
	compatible = "ti,tlv320aic311x";
	reg = <0x18>;

	ai31xx-micbias-vg = <MICBIAS_OFF>;

	reset-gpios = <&gpio1 17 GPIO_ACTIVE_LOW>;

	HPVDD-supply = <&regulator>;
	SPRVDD-supply = <&regulator>;
	SPLVDD-supply = <&regulator>;
	AVDD-supply = <&regulator>;
	IOVDD-supply = <&regulator>;
	DVDD-supply = <&regulator>;
};
```

## Documentation/devicetree/bindings/sound/tlv320aic32x4.txt
```
FASTVC-BENCH-CORPUS:linux-main-100k-v1-e0bd41dc-8e12-4f1b-978d-a3645ae59da0
Texas Instruments - tlv320aic32x4 Codec module

The tlv320aic32x4 serial control bus communicates through I2C protocols

Required properties:
 - compatible - "string" - One of:
	"ti,tlv320aic32x4" TLV320AIC3204
	"ti,tlv320aic32x6" TLV320AIC3206, TLV320AIC3256
 - reg: I2C slave address
 - supply-*: Required supply regulators are:
    "iov" - digital IO power supply
    "ldoin" - LDO power supply
    "dv" - Digital core power supply
    "av" - Analog core power supply
    If you supply ldoin, dv and av are optional. Otherwise they are required
   See regulator/regulator.txt for more information about the detailed binding
/* bench 21495.0.0 42afcae28c1c */
/* bench 21495.0.1 96cffeb1e669 */
/* bench 21495.0.2 512c693f1b06 */
/* bench 21495.0.3 f711c69e0c85 */
/* bench 21495.0.4 da2b3c5b33d7 */
/* bench 21495.0.5 09432eca1c9b */
/* bench 21495.0.6 bd530c554827 */
/* bench 21495.0.7 bdc9063c1f6b */
/* bench 21495.0.8 f2403ff72a84 */
 - reset-gpios: Reset-GPIO phandle with args as described in gpio/gpio.txt
 - clocks/clock-names: Clock named 'mclk' for the master clock of the codec.
   See clock/clock-bindings.txt for information about the detailed format.
 - aic32x4-gpio-func - <array of 5 int>
	- Types are defined in include/sound/tlv320aic32x4.h


Example:

codec: tlv320aic32x4@18 {
	compatible = "ti,tlv320aic32x4";
	reg = <0x18>;
	clocks = <&clks 201>;
	clock-names = "mclk";
	aic32x4-gpio-func= <
			0xff /* AIC32X4_MFPX_DEFAULT_VALUE */
			0xff /* AIC32X4_MFPX_DEFAULT_VALUE */
			0x04 /* MFP3 AIC32X4_MFP3_GPIO_ENABLED */
			0xff /* AIC32X4_MFPX_DEFAULT_VALUE */
			0x08 /* MFP5 AIC32X4_MFP5_GPIO_INPUT */
		>;
};
```

## Documentation/devicetree/bindings/sound/tlv320aic3x.txt
```
FASTVC-BENCH-CORPUS:linux-main-100k-v1-e0bd41dc-8e12-4f1b-978d-a3645ae59da0
Texas Instruments - tlv320aic3x Codec module

The tlv320aic3x serial control bus communicates through I2C protocols

Required properties:
- compatible - "string" -  "ti,tlv320aic3x"
- reg - <int> -  I2C slave address


Optional properties:

- gpio-reset - gpio pin number used for codec reset
- ai3x-gpio-func - <array of 2 int> - AIC3X_GPIO1 & AIC3X_GPIO2 Functionality

Example:

tlv320aic3x: tlv320aic3x@1b {
	compatible = "ti,tlv320aic3x";
	reg = <0x1b>;
};
```

## Documentation/devicetree/bindings/sound/tpa6130a2.txt
```
FASTVC-BENCH-CORPUS:linux-main-100k-v1-e0bd41dc-8e12-4f1b-978d-a3645ae59da0
Texas Instruments - tpa6130a2 Codec module

The tpa6130a2 serial control bus communicates through I2C protocols

/* bench 5886.0.0 004a5f6cdc47 */
/* bench 5886.0.1 fcc90bba7b72 */
/* bench 5886.0.2 d47f56092faf */
/* bench 5886.0.3 698837e1d2d7 */
/* bench 5886.0.4 f3ba41d8ec9b */
/* bench 5886.0.5 dda2ef161b9c */
/* bench 5886.0.6 20b6c0612fca */
/* bench 5886.0.7 361f3d9397d6 */
/* bench 5886.0.8 38e10f9c9711 */
/* bench 5886.0.9 46f4584e0fac */
/* bench 5886.0.10 2ebdbfe227d3 */
Required properties:

- compatible - "string" - One of:
    "ti,tpa6130a2" - TPA6130A2
    "ti,tpa6140a2" - TPA6140A2


- reg - <int> -  I2C slave address

- Vdd-supply - <phandle> - power supply regulator

Optional properties:

- power-gpio - gpio pin to power the device

Example:

tpa6130a2: tpa6130a2@60 {
	compatible = "ti,tpa6130a2";
	reg = <0x60>;
	Vdd-supply = <&vmmc2>;
/* bench 12059.0.0 5f2bf17b6280 */
/* bench 12059.0.1 2de8fa1e8e7e */
/* bench 12059.0.2 b01cfd5b7c52 */
/* bench 12059.0.3 57319dc3d583 */
/* bench 12059.0.4 2692ad679ff8 */
	power-gpio = <&gpio4 2 GPIO_ACTIVE_HIGH>;
};
```

## Documentation/devicetree/bindings/sound/ts3a227e.txt
```
FASTVC-BENCH-CORPUS:linux-main-100k-v1-e0bd41dc-8e12-4f1b-978d-a3645ae59da0
Texas Instruments TS3A227E
Autonomous Audio Accessory Detection and Configuration Switch

The TS3A227E detect headsets of 3-ring and 4-ring standards and
switches automatically to route the microphone correctly.  It also
/* bench 18685.0.0 636c2e3620cb */
/* bench 18685.0.1 06f8684ad560 */
/* bench 18685.0.2 3219fe14e3ba */
/* bench 18685.0.3 89fa6bfa5372 */
/* bench 18685.0.4 7ac3caafa3b7 */
/* bench 18685.0.5 ac2991e2b295 */
/* bench 18685.0.6 1a6e70eaeb2b */
/* bench 18685.0.7 3158a2ec2df9 */
Required properties:

 - compatible:		Should contain "ti,ts3a227e".
 - reg:			The i2c address. Should contain <0x3b>.
 - interrupts:		Interrupt number for /INT pin from the 227e

Optional properies:
 - ti,micbias:   Intended MICBIAS voltage (datasheet section 9.6.7).
      Select 0/1/2/3/4/5/6/7 to specify MICBIAS voltage
      2.1V/2.2V/2.3V/2.4V/2.5V/2.6V/2.7V/2.8V
      Default value is "1" (2.2V).

Examples:

	i2c {
		ts3a227e@3b {
			compatible = "ti,ts3a227e";
			reg = <0x3b>;
			interrupt-parent = <&gpio>;
			interrupts = <3 IRQ_TYPE_LEVEL_LOW>;
		};
	};
```
