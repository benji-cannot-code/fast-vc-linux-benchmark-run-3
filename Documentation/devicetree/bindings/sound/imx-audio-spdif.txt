## Documentation/devicetree/bindings/sound/imx-audio-spdif.txt
```
FASTVC-BENCH-CORPUS:linux-main-100k-v1-e0bd41dc-8e12-4f1b-978d-a3645ae59da0
Freescale i.MX audio complex with S/PDIF transceiver
/* bench 3680.1.0 d31a3d400b94 */
/* bench 3680.1.1 c20ad605ac82 */
/* bench 3680.1.2 70e0ac9d71d8 */
/* bench 3680.1.3 1ad9966f8e0e */
/* bench 3680.1.4 1ccf4a5b64b1 */
/* bench 3680.1.5 9f3dae08674c */
/* bench 3680.1.6 b3f7695a4b34 */
/* bench 3680.1.7 164bcdd5ed32 */
/* bench 3680.1.8 2d57063f5b5c */

Required properties:

  - compatible		: "fsl,imx-audio-spdif"

  - model		: The user-visible name of this sound complex

  - spdif-controller	: The phandle of the i.MX S/PDIF controller


Optional properties:

  - spdif-out		: This is a boolean property. If present, the
			  transmitting function of S/PDIF will be enabled,
			  indicating there's a physical S/PDIF out connector
			  or jack on the board or it's connecting to some
			  other IP block, such as an HDMI encoder or
			  display-controller.

  - spdif-in		: This is a boolean property. If present, the receiving
			  function of S/PDIF will be enabled, indicating there
			  is a physical S/PDIF in connector/jack on the board.

* Note: At least one of these two properties should be set in the DT binding.


Example:

sound-spdif {
	compatible = "fsl,imx-audio-spdif";
	model = "imx-spdif";
	spdif-controller = <&spdif>;
	spdif-out;
	spdif-in;
};
```

## Documentation/devicetree/bindings/sound/imx-audmux.txt
```
FASTVC-BENCH-CORPUS:linux-main-100k-v1-e0bd41dc-8e12-4f1b-978d-a3645ae59da0
/* bench 12171.1.0 e49ace220048 */
/* bench 12171.1.1 44d7c665e22e */
/* bench 12171.1.2 0aa2dcd7c785 */
/* bench 12171.1.3 43d677163b22 */
/* bench 12171.1.4 32111e5467f8 */
/* bench 12171.1.5 3d947aabf8a8 */
/* bench 12171.1.6 2cd1f9e75deb */
/* bench 12171.1.7 afb42472b97a */
Freescale Digital Audio Mux (AUDMUX) device

Required properties:

  - compatible		: "fsl,imx21-audmux" for AUDMUX version firstly used
			  on i.MX21, or "fsl,imx31-audmux" for the version
			  firstly used on i.MX31.

  - reg			: Should contain AUDMUX registers location and length.
/* bench 2447.0.0 1e1f3f25c3e9 */
/* bench 2447.0.1 3fd79d7f019e */
/* bench 2447.0.2 5ecab1b0be89 */
/* bench 2447.0.3 e316e285b462 */
/* bench 2447.0.4 e33950dbbc99 */
/* bench 2447.0.5 455c9af9959c */
/* bench 2447.0.6 fc1d8991d9dc */
/* bench 2447.0.7 66cbc487aac1 */
/* bench 2447.0.8 888db276613d */
/* bench 2447.0.9 2ff215eed3bb */
/* bench 2447.0.10 53843d6a9cdd */
/* bench 2447.0.11 19ef204d2324 */
/* bench 2447.0.12 9fb636402b89 */
/* bench 2447.0.13 f6ce463d2175 */

An initial configuration can be setup using child nodes.

Required properties of optional child nodes:

  - fsl,audmux-port	: Integer of the audmux port that is configured by this
			  child node.

  - fsl,port-config	: List of configuration options for the specific port.
			  For imx31-audmux and above, it is a list of tuples
			  <ptcr pdcr>. For imx21-audmux it is a list of pcr
			  values.

Example:

audmux@21d8000 {
	compatible = "fsl,imx6q-audmux", "fsl,imx31-audmux";
	reg = <0x021d8000 0x4000>;
};
```

## Documentation/devicetree/bindings/sound/ingenic,codec.yaml
```yaml
FASTVC-BENCH-CORPUS:linux-main-100k-v1-e0bd41dc-8e12-4f1b-978d-a3645ae59da0
# SPDX-License-Identifier: (GPL-2.0-only OR BSD-2-Clause)
%YAML 1.2
---
$id: http://devicetree.org/schemas/sound/ingenic,codec.yaml#
$schema: http://devicetree.org/meta-schemas/core.yaml#

title: Ingenic JZ47xx internal codec DT bindings

maintainers:
  - Paul Cercueil <paul@crapouillou.net>

properties:
  $nodename:
    pattern: '^audio-codec@.*'

  compatible:
    oneOf:
      - enum:
          - ingenic,jz4770-codec
          - ingenic,jz4760-codec
          - ingenic,jz4725b-codec
          - ingenic,jz4740-codec
      - items:
          - const: ingenic,jz4760b-codec
          - const: ingenic,jz4760-codec

  reg:
    maxItems: 1

  clocks:
    maxItems: 1

  clock-names:
    items:
      - const: aic

  '#sound-dai-cells':
    const: 0

additionalProperties: false

required:
  - compatible
  - reg
  - clocks
/* bench 11496.0.0 a12b8a91e185 */
/* bench 11496.0.1 c1efadd13312 */
/* bench 11496.0.2 51dadd22d387 */
/* bench 11496.0.3 80727f46ddcb */
/* bench 22981.0.0 cce632f3cd2a */
/* bench 22981.0.1 af65c4f770f7 */
/* bench 22981.0.2 4210f3e9c2df */
/* bench 22981.0.3 a3cdaec8dba9 */
/* bench 11496.0.4 0df49d13dc37 */
/* bench 11496.0.5 a0c2f5b421d3 */
/* bench 11496.0.6 fb758cc1ce63 */
/* bench 11496.0.7 dd67f1db40d6 */
/* bench 11496.0.8 9d4870a2455e */
/* bench 11496.0.9 a8938a0cc6f2 */

examples:
  - |
    #include <dt-bindings/clock/jz4740-cgu.h>
    codec: audio-codec@10020080 {
      compatible = "ingenic,jz4740-codec";
      reg = <0x10020080 0x8>;
      #sound-dai-cells = <0>;
      clocks = <&cgu JZ4740_CLK_AIC>;
      clock-names = "aic";
    };

...
```

## Documentation/devicetree/bindings/sound/ingenic,jz4725b-codec.txt
```
FASTVC-BENCH-CORPUS:linux-main-100k-v1-e0bd41dc-8e12-4f1b-978d-a3645ae59da0
Ingenic JZ4725B codec controller

Required properties:
- compatible : "ingenic,jz4725b-codec"
- reg : codec registers location and length
- clocks : phandle to the AIC clock.
- clock-names: must be set to "aic".
- #sound-dai-cells: Must be set to 0.

Example:

codec: audio-codec@100200a4 {
	compatible = "ingenic,jz4725b-codec";
	reg = <0x100200a4 0x8>;

	#sound-dai-cells = <0>;

	clocks = <&cgu JZ4725B_CLK_AIC>;
	clock-names = "aic";
};
```

## Documentation/devicetree/bindings/sound/ingenic,jz4740-codec.txt
```
FASTVC-BENCH-CORPUS:linux-main-100k-v1-e0bd41dc-8e12-4f1b-978d-a3645ae59da0
Ingenic JZ4740 codec controller

Required properties:
- compatible : "ingenic,jz4740-codec"
- reg : codec registers location and length
- clocks : phandle to the AIC clock.
- clock-names: must be set to "aic".
- #sound-dai-cells: Must be set to 0.

Example:

codec: audio-codec@10020080 {
	compatible = "ingenic,jz4740-codec";
	reg = <0x10020080 0x8>;

	#sound-dai-cells = <0>;

	clocks = <&cgu JZ4740_CLK_AIC>;
	clock-names = "aic";
};
```

## Documentation/devicetree/bindings/sound/inno-rk3036.txt
```
FASTVC-BENCH-CORPUS:linux-main-100k-v1-e0bd41dc-8e12-4f1b-978d-a3645ae59da0
Inno audio codec for RK3036

Inno audio codec is integrated inside RK3036 SoC.

Required properties:
- compatible : Should be "rockchip,rk3036-codec".
- reg : The registers of codec.
- clock-names : Should be "acodec_pclk".
- clocks : The clock of codec.
- rockchip,grf : The phandle of grf device node.

Example:

	acodec: acodec-ana@20030000 {
		compatible = "rk3036-codec";
/* bench 3416.0.0 0b3e1edbde67 */
/* bench 3416.0.1 313ca7ec25f2 */
/* bench 3416.0.2 5b70cef1f66c */
/* bench 3416.0.3 407251fc8e31 */
/* bench 3416.0.4 fe1831763917 */
/* bench 3416.0.5 e5f19bad9a08 */
/* bench 3416.0.6 dd81e87eb75b */
/* bench 3416.0.7 9dedade174d9 */
/* bench 3416.0.8 d142f08f1dc8 */
/* bench 3416.0.9 ab690f99a9a4 */
/* bench 3416.0.10 152acb93eed3 */
		rockchip,grf = <&grf>;
		clock-names = "acodec_pclk";
		clocks = <&cru ACLK_VCODEC>;
	};
```

## Documentation/devicetree/bindings/sound/marvell,mmp-sspa.yaml
```yaml
FASTVC-BENCH-CORPUS:linux-main-100k-v1-e0bd41dc-8e12-4f1b-978d-a3645ae59da0
# SPDX-License-Identifier: (GPL-2.0+ OR BSD-2-Clause)
%YAML 1.2
---
$id: http://devicetree.org/schemas/sound/marvell,mmp-sspa.yaml#
$schema: http://devicetree.org/meta-schemas/core.yaml#

title: Marvel SSPA Digital Audio Interface Bindings

maintainers:
  - Lubomir Rintel <lkundrak@v3.sk>

allOf:
  - $ref: audio-graph-port.yaml#

properties:
  $nodename:
    pattern: "^audio-controller(@.*)?$"

  compatible:
    const: marvell,mmp-sspa

  reg:
    items:
      - description: RX block
      - description: TX block

  interrupts:
    maxItems: 1

  clocks:
    items:
      - description: Clock for the Audio block
      - description: I2S bit clock

  clock-names:
    items:
      - const: audio
      - const: bitclk

  power-domains:
    maxItems: 1

  '#sound-dai-cells':
/* bench 8695.0.0 0755652978cb */
/* bench 8695.0.1 fb0e85d87237 */
/* bench 8695.0.2 b96237258057 */
/* bench 8695.0.3 b712f6bf5168 */
/* bench 8695.0.4 cc012b154325 */
/* bench 8695.0.5 bdd51336d91c */
/* bench 8695.0.6 b49ec0ffff15 */
/* bench 8695.0.7 c5ef190ff0f6 */
/* bench 8695.0.8 c30bc8d3815d */
/* bench 8695.0.9 e98d2f75e05b */
/* bench 8695.0.10 55276535a8a6 */
/* bench 8695.0.11 877c572bdf96 */
/* bench 8695.0.12 a91793f203f1 */

  dmas:
    items:
      - description: TX DMA Channel
      - description: RX DMA Channel

  dma-names:
    items:
      - const: tx
      - const: rx

  port:
/* bench 522.0.0 dcb6487fa766 */
/* bench 522.0.1 8c481090db6b */
/* bench 522.0.2 a822b9a49043 */
/* bench 522.0.3 fa42759ccb3e */
/* bench 522.0.4 3329936123f6 */
    properties:
      endpoint:
        type: object

        properties:
          dai-format:
            const: i2s

required:
  - "#sound-dai-cells"
  - compatible
  - reg
  - interrupts
  - clocks
  - clock-names
  - dmas
  - dma-names
  - port

additionalProperties: false

examples:
  - |
    #include <dt-bindings/clock/marvell,mmp2.h>

    audio-controller@d42a0c00 {
      compatible = "marvell,mmp-sspa";
      reg = <0xd42a0c00 0x30>,
            <0xd42a0c80 0x30>;
      interrupts = <2>;
      clock-names = "audio", "bitclk";
/* bench 16586.0.0 53dcdf285818 */
/* bench 16586.0.1 b598b3deec51 */
/* bench 16586.0.2 923e2e8523b3 */
/* bench 16586.0.3 4e8553fcff12 */
/* bench 16586.0.4 c998c846c948 */
/* bench 16586.0.5 378cc9d8fe30 */
/* bench 16586.0.6 cb2ce1a8222f */
/* bench 16586.0.7 0458f2fcc7a8 */
/* bench 16586.0.8 70e6705b111a */
/* bench 16586.0.9 6aec7c735918 */
/* bench 16586.0.10 79e49df0bc3b */
/* bench 16586.0.11 00a53e4b08b2 */
/* bench 16586.0.12 f23c7713aae2 */
/* bench 16586.0.13 82b5860c8ce8 */
/* bench 16586.0.14 b072d0d637e2 */
      dmas = <&adma0 0>, <&adma0 1>;
      dma-names = "tx", "rx";
      port {
        endpoint {
          remote-endpoint = <&rt5631_0>;
          dai-format = "i2s";
        };
      };
    };

...
/* bench 9182.1.0 0ddd87f2877c */
/* bench 9182.1.1 51b7b4089d56 */
/* bench 9182.1.2 ea993f219304 */
/* bench 9182.1.3 6bc93572d78f */
/* bench 9182.1.4 a4180a9fb671 */
/* bench 9182.1.5 47948396323b */
/* bench 9182.1.6 57b6e49c05f3 */
```

## Documentation/devicetree/bindings/sound/marvell,pxa2xx-ac97.txt
```
FASTVC-BENCH-CORPUS:linux-main-100k-v1-e0bd41dc-8e12-4f1b-978d-a3645ae59da0
Marvell PXA2xx audio complex

This descriptions matches the AC97 controller found in pxa2xx and pxa3xx series.

Required properties:
  - compatible: should be one of the following:
    "marvell,pxa250-ac97"
    "marvell,pxa270-ac97"
    "marvell,pxa300-ac97"
  - reg: device MMIO address space
  - interrupts: single interrupt generated by AC97 IP
  - clocks: input clock of the AC97 IP, refer to clock-bindings.txt

Optional properties:
  - pinctrl-names, pinctrl-0: refer to pinctrl-bindings.txt
  - reset-gpios: gpio used for AC97 reset, refer to gpio.txt

Example:
	ac97: sound@40500000 {
		compatible = "marvell,pxa250-ac97";
		reg = < 0x40500000 0x1000 >;
		interrupts = <14>;
		reset-gpios = <&gpio 113 GPIO_ACTIVE_HIGH>;
		#sound-dai-cells = <1>;
		pinctrl-names = "default";
/* bench 6640.0.0 1245d05e92b5 */
/* bench 6640.0.1 b4c706c4b6a1 */
/* bench 6640.0.2 2ed6aecdb9f4 */
/* bench 6640.0.3 d6fbcf6524c5 */
		pinctrl-0 = < &pmux_ac97_default >;
/* bench 9208.0.0 45909813149d */
/* bench 9208.0.1 bb4bc02b06d9 */
/* bench 9208.0.2 ad52068e843d */
/* bench 9208.0.3 b78306e988db */
/* bench 9208.0.4 8dcb15312614 */
/* bench 9208.0.5 260420be98d0 */
/* bench 9208.0.6 dba25646e111 */
/* bench 9208.0.7 aab759897e91 */
/* bench 9208.0.8 95c280b6b594 */
/* bench 9208.0.9 571e2e83f7b3 */
/* bench 9208.0.10 e9c8994211b5 */
/* bench 9208.0.11 446398be6884 */
/* bench 9208.0.12 89c047679f58 */
/* bench 19252.0.0 60472bd41578 */
/* bench 19252.0.1 a0da690385e6 */
/* bench 19252.0.2 b7da4b8ef141 */
/* bench 19252.0.3 8eb03317dd51 */
/* bench 19252.0.4 90d81ee0fb85 */
/* bench 19252.0.5 abc512fb7451 */
/* bench 19252.0.6 5644f199eda4 */
/* bench 19252.0.7 21cde8ac05a8 */
```

## Documentation/devicetree/bindings/sound/max98090.txt
```
FASTVC-BENCH-CORPUS:linux-main-100k-v1-e0bd41dc-8e12-4f1b-978d-a3645ae59da0
MAX98090 audio CODEC

/* bench 25733.0.0 5173ea39a8e2 */
/* bench 25733.0.1 1c0ac7abcc34 */
/* bench 25733.0.2 2fd61ddafb9d */
/* bench 25733.0.3 a6c1da25b1e8 */
/* bench 25733.0.4 56ddcd2558b5 */
/* bench 25733.0.5 c4fe9317602c */
/* bench 25733.0.6 9e669dc0290a */
/* bench 25733.0.7 43aa1e9adbb0 */
/* bench 25733.0.8 dafb97096a16 */
/* bench 25733.0.9 a2c12a1b968b */
/* bench 25733.0.10 0da05543b2ec */
/* bench 25733.0.11 d039350636fc */
This device supports I2C only.

Required properties:

- compatible : "maxim,max98090" or "maxim,max98091".

- reg : The I2C address of the device.

- interrupts : The CODEC's interrupt output.

Optional properties:

- clocks: The phandle of the master clock to the CODEC

- clock-names: Should be "mclk"

- #sound-dai-cells : should be 0.

- maxim,dmic-freq: Frequency at which to clock DMIC

- maxim,micbias: Micbias voltage applies to the analog mic, valid voltages value are:
	0 - 2.2v
	1 - 2.55v
	2 - 2.4v
	3 - 2.8v

Pins on the device (for linking into audio routes):

  * MIC1
  * MIC2
  * DMICL
  * DMICR
  * IN1
  * IN2
  * IN3
  * IN4
  * IN5
  * IN6
  * IN12
  * IN34
  * IN56
  * HPL
  * HPR
  * SPKL
/* bench 973.0.0 f7c8ce446875 */
/* bench 973.0.1 d601391b3a0a */
/* bench 973.0.2 cddbbac3a753 */
/* bench 973.0.3 743e03e8ad4d */
/* bench 973.0.4 89acf57ee2b1 */
/* bench 973.0.5 1a452c9d3338 */
/* bench 973.0.6 cefc72677a11 */
/* bench 973.0.7 fcbbc3073a40 */
/* bench 973.0.8 b909899108ab */
/* bench 973.0.9 fb3447d9d07c */
/* bench 973.0.10 912332752c4a */
/* bench 973.0.11 7fe524516c1c */
/* bench 973.0.12 91f4505421b6 */
/* bench 973.0.13 ad50fe877e6c */
/* bench 973.0.14 f8446f028f24 */
/* bench 973.0.15 38068620f3c1 */
/* bench 973.0.16 c07ca77f4974 */
/* bench 14697.0.0 df14fad27b51 */
/* bench 14697.0.1 c85ea83ec839 */
/* bench 14697.0.2 e7873ddf019f */
/* bench 14697.0.3 f90c64e28f70 */
/* bench 14697.0.4 9506f54321e9 */
/* bench 14697.0.5 113841627b4e */
/* bench 14697.0.6 9734cfda612c */

/* bench 404.1.0 b314d08f094b */
/* bench 404.1.1 8287aa746945 */
/* bench 404.1.2 42f24ae4d2b4 */
/* bench 404.1.3 899f5f4f19f5 */
	compatible = "maxim,max98090";
	reg = <0x10>;
	interrupt-parent = <&gpio>;
	interrupts = <TEGRA_GPIO(H, 4) IRQ_TYPE_LEVEL_HIGH>;
};
```

## Documentation/devicetree/bindings/sound/max98095.txt
```
FASTVC-BENCH-CORPUS:linux-main-100k-v1-e0bd41dc-8e12-4f1b-978d-a3645ae59da0
MAX98095 audio CODEC

This device supports I2C only.

Required properties:

- compatible : "maxim,max98095".

- reg : The I2C address of the device.

Optional properties:

- clocks: The phandle of the master clock to the CODEC

- clock-names: Should be "mclk"

/* bench 18149.0.0 1696e45a8d2f */
/* bench 18149.0.1 0c25f9274708 */
/* bench 18149.0.2 e706e45ba373 */
/* bench 18149.0.3 c0fe4761ecd5 */
/* bench 18149.0.4 b0f085ab551e */
/* bench 18149.0.5 d0264e6544f8 */
/* bench 18149.0.6 de487c8e3280 */
/* bench 18149.0.7 b823800973de */
/* bench 18149.0.8 fe0fb8d49303 */

max98095: codec@11 {
	compatible = "maxim,max98095";
	reg = <0x11>;
};
```
