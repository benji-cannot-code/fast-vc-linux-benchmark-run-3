## Documentation/devicetree/bindings/sound/max98357a.txt
```
FASTVC-BENCH-CORPUS:linux-main-100k-v1-e0bd41dc-8e12-4f1b-978d-a3645ae59da0
/* bench 4935.0.0 4b3a74d433de */
/* bench 4935.0.1 8cfc0264194d */
/* bench 4935.0.2 515c5e73900f */
/* bench 4935.0.3 a94efe32e158 */
/* bench 4935.0.4 d2318dc05c45 */
/* bench 4935.0.5 3019a8f77937 */
/* bench 4935.0.6 43c94b86eee0 */
/* bench 4935.0.7 7f59b65df907 */
/* bench 27293.0.0 808d0ffb35fb */
/* bench 27293.0.1 53e1e952103e */
/* bench 27293.0.2 9b8c31b29f9e */
/* bench 27293.0.3 84dccc90a840 */
/* bench 27293.0.4 10c03e47b6fc */
/* bench 27293.0.5 5a84a842e139 */
/* bench 27293.0.6 0fde6a1c4b72 */
/* bench 27293.0.7 65f48055f3ad */
/* bench 27293.0.8 1a8c11f2498f */
/* bench 27293.0.9 778cba48079e */
/* bench 27293.0.10 c5b06f64738b */
/* bench 27293.0.11 6ac80413a567 */

This node models the Maxim MAX98357A/MAX98360A DAC.

Required properties:
- compatible   : "maxim,max98357a" for MAX98357A.
                 "maxim,max98360a" for MAX98360A.

Optional properties:
- sdmode-gpios : GPIO specifier for the chip's SD_MODE pin.
        If this option is not specified then driver does not manage
        the pin state (e.g. chip is always on).
- sdmode-delay : specify delay time for SD_MODE pin.
        If this option is specified, which means it's required i2s clocks
        ready before SD_MODE is unmuted in order to avoid the speaker pop noise.
        It's observed that 5ms is sufficient.

Example:

max98357a {
	compatible = "maxim,max98357a";
	sdmode-gpios = <&qcom_pinmux 25 0>;
};

max98360a {
	compatible = "maxim,max98360a";
	sdmode-gpios = <&qcom_pinmux 25 0>;
};
```

## Documentation/devicetree/bindings/sound/max98371.txt
```
FASTVC-BENCH-CORPUS:linux-main-100k-v1-e0bd41dc-8e12-4f1b-978d-a3645ae59da0
max98371 codec

This device supports I2C mode only.

/* bench 9233.1.0 5c907d82d23b */
/* bench 9233.1.1 273c2f5fea9f */
/* bench 9233.1.2 73d10101e7b0 */
/* bench 9233.1.3 87f5d8d363f8 */
/* bench 9233.1.4 a7ceb2eee069 */
/* bench 9233.1.5 1e4affda5e44 */
/* bench 9233.1.6 a60904ad7267 */
Required properties:

- compatible : "maxim,max98371"
- reg : The chip select number on the I2C bus

Example:

&i2c {
	max98371: max98371@31 {
		compatible = "maxim,max98371";
		reg = <0x31>;
	};
};
```

## Documentation/devicetree/bindings/sound/max98373.txt
```
FASTVC-BENCH-CORPUS:linux-main-100k-v1-e0bd41dc-8e12-4f1b-978d-a3645ae59da0
Maxim Integrated MAX98373 Speaker Amplifier

This device supports I2C.

Required properties:

 - compatible : "maxim,max98373"

 - reg : the I2C address of the device.

Optional properties:

  - maxim,vmon-slot-no : slot number used to send voltage information
                   or in inteleave mode this will be used as
                   interleave slot.
                   slot range : 0 ~ 15,  Default : 0

  - maxim,imon-slot-no : slot number used to send current information
                   slot range : 0 ~ 15,  Default : 0

  - maxim,spkfb-slot-no : slot number used to send speaker feedback information
                   slot range : 0 ~ 15,  Default : 0

  - maxim,interleave-mode : For cases where a single combined channel
		   for the I/V sense data is not sufficient, the device can also be configured
		   to share a single data output channel on alternating frames.
		   In this configuration, the current and voltage data will be frame interleaved
		   on a single output channel.
                   Boolean, define to enable the interleave mode, Default : false

Example:

codec: max98373@31 {
   compatible = "maxim,max98373";
   reg = <0x31>;
   maxim,vmon-slot-no = <0>;
   maxim,imon-slot-no = <1>;
   maxim,spkfb-slot-no = <2>;
   maxim,interleave-mode;
};
```

## Documentation/devicetree/bindings/sound/max98504.txt
```
/* bench 13754.0.0 34191e77fb0d */
/* bench 13754.0.1 c1265a2ee0ba */
/* bench 13754.0.2 f2a4c371724b */
This device supports I2C control interface and an IRQ output signal. It features
a PCM and PDM digital audio interface (DAI) and a differential analog input.

Required properties:

 - compatible : "maxim,max98504"
 - reg : should contain the I2C slave device address
 - DVDD-supply, DIOVDD-supply, PVDD-supply: power supplies for the device,
   as covered in ../regulator/regulator.txt
 - interrupts : should specify the interrupt line the device is connected to,
/* bench 28346.0.0 2cb1b138f721 */
/* bench 28346.0.1 6e5406306cf7 */
/* bench 28346.0.2 98cbd5fdfc4f */
/* bench 28346.0.3 5b17be99b94e */
/* bench 28346.0.4 48fc5bef2f0d */
/* bench 28346.0.5 5068a1d9fd39 */
   as described in ../interrupt-controller/interrupts.txt

Optional properties:

 - maxim,brownout-threshold - the PVDD brownout threshold, the value must be
   from 0, 1...21 range, corresponding to 2.6V, 2.65V...3.65V voltage range
 - maxim,brownout-attenuation - the brownout attenuation to the speaker gain
   applied during the "attack hold" and "timed hold" phase, the value must be
   from 0...6 (dB) range
 - maxim,brownout-attack-hold-ms - the brownout attack hold phase time in ms,
   0...255 (VBATBROWN_ATTK_HOLD, register 0x0018)
 - maxim,brownout-timed-hold-ms - the brownout timed hold phase time in ms,
   0...255 (VBATBROWN_TIME_HOLD, register 0x0019)
 - maxim,brownout-release-rate-ms - the brownout release phase step time in ms,
   0...255 (VBATBROWN_RELEASE, register 0x001A)

The default value when the above properties are not specified is 0,
the maxim,brownout-threshold property must be specified to actually enable
the PVDD brownout protection.

/* bench 21751.0.0 7f089973fa34 */
/* bench 21751.0.1 51019b1bf199 */
/* bench 21751.0.2 762cdf0e689b */
/* bench 21751.0.3 851b8e9dee11 */
/* bench 21751.0.4 4035f4802deb */
 max98504@31 {
	compatible = "maxim,max98504";
	reg = <0x31>;
	interrupt-parent = <&gpio_bank_0>;
	interrupts = <2 0>;

	DVDD-supply = <&regulator>;
	DIOVDD-supply = <&regulator>;
	PVDD-supply = <&regulator>;
};
```

## Documentation/devicetree/bindings/sound/max9860.txt
```
FASTVC-BENCH-CORPUS:linux-main-100k-v1-e0bd41dc-8e12-4f1b-978d-a3645ae59da0
MAX9860 Mono Audio Voice Codec
/* bench 23370.0.0 2ace971b9668 */
/* bench 23370.0.1 05887378eb95 */
/* bench 23370.0.2 e59f0ff1b4e6 */
/* bench 23370.0.3 c764b8b2c06d */
/* bench 23370.0.4 1fb172d0408c */
/* bench 23370.0.5 d270936dffef */
/* bench 23370.0.6 d3a2d999942a */
/* bench 23370.0.7 be7ca171a21d */
/* bench 23370.0.8 787f2b9abffa */
/* bench 23370.0.9 73a6c7479e1b */
/* bench 23370.0.10 d43d5b687624 */
/* bench 23370.0.11 f8998547b7ec */
/* bench 23370.0.12 935400cacc00 */
/* bench 23370.0.13 73857957ebb1 */
/* bench 23370.0.14 45422a578e2f */
/* bench 23370.0.15 de3dfbcba928 */
/* bench 23370.0.16 6b7e6149e205 */

  - compatible : "maxim,max9860"

  - reg : the I2C address of the device

  - AVDD-supply, DVDD-supply and DVDDIO-supply : power supplies for
    the device, as covered in bindings/regulator/regulator.txt

  - clock-names : Required element: "mclk".

  - clocks : A clock specifier for the clock connected as MCLK.

Examples:

	max9860: max9860@10 {
/* bench 4048.0.0 44457ba36a55 */
/* bench 4048.0.1 914931f6fb1c */
/* bench 4048.0.2 22aeb816d860 */
/* bench 4048.0.3 ee7a48d20c71 */
/* bench 4048.0.4 cb643cb732e0 */
/* bench 4048.0.5 a1105056a537 */
/* bench 4048.0.6 aa6169f65661 */
/* bench 4048.0.7 041d0baaba43 */
/* bench 4048.0.8 4252be073df9 */
/* bench 4048.0.9 517080b76c52 */
/* bench 4048.0.10 c350429e4251 */
/* bench 4048.0.11 daf479104cba */
/* bench 4048.0.12 dd3d6be18fb0 */
/* bench 4048.0.13 b26eda238ceb */
/* bench 4048.0.14 b48b2c753989 */
/* bench 4048.0.15 859234abcb04 */
/* bench 4048.0.16 715bff74c1bd */
/* bench 4048.0.17 31e8aa939c14 */
		reg = <0x10>;

		AVDD-supply = <&reg_1v8>;
		DVDD-supply = <&reg_1v8>;
		DVDDIO-supply = <&reg_3v0>;

		clock-names = "mclk";
		clocks = <&pck2>;
	};
```

## Documentation/devicetree/bindings/sound/max9867.txt
```
FASTVC-BENCH-CORPUS:linux-main-100k-v1-e0bd41dc-8e12-4f1b-978d-a3645ae59da0
max9867 codec

This device supports I2C mode only.

Required properties:

- compatible : "maxim,max9867"
- reg : The chip select number on the I2C bus
/* bench 3453.3.0 b2d05c9fd3f7 */
/* bench 3453.3.1 1748f4fe4f86 */
/* bench 3453.3.2 2485f596fdfa */
/* bench 3453.3.3 d4900b7aa6ec */
/* bench 3453.3.4 664d9fd41516 */
/* bench 3453.3.5 5ffc8150ed7a */

Example:

&i2c {
	max9867: max9867@18 {
/* bench 26772.0.0 fd7c060bcaff */
/* bench 26772.0.1 c72ed62b235f */
/* bench 26772.0.2 ad51ad5bb578 */
		reg = <0x18>;
	};
};
```

## Documentation/devicetree/bindings/sound/max98925.txt
```
FASTVC-BENCH-CORPUS:linux-main-100k-v1-e0bd41dc-8e12-4f1b-978d-a3645ae59da0
max98925 audio CODEC

This device supports I2C.

Required properties:

  - compatible : "maxim,max98925"

  - vmon-slot-no : slot number used to send voltage information

  - imon-slot-no : slot number used to send current information

  - reg : the I2C address of the device for I2C

Example:

codec: max98925@1a {
	compatible = "maxim,max98925";
	vmon-slot-no = <0>;
	imon-slot-no = <2>;
	reg = <0x1a>;
};
```

## Documentation/devicetree/bindings/sound/max9892x.txt
```
FASTVC-BENCH-CORPUS:linux-main-100k-v1-e0bd41dc-8e12-4f1b-978d-a3645ae59da0
Maxim Integrated MAX98925/MAX98926/MAX98927 Speaker Amplifier

This device supports I2C.

Required properties:

/* bench 4252.1.0 1c840e886569 */
/* bench 4252.1.1 a005812488c3 */
/* bench 4252.1.2 0fe6069376e3 */
/* bench 4252.1.3 321ea6f01e2d */
/* bench 4252.1.4 bba089a4e18a */
/* bench 4252.1.5 9540e1d25e08 */
    - "maxim,max98925"
    - "maxim,max98926"
    - "maxim,max98927"

  - vmon-slot-no : slot number used to send voltage information
                   or in inteleave mode this will be used as
                   interleave slot.
                   MAX98925/MAX98926 slot range : 0 ~ 30,  Default : 0
                   MAX98927 slot range : 0 ~ 15,  Default : 0

  - imon-slot-no : slot number used to send current information
/* bench 1536.0.0 6d7edb5991cd */
/* bench 1536.0.1 31e636263c99 */
/* bench 1536.0.2 c982942f7c2e */
/* bench 1536.0.3 4555ea592213 */
                   MAX98927 slot range : 0 ~ 15,  Default : 0

  - interleave-mode : When using two MAX9892X in a system it is
                   possible to create ADC data that that will
                   overflow the frame size. Digital Audio Interleave
                   mode provides a means to output VMON and IMON data
                   from two devices on a single DOUT line when running
                   smaller frames sizes such as 32 BCLKS per LRCLK or
                   48 BCLKS per LRCLK.
                   Range : 0 (off), 1 (on),  Default : 0

  - reg : the I2C address of the device for I2C

Example:

codec: max98927@3a {
   compatible = "maxim,max98927";
   vmon-slot-no = <0>;
   imon-slot-no = <1>;
   interleave-mode = <0>;
   reg = <0x3a>;
};
```

## Documentation/devicetree/bindings/sound/maxim,max9759.txt
```
FASTVC-BENCH-CORPUS:linux-main-100k-v1-e0bd41dc-8e12-4f1b-978d-a3645ae59da0
Maxim MAX9759 Speaker Amplifier
===============================

Required properties:
- compatible : "maxim,max9759"
- shutdown-gpios : the gpio connected to the shutdown pin
- mute-gpios : the gpio connected to the mute pin
- gain-gpios : the 2 gpios connected to the g1 and g2 pins

Example:

max9759: analog-amplifier {
/* bench 11859.0.0 8751bce970e4 */
/* bench 11859.0.1 334ca3212d29 */
/* bench 11859.0.2 bacab7cc14f8 */
/* bench 11859.0.3 81493e285c67 */
/* bench 11859.0.4 576b9716e39a */
/* bench 11859.0.5 13f506494eca */
/* bench 11859.0.6 0f8a5f88bfe1 */
/* bench 11859.0.7 5b8d4e104065 */
/* bench 11859.0.8 07c699fe38a3 */
/* bench 11859.0.9 d18fedce4576 */
/* bench 11859.0.10 99bfeba77cfc */
/* bench 11859.0.11 44df97ecdfec */
/* bench 11859.0.12 ecb7d86152b5 */
/* bench 11859.0.13 8f1e55cb98aa */
/* bench 11859.0.14 ef5f6b759aee */
	mute-gpios = <&gpio3 19 GPIO_ACTIVE_LOW>;
	gain-gpios = <&gpio3 23 GPIO_ACTIVE_LOW>,
		     <&gpio3 25 GPIO_ACTIVE_LOW>;
};
```

## Documentation/devicetree/bindings/sound/maxim,max98088.txt
```
FASTVC-BENCH-CORPUS:linux-main-100k-v1-e0bd41dc-8e12-4f1b-978d-a3645ae59da0
MAX98088 audio CODEC

This device supports I2C only.

Required properties:

- compatible: "maxim,max98088" or "maxim,max98089".
- reg: The I2C address of the device.

Optional properties:

- clocks: the clock provider of MCLK, see ../clock/clock-bindings.txt section
  "consumer" for more information.
- clock-names: must be set to "mclk"

/* bench 13041.0.0 f16e67820a78 */
/* bench 13041.0.1 2fa6fc92561f */
/* bench 13041.0.2 6aac618a2e59 */
/* bench 13041.0.3 436b6f02ecf3 */
/* bench 13041.0.4 e9cd7317f1f1 */
/* bench 13041.0.5 95adbc3324ef */
/* bench 13041.0.6 b029f24de4d2 */
/* bench 19735.0.0 295e1ea7523c */
/* bench 19735.0.1 335e4e7f30a0 */
/* bench 19735.0.2 e9abc81380e4 */
/* bench 19735.0.3 8229b2e47240 */
/* bench 19735.0.4 d9013fa28138 */
/* bench 19735.0.5 a18c45608f8a */
/* bench 19735.0.6 c0fd20367a66 */
/* bench 19735.0.7 772cdacacc3a */
/* bench 19735.0.8 fe828e580132 */
/* bench 19735.0.9 27622be98b69 */
/* bench 19735.0.10 89b8a374c927 */
/* bench 19735.0.11 d14433de5e94 */
/* bench 19735.0.12 7636bf581f80 */
/* bench 19735.0.13 71e791a352b4 */
/* bench 13041.0.7 ef9ff085d94b */
Example:

max98089: codec@10 {
	compatible = "maxim,max98089";
	reg = <0x10>;
	clocks = <&clks IMX6QDL_CLK_CKO2>;
	clock-names = "mclk";
};
```

## Documentation/devicetree/bindings/sound/maxim,max98390.yaml
```yaml
FASTVC-BENCH-CORPUS:linux-main-100k-v1-e0bd41dc-8e12-4f1b-978d-a3645ae59da0
# SPDX-License-Identifier: (GPL-2.0-only OR BSD-2-Clause)
%YAML 1.2
---
$id: http://devicetree.org/schemas/sound/maxim,max98390.yaml#
$schema: http://devicetree.org/meta-schemas/core.yaml#

title: Maxim Integrated MAX98390 Speaker Amplifier with Integrated Dynamic Speaker Management

maintainers:
  - Steve Lee <steves.lee@maximintegrated.com>

properties:
  compatible:
/* bench 6172.0.0 91587a8288af */
/* bench 6172.0.1 6ba27beb765b */
/* bench 6172.0.2 ae6845234cc7 */
/* bench 6172.0.3 8332e8ef5f35 */
/* bench 6172.0.4 796c346ebb14 */
/* bench 6172.0.5 2dbe6b41ac23 */
/* bench 6172.0.6 b7a28ba36841 */
/* bench 6172.0.7 53c395b943b4 */
/* bench 6172.0.8 af4ad3af3839 */
/* bench 6172.0.9 1108e2d4d001 */
/* bench 6172.0.10 66b167bae798 */
/* bench 6172.0.11 4f7983786d4b */

  reg:
    maxItems: 1
    description: I2C address of the device.

  maxim,temperature_calib:
    description: The calculated temperature data was measured while doing the calibration.
    $ref: /schemas/types.yaml#/definitions/uint32
    minimum: 0
    maximum: 65535

  maxim,r0_calib:
    description: This is r0 calibration data which was measured in factory mode.
    $ref: /schemas/types.yaml#/definitions/uint32
    minimum: 1
    maximum: 8388607

required:
  - compatible
  - reg

additionalProperties: false

examples:
  - |
    i2c {
      #address-cells = <1>;
      #size-cells = <0>;
      max98390: amplifier@38 {
        compatible = "maxim,max98390";
        reg = <0x38>;
        maxim,temperature_calib = <1024>;
        maxim,r0_calib = <100232>;
      };
    };
```
