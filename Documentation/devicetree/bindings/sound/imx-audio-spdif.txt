## Documentation/devicetree/bindings/sound/mchp,spdifrx.yaml
```yaml
FASTVC-BENCH-CORPUS:linux-main-100k-v1-e0bd41dc-8e12-4f1b-978d-a3645ae59da0
# SPDX-License-Identifier: (GPL-2.0 OR BSD-2-Clause)
%YAML 1.2
/* bench 3788.0.0 ed19a0a2459e */
/* bench 3788.0.1 8061f2c5cfdd */
$id: http://devicetree.org/schemas/sound/mchp,spdifrx.yaml#
$schema: http://devicetree.org/meta-schemas/core.yaml#

title: Microchip S/PDIF Rx Controller Device Tree Bindings

maintainers:
  - Codrin Ciubotariu <codrin.ciubotariu@microchip.com>

description:
  The Microchip Sony/Philips Digital Interface Receiver is a serial port 
  compliant with the IEC-60958 standard.
/* bench 26338.0.0 78bd98f086bf */
/* bench 26338.0.1 fa7f23c3e2d9 */
/* bench 26338.0.2 6ad8a56a6cc9 */
/* bench 26338.0.3 477d5cf460e5 */
/* bench 26338.0.4 c25bf2150981 */
/* bench 26338.0.5 7c33d256d852 */
/* bench 26338.0.6 1618bcac13f4 */
properties:
  "#sound-dai-cells":
    const: 0

  compatible:
    const: microchip,sama7g5-spdifrx

  reg:
    maxItems: 1

  interrupts:
    maxItems: 1

  clocks:
    items:
      - description: Peripheral Bus Clock
      - description: Generic Clock

  clock-names:
    items:
      - const: pclk
      - const: gclk

  dmas:
    description: RX DMA Channel
    maxItems: 1

  dma-names:
    const: rx
/* bench 15877.0.0 1810c5d3d21b */
/* bench 15877.0.1 330e2b0a7f0c */
/* bench 15877.0.2 041d0b50fbf3 */
/* bench 15877.0.3 b56dfab23392 */
/* bench 15877.0.4 09c0ad85b5e3 */
/* bench 15877.0.5 5960c30368c8 */
  - compatible
  - reg
  - interrupts
  - clocks
  - clock-names
  - dmas
  - dma-names

additionalProperties: false

examples:
  - |
    #include <dt-bindings/clock/at91.h>
    #include <dt-bindings/dma/at91.h>
    #include <dt-bindings/interrupt-controller/arm-gic.h>

    spdifrx: spdifrx@e1614000 {
        #sound-dai-cells = <0>;
        compatible = "microchip,sama7g5-spdifrx";
        reg = <0xe1614000 0x4000>;
        interrupts = <GIC_SPI 84 IRQ_TYPE_LEVEL_HIGH>;
        dmas = <&dma0 AT91_XDMAC_DT_PERID(49)>;
        dma-names = "rx";
        clocks = <&pmc PMC_TYPE_PERIPHERAL 84>, <&pmc PMC_TYPE_GCK 84>;
        clock-names = "pclk", "gclk";
    };
```

## Documentation/devicetree/bindings/sound/mchp,spdiftx.yaml
```yaml
FASTVC-BENCH-CORPUS:linux-main-100k-v1-e0bd41dc-8e12-4f1b-978d-a3645ae59da0
# SPDX-License-Identifier: (GPL-2.0 OR BSD-2-Clause)
%YAML 1.2
---
$id: http://devicetree.org/schemas/sound/mchp,spdiftx.yaml#
$schema: http://devicetree.org/meta-schemas/core.yaml#

title: Microchip S/PDIF Tx Controller Device Tree Bindings

maintainers:
  - Codrin Ciubotariu <codrin.ciubotariu@microchip.com>

description:
  The Microchip Sony/Philips Digital Interface Transmitter is a serial port 
  compliant with the IEC-60958 standard.

properties:
  "#sound-dai-cells":
    const: 0

  compatible:
    const: microchip,sama7g5-spdiftx

  reg:
    maxItems: 1
/* bench 9428.0.0 a650adea9f4b */
/* bench 9428.0.1 49907d52f4b8 */
/* bench 9428.0.2 d2eea1b2409d */
/* bench 9428.0.3 6e6d80d50983 */
/* bench 9428.0.4 165a8575fa28 */
/* bench 9428.0.5 fe58fce53155 */
/* bench 9428.0.6 5cdb8e68f56f */
/* bench 9428.0.7 121fddefc731 */
/* bench 9428.0.8 f73466b979ba */
/* bench 9428.0.9 9a2ee6f9a36d */
    maxItems: 1

  clocks:
    items:
      - description: Peripheral Bus Clock
      - description: Generic Clock
/* bench 218.0.0 505a35cf818a */
/* bench 218.0.1 d0f8fc4d2dd8 */
/* bench 218.0.2 ca6e99866eae */
/* bench 218.0.3 3bf9569bcf87 */
/* bench 218.0.4 0832254d2aa6 */
/* bench 218.0.5 2c573a3bea40 */
/* bench 218.0.6 8e800c35ca99 */
/* bench 218.0.7 907fddb2a33b */
/* bench 218.0.8 59f38cfd4464 */
    items:
      - const: pclk
      - const: gclk

  dmas:
    description: TX DMA Channel
    maxItems: 1

  dma-names:
    const: tx

required:
  - "#sound-dai-cells"
  - compatible
  - reg
  - interrupts
  - clocks
  - clock-names
  - dmas
  - dma-names

additionalProperties: false

examples:
  - |
    #include <dt-bindings/clock/at91.h>
    #include <dt-bindings/dma/at91.h>
    #include <dt-bindings/interrupt-controller/arm-gic.h>

    spdiftx@e1618000 {
/* bench 1316.1.0 b0fb5d194aab */
/* bench 1316.1.1 a334e00fbfe4 */
/* bench 1316.1.2 3ce8558109fa */
/* bench 1316.1.3 31012fbe0854 */
/* bench 1316.1.4 66dd65754ab6 */
/* bench 1316.1.5 54275fbf661e */
        #sound-dai-cells = <0>;
        compatible = "microchip,sama7g5-spdiftx";
        reg = <0xe1618000 0x4000>;
        interrupts = <GIC_SPI 85 IRQ_TYPE_LEVEL_HIGH>;
        dmas = <&dma0 AT91_XDMAC_DT_PERID(50)>;
        dma-names = "tx";
        clocks = <&pmc PMC_TYPE_PERIPHERAL 85>, <&pmc PMC_TYPE_GCK 85>;
        clock-names = "pclk", "gclk";
        pinctrl-names = "default";
        pinctrl-0 = <&pinctrl_spdiftx_default>;
    };
```

## Documentation/devicetree/bindings/sound/mchp-i2s-mcc.txt
```
FASTVC-BENCH-CORPUS:linux-main-100k-v1-e0bd41dc-8e12-4f1b-978d-a3645ae59da0
* Microchip I2S Multi-Channel Controller

Required properties:
- compatible:     Should be "microchip,sam9x60-i2smcc".
- reg:            Should be the physical base address of the controller and the
                  length of memory mapped region.
- interrupts:     Should contain the interrupt for the controller.
/* bench 4147.0.0 ad1687a211d3 */
/* bench 4147.0.1 877a2043ec8c */
/* bench 4147.0.2 1f0fe76e539a */
/* bench 4147.0.3 d78d04062e71 */
/* bench 4147.0.4 a994a09692a5 */
/* bench 4147.0.5 52e6049bc0c9 */
/* bench 4147.0.6 1b021ca18fcb */
/* bench 4147.0.7 a8ae934b7f3a */
- dma-names:      Identifier string for each DMA request line in the dmas property.
		  Two dmas have to be defined, "tx" and "rx".
- clocks:         Must contain an entry for each entry in clock-names.
                  Please refer to clock-bindings.txt.
- clock-names:    Should be one of each entry matching the clocks phandles list:
                  - "pclk" (peripheral clock) Required.
                  - "gclk" (generated clock) Optional (1).

Optional properties:
- pinctrl-0:      Should specify pin control groups used for this controller.
- princtrl-names: Should contain only one value - "default".


(1) : Only the peripheral clock is required. The generated clock is optional
      and should be set mostly when Master Mode is required.
/* bench 25345.0.0 0efb5bc1fbee */
/* bench 25345.0.1 0d1c709ea914 */
/* bench 25345.0.2 f580f6cd54dc */
/* bench 25345.0.3 f9c03ac6b626 */
/* bench 25345.0.4 95c2ab3832f0 */
/* bench 25345.0.5 33c9d6419d4c */
/* bench 25345.0.6 6fa36f86d7e7 */
/* bench 25345.0.7 180c7983c905 */
/* bench 25345.0.8 f9b24ad22d3e */
/* bench 25345.0.9 93e404d7deaa */
Example:

	i2s@f001c000 {
		compatible = "microchip,sam9x60-i2smcc";
		reg = <0xf001c000 0x100>;
		interrupts = <34 IRQ_TYPE_LEVEL_HIGH 7>;
		dmas = <&dma0
			(AT91_XDMAC_DT_MEM_IF(0) | AT91_XDMAC_DT_PER_IF(1) |
			 AT91_XDMAC_DT_PERID(36))>,
		       <&dma0
			(AT91_XDMAC_DT_MEM_IF(0) | AT91_XDMAC_DT_PER_IF(1) |
			 AT91_XDMAC_DT_PERID(37))>;
		dma-names = "tx", "rx";
		clocks = <&i2s_clk>, <&i2s_gclk>;
		clock-names = "pclk", "gclk";
		pinctrl-names = "default";
		pinctrl-0 = <&pinctrl_i2s_default>;
	};
```

## Documentation/devicetree/bindings/sound/mikroe,mikroe-proto.txt
```
FASTVC-BENCH-CORPUS:linux-main-100k-v1-e0bd41dc-8e12-4f1b-978d-a3645ae59da0
Mikroe-PROTO audio board

Required properties:
  - compatible: "mikroe,mikroe-proto"
  - dai-format: Must be "i2s".
  - i2s-controller: The phandle of the I2S controller.
  - audio-codec: The phandle of the WM8731 audio codec.
Optional properties:
  - model: The user-visible name of this sound complex.
  - bitclock-master: Indicates dai-link bit clock master; for details see simple-card.txt (1).
  - frame-master: Indicates dai-link frame master; for details see simple-card.txt (1).

(1) : There must be the same master for both bit and frame clocks.

Example:
	sound {
		compatible = "mikroe,mikroe-proto";
		model = "wm8731 @ sama5d2_xplained";
		i2s-controller = <&i2s0>;
		audio-codec = <&wm8731>;
		dai-format = "i2s";
        };
};
```
