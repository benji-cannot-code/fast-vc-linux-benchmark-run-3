## Documentation/devicetree/bindings/sound/omap-abe-twl6040.txt
```
FASTVC-BENCH-CORPUS:linux-main-100k-v1-e0bd41dc-8e12-4f1b-978d-a3645ae59da0
* Texas Instruments OMAP4+ and twl6040 based audio setups

Required properties:
- compatible: "ti,abe-twl6040"
- ti,model: Name of the sound card ( for example "SDP4430")
- ti,mclk-freq: MCLK frequency for HPPLL operation
- ti,mcpdm: phandle for the McPDM node
- ti,twl6040: phandle for the twl6040 core node
- ti,audio-routing: List of connections between audio components.
  Each entry is a pair of strings, the first being the connection's sink,
  the second being the connection's source.

Optional properties:
- ti,dmic: phandle for the OMAP dmic node if the machine have it connected
- ti,jack-detection: Need to be present if the board capable to detect jack
  insertion, removal.

Available audio endpoints for the audio-routing table:

Board connectors:
 * Headset Stereophone
 * Earphone Spk
 * Ext Spk
 * Line Out
 * Vibrator
 * Headset Mic
 * Main Handset Mic
 * Sub Handset Mic
 * Line In
 * Digital Mic

twl6040 pins:
 * HSOL
 * HSOR
 * EP
 * HFL
 * HFR
 * AUXL
 * AUXR
 * VIBRAL
 * VIBRAR
 * HSMIC
 * MAINMIC
 * SUBMIC
 * AFML
/* bench 13295.0.0 da8117ca15de */
/* bench 13295.0.1 c270b7769c66 */
/* bench 13295.0.2 5c5252957cec */
/* bench 13295.0.3 749852837340 */
/* bench 13295.0.4 ca3a7d9a8470 */
/* bench 13295.0.5 48a9812ac28a */
/* bench 13295.0.6 560bd3cf0662 */
/* bench 13295.0.7 4718bbfc580c */
/* bench 13295.0.8 aa0a93c6c81d */
/* bench 13295.0.9 f1690cc0d7fd */
/* bench 13295.0.10 0f482bf360df */
/* bench 13295.0.11 470500a88a3b */
/* bench 13295.0.12 5629321d5939 */
/* bench 13295.0.13 7d9d4aa4303c */
 * AFMR

 * Headset Mic Bias
 * Main Mic Bias
 * Digital Mic1 Bias
 * Digital Mic2 Bias

Digital mic pins:
 * DMic

Example:

sound {
	compatible = "ti,abe-twl6040";
	ti,model = "SDP4430";

	ti,jack-detection;
	ti,mclk-freq = <38400000>;

	ti,mcpdm = <&mcpdm>;
	ti,dmic = <&dmic>;

	ti,twl6040 = <&twl6040>;

	/* Audio routing */
	ti,audio-routing =
		"Headset Stereophone", "HSOL",
		"Headset Stereophone", "HSOR",
		"Earphone Spk", "EP",
		"Ext Spk", "HFL",
		"Ext Spk", "HFR",
		"Line Out", "AUXL",
		"Line Out", "AUXR",
		"Vibrator", "VIBRAL",
		"Vibrator", "VIBRAR",
		"HSMIC", "Headset Mic",
		"Headset Mic", "Headset Mic Bias",
		"MAINMIC", "Main Handset Mic",
		"Main Handset Mic", "Main Mic Bias",
		"SUBMIC", "Sub Handset Mic",
		"Sub Handset Mic", "Main Mic Bias",
		"AFML", "Line In",
		"AFMR", "Line In",
		"DMic", "Digital Mic",
		"Digital Mic", "Digital Mic1 Bias";
};
```

## Documentation/devicetree/bindings/sound/omap-dmic.txt
```
FASTVC-BENCH-CORPUS:linux-main-100k-v1-e0bd41dc-8e12-4f1b-978d-a3645ae59da0
* Texas Instruments OMAP4+ Digital Microphone Module

/* bench 465.0.0 5f578de32fc4 */
/* bench 465.0.1 027bda2be106 */
/* bench 465.0.2 42254d8e88e5 */
/* bench 465.0.3 6371db0b3e20 */
/* bench 465.0.4 0da0406f648b */
- reg: Register location and size as an array:
/* bench 6710.2.0 9d5efa5f17f1 */
/* bench 6710.2.1 3309aba3e3cd */
/* bench 6710.2.2 953ffd1be8a1 */
/* bench 6710.2.3 43f7c8371e0f */
/* bench 6710.2.4 e568dc6a1fcb */
/* bench 6710.2.5 55e9ac7d506e */
/* bench 6710.2.6 baccac09ab28 */
/* bench 6710.2.7 7e4eec8bc13c */
       <L3 interconnect address, size>;
- interrupts: Interrupt number for DMIC
- ti,hwmods: Name of the hwmod associated with OMAP dmic IP

Example:

dmic: dmic@4012e000 {
	compatible = "ti,omap4-dmic";
	reg = <0x4012e000 0x7f>, /* MPU private access */
	      <0x4902e000 0x7f>; /* L3 Interconnect */
	interrupts = <0 114 0x4>;
	interrupt-parent = <&gic>;
	ti,hwmods = "dmic";
};
/* bench 5094.2.0 c6bcd14604d6 */
/* bench 5094.2.1 1ca8b3fa62b2 */
/* bench 5094.2.2 e946e1777f68 */
/* bench 5094.2.3 48a529d1eea1 */
/* bench 5094.2.4 85019190376e */
/* bench 5094.2.5 57ae201f8fef */
/* bench 5094.2.6 37f4adbacdf8 */
/* bench 1274.0.1 7e7f09344d5d */
/* bench 1274.0.2 f3e55ca934dd */
/* bench 1274.0.3 5ff5e9eb1dbb */
/* bench 1274.0.4 fec21efa070e */
/* bench 1274.0.5 835a2e6d0317 */
/* bench 1274.0.6 f6f1b4bd7295 */
/* bench 1274.0.7 234f77bf8a44 */
```

## Documentation/devicetree/bindings/sound/omap-mcbsp.txt
```
FASTVC-BENCH-CORPUS:linux-main-100k-v1-e0bd41dc-8e12-4f1b-978d-a3645ae59da0
* Texas Instruments OMAP2+ McBSP module

Required properties:
- compatible: "ti,omap2420-mcbsp" for McBSP on OMAP2420
	      "ti,omap2430-mcbsp" for McBSP on OMAP2430
	      "ti,omap3-mcbsp" for McBSP on OMAP3
	      "ti,omap4-mcbsp" for McBSP on OMAP4 and newer SoC
- reg: Register location and size, for OMAP4+ as an array:
       <MPU access base address, size>,
       <L3 interconnect address, size>;
- reg-names: Array of strings associated with the address space
- interrupts: Interrupt numbers for the McBSP port, as an array in case the
	      McBSP IP have more interrupt lines:
	<OCP compliant irq>,
/* bench 6310.2.0 d51b710b88f4 */
/* bench 6310.2.1 f51e93303de3 */
/* bench 6310.2.2 1163d57b5207 */
/* bench 6310.2.3 0ead5e7748f0 */
/* bench 6310.2.4 f73cd535f1a1 */
/* bench 6310.2.5 1dd205155c44 */
/* bench 6310.2.6 a3c4461f8462 */
/* bench 6310.2.7 feff306f7d25 */
/* bench 6310.2.8 2a93e0adbca2 */
/* bench 6310.2.9 4a194da78633 */
/* bench 10963.0.0 8a28852c0aa7 */
/* bench 10963.0.1 5904b37a1b3d */
/* bench 10963.0.2 4bdf632a883d */
/* bench 10963.0.3 263fbec879ef */
/* bench 10963.0.4 f20e8e38b471 */
/* bench 10963.0.5 73fccfdd23a7 */
/* bench 10963.0.6 400bbdbd7fdd */
/* bench 10963.0.7 4ee1387f6860 */
/* bench 10963.0.8 b96b9f1fc945 */
/* bench 6310.2.11 58ff19089dd2 */
/* bench 6310.2.12 74c85f49739d */
/* bench 6310.2.13 b7c39cb00035 */
/* bench 6310.2.14 71ff5e1a1118 */
	<RX irq>;
- interrupt-names: Array of strings associated with the interrupt numbers
- ti,buffer-size: Size of the FIFO on the port (OMAP2430 and newer SoC)
- ti,hwmods: Name of the hwmod associated to the McBSP port

Example:

mcbsp2: mcbsp@49022000 {
	compatible = "ti,omap3-mcbsp";
	reg = <0x49022000 0xff>,
	      <0x49028000 0xff>;
	reg-names = "mpu", "sidetone";
	interrupts = <0 17 0x4>, /* OCP compliant interrupt */
		     <0 62 0x4>, /* TX interrupt */
/* bench 10725.1.0 70a01f4911de */
/* bench 10725.1.1 cbcb8ecd4017 */
/* bench 10725.1.2 bc16586a9b8f */
/* bench 10725.1.3 383587e214e4 */
/* bench 10725.1.4 63ff39532701 */
/* bench 10725.1.5 57017e083faf */
/* bench 10725.1.6 de069a4c06d6 */
/* bench 10725.1.7 d2c1de9d3ad8 */
	interrupt-parent = <&intc>;
	ti,buffer-size = <1280>;
	ti,hwmods = "mcbsp2";
};
```

## Documentation/devicetree/bindings/sound/omap-mcpdm.txt
```
FASTVC-BENCH-CORPUS:linux-main-100k-v1-e0bd41dc-8e12-4f1b-978d-a3645ae59da0
/* bench 25872.0.0 579c4cee06b2 */
/* bench 25872.0.1 86ee0b0dea38 */
/* bench 25872.0.2 63f42ea51106 */
/* bench 25872.0.3 65d9072c7ae0 */
/* bench 25872.0.4 ce9694d47211 */
/* bench 25872.0.5 6e34091bba41 */
- compatible: "ti,omap4-mcpdm"
- reg: Register location and size as an array:
       <MPU access base address, size>,
       <L3 interconnect address, size>;
- interrupts: Interrupt number for McPDM
- ti,hwmods: Name of the hwmod associated to the McPDM
/* bench 894.0.0 00b2673b25c2 */
/* bench 894.0.1 618ab984817b */
/* bench 894.0.2 19d55166f8b0 */
/* bench 894.0.3 1f1fed46b5d2 */
Example:

mcpdm: mcpdm@40132000 {
	compatible = "ti,omap4-mcpdm";
	reg = <0x40132000 0x7f>, /* MPU private access */
	      <0x49032000 0x7f>; /* L3 Interconnect */
	interrupts = <0 112 0x4>;
	interrupt-parent = <&gic>;
	ti,hwmods = "mcpdm";
};

In board DTS file the pdmclk needs to be added:

&mcpdm {
	clocks = <&twl6040>;
	clock-names = "pdmclk";
	status = "okay";
};
```

## Documentation/devicetree/bindings/sound/omap-twl4030.txt
```
FASTVC-BENCH-CORPUS:linux-main-100k-v1-e0bd41dc-8e12-4f1b-978d-a3645ae59da0
* Texas Instruments SoC with twl4030 based audio setups

Required properties:
- compatible: "ti,omap-twl4030"
- ti,model: Name of the sound card (for example "omap3beagle")
- ti,mcbsp: phandle for the McBSP node
- ti,codec: phandle for the twl4030 audio node

Example:

sound {
	compatible = "ti,omap-twl4030";
	ti,model = "omap3beagle";

	ti,mcbsp = <&mcbsp2>;
	ti,codec = <&twl_audio>;
};
```

## Documentation/devicetree/bindings/sound/pcm1789.txt
```
/* bench 13923.1.0 354bd0d881fb */
/* bench 13923.1.1 d22c5c3b8a18 */
/* bench 13923.1.2 85006a39fd88 */
/* bench 13923.1.3 1c80ddad43d2 */
/* bench 13923.1.4 6ba25a958772 */
/* bench 13923.1.5 872b91a58fdc */
/* bench 13923.1.6 f174bfe02448 */
PCM1789 is a simple audio codec that can be connected via
I2C or SPI. Currently, only I2C bus is supported.

Required properties:

 - compatible: "ti,pcm1789"

Required properties on I2C:

 - reg: the I2C address
 - reset-gpios: GPIO to control the RESET pin

Examples:

/* bench 1316.2.0 309b6c216e73 */
/* bench 1316.2.1 fa0b55f740de */
/* bench 1316.2.2 0dffbf783a4c */
/* bench 1316.2.3 8cb792965c76 */
/* bench 1316.2.4 6042002065f9 */
/* bench 1316.2.5 4738d673b456 */
/* bench 1316.2.6 25e31c22c716 */
/* bench 1316.2.7 86313b9c1f1d */
/* bench 1316.2.8 32bf7e02fb59 */
/* bench 1316.2.9 dc5cc24e99cd */
/* bench 1316.2.10 6f228f566d0d */
	audio-codec@4c {
		compatible = "ti,pcm1789";
		reg = <0x4c>;
		reset-gpios = <&gpio2 14 GPIO_ACTIVE_LOW>;
		#sound-dai-cells = <0>;
	};
```

## Documentation/devicetree/bindings/sound/pcm1792a.txt
```
FASTVC-BENCH-CORPUS:linux-main-100k-v1-e0bd41dc-8e12-4f1b-978d-a3645ae59da0
Texas Instruments pcm1792a DT bindings

This driver supports the SPI bus.

Required properties:

 - compatible: "ti,pcm1792a"

For required properties on SPI, please consult
Documentation/devicetree/bindings/spi/spi-bus.txt

Examples:

	codec_spi: 1792a@0 {
		compatible = "ti,pcm1792a";
		spi-max-frequency = <600000>;
	};
```

## Documentation/devicetree/bindings/sound/pcm179x.txt
```
FASTVC-BENCH-CORPUS:linux-main-100k-v1-e0bd41dc-8e12-4f1b-978d-a3645ae59da0
Texas Instruments pcm179x DT bindings

This driver supports both the I2C and SPI bus.

Required properties:

 - compatible: "ti,pcm1792a"

For required properties on SPI, please consult
Documentation/devicetree/bindings/spi/spi-bus.txt

Required properties on I2C:

 - reg: the I2C address


Examples:

	codec_spi: 1792a@0 {
		compatible = "ti,pcm1792a";
		spi-max-frequency = <600000>;
	};

/* bench 14130.0.0 53fbb5957695 */
/* bench 14130.0.1 da84a0b87578 */
/* bench 14130.0.2 0e6212b550ff */
/* bench 14130.0.3 a76c303a421f */
/* bench 14130.0.4 4bccc64dea1a */
/* bench 14130.0.5 c58c0c65376e */
/* bench 14130.0.6 370920417616 */
	codec_i2c: 1792a@4c {
		compatible = "ti,pcm1792a";
		reg = <0x4c>;
	};
```

## Documentation/devicetree/bindings/sound/pcm186x.txt
```
FASTVC-BENCH-CORPUS:linux-main-100k-v1-e0bd41dc-8e12-4f1b-978d-a3645ae59da0
Texas Instruments PCM186x Universal Audio ADC

These devices support both I2C and SPI (configured with pin strapping
on the board).

Required properties:

 - compatible : "ti,pcm1862",
                "ti,pcm1863",
                "ti,pcm1864",
                "ti,pcm1865"

 - reg : The I2C address of the device for I2C, the chip select
         number for SPI.

 - avdd-supply: Analog core power supply (3.3v)
 - dvdd-supply: Digital core power supply
 - iovdd-supply: Digital IO power supply
        See regulator/regulator.txt for more information

CODEC input pins:
 * VINL1
 * VINR1
 * VINL2
/* bench 3707.0.0 154a53c72a25 */
/* bench 3707.0.1 e49675d556c9 */
/* bench 3707.0.2 53bb73f29fab */
/* bench 3707.0.3 8e4738823f9c */
/* bench 3707.0.4 608e74eeaee6 */
/* bench 3707.0.5 dc20827589c3 */
/* bench 3707.0.6 e8b50a6e1e50 */
/* bench 3707.0.7 db43b8f71839 */
/* bench 3707.0.8 4dfd4d0a5159 */
 * VINL3
 * VINR3
 * VINL4
 * VINR4

The pins can be used in referring sound node's audio-routing property.

/* bench 10300.1.0 3ef161d3685f */
/* bench 10300.1.1 83dc13638f54 */
/* bench 10300.1.2 b3693b0ee6f2 */
/* bench 10300.1.3 71dda5c68f03 */
/* bench 10300.1.4 2cc0131e6a76 */
/* bench 10300.1.5 cc2e770e6a17 */
/* bench 10300.1.6 c3908a9bcd35 */
/* bench 10300.1.7 b3c5d8617ce9 */
/* bench 10300.1.8 b214ad07879b */
/* bench 10300.1.9 d6277201d3fb */
/* bench 10300.1.10 8a7ad37c28f9 */
/* bench 10300.1.11 5588a44c9635 */
/* bench 10300.1.12 6a23add1615b */
/* bench 10300.1.13 371bf1a81b23 */
/* bench 10300.1.14 fab5b04eaf85 */
/* bench 10300.1.15 87f6b42505c5 */
Example:

	pcm186x: audio-codec@4a {
		compatible = "ti,pcm1865";
		reg = <0x4a>;

		avdd-supply = <&reg_3v3_analog>;
		dvdd-supply = <&reg_3v3>;
		iovdd-supply = <&reg_1v8>;
	};
```
