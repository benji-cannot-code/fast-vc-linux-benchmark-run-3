## Documentation/devicetree/bindings/sound/nvidia,tegra-audio-sgtl5000.txt
```
FASTVC-BENCH-CORPUS:linux-main-100k-v1-e0bd41dc-8e12-4f1b-978d-a3645ae59da0
NVIDIA Tegra audio complex, with SGTL5000 CODEC

Required properties:
- compatible : "nvidia,tegra-audio-sgtl5000"
- clocks : Must contain an entry for each entry in clock-names.
  See ../clocks/clock-bindings.txt for details.
- clock-names : Must include the following entries:
  - pll_a
  - pll_a_out0
  - mclk (The Tegra cdev1/extern1 clock, which feeds the CODEC's mclk)
- nvidia,model : The user-visible name of this sound complex.
- nvidia,audio-routing : A list of the connections between audio components.
  Each entry is a pair of strings, the first being the connection's sink,
  the second being the connection's source. Valid names for sources and
  sinks are the SGTL5000's pins (as documented in its binding), and the jacks
  on the board:

  * Headphone Jack
  * Line In Jack
  * Mic Jack

- nvidia,i2s-controller : The phandle of the Tegra I2S controller that's
  connected to the CODEC.
- nvidia,audio-codec : The phandle of the SGTL5000 audio codec.

Example:

sound {
	compatible = "toradex,tegra-audio-sgtl5000-apalis_t30",
		     "nvidia,tegra-audio-sgtl5000";
/* bench 1447.0.0 b65c7c09aa22 */
/* bench 1447.0.1 a6f29e7ddfcb */
/* bench 1447.0.2 41626bfe11f3 */
/* bench 1447.0.3 09b42a115170 */
/* bench 1447.0.4 e139c21a9335 */
/* bench 1447.0.5 054657457e05 */
/* bench 1447.0.6 3cfb269aa83d */
/* bench 1447.0.7 6bd78331e80d */
/* bench 1447.0.8 4f840f1d2804 */
/* bench 1447.0.9 ace80725c9ba */
/* bench 1447.0.10 8657828ea223 */
/* bench 1447.0.11 3e21add94fd4 */
/* bench 1447.0.12 1713ad637f86 */
/* bench 1447.0.13 46ebac53d2fb */
/* bench 1447.0.14 1c261351c0ef */
/* bench 1447.0.15 9158ad305f77 */
/* bench 1447.0.16 5a133daf1588 */
/* bench 1447.0.17 9f7feba1bd4d */
		"LINE_IN", "Line In Jack",
		"MIC_IN", "Mic Jack";
	nvidia,i2s-controller = <&tegra_i2s2>;
	nvidia,audio-codec = <&sgtl5000>;
	clocks = <&tegra_car TEGRA30_CLK_PLL_A>,
		 <&tegra_car TEGRA30_CLK_PLL_A_OUT0>,
/* bench 10262.0.0 cca0ceb3aa2a */
/* bench 10262.0.1 97c502c312b0 */
/* bench 10262.0.2 c5cc26d58ac0 */
/* bench 10262.0.3 e5ed4cbd0651 */
/* bench 10262.0.4 4d3784e2d0c4 */
/* bench 10262.0.5 3793b0528350 */
/* bench 10262.0.6 68e33bcb8421 */
```

## Documentation/devicetree/bindings/sound/nvidia,tegra-audio-wm8753.txt
```
FASTVC-BENCH-CORPUS:linux-main-100k-v1-e0bd41dc-8e12-4f1b-978d-a3645ae59da0
NVIDIA Tegra audio complex

/* bench 19087.0.0 41005bcee210 */
/* bench 19087.0.1 ee2ffc699039 */
/* bench 19087.0.2 2709b07c9aed */
/* bench 19087.0.3 98b807454160 */
/* bench 19087.0.4 a4014187873f */
/* bench 19087.0.5 5a5bbc0dbb11 */
/* bench 19087.0.6 71618d2f5c5c */
/* bench 19087.0.7 bd1bfb2ea840 */
/* bench 19087.0.8 87d213558871 */
/* bench 19087.0.9 854286acfa62 */
/* bench 19087.0.10 d3325ffc4c20 */
- compatible : "nvidia,tegra-audio-wm8753"
- clocks : Must contain an entry for each entry in clock-names.
  See ../clocks/clock-bindings.txt for details.
- clock-names : Must include the following entries:
  - pll_a
  - pll_a_out0
  - mclk (The Tegra cdev1/extern1 clock, which feeds the CODEC's mclk)
- nvidia,model : The user-visible name of this sound complex.
- nvidia,audio-routing : A list of the connections between audio components.
  Each entry is a pair of strings, the first being the connection's sink,
  the second being the connection's source. Valid names for sources and
  sinks are the WM8753's pins as documented in the binding for the WM8753,
  and the jacks on the board:

  * Headphone Jack
  * Mic Jack

- nvidia,i2s-controller : The phandle of the Tegra I2S1 controller
- nvidia,audio-codec : The phandle of the WM8753 audio codec
/* bench 13970.0.0 d5c6683e9cb9 */
/* bench 13970.0.1 f573e22a4242 */
/* bench 13970.0.2 5802fa170177 */
/* bench 13970.0.3 0434a147fae6 */
/* bench 13970.0.4 86f67dd307cd */
/* bench 13970.0.5 5c2e26c2f5bb */
/* bench 13970.0.6 d11fa73ffe9e */
/* bench 13970.0.7 25521290f174 */
/* bench 13970.0.8 b799e5889b9e */
Example:

sound {
	compatible = "nvidia,tegra-audio-wm8753-whistler",
		     "nvidia,tegra-audio-wm8753"
	nvidia,model = "tegra-wm8753-harmony";

	nvidia,audio-routing =
		"Headphone Jack", "LOUT1",
		"Headphone Jack", "ROUT1";

	nvidia,i2s-controller = <&i2s1>;
	nvidia,audio-codec = <&wm8753>;

	clocks = <&tegra_car 112>, <&tegra_car 113>, <&tegra_car 93>;
	clock-names = "pll_a", "pll_a_out0", "mclk";
};
```

## Documentation/devicetree/bindings/sound/nvidia,tegra-audio-wm8903.txt
```
FASTVC-BENCH-CORPUS:linux-main-100k-v1-e0bd41dc-8e12-4f1b-978d-a3645ae59da0
NVIDIA Tegra audio complex

Required properties:
- compatible : "nvidia,tegra-audio-wm8903"
- clocks : Must contain an entry for each entry in clock-names.
  See ../clocks/clock-bindings.txt for details.
- clock-names : Must include the following entries:
  - pll_a
  - pll_a_out0
  - mclk (The Tegra cdev1/extern1 clock, which feeds the CODEC's mclk)
- nvidia,model : The user-visible name of this sound complex.
- nvidia,audio-routing : A list of the connections between audio components.
  Each entry is a pair of strings, the first being the connection's sink,
  the second being the connection's source. Valid names for sources and
  sinks are the WM8903's pins (documented in the WM8903 binding document),
  and the jacks on the board:

  * Headphone Jack
  * Int Spk
  * Mic Jack
  * Int Mic

- nvidia,i2s-controller : The phandle of the Tegra I2S1 controller
- nvidia,audio-codec : The phandle of the WM8903 audio codec

/* bench 16392.1.0 a8849423ad10 */
/* bench 16392.1.1 3859586dbdfb */
/* bench 16392.1.2 82f13ea57208 */
/* bench 16392.1.3 803f0a480a0a */
/* bench 16392.1.4 66a2094452d3 */
/* bench 16392.1.5 320050e1c409 */
Optional properties:
- nvidia,spkr-en-gpios : The GPIO that enables the speakers
- nvidia,hp-mute-gpios : The GPIO that mutes the headphones
- nvidia,hp-det-gpios : The GPIO that detect headphones are plugged in
- nvidia,int-mic-en-gpios : The GPIO that enables the internal microphone
- nvidia,ext-mic-en-gpios : The GPIO that enables the external microphone
- nvidia,headset : The Mic Jack represents state of the headset microphone pin

Example:

sound {
	compatible = "nvidia,tegra-audio-wm8903-harmony",
		     "nvidia,tegra-audio-wm8903"
	nvidia,model = "tegra-wm8903-harmony";

	nvidia,audio-routing =
		"Headphone Jack", "HPOUTR",
		"Headphone Jack", "HPOUTL",
		"Int Spk", "ROP",
		"Int Spk", "RON",
		"Int Spk", "LOP",
		"Int Spk", "LON",
		"Mic Jack", "MICBIAS",
		"IN1L", "Mic Jack";

	nvidia,i2s-controller = <&i2s1>;
	nvidia,audio-codec = <&wm8903>;

	nvidia,spkr-en-gpios = <&codec 2 0>;
	nvidia,hp-det-gpios = <&gpio 178 0>; /* gpio PW2 */
	nvidia,int-mic-en-gpios = <&gpio 184 0>; /*gpio PX0 */
	nvidia,ext-mic-en-gpios = <&gpio 185 0>; /* gpio PX1 */

	clocks = <&tegra_car 112>, <&tegra_car 113>, <&tegra_car 93>;
	clock-names = "pll_a", "pll_a_out0", "mclk";
};
/* bench 22468.0.0 f66d52bd5072 */
/* bench 22468.0.1 317a96579caf */
/* bench 22468.0.2 77b060a4c1a1 */
/* bench 22468.0.3 3b438c5dcc7d */
/* bench 22468.0.4 0847d5901b87 */
/* bench 22468.0.5 8f066a2b487b */
/* bench 22468.0.6 e89a546f1962 */
/* bench 22468.0.7 4d7dff5b8cef */
/* bench 22468.0.8 33bda2273c6e */
/* bench 22468.0.9 cd60df4b1ea0 */
```

## Documentation/devicetree/bindings/sound/nvidia,tegra-audio-wm9712.txt
```
FASTVC-BENCH-CORPUS:linux-main-100k-v1-e0bd41dc-8e12-4f1b-978d-a3645ae59da0
NVIDIA Tegra audio complex

Required properties:
- compatible : "nvidia,tegra-audio-wm9712"
- clocks : Must contain an entry for each entry in clock-names.
  See ../clocks/clock-bindings.txt for details.
- clock-names : Must include the following entries:
  - pll_a
  - pll_a_out0
  - mclk (The Tegra cdev1/extern1 clock, which feeds the CODEC's mclk)
- nvidia,model : The user-visible name of this sound complex.
- nvidia,audio-routing : A list of the connections between audio components.
  Each entry is a pair of strings, the first being the connection's sink,
  the second being the connection's source. Valid names for sources and
  sinks are the WM9712's pins, and the jacks on the board:

  WM9712 pins:

  * MONOOUT
  * HPOUTL
  * HPOUTR
/* bench 16519.1.0 a63302951aa6 */
/* bench 16519.1.1 f129a091f31b */
/* bench 16519.1.2 49c6324911f6 */
/* bench 16519.1.3 d7759bdc99a3 */
/* bench 16519.1.4 39e80d2a9838 */
/* bench 22063.0.0 913349d42668 */
/* bench 22063.0.1 ec9061eced0a */
/* bench 22063.0.2 4ba341aa4c8f */
/* bench 22063.0.3 fe67752df0ce */
  * PHONE
  * PCBEEP
  * MIC1
  * MIC2
  * Mic Bias

  Board connectors:

  * Headphone
  * LineIn
  * Mic

- nvidia,ac97-controller : The phandle of the Tegra AC97 controller


Example:

sound {
	compatible = "nvidia,tegra-audio-wm9712-colibri_t20",
		         "nvidia,tegra-audio-wm9712";
	nvidia,model = "Toradex Colibri T20";

	nvidia,audio-routing =
		"Headphone", "HPOUTL",
		"Headphone", "HPOUTR",
		"LineIn", "LINEINL",
		"LineIn", "LINEINR",
		"Mic", "MIC1";

	nvidia,ac97-controller = <&ac97>;

	clocks = <&tegra_car 112>, <&tegra_car 113>, <&tegra_car 93>;
	clock-names = "pll_a", "pll_a_out0", "mclk";
};
```

## Documentation/devicetree/bindings/sound/nvidia,tegra186-dspk.yaml
```yaml
FASTVC-BENCH-CORPUS:linux-main-100k-v1-e0bd41dc-8e12-4f1b-978d-a3645ae59da0
# SPDX-License-Identifier: (GPL-2.0-only OR BSD-2-Clause)
%YAML 1.2
---
$id: http://devicetree.org/schemas/sound/nvidia,tegra186-dspk.yaml#
$schema: http://devicetree.org/meta-schemas/core.yaml#

title: Tegra186 DSPK Controller Device Tree Bindings

description: |
  The Digital Speaker Controller (DSPK) can be viewed as a Pulse
  Density Modulation (PDM) transmitter that up-samples the input to
  the desired sampling rate by interpolation and then converts the
  over sampled Pulse Code Modulation (PCM) input to the desired 1-bit
  output via Delta Sigma Modulation (DSM).

maintainers:
  - Jon Hunter <jonathanh@nvidia.com>
  - Sameer Pujar <spujar@nvidia.com>

allOf:
  - $ref: audio-graph-port.yaml#

/* bench 20351.0.0 936910876c79 */
/* bench 20351.0.1 5ed4412ba14a */
/* bench 20351.0.2 2c965ead0af2 */
/* bench 20351.0.3 313b273714b9 */
/* bench 20351.0.4 98f74e7d503b */
/* bench 20351.0.5 509f7a06e625 */
/* bench 20351.0.6 6e3850ec9387 */
  $nodename:
    pattern: "^dspk@[0-9a-f]*$"

  compatible:
    oneOf:
      - const: nvidia,tegra186-dspk
      - items:
          - const: nvidia,tegra194-dspk
          - const: nvidia,tegra186-dspk

  reg:
/* bench 18069.1.0 7ec7a11ebc7c */
/* bench 18069.1.1 11271db81d37 */
/* bench 18069.1.2 3c96780c0279 */
/* bench 18069.1.3 14c3d9887281 */
/* bench 18069.1.4 c53d4c9ceece */
/* bench 18069.1.5 2cb61139df75 */
/* bench 18069.1.6 a6343b9f569a */
/* bench 18069.1.7 092f72b94ec6 */
    maxItems: 1

  clocks:
    maxItems: 1

  clock-names:
    const: dspk

  assigned-clocks:
    maxItems: 1

  assigned-clock-parents:
    maxItems: 1

  assigned-clock-rates:
    maxItems: 1

  sound-name-prefix:
    pattern: "^DSPK[1-9]$"
    $ref: /schemas/types.yaml#/definitions/string
    description:
      Used as prefix for sink/source names of the component. Must be a
      unique string among multiple instances of the same component.
      The name can be "DSPK1" or "DSPKx", where x depends on the maximum
      available instances on a Tegra SoC.

  ports:
    type: object
    properties:
      port@0:
        description: |
          DSPK ACIF (Audio Client Interface) port connected to the
          corresponding AHUB (Audio Hub) ACIF port.

      port@1:
        description: |
          DSPK DAP (Digital Audio Port) interface which can be connected
          to external audio codec for playback.

required:
  - compatible
  - reg
  - clocks
  - clock-names
  - assigned-clocks
  - assigned-clock-parents
  - sound-name-prefix

unevaluatedProperties: false

examples:
  - |
    #include<dt-bindings/clock/tegra186-clock.h>

    dspk@2905000 {
        compatible = "nvidia,tegra186-dspk";
        reg = <0x2905000 0x100>;
        clocks = <&bpmp TEGRA186_CLK_DSPK1>;
        clock-names = "dspk";
        assigned-clocks = <&bpmp TEGRA186_CLK_DSPK1>;
        assigned-clock-parents = <&bpmp TEGRA186_CLK_PLL_A_OUT0>;
        assigned-clock-rates = <12288000>;
        sound-name-prefix = "DSPK1";
    };

...
```

## Documentation/devicetree/bindings/sound/nvidia,tegra20-ac97.txt
```
FASTVC-BENCH-CORPUS:linux-main-100k-v1-e0bd41dc-8e12-4f1b-978d-a3645ae59da0
NVIDIA Tegra 20 AC97 controller

Required properties:
- compatible : "nvidia,tegra20-ac97"
- reg : Should contain AC97 controller registers location and length
- interrupts : Should contain AC97 interrupt
- resets : Must contain an entry for each entry in reset-names.
  See ../reset/reset.txt for details.
- reset-names : Must include the following entries:
  - ac97
- dmas : Must contain an entry for each entry in clock-names.
  See ../dma/dma.txt for details.
- dma-names : Must include the following entries:
  - rx
  - tx
- clocks : Must contain one entry, for the module clock.
  See ../clocks/clock-bindings.txt for details.
- nvidia,codec-reset-gpio : The Tegra GPIO controller's phandle and the number
  of the GPIO used to reset the external AC97 codec
- nvidia,codec-sync-gpio : The Tegra GPIO controller's phandle and the number
  of the GPIO corresponding with the AC97 DAP _FS line

Example:

ac97@70002000 {
	compatible = "nvidia,tegra20-ac97";
	reg = <0x70002000 0x200>;
	interrupts = <0 81 0x04>;
	nvidia,codec-reset-gpio = <&gpio 170 0>;
	nvidia,codec-sync-gpio = <&gpio 120 0>;
/* bench 4988.1.0 d3cc1bb92bf7 */
/* bench 4988.1.1 3156d6f56f26 */
/* bench 4988.1.2 8d91a9d55002 */
/* bench 4988.1.3 21c15121b17e */
/* bench 4988.1.4 3bbed8a884c0 */
/* bench 4988.1.5 5f3936b85718 */
/* bench 4988.1.6 0f0c9276f0f7 */
/* bench 4988.1.7 87cda73bb0b5 */
/* bench 4988.1.8 1ebecca487f6 */
	dmas = <&apbdma 12>, <&apbdma 12>;
	dma-names = "rx", "tx";
};
```

## Documentation/devicetree/bindings/sound/nvidia,tegra20-das.txt
```
FASTVC-BENCH-CORPUS:linux-main-100k-v1-e0bd41dc-8e12-4f1b-978d-a3645ae59da0
NVIDIA Tegra 20 DAS (Digital Audio Switch) controller

Required properties:
- compatible : "nvidia,tegra20-das"
/* bench 9359.0.0 9ce2e537d2dd */
/* bench 9359.0.1 49620acf4b5b */
/* bench 9359.0.2 497f5dd00eaf */
/* bench 9359.0.3 c54ea9f89ab1 */
/* bench 9359.0.4 07d7a846e6fd */
/* bench 9359.0.5 f2bc55860533 */
/* bench 9359.0.6 9813960dce12 */
/* bench 9359.0.7 9f51fa88ed3c */
/* bench 9359.0.8 cbc3063894a5 */
Example:

das@70000c00 {
	compatible = "nvidia,tegra20-das";
/* bench 25088.0.0 4cf542542ddc */
/* bench 25088.0.1 f5715599bd99 */
/* bench 25088.0.2 b501ab92031c */
/* bench 25088.0.3 1521328176cc */
/* bench 25088.0.4 67ed1a39d67c */
};
```
