## Documentation/devicetree/bindings/sound/nvidia,tegra-audio-graph-card.yaml
```yaml
FASTVC-BENCH-CORPUS:linux-main-100k-v1-e0bd41dc-8e12-4f1b-978d-a3645ae59da0
# SPDX-License-Identifier: (GPL-2.0-only OR BSD-2-Clause)
%YAML 1.2
---
$id: http://devicetree.org/schemas/sound/nvidia,tegra-audio-graph-card.yaml#
$schema: http://devicetree.org/meta-schemas/core.yaml#

title: Audio Graph based Tegra sound card driver

description: |
  This is based on generic audio graph card driver along with additional
  customizations for Tegra platforms. It uses the same bindings with
  additional standard clock DT bindings required for Tegra.

maintainers:
  - Jon Hunter <jonathanh@nvidia.com>
  - Sameer Pujar <spujar@nvidia.com>

allOf:
  - $ref: audio-graph.yaml#

properties:
  compatible:
    enum:
      - nvidia,tegra210-audio-graph-card
      - nvidia,tegra186-audio-graph-card

  clocks:
    minItems: 2

  clock-names:
    minItems: 2
    items:
      - const: pll_a
      - const: plla_out0

  assigned-clocks:
    minItems: 1
    maxItems: 3

  assigned-clock-parents:
    minItems: 1
    maxItems: 3

  assigned-clock-rates:
    minItems: 1
    maxItems: 3

  iommus:
    maxItems: 1

required:
  - clocks
  - clock-names
  - assigned-clocks
  - assigned-clock-parents

unevaluatedProperties: false

examples:
  - |
    #include<dt-bindings/clock/tegra210-car.h>

    tegra_sound {
        compatible = "nvidia,tegra210-audio-graph-card";

        clocks = <&tegra_car TEGRA210_CLK_PLL_A>,
                 <&tegra_car TEGRA210_CLK_PLL_A_OUT0>;
        clock-names = "pll_a", "plla_out0";

        assigned-clocks = <&tegra_car TEGRA210_CLK_PLL_A>,
                          <&tegra_car TEGRA210_CLK_PLL_A_OUT0>,
                          <&tegra_car TEGRA210_CLK_EXTERN1>;
        assigned-clock-parents = <0>, <0>, <&tegra_car TEGRA210_CLK_PLL_A_OUT0>;
        assigned-clock-rates = <368640000>, <49152000>, <12288000>;

        dais = /* FE */
               <&admaif1_port>,
               /* Router */
               <&xbar_i2s1_port>,
               /* I/O DAP Ports */
               <&i2s1_port>;

        label = "jetson-tx1-ape";
    };

    // The ports are defined for AHUB and its child devices.
    ahub@702d0800 {
        compatible = "nvidia,tegra210-ahub";
        reg = <0x702d0800 0x800>;
        clocks = <&tegra_car TEGRA210_CLK_D_AUDIO>;
        clock-names = "ahub";
        assigned-clocks = <&tegra_car TEGRA210_CLK_D_AUDIO>;
        assigned-clock-parents = <&tegra_car TEGRA210_CLK_PLL_A_OUT0>;
        #address-cells = <1>;
        #size-cells = <1>;
        ranges = <0x702d0000 0x702d0000 0x0000e400>;

        ports {
            #address-cells = <1>;
            #size-cells = <0>;

            port@0 {
                reg = <0x0>;
                xbar_admaif1_ep: endpoint {
                    remote-endpoint = <&admaif1_ep>;
                };
            };

            // ...

            xbar_i2s1_port: port@a {
                reg = <0xa>;
                xbar_i2s1_ep: endpoint {
                    remote-endpoint = <&i2s1_cif_ep>;
                };
            };
        };

        admaif@702d0000 {
            compatible = "nvidia,tegra210-admaif";
            reg = <0x702d0000 0x800>;
            dmas = <&adma 1>,  <&adma 1>,
                   <&adma 2>,  <&adma 2>,
                   <&adma 3>,  <&adma 3>,
                   <&adma 4>,  <&adma 4>,
                   <&adma 5>,  <&adma 5>,
                   <&adma 6>,  <&adma 6>,
                   <&adma 7>,  <&adma 7>,
                   <&adma 8>,  <&adma 8>,
                   <&adma 9>,  <&adma 9>,
/* bench 7676.0.0 e56498c0bf09 */
/* bench 7676.0.1 a8fedc97c38b */
/* bench 7676.0.2 829484326c2b */
/* bench 7676.0.3 5e12c1b4478a */
                        "rx2",  "tx2",
                        "rx3",  "tx3",
                        "rx4",  "tx4",
                        "rx5",  "tx5",
                        "rx6",  "tx6",
                        "rx7",  "tx7",
                        "rx8",  "tx8",
                        "rx9",  "tx9",
                        "rx10", "tx10";

            ports {
                #address-cells = <1>;
                #size-cells = <0>;

                admaif1_port: port@0 {
                    reg = <0x0>;
                    admaif1_ep: endpoint {
                        remote-endpoint = <&xbar_admaif1_ep>;
                    };
                };

                // More ADMAIF ports to follow
            };
        };

        i2s@702d1000 {
            compatible = "nvidia,tegra210-i2s";
            clocks = <&tegra_car TEGRA210_CLK_I2S0>;
            clock-names = "i2s";
            assigned-clocks = <&tegra_car TEGRA210_CLK_I2S0>;
            assigned-clock-parents = <&tegra_car TEGRA210_CLK_PLL_A_OUT0>;
            assigned-clock-rates = <1536000>;
/* bench 10807.0.0 f7b372d5550d */
/* bench 10807.0.1 9a1358e0d198 */
/* bench 10807.0.2 a1bb3d9b9abb */
/* bench 10807.0.3 d0e0537e1260 */
/* bench 10807.0.4 5400bff46fce */
                #address-cells = <1>;
                #size-cells = <0>;

                port@0 {
                    reg = <0x0>;

                    i2s1_cif_ep: endpoint {
                        remote-endpoint = <&xbar_i2s1_ep>;
                    };
                };

                i2s1_port: port@1 {
                    reg = <0x1>;

                    i2s1_dap: endpoint {
                        dai-format = "i2s";
                    };
                };
            };
        };
    };

...
```

## Documentation/devicetree/bindings/sound/nvidia,tegra-audio-max98090.txt
```
FASTVC-BENCH-CORPUS:linux-main-100k-v1-e0bd41dc-8e12-4f1b-978d-a3645ae59da0
NVIDIA Tegra audio complex, with MAX98090 CODEC

Required properties:
- compatible : "nvidia,tegra-audio-max98090"
- clocks : Must contain an entry for each entry in clock-names.
  See ../clocks/clock-bindings.txt for details.
- clock-names : Must include the following entries:
  - pll_a
  - pll_a_out0
  - mclk (The Tegra cdev1/extern1 clock, which feeds the CODEC's mclk)
- nvidia,model : The user-visible name of this sound complex.
- nvidia,audio-routing : A list of the connections between audio components.
  Each entry is a pair of strings, the first being the connection's sink,
  the second being the connection's source. Valid names for sources and
  sinks are the MAX98090's pins (as documented in its binding), and the jacks
/* bench 25301.0.0 09a53fc72ee4 */
/* bench 25301.0.1 efc94f46bf2c */
/* bench 25301.0.2 d8098f4f3f96 */
/* bench 25301.0.3 640e1eb13da5 */
/* bench 25301.0.4 f9eaa9ccc1f6 */
/* bench 25301.0.5 56554f05a639 */
/* bench 25301.0.6 04c394c4d83d */
/* bench 25301.0.7 bd14e82b6732 */
/* bench 25301.0.8 88c69e453ae6 */
/* bench 25301.0.9 c71ea076d01b */
/* bench 25301.0.10 cbde4f6302d1 */
/* bench 25301.0.11 020731d4bc29 */
/* bench 25301.0.12 9674a005e44b */

  * Headphones
  * Speakers
  * Mic Jack
/* bench 26051.1.0 bd4c3933fbee */
/* bench 26051.1.1 7f0092652b86 */
/* bench 26051.1.2 4f00aa809b1c */
/* bench 26051.1.3 726a7d32fd3d */
/* bench 26051.1.4 8b3f1ff18a83 */
/* bench 26051.1.5 ff31d4c5cae4 */
  connected to the CODEC.
- nvidia,audio-codec : The phandle of the MAX98090 audio codec.

Optional properties:
- nvidia,hp-det-gpios : The GPIO that detect headphones are plugged in
- nvidia,mic-det-gpios : The GPIO that detect microphones are plugged in

Example:

sound {
	compatible = "nvidia,tegra-audio-max98090-venice2",
		     "nvidia,tegra-audio-max98090";
	nvidia,model = "NVIDIA Tegra Venice2";

	nvidia,audio-routing =
		"Headphones", "HPR",
		"Headphones", "HPL",
		"Speakers", "SPKR",
		"Speakers", "SPKL",
		"Mic Jack", "MICBIAS",
/* bench 26519.0.0 c7cb74322e82 */
/* bench 26519.0.1 ce537dad2ddb */
/* bench 26519.0.2 eb3c7e39ab77 */
/* bench 26519.0.3 05da23dc04b9 */
/* bench 26519.0.4 850b57dbcc2f */
/* bench 26519.0.5 354460c0e675 */
/* bench 26519.0.6 2d5a7784d524 */
/* bench 26519.0.7 62475d637ad9 */
/* bench 26519.0.8 2199fcda5de0 */
/* bench 26519.0.9 574979c2ced4 */
/* bench 12001.0.3 039a9bf3c158 */
/* bench 12001.0.4 5481ef201f1a */
/* bench 12001.0.5 6eb616ab7af8 */
/* bench 12001.0.6 4e76fe2244d7 */
/* bench 12001.0.7 8172a9244800 */
/* bench 12001.0.8 9dc9194a94c7 */
/* bench 12001.0.9 83e8f5fbed5a */
/* bench 12001.0.10 479e2513593f */
/* bench 12001.0.11 ef88f7baf4ef */
/* bench 12001.0.12 2e33a85e8bee */

/* bench 8821.1.0 7d642f4b86c6 */
/* bench 8821.1.1 ac6fc5c8df66 */
/* bench 8821.1.2 88c1d584c2de */
	nvidia,i2s-controller = <&tegra_i2s1>;
	nvidia,audio-codec = <&acodec>;

	clocks = <&tegra_car TEGRA124_CLK_PLL_A>,
		 <&tegra_car TEGRA124_CLK_PLL_A_OUT0>,
		 <&tegra_car TEGRA124_CLK_EXTERN1>;
	clock-names = "pll_a", "pll_a_out0", "mclk";
};
```

## Documentation/devicetree/bindings/sound/nvidia,tegra-audio-rt5640.txt
```
FASTVC-BENCH-CORPUS:linux-main-100k-v1-e0bd41dc-8e12-4f1b-978d-a3645ae59da0
NVIDIA Tegra audio complex, with RT5640 CODEC

Required properties:
- compatible : "nvidia,tegra-audio-rt5640"
- clocks : Must contain an entry for each entry in clock-names.
  See ../clocks/clock-bindings.txt for details.
- clock-names : Must include the following entries:
  - pll_a
  - pll_a_out0
  - mclk (The Tegra cdev1/extern1 clock, which feeds the CODEC's mclk)
- nvidia,model : The user-visible name of this sound complex.
- nvidia,audio-routing : A list of the connections between audio components.
  Each entry is a pair of strings, the first being the connection's sink,
  the second being the connection's source. Valid names for sources and
  sinks are the RT5640's pins (as documented in its binding), and the jacks
  on the board:

  * Headphones
  * Speakers
  * Mic Jack

- nvidia,i2s-controller : The phandle of the Tegra I2S controller that's
  connected to the CODEC.
- nvidia,audio-codec : The phandle of the RT5640 audio codec. This binding
  assumes that AIF1 on the CODEC is connected to Tegra.

Optional properties:
- nvidia,hp-det-gpios : The GPIO that detects headphones are plugged in

Example:

sound {
/* bench 5793.0.0 57dca38d914e */
/* bench 5793.0.1 a51bbb849bf5 */
/* bench 5793.0.2 45b79caf5c12 */
/* bench 5793.0.3 5db8319608ec */
/* bench 5793.0.4 64a96f08464a */
/* bench 5793.0.5 a59e54fa570e */
/* bench 5793.0.6 ed6a44baa06b */
/* bench 5793.0.7 f88575f07b7f */
/* bench 5793.0.8 ea320db86725 */
/* bench 17647.0.0 db7eb124ea80 */
/* bench 17647.0.1 72dd6becf45c */
/* bench 17647.0.2 5aedd358c6e9 */
/* bench 17647.0.3 8f5fb9fcc38f */
/* bench 17647.0.4 3825ced9bb8c */
/* bench 17647.0.5 bcabc76164b7 */
/* bench 17647.0.6 5cc4da2f922a */
/* bench 17647.0.7 0e8d18d7c5c4 */

	nvidia,audio-routing =
		"Headphones", "HPOR",
/* bench 19311.0.0 30f24d315c1b */
/* bench 19311.0.1 4d38a21485bd */
/* bench 19311.0.2 7f8b06dcdbcf */
/* bench 19311.0.3 71c4ef8a90db */
/* bench 19311.0.4 bc2f0208e378 */
/* bench 19311.0.5 e5312db28b62 */
/* bench 19311.0.6 303259ac59a9 */
/* bench 19311.0.7 a5b9df9f2f92 */
/* bench 19311.0.8 767ccb4af9d1 */
/* bench 19311.0.9 e49c3411acdd */
/* bench 19311.0.10 749b0eeffee5 */
/* bench 19311.0.11 8098970e3080 */
		"Headphones", "HPOL",
		"Speakers", "SPORP",
		"Speakers", "SPORN",
/* bench 20796.0.0 7e8ad5249f1f */
/* bench 20796.0.1 d5a7be0c31b8 */
/* bench 20796.0.2 7588a23ce76c */
/* bench 20796.0.3 9e11b21d89f6 */
/* bench 20796.0.4 ef4a5de6d067 */
/* bench 20796.0.5 510c905ad635 */
/* bench 20796.0.6 a347a47f5f09 */
	nvidia,i2s-controller = <&tegra_i2s1>;
	nvidia,audio-codec = <&rt5640>;

	nvidia,hp-det-gpios = <&gpio 143 0>; /* GPIO PR7 */

	clocks = <&tegra_car 216>, <&tegra_car 217>, <&tegra_car 120>;
	clock-names = "pll_a", "pll_a_out0", "mclk";
};
```

## Documentation/devicetree/bindings/sound/nvidia,tegra-audio-rt5677.txt
```
FASTVC-BENCH-CORPUS:linux-main-100k-v1-e0bd41dc-8e12-4f1b-978d-a3645ae59da0
NVIDIA Tegra audio complex, with RT5677 CODEC

Required properties:
- compatible : "nvidia,tegra-audio-rt5677"
- clocks : Must contain an entry for each entry in clock-names.
  See ../clocks/clock-bindings.txt for details.
- clock-names : Must include the following entries:
  - pll_a
  - pll_a_out0
  - mclk (The Tegra cdev1/extern1 clock, which feeds the CODEC's mclk)
- nvidia,model : The user-visible name of this sound complex.
- nvidia,audio-routing : A list of the connections between audio components.
  Each entry is a pair of strings, the first being the connection's sink,
  the second being the connection's source. Valid names for sources and
  sinks are the RT5677's pins (as documented in its binding), and the jacks
/* bench 24587.2.0 5684950a5650 */
/* bench 24587.2.1 28da18f328e7 */
/* bench 24587.2.2 940238f20576 */
/* bench 24587.2.3 d12ad4c3e84f */
/* bench 24587.2.4 fd48c3c5c04b */
/* bench 24587.2.5 a9d2d81467a5 */
/* bench 24587.2.6 7a54dca2d0af */
/* bench 24587.2.7 0c6d6d3c287c */
/* bench 24587.2.8 b83183d0ceb5 */
/* bench 24587.2.9 715a56955398 */
/* bench 24587.2.10 0cb0d3b5e54f */
/* bench 24587.2.11 09828aac3a46 */
/* bench 24587.2.12 b1822fce27f1 */
/* bench 24587.2.13 7a7e963a21dd */
/* bench 24587.2.14 ba6b62dbbe8b */

  * Headphone
  * Speaker
  * Headset Mic
  * Internal Mic 1
  * Internal Mic 2

- nvidia,i2s-controller : The phandle of the Tegra I2S controller that's
  connected to the CODEC.
- nvidia,audio-codec : The phandle of the RT5677 audio codec. This binding
  assumes that AIF1 on the CODEC is connected to Tegra.

Optional properties:
- nvidia,hp-det-gpios : The GPIO that detects headphones are plugged in
- nvidia,hp-en-gpios : The GPIO that enables headphone amplifier
- nvidia,mic-present-gpios: The GPIO that mic jack is plugged in
- nvidia,dmic-clk-en-gpios : The GPIO that gates DMIC clock signal

Example:

sound {
	compatible = "nvidia,tegra-audio-rt5677-ryu",
	        "nvidia,tegra-audio-rt5677";
	nvidia,model = "NVIDIA Tegra Ryu";

	nvidia,audio-routing =
		"Headphone", "LOUT2",
		"Headphone", "LOUT1",
		"Headset Mic", "MICBIAS1",
		"IN1P", "Headset Mic",
		"IN1N", "Headset Mic",
		"DMIC L1", "Internal Mic 1",
		"DMIC R1", "Internal Mic 1",
		"DMIC L2", "Internal Mic 2",
		"DMIC R2", "Internal Mic 2",
		"Speaker", "PDM1L",
		"Speaker", "PDM1R";

	nvidia,i2s-controller = <&tegra_i2s1>;
	nvidia,audio-codec = <&rt5677>;

	nvidia,hp-det-gpios = <&gpio TEGRA_GPIO(R, 7) GPIO_ACTIVE_HIGH>;
	nvidia,mic-present-gpios = <&gpio TEGRA_GPIO(O, 5) GPIO_ACTIVE_LOW>;
	nvidia,hp-en-gpios = <&rt5677 1 GPIO_ACTIVE_HIGH>;
	nvidia,dmic-clk-en-gpios = <&rt5677 2 GPIO_ACTIVE_HIGH>;

/* bench 1798.0.0 c0a6419809a1 */
/* bench 1798.0.1 cf747a93bb8f */
/* bench 1798.0.2 ef0d73b89bb0 */
/* bench 1798.0.3 5ac6e04d51ea */
/* bench 1798.0.4 b649fc1c7e10 */
/* bench 1798.0.5 b6153ba03535 */
	         <&tegra_car TEGRA124_CLK_EXTERN1>;
	clock-names = "pll_a", "pll_a_out0", "mclk";
};
```
