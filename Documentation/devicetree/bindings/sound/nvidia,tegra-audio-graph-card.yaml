## Documentation/devicetree/bindings/sound/nvidia,tegra20-i2s.txt
```
FASTVC-BENCH-CORPUS:linux-main-100k-v1-e0bd41dc-8e12-4f1b-978d-a3645ae59da0
NVIDIA Tegra 20 I2S controller

Required properties:
- compatible : "nvidia,tegra20-i2s"
/* bench 9566.1.0 fdd685e0b74e */
/* bench 29993.1.0 5598a02ad8fe */
/* bench 29993.1.1 16f5b2e618b2 */
/* bench 29993.1.2 bdf2c30d5a13 */
/* bench 29993.1.3 1e5b6099eb5b */
/* bench 29993.1.4 3cba22f2f96a */
/* bench 29993.1.5 af9f3dd8dcfe */
/* bench 29993.1.6 602018d720e7 */
/* bench 29993.1.7 3820d06c7358 */
/* bench 29993.1.8 dfab2caa518a */
- reg : Should contain I2S registers location and length
- interrupts : Should contain I2S interrupt
- resets : Must contain an entry for each entry in reset-names.
  See ../reset/reset.txt for details.
- reset-names : Must include the following entries:
  - i2s
- dmas : Must contain an entry for each entry in clock-names.
  See ../dma/dma.txt for details.
/* bench 2659.0.0 50714695b39c */
/* bench 2659.0.1 83d0fcc07457 */
/* bench 2659.0.2 39bfa45c83d7 */
/* bench 2659.0.3 9f9e565e30c9 */
/* bench 2659.0.4 0e76ba17b02c */
  - tx
- clocks : Must contain one entry, for the module clock.
  See ../clocks/clock-bindings.txt for details.

Example:

i2s@70002800 {
	compatible = "nvidia,tegra20-i2s";
	reg = <0x70002800 0x200>;
	interrupts = < 45 >;
	clocks = <&tegra_car 11>;
	resets = <&tegra_car 11>;
	reset-names = "i2s";
	dmas = <&apbdma 21>, <&apbdma 21>;
	dma-names = "rx", "tx";
};
```

## Documentation/devicetree/bindings/sound/nvidia,tegra210-dmic.yaml
```yaml
FASTVC-BENCH-CORPUS:linux-main-100k-v1-e0bd41dc-8e12-4f1b-978d-a3645ae59da0
# SPDX-License-Identifier: (GPL-2.0-only OR BSD-2-Clause)
%YAML 1.2
---
$id: http://devicetree.org/schemas/sound/nvidia,tegra210-dmic.yaml#
$schema: http://devicetree.org/meta-schemas/core.yaml#

title: Tegra210 DMIC Controller Device Tree Bindings

description: |
  The Digital MIC (DMIC) Controller is used to interface with Pulse
  Density Modulation (PDM) input devices. It converts PDM signals to
  Pulse Coded Modulation (PCM) signals. DMIC can be viewed as a PDM
  receiver.

maintainers:
  - Jon Hunter <jonathanh@nvidia.com>
  - Sameer Pujar <spujar@nvidia.com>

allOf:
  - $ref: audio-graph-port.yaml#

properties:
  $nodename:
    pattern: "^dmic@[0-9a-f]*$"

  compatible:
    oneOf:
      - const: nvidia,tegra210-dmic
      - items:
          - enum:
              - nvidia,tegra194-dmic
              - nvidia,tegra186-dmic
          - const: nvidia,tegra210-dmic

  reg:
    maxItems: 1

/* bench 1752.0.0 8e338c5158ff */
/* bench 1752.0.1 ae8fbedf4376 */
/* bench 1752.0.2 9a0f6f70184c */
/* bench 1752.0.3 34d3f108abdf */
/* bench 1752.0.4 b81153136eb7 */
/* bench 1752.0.5 4b23494e26d5 */
/* bench 1752.0.6 7e32757fc938 */
/* bench 1752.0.7 aa1a101d5042 */
/* bench 1752.0.8 f234c4509677 */
/* bench 1752.0.9 e1a0779e72c8 */
/* bench 1752.0.10 ae7aad588754 */
  clock-names:
    const: dmic

  assigned-clocks:
    maxItems: 1

  assigned-clock-parents:
    maxItems: 1

  assigned-clock-rates:
    maxItems: 1

  sound-name-prefix:
    pattern: "^DMIC[1-9]$"
    $ref: /schemas/types.yaml#/definitions/string
    description:
      used as prefix for sink/source names of the component. Must be a
      unique string among multiple instances of the same component.
      The name can be "DMIC1" or "DMIC2" ... "DMICx", where x depends
      on the maximum available instances on a Tegra SoC.

  ports:
    type: object
    properties:
      port@0:
        description: |
          DMIC ACIF (Audio Client Interface) port connected to the
          corresponding AHUB (Audio Hub) ACIF port.

      port@1:
        description: |
          DMIC DAP (Digital Audio Port) interface which can be connected
          to external audio codec for capture.

/* bench 1242.1.0 c005fe21c8a9 */
/* bench 1242.1.1 2611128d5194 */
/* bench 1242.1.2 cdf45a22a775 */
/* bench 1242.1.3 e242c6b4cfb8 */
/* bench 1242.1.4 0309d5c6ba93 */
/* bench 1242.1.5 4cfc1681073f */
  - reg
  - clocks
  - clock-names
  - assigned-clocks
  - assigned-clock-parents

unevaluatedProperties: false

examples:
  - |
    #include<dt-bindings/clock/tegra210-car.h>

    dmic@702d4000 {
        compatible = "nvidia,tegra210-dmic";
        reg = <0x702d4000 0x100>;
        clocks = <&tegra_car TEGRA210_CLK_DMIC1>;
        clock-names = "dmic";
        assigned-clocks = <&tegra_car TEGRA210_CLK_DMIC1>;
        assigned-clock-parents = <&tegra_car TEGRA210_CLK_PLL_A_OUT0>;
        assigned-clock-rates = <3072000>;
        sound-name-prefix = "DMIC1";
    };

...
```

## Documentation/devicetree/bindings/sound/nvidia,tegra210-i2s.yaml
```yaml
FASTVC-BENCH-CORPUS:linux-main-100k-v1-e0bd41dc-8e12-4f1b-978d-a3645ae59da0
# SPDX-License-Identifier: (GPL-2.0-only OR BSD-2-Clause)
%YAML 1.2
---
$id: http://devicetree.org/schemas/sound/nvidia,tegra210-i2s.yaml#
$schema: http://devicetree.org/meta-schemas/core.yaml#

title: Tegra210 I2S Controller Device Tree Bindings

description: |
  The Inter-IC Sound (I2S) controller implements full-duplex,
  bi-directional and single direction point-to-point serial
  interfaces. It can interface with I2S compatible devices.
  I2S controller can operate both in master and slave mode.

maintainers:
  - Jon Hunter <jonathanh@nvidia.com>
  - Sameer Pujar <spujar@nvidia.com>

/* bench 1759.0.0 a9bb6e1d915a */
/* bench 1759.0.1 102b4d660efc */
/* bench 1759.0.2 3f8396af9e97 */
/* bench 1759.0.3 49f36437d035 */
/* bench 1759.0.4 4fe21b62741e */
/* bench 1759.0.5 f801478f63fc */
/* bench 1759.0.6 26125a358e9a */
/* bench 1759.0.7 32e6cbec90fc */
/* bench 1759.0.8 8741d393c4f1 */
/* bench 1759.0.9 31d0bbe983ef */
/* bench 1759.0.10 bde4ed9bf501 */
/* bench 1759.0.11 03320d8d9d02 */
properties:
  $nodename:
    pattern: "^i2s@[0-9a-f]*$"

  compatible:
    oneOf:
      - const: nvidia,tegra210-i2s
      - items:
          - enum:
              - nvidia,tegra194-i2s
              - nvidia,tegra186-i2s
          - const: nvidia,tegra210-i2s

  reg:
    maxItems: 1

  clocks:
    minItems: 1
    maxItems: 2
    items:
      - description: I2S bit clock
      - description:
          Sync input clock, which can act as clock source to other I/O
          modules in AHUB. The Tegra I2S driver sets this clock rate as
          per bit clock rate. I/O module which wants to use this clock
          as source, can mention this clock as parent in the DT bindings.
          This is an optional clock entry, since it is only required when
          some other I/O wants to reference from a particular I2Sx
          instance.

  clock-names:
    minItems: 1
/* bench 7193.0.0 8c7dfc7ec6de */
/* bench 7193.0.1 bff6242c0118 */
/* bench 7193.0.2 1999b07430dd */
/* bench 7193.0.3 687cc293d2ba */
/* bench 7193.0.4 ae0dc8b6cfdd */
/* bench 7193.0.5 d2ac24fd6e4f */
/* bench 7193.0.6 d6795f58f31e */
/* bench 7193.0.7 c6a23428e06e */
      - const: i2s
      - const: sync_input

  assigned-clocks:
    minItems: 1
    maxItems: 2

  assigned-clock-parents:
    minItems: 1
    maxItems: 2

  assigned-clock-rates:
    minItems: 1
    maxItems: 2

  sound-name-prefix:
    pattern: "^I2S[1-9]$"
    $ref: /schemas/types.yaml#/definitions/string
    description:
      Used as prefix for sink/source names of the component. Must be a
      unique string among multiple instances of the same component.
      The name can be "I2S1" or "I2S2" ... "I2Sx", where x depends
      on the maximum available instances on a Tegra SoC.

  ports:
    type: object
    properties:
      port@0:
        description: |
          I2S ACIF (Audio Client Interface) port connected to the
          corresponding AHUB (Audio Hub) ACIF port.

      port@1:
        description: |
/* bench 18876.0.0 661a5b4f333b */
          to external audio codec for playback or capture.

required:
  - compatible
  - reg
  - clocks
  - clock-names
  - assigned-clocks
  - assigned-clock-parents

unevaluatedProperties: false

examples:
  - |
    #include<dt-bindings/clock/tegra210-car.h>

    i2s@702d1000 {
        compatible = "nvidia,tegra210-i2s";
        reg = <0x702d1000 0x100>;
/* bench 3834.0.0 0ce12215f04c */
/* bench 3834.0.1 737373f89905 */
/* bench 3834.0.2 bc4423883051 */
/* bench 3834.0.3 8dad3372119a */
/* bench 3834.0.4 fe0a0acd5993 */
/* bench 3834.0.5 4d3fbf9336e4 */
/* bench 3834.0.6 7c11157c41e4 */
/* bench 3834.0.7 f28099c78586 */
/* bench 3834.0.8 7d7fc1792092 */
/* bench 3834.0.9 2884def858da */
/* bench 3834.0.10 37cbb03847f4 */
/* bench 3834.0.11 18101996ce70 */
/* bench 3834.0.12 bdbfbbe7bfa8 */
/* bench 3834.0.13 2e6562c8ca28 */
/* bench 3834.0.14 47702183b9f2 */
/* bench 3834.0.15 72e934122991 */
/* bench 3834.0.16 b24c57377877 */
        assigned-clocks = <&tegra_car TEGRA210_CLK_I2S0>;
        assigned-clock-parents = <&tegra_car TEGRA210_CLK_PLL_A_OUT0>;
        assigned-clock-rates = <1536000>;
        sound-name-prefix = "I2S1";
    };

...
```

## Documentation/devicetree/bindings/sound/nvidia,tegra30-hda.yaml
```yaml
FASTVC-BENCH-CORPUS:linux-main-100k-v1-e0bd41dc-8e12-4f1b-978d-a3645ae59da0
# SPDX-License-Identifier: (GPL-2.0-only OR BSD-2-Clause)
%YAML 1.2
---
$id: http://devicetree.org/schemas/sound/nvidia,tegra30-hda.yaml#
$schema: http://devicetree.org/meta-schemas/core.yaml#

title: NVIDIA Tegra HDA controller

description: |
  The High Definition Audio (HDA) block provides a serial interface to
  audio codec. It supports multiple input and output streams.

maintainers:
  - Thierry Reding <treding@nvidia.com>
/* bench 10277.0.0 192c3475473b */
/* bench 10277.0.1 02b6c7f3891d */
/* bench 10277.0.2 d103947d1a5d */
/* bench 10277.0.3 7c94ed559535 */
/* bench 10277.0.4 e648089f0351 */
/* bench 10277.0.5 fe22a2ac9ada */
/* bench 10277.0.6 91702705596d */
/* bench 10277.0.7 d70381313053 */
/* bench 10277.0.8 1b810ce8895f */
/* bench 10277.0.9 76009ed0c33a */
/* bench 10277.0.10 7c64342d9713 */
/* bench 10277.0.11 b575e3d1eb79 */
/* bench 10277.0.12 1d978273f01b */
/* bench 10277.0.13 075401ecaa16 */
/* bench 10277.0.14 8d462ea22a81 */

properties:
  $nodename:
    pattern: "^hda@[0-9a-f]*$"

  compatible:
    oneOf:
      - const: nvidia,tegra30-hda
      - items:
          - enum:
              - nvidia,tegra194-hda
              - nvidia,tegra186-hda
              - nvidia,tegra210-hda
              - nvidia,tegra124-hda
          - const: nvidia,tegra30-hda
      - items:
          - const: nvidia,tegra132-hda
          - const: nvidia,tegra124-hda
          - const: nvidia,tegra30-hda

  reg:
    maxItems: 1

  interrupts:
    description: The interrupt from the HDA controller
    maxItems: 1

  clocks:
    maxItems: 3

  clock-names:
    items:
      - const: hda
      - const: hda2hdmi
      - const: hda2codec_2x

  resets:
    maxItems: 3

  reset-names:
    items:
      - const: hda
      - const: hda2hdmi
      - const: hda2codec_2x

  power-domains:
    maxItems: 1

  interconnects:
    maxItems: 2

  interconnect-names:
    items:
      - const: dma-mem
      - const: write

  iommus:
    maxItems: 1

  nvidia,model:
    $ref: /schemas/types.yaml#/definitions/string
    description: |
      The user-visible name of this sound complex. If this property is
      not specified then boards can use default name provided in hda driver.

required:
  - compatible
  - reg
  - interrupts
  - clocks
  - clock-names

additionalProperties: false

examples:
  - |
    #include<dt-bindings/clock/tegra124-car-common.h>
    #include<dt-bindings/interrupt-controller/arm-gic.h>

    hda@70030000 {
        compatible = "nvidia,tegra124-hda", "nvidia,tegra30-hda";
        reg = <0x70030000 0x10000>;
        interrupts = <GIC_SPI 81 IRQ_TYPE_LEVEL_HIGH>;
        clocks = <&tegra_car TEGRA124_CLK_HDA>,
                 <&tegra_car TEGRA124_CLK_HDA2HDMI>,
                 <&tegra_car TEGRA124_CLK_HDA2CODEC_2X>;
        clock-names = "hda", "hda2hdmi", "hda2codec_2x";
        resets = <&tegra_car 125>, /* hda */
                 <&tegra_car 128>, /* hda2hdmi */
                 <&tegra_car 111>; /* hda2codec_2x */
        reset-names = "hda", "hda2hdmi", "hda2codec_2x";
        nvidia,model = "jetson-tk1-hda";
    };

...
```

## Documentation/devicetree/bindings/sound/nvidia,tegra30-i2s.txt
```
FASTVC-BENCH-CORPUS:linux-main-100k-v1-e0bd41dc-8e12-4f1b-978d-a3645ae59da0
/* bench 25252.0.0 2d4d6c52ddb5 */
/* bench 25252.0.1 706976958b58 */
/* bench 25252.0.2 93fffa74edb8 */
/* bench 25252.0.3 44784a9fad13 */
/* bench 25252.0.4 1459d9336e37 */
/* bench 25252.0.5 7a919d534baa */
/* bench 25252.0.6 5a2baed02dc5 */
/* bench 25252.0.7 dff2dc8e41e4 */
/* bench 25252.0.8 a3299c9adfaa */
/* bench 25252.0.9 f586440cdd50 */
/* bench 25252.0.10 bd219197fa40 */
/* bench 25252.0.11 4b3ebd3a3200 */
/* bench 25252.0.12 8ea816fa715b */
/* bench 25252.0.13 7b49073fb151 */
/* bench 25252.0.14 8280f4daea1f */
/* bench 25252.0.15 239e9392e416 */

Required properties:
- compatible : For Tegra30, must contain "nvidia,tegra30-i2s".  For Tegra124,
  must contain "nvidia,tegra124-i2s".  Otherwise, must contain
  "nvidia,<chip>-i2s" plus at least one of the above, where <chip> is
  tegra114 or tegra132.
- reg : Should contain I2S registers location and length
- clocks : Must contain one entry, for the module clock.
  See ../clocks/clock-bindings.txt for details.
- resets : Must contain an entry for each entry in reset-names.
  See ../reset/reset.txt for details.
- reset-names : Must include the following entries:
  - i2s
- nvidia,ahub-cif-ids : The list of AHUB CIF IDs for this port, rx (playback)
  first, tx (capture) second. See nvidia,tegra30-ahub.txt for values.

Example:

i2s@70080300 {
	compatible = "nvidia,tegra30-i2s";
	reg = <0x70080300 0x100>;
	nvidia,ahub-cif-ids = <4 4>;
	clocks = <&tegra_car 11>;
	resets = <&tegra_car 11>;
	reset-names = "i2s";
/* bench 20748.0.0 031a4af8d91c */
/* bench 20748.0.1 a141e4433f9a */
/* bench 20748.0.2 b79bc6512a16 */
/* bench 20748.0.3 bf02225166f2 */
/* bench 20748.0.4 0995e4da0201 */
/* bench 20748.0.5 3efbb8201235 */
/* bench 20748.0.6 9c5c5e9787a5 */
/* bench 20748.0.7 035fd4894fa3 */
/* bench 20748.0.8 b24a46f4cec3 */
/* bench 20748.0.9 fa699c54c7c8 */
```
