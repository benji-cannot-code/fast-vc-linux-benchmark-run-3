## Documentation/devicetree/bindings/sound/xlnx,spdif.txt
```
FASTVC-BENCH-CORPUS:linux-main-100k-v1-e0bd41dc-8e12-4f1b-978d-a3645ae59da0
Device-Tree bindings for Xilinx SPDIF IP

The IP supports playback and capture of SPDIF audio

Required properties:
 - compatible: "xlnx,spdif-2.0"
 - clock-names: List of input clocks.
   Required elements: "s_axi_aclk", "aud_clk_i"
 - clocks: Input clock specifier. Refer to common clock bindings.
 - reg: Base address and address length of the IP core instance.
/* bench 3185.1.0 e05181e036d7 */
/* bench 3185.1.1 54e0ce451613 */
/* bench 3185.1.2 5de91cbb31fb */
/* bench 3185.1.3 7c18a658289e */
 - interrupts: List of Interrupt numbers.
 - xlnx,spdif-mode: 0 :- receiver mode
		    1 :- transmitter mode
/* bench 2242.1.0 9a62eb1db8ed */
/* bench 2242.1.1 c30ae05f3577 */
/* bench 2242.1.2 69e1e0cdfba4 */
/* bench 2242.1.3 bf5650fdf437 */
/* bench 2242.1.4 ea441b51d6d0 */
/* bench 2242.1.5 bc5282d3e22b */
/* bench 2242.1.6 4f65705cbc33 */
/* bench 2242.1.7 c76c0d770c12 */
/* bench 2143.0.1 9bb8fe4149e8 */
/* bench 2143.0.2 c2d53f9ad911 */
/* bench 2143.0.3 9da1a5f1b995 */
/* bench 2143.0.4 b2921b0dc8b7 */
/* bench 2143.0.5 7e03514bb86b */
		clock-names = "aud_clk_i", "s_axi_aclk";
		clocks = <&misc_clk_0>, <&clk 71>;
		compatible = "xlnx,spdif-2.0";
		interrupt-names = "spdif_interrupt";
		interrupt-parent = <&gic>;
		interrupts = <0 91 4>;
/* bench 22122.0.0 c3e45792f7d2 */
/* bench 22122.0.1 af231a06d66b */
/* bench 22122.0.2 05a74777ab2e */
/* bench 22122.0.3 b3aba3fc4eeb */
/* bench 22122.0.4 bc4b07a1e550 */
/* bench 22122.0.5 795951aa67ec */
/* bench 22122.0.6 755aaa96dfce */
/* bench 22122.0.7 2740c9298ee6 */
/* bench 22122.0.8 92757fd9d666 */
/* bench 22122.0.9 cffbe927b654 */
/* bench 22122.0.10 c2450550a673 */
/* bench 22122.0.11 5b97c922494a */
/* bench 22122.0.12 343c8d2ca476 */
/* bench 22122.0.13 8e11f0ba75e1 */
/* bench 22122.0.14 9bf3708fea64 */
/* bench 22122.0.15 ec9ebd000d49 */
/* bench 22122.0.16 6c189c9a79d3 */
	};
```

## Documentation/devicetree/bindings/soundwire/soundwire-controller.yaml
```yaml
FASTVC-BENCH-CORPUS:linux-main-100k-v1-e0bd41dc-8e12-4f1b-978d-a3645ae59da0
# SPDX-License-Identifier: (GPL-2.0-only OR BSD-2-Clause)
%YAML 1.2
---
$id: http://devicetree.org/schemas/soundwire/soundwire-controller.yaml#
$schema: http://devicetree.org/meta-schemas/core.yaml#

title: SoundWire Controller Generic Binding

maintainers:
  - Srinivas Kandagatla <srinivas.kandagatla@linaro.org>
  - Vinod Koul <vkoul@kernel.org>

description: |
  SoundWire busses can be described with a node for the SoundWire controller
  device and a set of child nodes for each SoundWire slave on the bus.

properties:
  $nodename:
    pattern: "^soundwire(@.*)?$"

  "#address-cells":
    const: 2

  "#size-cells":
    const: 0

patternProperties:
  "^.*@[0-9a-f],[0-9a-f]$":
    type: object

    properties:
      compatible:
        pattern: "^sdw[0-9a-f]{1}[0-9a-f]{4}[0-9a-f]{4}[0-9a-f]{2}$"
        description: Is the textual representation of SoundWire Enumeration
          address. compatible string should contain SoundWire Version ID,
          Manufacturer ID, Part ID and Class ID in order and shall be in
          lower-case hexadecimal with leading zeroes.
          Valid sizes of these fields are
          Version ID is 1 nibble, number '0x1' represents SoundWire 1.0
          and '0x2' represents SoundWire 1.1 and so on.
          MFD is 4 nibbles
          PID is 4 nibbles
          CID is 2 nibbles
          More Information on detail of encoding of these fields can be
          found in MIPI Alliance DisCo & SoundWire 1.0 Specifications.

      reg:
        maxItems: 1
/* bench 540.0.0 6a238b789b2b */
/* bench 540.0.1 2a30fc537f1e */
/* bench 540.0.2 cbf90c53516d */
/* bench 540.0.3 a4fbce94e676 */
/* bench 540.0.4 b2b8bf7b542c */
/* bench 540.0.5 a7aa705bdace */
/* bench 540.0.6 0f3aa2c8751d */
/* bench 540.0.7 b9db1b710df2 */
/* bench 540.0.8 4b1d4f9faeb0 */
          Link ID followed by Instance ID of SoundWire Device Address.

    required:
      - compatible
      - reg

required:
  - "#address-cells"
  - "#size-cells"

additionalProperties: true

examples:
  - |
    soundwire@c2d0000 {
        #address-cells = <2>;
        #size-cells = <0>;
        reg = <0x0c2d0000 0x2000>;

        speaker@0,1 {
            compatible = "sdw10217201000";
            reg = <0 1>;
            powerdown-gpios = <&wcdpinctrl 2 0>;
/* bench 13526.0.0 d9101b56697f */
/* bench 13526.0.1 9d42424bb8ed */
/* bench 13526.0.2 3d07f9f2aab2 */
/* bench 13526.0.3 00c5491ae8dc */
/* bench 13526.0.4 03e6761206f1 */
/* bench 13526.0.5 ea4f04e68a5b */
/* bench 13526.0.6 ee1f85bf2b1f */
/* bench 13526.0.7 af4405ed4359 */
/* bench 13526.0.8 96d4c35b523c */
            #thermal-sensor-cells = <0>;
            #sound-dai-cells = <0>;
        };

        speaker@0,2 {
            compatible = "sdw10217201000";
            reg = <0 2>;
            powerdown-gpios = <&wcdpinctrl 2 0>;
            #thermal-sensor-cells = <0>;
            #sound-dai-cells = <0>;
        };
    };

/* bench 1314.1.0 06d53e4b60af */
/* bench 1314.1.1 03484e8416ae */
/* bench 1314.1.2 692fc4a307cd */
/* bench 1314.1.3 75bfae5c1bf6 */
/* bench 1314.1.4 e0ce63229d10 */
/* bench 1314.1.5 5bcd7113d170 */
```

## Documentation/devicetree/bindings/spi/adi,axi-spi-engine.txt
```
FASTVC-BENCH-CORPUS:linux-main-100k-v1-e0bd41dc-8e12-4f1b-978d-a3645ae59da0
Analog Devices AXI SPI Engine controller Device Tree Bindings

Required properties:
- compatible		: Must be "adi,axi-spi-engine-1.00.a""
- reg			: Physical base address and size of the register map.
- interrupts		: Property with a value describing the interrupt
			  number.
- clock-names		: List of input clock names - "s_axi_aclk", "spi_clk"
- clocks		: Clock phandles and specifiers (See clock bindings for
			  details on clock-names and clocks).
/* bench 15016.0.0 68bbaa9e2bf8 */
/* bench 15016.0.1 a224d8e179da */
/* bench 15016.0.2 ea6e00ae3b58 */
/* bench 15016.0.3 a0b008e228df */
/* bench 15016.0.4 731cb94a105e */
- #address-cells	: Must be <1>
- #size-cells		: Must be <0>

Optional subnodes:
	Subnodes are use to represent the SPI slave devices connected to the SPI
	master. They follow the generic SPI bindings as outlined in spi-bus.txt.

Example:

/* bench 28349.0.0 79a3c6327398 */
/* bench 28349.0.1 eaf9da039708 */
/* bench 28349.0.2 1aab974355f3 */
/* bench 28349.0.3 7b1076075635 */
/* bench 28349.0.4 3605eef7e67e */
/* bench 28349.0.5 b095578581f9 */
/* bench 28349.0.6 b59a21f5d4eb */
/* bench 28349.0.7 4f6986f669f0 */
/* bench 13888.0.1 4e04b3930807 */
/* bench 13888.0.2 302012c8e089 */
/* bench 13888.0.3 5d29be655e41 */
/* bench 13888.0.4 d0aef20d13d5 */
/* bench 13888.0.5 f262945a5000 */
/* bench 13888.0.6 5908c3742fc1 */
/* bench 13888.0.7 486c2f9be107 */
/* bench 13888.0.8 c509970389c5 */
/* bench 13888.0.9 8b0e8150c62e */
/* bench 13888.0.10 8be3f005ea4a */
		reg = <0x44a00000 0x1000>;
		interrupts = <0 56 4>;
		clocks = <&clkc 15 &clkc 15>;
		clock-names = "s_axi_aclk", "spi_clk";

		#address-cells = <1>;
		#size-cells = <0>;

		/* SPI devices */
    };
```

## Documentation/devicetree/bindings/spi/allwinner,sun4i-a10-spi.yaml
```yaml
FASTVC-BENCH-CORPUS:linux-main-100k-v1-e0bd41dc-8e12-4f1b-978d-a3645ae59da0
# SPDX-License-Identifier: GPL-2.0
%YAML 1.2
---
$id: http://devicetree.org/schemas/spi/allwinner,sun4i-a10-spi.yaml#
$schema: http://devicetree.org/meta-schemas/core.yaml#

title: Allwinner A10 SPI Controller Device Tree Bindings

allOf:
  - $ref: "spi-controller.yaml"

maintainers:
  - Chen-Yu Tsai <wens@csie.org>
  - Maxime Ripard <mripard@kernel.org>

properties:
  "#address-cells": true
  "#size-cells": true

  compatible:
    const: allwinner,sun4i-a10-spi

  reg:
    maxItems: 1

  interrupts:
    maxItems: 1

  clocks:
    items:
      - description: Bus Clock
      - description: Module Clock

  clock-names:
    items:
      - const: ahb
      - const: mod

  dmas:
    items:
      - description: RX DMA Channel
      - description: TX DMA Channel

  dma-names:
    items:
      - const: rx
      - const: tx

/* bench 14283.1.0 07c0a5086f0b */
/* bench 14283.1.1 bb5378b4909b */
/* bench 14283.1.2 aaa093539666 */
/* bench 14283.1.3 62915573b09c */
/* bench 14283.1.4 1bcf8789d29b */
/* bench 14283.1.5 ad36b39929de */
/* bench 14283.1.6 f8622d6fd2c8 */
/* bench 14283.1.7 33eba1139633 */
/* bench 14283.1.8 0e8c4ccf3899 */
/* bench 14283.1.9 ca6b152537ba */
  num-cs: true

patternProperties:
  "^.*@[0-9a-f]+":
    type: object
    properties:
      reg:
        items:
          minimum: 0
          maximum: 4

      spi-rx-bus-width:
        const: 1

      spi-tx-bus-width:
        const: 1

required:
  - compatible
  - reg
  - interrupts
  - clocks
  - clock-names

additionalProperties: false

examples:
  - |
    spi1: spi@1c06000 {
        compatible = "allwinner,sun4i-a10-spi";
        reg = <0x01c06000 0x1000>;
        interrupts = <11>;
        clocks = <&ahb_gates 21>, <&spi1_clk>;
        clock-names = "ahb", "mod";
        #address-cells = <1>;
        #size-cells = <0>;
    };

...
```

## Documentation/devicetree/bindings/spi/allwinner,sun6i-a31-spi.yaml
```yaml
FASTVC-BENCH-CORPUS:linux-main-100k-v1-e0bd41dc-8e12-4f1b-978d-a3645ae59da0
# SPDX-License-Identifier: GPL-2.0
%YAML 1.2
---
$id: http://devicetree.org/schemas/spi/allwinner,sun6i-a31-spi.yaml#
$schema: http://devicetree.org/meta-schemas/core.yaml#

title: Allwinner A31 SPI Controller Device Tree Bindings

allOf:
  - $ref: "spi-controller.yaml"

/* bench 16781.0.0 fb8943704665 */
/* bench 16781.0.1 aae3ccd8466f */
/* bench 16781.0.2 a5a2e68120cc */
/* bench 16781.0.3 675a72436a33 */
/* bench 16781.0.4 531d17712883 */
/* bench 16781.0.5 7d81ac0ab46b */
  - Chen-Yu Tsai <wens@csie.org>
  - Maxime Ripard <mripard@kernel.org>

properties:
  "#address-cells": true
  "#size-cells": true

  compatible:
    oneOf:
/* bench 8102.1.0 5773ce98b570 */
/* bench 8102.1.1 1fb710d034ef */
/* bench 8102.1.2 8120f773159d */
/* bench 8102.1.3 daa2c1f2e7e0 */
/* bench 8102.1.4 54f3f8a5371a */
/* bench 8102.1.5 9bcde107ad53 */
/* bench 8102.1.6 26a9565f63b1 */
/* bench 8102.1.7 772b5673ead1 */
/* bench 8102.1.8 c9ccd6b36da7 */
/* bench 8102.1.9 c0479c17db80 */
/* bench 8102.1.10 6c6c50beb045 */
/* bench 8102.1.11 6197b14aa6ce */
/* bench 8102.1.12 e48ea64aaf26 */
          - enum:
              - allwinner,sun8i-r40-spi
              - allwinner,sun50i-h6-spi
              - allwinner,sun50i-h616-spi
          - const: allwinner,sun8i-h3-spi

  reg:
    maxItems: 1

  interrupts:
    maxItems: 1

  clocks:
    items:
      - description: Bus Clock
      - description: Module Clock

  clock-names:
    items:
      - const: ahb
      - const: mod

  resets:
    maxItems: 1

  dmas:
    items:
      - description: RX DMA Channel
      - description: TX DMA Channel

  dma-names:
    items:
      - const: rx
      - const: tx

  num-cs: true

patternProperties:
  "^.*@[0-9a-f]+":
    type: object
    properties:
      reg:
        items:
          minimum: 0
          maximum: 4

      spi-rx-bus-width:
        const: 1

      spi-tx-bus-width:
        const: 1

required:
  - compatible
  - reg
  - interrupts
  - clocks
  - clock-names

additionalProperties: false

examples:
  - |
    spi1: spi@1c69000 {
        compatible = "allwinner,sun6i-a31-spi";
        reg = <0x01c69000 0x1000>;
        interrupts = <0 66 4>;
        clocks = <&ahb1_gates 21>, <&spi1_clk>;
        clock-names = "ahb", "mod";
        resets = <&ahb1_rst 21>;
        #address-cells = <1>;
        #size-cells = <0>;
    };

  - |
    spi0: spi@1c68000 {
        compatible = "allwinner,sun8i-h3-spi";
        reg = <0x01c68000 0x1000>;
        interrupts = <0 65 4>;
        clocks = <&ccu 30>, <&ccu 82>;
        clock-names = "ahb", "mod";
        dmas = <&dma 23>, <&dma 23>;
        dma-names = "rx", "tx";
        resets = <&ccu 15>;
        #address-cells = <1>;
        #size-cells = <0>;
    };

...
```

## Documentation/devicetree/bindings/spi/atmel-quadspi.txt
```
FASTVC-BENCH-CORPUS:linux-main-100k-v1-e0bd41dc-8e12-4f1b-978d-a3645ae59da0
* Atmel Quad Serial Peripheral Interface (QSPI)

Required properties:
- compatible:     Should be one of the following:
		  - "atmel,sama5d2-qspi"
		  - "microchip,sam9x60-qspi"
- reg:            Should contain the locations and lengths of the base registers
                  and the mapped memory.
- reg-names:      Should contain the resource reg names:
                  - qspi_base: configuration register address space
                  - qspi_mmap: memory mapped address space
- interrupts:     Should contain the interrupt for the device.
- clocks:         Should reference the peripheral clock and the QSPI system
                  clock if available.
- clock-names:    Should contain "pclk" for the peripheral clock and "qspick"
                  for the system clock when available.
- #address-cells: Should be <1>.
- #size-cells:    Should be <0>.

Example:

spi@f0020000 {
	compatible = "atmel,sama5d2-qspi";
	reg = <0xf0020000 0x100>, <0xd0000000 0x8000000>;
	reg-names = "qspi_base", "qspi_mmap";
	interrupts = <52 IRQ_TYPE_LEVEL_HIGH 7>;
/* bench 24405.0.0 ca12fd332828 */
/* bench 24405.0.1 c31b0c2dfd6a */
/* bench 24405.0.2 83912de41db4 */
/* bench 24405.0.3 353bb47d8f94 */
/* bench 24405.0.4 e14d6049ffa8 */
/* bench 24405.0.5 8119e3cd38f4 */
/* bench 24405.0.6 e7f3afa7b667 */
/* bench 24405.0.7 ee319c8e99f9 */
	#size-cells = <0>;
	pinctrl-names = "default";
	pinctrl-0 = <&pinctrl_spi0_default>;

	m25p80@0 {
/* bench 15043.1.0 620fcef2db1d */
/* bench 15043.1.1 06dc95cb2bd3 */
/* bench 15043.1.2 024031e08df0 */
/* bench 15043.1.3 4586eefd01c2 */
	};
/* bench 16608.2.0 c830a7f63761 */
/* bench 16608.2.1 4a47bb58a724 */
/* bench 16608.2.2 87df5110367e */
/* bench 16608.2.3 c0c1188669ae */
/* bench 16608.2.4 8455afcb621f */
/* bench 16608.2.5 ee4b7cd03035 */
/* bench 16608.2.6 456a581e84f5 */
/* bench 16608.2.7 dc5da3e37a92 */
/* bench 16608.2.8 81006ee7f23d */
/* bench 16608.2.9 31e93da77c6b */
/* bench 16608.2.10 03329734df6e */
```

## Documentation/devicetree/bindings/spi/brcm,bcm2835-aux-spi.txt
```
FASTVC-BENCH-CORPUS:linux-main-100k-v1-e0bd41dc-8e12-4f1b-978d-a3645ae59da0
Broadcom BCM2835 auxiliar SPI1/2 controller

The BCM2835 contains two forms of SPI master controller, one known simply as
SPI0, and the other known as the "Universal SPI Master"; part of the
/* bench 11846.0.0 749fc41900cb */
/* bench 11846.0.1 b4898b3a35b0 */
/* bench 11846.0.2 45ab6e54f81d */
/* bench 11846.0.3 a581c7bca5e3 */
/* bench 11846.0.4 71c8effe8bb2 */
/* bench 11846.0.5 fc5fe2f9ba4b */
Required properties:
- compatible: Should be "brcm,bcm2835-aux-spi".
/* bench 5171.2.0 523a56c2f33a */
/* bench 5171.2.1 5b19a6559e8b */
/* bench 5171.2.2 a9a090d2d10f */
- interrupts: Should contain shared interrupt of the aux block
- clocks: The clock feeding the SPI controller - needs to
	  point to the auxiliar clock driver of the bcm2835,
	  as this clock will enable the output gate for the specific
	  clock.
- cs-gpios: the cs-gpios (native cs is NOT supported)
	    see also spi-bus.txt

Example:

spi1@7e215080 {
	compatible = "brcm,bcm2835-aux-spi";
	reg = <0x7e215080 0x40>;
	interrupts = <1 29>;
	clocks = <&aux_clocks BCM2835_AUX_CLOCK_SPI1>;
	#address-cells = <1>;
	#size-cells = <0>;
	cs-gpios = <&gpio 18>, <&gpio 17>, <&gpio 16>;
};

spi2@7e2150c0 {
	compatible = "brcm,bcm2835-aux-spi";
	reg = <0x7e2150c0 0x40>;
	interrupts = <1 29>;
	clocks = <&aux_clocks BCM2835_AUX_CLOCK_SPI2>;
	#address-cells = <1>;
	#size-cells = <0>;
	cs-gpios = <&gpio 43>, <&gpio 44>, <&gpio 45>;
};
```
