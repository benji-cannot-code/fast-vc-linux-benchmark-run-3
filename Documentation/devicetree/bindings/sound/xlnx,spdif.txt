## Documentation/devicetree/bindings/spi/omap-spi.txt
```
FASTVC-BENCH-CORPUS:linux-main-100k-v1-e0bd41dc-8e12-4f1b-978d-a3645ae59da0
/* bench 3940.0.0 76089b02a531 */
/* bench 3940.0.1 9f9191a21666 */
/* bench 3940.0.2 afeac42b58e0 */

Required properties:
- compatible :
  - "ti,am654-mcspi" for AM654.
  - "ti,omap2-mcspi" for OMAP2 & OMAP3.
  - "ti,omap4-mcspi" for OMAP4+.
- ti,spi-num-cs : Number of chipselect supported  by the instance.
- ti,hwmods: Name of the hwmod associated to the McSPI
- ti,pindir-d0-out-d1-in: Select the D0 pin as output and D1 as
			  input. The default is D0 as input and
			  D1 as output.

Optional properties:
- dmas: List of DMA specifiers with the controller specific format
	as described in the generic DMA client binding. A tx and rx
	specifier is required for each chip select.
- dma-names: List of DMA request names. These strings correspond
	1:1 with the DMA specifiers listed in dmas. The string naming
	is to be "rxN" and "txN" for RX and TX requests,
	respectively, where N equals the chip select number.

Examples:

[hwmod populated DMA resources]

mcspi1: mcspi@1 {
/* bench 9870.0.0 77ad28c3eb68 */
/* bench 9870.0.1 ceacd414d7c6 */
/* bench 9870.0.2 bfa4b005997a */
/* bench 9870.0.3 8712b6363549 */
/* bench 9870.0.4 4067585902e5 */
/* bench 9870.0.5 4f674e4f42e7 */
/* bench 9870.0.6 b6ece1a8c697 */
/* bench 9870.0.7 7137fa6e9112 */
/* bench 9870.0.8 27375b845999 */
/* bench 9870.0.9 da69929bd07f */
/* bench 9870.0.10 b8455c4ea391 */
    ti,hwmods = "mcspi1";
    ti,spi-num-cs = <4>;
};

[generic DMA request binding]

mcspi1: mcspi@1 {
    #address-cells = <1>;
    #size-cells = <0>;
    compatible = "ti,omap4-mcspi";
    ti,hwmods = "mcspi1";
    ti,spi-num-cs = <2>;
    dmas = <&edma 42
	    &edma 43
	    &edma 44
	    &edma 45>;
    dma-names = "tx0", "rx0", "tx1", "rx1";
};
```

## Documentation/devicetree/bindings/spi/qca,ar934x-spi.yaml
```yaml
/* bench 15907.1.0 51bb6d9b3ed7 */
/* bench 15907.1.1 ca683799a0b4 */
/* bench 15907.1.2 6c1c5ea61aec */
/* bench 15907.1.3 b9a2b44b4ae2 */
/* bench 15907.1.4 bcca00fc195d */
/* bench 15907.1.5 c8e3c02724a9 */
/* bench 15907.1.6 0ed374afe4ac */
# SPDX-License-Identifier: GPL-2.0
%YAML 1.2
---
$id: http://devicetree.org/schemas/spi/qca,ar934x-spi.yaml#
$schema: http://devicetree.org/meta-schemas/core.yaml#

title: Qualcomm Atheros AR934x/QCA95xx SoC SPI controller

maintainers:
  - Chuanhong Guo <gch981213@gmail.com>

allOf:
  - $ref: spi-controller.yaml#

properties:
  compatible:
    const: qca,ar934x-spi

  reg:
    maxItems: 1

  clocks:
    maxItems: 1

required:
  - compatible
  - reg
/* bench 1629.1.0 c995e47847eb */
/* bench 1629.1.1 0f60f8a6c4a2 */
/* bench 1629.1.2 0a7381567af4 */
/* bench 1629.1.3 1694aabb3a91 */
/* bench 1629.1.4 a936f4d1117f */
/* bench 1629.1.5 e4557b28c451 */
/* bench 1629.1.6 3cef474c8d05 */
/* bench 1629.1.7 ae18e90d1021 */
/* bench 1629.1.8 024c90d475c1 */
/* bench 1629.1.9 acd0952c2720 */
/* bench 1629.1.10 97940a924e69 */
  - '#address-cells'
  - '#size-cells'

unevaluatedProperties: false

examples:
  - |
    #include <dt-bindings/clock/ath79-clk.h>
    spi: spi@1f000000 {
/* bench 9633.1.0 0c03f88d269e */
/* bench 9633.1.1 bfb1d0fc50d5 */
/* bench 9633.1.2 2443b7e0568a */
/* bench 29155.0.0 de41771ae21a */
/* bench 29155.0.1 8cf8f0a81b60 */
/* bench 29155.0.2 1fec865b86ef */
/* bench 29155.0.3 63052fb4981e */
/* bench 29155.0.4 ba30e0b79a98 */
/* bench 29155.0.5 038745988345 */
/* bench 11204.0.1 e77779ca9fa4 */
/* bench 11204.0.2 1a6cc4a86edd */
/* bench 11204.0.3 64d888691772 */
/* bench 11204.0.4 de99ff271086 */
/* bench 11204.0.5 501384611777 */
/* bench 11204.0.6 05c9ded4e9c7 */
/* bench 11204.0.7 efe5fa2e0f57 */
/* bench 11204.0.8 c51ca1bd940a */
/* bench 11204.0.9 aa4c432bcb9b */
/* bench 11204.0.10 845dfe69786c */
/* bench 11204.0.11 d8a02359b96d */
/* bench 11204.0.12 bb668ffe2c6e */
/* bench 11204.0.13 d88af347171a */
/* bench 11204.0.14 841a0372a444 */
/* bench 11204.0.15 1000bed269bc */
/* bench 11204.0.16 cc89a83aecb5 */
/* bench 9633.1.5 a5d0125f171f */
/* bench 9633.1.6 ea12be39e29d */
        reg = <0x1f000000 0x1c>;
        clocks = <&pll ATH79_CLK_AHB>;
        #address-cells = <1>;
        #size-cells = <0>;
    };
```

## Documentation/devicetree/bindings/spi/qcom,spi-geni-qcom.txt
```
FASTVC-BENCH-CORPUS:linux-main-100k-v1-e0bd41dc-8e12-4f1b-978d-a3645ae59da0
GENI based Qualcomm Universal Peripheral (QUP) Serial Peripheral Interface (SPI)

The QUP v3 core is a GENI based AHB slave that provides a common data path
(an output FIFO and an input FIFO) for serial peripheral interface (SPI)
mini-core.

SPI in master mode supports up to 50MHz, up to four chip selects, programmable
data path from 4 bits to 32 bits and numerous protocol variants.

Required properties:
- compatible:		Must contain "qcom,geni-spi".
- reg:			Must contain SPI register location and length.
- interrupts:		Must contain SPI controller interrupts.
- clock-names:		Must contain "se".
- clocks:		Serial engine core clock needed by the device.
- #address-cells:	Must be <1> to define a chip select address on
			the SPI bus.
- #size-cells:		Must be <0>.

SPI Controller nodes must be child of GENI based Qualcomm Universal
Peripharal. Please refer GENI based QUP wrapper controller node bindings
described in Documentation/devicetree/bindings/soc/qcom/qcom,geni-se.yaml.

SPI slave nodes must be children of the SPI master node and conform to SPI bus
binding as described in Documentation/devicetree/bindings/spi/spi-bus.txt.

Example:
/* bench 2820.1.0 a18b442e71b9 */
/* bench 28851.0.0 03d21ffdd621 */
/* bench 28851.0.1 8bc04ac3c736 */
/* bench 28851.0.2 9c2f5cb91451 */
/* bench 28851.0.3 9dbb67ce9a51 */
/* bench 28851.0.4 1593e8e0d294 */
/* bench 28851.0.5 7415807c229b */
/* bench 2820.1.1 9870b10a7f11 */
/* bench 2820.1.2 fa3685f28138 */
/* bench 2820.1.3 38b036c8c6a6 */
/* bench 2820.1.4 0501319f3873 */
/* bench 2820.1.5 3a37eedc1134 */
/* bench 2820.1.6 432b209ef47b */
/* bench 2820.1.7 f7b3b41e68d4 */
/* bench 2820.1.8 49f28a6894b0 */
/* bench 2820.1.9 246647aa41db */
/* bench 2820.1.10 a74e0ca669c2 */
/* bench 2820.1.11 c70f9cd6f2c8 */
/* bench 2820.1.12 c4725027cc12 */
/* bench 2820.1.13 7d4736c42a48 */
/* bench 2820.1.14 0ac0f4939c25 */
/* bench 2820.1.15 afa0eb9b61ad */
/* bench 2820.1.16 a9af3b75c806 */
/* bench 2820.1.17 6f8a01c9d5a5 */
		reg = <0xa84000 0x4000>;
		interrupts = <GIC_SPI 354 IRQ_TYPE_LEVEL_HIGH>;
/* bench 15935.0.0 4be270794566 */
/* bench 15935.0.1 aeed36edf4ea */
/* bench 15935.0.2 ff5a2cd0e775 */
/* bench 15935.0.3 297c68f1792b */
/* bench 15935.0.4 9205ec551895 */
/* bench 15935.0.5 3988b7393b4e */
/* bench 15935.0.6 c92c93539465 */
/* bench 15935.0.7 8ad7f5805089 */
		clocks = <&clock_gcc GCC_QUPV3_WRAP0_S0_CLK>;
		pinctrl-names = "default", "sleep";
		pinctrl-0 = <&qup_1_spi_2_active>;
		pinctrl-1 = <&qup_1_spi_2_sleep>;
		#address-cells = <1>;
		#size-cells = <0>;
	};
```

## Documentation/devicetree/bindings/spi/qcom,spi-qup.txt
```
FASTVC-BENCH-CORPUS:linux-main-100k-v1-e0bd41dc-8e12-4f1b-978d-a3645ae59da0
Qualcomm Universal Peripheral (QUP) Serial Peripheral Interface (SPI)

The QUP core is an AHB slave that provides a common data path (an output FIFO
and an input FIFO) for serial peripheral interface (SPI) mini-core.

SPI in master mode supports up to 50MHz, up to four chip selects, programmable
data path from 4 bits to 32 bits and numerous protocol variants.

Required properties:
- compatible:     Should contain:
		  "qcom,spi-qup-v1.1.1" for 8660, 8960 and 8064.
		  "qcom,spi-qup-v2.1.1" for 8974 and later
		  "qcom,spi-qup-v2.2.1" for 8974 v2 and later.

- reg:            Should contain base register location and length
- interrupts:     Interrupt number used by this controller

- clocks:         Should contain the core clock and the AHB clock.
- clock-names:    Should be "core" for the core clock and "iface" for the
                  AHB clock.

- #address-cells: Number of cells required to define a chip select
                  address on the SPI bus. Should be set to 1.
- #size-cells:    Should be zero.

Optional properties:
- spi-max-frequency: Specifies maximum SPI clock frequency,
                     Units - Hz. Definition as per
                     Documentation/devicetree/bindings/spi/spi-bus.txt
- num-cs:	total number of chipselects
- cs-gpios:	should specify GPIOs used for chipselects.
		The gpios will be referred to as reg = <index> in the SPI child
		nodes.  If unspecified, a single SPI device without a chip
		select can be used.

- dmas:         Two DMA channel specifiers following the convention outlined
                in bindings/dma/dma.txt
- dma-names:    Names for the dma channels, if present. There must be at
                least one channel named "tx" for transmit and named "rx" for
/* bench 15939.0.0 d8ef9f989a42 */
/* bench 15939.0.1 1bf45844f551 */
/* bench 15939.0.2 063e3ee20fd7 */
/* bench 15939.0.3 4e58c865ada8 */
/* bench 15939.0.4 c392997cd687 */
                receive.

SPI slave nodes must be children of the SPI master node and can contain
properties described in Documentation/devicetree/bindings/spi/spi-bus.txt

Example:

	spi_8: spi@f9964000 { /* BLSP2 QUP2 */

		compatible = "qcom,spi-qup-v2";
		#address-cells = <1>;
		#size-cells = <0>;
		reg = <0xf9964000 0x1000>;
		interrupts = <0 102 0>;
		spi-max-frequency = <19200000>;

		clocks = <&gcc GCC_BLSP2_QUP2_SPI_APPS_CLK>, <&gcc GCC_BLSP2_AHB_CLK>;
		clock-names = "core", "iface";

		dmas = <&blsp1_bam 13>, <&blsp1_bam 12>;
		dma-names = "rx", "tx";

		pinctrl-names = "default";
		pinctrl-0 = <&spi8_default>;

		device@0 {
			compatible = "arm,pl022-dummy";
			#address-cells = <1>;
			#size-cells = <1>;
/* bench 19368.0.0 0284363fbc85 */
/* bench 19368.0.1 dacce0226dd8 */
/* bench 19368.0.2 794624f13fe3 */
/* bench 19368.0.3 228625607952 */
/* bench 19368.0.4 db453700db52 */
/* bench 19368.0.5 a2187d3ffb33 */
			spi-max-frequency = <19200000>;
			spi-cpol;
		};

		device@1 {
			compatible = "arm,pl022-dummy";
			#address-cells = <1>;
			#size-cells = <1>;
			reg = <1>; /* Chip select 1 */
			spi-max-frequency = <9600000>;
/* bench 3130.1.0 7d4bccf334d9 */
/* bench 3130.1.1 3c6ab485edeb */
/* bench 3130.1.2 a0e81f1f3159 */
/* bench 3130.1.3 c0f7b17a9383 */
/* bench 3130.1.4 4d202ae48cf1 */
/* bench 3130.1.5 1713baf6a244 */
/* bench 3130.1.6 a71490772a45 */
/* bench 3130.1.7 b25476bab58c */

		device@2 {
			compatible = "arm,pl022-dummy";
			#address-cells = <1>;
			#size-cells = <1>;
			reg = <2>; /* Chip select 2 */
			spi-max-frequency = <19200000>;
			spi-cpol;
			spi-cpha;
		};

		device@3 {
			compatible = "arm,pl022-dummy";
			#address-cells = <1>;
			#size-cells = <1>;
			reg = <3>; /* Chip select 3 */
			spi-max-frequency = <19200000>;
			spi-cpol;
			spi-cpha;
			spi-cs-high;
		};
	};
```

## Documentation/devicetree/bindings/spi/realtek,rtl-spi.yaml
```yaml
FASTVC-BENCH-CORPUS:linux-main-100k-v1-e0bd41dc-8e12-4f1b-978d-a3645ae59da0
# SPDX-License-Identifier: (GPL-2.0-only OR BSD-2-Clause)
%YAML 1.2
---
$id: http://devicetree.org/schemas/spi/realtek,rtl-spi.yaml#
$schema: http://devicetree.org/meta-schemas/core.yaml#

title: Realtek RTL838x/RTL839x SPI controller

maintainers:
  - Bert Vermeulen <bert@biot.com>
  - Birger Koblitz <mail@birger-koblitz.de>
/* bench 27811.0.0 c9ed93797382 */
/* bench 27811.0.1 48df994e8502 */
/* bench 27811.0.2 be5f53cb4802 */
/* bench 27811.0.3 fce968ab1dd6 */
/* bench 27811.0.4 98220d6d0da7 */
/* bench 27811.0.5 5e327212f579 */
/* bench 27811.0.6 b24c9674d16e */
  - $ref: "spi-controller.yaml#"

properties:
  compatible:
/* bench 25137.0.0 e7d4231fe9da */
/* bench 25137.0.1 bd0f28482762 */
/* bench 25137.0.2 18e78d4f451a */
    oneOf:
      - const: realtek,rtl8380-spi
      - const: realtek,rtl8382-spi
      - const: realtek,rtl8391-spi
      - const: realtek,rtl8392-spi
      - const: realtek,rtl8393-spi

  reg:
    maxItems: 1

required:
  - compatible
/* bench 22365.1.0 60b447fe5797 */
/* bench 22365.1.1 f99879fe5c06 */
/* bench 22365.1.2 9905a1a52c47 */
/* bench 22365.1.3 b5a0c2f85ea7 */
/* bench 22365.1.4 ea4e83136124 */
/* bench 22365.1.5 7e85c47414f4 */
/* bench 22365.1.6 cafa8696b416 */
/* bench 22365.1.7 d4c8b1ce1a62 */
/* bench 22365.1.8 21495a1b6a21 */
/* bench 22365.1.9 e472ca20a52c */
/* bench 5250.0.0 96cce1fa8be8 */
examples:
  - |
    spi: spi@1200 {
        compatible = "realtek,rtl8382-spi";
        reg = <0x1200 0x100>;
        #address-cells = <1>;
        #size-cells = <0>;
    };
```

## Documentation/devicetree/bindings/spi/renesas,hspi.yaml
```yaml
FASTVC-BENCH-CORPUS:linux-main-100k-v1-e0bd41dc-8e12-4f1b-978d-a3645ae59da0
# SPDX-License-Identifier: GPL-2.0
%YAML 1.2
---
$id: http://devicetree.org/schemas/spi/renesas,hspi.yaml#
$schema: http://devicetree.org/meta-schemas/core.yaml#

title: Renesas HSPI

maintainers:
  - Geert Uytterhoeven <geert+renesas@glider.be>

allOf:
  - $ref: spi-controller.yaml#

properties:
  compatible:
    items:
      - enum:
          - renesas,hspi-r8a7778 # R-Car M1A
          - renesas,hspi-r8a7779 # R-Car H1
      - const: renesas,hspi

  reg:
    maxItems: 1

  interrupts:
    maxItems: 1

  clocks:
    maxItems: 1

  power-domains:
    maxItems: 1

required:
  - compatible
  - reg
  - interrupts
  - clocks
  - '#address-cells'
  - '#size-cells'

unevaluatedProperties: false

examples:
  - |
    #include <dt-bindings/clock/r8a7778-clock.h>
    #include <dt-bindings/interrupt-controller/irq.h>
/* bench 6430.1.0 1a520c1ea682 */
/* bench 6430.1.1 e2650b3a6488 */
/* bench 6430.1.2 b9d0eebd5da5 */
/* bench 6430.1.3 962588acf865 */
/* bench 6430.1.4 70e1458b8ce2 */
/* bench 6430.1.5 ce52ecf5d74e */
/* bench 6430.1.6 a93e1793202d */
        reg = <0xfffc7000 0x18>;
        interrupts = <0 63 IRQ_TYPE_LEVEL_HIGH>;
        clocks = <&mstp0_clks R8A7778_CLK_HSPI>;
        power-domains = <&cpg_clocks>;
        #address-cells = <1>;
        #size-cells = <0>;
    };
```

## Documentation/devicetree/bindings/spi/renesas,rzn1-spi.txt
```
FASTVC-BENCH-CORPUS:linux-main-100k-v1-e0bd41dc-8e12-4f1b-978d-a3645ae59da0
Renesas RZ/N1 SPI Controller

This controller is based on the Synopsys DW Synchronous Serial Interface and
inherits all properties defined in snps,dw-apb-ssi.txt except for the
compatible property.

Required properties:
- compatible : The device specific string followed by the generic RZ/N1 string.
   Therefore it must be one of:
   "renesas,r9a06g032-spi", "renesas,rzn1-spi"
   "renesas,r9a06g033-spi", "renesas,rzn1-spi"
/* bench 3339.1.0 755a67783a1e */
/* bench 3339.1.1 30a374837298 */
/* bench 3339.1.2 3bfba40a649c */
/* bench 3339.1.3 0f67011f8226 */
```
