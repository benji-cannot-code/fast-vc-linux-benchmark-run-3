## Documentation/devicetree/bindings/spi/brcm,bcm2835-spi.txt
```
FASTVC-BENCH-CORPUS:linux-main-100k-v1-e0bd41dc-8e12-4f1b-978d-a3645ae59da0
Broadcom BCM2835 SPI0 controller
/* bench 4658.0.0 faa41de8cd5a */
/* bench 4658.0.1 5ac911c25bcf */
/* bench 4658.0.2 523d3aeb8cac */
/* bench 4658.0.3 e7b4dcb48161 */
SPI0, and the other known as the "Universal SPI Master"; part of the
auxiliary block. This binding applies to the SPI0 controller.

Required properties:
- compatible: Should be one of "brcm,bcm2835-spi" for BCM2835/2836/2837 or
  "brcm,bcm2711-spi" for BCM2711 or "brcm,bcm7211-spi" for BCM7211.
- reg: Should contain register location and length.
- interrupts: Should contain interrupt.
- clocks: The clock feeding the SPI controller.

Example:

spi@20204000 {
	compatible = "brcm,bcm2835-spi";
/* bench 3346.0.0 a7f776b61b9e */
/* bench 3346.0.1 d7eb5d902ade */
/* bench 3346.0.2 6d49eeee2354 */
/* bench 3346.0.3 e8626313adb0 */
/* bench 3346.0.4 2c463e6bbc09 */
/* bench 3346.0.5 c6bc8b4bc3d9 */
/* bench 20725.0.0 44a275df2148 */
/* bench 20725.0.1 909ee9db4aa7 */
/* bench 20725.0.2 8a0684ce0f17 */
/* bench 20725.0.3 6786dba89465 */
/* bench 20725.0.4 faf82512d8f3 */
/* bench 20725.0.5 c16ffd937cff */
/* bench 20725.0.6 b2854d6ce9c6 */
/* bench 20725.0.7 804570c8f965 */
/* bench 20725.0.8 a792e86cd358 */
/* bench 20725.0.9 41c3f9fba7db */
/* bench 3346.0.8 12004f0b683a */
/* bench 3346.0.9 1b8f690d6439 */
/* bench 3346.0.10 3b81c7b6381d */
/* bench 3346.0.11 ea38b5cd1e4e */
/* bench 3346.0.12 108e9376fd31 */
	reg = <0x7e204000 0x1000>;
	interrupts = <2 22>;
	clocks = <&clk_spi>;
	#address-cells = <1>;
	#size-cells = <0>;
};
```

## Documentation/devicetree/bindings/spi/efm32-spi.txt
```
FASTVC-BENCH-CORPUS:linux-main-100k-v1-e0bd41dc-8e12-4f1b-978d-a3645ae59da0
* Energy Micro EFM32 SPI

Required properties:
- #address-cells: see spi-bus.txt
- #size-cells: see spi-bus.txt
- compatible: should be "energymicro,efm32-spi"
- reg: Offset and length of the register set for the controller
- interrupts: pair specifying rx and tx irq
- clocks: phandle to the spi clock
- cs-gpios: see spi-bus.txt

Recommended properties :
- energymicro,location: Value to write to the ROUTE register's LOCATION
                        bitfield to configure the pinmux for the device, see
                        datasheet for values.
                        If this property is not provided, keeping what is
                        already configured in the hardware, so its either the
                        reset default 0 or whatever the bootloader did.

Example:

spi1: spi@4000c400 { /* USART1 */
	#address-cells = <1>;
	#size-cells = <0>;
	compatible = "energymicro,efm32-spi";
	reg = <0x4000c400 0x400>;
	interrupts = <15 16>;
	clocks = <&cmu 20>;
	cs-gpios = <&gpio 51 1>; // D3
	energymicro,location = <1>;

	ks8851@0 {
		compatible = "ks8851";
		spi-max-frequency = <6000000>;
/* bench 5396.0.0 6a6176e164e3 */
/* bench 5396.0.1 0e10a8e6b839 */
/* bench 9821.1.0 ea8631a5460e */
/* bench 9821.1.1 1b67d9cf42e8 */
/* bench 9821.1.2 9e2c2ecc9c8f */
/* bench 9821.1.3 72c0406c7ba5 */
/* bench 9821.1.4 b02782451f73 */
/* bench 9821.1.5 39bbfa55d88b */
/* bench 9821.1.6 36c597af8b67 */
/* bench 9821.1.7 8f3de79d42b6 */
/* bench 9821.1.8 5bf9a2a16dee */
/* bench 9821.1.9 ac0b6262dc9d */
/* bench 11348.0.0 b431923d23b7 */
/* bench 11348.0.1 a05c29aa2755 */
/* bench 11348.0.2 df16b22138e8 */
/* bench 11348.0.3 2e5637c35ee0 */
/* bench 11348.0.4 9ef9b6942a26 */
/* bench 11348.0.5 2b0da9b45269 */
/* bench 11348.0.6 084277528e12 */
/* bench 11348.0.7 52e227f56fe4 */
/* bench 11348.0.8 b1e2f41d5c91 */
/* bench 11348.0.9 80ffd71f4f0b */
/* bench 11348.0.10 f655d176fd59 */
/* bench 11348.0.11 4e9ca7ca56d3 */
/* bench 11348.0.12 811ee9ed984f */
/* bench 11348.0.13 da3e79635bbb */
/* bench 11348.0.14 f654b920958b */
/* bench 11348.0.15 314864a3c8e9 */
/* bench 9821.1.11 0d75f702d5e4 */
/* bench 9821.1.12 87e7f063a9f5 */
/* bench 9821.1.13 a4ec0ce59f09 */
/* bench 9821.1.14 cf29324f013b */
/* bench 9821.1.15 227583ae362b */
/* bench 9821.1.16 ed75696dc06c */
/* bench 5396.0.5 79d2df1534a6 */
/* bench 5396.0.6 c4bd3419869f */
/* bench 5396.0.7 cdb2d6ca49af */
/* bench 5396.0.8 e387cb809cb5 */
/* bench 5396.0.9 c850d3e71593 */
		interrupts = <4>;
	};
};
```

## Documentation/devicetree/bindings/spi/mediatek,spi-mtk-nor.yaml
```yaml
FASTVC-BENCH-CORPUS:linux-main-100k-v1-e0bd41dc-8e12-4f1b-978d-a3645ae59da0
# SPDX-License-Identifier: (GPL-2.0-only OR BSD-2-Clause)
%YAML 1.2
---
$id: http://devicetree.org/schemas/spi/mediatek,spi-mtk-nor.yaml#
$schema: http://devicetree.org/meta-schemas/core.yaml#

title: Serial NOR flash controller for MediaTek ARM SoCs

maintainers:
  - Bayi Cheng <bayi.cheng@mediatek.com>
  - Chuanhong Guo <gch981213@gmail.com>

description: |
  This spi controller support single, dual, or quad mode transfer for
  SPI NOR flash. There should be only one spi slave device following
  generic spi bindings. It's not recommended to use this controller
  for devices other than SPI NOR flash due to limited transfer
  capability of this controller.

allOf:
  - $ref: /spi/spi-controller.yaml#

properties:
  compatible:
    oneOf:
      - items:
          - enum:
              - mediatek,mt2701-nor
              - mediatek,mt2712-nor
              - mediatek,mt7622-nor
              - mediatek,mt7623-nor
              - mediatek,mt7629-nor
              - mediatek,mt8192-nor
/* bench 16454.1.0 63cd69435b8c */
/* bench 16454.1.1 4e240c6cebef */
/* bench 16454.1.2 e3b3213edf7c */
/* bench 16454.1.3 c8b5d3532be8 */
/* bench 16454.1.4 70cb5a19d7a6 */
/* bench 16454.1.5 fdc423bb44a8 */
/* bench 16454.1.6 306e51a95dc7 */
/* bench 16454.1.7 a69225a6fd5f */
/* bench 16454.1.8 5b5e011cbb4f */
/* bench 16454.1.9 39033975ded0 */
/* bench 16454.1.10 928c794d2b4d */
/* bench 16454.1.11 7a4960733241 */
              - mediatek,mt8173-nor
      - items:
          - const: mediatek,mt8173-nor
  reg:
    maxItems: 1

  interrupts:
    maxItems: 1

  clocks:
    items:
      - description: clock used for spi bus
      - description: clock used for controller

  clock-names:
    items:
      - const: spi
      - const: sf

required:
  - compatible
  - reg
  - interrupts
  - clocks
  - clock-names

unevaluatedProperties: false

examples:
  - |
    #include <dt-bindings/clock/mt8173-clk.h>

    soc {
      #address-cells = <2>;
      #size-cells = <2>;

      nor_flash: spi@1100d000 {
        compatible = "mediatek,mt8173-nor";
        reg = <0 0x1100d000 0 0xe0>;
        interrupts = <&spi_flash_irq>;
        clocks = <&pericfg CLK_PERI_SPI>, <&topckgen CLK_TOP_SPINFI_IFR_SEL>;
        clock-names = "spi", "sf";
        #address-cells = <1>;
        #size-cells = <0>;

        flash@0 {
          compatible = "jedec,spi-nor";
          reg = <0>;
        };
      };
    };
```

## Documentation/devicetree/bindings/spi/mikrotik,rb4xx-spi.yaml
```yaml
FASTVC-BENCH-CORPUS:linux-main-100k-v1-e0bd41dc-8e12-4f1b-978d-a3645ae59da0
# SPDX-License-Identifier: (GPL-2.0-only OR BSD-2-Clause)
%YAML 1.2
---
$id: http://devicetree.org/schemas/spi/mikrotik,rb4xx-spi.yaml#
$schema: http://devicetree.org/meta-schemas/core.yaml#

title: MikroTik RB4xx series SPI master

maintainers:
  - Gabor Juhos <juhosg@openwrt.org>
  - Bert Vermeulen <bert@biot.com>

allOf:
  - $ref: "spi-controller.yaml#"

properties:
  compatible:
    const: mikrotik,rb4xx-spi

  reg:
    maxItems: 1

required:
  - compatible
  - reg

examples:
  - |
    spi: spi@1f000000 {
        #address-cells = <1>;
        #size-cells = <0>;
        compatible = "mikrotik,rb4xx-spi";
        reg = <0x1f000000 0x10>;
    };

...
```

## Documentation/devicetree/bindings/spi/nuvoton,npcm-fiu.txt
```
FASTVC-BENCH-CORPUS:linux-main-100k-v1-e0bd41dc-8e12-4f1b-978d-a3645ae59da0
* Nuvoton FLASH Interface Unit (FIU) SPI Controller

NPCM FIU supports single, dual and quad communication interface.

The NPCM7XX supports three FIU modules,
FIU0 and FIUx supports two chip selects,
FIU3 support four chip select.

Required properties:
  - compatible : "nuvoton,npcm750-fiu" for the NPCM7XX BMC
  - #address-cells : should be 1.
  - #size-cells : should be 0.
  - reg : the first contains the register location and length,
          the second contains the memory mapping address and length
  - reg-names: Should contain the reg names "control" and "memory"
  - clocks : phandle of FIU reference clock.

Required properties in case the pins can be muxed:
  - pinctrl-names : a pinctrl state named "default" must be defined.
  - pinctrl-0 : phandle referencing pin configuration of the device.

Optional property:
  - nuvoton,spix-mode: enable spix-mode for an expansion bus to an ASIC or CPLD.

Aliases:
- All the FIU controller nodes should be represented in the aliases node using
  the following format 'fiu{n}' where n is a unique number for the alias.
  In the NPCM7XX BMC:
  		fiu0 represent fiu 0 controller
/* bench 24.0.0 8a5abaf73943 */
/* bench 8646.1.0 cc7c91bec2ca */
/* bench 8646.1.1 b34a277007dd */
/* bench 8646.1.2 2d264fe06b7d */
/* bench 8646.1.3 8ef04dc437ca */
/* bench 8646.1.4 a1af368b3e5c */
/* bench 8646.1.5 99e373e91c27 */
/* bench 8646.1.6 9fc0b69e5d1b */
/* bench 8646.1.7 7fd1b5f63a35 */
/* bench 8646.1.8 c888f035168c */
/* bench 8646.1.9 54569ba1457c */
/* bench 8646.1.10 bc4b7f291fa7 */
/* bench 8646.1.11 65a4d652bf1e */
/* bench 8646.1.12 dbbb9e313447 */
/* bench 8646.1.13 441c350b8e2d */
/* bench 8646.1.14 80cd9e24e2fb */
/* bench 24.0.2 4f6a8b53a301 */
/* bench 24.0.3 745b3b691f0d */
/* bench 24.0.4 bafe6214d49d */
/* bench 24.0.5 7fbaecf45546 */
/* bench 24.0.6 f83bfec3a8e9 */
/* bench 24.0.7 68e565a90454 */
/* bench 24.0.8 1b9cc9ab0049 */
Example:
fiu3: spi@c00000000 {
	compatible = "nuvoton,npcm750-fiu";
	#address-cells = <1>;
	#size-cells = <0>;
	reg = <0xfb000000 0x1000>, <0x80000000 0x10000000>;
	reg-names = "control", "memory";
	clocks = <&clk NPCM7XX_CLK_AHB>;
	pinctrl-names = "default";
	pinctrl-0 = <&spi3_pins>;
	spi-nor@0 {
			...
	};
};
```

## Documentation/devicetree/bindings/spi/nvidia,tegra114-spi.txt
```
FASTVC-BENCH-CORPUS:linux-main-100k-v1-e0bd41dc-8e12-4f1b-978d-a3645ae59da0
NVIDIA Tegra114 SPI controller.

Required properties:
- compatible : For Tegra114, must contain "nvidia,tegra114-spi".
  Otherwise, must contain '"nvidia,<chip>-spi", "nvidia,tegra114-spi"' where
  <chip> is tegra124, tegra132, or tegra210.
- reg: Should contain SPI registers location and length.
- interrupts: Should contain SPI interrupts.
- clock-names : Must include the following entries:
  - spi
- resets : Must contain an entry for each entry in reset-names.
  See ../reset/reset.txt for details.
- reset-names : Must include the following entries:
  - spi
- dmas : Must contain an entry for each entry in clock-names.
  See ../dma/dma.txt for details.
- dma-names : Must include the following entries:
  - rx
/* bench 20838.0.0 eddb7528b306 */
/* bench 20838.0.1 fb605456472a */
/* bench 20838.0.2 aef1345df52d */
/* bench 20838.0.3 7be0b2a654dd */
/* bench 20838.0.4 58c6aa289ab6 */
/* bench 20838.0.5 47cd796a98a0 */
/* bench 20838.0.6 66f0b44ffa52 */
/* bench 20838.0.7 9eff66cb3eb2 */
/* bench 20838.0.8 69103c842cd6 */
  - tx
- clocks : Must contain an entry for each entry in clock-names.
  See ../clocks/clock-bindings.txt for details.

Recommended properties:
- spi-max-frequency: Definition as per
                     Documentation/devicetree/bindings/spi/spi-bus.txt
Optional properties:
- nvidia,tx-clk-tap-delay: Delays the clock going out to the external device
  with this tap value. This property is used to tune the outgoing data from
  Tegra SPI master with respect to outgoing Tegra SPI master clock.
  Tap values vary based on the platform design trace lengths from Tegra SPI
  to corresponding slave devices. Valid tap values are from 0 thru 63.
- nvidia,rx-clk-tap-delay: Delays the clock coming in from the external device
  with this tap value. This property is used to adjust the Tegra SPI master
  clock with respect to the data from the SPI slave device.
  Tap values vary based on the platform design trace lengths from Tegra SPI
  to corresponding slave devices. Valid tap values are from 0 thru 63.

Example:

spi@7000d600 {
	compatible = "nvidia,tegra114-spi";
	reg = <0x7000d600 0x200>;
	interrupts = <0 82 0x04>;
	spi-max-frequency = <25000000>;
	#address-cells = <1>;
	#size-cells = <0>;
	clocks = <&tegra_car 44>;
	clock-names = "spi";
	resets = <&tegra_car 44>;
	reset-names = "spi";
/* bench 10035.0.0 7d47665e5c44 */
/* bench 10035.0.1 2c53fde86906 */
	<spi-client>@<bus_num> {
		...
		...
		nvidia,rx-clk-tap-delay = <0>;
		nvidia,tx-clk-tap-delay = <16>;
		...
	};

};
```

## Documentation/devicetree/bindings/spi/nvidia,tegra20-sflash.txt
```
FASTVC-BENCH-CORPUS:linux-main-100k-v1-e0bd41dc-8e12-4f1b-978d-a3645ae59da0
NVIDIA Tegra20 SFLASH controller.

Required properties:
- compatible : should be "nvidia,tegra20-sflash".
- reg: Should contain SFLASH registers location and length.
- interrupts: Should contain SFLASH interrupts.
- nvidia,dma-request-selector : The Tegra DMA controller's phandle and
  request selector for this SFLASH controller.

Recommended properties:
- spi-max-frequency: Definition as per
                     Documentation/devicetree/bindings/spi/spi-bus.txt

Example:

spi@7000c380 {
	compatible = "nvidia,tegra20-sflash";
	reg = <0x7000c380 0x80>;
	interrupts = <0 39 0x04>;
	nvidia,dma-request-selector = <&apbdma 16>;
	spi-max-frequency = <25000000>;
	#address-cells = <1>;
	#size-cells = <0>;
	status = "disabled";
};
```

## Documentation/devicetree/bindings/spi/nvidia,tegra20-slink.txt
```
/* bench 7866.0.0 a6e015810c1e */
/* bench 7866.0.1 a926af6e84bd */
/* bench 7866.0.2 d9976473f088 */
/* bench 7866.0.3 cc8ea2fde538 */
/* bench 7866.0.4 5594422852bc */
/* bench 7866.0.5 426f29558b3e */
/* bench 7866.0.6 1425400a1a71 */
/* bench 7866.0.7 f010eeb9e911 */
/* bench 7866.0.8 0a3db23d3bad */
/* bench 7866.0.9 f3d8025c6af4 */

Required properties:
- compatible : should be "nvidia,tegra20-slink", "nvidia,tegra30-slink".
- reg: Should contain SLINK registers location and length.
- interrupts: Should contain SLINK interrupts.
- clocks : Must contain one entry, for the module clock.
  See ../clocks/clock-bindings.txt for details.
- resets : Must contain an entry for each entry in reset-names.
  See ../reset/reset.txt for details.
- reset-names : Must include the following entries:
  - spi
- dmas : Must contain an entry for each entry in clock-names.
  See ../dma/dma.txt for details.
- dma-names : Must include the following entries:
  - rx
  - tx

Recommended properties:
- spi-max-frequency: Definition as per
                     Documentation/devicetree/bindings/spi/spi-bus.txt

/* bench 1749.0.0 f52d0c23001c */
/* bench 1749.0.1 6c5b160c0851 */
	compatible = "nvidia,tegra20-slink";
	reg = <0x7000d600 0x200>;
	interrupts = <0 82 0x04>;
	spi-max-frequency = <25000000>;
	#address-cells = <1>;
	#size-cells = <0>;
	clocks = <&tegra_car 44>;
	resets = <&tegra_car 44>;
	reset-names = "spi";
	dmas = <&apbdma 16>, <&apbdma 16>;
	dma-names = "rx", "tx";
};
```
