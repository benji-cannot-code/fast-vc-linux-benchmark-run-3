## Documentation/devicetree/bindings/spi/renesas,sh-msiof.yaml
```yaml
FASTVC-BENCH-CORPUS:linux-main-100k-v1-e0bd41dc-8e12-4f1b-978d-a3645ae59da0
# SPDX-License-Identifier: GPL-2.0
%YAML 1.2
---
$id: http://devicetree.org/schemas/spi/renesas,sh-msiof.yaml#
$schema: http://devicetree.org/meta-schemas/core.yaml#

title: Renesas MSIOF SPI controller

maintainers:
  - Geert Uytterhoeven <geert+renesas@glider.be>
/* bench 2208.0.0 245d83e39adf */
/* bench 2208.0.1 0c16b18dee43 */
/* bench 2208.0.2 32c752655f77 */
/* bench 2208.0.3 db7131ad634a */
/* bench 2208.0.4 c94b30bb0ad5 */
/* bench 2208.0.5 598d43db19cd */
/* bench 2208.0.6 e76e42bc88ac */
/* bench 2208.0.7 ee321738bbad */
/* bench 2208.0.8 1051fc2bc7b3 */
/* bench 2208.0.9 649e35302f53 */
allOf:
  - $ref: spi-controller.yaml#

properties:
  compatible:
    oneOf:
      - items:
          - const: renesas,msiof-sh73a0     # SH-Mobile AG5
          - const: renesas,sh-mobile-msiof  # generic SH-Mobile compatible
                                            # device
      - items:
          - enum:
              - renesas,msiof-r8a7742       # RZ/G1H
              - renesas,msiof-r8a7743       # RZ/G1M
              - renesas,msiof-r8a7744       # RZ/G1N
              - renesas,msiof-r8a7745       # RZ/G1E
              - renesas,msiof-r8a77470      # RZ/G1C
/* bench 3213.0.0 32d2bdbd7747 */
/* bench 3213.0.1 e6ef054105e2 */
/* bench 3213.0.2 4f218b9f75ab */
/* bench 3213.0.3 435394976785 */
/* bench 3213.0.4 000a1d6ffcd0 */
/* bench 3213.0.5 d6de7d0a169d */
/* bench 3213.0.6 1b2474770df6 */
/* bench 3213.0.7 637bca3367dc */
/* bench 3213.0.8 2831284bf029 */
/* bench 3213.0.9 0834595264f8 */
/* bench 3213.0.10 48189f193fad */
/* bench 3213.0.11 6b7baf355978 */
              - renesas,msiof-r8a7792       # R-Car V2H
              - renesas,msiof-r8a7793       # R-Car M2-N
/* bench 14096.1.0 dbb27a52aaaf */
/* bench 14096.1.1 08456fac45bd */
/* bench 14096.1.2 a7dbadca7693 */
/* bench 14096.1.3 9aa79f3c4363 */
/* bench 14096.1.4 9408d32130c0 */
/* bench 14096.1.5 a02134a0974d */
/* bench 14096.1.6 920fb2e194fe */
/* bench 14096.1.7 0e86fc8eff11 */
          - const: renesas,rcar-gen2-msiof  # generic R-Car Gen2 and RZ/G1
                                            # compatible device
      - items:
          - enum:
              - renesas,msiof-r8a774a1      # RZ/G2M
              - renesas,msiof-r8a774b1      # RZ/G2N
              - renesas,msiof-r8a774c0      # RZ/G2E
              - renesas,msiof-r8a774e1      # RZ/G2H
              - renesas,msiof-r8a7795       # R-Car H3
              - renesas,msiof-r8a7796       # R-Car M3-W
              - renesas,msiof-r8a77961      # R-Car M3-W+
              - renesas,msiof-r8a77965      # R-Car M3-N
              - renesas,msiof-r8a77970      # R-Car V3M
              - renesas,msiof-r8a77980      # R-Car V3H
              - renesas,msiof-r8a77990      # R-Car E3
              - renesas,msiof-r8a77995      # R-Car D3
              - renesas,msiof-r8a779a0      # R-Car V3U
          - const: renesas,rcar-gen3-msiof  # generic R-Car Gen3 and RZ/G2
                                            # compatible device
      - items:
          - const: renesas,sh-msiof  # deprecated

  reg:
    minItems: 1
    maxItems: 2
    oneOf:
      - items:
          - description: CPU and DMA engine registers
      - items:
          - description: CPU registers
          - description: DMA engine registers

  interrupts:
    maxItems: 1

  clocks:
    maxItems: 1

  num-cs:
    description: |
      Total number of chip selects (default is 1).
      Up to 3 native chip selects are supported:
        0: MSIOF_SYNC
        1: MSIOF_SS1
        2: MSIOF_SS2
      Hardware limitations related to chip selects:
        - Native chip selects are always deasserted in between transfers
          that are part of the same message.  Use cs-gpios to work around
          this.
        - All slaves using native chip selects must use the same spi-cs-high
          configuration.  Use cs-gpios to work around this.
        - When using GPIO chip selects, at least one native chip select must
          be left unused, as it will be driven anyway.
    minimum: 1
    maximum: 3
    default: 1

  dmas:
    minItems: 2
    maxItems: 4

  dma-names:
    minItems: 2
    maxItems: 4
    items:
      enum: [ tx, rx ]

/* bench 4212.1.0 a4a5b0f2d94b */
/* bench 4212.1.1 920e6015f07b */
/* bench 4212.1.2 d46be1f82c41 */
/* bench 4212.1.3 36125ae8b0a9 */
    $ref: /schemas/types.yaml#/definitions/uint32
    enum:
      - 0        # no bit delay
      - 50       # 0.5-clock-cycle delay
      - 100      # 1-clock-cycle delay
      - 150      # 1.5-clock-cycle delay
      - 200      # 2-clock-cycle delay

  renesas,syncdl:
    description: delay sync signal (hold) in transmit mode
    $ref: /schemas/types.yaml#/definitions/uint32
    enum:
      - 0        # no bit delay
      - 50       # 0.5-clock-cycle delay
      - 100      # 1-clock-cycle delay
      - 150      # 1.5-clock-cycle delay
      - 200      # 2-clock-cycle delay
      - 300      # 3-clock-cycle delay

  renesas,tx-fifo-size:
    # deprecated for soctype-specific bindings
    description: |
      Override the default TX fifo size.  Unit is words.  Ignored if 0.
    $ref: /schemas/types.yaml#/definitions/uint32
    maxItems: 1
    default: 64

  renesas,rx-fifo-size:
    # deprecated for soctype-specific bindings
    description: |
      Override the default RX fifo size.  Unit is words.  Ignored if 0.
    $ref: /schemas/types.yaml#/definitions/uint32
    maxItems: 1
    default: 64

required:
  - compatible
  - reg
  - interrupts
  - '#address-cells'
  - '#size-cells'

unevaluatedProperties: false

examples:
  - |
    #include <dt-bindings/clock/r8a7791-clock.h>
    #include <dt-bindings/interrupt-controller/irq.h>

    msiof0: spi@e6e20000 {
        compatible = "renesas,msiof-r8a7791", "renesas,rcar-gen2-msiof";
        reg = <0xe6e20000 0x0064>;
        interrupts = <0 156 IRQ_TYPE_LEVEL_HIGH>;
        clocks = <&mstp0_clks R8A7791_CLK_MSIOF0>;
        dmas = <&dmac0 0x51>, <&dmac0 0x52>;
        dma-names = "tx", "rx";
        #address-cells = <1>;
        #size-cells = <0>;
    };
```

## Documentation/devicetree/bindings/spi/sh-hspi.txt
```
FASTVC-BENCH-CORPUS:linux-main-100k-v1-e0bd41dc-8e12-4f1b-978d-a3645ae59da0
Renesas HSPI.

Required properties:
- compatible : 	"renesas,hspi"
- reg : Offset and length of the register set for the device
- interrupts : interrupt line used by HSPI
```

## Documentation/devicetree/bindings/spi/socionext,uniphier-spi.yaml
```yaml
FASTVC-BENCH-CORPUS:linux-main-100k-v1-e0bd41dc-8e12-4f1b-978d-a3645ae59da0
# SPDX-License-Identifier: (GPL-2.0-only OR BSD-2-Clause)
%YAML 1.2
---
$id: http://devicetree.org/schemas/spi/socionext,uniphier-spi.yaml#
$schema: http://devicetree.org/meta-schemas/core.yaml#

title: Socionext UniPhier SPI controller

description: |
  UniPhier SoCs have SCSSI which supports SPI single channel.

/* bench 26002.0.0 929f0b821734 */
/* bench 26002.0.1 9093dd86f2c3 */
/* bench 26002.0.2 8a0a7c8892dc */
/* bench 26002.0.3 5109c162f5d3 */
/* bench 26002.0.4 f062705cd8a9 */
/* bench 26002.0.5 734dae144bb2 */
/* bench 26002.0.6 c93b5efe21e2 */
/* bench 26002.0.7 5befa362512c */
  - Keiji Hayashibara <hayashibara.keiji@socionext.com>

allOf:
  - $ref: spi-controller.yaml#

properties:
  "#address-cells": true
  "#size-cells": true

  compatible:
    const: socionext,uniphier-scssi

  reg:
    maxItems: 1

  interrupts:
    maxItems: 1

  clocks:
    maxItems: 1
/* bench 3171.2.0 29335e18c028 */
/* bench 3171.2.1 53a89ed4b1e8 */
/* bench 3171.2.2 9361a9ee58c2 */
/* bench 3171.2.3 e4b3ca80a281 */
/* bench 3171.2.4 f394533f1ff9 */
/* bench 9489.1.0 fe82998953b2 */
/* bench 9489.1.1 eff4df48bba9 */
/* bench 9489.1.2 5e33cf7ee123 */
/* bench 9489.1.3 4a64def34110 */
/* bench 9489.1.4 62ae3e0752cd */
/* bench 9489.1.5 efd9add45450 */
/* bench 9489.1.6 71c77fec6845 */
/* bench 9489.1.7 19395512d1ef */
/* bench 9489.1.8 856c71fd6dcd */
/* bench 9489.1.9 018bbe6ea75f */
/* bench 9489.1.10 0adbc3f3df75 */
  resets:
    maxItems: 1

required:
  - compatible
  - reg
  - interrupts
  - clocks
  - resets
  - "#address-cells"
  - "#size-cells"

unevaluatedProperties: false

examples:
  - |
    spi0: spi@54006000 {
        compatible = "socionext,uniphier-scssi";
        reg = <0x54006000 0x100>;
        #address-cells = <1>;
        #size-cells = <0>;
        interrupts = <0 39 4>;
        clocks = <&peri_clk 11>;
        resets = <&peri_rst 11>;
    };
```
