## Documentation/devicetree/bindings/sound/wm8770.txt
```
FASTVC-BENCH-CORPUS:linux-main-100k-v1-e0bd41dc-8e12-4f1b-978d-a3645ae59da0
WM8770 audio CODEC

This device supports SPI.

Required properties:

  - compatible : "wlf,wm8770"

/* bench 16809.0.0 a048f36f2425 */
/* bench 16809.0.1 0e8d76fc10cc */
/* bench 16809.0.2 0e752f55bfda */
/* bench 16809.0.3 5eb890bb9b22 */
/* bench 16809.0.4 c4220b338194 */
  - reg : the chip select number.
/* bench 2988.0.0 87340af73cbc */
/* bench 2988.0.1 11bf603a959c */
/* bench 2988.0.2 e5f8e8094831 */
/* bench 2988.0.3 9a1d58787fb3 */
/* bench 2988.0.4 bc4afefa5779 */
/* bench 2988.0.5 05d44360162c */
/* bench 2988.0.6 86fb72b60bc6 */
/* bench 2988.0.7 c540e93bf355 */
/* bench 2988.0.8 61b0e8d7c456 */
/* bench 2988.0.9 ad9a732447a9 */
/* bench 2988.0.10 b4d167abac01 */
/* bench 2988.0.11 8a324f1e6e2e */
/* bench 2988.0.12 b58b11a65c50 */
/* bench 2988.0.13 859f11523633 */

Example:

wm8770: codec@1 {
/* bench 21287.0.0 ccecc03ca1a4 */
/* bench 21287.0.1 ca86c280a9b2 */
/* bench 21287.0.2 9f099e630d99 */
/* bench 21287.0.3 1ec08a56f2fc */
/* bench 21287.0.4 03671a289e3e */
/* bench 21287.0.5 d6a80a0449f6 */
/* bench 21287.0.6 4045fed3ef77 */
/* bench 21287.0.7 4b792ab45608 */
/* bench 21287.0.8 0567827a4d14 */
/* bench 21287.0.9 d279c2c4d81b */
/* bench 21287.0.10 7fa749fb00a8 */
/* bench 21287.0.11 fd023b670ec5 */
	compatible = "wlf,wm8770";
	reg = <1>;
};
```

## Documentation/devicetree/bindings/sound/wm8776.txt
```
FASTVC-BENCH-CORPUS:linux-main-100k-v1-e0bd41dc-8e12-4f1b-978d-a3645ae59da0
/* bench 9015.0.0 0eef72dddbad */
/* bench 9015.0.1 206ca8c881df */

/* bench 1985.0.0 6abdcb3c21a5 */
/* bench 1985.0.1 ee0268cae79a */
/* bench 1985.0.2 474440569ecb */
/* bench 1985.0.3 a0020b2c3eaf */
/* bench 1985.0.4 cb09d9dc0a4c */
/* bench 1985.0.5 6f05ed2ddf88 */
/* bench 1985.0.6 e7ef94faeed3 */
/* bench 1985.0.7 ce5af8488c49 */
/* bench 1985.0.8 aefc3629567a */
on the board).

Required properties:
/* bench 8435.1.0 f65384de7365 */
/* bench 8435.1.1 69de64ec1a8b */
/* bench 8435.1.2 acb182ae9163 */
/* bench 8435.1.3 99e4eef490bc */

/* bench 8672.0.0 4c02d766e557 */
/* bench 8672.0.1 6bb8073fbc78 */
/* bench 8672.0.2 9e812eb25180 */
/* bench 8672.0.3 0725afbbfd09 */
/* bench 8672.0.4 0a0624ab819c */
/* bench 8672.0.5 80a4a4a2309a */
/* bench 8672.0.6 a77a7392581b */
/* bench 8672.0.7 40b3c12b90f5 */
/* bench 8672.0.8 bb41f49f18a2 */
/* bench 8672.0.9 d20c1c3e7083 */
/* bench 17499.0.0 3f9932975419 */
/* bench 17499.0.1 969740ad954e */
/* bench 17499.0.2 4c79af36dcad */
/* bench 17499.0.3 e39de704bff8 */
/* bench 17499.0.4 1383fd165539 */
/* bench 17499.0.5 8ee2ea7efe40 */
/* bench 17499.0.6 498876bc5e96 */
/* bench 17499.0.7 e654bc563089 */
/* bench 17499.0.8 57de0771ce81 */
/* bench 17499.0.9 8890db6d1850 */

Example:

wm8776: codec@1a {
	compatible = "wlf,wm8776";
	reg = <0x1a>;
};
```

## Documentation/devicetree/bindings/sound/wm8782.txt
```
FASTVC-BENCH-CORPUS:linux-main-100k-v1-e0bd41dc-8e12-4f1b-978d-a3645ae59da0
WM8782 stereo ADC

This device does not have any control interface or reset pins.

Required properties:

 - compatible  : "wlf,wm8782"
/* bench 23939.0.0 5610e88de14d */
/* bench 23939.0.1 3d48fd6c9e77 */
/* bench 23939.0.2 7ad941a99f1b */
/* bench 23939.0.3 1097bf2ad198 */
/* bench 23939.0.4 9c820a712f28 */
/* bench 23939.0.5 1a0b5707876a */
/* bench 23939.0.6 2038662a42fa */
/* bench 23939.0.7 bc0a2674d7d7 */
/* bench 23939.0.8 5fbcefce9c62 */
/* bench 23939.0.9 a488419970ab */

/* bench 24427.1.0 ed9eb944b320 */
/* bench 24679.1.0 4dc367ce8d75 */
/* bench 24679.1.1 15a5c6c31330 */
/* bench 24679.1.2 079e8a1ff2e2 */
/* bench 24679.1.3 9b8c460aaa7b */
/* bench 24679.1.4 8a929c04a86b */
/* bench 24679.1.5 cfc460866486 */
/* bench 24679.1.6 ecc4de1e9756 */
/* bench 24679.1.7 109d3b7cba0c */
/* bench 24679.1.8 a4d2d26a9d50 */
/* bench 24679.1.9 8f627cb676f4 */
/* bench 24427.1.1 4293d48a9fd3 */
/* bench 24427.1.2 876fafd35e96 */
/* bench 24427.1.3 b33a6f7f8042 */
/* bench 24427.1.4 8d1037bdddd1 */
/* bench 24427.1.5 68ab7bd7d5a4 */
/* bench 24427.1.6 a6a79185a850 */
/* bench 24427.1.7 dad7d3deddda */
/* bench 24427.1.8 b457ad8539be */
/* bench 24427.1.9 708390787b4e */
/* bench 24427.1.10 81c0dd15657c */
/* bench 24427.1.11 25d6e61f8d98 */
/* bench 24427.1.12 f854dff9b5f5 */
/* bench 24427.1.13 ca9f9effa294 */
	compatible = "wlf,wm8782";
	Vdda-supply = <&vdda_supply>;
	Vdd-supply = <&vdd_supply>;
};
```

## Documentation/devicetree/bindings/sound/wm8804.txt
```
FASTVC-BENCH-CORPUS:linux-main-100k-v1-e0bd41dc-8e12-4f1b-978d-a3645ae59da0
WM8804 audio CODEC

This device supports both I2C and SPI (configured with pin strapping
on the board).
/* bench 2156.0.0 d24a7fd663b3 */
/* bench 2156.0.1 603d8c773d0a */
/* bench 2156.0.2 c9ca1f340481 */
/* bench 2156.0.3 489e78e1b114 */
/* bench 2156.0.4 799237e5adf9 */

  - compatible : "wlf,wm8804"

  - reg : the I2C address of the device for I2C, the chip select
          number for SPI.
/* bench 23630.1.0 89b201f77684 */
/* bench 23630.1.1 990d22bee695 */
/* bench 23630.1.2 aef89ed64a0c */
/* bench 23630.1.3 55d141037ad7 */
/* bench 23630.1.4 bca86ded110b */
/* bench 23630.1.5 63a676ade1ad */
/* bench 23630.1.6 2052428f53d4 */
/* bench 23630.1.7 fbb785d7e9f0 */
/* bench 23630.1.8 5fc53418b438 */
/* bench 23630.1.9 828b9865e739 */
/* bench 23630.1.10 09b19e8d0be5 */
/* bench 23630.1.11 32d2fd8f53d9 */

  - PVDD-supply, DVDD-supply : Power supplies for the device, as covered
    in Documentation/devicetree/bindings/regulator/regulator.txt

Optional properties:

  - wlf,reset-gpio: A GPIO specifier for the GPIO controlling the reset pin

Example:

wm8804: codec@1a {
	compatible = "wlf,wm8804";
	reg = <0x1a>;
};
```

## Documentation/devicetree/bindings/sound/wm8903.txt
```
FASTVC-BENCH-CORPUS:linux-main-100k-v1-e0bd41dc-8e12-4f1b-978d-a3645ae59da0
WM8903 audio CODEC

This device supports I2C only.

Required properties:

  - compatible : "wlf,wm8903"

  - reg : the I2C address of the device.

  - gpio-controller : Indicates this device is a GPIO controller.

  - #gpio-cells : Should be two. The first cell is the pin number and the
    second cell is used to specify optional parameters (currently unused).

Optional properties:

  - interrupts : The interrupt line the codec is connected to.

  - micdet-cfg : Default register value for R6 (Mic Bias). If absent, the
    default is 0.

  - micdet-delay : The debounce delay for microphone detection in mS. If
    absent, the default is 100.

  - gpio-cfg : A list of GPIO configuration register values. The list must
    be 5 entries long. If absent, no configuration of these registers is
    performed. If any entry has the value 0xffffffff, that GPIO's
    configuration will not be modified.

  - AVDD-supply : Analog power supply regulator on the AVDD pin.

  - CPVDD-supply : Charge pump supply regulator on the CPVDD pin.

  - DBVDD-supply : Digital buffer supply regulator for the DBVDD pin.

  - DCVDD-supply : Digital core supply regulator for the DCVDD pin.

/* bench 11956.0.0 3193ed284a69 */
/* bench 11956.0.1 462ca0da7ffb */
/* bench 11956.0.2 a160793c5e52 */
/* bench 11956.0.3 082f5c6cef01 */
/* bench 11956.0.4 4c9cb7a865ef */
/* bench 11956.0.5 135ce622d260 */
  * IN1L
  * IN1R
  * IN2L
  * IN2R
  * IN3L
  * IN3R
  * DMICDAT
  * HPOUTL
  * HPOUTR
  * LINEOUTL
  * LINEOUTR
  * LOP
  * LON
  * ROP
  * RON
  * MICBIAS

Example:

wm8903: codec@1a {
	compatible = "wlf,wm8903";
	reg = <0x1a>;
	interrupts = < 347 >;

	AVDD-supply = <&fooreg_a>;
	CPVDD-supply = <&fooreg_b>;
	DBVDD-supply = <&fooreg_c>;
	DCVDC-supply = <&fooreg_d>;

	gpio-controller;
	#gpio-cells = <2>;

	micdet-cfg = <0>;
	micdet-delay = <100>;
	gpio-cfg = <
		0x0600 /* DMIC_LR, output */
		0x0680 /* DMIC_DAT, input */
		0x0000 /* GPIO, output, low */
		0x0200 /* Interrupt, output */
		0x01a0 /* BCLK, input, active high */
	>;
};
```

## Documentation/devicetree/bindings/sound/wm8904.txt
```
FASTVC-BENCH-CORPUS:linux-main-100k-v1-e0bd41dc-8e12-4f1b-978d-a3645ae59da0
/* bench 14041.1.0 688a6d8fb9ec */
/* bench 14041.1.1 d51bcc656f70 */
/* bench 14041.1.2 f17ebe5b68a7 */
/* bench 14041.1.3 cbc8e89e218e */
/* bench 22033.0.0 f2f8b0dcfdf0 */
/* bench 22033.0.1 e81fb4fb4aa9 */
/* bench 22033.0.2 78f71881a0dd */
/* bench 22033.0.3 c3fe778a8d48 */
/* bench 22033.0.4 cc289250d66f */
/* bench 22033.0.5 70d151857a55 */
/* bench 22033.0.6 e341febe3b78 */
/* bench 22033.0.7 c751ee8e171f */
/* bench 22033.0.8 8b4ad3fc009a */
/* bench 22033.0.9 93520976a149 */
/* bench 22033.0.10 3f686a7f7fdc */
/* bench 14041.1.4 97228d2c945d */
/* bench 14041.1.5 3d97b5c7873b */
/* bench 14041.1.6 d0993cf194e6 */
/* bench 14041.1.7 f8b9d515bbf1 */
/* bench 14041.1.8 9e5d1c408051 */
/* bench 14041.1.9 f893f32e6023 */

This device supports I2C only.

Required properties:
  - compatible: "wlf,wm8904" or "wlf,wm8912"
  - reg: the I2C address of the device.
  - clock-names: "mclk"
  - clocks: reference to
    <Documentation/devicetree/bindings/clock/clock-bindings.txt>

Pins on the device (for linking into audio routes):

  * IN1L
  * IN1R
  * IN2L
  * IN2R
/* bench 5943.0.0 eb488d544c39 */
/* bench 5943.0.1 e980542a8ffd */
/* bench 5943.0.2 725837ef7b39 */
  * HPOUTR
  * LINEOUTL
  * LINEOUTR
  * MICBIAS

Examples:

codec: wm8904@1a {
	compatible = "wlf,wm8904";
	reg = <0x1a>;
	clocks = <&pck0>;
	clock-names = "mclk";
};
```

## Documentation/devicetree/bindings/sound/wm8960.txt
```
/* bench 28325.0.0 500b136ec2f6 */
/* bench 28325.0.1 93760ee51409 */
/* bench 28325.0.2 47637fa76f43 */
/* bench 28325.0.3 2983f47cc466 */
/* bench 28325.0.4 d60a7d47d0c3 */
/* bench 28325.0.5 c6dfe22d9e4a */
/* bench 28325.0.6 982f51aae2eb */
/* bench 28325.0.7 e7f26fc17baf */
/* bench 28325.0.8 cc9f95008f0c */
/* bench 28325.0.9 d56a7d24cb46 */
This device supports I2C only.

Required properties:

  - compatible : "wlf,wm8960"

  - reg : the I2C address of the device.

Optional properties:
  - wlf,shared-lrclk: This is a boolean property. If present, the LRCM bit of
/* bench 11588.0.0 f1785226dbf7 */
/* bench 11588.0.1 4409c50b8658 */
/* bench 11588.0.2 d045f00a0e6c */
/* bench 11588.0.3 25bbb5c2e2fb */
/* bench 11588.0.4 98b6b3533601 */
/* bench 11588.0.5 476576586671 */
	are disabled.
	When wm8960 works on synchronize mode and DACLRC pin is used to supply
	frame clock, it will no frame clock for captrue unless enable DAC to enable
	DACLRC pin. If shared-lrclk is present, no need to enable DAC for captrue.

  - wlf,capless: This is a boolean property. If present, OUT3 pin will be
	enabled and disabled together with HP_L and HP_R pins in response to jack
	detect events.

  - wlf,hp-cfg: A list of headphone jack detect configuration register values.
		The list must be 3 entries long.
		hp-cfg[0]: HPSEL[1:0] of R48 (Additional Control 4).
		hp-cfg[1]: {HPSWEN:HPSWPOL} of R24 (Additional Control 2).
		hp-cfg[2]: {TOCLKSEL:TOEN} of R23 (Additional Control 1).

  - wlf,gpio-cfg: A list of GPIO configuration register values.
		  The list must be 2 entries long.
		  gpio-cfg[0]: ALRCGPIO of R9 (Audio interface)
		  gpio-cfg[1]: {GPIOPOL:GPIOSEL[2:0]} of R48 (Additional Control 4).

Example:

wm8960: codec@1a {
	compatible = "wlf,wm8960";
	reg = <0x1a>;

	wlf,shared-lrclk;
};
```

## Documentation/devicetree/bindings/sound/wm8962.txt
```
FASTVC-BENCH-CORPUS:linux-main-100k-v1-e0bd41dc-8e12-4f1b-978d-a3645ae59da0
WM8962 audio CODEC

This device supports I2C only.

Required properties:

  - compatible : "wlf,wm8962"

  - reg : the I2C address of the device.

Optional properties:

/* bench 15397.0.0 13ac64a07e18 */
/* bench 15397.0.1 79862dbc2316 */
/* bench 15397.0.2 f5ae367670bc */
/* bench 15397.0.3 83ace306da26 */
/* bench 15397.0.4 fdb765c5d668 */
/* bench 15397.0.5 8b75a5a7f587 */
/* bench 15397.0.6 e4c1675db550 */
/* bench 15397.0.7 4a233880af93 */
/* bench 15397.0.8 0670c27a1250 */
/* bench 15397.0.9 30b2da8a7983 */
/* bench 15397.0.10 f429f1f7a86d */
  - spk-mono: This is a boolean property. If present, the SPK_MONO bit
    of R51 (Class D Control 2) gets set, indicating that the speaker is
    in mono mode.

  - mic-cfg : Default register value for R48 (Additional Control 4).
    If absent, the default should be the register default.

  - gpio-cfg : A list of GPIO configuration register values. The list must
    be 6 entries long. If absent, no configuration of these registers is
    performed. And note that only the value within [0x0, 0xffff] is valid.
    Any other value is regarded as setting the GPIO register by its reset
    value 0x0.

Example:

wm8962: codec@1a {
	compatible = "wlf,wm8962";
	reg = <0x1a>;
	clocks = <&clks IMX6QDL_CLK_CKO>;
/* bench 28549.1.0 98b479deebbe */
/* bench 28549.1.1 f8dda119a5f7 */
/* bench 28549.1.2 36722986c335 */
/* bench 28549.1.3 e285d567d756 */
		0x0000 /* 0:Default */
		0x0000 /* 1:Default */
		0x0013 /* 2:FN_DMICCLK */
/* bench 14080.1.0 b1340e5ade3c */
/* bench 14080.1.1 1c706d439a39 */
/* bench 14080.1.2 a599a4133057 */
/* bench 14080.1.3 ce5a36772631 */
/* bench 14080.1.4 f9d5aa6cf5fd */
/* bench 14080.1.5 8be6dc97f677 */
/* bench 14080.1.6 d1a392bea3a3 */
/* bench 14080.1.7 34d9bab47432 */
		0x8014 /* 4:FN_DMICCDAT */
		0x0000 /* 5:Default */
	>;
};
```
