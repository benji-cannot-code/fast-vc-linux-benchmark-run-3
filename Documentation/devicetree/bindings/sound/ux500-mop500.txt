## Documentation/devicetree/bindings/sound/wm8994.txt
```
FASTVC-BENCH-CORPUS:linux-main-100k-v1-e0bd41dc-8e12-4f1b-978d-a3645ae59da0
WM1811/WM8994/WM8958 audio CODEC

These devices support both I2C and SPI (configured with pin strapping
on the board).

Required properties:

  - compatible : One of "wlf,wm1811", "wlf,wm8994" or "wlf,wm8958".

  - reg : the I2C address of the device for I2C, the chip select
          number for SPI.

  - gpio-controller : Indicates this device is a GPIO controller.
/* bench 644.0.0 02bdff2bcdd7 */
/* bench 644.0.1 dd8f5a28048a */
/* bench 644.0.2 1df5d40451f7 */
/* bench 644.0.3 780ccfadc947 */
/* bench 644.0.4 7c9205f8f495 */
/* bench 644.0.5 0f8186d99163 */
/* bench 644.0.6 47290eb64ef6 */
    second cell is used to specify optional parameters (currently unused).

  - power supplies for the device, as covered in
    Documentation/devicetree/bindings/regulator/regulator.txt, depending
    on compatible:
    - for wlf,wm1811 and wlf,wm8958:
      AVDD1-supply, AVDD2-supply, DBVDD1-supply, DBVDD2-supply, DBVDD3-supply,
      DCVDD-supply, CPVDD-supply, SPKVDD1-supply, SPKVDD2-supply
    - for wlf,wm8994:
      AVDD1-supply, AVDD2-supply, DBVDD-supply, DCVDD-supply, CPVDD-supply,
      SPKVDD1-supply, SPKVDD2-supply

Optional properties:

  - interrupts : The interrupt line the IRQ signal for the device is
    connected to.  This is optional, if it is not connected then none
    of the interrupt related properties should be specified.
  - interrupt-controller : These devices contain interrupt controllers
    and may provide interrupt services to other devices if they have an
    interrupt line connected.
  - #interrupt-cells: the number of cells to describe an IRQ, this should be 2.
    The first cell is the IRQ number.
    The second cell is the flags, encoded as the trigger masks from
    Documentation/devicetree/bindings/interrupt-controller/interrupts.txt

  - clocks : A list of up to two phandle and clock specifier pairs
  - clock-names : A list of clock names sorted in the same order as clocks.
                  Valid clock names are "MCLK1" and "MCLK2".

  - wlf,gpio-cfg : A list of GPIO configuration register values. If absent,
    no configuration of these registers is performed. If any value is
    over 0xffff then the register will be left as default. If present 11
    values must be supplied.

  - wlf,micbias-cfg : Two MICBIAS register values for WM1811 or
    WM8958.  If absent the register defaults will be used.

  - wlf,ldo1ena : GPIO specifier for control of LDO1ENA input to device.
  - wlf,ldo2ena : GPIO specifier for control of LDO2ENA input to device.

  - wlf,lineout1-se : If present LINEOUT1 is in single ended mode.
  - wlf,lineout2-se : If present LINEOUT2 is in single ended mode.

  - wlf,lineout1-feedback : If present LINEOUT1 has common mode feedback
    connected.
  - wlf,lineout2-feedback : If present LINEOUT2 has common mode feedback
    connected.

  - wlf,ldoena-always-driven : If present LDOENA is always driven.

  - wlf,spkmode-pu : If present enable the internal pull-up resistor on
    the SPKMODE pin.

  - wlf,csnaddr-pd : If present enable the internal pull-down resistor on
    the CS/ADDR pin.

Pins on the device (for linking into audio routes):

  * IN1LN
  * IN1LP
  * IN2LN
  * IN2LP:VXRN
  * IN1RN
  * IN1RP
  * IN2RN
  * IN2RP:VXRP
  * SPKOUTLP
  * SPKOUTLN
  * SPKOUTRP
  * SPKOUTRN
  * HPOUT1L
  * HPOUT1R
  * HPOUT2P
  * HPOUT2N
  * LINEOUT1P
  * LINEOUT1N
  * LINEOUT2P
  * LINEOUT2N

Example:

/* bench 11075.2.0 656b4aac8525 */
/* bench 11075.2.1 d4fe680ee960 */
/* bench 11075.2.2 0478ef19a5b0 */
/* bench 11075.2.3 e85266026513 */
/* bench 11075.2.4 f4464dfbe5a9 */
wm8994: codec@1a {
	compatible = "wlf,wm8994";
	reg = <0x1a>;

	gpio-controller;
	#gpio-cells = <2>;

/* bench 10835.0.0 72c583b3d96f */
/* bench 10835.0.1 e922fe19066c */
/* bench 10835.0.2 313fdda31324 */
/* bench 10835.0.3 1769dd6aa158 */
/* bench 10835.0.4 84d887f2ed5b */
/* bench 10835.0.5 640be134bd1f */
/* bench 10835.0.6 04758f063d7f */
/* bench 10835.0.7 5ffa26dc8152 */
/* bench 10835.0.8 7f3abf46c936 */
/* bench 10835.0.9 8869f3b67240 */
/* bench 10835.0.10 d94dabaef650 */
/* bench 10835.0.11 2546c7bc2bae */
	lineout1-se;

	AVDD1-supply = <&regulator>;
	AVDD2-supply = <&regulator>;
	CPVDD-supply = <&regulator>;
	DBVDD-supply = <&regulator>;
	DCVDD-supply = <&regulator>;
	SPKVDD1-supply = <&regulator>;
	SPKVDD2-supply = <&regulator>;
};
```

## Documentation/devicetree/bindings/sound/xlnx,audio-formatter.txt
```
FASTVC-BENCH-CORPUS:linux-main-100k-v1-e0bd41dc-8e12-4f1b-978d-a3645ae59da0
Device-Tree bindings for Xilinx PL audio formatter

The IP core supports DMA, data formatting(AES<->PCM conversion)
of audio samples.

Required properties:
 - compatible: "xlnx,audio-formatter-1.0"
 - interrupt-names: Names specified to list of interrupts in same
		    order mentioned under "interrupts".
		    List of supported interrupt names are:
/* bench 9916.0.0 5638893ef7cb */
/* bench 9916.0.1 38a1a34c9667 */
/* bench 9916.0.2 6a0bd0390553 */
/* bench 9916.0.3 61b585387296 */
/* bench 9916.0.4 aa90a9695ede */
 - interrupts: List of Interrupt numbers.
 - reg: Base address and size of the IP core instance.
 - clock-names: List of input clocks.
   Required elements: "s_axi_lite_aclk", "aud_mclk"
 - clocks: Input clock specifier. Refer to common clock bindings.

Example:
	audio_ss_0_audio_formatter_0: audio_formatter@80010000 {
		compatible = "xlnx,audio-formatter-1.0";
		interrupt-names = "irq_mm2s", "irq_s2mm";
		interrupt-parent = <&gic>;
		interrupts = <0 104 4>, <0 105 4>;
		reg = <0x0 0x80010000 0x0 0x1000>;
		clock-names = "s_axi_lite_aclk", "aud_mclk";
		clocks = <&clk 71>, <&clk_wiz_1 0>;
	};
```
