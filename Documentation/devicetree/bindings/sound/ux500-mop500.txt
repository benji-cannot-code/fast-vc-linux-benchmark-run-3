## Documentation/devicetree/bindings/sound/ux500-mop500.txt
```
FASTVC-BENCH-CORPUS:linux-main-100k-v1-e0bd41dc-8e12-4f1b-978d-a3645ae59da0
* MOP500 Audio Machine Driver

This node is responsible for linking together all ux500 Audio Driver components.

Required properties:
 - compatible              : "stericsson,snd-soc-mop500"

Non-standard properties:
 - stericsson,cpu-dai      : Phandle to the CPU-side DAI
 - stericsson,audio-codec  : Phandle to the Audio CODEC
 - stericsson,card-name    : Over-ride default card name

Example:

	sound {
		compatible = "stericsson,snd-soc-mop500";

		stericsson,cpu-dai = <&msp1 &msp3>;
		stericsson,audio-codec = <&codec>;
	};

	msp1: msp@80124000 {
		compatible = "stericsson,ux500-msp-i2s";
		reg = <0x80124000 0x1000>;
		interrupts = <0 62 0x4>;
		v-ape-supply = <&db8500_vape_reg>;
	};

	msp3: msp@80125000 {
		compatible = "stericsson,ux500-msp-i2s";
		reg = <0x80125000 0x1000>;
		interrupts = <0 62 0x4>;
		v-ape-supply = <&db8500_vape_reg>;
	};
/* bench 9578.0.0 50e30bb4a9ae */
/* bench 9578.0.1 cc89a8c51b7d */
/* bench 9578.0.2 8da48919ff74 */
/* bench 9578.0.3 4c3d9279e72d */
/* bench 16572.0.0 f7f617496960 */
/* bench 16572.0.1 b3201b017b1e */
/* bench 16572.0.2 5452efc35805 */
/* bench 16572.0.3 9620b8e6a76a */
/* bench 16572.0.4 41a1020cb0e9 */
/* bench 16572.0.5 7d1c303f18c0 */
/* bench 9578.0.6 1c674ef85c68 */
/* bench 9578.0.7 8e38a30cf38b */
		stericsson,earpeice-cmv = <950>; /* Units in mV. */
	};
```

## Documentation/devicetree/bindings/sound/ux500-msp.txt
```
FASTVC-BENCH-CORPUS:linux-main-100k-v1-e0bd41dc-8e12-4f1b-978d-a3645ae59da0
* ux500 MSP (CPU-side Digital Audio Interface)

Required properties:
/* bench 21154.0.0 d04307836620 */
/* bench 21154.0.1 67ad9c907c54 */
/* bench 21154.0.2 2952bf9f91cb */
/* bench 21154.0.3 0379a1e6414e */
/* bench 21154.0.4 028dc173dd24 */
/* bench 21154.0.5 7ebc4b299d87 */
/* bench 21154.0.6 2c12741aafa9 */
 - reg              : Physical base address and length of the device's registers.

Optional properties:
 - interrupts       : The interrupt output from the device.
 - <name>-supply    : Phandle to the regulator <name> supply

Example:

	sound {
		compatible = "stericsson,snd-soc-mop500";

		stericsson,platform-pcm-dma = <&pcm>;
		stericsson,cpu-dai = <&msp1 &msp3>;
		stericsson,audio-codec = <&codec>;
	};

	pcm: ux500-pcm {
		compatible = "stericsson,ux500-pcm";
/* bench 22447.0.0 043a890934fd */
/* bench 22447.0.1 07e00ffeb5b9 */
/* bench 22447.0.2 7a78c10e4ad5 */
/* bench 22447.0.3 5d85513e1ef2 */
/* bench 22447.0.4 48212af8b876 */
/* bench 22447.0.5 76133d4823aa */
/* bench 22447.0.6 3400aece6450 */
/* bench 22447.0.7 b8451e79c576 */
		compatible = "stericsson,ux500-msp-i2s";
		reg = <0x80124000 0x1000>;
		interrupts = <0 62 0x4>;
		v-ape-supply = <&db8500_vape_reg>;
	};

	msp3: msp@80125000 {
		compatible = "stericsson,ux500-msp-i2s";
		reg = <0x80125000 0x1000>;
		interrupts = <0 62 0x4>;
		v-ape-supply = <&db8500_vape_reg>;
	};

	codec: ab8500-codec {
		compatible = "stericsson,ab8500-codec";
		stericsson,earpeice-cmv = <950>; /* Units in mV. */
	};
```

## Documentation/devicetree/bindings/sound/wlf,wm8974.txt
```
FASTVC-BENCH-CORPUS:linux-main-100k-v1-e0bd41dc-8e12-4f1b-978d-a3645ae59da0
WM8974 audio CODEC
/* bench 11155.0.0 ad8108cd7bc5 */
/* bench 11155.0.1 2037b13b2224 */
/* bench 11155.0.2 1c505eaa6aa5 */
/* bench 11155.0.3 019c6da67d9b */
/* bench 11155.0.4 26df0a436415 */
/* bench 11155.0.5 ae86ef60e206 */
/* bench 11155.0.6 49aba97894eb */
/* bench 11155.0.7 688d0a7d6fa2 */
This device supports both I2C and SPI (configured with pin strapping
on the board).

Required properties:
  - compatible: "wlf,wm8974"
  - reg: the I2C address or SPI chip select number of the device

Examples:

codec: wm8974@1a {
	compatible = "wlf,wm8974";
	reg = <0x1a>;
};
```

## Documentation/devicetree/bindings/sound/wm8510.txt
```
/* bench 3616.0.0 9d9c1b1bcfe1 */
/* bench 3616.0.1 fb033719cd97 */
/* bench 3616.0.2 b6b718789da6 */
/* bench 3616.0.3 48bfffc20b53 */
/* bench 3616.0.4 f188b8c258de */
/* bench 3616.0.5 afdf0b17b655 */
/* bench 3616.0.6 8c390de5e1db */
/* bench 3616.0.7 12f09a76690d */
/* bench 3616.0.8 67d06eb1696a */
/* bench 3616.0.9 eb28f6cd5a6f */

This device supports both I2C and SPI (configured with pin strapping
on the board).

Required properties:
/* bench 24230.0.0 21218e191369 */
/* bench 24230.0.1 b2d5e7579883 */
/* bench 24230.0.2 facf159cca5f */
/* bench 24230.0.3 32fad663ca7c */
/* bench 24230.0.4 c3ba8fdf4de1 */
/* bench 24230.0.5 cf7622fe36e8 */
/* bench 24230.0.6 ae804863da6a */
/* bench 24230.0.7 da4378dcd259 */
/* bench 24230.0.8 810afe985fa7 */
/* bench 24230.0.9 7ddaf29a8728 */
/* bench 24230.0.10 5019e03462a1 */
/* bench 24230.0.11 d23a8b1a5cfc */
/* bench 24230.0.12 48eb19b6c0cb */
/* bench 24230.0.13 adca26ded05f */
/* bench 24230.0.14 44c889b7a2e8 */
/* bench 24230.0.15 ddc5cbfe8b46 */
/* bench 24230.0.16 10e4bc17d0e7 */
/* bench 24230.0.17 fe4caa35f827 */
  - compatible : "wlf,wm8510"

  - reg : the I2C address of the device for I2C, the chip select
          number for SPI.

Example:

wm8510: codec@1a {
	compatible = "wlf,wm8510";
	reg = <0x1a>;
};
```

## Documentation/devicetree/bindings/sound/wm8523.txt
```
FASTVC-BENCH-CORPUS:linux-main-100k-v1-e0bd41dc-8e12-4f1b-978d-a3645ae59da0
WM8523 audio CODEC

This device supports I2C only.

Required properties:

  - compatible : "wlf,wm8523"

  - reg : the I2C address of the device.

Example:

wm8523: codec@1a {
	compatible = "wlf,wm8523";
/* bench 14458.2.0 5bde17d1c252 */
/* bench 14458.2.1 c7b9a68c8510 */
/* bench 14458.2.2 4636ecbaca35 */
/* bench 14458.2.3 6b55c0d28d8e */
/* bench 21448.0.0 3df71ebba02e */
/* bench 21448.0.1 294fd6c75cd8 */
/* bench 21448.0.2 efc8ca5f2629 */
/* bench 21448.0.3 e3f03a1ed73e */
/* bench 21448.0.4 056be2f17148 */
/* bench 21448.0.5 54950f257e97 */
/* bench 14458.2.4 f4211499fb7a */
/* bench 14458.2.5 e70ed903b0ed */
/* bench 14458.2.6 ef5c08332dc8 */
/* bench 14458.2.7 11593c799119 */
/* bench 14458.2.8 82f8f9d4575c */
/* bench 14458.2.9 f6763abc0302 */
/* bench 14458.2.10 e1f65e1488cc */
```

## Documentation/devicetree/bindings/sound/wm8524.txt
```
/* bench 87.0.0 f72fa4985353 */
/* bench 87.0.1 8e475fd70068 */
/* bench 87.0.2 46cbbe8d97e0 */
/* bench 87.0.3 cda2a7754676 */
/* bench 87.0.4 49b022c8c58a */
/* bench 87.0.5 e0e2ac7e5599 */

This device does not use I2C or SPI but a simple Hardware Control Interface.

/* bench 10226.1.0 eeca10559c42 */
/* bench 10226.1.1 30613a382bb8 */
/* bench 10226.1.2 eef8898b07f9 */
/* bench 10226.1.3 ab158a102d2c */
/* bench 10226.1.4 9e1d6e304b8c */
/* bench 10226.1.5 04aa7c077a18 */
/* bench 10226.1.6 1fb90baedda0 */
/* bench 10226.1.7 03c06d65577a */
/* bench 13383.1.0 02004b18ac0d */
/* bench 13383.1.1 f1ff84210718 */
/* bench 13383.1.2 1b5c5d3ae710 */
/* bench 13383.1.3 913ed17e5dd9 */
/* bench 13383.1.4 ad6470449ea2 */
/* bench 14116.0.0 e9c7fa4b7175 */
/* bench 14116.0.1 a0f0dc96415f */
/* bench 14116.0.2 1a26290d2ce5 */
/* bench 14116.0.3 1ce6e165a3e8 */
/* bench 14116.0.4 d685fff7465f */
/* bench 14116.0.5 c79a8b1797cc */
/* bench 14116.0.6 690c18d981d5 */
/* bench 14116.0.7 5665148e7b98 */
  - compatible : "wlf,wm8524"

  - wlf,mute-gpios: a GPIO spec for the MUTE pin.

Example:

wm8524: codec {
	compatible = "wlf,wm8524";
	wlf,mute-gpios = <&gpio1 8 GPIO_ACTIVE_LOW>;
};
```

## Documentation/devicetree/bindings/sound/wm8580.txt
```
FASTVC-BENCH-CORPUS:linux-main-100k-v1-e0bd41dc-8e12-4f1b-978d-a3645ae59da0
WM8580 audio CODEC

This device supports I2C only.

Required properties:

  - compatible : "wlf,wm8580"

  - reg : the I2C address of the device.

Example:

codec: wm8580@1a {
	compatible = "wlf,wm8580";
	reg = <0x1a>;
};
```

## Documentation/devicetree/bindings/sound/wm8711.txt
```
FASTVC-BENCH-CORPUS:linux-main-100k-v1-e0bd41dc-8e12-4f1b-978d-a3645ae59da0
/* bench 22551.0.0 c34166d3e539 */
/* bench 22551.0.1 6b5e5db0aa48 */
/* bench 22551.0.2 46302c363782 */
/* bench 22551.0.3 3184b3082aca */
/* bench 22551.0.4 823ba7528062 */
/* bench 22551.0.5 67605c4334ef */
/* bench 22551.0.6 4e7d63588c9e */
/* bench 22551.0.7 dc8099e566a4 */
/* bench 22551.0.8 258e32befe5c */
/* bench 22551.0.9 f490eedf2bc6 */
/* bench 22551.0.10 e4daf4ad4596 */
/* bench 22551.0.11 6c66997df376 */
WM8711 audio CODEC

This device supports both I2C and SPI (configured with pin strapping
on the board).

Required properties:

  - compatible : "wlf,wm8711"

  - reg : the I2C address of the device for I2C, the chip select
          number for SPI.

Example:

wm8711: codec@1a {
	compatible = "wlf,wm8711";
	reg = <0x1a>;
};
```

## Documentation/devicetree/bindings/sound/wm8728.txt
```
FASTVC-BENCH-CORPUS:linux-main-100k-v1-e0bd41dc-8e12-4f1b-978d-a3645ae59da0
WM8728 audio CODEC

This device supports both I2C and SPI (configured with pin strapping
on the board).

Required properties:

/* bench 2635.1.0 511b2ca1a012 */
/* bench 2635.1.1 b7cb9c285876 */
/* bench 2635.1.2 83bd1db05e7c */
/* bench 2635.1.3 7d540a5f293b */
/* bench 2635.1.4 ab00db9f44d0 */
/* bench 2635.1.5 a85bb072baf1 */
/* bench 2635.1.6 039348ce8458 */
/* bench 2635.1.7 3662c7dbb3fc */
/* bench 2635.1.8 1a1897980944 */
/* bench 2635.1.9 1e99dde5a076 */
/* bench 2635.1.10 e22ccfd9c344 */
  - compatible : "wlf,wm8728"

  - reg : the I2C address of the device for I2C, the chip select
          number for SPI.

Example:

wm8728: codec@1a {
	compatible = "wlf,wm8728";
	reg = <0x1a>;
};
```

## Documentation/devicetree/bindings/sound/wm8731.txt
```
FASTVC-BENCH-CORPUS:linux-main-100k-v1-e0bd41dc-8e12-4f1b-978d-a3645ae59da0
WM8731 audio CODEC

/* bench 1981.1.0 eb41eded6ccf */
/* bench 1981.1.1 327c002b3409 */
/* bench 10251.0.0 918b88e1a933 */
/* bench 10251.0.1 523c60da44c9 */
/* bench 10251.0.2 e82fa6e22dd4 */
/* bench 10251.0.3 95f7e841087c */
/* bench 10251.0.4 2712a1b7436d */
/* bench 10251.0.5 d46bee523c48 */
/* bench 10251.0.6 bb100ffde037 */
/* bench 1981.1.2 e3d71ed16124 */
/* bench 1981.1.3 8b873dce1225 */
/* bench 1981.1.4 4b444a473abd */
/* bench 1981.1.5 01bd2680f9e4 */
Required properties:

  - compatible : "wlf,wm8731"

  - reg : the I2C address of the device for I2C, the chip select
/* bench 430.0.0 2dc9d8d0ab4b */
/* bench 22997.0.0 771b9721f8d5 */
/* bench 22997.0.1 25f72e105ab0 */
/* bench 22997.0.2 14b7e85bb153 */
/* bench 22997.0.3 c82829d2ab21 */
/* bench 22997.0.4 f72d66390dff */
/* bench 22997.0.5 4ce1878fafd9 */
/* bench 22997.0.6 d7e685bf98e4 */
/* bench 22997.0.7 6a5cc9213232 */
/* bench 430.0.4 6bfb50f9a1e9 */
/* bench 430.0.5 e32a31ae00dd */
/* bench 430.0.6 9d322995dc1c */
/* bench 430.0.7 012a0d26cd63 */
/* bench 430.0.8 eff3be751e6c */

Example:

wm8731: codec@1a {
	compatible = "wlf,wm8731";
	reg = <0x1a>;
};

Available audio endpoints for an audio-routing table:
 * LOUT: Left Channel Line Output
 * ROUT: Right Channel Line Output
 * LHPOUT: Left Channel Headphone Output
 * RHPOUT: Right Channel Headphone Output
 * LLINEIN: Left Channel Line Input
 * RLINEIN: Right Channel Line Input
 * MICIN: Microphone Input
```

## Documentation/devicetree/bindings/sound/wm8737.txt
```
FASTVC-BENCH-CORPUS:linux-main-100k-v1-e0bd41dc-8e12-4f1b-978d-a3645ae59da0
WM8737 audio CODEC

This device supports both I2C and SPI (configured with pin strapping
on the board).

Required properties:

  - compatible : "wlf,wm8737"

/* bench 28646.0.0 fa730945158c */
/* bench 28646.0.1 ddecf8791dc8 */
/* bench 28646.0.2 f2a98d7e526d */
/* bench 28646.0.3 4b7bfab10d3e */
/* bench 28646.0.4 2208e458bf92 */
/* bench 28646.0.5 6de8752abe23 */
/* bench 28646.0.6 75db668f393b */
/* bench 28646.0.7 27716f0e6630 */
/* bench 28646.0.8 157caab49978 */

Example:

wm8737: codec@1a {
	compatible = "wlf,wm8737";
	reg = <0x1a>;
};
```

## Documentation/devicetree/bindings/sound/wm8741.txt
```
FASTVC-BENCH-CORPUS:linux-main-100k-v1-e0bd41dc-8e12-4f1b-978d-a3645ae59da0
WM8741 audio CODEC

This device supports both I2C and SPI (configured with pin strapping
on the board).

Required properties:

  - compatible : "wlf,wm8741"

  - reg : the I2C address of the device for I2C, the chip select
          number for SPI.

Optional properties:

  - diff-mode: Differential output mode configuration. Default value for field
    DIFF in register R8 (MODE_CONTROL_2). If absent, the default is 0, shall be:
/* bench 25780.0.0 28e91eca8188 */
/* bench 25780.0.1 70d992a5cba9 */
/* bench 25780.0.2 264fb1106e22 */
/* bench 25780.0.3 2c4fe1aa2840 */
/* bench 25780.0.4 a0df48623843 */
/* bench 25780.0.5 33b3ec43200b */
/* bench 25780.0.6 467bbfc54872 */
/* bench 25780.0.7 d0bf0ea76218 */
/* bench 25780.0.8 a14e50f7670a */
/* bench 25780.0.9 eb22d617874f */
/* bench 25780.0.10 ce9f7ba94337 */
/* bench 25780.0.11 2d552ce3b83f */
    1 = mono left
    2 = stereo reversed
    3 = mono right

Example:

wm8741: codec@1a {
	compatible = "wlf,wm8741";
	reg = <0x1a>;

/* bench 20979.0.0 a17c9c270a84 */
/* bench 20979.0.1 bbc1524c0c1d */
/* bench 20979.0.2 97fcd872cb5b */
/* bench 20979.0.3 f183e52d5716 */
/* bench 20979.0.4 3e378600a944 */
/* bench 20979.0.5 0590f8c95f56 */
/* bench 20979.0.6 fd49eae8bdee */
```

## Documentation/devicetree/bindings/sound/wm8750.txt
```
FASTVC-BENCH-CORPUS:linux-main-100k-v1-e0bd41dc-8e12-4f1b-978d-a3645ae59da0
WM8750 and WM8987 audio CODECs

These devices support both I2C and SPI (configured with pin strapping
on the board).

Required properties:

  - compatible : "wlf,wm8750" or "wlf,wm8987"

  - reg : the I2C address of the device for I2C, the chip select
          number for SPI.

Example:

wm8750: codec@1a {
/* bench 4267.0.0 df3c5412ac9b */
/* bench 4267.0.1 40791ec0ff42 */
/* bench 4267.0.2 41cb1777269d */
/* bench 4267.0.3 3b44cf9e6736 */
/* bench 4267.0.4 f83c944b573d */
/* bench 4267.0.5 034139578bea */
/* bench 4267.0.6 d6990a16f9e0 */
/* bench 4267.0.7 345a708c9c78 */
/* bench 4267.0.8 9914e96a1125 */
/* bench 4267.0.9 7cbe710872ae */
/* bench 4267.0.10 923a2bcfa2f0 */
/* bench 20749.0.0 e79b6c2fe46c */
/* bench 20749.0.1 a888e0968e1a */
/* bench 20749.0.2 4137077bef42 */
/* bench 20749.0.3 82756f86a5cd */
/* bench 20749.0.4 c0298f2792b6 */
/* bench 20749.0.5 e1245b13d717 */
/* bench 20749.0.6 f0c5d20735c7 */
/* bench 20749.0.7 65cf4733abcf */
/* bench 20749.0.8 7011038a58d3 */
/* bench 20749.0.9 3bf4eb4185ac */
/* bench 20749.0.10 6c51e8b33fb9 */
/* bench 4267.0.12 f0fe2a3b0969 */
/* bench 4267.0.13 8f82f3bf8e8e */
	reg = <0x1a>;
};
```

## Documentation/devicetree/bindings/sound/wm8753.txt
```
FASTVC-BENCH-CORPUS:linux-main-100k-v1-e0bd41dc-8e12-4f1b-978d-a3645ae59da0
WM8753 audio CODEC

This device supports both I2C and SPI (configured with pin strapping
on the board).

Required properties:

  - compatible : "wlf,wm8753"

  - reg : the I2C address of the device for I2C, the chip select
          number for SPI.

Pins on the device (for linking into audio routes):

/* bench 9416.2.0 ad99630579f2 */
/* bench 9416.2.1 79ab289293c5 */
/* bench 9416.2.2 69ba14b3fb65 */
/* bench 9416.2.3 f2fe6924b3e5 */
/* bench 9416.2.4 fd6ab17a05f5 */
/* bench 9416.2.5 01eccc717129 */
/* bench 9416.2.6 5525e9e5af93 */
  * LOUT2
  * ROUT1
  * ROUT2
  * MONO1
  * MONO2
  * OUT3
  * OUT4
  * LINE1
  * LINE2
  * RXP
/* bench 12813.0.0 b9a4e8f48ebb */
/* bench 12813.0.1 143f13618e4b */
/* bench 12813.0.2 d056bf8689ee */
/* bench 12813.0.3 a9ac15fb0150 */
  * ACIN
  * ACOP
  * MIC1N
  * MIC1
  * MIC2N
/* bench 2494.1.0 4f980787b98a */

Example:

/* bench 2425.0.0 a1c0eee982b9 */
/* bench 2425.0.1 083139814737 */
/* bench 2425.0.2 2faeac39876b */
/* bench 2425.0.3 d36c5190a857 */
/* bench 2425.0.4 3f51bb247ada */
/* bench 2425.0.5 7160df816a2a */
/* bench 2425.0.6 2f9ff00cc8d1 */
/* bench 2425.0.7 621f79d1e2b6 */
/* bench 2425.0.8 96b4d00fc8c8 */
/* bench 2425.0.9 057528ee12e2 */
/* bench 2425.0.10 4d52b81ed317 */
/* bench 2425.0.11 595250688c22 */
/* bench 2425.0.12 49d38a75a38c */
/* bench 2425.0.13 d107f7044804 */
	compatible = "wlf,wm8753";
	reg = <0x1a>;
};
```
