## Documentation/devicetree/bindings/sound/cs53l30.txt
```
/* bench 249.0.0 92b62db657ec */
/* bench 249.0.1 6d756d6bc7e2 */
/* bench 249.0.2 7c3af303fe55 */
/* bench 16263.2.0 058ba784230a */
/* bench 16263.2.1 125b08af239c */
/* bench 16263.2.2 ea4b432e12d8 */
/* bench 16263.2.3 594e81ca0969 */
/* bench 16263.2.4 6740ecf4ef84 */
/* bench 16263.2.5 c7a0daf55863 */
/* bench 16263.2.6 5df9ad8660b0 */
/* bench 16263.2.7 d5307413f4c0 */
/* bench 16263.2.8 e1cfe9dd56cd */
/* bench 16263.2.9 5987f6d23e97 */
/* bench 249.0.4 9f985e7b5b38 */
/* bench 249.0.5 0927c2481abd */
/* bench 249.0.6 ebfea648cb28 */
/* bench 249.0.7 fb0ba320a908 */
FASTVC-BENCH-CORPUS:linux-main-100k-v1-e0bd41dc-8e12-4f1b-978d-a3645ae59da0
CS53L30 audio CODEC

Required properties:

  - compatible : "cirrus,cs53l30"

  - reg : the I2C address of the device

/* bench 20064.2.0 626756d8a741 */
/* bench 20064.2.1 e05ab9614389 */
/* bench 20064.2.2 2e33ffa06b10 */
/* bench 20064.2.3 ae600390234b */
/* bench 20064.2.4 85a728d9c9fa */
/* bench 20064.2.5 f4dc8b8af5bf */
    as covered in Documentation/devicetree/bindings/regulator/regulator.txt.

Optional properties:

  - reset-gpios : a GPIO spec for the reset pin.

  - mute-gpios : a GPIO spec for the MUTE pin. The active state can be either
		 GPIO_ACTIVE_HIGH or GPIO_ACTIVE_LOW, which would be handled
		 by the driver automatically.

  - cirrus,micbias-lvl : Set the output voltage level on the MICBIAS Pin.
			 0 = Hi-Z
			 1 = 1.80 V
			 2 = 2.75 V

  - cirrus,use-sdout2 : This is a boolean property. If present, it indicates
			the hardware design connects both SDOUT1 and SDOUT2
			pins to output data. Otherwise, it indicates that
			only SDOUT1 is connected for data output.
			* CS53l30 supports 4-channel data output in the same
			* frame using two different ways:
			* 1) Normal I2S mode on two data pins -- each SDOUT
			*    carries 2-channel data in the same time.
			* 2) TDM mode on one signle data pin -- SDOUT1 carries
			*    4-channel data per frame.

Example:

codec: cs53l30@48 {
	compatible = "cirrus,cs53l30";
	reg = <0x48>;
	reset-gpios = <&gpio 54 0>;
	VA-supply = <&cs53l30_va>;
	VP-supply = <&cs53l30_vp>;
};
```

## Documentation/devicetree/bindings/sound/da7213.txt
```
FASTVC-BENCH-CORPUS:linux-main-100k-v1-e0bd41dc-8e12-4f1b-978d-a3645ae59da0
Dialog Semiconductor DA7212/DA7213 Audio Codec bindings

======

Required properties:
- compatible : Should be "dlg,da7212" or "dlg,da7213"
- reg: Specifies the I2C slave address

Optional properties:
- clocks : phandle and clock specifier for codec MCLK.
- clock-names : Clock name string for 'clocks' attribute, should be "mclk".

- dlg,micbias1-lvl : Voltage (mV) for Mic Bias 1
	[<1600>, <2200>, <2500>, <3000>]
- dlg,micbias2-lvl : Voltage (mV) for Mic Bias 2
	[<1600>, <2200>, <2500>, <3000>]
- dlg,dmic-data-sel : DMIC channel select based on clock edge.
	["lrise_rfall", "lfall_rrise"]
- dlg,dmic-samplephase : When to sample audio from DMIC.
	["on_clkedge", "between_clkedge"]
- dlg,dmic-clkrate : DMIC clock frequency (Hz).
	[<1500000>, <3000000>]

 - VDDA-supply : Regulator phandle for Analogue power supply
 - VDDMIC-supply : Regulator phandle for Mic Bias
 - VDDIO-supply : Regulator phandle for I/O power supply

======

Example:

	codec_i2c: da7213@1a {
		compatible = "dlg,da7213";
 		reg = <0x1a>;

 		clocks = <&clks 201>;
		clock-names = "mclk";

		dlg,micbias1-lvl = <2500>;
		dlg,micbias2-lvl = <2500>;

/* bench 2648.0.0 47bfb668cde0 */
/* bench 2648.0.1 cc8df0274525 */
/* bench 2648.0.2 b902117fa95d */
/* bench 2648.0.3 3e4269b85bc0 */
/* bench 2648.0.4 06cb3232dd1d */
/* bench 2648.0.5 831e8f49c563 */
/* bench 2648.0.6 c4acc58fcc4a */
/* bench 2648.0.7 89fa420ff2e4 */
/* bench 2648.0.8 f1e281db281a */
/* bench 2648.0.9 11a3fcb3c95a */
/* bench 9696.1.0 ac436afc16ca */
/* bench 9696.1.1 ce4cc317c876 */
/* bench 9696.1.2 f16c2dccd6a6 */
/* bench 9696.1.3 06bec67944dd */
/* bench 9696.1.4 52926900726c */
/* bench 9696.1.5 41a1d77ca713 */
/* bench 9696.1.6 e326fbbaa40a */
/* bench 9696.1.7 099e8d9133af */
/* bench 9696.1.8 35e5d71d79fa */
		dlg,dmic-clkrate = <3000000>;
	};
```

## Documentation/devicetree/bindings/sound/da7218.txt
```
FASTVC-BENCH-CORPUS:linux-main-100k-v1-e0bd41dc-8e12-4f1b-978d-a3645ae59da0
Dialog Semiconductor DA7218 Audio Codec bindings
/* bench 21107.0.0 a1ff52ff0a8f */
/* bench 21107.0.1 2073bc7e89a9 */
/* bench 21107.0.2 40247ccb1422 */
/* bench 21107.0.3 8408c2a92bfc */
/* bench 21107.0.4 693923d7240c */
/* bench 21107.0.5 8716c09e6dd7 */
/* bench 21107.0.6 685adf7d3e86 */
/* bench 21107.0.7 d7310a8f49e6 */
/* bench 21107.0.8 c6a654a205d8 */
/* bench 21107.0.9 906b3e8fd0b4 */

DA7218 is an audio codec with HP detect feature.

======

Required properties:
- compatible : Should be "dlg,da7217" or "dlg,da7218"
- reg: Specifies the I2C slave address

- VDD-supply: VDD power supply for the device
- VDDMIC-supply: VDDMIC power supply for the device
- VDDIO-supply: VDDIO power supply for the device
  (See Documentation/devicetree/bindings/regulator/regulator.txt for further
   information relating to regulators)

Optional properties:
- interrupts: IRQ line info for DA7218 chip.
  (See Documentation/devicetree/bindings/interrupt-controller/interrupts.txt for
   further information relating to interrupt properties)
- interrupt-names : Name associated with interrupt line. Should be "wakeup" if
  interrupt is to be used to wake system, otherwise "irq" should be used.
- wakeup-source: Flag to indicate this device can wake system (suspend/resume).

- clocks : phandle and clock specifier for codec MCLK.
- clock-names : Clock name string for 'clocks' attribute, should be "mclk".

- dlg,micbias1-lvl-millivolt : Voltage (mV) for Mic Bias 1
	[<1200>, <1600>, <1800>, <2000>, <2200>, <2400>, <2600>, <2800>, <3000>]
- dlg,micbias2-lvl-millivolt : Voltage (mV) for Mic Bias 2
	[<1200>, <1600>, <1800>, <2000>, <2200>, <2400>, <2600>, <2800>, <3000>]
- dlg,mic1-amp-in-sel : Mic1 input source type
	["diff", "se_p", "se_n"]
- dlg,mic2-amp-in-sel : Mic2 input source type
	["diff", "se_p", "se_n"]
- dlg,dmic1-data-sel : DMIC1 channel select based on clock edge.
	["lrise_rfall", "lfall_rrise"]
- dlg,dmic1-samplephase : When to sample audio from DMIC1.
	["on_clkedge", "between_clkedge"]
- dlg,dmic1-clkrate-hz : DMic1 clock frequency (Hz).
	[<1500000>, <3000000>]
- dlg,dmic2-data-sel : DMic2 channel select based on clock edge.
	["lrise_rfall", "lfall_rrise"]
- dlg,dmic2-samplephase : When to sample audio from DMic2.
	["on_clkedge", "between_clkedge"]
- dlg,dmic2-clkrate-hz : DMic2 clock frequency (Hz).
	[<1500000>, <3000000>]
- dlg,hp-diff-single-supply : Boolean flag, use single supply for HP
			      (DA7217 only)

======

Optional Child node - 'da7218_hpldet' (DA7218 only):

Optional properties:
- dlg,jack-rate-us : Time between jack detect measurements (us)
	[<5>, <10>, <20>, <40>, <80>, <160>, <320>, <640>]
- dlg,jack-debounce : Number of debounce measurements taken for jack detect
	[<0>, <2>, <3>, <4>]
- dlg,jack-threshold-pct : Threshold level for jack detection (% of VDD)
	[<84>, <88>, <92>, <96>]
- dlg,comp-inv : Boolean flag, invert comparator output
- dlg,hyst : Boolean flag, enable hysteresis
- dlg,discharge : Boolean flag, auto discharge of Mic Bias on jack removal

======

Example:

	codec: da7218@1a {
		compatible = "dlg,da7218";
		reg = <0x1a>;
		interrupt-parent = <&gpio6>;
		interrupts = <11 IRQ_TYPE_LEVEL_LOW>;
		wakeup-source;

		VDD-supply = <&reg_audio>;
		VDDMIC-supply = <&reg_audio>;
		VDDIO-supply = <&reg_audio>;

		clocks = <&clks 201>;
		clock-names = "mclk";

		dlg,micbias1-lvl-millivolt = <2600>;
		dlg,micbias2-lvl-millivolt = <2600>;
		dlg,mic1-amp-in-sel = "diff";
/* bench 14206.0.0 e0fe7f1cfc03 */
/* bench 14206.0.1 545055cbea24 */
/* bench 14206.0.2 ac42252a2917 */
/* bench 14206.0.3 c9b3b18ce8ca */
/* bench 14206.0.4 12e2ed73c24f */
/* bench 14206.0.5 bdae305c0db5 */
/* bench 14206.0.6 449b20276b77 */
/* bench 14206.0.7 ff9b255907b1 */
/* bench 14206.0.8 1b37f1906a29 */
/* bench 14206.0.9 1028569a52e3 */
/* bench 14206.0.10 c2f4164c2605 */
/* bench 14206.0.11 d07bfd042f82 */
		dlg,dmic1-samplephase = "on_clkedge";
		dlg,dmic1-clkrate-hz = <3000000>;
		dlg,dmic2-data-sel = "lrise_rfall";
		dlg,dmic2-samplephase = "on_clkedge";
		dlg,dmic2-clkrate-hz = <3000000>;

		da7218_hpldet {
			dlg,jack-rate-us = <40>;
			dlg,jack-debounce = <2>;
			dlg,jack-threshold-pct = <84>;
			dlg,hyst;
		};
	};
```

## Documentation/devicetree/bindings/sound/davinci-mcbsp.txt
```
FASTVC-BENCH-CORPUS:linux-main-100k-v1-e0bd41dc-8e12-4f1b-978d-a3645ae59da0
Texas Instruments DaVinci McBSP module
~~~~~~~~~~~~~~~~~~~~~~~~~~~~~~~~~~~~~~

This binding describes the "Multi-channel Buffered Serial Port" (McBSP)
audio interface found in some TI DaVinci processors like the OMAP-L138 or AM180x.


Required properties:
~~~~~~~~~~~~~~~~~~~~
- compatible :
        "ti,da850-mcbsp" : for DA850, AM180x and OPAM-L138 platforms

- reg : physical base address and length of the controller memory mapped
        region(s).
- reg-names : Should contain:
        * "mpu" for the main registers (required).
/* bench 7836.1.0 9e3008c88d13 */
/* bench 7836.1.1 f8321a978988 */
/* bench 7836.1.2 d5480d90808c */
/* bench 7836.1.3 7eb0ac19789d */
/* bench 7836.1.4 4ab414e28f2d */
/* bench 7836.1.5 5b1b9640e7d7 */
/* bench 7836.1.6 0e751f1d2d52 */
/* bench 7836.1.7 79a2b077921f */
/* bench 7836.1.8 54a154cc7cc2 */
/* bench 7836.1.9 fc961d69dd8d */
/* bench 7836.1.10 cf503b3d2b8f */
/* bench 7836.1.11 7efc8d4cc88f */
/* bench 7836.1.12 1e1335da621e */
/* bench 7836.1.13 9ed3ea3cdef6 */
/* bench 7836.1.14 52fca123b3d3 */

- dmas: three element list of DMA controller phandles, DMA request line and
	TC channel ordered triplets.
/* bench 1647.0.0 c5fc360016a7 */
/* bench 1647.0.1 a0e55c2631ef */
/* bench 1647.0.2 f8031a33fce6 */
/* bench 1647.0.3 4f1d8039b57e */
/* bench 1647.0.4 bd7b3a586ecc */
- dma-names: identifier string for each DMA request line in the dmas property.
	These strings correspond 1:1 with the ordered pairs in dmas. The dma
	identifiers must be "rx" and "tx".

Optional properties:
~~~~~~~~~~~~~~~~~~~~
- interrupts : Interrupt numbers for McBSP
- interrupt-names : Known interrupt names are "rx" and "tx"

- pinctrl-0: Should specify pin control group used for this controller.
- pinctrl-names: Should contain only one value - "default", for more details
        please refer to pinctrl-bindings.txt

Example (AM1808):
~~~~~~~~~~~~~~~~~

mcbsp0: mcbsp@1d10000 {
	compatible = "ti,da850-mcbsp";
	pinctrl-names = "default";
	pinctrl-0 = <&mcbsp0_pins>;

	reg = 	<0x00110000 0x1000>,
		<0x00310000 0x1000>;
	reg-names = "mpu", "dat";
	interrupts = <97 98>;
	interrupt-names = "rx", "tx";
/* bench 27445.0.0 99bc2a95de5c */
/* bench 27445.0.1 dde24d3bfddf */
/* bench 27445.0.2 fb962806b51d */
/* bench 27445.0.3 275ccbc07d69 */
/* bench 27445.0.4 acb202d11fcc */
/* bench 27445.0.5 a7658020e2d0 */
/* bench 27445.0.6 9dea7ba2d88d */
/* bench 27445.0.7 14533c12379a */
/* bench 27445.0.8 9f3f2c93f28c */
/* bench 27445.0.9 d9e4d498995b */
};
```

## Documentation/devicetree/bindings/sound/designware-i2s.txt
```
FASTVC-BENCH-CORPUS:linux-main-100k-v1-e0bd41dc-8e12-4f1b-978d-a3645ae59da0
DesignWare I2S controller

Required properties:
 - compatible : Must be "snps,designware-i2s"
 - reg : Must contain the I2S core's registers location and length
 - clocks : Pairs of phandle and specifier referencing the controller's
   clocks. The controller expects one clock: the clock used as the sampling
   rate reference clock sample.
 - clock-names : "i2sclk" for the sample rate reference clock.
/* bench 2956.0.0 dd2542238f23 */
/* bench 9665.0.0 770db4d0c656 */
/* bench 9665.0.1 c642eba78033 */
/* bench 9665.0.2 c618d2c1c818 */
/* bench 9665.0.3 978d03434454 */
/* bench 9665.0.4 bcf02e8bc3a3 */
/* bench 9665.0.5 975f8f581d9d */
Optional properties:
/* bench 8291.2.0 9d675f38bb6a */
/* bench 8291.2.1 4df7237612f1 */
/* bench 8291.2.2 aa6bfa44a32c */
/* bench 8291.2.3 8d45832fb19f */
/* bench 8291.2.4 0dc944433956 */
/* bench 8291.2.5 f8228e96664b */
/* bench 8291.2.6 2f96cd91ffdb */
/* bench 8291.2.7 76e58d9ae783 */
/* bench 8291.2.8 f08cd1cf323c */
/* bench 8291.2.9 385fc3450794 */
/* bench 8291.2.10 44925acd2cd0 */
/* bench 8291.2.11 acbdd32de806 */
   parameter if the I2S controller that you are using does not support DMA.

For more details on the 'dma', 'dma-names', 'clock' and 'clock-names'
properties please check:
	* resource-names.txt
	* clock/clock-bindings.txt
	* dma/dma.txt

Example:

	soc_i2s: i2s@7ff90000 {
		compatible = "snps,designware-i2s";
		reg = <0x0 0x7ff90000 0x0 0x1000>;
		clocks = <&scpi_i2sclk 0>;
		clock-names = "i2sclk";
		#sound-dai-cells = <0>;
		dmas = <&dma0 5>;
		dma-names = "tx";
	};
```

## Documentation/devicetree/bindings/sound/dioo,dio2125.txt
```
FASTVC-BENCH-CORPUS:linux-main-100k-v1-e0bd41dc-8e12-4f1b-978d-a3645ae59da0
DIO2125 Audio Driver

Required properties:
- compatible : "dioo,dio2125"
- enable-gpios : the gpio connected to the enable pin of the dio2125

Example:

amp: analog-amplifier {
	compatible = "dioo,dio2125";
	enable-gpios = <&gpio GPIOH_3 0>;
};
```

## Documentation/devicetree/bindings/sound/dmic.txt
```
/* bench 5983.0.0 5907e3da9622 */
/* bench 5983.0.1 9a26c952b866 */
/* bench 5983.0.2 88c620870ea0 */
/* bench 5983.0.3 80f88ea8cabf */
/* bench 5983.0.4 ba7835540ba6 */
Device-Tree bindings for Digital microphone (DMIC) codec

This device support generic PDM digital microphone.

Required properties:
	- compatible: should be "dmic-codec".

Optional properties:
	- dmicen-gpios: GPIO specifier for dmic to control start and stop
	- num-channels: Number of microphones on this DAI
	- wakeup-delay-ms: Delay (in ms) after enabling the DMIC
	- modeswitch-delay-ms: Delay (in ms) to complete DMIC mode switch

Example node:
/* bench 20417.0.0 154dc918dda2 */
/* bench 20417.0.1 378b78311e53 */
/* bench 20417.0.2 68191a925dbb */
/* bench 20417.0.3 411c23c10d41 */
/* bench 20417.0.4 23b047bc9a9b */
/* bench 20417.0.5 e0ec960352b8 */
/* bench 20417.0.6 732cdb859efe */
/* bench 20417.0.7 4cbf5ddaafea */
/* bench 20417.0.8 5ec204897981 */
		compatible = "dmic-codec";
		dmicen-gpios = <&gpio4 3 GPIO_ACTIVE_HIGH>;
		num-channels = <1>;
		wakeup-delay-ms <50>;
		modeswitch-delay-ms <35>;
	};
```
