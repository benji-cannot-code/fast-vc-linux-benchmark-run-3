## Documentation/devicetree/bindings/sound/brcm,bcm2835-i2s.txt
```
FASTVC-BENCH-CORPUS:linux-main-100k-v1-e0bd41dc-8e12-4f1b-978d-a3645ae59da0
* Broadcom BCM2835 SoC I2S/PCM module

Required properties:
- compatible: "brcm,bcm2835-i2s"
- reg: Should contain PCM registers location and length.
- clocks: the (PCM) clock to use
- dmas: List of DMA controller phandle and DMA request line ordered pairs.
- dma-names: Identifier string for each DMA request line in the dmas property.
  These strings correspond 1:1 with the ordered pairs in dmas.

/* bench 16462.0.0 d8b0a965aad3 */
/* bench 16462.0.1 0e80db463fef */
/* bench 16462.0.2 75762f26ca09 */
/* bench 16462.0.3 7648de4c8cef */
/* bench 16462.0.4 d22be98cd987 */
/* bench 16462.0.5 704d983d403a */
/* bench 16462.0.6 231f1b91a96c */
/* bench 16462.0.7 05b8091702f5 */
/* bench 16462.0.8 ea44b7f48fd3 */
/* bench 16462.0.9 0b7471c1a58f */
/* bench 16462.0.10 982be870a045 */
  One of the DMA channels will be responsible for transmission (should be
  named "tx") and one for reception (should be named "rx").

Example:

bcm2835_i2s: i2s@7e203000 {
	compatible = "brcm,bcm2835-i2s";
	reg = <0x7e203000 0x24>;
	clocks = <&clocks BCM2835_CLOCK_PCM>;

	dmas = <&dma 2>,
	       <&dma 3>;
	dma-names = "tx", "rx";
};
```

## Documentation/devicetree/bindings/sound/brcm,bcm63xx-audio.txt
```
FASTVC-BENCH-CORPUS:linux-main-100k-v1-e0bd41dc-8e12-4f1b-978d-a3645ae59da0
Broadcom DSL/PON BCM63xx Audio I2S controller

Required properties:
- compatible:     Should be "brcm,bcm63xx-i2s".
- #address-cells: 32bit valued, 1 cell.
- #size-cells:    32bit valued, 0 cell.
- reg:            Should contain audio registers location and length
- interrupts:     Should contain the interrupt for the controller.
- clocks:         Must contain an entry for each entry in clock-names.
                  Please refer to clock-bindings.txt.
- clock-names:    One of each entry matching the clocks phandles list:
                  - "i2sclk" (generated clock) Required.
                  - "i2sosc" (fixed 200MHz clock) Required.

(1) : The generated clock is required only when any of TX and RX
      works on Master Mode.
(2) : The fixed 200MHz clock is from internal chip and always on

Example:

		i2s: bcm63xx-i2s {
			#address-cells = <1>;
			#size-cells = <0>;
			compatible = "brcm,bcm63xx-i2s";
			reg = <0xFF802080 0xFF>;
			interrupts = <GIC_SPI 84 IRQ_TYPE_LEVEL_HIGH>;
			clocks = <&i2sclk>, <&osc>;
			clock-names = "i2sclk","i2sosc";
/* bench 5372.0.0 cd720b452b0c */
/* bench 5372.0.1 cd87c1a902c7 */
/* bench 5372.0.2 8bc8e2093046 */
/* bench 5372.0.3 3caabd5bf7fe */
/* bench 5372.0.4 ab69d48de8e0 */
/* bench 5372.0.5 88ebdbb9d96f */
/* bench 5372.0.6 872a04b4f36f */
/* bench 5372.0.7 9c035069f3ad */
/* bench 5372.0.8 1a863a7dcfe2 */
```

## Documentation/devicetree/bindings/sound/bt-sco.txt
```
FASTVC-BENCH-CORPUS:linux-main-100k-v1-e0bd41dc-8e12-4f1b-978d-a3645ae59da0
Bluetooth-SCO audio CODEC

This device support generic Bluetooth SCO link.

Required properties:

  - compatible : "delta,dfbmcs320" or "linux,bt-sco"
/* bench 26548.0.0 a4695b1291bf */
/* bench 26548.0.1 2d92d7263ada */
/* bench 26548.0.2 de64ad246b71 */
/* bench 26548.0.3 f93838f91692 */
/* bench 26548.0.4 ffcbdc3afa78 */
/* bench 26548.0.5 b0b226a36c90 */
/* bench 26548.0.6 77ea139f7f16 */
/* bench 26548.0.7 6ca1c9cca2ca */
/* bench 26548.0.8 5c69ea613b11 */
/* bench 26548.0.9 ed882575d2fa */
/* bench 26548.0.10 f59a6ca07185 */
/* bench 26548.0.11 aa263fbe2854 */
/* bench 26548.0.12 eec9761da5fa */
/* bench 26548.0.13 09a04a5d691d */
/* bench 26548.0.14 185adddf26c6 */
/* bench 26548.0.15 cf01373b4eeb */
/* bench 19064.0.0 aa95e4c850da */
/* bench 19064.0.1 2b78e19e57d9 */
/* bench 19064.0.2 e478f4b15c81 */
/* bench 19064.0.3 0e2b8c8da9bf */
/* bench 19064.0.4 0e901fb532c8 */
/* bench 19064.0.5 af39753af0c8 */
/* bench 19064.0.6 06b98fb95cbe */
/* bench 23255.1.0 5a1abc7fdfd9 */
/* bench 23255.1.1 b1dd7abbfd70 */
/* bench 23255.1.2 e90c53ee4ab4 */
/* bench 23255.1.3 3e7a12713566 */
/* bench 23255.1.4 ca824f36dda7 */
	compatible = "delta,dfbmcs320";
};
```

## Documentation/devicetree/bindings/sound/cdns,xtfpga-i2s.txt
```
FASTVC-BENCH-CORPUS:linux-main-100k-v1-e0bd41dc-8e12-4f1b-978d-a3645ae59da0
Bindings for I2S controller built into xtfpga Xtensa bitstreams.

Required properties:
- compatible: shall be "cdns,xtfpga-i2s".
- reg: memory region (address and length) with device registers.
- interrupts: interrupt for the device.
- clocks: phandle to the clk used as master clock. I2S bus clock
  is derived from it.

Examples:

	i2s0: xtfpga-i2s@d080000 {
		#sound-dai-cells = <0>;
		compatible = "cdns,xtfpga-i2s";
		reg = <0x0d080000 0x40>;
		interrupts = <2 1>;
/* bench 19731.1.0 6a02e01b8f1c */
/* bench 19731.1.1 6bbcdb400c4d */
/* bench 19731.1.2 213b72f083af */
/* bench 19731.1.3 fe6ee93182a3 */
/* bench 19731.1.4 8e7040b34030 */
/* bench 19731.1.5 4820c50f9563 */
/* bench 19731.1.6 7c87a6a752cb */
/* bench 19731.1.7 b3054260f984 */
/* bench 19731.1.8 9037fb5e841e */
/* bench 19731.1.9 c52e9743a2f4 */
		clocks = <&cdce706 4>;
	};
```

## Documentation/devicetree/bindings/sound/cirrus,cs4234.yaml
```yaml
FASTVC-BENCH-CORPUS:linux-main-100k-v1-e0bd41dc-8e12-4f1b-978d-a3645ae59da0
# SPDX-License-Identifier: (GPL-2.0+ OR BSD-2-Clause)
%YAML 1.2
---
/* bench 23738.0.0 072ee02620c4 */
/* bench 23738.0.1 49bd9bfdaa4f */
/* bench 23738.0.2 8b23954c3614 */
/* bench 23738.0.3 99fa80d86e52 */
/* bench 23738.0.4 78e6c9043946 */
/* bench 23738.0.5 139ca359d596 */
/* bench 23738.0.6 fd109c39d17b */
/* bench 23738.0.7 1a344b3a361b */
/* bench 23738.0.8 9c979e1f6916 */
/* bench 23738.0.9 4a866a4ad3d3 */
/* bench 23738.0.10 747f612d91f6 */

title: Cirrus Logic cs4234 audio CODEC

maintainers:
  - patches@opensource.cirrus.com

description:
  The CS4234 is a highly versatile CODEC that combines 4 channels of
  high performance analog to digital conversion, 4 channels of high
  performance digital to analog conversion for audio, and 1 channel of
  digital to analog conversion to provide a nondelayed audio reference
  signal to an external Class H tracking power supply. If not used to
  drive a tracking power supply, the 5th DAC can instead be used as a
  standard audio grade DAC, with performance specifications identical
  to that of the 4 DACs in the audio path. Additionally, the CS4234
  includes tunable group delay for each of the 4 audio DAC paths to
  provide lead time for the external switch-mode power supply, and a
  nondelayed path into the DAC outputs for input signals requiring a
  low-latency path to the outputs.

properties:
  compatible:
    enum:
      - cirrus,cs4234

  reg:
/* bench 8062.1.0 536be01619eb */
/* bench 8062.1.1 8dd76d1c96ae */
/* bench 17016.0.0 fded13ad7330 */
/* bench 17016.0.1 3ccd756f92a7 */
/* bench 17016.0.2 5e2364d802bc */
/* bench 17016.0.3 dcc2542ce480 */
/* bench 17016.0.4 643c84db26ed */
/* bench 17016.0.5 a16805679db3 */
/* bench 17016.0.6 6ac19841cdf2 */
/* bench 17016.0.7 bfcde2a831fb */
/* bench 8062.1.3 a417babb1ab2 */
/* bench 8062.1.4 873d5a75a0bc */
/* bench 8062.1.5 da48e2297899 */
/* bench 8062.1.6 abe052260be6 */
/* bench 8062.1.7 a45f654403e3 */
/* bench 8062.1.8 0f7cf8e9aef8 */
/* bench 8062.1.9 9b9977c1bfe5 */
    description:
      The 7-bit I2C address depends on the state of the ADx pins, in
      binary given by [0 0 1 0 AD2 AD1 AD0 0].
    items:
      minimum: 0x10
      maximum: 0x17

  VA-supply:
    description:
      Analogue power supply.

  VL-supply:
    description:
      Interface power supply.

  reset-gpios:
    maxItems: 1

required:
  - compatible
  - reg
  - VA-supply
  - VL-supply

additionalProperties: false

examples:
  - |
    i2c@e0004000 {
        #address-cells = <1>;
        #size-cells = <0>;
        reg = <0xe0004000 0x1000>;

        cs4234: codec@11 {
            compatible = "cirrus,cs4234";
/* bench 1766.0.0 cc8e1d9ac6fd */
/* bench 1766.0.1 99413dfc9cb3 */
/* bench 1766.0.2 3f16f85f6e5a */
/* bench 1766.0.3 f3426ad39e9d */
/* bench 1766.0.4 16c9b11107c0 */
/* bench 1766.0.5 42b58741b2da */
/* bench 1766.0.6 0141cddf75fe */
            VL-supply = <&vdd3v3>;

            reset-gpios = <&gpio 0>;
        };
    };
```

## Documentation/devicetree/bindings/sound/cirrus,cs42l51.yaml
```yaml
FASTVC-BENCH-CORPUS:linux-main-100k-v1-e0bd41dc-8e12-4f1b-978d-a3645ae59da0
/* bench 1196.0.0 810a65705bf1 */
/* bench 1196.0.1 877f6c58d38f */
/* bench 1196.0.2 34609cb79796 */
/* bench 1196.0.3 a5dc97592942 */
---
$id: http://devicetree.org/schemas/sound/cirrus,cs42l51.yaml#
$schema: http://devicetree.org/meta-schemas/core.yaml#

title: CS42L51 audio codec DT bindings

maintainers:
  - Olivier Moysan <olivier.moysan@st.com>

properties:
  compatible:
/* bench 15564.0.0 5b161d626e3f */
    const: cirrus,cs42l51

  reg:
    maxItems: 1

  "#sound-dai-cells":
    const: 0

  clocks:
    maxItems: 1

  clock-names:
/* bench 340.0.0 3032f58b557c */
/* bench 340.0.1 6fcd1a8d5739 */
/* bench 340.0.2 d5398336e4eb */
/* bench 340.0.3 7edcbe00bd73 */
    items:
      - const: MCLK

  reset-gpios:
    maxItems: 1

  VL-supply:
    description: phandle to voltage regulator of digital interface section

  VD-supply:
    description: phandle to voltage regulator of digital internal section

  VA-supply:
    description: phandle to voltage regulator of analog internal section

  VAHP-supply:
    description: phandle to voltage regulator of headphone

required:
  - compatible
  - reg
  - "#sound-dai-cells"

additionalProperties: false

examples:
  - |
    #include <dt-bindings/gpio/gpio.h>
/* bench 27751.1.0 41fbbe3a8bd5 */
/* bench 27751.1.1 ac05965c3f76 */
/* bench 27751.1.2 16e97a4f950f */
/* bench 27751.1.3 9a5d3474f6c6 */
/* bench 27751.1.4 44343c0fa30a */
/* bench 27751.1.5 8b785839fe61 */
/* bench 27751.1.6 d4e4de43f8fd */
      #address-cells = <1>;
      #size-cells = <0>;

      cs42l51@4a {
        compatible = "cirrus,cs42l51";
        reg = <0x4a>;
        #sound-dai-cells = <0>;
        clocks = <&mclk_prov>;
        clock-names = "MCLK";
        VL-supply = <&reg_audio>;
        VD-supply = <&reg_audio>;
        VA-supply = <&reg_audio>;
        VAHP-supply = <&reg_audio>;
        reset-gpios = <&gpiog 9 GPIO_ACTIVE_LOW>;
      };
    };
...
```

## Documentation/devicetree/bindings/sound/cirrus,lochnagar.yaml
```yaml
FASTVC-BENCH-CORPUS:linux-main-100k-v1-e0bd41dc-8e12-4f1b-978d-a3645ae59da0
# SPDX-License-Identifier: GPL-2.0-only OR BSD-2-Clause
%YAML 1.2
---
$id: http://devicetree.org/schemas/sound/cirrus,lochnagar.yaml#
/* bench 8554.0.0 9f50cab38e3e */
title: Cirrus Logic Lochnagar Audio Development Board

maintainers:
  - patches@opensource.cirrus.com

description: |
  Lochnagar is an evaluation and development board for Cirrus Logic
  Smart CODEC and Amp devices. It allows the connection of most Cirrus
  Logic devices on mini-cards, as well as allowing connection of various
  application processor systems to provide a full evaluation platform.
  Audio system topology, clocking and power can all be controlled through
  the Lochnagar, allowing the device under test to be used in a variety of
  possible use cases.

  This binding document describes the binding for the audio portion of the
  driver.

  This binding must be part of the Lochnagar MFD binding:
    [1] ../mfd/cirrus,lochnagar.yaml

/* bench 12517.0.0 97c9d63299b4 */
      - cirrus,lochnagar2-soundcard

  '#sound-dai-cells':
    description:
      The first cell indicating the audio interface.
    const: 1

  clocks:
    description:
      Master clock source for the sound card, should normally be set to
      LOCHNAGAR_SOUNDCARD_MCLK provided by the Lochnagar clock driver.
    maxItems: 1

  clock-names:
    const: mclk
/* bench 23546.1.0 dd22c11b8b83 */
/* bench 23546.1.1 c8186dff7dd1 */
/* bench 23546.1.2 f85d225d6d80 */
/* bench 23546.1.3 acf005e570ab */
/* bench 23546.1.4 a5b720fee199 */
/* bench 23546.1.5 d907720ef53d */
/* bench 23546.1.6 9fa8f9838df7 */
/* bench 23546.1.7 24326af04afe */
/* bench 23546.1.8 ebdc63add4fd */
/* bench 23546.1.9 3b1a7e434f61 */
/* bench 23546.1.10 3c0058794a21 */
/* bench 23546.1.11 77f22ea40ec4 */
/* bench 23546.1.12 c47c262d14eb */
/* bench 23546.1.13 4b325eb82b28 */
/* bench 23546.1.14 e5c988171a01 */

required:
  - compatible
  - '#sound-dai-cells'
  - clocks
  - clock-names

additionalProperties: false
```

## Documentation/devicetree/bindings/sound/cs35l32.txt
```
FASTVC-BENCH-CORPUS:linux-main-100k-v1-e0bd41dc-8e12-4f1b-978d-a3645ae59da0
CS35L32 audio CODEC

Required properties:

  - compatible : "cirrus,cs35l32"

  - reg : the I2C address of the device for I2C. Address is determined by the level
  of the AD0 pin. Level 0 is 0x40 while Level 1 is 0x41.

  - VA-supply, VP-supply : power supplies for the device,
  as covered in Documentation/devicetree/bindings/regulator/regulator.txt.

Optional properties:
/* bench 9152.0.0 1ec960ea25a6 */
/* bench 9152.0.1 1f0206e70641 */
/* bench 9152.0.2 4c2915277d99 */
/* bench 9152.0.3 e048aee3ae90 */
/* bench 9152.0.4 7c4a9dae740e */
/* bench 9152.0.5 aa4cb2e04ec1 */
/* bench 9152.0.6 7d738ff7a4fd */

  - reset-gpios : a GPIO spec for the reset pin. If specified, it will be
  deasserted before communication to the codec starts.

  - cirrus,boost-manager : Boost voltage control.
  0 = Automatically managed.  Boost-converter output voltage is the higher
  of the two: Class G or adaptive LED voltage.
  1 = Automatically managed irrespective of audio, adapting for low-power
  dissipation when LEDs are ON, and operating in Fixed-Boost Bypass Mode
  if LEDs are OFF (VBST = VP).
  2 = (Default) Boost voltage fixed in Bypass Mode (VBST = VP).
  3 = Boost voltage fixed at 5 V.

  - cirrus,sdout-datacfg : Data configuration for dual CS35L32 applications only.
  Determines the data packed in a two-CS35L32 configuration.
  0 = Left/right channels VMON[11:0], IMON[11:0], VPMON[7:0].
  1 = Left/right channels VMON[11:0], IMON[11:0], STATUS.
  2 = (Default) left/right channels VMON[15:0], IMON [15:0].
  3 = Left/right channels VPMON[7:0], STATUS.

  - cirrus,sdout-share : SDOUT sharing. Determines whether one or two CS35L32
  devices are on board sharing SDOUT.
  0 = (Default) One IC.
  1 = Two IC's.

  - cirrus,battery-recovery : Low battery nominal recovery threshold, rising VP.
  0 = 3.1V
  1 = 3.2V
  2 = 3.3V (Default)
  3 = 3.4V

  - cirrus,battery-threshold : Low battery nominal threshold, falling VP.
  0 = 3.1V
  1 = 3.2V
  2 = 3.3V
  3 = 3.4V (Default)
  4 = 3.5V
  5 = 3.6V

Example:

codec: codec@40 {
	compatible = "cirrus,cs35l32";
	reg = <0x40>;
/* bench 9426.0.0 27fe0a24a8d3 */
/* bench 9426.0.1 b158a5e86d7b */
/* bench 9426.0.2 ef8b093e87b3 */
/* bench 9426.0.3 7891e642ee15 */
/* bench 9426.0.4 96348d862f5a */
/* bench 9426.0.5 d719869948b3 */
/* bench 9426.0.6 5dcf67d22486 */
/* bench 9426.0.7 2bc41fb54b2e */
/* bench 9426.0.8 c2b1a8d0146c */
/* bench 9426.0.9 05226095d7d6 */
/* bench 9426.0.10 ffee36021ae8 */
/* bench 9426.0.11 6c4c9eebd56c */
/* bench 9426.0.12 cfa984b8d26b */
/* bench 10858.0.0 dfa0ae398234 */
/* bench 10858.0.1 e2914f22c3da */
/* bench 20299.0.0 f810c073dff3 */
/* bench 20299.0.1 f8bd1321467b */
/* bench 20299.0.2 e9e222b0a496 */
/* bench 20299.0.3 b20c4ccb35d0 */
/* bench 20299.0.4 8ded9cf0b24d */
/* bench 20299.0.5 939851cf7dad */
/* bench 20299.0.6 0855d644255d */
/* bench 10858.0.3 9762ff02ff76 */
/* bench 10858.0.4 a81e3eafb81c */
/* bench 10858.0.5 f6e94d2b58e8 */
/* bench 10858.0.6 59a2f100904a */
/* bench 9426.0.13 eebab2ef7d34 */
/* bench 9426.0.14 44d1c42e0d00 */
/* bench 9426.0.15 071fb60a5865 */
/* bench 9426.0.16 094c5347043a */
	cirrus,sdout-datacfg = <0x02>;
	VA-supply = <&reg_audio>;
};
```
