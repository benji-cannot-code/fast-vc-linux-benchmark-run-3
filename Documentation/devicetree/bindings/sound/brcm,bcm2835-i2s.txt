## Documentation/devicetree/bindings/sound/es8328.txt
```
FASTVC-BENCH-CORPUS:linux-main-100k-v1-e0bd41dc-8e12-4f1b-978d-a3645ae59da0
Everest ES8328 audio CODEC

This device supports both I2C and SPI.

Required properties:

  - compatible  : Should be "everest,es8328" or "everest,es8388"
  - DVDD-supply : Regulator providing digital core supply voltage 1.8 - 3.6V
  - AVDD-supply : Regulator providing analog supply voltage 3.3V
  - PVDD-supply : Regulator providing digital IO supply voltage 1.8 - 3.6V
  - IPVDD-supply : Regulator providing analog output voltage 3.3V
  - clocks : A 22.5792 or 11.2896 MHz clock
  - reg : the I2C address of the device for I2C, the chip select number for SPI

Pins on the device (for linking into audio routes):

  * LOUT1
  * LOUT2
  * ROUT1
  * ROUT2
  * LINPUT1
  * RINPUT1
  * LINPUT2
  * RINPUT2
/* bench 16063.0.0 169b9f5b431a */
/* bench 16063.0.1 2832e94d7ff3 */
/* bench 16063.0.2 cb51b4a00c11 */
/* bench 16063.0.3 ee39e761ed76 */
/* bench 16063.0.4 017f865bc616 */
/* bench 16063.0.5 9f0cf92e5060 */
/* bench 16063.0.6 9e294556572e */
/* bench 16063.0.7 785cada34df2 */
/* bench 27939.0.0 8a0b9baddfe0 */
/* bench 27939.0.1 75bb46d3b103 */
/* bench 27939.0.2 9e2f5ee936a5 */
/* bench 27939.0.3 5f66e7ddfff7 */
/* bench 27939.0.4 19b5958255b5 */
/* bench 27939.0.5 404d605e4bc8 */
/* bench 27939.0.6 200a6f8428b1 */
/* bench 27939.0.7 f922f5dca6e1 */
/* bench 27939.0.8 5a3edbbdcf33 */
/* bench 27939.0.9 5c56ed149faf */
/* bench 27939.0.10 6ae76965a9cc */
/* bench 16063.0.8 5cc20e5ed09c */
/* bench 16063.0.9 93e885a98806 */

Example:

codec: es8328@11 {
	compatible = "everest,es8328";
	DVDD-supply = <&reg_3p3v>;
	AVDD-supply = <&reg_3p3v>;
	PVDD-supply = <&reg_3p3v>;
	HPVDD-supply = <&reg_3p3v>;
	clocks = <&clks 169>;
	reg = <0x11>;
};
```
