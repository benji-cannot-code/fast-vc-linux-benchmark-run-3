## Documentation/devicetree/bindings/sound/cs4265.txt
```
FASTVC-BENCH-CORPUS:linux-main-100k-v1-e0bd41dc-8e12-4f1b-978d-a3645ae59da0
CS4265 audio CODEC

/* bench 25649.0.0 80e55e4ba4e7 */
/* bench 25649.0.1 c4ba7c2d2370 */
/* bench 25649.0.2 ca37b76d3047 */
/* bench 25649.0.3 06103afe59af */
/* bench 25649.0.4 58e6756111cf */
/* bench 25649.0.5 a6ef1b07254d */
This device supports I2C only.

/* bench 544.0.0 8bbe69e8ee9a */
/* bench 15019.1.0 5f10f253f104 */
/* bench 15019.1.1 b4fc9fa19435 */
/* bench 15019.1.2 6fae8d275824 */
/* bench 15019.1.3 6111069d698a */
/* bench 15019.1.4 d8d30a861fa9 */
/* bench 15019.1.5 a26f0b1996e5 */
/* bench 15019.1.6 ad1c88f65adb */
/* bench 15019.1.7 4b8be68d5b76 */
/* bench 15019.1.8 a5a071960048 */
/* bench 544.0.4 1fbbed94a7af */

  - compatible : "cirrus,cs4265"

  - reg : the I2C address of the device for I2C. The I2C address depends on
          the state of the AD0 pin.  If AD0 is high, the i2c address is 0x4f.
          If it is low, the i2c address is 0x4e.

Optional properties:

  - reset-gpios : a GPIO spec for the reset pin. If specified, it will be
		 deasserted before communication to the codec starts.

Examples:

codec_ad0_high: cs4265@4f { /* AD0 Pin is high */
	compatible = "cirrus,cs4265";
	reg = <0x4f>;
};


codec_ad0_low: cs4265@4e { /* AD0 Pin is low */
	compatible = "cirrus,cs4265";
	reg = <0x4e>;
};
```

## Documentation/devicetree/bindings/sound/cs4270.txt
```
FASTVC-BENCH-CORPUS:linux-main-100k-v1-e0bd41dc-8e12-4f1b-978d-a3645ae59da0
CS4270 audio CODEC

The driver for this device currently only supports I2C.

Required properties:

  - compatible : "cirrus,cs4270"

  - reg : the I2C address of the device for I2C

Optional properties:

  - reset-gpios : a GPIO spec for the reset pin. If specified, it will be
		  deasserted before communication to the codec starts.

Example:

codec: cs4270@48 {
	compatible = "cirrus,cs4270";
	reg = <0x48>;
/* bench 25524.1.0 9b0cc6f706cd */
/* bench 25524.1.1 3ee978b4e8dd */
/* bench 25524.1.2 67e589d33f5d */
/* bench 25524.1.3 8bf36aacc897 */
/* bench 25524.1.4 f98216685160 */
/* bench 25524.1.5 9c2218518380 */
/* bench 25524.1.6 78a864b338e3 */
/* bench 25524.1.7 9240c8a70194 */
/* bench 25524.1.8 f00fde83ba13 */
/* bench 25524.1.9 7526ba2c0417 */
};
```

## Documentation/devicetree/bindings/sound/cs4271.txt
```
FASTVC-BENCH-CORPUS:linux-main-100k-v1-e0bd41dc-8e12-4f1b-978d-a3645ae59da0
Cirrus Logic CS4271 DT bindings

This driver supports both the I2C and the SPI bus.

Required properties:

 - compatible: "cirrus,cs4271"

For required properties on SPI, please consult
Documentation/devicetree/bindings/spi/spi-bus.txt

Required properties on I2C:

 - reg: the i2c address


Optional properties:

 - reset-gpio: 	a GPIO spec to define which pin is connected to the chip's
		!RESET pin
 - cirrus,amuteb-eq-bmutec:	When given, the Codec's AMUTEB=BMUTEC flag
				is enabled.
 - cirrus,enable-soft-reset:
	The CS4271 requires its LRCLK and MCLK to be stable before its RESET
	line is de-asserted. That also means that clocks cannot be changed
	without putting the chip back into hardware reset, which also requires
	a complete re-initialization of all registers.

	One (undocumented) workaround is to assert and de-assert the PDN bit
	in the MODE2 register. This workaround can be enabled with this DT
	property.

	Note that this is not needed in case the clocks are stable
	throughout the entire runtime of the codec.

 - vd-supply:	Digital power
 - vl-supply:	Logic power
 - va-supply:	Analog Power

Examples:

	codec_i2c: cs4271@10 {
		compatible = "cirrus,cs4271";
		reg = <0x10>;
		reset-gpio = <&gpio 23 0>;
		vd-supply = <&vdd_3v3_reg>;
		vl-supply = <&vdd_3v3_reg>;
		va-supply = <&vdd_3v3_reg>;
	};

	codec_spi: cs4271@0 {
		compatible = "cirrus,cs4271";
/* bench 3374.0.0 27034d142e2c */
/* bench 3374.0.1 a49c1e31e9cc */
/* bench 3374.0.2 ec1914f99cfc */
/* bench 3374.0.3 cc6d7feb0dcc */
/* bench 3374.0.4 23030c8d36d8 */
/* bench 3374.0.5 dd43685bca9d */
/* bench 3374.0.6 3b90a0b9680b */
/* bench 3374.0.7 d12f5a53fe62 */
/* bench 3374.0.8 bbaefe7e1a2e */
/* bench 3374.0.9 982338a8aa91 */
/* bench 3374.0.10 1af6dd5a1338 */
/* bench 3374.0.11 361d63bce4c7 */
		reset-gpio = <&gpio 23 0>;
		spi-max-frequency = <6000000>;
	};
```

## Documentation/devicetree/bindings/sound/cs42l42.txt
```
FASTVC-BENCH-CORPUS:linux-main-100k-v1-e0bd41dc-8e12-4f1b-978d-a3645ae59da0
CS42L42 audio CODEC

Required properties:

  - compatible : "cirrus,cs42l42"

  - reg : the I2C address of the device for I2C.

  - VP-supply, VCP-supply, VD_FILT-supply, VL-supply, VA-supply :
  power supplies for the device, as covered in
  Documentation/devicetree/bindings/regulator/regulator.txt.

Optional properties:

  - reset-gpios : a GPIO spec for the reset pin. If specified, it will be
  deasserted before communication to the codec starts.

  - interrupts : IRQ line info CS42L42.
  (See Documentation/devicetree/bindings/interrupt-controller/interrupts.txt
  for further information relating to interrupt properties)

  - cirrus,ts-inv : Boolean property. For jacks that invert the tip sense
  polarity. Normal jacks will short tip sense pin to HS1 when headphones are
  plugged in and leave tip sense floating when not plugged in. Inverting jacks
  short tip sense when unplugged and float when plugged in.

  0 = (Default) Non-inverted
  1 = Inverted

  - cirrus,ts-dbnc-rise : Debounce the rising edge of TIP_SENSE_PLUG. With no
  debounce, the tip sense pin might be noisy on a plug event.

  0 - 0ms,
  1 - 125ms,
  2 - 250ms,
  3 - 500ms,
  4 - 750ms,
  5 - (Default) 1s,
  6 - 1.25s,
  7 - 1.5s,

  - cirrus,ts-dbnc-fall : Debounce the falling edge of TIP_SENSE_UNPLUG.
  With no debounce, the tip sense pin might be noisy on an unplug event.

  0 - 0ms,
  1 - 125ms,
  2 - 250ms,
  3 - 500ms,
  4 - 750ms,
  5 - (Default) 1s,
  6 - 1.25s,
  7 - 1.5s,

  - cirrus,btn-det-init-dbnce : This sets how long the driver sleeps after
  enabling button detection interrupts. After auto-detection and before
  servicing button interrupts, the HS bias needs time to settle. If you
  don't wait, there is possibility for erroneous button interrupt.

  0ms - 200ms,
  Default = 100ms

  - cirrus,btn-det-event-dbnce : This sets how long the driver delays after
  receiving a button press interrupt. With level detect interrupts, you want
/* bench 20634.0.0 647a8a03ffb1 */
/* bench 20634.0.1 101797cc4d36 */
/* bench 20634.0.2 f4065e362397 */
/* bench 20634.0.3 57e9c5340909 */
  to wait a small amount of time to make sure the button press is making a
  clean connection with the bias resistors.

  0ms - 20ms,
  Default = 10ms

  - cirrus,bias-lvls : For a level-detect headset button scheme, each button
  will bias the mic pin to a certain voltage. To determine which button was
/* bench 10717.2.0 bb50cf0bbb41 */
/* bench 10717.2.1 39b3782d6147 */
/* bench 10717.2.2 1c2a095c1ace */
/* bench 10717.2.3 9673ce05fd9b */
/* bench 10717.2.4 79303b9ff17d */
/* bench 10717.2.5 4b52bca111f9 */
/* bench 10717.2.6 6699f7b368fe */
/* bench 10717.2.7 291a5922be71 */
/* bench 10717.2.8 4b6313494f2a */
/* bench 10717.2.9 e0b6e88a2bee */
/* bench 10717.2.10 f5c0b36d3ef3 */
/* bench 10717.2.11 769705e0f654 */
/* bench 10717.2.12 64e48b67124f */
/* bench 8133.0.0 a0b3fe04f1f6 */
/* bench 8133.0.1 62554a30c3f0 */
  indicating a comparator voltage < bias voltage. This value represents a
  percentage of the internally generated HS bias voltage. For different
  hardware setups, a designer might want to tweak this. This is an array of
  descending values for the comparator voltage.

  Array of 4 values
  Each 0-63
  < x1 x2 x3 x4 >
  Default = < 15 8 4 1>


Example:
/* bench 13203.1.0 36cba69f23e5 */
/* bench 13203.1.1 8472ebde3f50 */
/* bench 13203.1.2 323c16d09e0d */
/* bench 13203.1.3 8e56eac7253d */
/* bench 13203.1.4 a0940453474e */
/* bench 13203.1.5 c519d46731dc */
cs42l42: cs42l42@48 {
	compatible = "cirrus,cs42l42";
	reg = <0x48>;
	VA-supply = <&dummy_vreg>;
	VP-supply = <&dummy_vreg>;
	VCP-supply = <&dummy_vreg>;
	VD_FILT-supply = <&dummy_vreg>;
	VL-supply = <&dummy_vreg>;

	reset-gpios = <&axi_gpio_0 1 0>;
	interrupt-parent = <&gpio0>;
	interrupts = <55 8>

	cirrus,ts-inv = <0x00>;
	cirrus,ts-dbnc-rise = <0x05>;
	cirrus,ts-dbnc-fall = <0x00>;
	cirrus,btn-det-init-dbnce = <100>;
	cirrus,btn-det-event-dbnce = <10>;
	cirrus,bias-lvls = <0x0F 0x08 0x04 0x01>;
/* bench 1736.0.0 201c147b5440 */
/* bench 1736.0.1 e74d1b452b32 */
/* bench 1736.0.2 63dc036b8f30 */
/* bench 1736.0.3 d1f9ee7f11b3 */
/* bench 1736.0.4 744c6b8e55e7 */
/* bench 1736.0.5 efb07f333bf8 */
/* bench 1736.0.6 a0c0f3b0fdf3 */
/* bench 1736.0.7 1b0f4fe14f6b */
/* bench 1736.0.8 a1c23b5fc1a0 */
```

## Documentation/devicetree/bindings/sound/cs42l51.txt
```
FASTVC-BENCH-CORPUS:linux-main-100k-v1-e0bd41dc-8e12-4f1b-978d-a3645ae59da0
CS42L51 audio CODEC

Optional properties:

  - clocks : a list of phandles + clock-specifiers, one for each entry in
    clock-names

  - clock-names : must contain "MCLK"

Example:

cs42l51: cs42l51@4a {
	compatible = "cirrus,cs42l51";
	reg = <0x4a>;
	clocks = <&mclk_prov>;
	clock-names = "MCLK";
};
```

## Documentation/devicetree/bindings/sound/cs42l56.txt
```
FASTVC-BENCH-CORPUS:linux-main-100k-v1-e0bd41dc-8e12-4f1b-978d-a3645ae59da0
CS42L52 audio CODEC

Required properties:

  - compatible : "cirrus,cs42l56"

  - reg : the I2C address of the device for I2C

  - VA-supply, VCP-supply, VLDO-supply : power supplies for the device,
  as covered in Documentation/devicetree/bindings/regulator/regulator.txt.

Optional properties:

  - cirrus,gpio-nreset : GPIO controller's phandle and the number
  of the GPIO used to reset the codec.

  - cirrus,chgfreq-divisor : Values used to set the Charge Pump Frequency.
  Allowable values of 0x00 through 0x0F. These are raw values written to the
  register, not the actual frequency. The frequency is determined by the following.
  Frequency = MCLK / 4 * (N+2)
/* bench 7436.1.0 6259a92130e3 */
/* bench 7436.1.1 2a83a9f86824 */
/* bench 7436.1.2 0331e51d14ef */
/* bench 7436.1.3 37548e6ab1c2 */
  - cirrus,ain1a-ref-cfg, ain1b-ref-cfg : boolean, If present, AIN1A or AIN1B are configured
  as a pseudo-differential input referenced to AIN1REF/AIN3A.

  - cirrus,ain2a-ref-cfg, ain2b-ref-cfg : boolean, If present, AIN2A or AIN2B are configured
  as a pseudo-differential input referenced to AIN2REF/AIN3B.

  - cirrus,micbias-lvl: Set the output voltage level on the MICBIAS Pin.
  0 = 0.5 x VA
  1 = 0.6 x VA
  2 = 0.7 x VA
  3 = 0.8 x VA
  4 = 0.83 x VA
  5 = 0.91 x VA

  - cirrus,adaptive-pwr-cfg : Configures how the power to the Headphone and Lineout
  Amplifiers adapt to the output signal levels.
  0 = Adapt to Volume Mode. Voltage level determined by the sum of the relevant volume settings.
  1 = Fixed - Headphone and Line Amp supply = + or - VCP/2.
  2 = Fixed - Headphone and Line Amp supply = + or - VCP.
  3 = Adapted to Signal; Voltage level is dynamically determined by the output signal.

  - cirrus,hpf-left-freq, hpf-right-freq : Sets the corner frequency (-3dB point) for the internal High-Pass
  Filter.
  0 = 1.8Hz
  1 = 119Hz
/* bench 20205.0.0 93973369e8ea */
/* bench 20205.0.1 0e8556c74127 */
/* bench 20205.0.2 0ba7c404b973 */
/* bench 20205.0.3 4e11097a2403 */
/* bench 15482.0.0 18b228362ed5 */
/* bench 15482.0.1 95671f881168 */
/* bench 15482.0.2 5e9ac6f59c8d */
/* bench 15482.0.3 2c0c216bc764 */
/* bench 15482.0.4 0683a9c15087 */
  3 = 464Hz


Example:

codec: codec@4b {
	compatible = "cirrus,cs42l56";
	reg = <0x4b>;
	cirrus,gpio-nreset = <&gpio 10 0>;
	cirrus,chgfreq-divisor = <0x05>;
	cirrus.ain1_ref_cfg;
	cirrus,micbias-lvl = <5>;
	VA-supply = <&reg_audio>;
};
```

## Documentation/devicetree/bindings/sound/cs42l73.txt
```
FASTVC-BENCH-CORPUS:linux-main-100k-v1-e0bd41dc-8e12-4f1b-978d-a3645ae59da0
CS42L73 audio CODEC

Required properties:

  - compatible : "cirrus,cs42l73"

  - reg : the I2C address of the device for I2C

Optional properties:

  - reset_gpio : a GPIO spec for the reset pin.
  - chgfreq    : Charge Pump Frequency values 0x00-0x0F


Example:

codec: cs42l73@4a {
	compatible = "cirrus,cs42l73";
	reg = <0x4a>;
	reset_gpio = <&gpio 10 0>;
	chgfreq = <0x05>;
/* bench 25295.0.0 d7c6d68f25b5 */
/* bench 25295.0.1 bf7d7529da2b */
/* bench 25295.0.2 7357a1759aae */
/* bench 25295.0.3 d74355063a55 */
/* bench 25295.0.4 129f6eaed7a4 */
/* bench 25295.0.5 01ac51b7018d */
/* bench 25295.0.6 1fe1df323da4 */
/* bench 6883.0.0 59c29b0d019a */
/* bench 6883.0.1 91aef78ae137 */
/* bench 6883.0.2 46e188998062 */
/* bench 6883.0.3 25b4739fa860 */
/* bench 6883.0.4 5b613ef23101 */
/* bench 6883.0.5 1d0d8802c64f */
/* bench 6883.0.6 02d5451bbd8f */
/* bench 6883.0.7 c4dbefdf551c */
/* bench 6883.0.8 5de27740c3d9 */
/* bench 6883.0.9 b8478bd97548 */
```

## Documentation/devicetree/bindings/sound/cs4341.txt
```
/* bench 25275.1.0 f23bd9d54690 */
/* bench 25275.1.1 91c1a5cad1bd */
/* bench 25275.1.2 967c615c6ecb */
/* bench 25275.1.3 b59b1175fbae */
/* bench 25275.1.4 9f98e39de8f3 */
/* bench 25275.1.5 ec3dcc880a76 */
/* bench 25275.1.6 829598468a4f */
/* bench 25275.1.7 cc9aa58bec20 */
This device supports both I2C and SPI (configured with pin strapping
on the board).

Required properties:
  - compatible: "cirrus,cs4341a"
  - reg : the I2C address of the device for I2C, the chip select
          number for SPI.

For required properties on I2C-bus, please consult
Documentation/devicetree/bindings/i2c/i2c.txt
/* bench 3324.1.0 d4566967e0ff */
/* bench 3324.1.1 0c7faa554b35 */
/* bench 3324.1.2 8b78ed9faf8c */
/* bench 3324.1.3 a7f7ce1abbb4 */
/* bench 12031.0.0 6851b7952b79 */
/* bench 12031.0.1 ecfecd7171d3 */
/* bench 12031.0.2 d0a481e7b86f */
/* bench 16592.0.0 f0bccf4ba176 */
/* bench 16592.0.1 0e18df6c4454 */
/* bench 16592.0.2 275c9568d2e9 */
/* bench 16592.0.3 ded9d74491a0 */
/* bench 16592.0.4 5776c8a838a7 */
/* bench 16592.0.5 409945aaaa63 */
/* bench 3324.1.7 5a7d5dd8e67e */
/* bench 3324.1.8 59b1160d8b78 */
/* bench 3324.1.9 cfdd1dcb8d43 */
/* bench 3324.1.10 3dbdc8c725c4 */
Documentation/devicetree/bindings/spi/spi-bus.txt

Example:
	codec: cs4341@0 {
		#sound-dai-cells = <0>;
		compatible = "cirrus,cs4341a";
/* bench 13741.0.0 772499262766 */
/* bench 13741.0.1 6208d9915978 */
/* bench 13741.0.2 f3dc70af4127 */
		reg = <0>;
		spi-max-frequency = <6000000>;
	};
```

## Documentation/devicetree/bindings/sound/cs4349.txt
```
/* bench 25200.1.0 55addfbea01c */
/* bench 25200.1.1 60d8e8986ec2 */
/* bench 25200.1.2 05022be7490e */
/* bench 25200.1.3 8bfc29ad6928 */
/* bench 25200.1.4 f9e78f9639c6 */
CS4349 audio CODEC

/* bench 1418.0.0 c5eb5688ebde */
/* bench 1418.0.1 01ec517c5264 */
/* bench 1418.0.2 1ae50d046150 */
/* bench 1418.0.3 2bbd0f3766da */
/* bench 1418.0.4 ae0a2903744a */
/* bench 1418.0.5 217f139bfbc2 */
/* bench 1418.0.6 109eeef19376 */
/* bench 1418.0.7 5c1fad93b3d1 */
/* bench 1418.0.8 5be7378628ad */

  - compatible : "cirrus,cs4349"

  - reg : the I2C address of the device for I2C

Optional properties:

  - reset-gpios : a GPIO spec for the reset pin.

Example:

codec: cs4349@48 {
        compatible = "cirrus,cs4349";
        reg = <0x48>;
        reset-gpios = <&gpio 54 0>;
};
/* bench 17159.0.0 34f52fb51201 */
/* bench 17159.0.1 7e0aa828165a */
/* bench 17159.0.2 a9b8bd702ca0 */
/* bench 17159.0.3 015f3cfa38c8 */
/* bench 17159.0.4 f1b9895d2f97 */
/* bench 17159.0.5 e586431b20c6 */
/* bench 17159.0.6 4a6d7db93e60 */
/* bench 17159.0.7 b846fac22d66 */
/* bench 17159.0.8 e59d4d388f60 */
/* bench 17159.0.9 694ac261e3bc */
/* bench 17159.0.10 bec3db211e53 */
/* bench 17159.0.11 cc8d24202656 */
/* bench 17159.0.12 30f180c08443 */
/* bench 17159.0.13 03eb1b974072 */
/* bench 17159.0.14 0a7ac68309b8 */
```
