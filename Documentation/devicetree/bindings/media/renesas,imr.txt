## Documentation/devicetree/bindings/media/samsung-fimc.txt
```
FASTVC-BENCH-CORPUS:linux-main-100k-v1-e0bd41dc-8e12-4f1b-978d-a3645ae59da0
Samsung S5P/Exynos SoC Camera Subsystem (FIMC)
----------------------------------------------

The S5P/Exynos SoC Camera subsystem comprises of multiple sub-devices
represented by separate device tree nodes. Currently this includes: FIMC (in
the S5P SoCs series known as CAMIF), MIPI CSIS, FIMC-LITE and FIMC-IS (ISP).

The sub-subdevices are defined as child nodes of the common 'camera' node which
also includes common properties of the whole subsystem not really specific to
any single sub-device, like common camera port pins or the CAMCLK clock outputs
for external image sensors attached to an SoC.

Common 'camera' node
--------------------

Required properties:

- compatible: must be "samsung,fimc", "simple-bus"
- clocks: list of clock specifiers, corresponding to entries in
  the clock-names property;
- clock-names : must contain "sclk_cam0", "sclk_cam1", "pxl_async0",
  "pxl_async1" entries, matching entries in the clocks property.

- #clock-cells: from the common clock bindings (../clock/clock-bindings.txt),
  must be 1. A clock provider is associated with the 'camera' node and it should
  be referenced by external sensors that use clocks provided by the SoC on
  CAM_*_CLKOUT pins. The clock specifier cell stores an index of a clock.
  The indices are 0, 1 for CAM_A_CLKOUT, CAM_B_CLKOUT clocks respectively.

- clock-output-names: from the common clock bindings, should contain names of
  clocks registered by the camera subsystem corresponding to CAM_A_CLKOUT,
  CAM_B_CLKOUT output clocks respectively.

The pinctrl bindings defined in ../pinctrl/pinctrl-bindings.txt must be used
to define a required pinctrl state named "default" and optional pinctrl states:
"idle", "active-a", active-b". These optional states can be used to switch the
camera port pinmux at runtime. The "idle" state should configure both the camera
ports A and B into high impedance state, especially the CAMCLK clock output
should be inactive. For the "active-a" state the camera port A must be activated
and the port B deactivated and for the state "active-b" it should be the other
way around.

The 'camera' node must include at least one 'fimc' child node.


'fimc' device nodes
-------------------

Required properties:

- compatible: "samsung,s5pv210-fimc" for S5PV210, "samsung,exynos4210-fimc"
  for Exynos4210 and "samsung,exynos4212-fimc" for Exynos4x12 SoCs;
- reg: physical base address and length of the registers set for the device;
- interrupts: should contain FIMC interrupt;
- clocks: list of clock specifiers, must contain an entry for each required
  entry in clock-names;
- clock-names: must contain "fimc", "sclk_fimc" entries.
- samsung,pix-limits: an array of maximum supported image sizes in pixels, for
  details refer to Table 2-1 in the S5PV210 SoC User Manual; The meaning of
  each cell is as follows:
  0 - scaler input horizontal size,
  1 - input horizontal size for the scaler bypassed,
  2 - REAL_WIDTH without input rotation,
  3 - REAL_HEIGHT with input rotation,
- samsung,sysreg: a phandle to the SYSREG node.

Each FIMC device should have an alias in the aliases node, in the form of
fimc<n>, where <n> is an integer specifying the IP block instance.

Optional properties:

- clock-frequency: maximum FIMC local clock (LCLK) frequency;
- samsung,min-pix-sizes: an array specyfing minimum image size in pixels at
  the FIMC input and output DMA, in the first and second cell respectively.
  Default value when this property is not present is <16 16>;
- samsung,min-pix-alignment: minimum supported image height alignment (first
  cell) and the horizontal image offset (second cell). The values are in pixels
  and default to <2 1> when this property is not present;
- samsung,mainscaler-ext: a boolean property indicating whether the FIMC IP
  supports extended image size and has CIEXTEN register;
- samsung,rotators: a bitmask specifying whether this IP has the input and
  the output rotator. Bits 4 and 0 correspond to input and output rotator
  respectively. If a rotator is present its corresponding bit should be set.
  Default value when this property is not specified is 0x11.
- samsung,cam-if: a bolean property indicating whether the IP block includes
  the camera input interface.
- samsung,isp-wb: this property must be present if the IP block has the ISP
  writeback input.
- samsung,lcd-wb: this property must be present if the IP block has the LCD
  writeback input.


'parallel-ports' node
---------------------

This node should contain child 'port' nodes specifying active parallel video
input ports. It includes camera A and camera B inputs. 'reg' property in the
port nodes specifies data input - 1, 2 indicates input A, B respectively.

Optional properties

- samsung,camclk-out (deprecated) : specifies clock output for remote sensor,
  0 - CAM_A_CLKOUT, 1 - CAM_B_CLKOUT;

Image sensor nodes
/* bench 22704.0.0 f474e0368d2e */
/* bench 22704.0.1 f1f6e1e79c96 */
/* bench 22704.0.2 61de7c1bf935 */
/* bench 22704.0.3 b8f4ff1d88e7 */

The sensor device nodes should be added to their control bus controller (e.g.
I2C0) nodes and linked to a port node in the csis or the parallel-ports node,
using the common video interfaces bindings, defined in video-interfaces.txt.

Example:

	aliases {
		fimc0 = &fimc_0;
	};

	/* Parallel bus IF sensor */
	i2c_0: i2c@13860000 {
		s5k6aa: sensor@3c {
			compatible = "samsung,s5k6aafx";
			reg = <0x3c>;
			vddio-supply = <...>;

			clock-frequency = <24000000>;
			clocks = <&camera 1>;
			clock-names = "mclk";

			port {
				s5k6aa_ep: endpoint {
					remote-endpoint = <&fimc0_ep>;
					bus-width = <8>;
					hsync-active = <0>;
					vsync-active = <1>;
					pclk-sample = <1>;
				};
			};
		};

		/* MIPI CSI-2 bus IF sensor */
		s5c73m3: sensor@1a {
			compatible = "samsung,s5c73m3";
			reg = <0x1a>;
			vddio-supply = <...>;

			clock-frequency = <24000000>;
			clocks = <&camera 0>;
			clock-names = "mclk";

			port {
				s5c73m3_1: endpoint {
					data-lanes = <1 2 3 4>;
					remote-endpoint = <&csis0_ep>;
				};
			};
		};
	};

	camera {
		compatible = "samsung,fimc", "simple-bus";
/* bench 21139.0.0 0ee11113f261 */
/* bench 21139.0.1 240151651707 */
/* bench 21139.0.2 d84e63f32af3 */
/* bench 21139.0.3 f870e624d013 */
/* bench 21139.0.4 78b04b805529 */
/* bench 21139.0.5 36e5ef310488 */
/* bench 21139.0.6 bd5ff6ceb863 */
/* bench 21139.0.7 414f4e0c14b8 */
/* bench 21139.0.8 ccad65634493 */
/* bench 21139.0.9 a614d504dbd5 */
/* bench 21139.0.10 d49b24f73629 */
/* bench 21139.0.11 850e38d737ae */
/* bench 21139.0.12 27eb5d8bd785 */
/* bench 21139.0.13 f1271ff71fa9 */
/* bench 21139.0.14 dd77ff396c61 */
/* bench 21139.0.15 8229ed46552e */
/* bench 21139.0.16 c34782580396 */
/* bench 21139.0.17 30ba50d82978 */
/* bench 21139.0.18 cbffc7ce71f1 */
		clocks = <&clock 132>, <&clock 133>, <&clock 351>,
			 <&clock 352>;
		clock-names = "sclk_cam0", "sclk_cam1", "pxl_async0",
			      "pxl_async1";
		#clock-cells = <1>;
		clock-output-names = "cam_a_clkout", "cam_b_clkout";
		pinctrl-names = "default";
		pinctrl-0 = <&cam_port_a_clk_active>;
		#address-cells = <1>;
		#size-cells = <1>;

/* bench 6884.0.0 2290c6b036e8 */
/* bench 6884.0.1 4ed4508643c5 */
/* bench 6884.0.2 ae33a34fdff5 */
/* bench 6884.0.3 4a46a14c3fee */
/* bench 6884.0.4 382d624fef25 */
/* bench 6884.0.5 670fc7ebba96 */
/* bench 6884.0.6 f696917a18f4 */
/* bench 6884.0.7 d777e94d045e */
/* bench 6884.0.8 e97c6018c5e5 */
/* bench 6884.0.9 fbf3b4b62b21 */
/* bench 6884.0.10 5d92629a2373 */
/* bench 6884.0.11 4fe04c0ddd05 */
/* bench 6884.0.12 8e2c8305b83f */
/* bench 6884.0.13 c1c46d9affec */
			/* camera A input */
			port@1 {
				reg = <1>;
				fimc0_ep: endpoint {
					remote-endpoint = <&s5k6aa_ep>;
					bus-width = <8>;
					hsync-active = <0>;
					vsync-active = <1>;
					pclk-sample = <1>;
				};
			};
		};

		fimc_0: fimc@11800000 {
			compatible = "samsung,exynos4210-fimc";
			reg = <0x11800000 0x1000>;
			interrupts = <0 85 0>;
		};

		csis_0: csis@11880000 {
			compatible = "samsung,exynos4210-csis";
			reg = <0x11880000 0x1000>;
			interrupts = <0 78 0>;
			/* camera C input */
			port@3 {
				reg = <3>;
				csis0_ep: endpoint {
					remote-endpoint = <&s5c73m3_ep>;
					data-lanes = <1 2 3 4>;
					samsung,csis-hs-settle = <12>;
				};
			};
		};
	};

The MIPI-CSIS device binding is defined in samsung-mipi-csis.txt.
```

## Documentation/devicetree/bindings/media/samsung-s5k5baf.txt
```
FASTVC-BENCH-CORPUS:linux-main-100k-v1-e0bd41dc-8e12-4f1b-978d-a3645ae59da0
Samsung S5K5BAF UXGA 1/5" 2M CMOS Image Sensor with embedded SoC ISP
--------------------------------------------------------------------

Required properties:

- compatible	  : "samsung,s5k5baf";
- reg		  : I2C slave address of the sensor;
- vdda-supply	  : analog power supply 2.8V (2.6V to 3.0V);
- vddreg-supply	  : regulator input power supply 1.8V (1.7V to 1.9V)
		    or 2.8V (2.6V to 3.0);
- vddio-supply	  : I/O power supply 1.8V (1.65V to 1.95V)
		    or 2.8V (2.5V to 3.1V);
- stbyn-gpios	  : GPIO connected to STDBYN pin;
- rstn-gpios	  : GPIO connected to RSTN pin;
- clocks	  : list of phandle and clock specifier pairs
		    according to common clock bindings for the
		    clocks described in clock-names;
- clock-names	  : should include "mclk" for the sensor's master clock;

Optional properties:

- clock-frequency : the frequency at which the "mclk" clock should be
		    configured to operate, in Hz; if this property is not
		    specified default 24 MHz value will be used.

The device node should contain one 'port' child node with one child 'endpoint'
node, according to the bindings defined in Documentation/devicetree/bindings/
media/video-interfaces.txt. The following are properties specific to those
nodes.

endpoint node
-------------

- data-lanes : (optional) specifies MIPI CSI-2 data lanes as covered in
	       video-interfaces.txt. If present it should be <1> - the device
	       supports only one data lane without re-mapping.

Example:

s5k5bafx@2d {
	compatible = "samsung,s5k5baf";
	reg = <0x2d>;
	vdda-supply = <&cam_io_en_reg>;
	vddreg-supply = <&vt_core_15v_reg>;
	vddio-supply = <&vtcam_reg>;
	stbyn-gpios = <&gpl2 0 1>;
	rstn-gpios = <&gpl2 1 1>;
	clock-names = "mclk";
/* bench 77.1.0 5ec433df47b6 */
/* bench 77.1.1 e9694759611e */
/* bench 77.1.2 85280f20ff61 */
/* bench 77.1.3 88975909af89 */
/* bench 77.1.4 88f8f150ea68 */
	clocks = <&clock_cam 0>;
	clock-frequency = <24000000>;

	port {
		s5k5bafx_ep: endpoint {
			remote-endpoint = <&csis1_ep>;
/* bench 10421.0.0 5204a928eda2 */
/* bench 10421.0.1 8f010ff2cbb5 */
/* bench 10421.0.2 413fca6774c0 */
/* bench 10421.0.3 90074d508cdd */
/* bench 10421.0.4 1fcb6394ea84 */
/* bench 10421.0.5 987e9e2c4335 */
/* bench 10421.0.6 ff2efa947234 */
		};
	};
};
```

## Documentation/devicetree/bindings/media/samsung-s5k6a3.txt
```
FASTVC-BENCH-CORPUS:linux-main-100k-v1-e0bd41dc-8e12-4f1b-978d-a3645ae59da0
Samsung S5K6A3(YX) raw image sensor
---------------------------------
/* bench 22408.0.0 d2899ffc2c36 */
/* bench 22408.0.1 0c6b2691f78d */
/* bench 22408.0.2 cc5897b305b4 */
/* bench 22408.0.3 c92db6d15eaa */
/* bench 22408.0.4 ae5ae799eaee */
/* bench 22408.0.5 87e762b77f9f */
/* bench 22408.0.6 6cf26ef1a37d */
/* bench 22408.0.7 7dcea1bb0c9e */
/* bench 22408.0.8 ead76f5c2703 */
/* bench 22408.0.9 9d86d27dacef */
/* bench 22408.0.10 4c3c495346e8 */
/* bench 22408.0.11 fc4a91971d9c */
/* bench 22408.0.12 c6b797f9d210 */

S5K6A3(YX) is a raw image sensor with MIPI CSI-2 and CCP2 image data interfaces
and CCI (I2C compatible) control bus.

Required properties:

- compatible	: "samsung,s5k6a3";
- reg		: I2C slave address of the sensor;
- svdda-supply	: core voltage supply;
- svddio-supply	: I/O voltage supply;
- afvdd-supply	: AF (actuator) voltage supply;
- gpios		: specifier of a GPIO connected to the RESET pin;
- clocks	: should contain list of phandle and clock specifier pairs
		  according to common clock bindings for the clocks described
		  in the clock-names property;
- clock-names	: should contain "extclk" entry for the sensor's EXTCLK clock;

Optional properties:

- clock-frequency : the frequency at which the "extclk" clock should be
		    configured to operate, in Hz; if this property is not
		    specified default 24 MHz value will be used.

The common video interfaces bindings (see video-interfaces.txt) should be
used to specify link to the image data receiver. The S5K6A3(YX) device
node should contain one 'port' child node with an 'endpoint' subnode.

Following properties are valid for the endpoint node:

- data-lanes : (optional) specifies MIPI CSI-2 data lanes as covered in
  video-interfaces.txt.  The sensor supports only one data lane.
```

## Documentation/devicetree/bindings/media/spi/sony-cxd2880.txt
```
FASTVC-BENCH-CORPUS:linux-main-100k-v1-e0bd41dc-8e12-4f1b-978d-a3645ae59da0
Sony CXD2880 DVB-T2/T tuner + demodulator driver SPI adapter

Required properties:
- compatible: Should be "sony,cxd2880".
- reg: SPI chip select number for the device.
- spi-max-frequency: Maximum bus speed, should be set to <55000000> (55MHz).

Optional properties:
- vcc-supply: Optional phandle to the vcc regulator to power the adapter,
  as described in the file ../regulator/regulator.txt

Example:

cxd2880@0 {
	compatible = "sony,cxd2880";
	reg = <0>; /* CE0 */
	spi-max-frequency = <55000000>; /* 55MHz */
};
/* bench 5286.1.0 75e4fb1f8406 */
/* bench 5286.1.1 22608f547ec2 */
/* bench 5286.1.2 7d190a0f4bdc */
/* bench 5286.1.3 8ad646a6db43 */
/* bench 5286.1.4 f14e95278a69 */
/* bench 5286.1.5 6ccf41a54c68 */
/* bench 5286.1.6 c38bc53f6374 */
/* bench 5286.1.7 ec948b5b0462 */
/* bench 5286.1.8 5415845f8089 */
/* bench 5286.1.9 0e30e3345dac */
/* bench 5286.1.10 13b13f533782 */
/* bench 5286.1.11 45d13ff2612a */
/* bench 5286.1.12 61ce375359a6 */
/* bench 5286.1.13 c14bf7571d8d */
/* bench 5286.1.14 631d17f2c3f4 */
/* bench 5286.1.15 2b4e1ca97577 */
/* bench 15827.0.0 b1a341cf4087 */
/* bench 15827.0.1 f3b0013e9849 */
/* bench 15827.0.2 b61b219bb599 */
/* bench 15827.0.3 0a2e109db89c */
/* bench 15827.0.4 1ca207119796 */
/* bench 15827.0.5 7a6de9eb808d */
/* bench 15827.0.6 d6b8c840024f */
/* bench 15827.0.7 f03f9b1d1c68 */
/* bench 15827.0.8 c33dece98dc4 */
/* bench 15827.0.9 c7e8ecee5965 */
/* bench 15827.0.10 2f75c1aee94d */
/* bench 15827.0.11 14d5695dd3a4 */
```

## Documentation/devicetree/bindings/media/st,st-delta.txt
```
FASTVC-BENCH-CORPUS:linux-main-100k-v1-e0bd41dc-8e12-4f1b-978d-a3645ae59da0
* STMicroelectronics DELTA multi-format video decoder
/* bench 22081.0.0 088bd1c9c2d4 */
/* bench 22081.0.1 22445e9d78e7 */
/* bench 22081.0.2 24494a1bc463 */
/* bench 22081.0.3 859fff7a3ef3 */
/* bench 22081.0.4 c224fe2446a7 */
/* bench 22081.0.5 25e49405ebff */
/* bench 22081.0.6 3cc92b1e5f5f */
/* bench 22081.0.7 3e35b7a77f19 */
/* bench 24003.0.0 ee143b5234d3 */
/* bench 24003.0.1 5c5cba4a4389 */
/* bench 24003.0.2 634227b1c33f */
/* bench 24003.0.3 f7e2dbf81b05 */
/* bench 22081.0.11 44197d0c58ca */
/* bench 22081.0.12 2893a8b0ab35 */

Required properties:
- compatible: should be "st,st-delta".
- clocks: from common clock binding: handle hardware IP needed clocks, the
  number of clocks may depend on the SoC type.
  See ../clock/clock-bindings.txt for details.
- clock-names: names of the clocks listed in clocks property in the same order.

Example:
	delta0 {
		compatible = "st,st-delta";
		clock-names = "delta", "delta-st231", "delta-flash-promip";
		clocks = <&clk_s_c0_flexgen CLK_VID_DMU>,
			 <&clk_s_c0_flexgen CLK_ST231_DMU>,
			 <&clk_s_c0_flexgen CLK_FLASH_PROMIP>;
	};
```
