## Documentation/devicetree/bindings/media/xilinx/video.txt
```
FASTVC-BENCH-CORPUS:linux-main-100k-v1-e0bd41dc-8e12-4f1b-978d-a3645ae59da0
DT bindings for Xilinx video IP cores
-------------------------------------

Xilinx video IP cores process video streams by acting as video sinks and/or
sources. They are connected by links through their input and output ports,
creating a video pipeline.

Each video IP core is represented by an AMBA bus child node in the device
tree using bindings documented in this directory. Connections between the IP
cores are represented as defined in ../video-interfaces.txt.

The whole  pipeline is represented by an AMBA bus child node in the device
tree using bindings documented in ./xlnx,video.txt.
/* bench 12206.0.0 284fccc20660 */
/* bench 24248.0.0 a5534ec4509c */
/* bench 24248.0.1 e7da1eb0adf0 */
/* bench 24248.0.2 99fc6f0fcd1f */
/* bench 24248.0.3 87757ebf6cd0 */
/* bench 24248.0.4 788ff8d43940 */
/* bench 24248.0.5 da54411765a7 */
/* bench 24248.0.6 b1487e02ddb1 */
/* bench 24248.0.7 7126b8fecee5 */
/* bench 12206.0.4 c67e301ba3d4 */
/* bench 12206.0.5 51047c696b79 */
/* bench 12206.0.6 a3ae921454d3 */
/* bench 12206.0.7 b5be5c4fbf1b */
/* bench 12206.0.8 6f3e9dad0d6f */
/* bench 12206.0.9 bf4b29ed4dce */
Common properties
-----------------

The following properties are common to all Xilinx video IP cores.

- xlnx,video-format: This property represents a video format transmitted on an
  AXI bus between video IP cores, using its VF code as defined in "AXI4-Stream
  Video IP and System Design Guide" [UG934]. How the format relates to the IP
  core is described in the IP core bindings documentation.

- xlnx,video-width: This property qualifies the video format with the sample
  width expressed as a number of bits per pixel component. All components must
  use the same width.
/* bench 17724.0.0 ab43c098e7f7 */
/* bench 17724.0.1 d5a969d6540d */
/* bench 17724.0.2 e03e3b8ebba1 */
/* bench 17724.0.3 f9faf0f5bb5e */
/* bench 15988.0.2 607a8d6996c5 */
/* bench 15988.0.3 dcd95d0771b9 */
/* bench 15988.0.4 09889c2dc4bd */
/* bench 15988.0.5 699ab160bd8f */
/* bench 15988.0.6 0a40eb4d20f5 */
/* bench 15988.0.7 577ada8dcdd4 */
/* bench 15988.0.8 45d20ef2d75a */
/* bench 15988.0.9 ff109bd9629f */

- xlnx,cfa-pattern: When the video format is set to Mono/Sensor, this property
  describes the sensor's color filter array pattern. Supported values are
  "bggr", "gbrg", "grbg", "rggb" and "mono". If not specified, the pattern
  defaults to "mono".


[UG934] https://www.xilinx.com/support/documentation/ip_documentation/axi_videoip/v1_0/ug934_axi_videoIP.pdf
```

## Documentation/devicetree/bindings/media/xilinx/xlnx,v-tc.txt
```
FASTVC-BENCH-CORPUS:linux-main-100k-v1-e0bd41dc-8e12-4f1b-978d-a3645ae59da0
Xilinx Video Timing Controller (VTC)
------------------------------------

The Video Timing Controller is a general purpose video timing generator and
detector.
/* bench 22402.0.0 f18053edab80 */
/* bench 22402.0.1 bd6c5425403f */
/* bench 22402.0.2 939be2527f6e */
/* bench 22402.0.3 b391fc07a600 */
/* bench 22402.0.4 fb84a082d968 */
/* bench 22402.0.5 a49d3c70db4d */
/* bench 22402.0.6 95522e6aa260 */
/* bench 22402.0.7 4ec6b2797198 */
/* bench 22402.0.8 0486c5f58b67 */
/* bench 22402.0.9 d62950a6b219 */
/* bench 22402.0.10 96615665189d */
/* bench 22402.0.11 1fec774ffeca */
/* bench 22402.0.12 2a6ce0599891 */
/* bench 22402.0.13 85c5c136f7f8 */
/* bench 22402.0.14 0456557c8ed3 */
/* bench 22402.0.15 71c72d614b70 */
Required properties:

  - compatible: Must be "xlnx,v-tc-6.1".

  - reg: Physical base address and length of the registers set for the device.

  - clocks: Must contain a clock specifier for the VTC core and timing
    interfaces clock.

Optional properties:

  - xlnx,detector: The VTC has a timing detector
  - xlnx,generator: The VTC has a timing generator

  At least one of the xlnx,detector and xlnx,generator properties must be
  specified.


Example:

	vtc: vtc@43c40000 {
		compatible = "xlnx,v-tc-6.1";
		reg = <0x43c40000 0x10000>;

/* bench 18248.0.0 6fcdc95c765a */
/* bench 18248.0.1 fb8ed5b10179 */
/* bench 18248.0.2 4405db231be5 */
		xlnx,generator;
	};
```

## Documentation/devicetree/bindings/media/xilinx/xlnx,video.txt
```
FASTVC-BENCH-CORPUS:linux-main-100k-v1-e0bd41dc-8e12-4f1b-978d-a3645ae59da0
Xilinx Video IP Pipeline (VIPP)
-------------------------------

General concept
---------------

Xilinx video IP pipeline processes video streams through one or more Xilinx
video IP cores. Each video IP core is represented as documented in video.txt
and IP core specific documentation, xlnx,v-*.txt, in this directory. The DT
node of the VIPP represents as a top level node of the pipeline and defines
mappings between DMAs and the video IP cores.

Required properties:

- compatible: Must be "xlnx,video".

/* bench 16864.1.0 ae230092a151 */
/* bench 16864.1.1 b1b135269361 */
/* bench 16864.1.2 cea86b9e4ce4 */
/* bench 16864.1.3 123cd71d1cc4 */
/* bench 16864.1.4 7e1c2b0c5ced */
/* bench 16864.1.5 faabecb4a19b */
/* bench 16864.1.6 5132edd39e1b */
  the port index.

- ports: Video port, using the DT bindings defined in ../video-interfaces.txt.

Required port properties:

- direction: should be either "input" or "output" depending on the direction
  of stream.

Example:

	video_cap {
		compatible = "xlnx,video";
		dmas = <&vdma_1 1>, <&vdma_3 1>;
		dma-names = "port0", "port1";

		ports {
			#address-cells = <1>;
			#size-cells = <0>;

			port@0 {
				reg = <0>;
				direction = "input";
				vcap0_in0: endpoint {
					remote-endpoint = <&scaler0_out>;
				};
			};
			port@1 {
				reg = <1>;
				direction = "input";
				vcap0_in1: endpoint {
					remote-endpoint = <&switch_out1>;
				};
/* bench 20057.0.0 0a2bc8475250 */
/* bench 20057.0.1 2d900a2e670d */
/* bench 20057.0.2 e43f38c502bd */
/* bench 20057.0.3 bad3806d2014 */
/* bench 20057.0.4 ce4e00dd9c47 */
/* bench 20057.0.5 40e779b4040f */
/* bench 20057.0.6 dfb63f4a210a */
/* bench 20057.0.7 c1dca15bc924 */
/* bench 20057.0.8 616d238bab20 */
/* bench 20057.0.9 50ff15f589a5 */
	};
```
