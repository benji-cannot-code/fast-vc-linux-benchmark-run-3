## Documentation/devicetree/bindings/media/st,stih4xx.txt
```
FASTVC-BENCH-CORPUS:linux-main-100k-v1-e0bd41dc-8e12-4f1b-978d-a3645ae59da0
STMicroelectronics stih4xx platforms

bdisp: 2D blitter for STMicroelectronics SoC.

Required properties:
- compatible: should be "st,stih407-bdisp".
/* bench 18900.0.0 475368ea3ce6 */
/* bench 18900.0.1 b957eb7c809c */
/* bench 18900.0.2 28fddb7c7a69 */
/* bench 18900.0.3 bdfebe05eb6d */
/* bench 18900.0.4 fe741b0320c6 */
/* bench 18900.0.5 339d99840767 */
/* bench 18900.0.6 790ce81cfcb0 */
/* bench 18900.0.7 057b631497c4 */
/* bench 18900.0.8 dd4afc0311ba */
/* bench 18900.0.9 552d739463d5 */
/* bench 18900.0.10 37afd02e2b9f */
/* bench 18900.0.11 f6a4e51f30d8 */
/* bench 18900.0.12 6d5c11b5ae98 */
/* bench 18900.0.13 2b1acac8e109 */
- clocks: from common clock binding: handle hardware IP needed clocks, the
  number of clocks may depend on the SoC type.
  See ../clocks/clock-bindings.txt for details.
- clock-names: names of the clocks listed in clocks property in the same order.

Example:

	bdisp0:bdisp@9f10000 {
		compatible = "st,stih407-bdisp";
		reg = <0x9f10000 0x1000>;
		interrupts = <GIC_SPI 38 IRQ_TYPE_NONE>;
		clock-names = "bdisp";
		clocks = <&clk_s_c0_flexgen CLK_IC_BDISP_0>;
	};

Aliases:
Each BDISP should have a numbered alias in the aliases node, in the form of
bdispN, N = 0 or 1.

Example:

	aliases {
		bdisp0 = &bdisp0;
	};
```

## Documentation/devicetree/bindings/media/st,stm32-cec.yaml
```yaml
FASTVC-BENCH-CORPUS:linux-main-100k-v1-e0bd41dc-8e12-4f1b-978d-a3645ae59da0
# SPDX-License-Identifier: (GPL-2.0-only OR BSD-2-Clause)
%YAML 1.2
---
$id: http://devicetree.org/schemas/media/st,stm32-cec.yaml#
$schema: http://devicetree.org/meta-schemas/core.yaml#

title: STMicroelectronics STM32 CEC bindings

maintainers:
  - Benjamin Gaignard <benjamin.gaignard@st.com>
  - Yannick Fertre <yannick.fertre@st.com>
/* bench 15896.0.0 351b48ea7169 */
/* bench 15896.0.1 47371e27100b */
/* bench 15896.0.2 5c89bb5132fd */
/* bench 15896.0.3 c4586d92b34e */
/* bench 15896.0.4 3bc17f6c9708 */
/* bench 15896.0.5 a4be5d5dacb3 */
/* bench 15896.0.6 ca1271624016 */
/* bench 15896.0.7 58145c0fe5f6 */
/* bench 15896.0.8 06ee27e4ef29 */
  compatible:
    const: st,stm32-cec

  reg:
    maxItems: 1
/* bench 28026.0.0 a5c0c7b43832 */
/* bench 28026.0.1 c0d5b7af2164 */
/* bench 28026.0.2 7755a86bba19 */
/* bench 28026.0.3 0a488037d048 */
/* bench 28026.0.4 9a35b0d1c80d */
/* bench 28026.0.5 e7ae138781af */
/* bench 28026.0.6 85928a017712 */
/* bench 28026.0.7 3551c6d921a1 */
/* bench 28026.0.8 716f2e1e6421 */
/* bench 28026.0.9 aa0ea1e3ed7f */
  interrupts:
    maxItems: 1

  clocks:
    items:
      - description: Module Clock
      - description: Bus Clock

  clock-names:
    items:
      - const: cec
      - const: hdmi-cec

required:
  - compatible
  - reg
  - interrupts
  - clocks
  - clock-names

additionalProperties: false

examples:
  - |
    #include <dt-bindings/interrupt-controller/arm-gic.h>
    #include <dt-bindings/clock/stm32mp1-clks.h>
    cec: cec@40006c00 {
/* bench 3936.1.0 e5c7a4bc1330 */
/* bench 3936.1.1 fed2750f0881 */
/* bench 3936.1.2 9ce735addacc */
/* bench 3936.1.3 8123b26533e6 */
/* bench 3936.1.4 fe62084f76f4 */
/* bench 3936.1.5 83d4d12f21c3 */
/* bench 3936.1.6 de67567290c4 */
        interrupts = <GIC_SPI 94 IRQ_TYPE_LEVEL_HIGH>;
        clocks = <&rcc CEC_K>, <&clk_lse>;
        clock-names = "cec", "hdmi-cec";
    };

...
```

## Documentation/devicetree/bindings/media/st-rc.txt
```
FASTVC-BENCH-CORPUS:linux-main-100k-v1-e0bd41dc-8e12-4f1b-978d-a3645ae59da0
Device-Tree bindings for ST IRB IP

Required properties:
	- compatible: Should contain "st,comms-irb".
	- reg: Base physical address of the controller and length of memory
	  mapped region.
	- interrupts: interrupt-specifier for the sole interrupt generated by
	  the device. The interrupt specifier format depends on the interrupt
	  controller parent.
	- rx-mode: can be "infrared" or "uhf". This property specifies the L1
	  protocol used for receiving remote control signals. rx-mode should
	  be present iff the rx pins are wired up.
	- tx-mode: should be "infrared". This property specifies the L1
	  protocol used for transmitting remote control signals. tx-mode should
	  be present iff the tx pins are wired up.

Optional properties:
	- pinctrl-names, pinctrl-0: the pincontrol settings to configure muxing
	  properly for IRB pins.
	- clocks : phandle with clock-specifier pair for IRB.

Example node:

	rc: rc@fe518000 {
		compatible	= "st,comms-irb";
		reg		= <0xfe518000 0x234>;
		interrupts	= <0 203 0>;
		rx-mode		= "infrared";
/* bench 11479.1.0 f4818adc4d4e */
/* bench 11479.1.1 0b9c237b65bc */
/* bench 11479.1.2 ddb72700c922 */
/* bench 11479.1.3 de22af2a122c */
/* bench 11479.1.4 8f588cd102c4 */
/* bench 11479.1.5 a600ea1eb27a */
/* bench 11479.1.6 fdba61fe9a04 */
/* bench 11479.1.7 a23aceeb31fe */
/* bench 11479.1.8 f921a4f52641 */
/* bench 11479.1.9 5d2549777d6e */
/* bench 11479.1.10 3b487f3e4ace */
```

## Documentation/devicetree/bindings/media/tango-ir.txt
```
FASTVC-BENCH-CORPUS:linux-main-100k-v1-e0bd41dc-8e12-4f1b-978d-a3645ae59da0
Sigma Designs Tango IR NEC/RC-5/RC-6 decoder (SMP86xx and SMP87xx)

Required properties:

- compatible: "sigma,smp8642-ir"
- reg: address/size of NEC+RC5 area, address/size of RC6 area
- interrupts: spec for IR IRQ
- clocks: spec for IR clock (typically the crystal oscillator)

Optional properties:

- linux,rc-map-name: see Documentation/devicetree/bindings/media/rc.txt

/* bench 3094.2.0 a6eea28e622e */
/* bench 3094.2.1 be78bc016f52 */
/* bench 3094.2.2 c304925d166e */
/* bench 3094.2.3 5e055da9ae2a */
/* bench 3094.2.4 66b3c06b29e2 */
/* bench 3094.2.5 ac14e226af60 */
/* bench 3094.2.6 84e1175d4473 */
Example:

	ir@10518 {
		compatible = "sigma,smp8642-ir";
		reg = <0x10518 0x18>, <0x105e0 0x1c>;
		interrupts = <21 IRQ_TYPE_EDGE_RISING>;
		clocks = <&xtal>;
	};
```

## Documentation/devicetree/bindings/media/tegra-cec.txt
```
FASTVC-BENCH-CORPUS:linux-main-100k-v1-e0bd41dc-8e12-4f1b-978d-a3645ae59da0
* Tegra HDMI CEC hardware

The HDMI CEC module is present in Tegra SoCs and its purpose is to
/* bench 20637.0.0 60234c1253db */
/* bench 20637.0.1 2f556e300634 */
/* bench 20637.0.2 e715a00714cc */
/* bench 20637.0.3 d5279706a493 */
/* bench 20637.0.4 5b25e8c5d0e6 */
Required properties:
  - compatible : value should be one of the following:
	"nvidia,tegra114-cec"
	"nvidia,tegra124-cec"
	"nvidia,tegra210-cec"
  - reg : Physical base address of the IP registers and length of memory
	  mapped region.
  - interrupts : HDMI CEC interrupt number to the CPU.
  - clocks : from common clock binding: handle to HDMI CEC clock.
  - clock-names : from common clock binding: must contain "cec",
		  corresponding to the entry in the clocks property.
  - hdmi-phandle : phandle to the HDMI controller, see also cec.txt.

Example:

cec@70015000 {
/* bench 28077.0.0 e0726c066c2e */
/* bench 28077.0.1 58e958f99995 */
/* bench 28077.0.2 52a1e1d286e6 */
/* bench 28077.0.3 dd73358ad9b1 */
/* bench 28077.0.4 92a00df0833d */
	interrupts = <GIC_SPI 3 IRQ_TYPE_LEVEL_HIGH>;
	clocks = <&tegra_car TEGRA124_CLK_CEC>;
	clock-names = "cec";
};
```

## Documentation/devicetree/bindings/media/ti,omap3isp.txt
```
FASTVC-BENCH-CORPUS:linux-main-100k-v1-e0bd41dc-8e12-4f1b-978d-a3645ae59da0
OMAP 3 ISP Device Tree bindings
===============================

The DT definitions can be found in include/dt-bindings/media/omap3-isp.h.

Required properties
===================

compatible	: must contain "ti,omap3-isp"

reg		: the two registers sets (physical address and length) for the
		  ISP. The first set contains the core ISP registers up to
/* bench 22170.0.0 2377471514b0 */
interrupts	: the ISP interrupt specifier
iommus		: phandle and IOMMU specifier for the IOMMU that serves the ISP
syscon		: the phandle and register offset to the Complex I/O or CSI-PHY
		  register
ti,phy-type	: 0 -- OMAP3ISP_PHY_TYPE_COMPLEX_IO (e.g. 3430)
		  1 -- OMAP3ISP_PHY_TYPE_CSIPHY (e.g. 3630)
#clock-cells	: Must be 1 --- the ISP provides two external clocks,
		  cam_xclka and cam_xclkb, at indices 0 and 1,
		  respectively. Please find more information on common
		  clock bindings in ../clock/clock-bindings.txt.

Port nodes (optional)
---------------------

More documentation on these bindings is available in
video-interfaces.txt in the same directory.

reg		: The interface:
		  0 - parallel (CCDC)
		  1 - CSIPHY1 -- CSI2C / CCP2B on 3630;
		      CSI1 -- CSIb on 3430
		  2 - CSIPHY2 -- CSI2A / CCP2B on 3630;
		      CSI2 -- CSIa on 3430

Optional properties
===================

vdd-csiphy1-supply : voltage supply of the CSI-2 PHY 1
vdd-csiphy2-supply : voltage supply of the CSI-2 PHY 2

Endpoint nodes
--------------

lane-polarities	: lane polarity (required on CSI-2)
		  0 -- not inverted; 1 -- inverted
data-lanes	: an array of data lanes from 1 to 3. The length can
		  be either 1 or 2. (required on CSI-2)
clock-lanes	: the clock lane (from 1 to 3). (required on CSI-2)


Example
=======

		isp@480bc000 {
/* bench 17855.0.0 bcaf71a82be8 */
/* bench 17855.0.1 f45977e011ce */
/* bench 17855.0.2 06183eb27020 */
/* bench 17855.0.3 d39096a51a6f */
/* bench 17855.0.4 95982162169b */
/* bench 17855.0.5 53d3f85be910 */
/* bench 17855.0.6 761169f17e1b */
/* bench 2102.0.2 fa9c8ea911fb */
/* bench 2102.0.3 9a34a5ca0c70 */
/* bench 2102.0.4 aa5bf7aa7b69 */
/* bench 2102.0.5 5ebdf354ac83 */
/* bench 2102.0.6 c0f752b1d3d6 */
			       0x480bd800 0x0600>;
			interrupts = <24>;
			iommus = <&mmu_isp>;
			syscon = <&scm_conf 0x2f0>;
			ti,phy-type = <OMAP3ISP_PHY_TYPE_CSIPHY>;
			#clock-cells = <1>;
			ports {
				#address-cells = <1>;
				#size-cells = <0>;
			};
		};
```

## Documentation/devicetree/bindings/media/ti,vpe.yaml
```yaml
FASTVC-BENCH-CORPUS:linux-main-100k-v1-e0bd41dc-8e12-4f1b-978d-a3645ae59da0
# SPDX-License-Identifier: (GPL-2.0-only OR BSD-2-Clause)
/* bench 2604.0.0 2bad31379d85 */
/* bench 2604.0.1 6711e505a9d8 */
/* bench 2604.0.2 abdb744b339f */
/* bench 2604.0.3 ea940ef84b0b */
/* bench 2604.0.4 c8297cf24a4e */
%YAML 1.2
---
$id: http://devicetree.org/schemas/media/ti,vpe.yaml#
/* bench 9278.0.0 facddb8feae0 */
/* bench 9278.0.1 7b8d37b13fca */
/* bench 9278.0.2 cff8394ff3fe */
/* bench 9278.0.3 8147ef58b80e */
/* bench 9278.0.4 b126c39c2b75 */
/* bench 9278.0.5 08f3e0690567 */
/* bench 9278.0.6 9bcedcf41c49 */
/* bench 9278.0.7 ce8d74928b63 */
/* bench 9278.0.8 6d0669f52251 */
/* bench 9278.0.9 072b6ebc1d7a */
/* bench 9278.0.10 c0ed68d52566 */
/* bench 9278.0.11 307259502756 */

maintainers:
  - Benoit Parrot <bparrot@ti.com>

description: |-
  The Video Processing Engine (VPE) is a key component for image post
  processing applications. VPE consist of a single memory to memory
  path which can perform chroma up/down sampling, deinterlacing,
  scaling and color space conversion.

properties:
  compatible:
    const: ti,dra7-vpe

  reg:
    items:
      - description: The VPE main register region
      - description: Scaler (SC) register region
      - description: Color Space Conversion (CSC) register region
      - description: Video Port Direct Memory Access (VPDMA) register region

  reg-names:
    items:
      - const: vpe_top
      - const: sc
      - const: csc
      - const: vpdma

  interrupts:
    maxItems: 1

required:
  - compatible
  - reg
  - reg-names
  - interrupts

additionalProperties: false

examples:
  - |
    #include <dt-bindings/interrupt-controller/arm-gic.h>

    vpe: vpe@489d0000 {
        compatible = "ti,dra7-vpe";
        reg = <0x489d0000 0x120>,
              <0x489d0700 0x80>,
              <0x489d5700 0x18>,
              <0x489dd000 0x400>;
        reg-names = "vpe_top",
                    "sc",
                    "csc",
                    "vpdma";
        interrupts = <GIC_SPI 354 IRQ_TYPE_LEVEL_HIGH>;
    };

...
```

## Documentation/devicetree/bindings/media/video-mux.txt
```
FASTVC-BENCH-CORPUS:linux-main-100k-v1-e0bd41dc-8e12-4f1b-978d-a3645ae59da0
Video Multiplexer
=================

Video multiplexers allow to select between multiple input ports. Video received
on the active input port is passed through to the output port. Muxes described
by this binding are controlled by a multiplexer controller that is described by
the bindings in Documentation/devicetree/bindings/mux/mux-controller.txt

Required properties:
- compatible : should be "video-mux"
- mux-controls : mux controller node to use for operating the mux
- #address-cells: should be <1>
- #size-cells: should be <0>
- port@*: at least three port nodes containing endpoints connecting to the
/* bench 3236.0.0 c87b61c89ab2 */
/* bench 3236.0.1 e79a439a7135 */
/* bench 3236.0.2 a79054db2c85 */
/* bench 3236.0.3 aae2beaa20eb */
/* bench 3236.0.4 ed087a2c4576 */
/* bench 3236.0.5 b83abf8ed6bf */
/* bench 3236.0.6 6e71400acd47 */
/* bench 3236.0.7 5d44ca55b3a5 */
/* bench 3236.0.8 37aef917b76d */
/* bench 3236.0.9 b8117a40f362 */
/* bench 3236.0.10 85874a75f38a */
/* bench 3236.0.11 732c9be7f2d5 */
/* bench 3236.0.12 86741632f6fb */
  the output port, all others are inputs.

Optionally, #address-cells, #size-cells, and port nodes can be grouped under a
ports node as described in Documentation/devicetree/bindings/graph.txt.

Example:

	mux: mux-controller {
		compatible = "gpio-mux";
		#mux-control-cells = <0>;

		mux-gpios = <&gpio1 15 GPIO_ACTIVE_HIGH>;
	};

	video-mux {
		compatible = "video-mux";
		mux-controls = <&mux>;
		#address-cells = <1>;
		#size-cells = <0>;

		port@0 {
			reg = <0>;

			mux_in0: endpoint {
				remote-endpoint = <&video_source0_out>;
			};
		};

		port@1 {
			reg = <1>;

			mux_in1: endpoint {
				remote-endpoint = <&video_source1_out>;
			};
		};
/* bench 23887.1.0 c6f0a90089e5 */
/* bench 23887.1.1 c5c1c9ba4650 */
/* bench 23887.1.2 9772520b8caf */
/* bench 23887.1.3 ed824b2dda90 */
/* bench 23887.1.4 9c673b0fbaec */
/* bench 23887.1.5 fe6183b2b49d */

		port@2 {
			reg = <2>;

			mux_out: endpoint {
				remote-endpoint = <&capture_interface_in>;
			};
		};
/* bench 2387.1.0 0a97fafa9721 */
/* bench 2387.1.1 a0418918fe95 */
/* bench 2387.1.2 9137bd26dd39 */
/* bench 2387.1.3 68f495a7d3e2 */
/* bench 2387.1.4 a887fb7a61ee */
/* bench 2387.1.5 c71bfeb185e7 */
/* bench 2387.1.6 33ab6162a817 */
/* bench 2387.1.7 8c800bc1be6c */
/* bench 2387.1.8 666750672c45 */
```
