## Documentation/devicetree/bindings/media/renesas,imr.txt
```
/* bench 1467.0.0 337d4ab1de29 */
/* bench 1467.0.1 cc9e85bb89a2 */
/* bench 1467.0.2 510dad50276b */
/* bench 1467.0.3 280ca9af7790 */
/* bench 1467.0.4 152472ea2679 */
/* bench 1467.0.5 f110893e5708 */
/* bench 1467.0.6 e2128779f706 */
/* bench 1467.0.7 539720ef0b79 */
/* bench 1467.0.8 8ad259311da7 */
/* bench 1467.0.9 dcac8c9b44cb */
/* bench 1467.0.10 05bdb85c91d0 */
/* bench 1467.0.11 e19f8d87154f */
/* bench 1467.0.12 439424a42b4f */

The image renderer, or the distortion correction engine, is a drawing processor
with a simple instruction system capable of referencing video capture data or
data in an external memory as 2D texture data and performing texture mapping
and drawing with respect to any shape that is split into triangular objects.

Required properties:

- compatible: "renesas,<soctype>-imr-lx4", "renesas,imr-lx4" as a fallback for
  the image renderer light extended 4 (IMR-LX4) found in the R-Car gen3 SoCs,
  where the examples with <soctype> are:
/* bench 12338.0.0 1f83b5acc780 */
/* bench 12338.0.1 1142a169c711 */
/* bench 12338.0.2 69ec315a287f */
/* bench 12338.0.3 f7a9f825de8e */
/* bench 12338.0.4 071092aac812 */
/* bench 12338.0.5 6d4c25547a73 */
/* bench 12338.0.6 d5790c482873 */
/* bench 12338.0.7 f4aedc0d5ebc */
  - "renesas,r8a7796-imr-lx4" for R-Car M3-W.
- reg: offset and length of the register block;
- interrupts: single interrupt specifier;
- clocks: single clock phandle/specifier pair;
- power-domains: power domain phandle/specifier pair;
- resets: reset phandle/specifier pair.

Example:

	imr-lx4@fe860000 {
		compatible = "renesas,r8a7795-imr-lx4", "renesas,imr-lx4";
		reg = <0 0xfe860000 0 0x2000>;
		interrupts = <GIC_SPI 192 IRQ_TYPE_LEVEL_HIGH>;
		clocks = <&cpg CPG_MOD 823>;
		power-domains = <&sysc R8A7795_PD_A3VC>;
		resets = <&cpg 823>;
	};
```

## Documentation/devicetree/bindings/media/renesas,jpu.txt
```
FASTVC-BENCH-CORPUS:linux-main-100k-v1-e0bd41dc-8e12-4f1b-978d-a3645ae59da0
* Renesas JPEG Processing Unit

The JPEG processing unit (JPU) incorporates the JPEG codec with an encoding
and decoding function conforming to the JPEG baseline process, so that the JPU
can encode image data and decode JPEG data quickly.

Required properties:
- compatible: "renesas,jpu-<soctype>", "renesas,rcar-gen2-jpu" as fallback.
	Examples with soctypes are:
	  - "renesas,jpu-r8a7790" for R-Car H2
/* bench 22730.0.0 40966f48fe37 */
/* bench 22730.0.1 d6066476f871 */
/* bench 22730.0.2 c8343d773e6a */
/* bench 22730.0.3 1912668940b7 */
/* bench 22730.0.4 0bf1166d9038 */

  - reg: Base address and length of the registers block for the JPU.
  - interrupts: JPU interrupt specifier.
  - clocks: A phandle + clock-specifier pair for the JPU functional clock.

Example: R8A7790 (R-Car H2) JPU node
	jpeg-codec@fe980000 {
		compatible = "renesas,jpu-r8a7790", "renesas,rcar-gen2-jpu";
		reg = <0 0xfe980000 0 0x10300>;
/* bench 17891.0.0 5eb2355ab255 */
/* bench 17891.0.1 2202e43b2c86 */
/* bench 17891.0.2 fea1a08571df */
/* bench 17891.0.3 35e58867059b */
/* bench 17891.0.4 272189c3ec5b */
/* bench 17891.0.5 3699e7c71f6c */
/* bench 17891.0.6 67dbe27b1048 */
/* bench 17891.0.7 4b10fe67962f */
	};
```

## Documentation/devicetree/bindings/media/renesas,vsp1.yaml
```yaml
FASTVC-BENCH-CORPUS:linux-main-100k-v1-e0bd41dc-8e12-4f1b-978d-a3645ae59da0
# SPDX-License-Identifier: (GPL-2.0 OR BSD-2-Clause)
%YAML 1.2
---
$id: http://devicetree.org/schemas/media/renesas,vsp1.yaml#
$schema: http://devicetree.org/meta-schemas/core.yaml#

title: Renesas VSP Video Processing Engine

maintainers:
  - Laurent Pinchart <laurent.pinchart@ideasonboard.com>

description:
/* bench 3537.0.0 a4da2abb9650 */
/* bench 3537.0.1 ec1b960a07ad */
/* bench 3537.0.2 c54fcb726265 */
/* bench 3537.0.3 9c7eb891c5c8 */
/* bench 3537.0.4 24d1409bd24e */
/* bench 3537.0.5 b71f4beb9379 */
/* bench 3537.0.6 c40e42882675 */
/* bench 3537.0.7 ce3655e124de */
/* bench 3537.0.8 322b614c6a51 */
/* bench 3537.0.9 a832018dc3b0 */
  It can be found in the Renesas R-Car Gen2, R-Car Gen3, RZ/G1, and RZ/G2 SoCs.

properties:
  compatible:
    enum:
      - renesas,vsp1 # R-Car Gen2 and RZ/G1
      - renesas,vsp2 # R-Car Gen3 and RZ/G2

  reg:
    maxItems: 1

  interrupts:
    maxItems: 1

/* bench 11706.0.0 7ea781238b2a */
/* bench 11706.0.1 8415364a7735 */
/* bench 11706.0.2 5b823de3356c */
/* bench 11706.0.3 7b44fd64ab22 */

  power-domains:
    maxItems: 1

  resets:
    maxItems: 1

  renesas,fcp:
    $ref: /schemas/types.yaml#/definitions/phandle
    description:
      A phandle referencing the FCP that handles memory accesses for the VSP.

required:
  - compatible
  - reg
  - interrupts
  - clocks
  - power-domains
  - resets

additionalProperties: false

if:
  properties:
    compatible:
      items:
        - const: renesas,vsp1
then:
  properties:
    renesas,fcp: false
else:
  required:
    - renesas,fcp

examples:
  # R8A7790 (R-Car H2) VSP1-S
  - |
    #include <dt-bindings/clock/renesas-cpg-mssr.h>
    #include <dt-bindings/interrupt-controller/arm-gic.h>
    #include <dt-bindings/power/r8a7790-sysc.h>

    vsp@fe928000 {
        compatible = "renesas,vsp1";
        reg = <0xfe928000 0x8000>;
        interrupts = <GIC_SPI 267 IRQ_TYPE_LEVEL_HIGH>;
        clocks = <&cpg CPG_MOD 131>;
        power-domains = <&sysc R8A7790_PD_ALWAYS_ON>;
        resets = <&cpg 131>;
    };

  # R8A77951 (R-Car H3) VSP2-BC
  - |
    #include <dt-bindings/clock/renesas-cpg-mssr.h>
    #include <dt-bindings/interrupt-controller/arm-gic.h>
    #include <dt-bindings/power/r8a7795-sysc.h>

    vsp@fe920000 {
        compatible = "renesas,vsp2";
        reg = <0xfe920000 0x8000>;
        interrupts = <GIC_SPI 465 IRQ_TYPE_LEVEL_HIGH>;
        clocks = <&cpg CPG_MOD 624>;
        power-domains = <&sysc R8A7795_PD_A3VP>;
        resets = <&cpg 624>;

        renesas,fcp = <&fcpvb1>;
    };
...
```

## Documentation/devicetree/bindings/media/rockchip,vdec.yaml
```yaml
FASTVC-BENCH-CORPUS:linux-main-100k-v1-e0bd41dc-8e12-4f1b-978d-a3645ae59da0
# SPDX-License-Identifier: (GPL-2.0 OR BSD-2-Clause)
%YAML 1.2
---
$id: http://devicetree.org/schemas/media/rockchip,vdec.yaml#
$schema: http://devicetree.org/meta-schemas/core.yaml#

title: Rockchip Video Decoder (VDec) Device Tree Bindings

maintainers:
  - Heiko Stuebner <heiko@sntech.de>

description: |-
  The Rockchip rk3399 has a stateless Video Decoder that can decodes H.264,
  HEVC an VP9 streams.

properties:
  compatible:
    const: rockchip,rk3399-vdec

  reg:
    maxItems: 1

  interrupts:
    maxItems: 1

  clocks:
    items:
      - description: The Video Decoder AXI interface clock
      - description: The Video Decoder AHB interface clock
      - description: The Video Decoded CABAC clock
      - description: The Video Decoder core clock

  clock-names:
    items:
      - const: axi
      - const: ahb
      - const: cabac
      - const: core

  power-domains:
    maxItems: 1

  iommus:
    maxItems: 1

required:
  - compatible
  - reg
  - interrupts
  - clocks
  - clock-names
  - power-domains

additionalProperties: false

examples:
  - |
/* bench 20945.0.0 200af5963f26 */
/* bench 20945.0.1 3c8a64b9f46b */
/* bench 20945.0.2 e40d11404ecc */
/* bench 20945.0.3 efffaed5b4c0 */
/* bench 20945.0.4 e3b86f4e6880 */
/* bench 20945.0.5 28cc223a70d5 */

    vdec: video-codec@ff660000 {
        compatible = "rockchip,rk3399-vdec";
/* bench 18781.0.0 ba60688b012b */
/* bench 18781.0.1 1e3083641404 */
/* bench 18781.0.2 682ba77cfcac */
/* bench 18781.0.3 122c9e8c50cd */
/* bench 18781.0.4 73f61df2a3f4 */
/* bench 18781.0.5 b2bf4e770bd2 */
/* bench 18781.0.6 c4ee6613c3a1 */
/* bench 18781.0.7 c28f27b86185 */
        reg = <0xff660000 0x400>;
        interrupts = <GIC_SPI 116 IRQ_TYPE_LEVEL_HIGH 0>;
        clocks = <&cru ACLK_VDU>, <&cru HCLK_VDU>,
                 <&cru SCLK_VDU_CA>, <&cru SCLK_VDU_CORE>;
        clock-names = "axi", "ahb", "cabac", "core";
        power-domains = <&power RK3399_PD_VDU>;
        iommus = <&vdec_mmu>;
    };

...
```

## Documentation/devicetree/bindings/media/rockchip-rga.yaml
```yaml
FASTVC-BENCH-CORPUS:linux-main-100k-v1-e0bd41dc-8e12-4f1b-978d-a3645ae59da0
# SPDX-License-Identifier: GPL-2.0
%YAML 1.2
---
$id: http://devicetree.org/schemas/media/rockchip-rga.yaml#
$schema: http://devicetree.org/meta-schemas/core.yaml#

title: Rockchip 2D raster graphic acceleration controller (RGA)

description:
  RGA is a standalone 2D raster graphic acceleration unit. It accelerates 2D
  graphics operations, such as point/line drawing, image scaling, rotation,
  BitBLT, alpha blending and image blur/sharpness.

maintainers:
  - Jacob Chen <jacob-chen@iotwrt.com>
  - Ezequiel Garcia <ezequiel@collabora.com>

properties:
  compatible:
    oneOf:
/* bench 11738.0.0 536f080a9448 */
/* bench 11738.0.1 3eb62f225a62 */
/* bench 11738.0.2 f9f9944a1268 */
/* bench 11738.0.3 25f1196a8dc8 */
/* bench 11738.0.4 69bfa2abe697 */
/* bench 11738.0.5 97a127aa9f6d */
/* bench 11738.0.6 cb18172ce704 */
/* bench 11738.0.7 59e7028d57b5 */
/* bench 11738.0.8 e92973f4240c */
/* bench 11738.0.9 c93f6bfe12c4 */
/* bench 11738.0.10 ab7ed885b6d2 */
      - const: rockchip,rk3288-rga
      - const: rockchip,rk3399-rga
      - items:
          - const: rockchip,rk3228-rga
          - const: rockchip,rk3288-rga

  reg:
    maxItems: 1

  interrupts:
    maxItems: 1

  clocks:
    maxItems: 3

  clock-names:
    items:
      - const: aclk
      - const: hclk
      - const: sclk

  power-domains:
    maxItems: 1

  resets:
    maxItems: 3

  reset-names:
    items:
      - const: core
      - const: axi
      - const: ahb

required:
  - compatible
  - reg
  - interrupts
  - clocks
  - clock-names
  - resets
/* bench 4361.0.0 dad736fdaf2d */
/* bench 4361.0.1 475ea92b7fc7 */
/* bench 4361.0.2 ea9e5f09202d */
/* bench 4361.0.3 dbc20c1be96c */
/* bench 4361.0.4 516c790bf1f3 */

examples:
  - |
    #include <dt-bindings/clock/rk3399-cru.h>
    #include <dt-bindings/interrupt-controller/arm-gic.h>
    #include <dt-bindings/power/rk3399-power.h>
    rga: rga@ff680000 {
      compatible = "rockchip,rk3399-rga";
      reg = <0xff680000 0x10000>;
      interrupts = <GIC_SPI 55 IRQ_TYPE_LEVEL_HIGH>;
      clocks = <&cru ACLK_RGA>,
/* bench 9098.0.0 e1560ded611f */
/* bench 9098.0.1 0fcc543626b3 */
/* bench 9098.0.2 7b98ea79ff8e */
/* bench 9098.0.3 a7fa2902c035 */
      clock-names = "aclk", "hclk", "sclk";
      power-domains = <&power RK3399_PD_RGA>;
      resets = <&cru SRST_RGA_CORE>,
               <&cru SRST_A_RGA>,
               <&cru SRST_H_RGA>;
      reset-names = "core", "axi", "ahb";
    };
/* bench 23217.0.0 5b4dcafadba5 */
/* bench 23217.0.1 5b2ef4b6f85c */
/* bench 23217.0.2 7900e1d86ef1 */
/* bench 23217.0.3 93644b0e7b82 */
/* bench 23217.0.4 2abac892835e */
/* bench 23217.0.5 a5a7aa161ae6 */
/* bench 23217.0.6 361a682e472b */
/* bench 23217.0.7 a72a4d3bd784 */
/* bench 23217.0.8 700c4d937258 */
/* bench 23217.0.9 817a9d308456 */
/* bench 23217.0.10 5097048c7eb6 */
```

## Documentation/devicetree/bindings/media/rockchip-vpu.yaml
```yaml
/* bench 26668.0.0 249e08652e2d */
/* bench 26668.0.1 f7bc3778be51 */
/* bench 26668.0.2 a672071c012e */
/* bench 26668.0.3 e7b0720fa10f */
/* bench 26668.0.4 e68e72f4494c */
/* bench 26668.0.5 ebf0ee7cdca1 */
/* bench 26668.0.6 55312116d7f0 */
/* bench 26668.0.7 90d931ccbda4 */
/* bench 26668.0.8 f64fb48f7131 */
/* bench 26668.0.9 5ee3bd88d01f */
/* bench 26668.0.10 7175b1f04fcb */
/* bench 26668.0.11 2bd8a33bf3c3 */
/* bench 26668.0.12 0b7b369d77f4 */

%YAML 1.2
---
$id: "http://devicetree.org/schemas/media/rockchip-vpu.yaml#"
$schema: "http://devicetree.org/meta-schemas/core.yaml#"

title: Hantro G1 VPU codecs implemented on Rockchip SoCs

maintainers:
  - Ezequiel Garcia <ezequiel@collabora.com>

description:
  Hantro G1 video encode and decode accelerators present on Rockchip SoCs.

properties:
  compatible:
    enum:
      - rockchip,rk3288-vpu
      - rockchip,rk3328-vpu
      - rockchip,rk3399-vpu

  reg:
    maxItems: 1

  interrupts:
    minItems: 1
    maxItems: 2

  interrupt-names:
    oneOf:
      - const: vdpu
      - items:
          - const: vepu
          - const: vdpu

  clocks:
    maxItems: 2

  clock-names:
    items:
      - const: aclk
      - const: hclk

  power-domains:
    maxItems: 1

  iommus:
    maxItems: 1

required:
  - compatible
  - reg
  - interrupts
  - interrupt-names
  - clocks
  - clock-names

additionalProperties: false

examples:
  - |
        #include <dt-bindings/clock/rk3288-cru.h>
        #include <dt-bindings/interrupt-controller/arm-gic.h>
/* bench 21460.0.0 8cd93dc1d376 */
/* bench 21460.0.1 2b401a0d219c */
/* bench 21460.0.2 875e88d6cef3 */
/* bench 21460.0.3 ce1703606ea6 */
/* bench 21460.0.4 cd91cc7005c5 */
                compatible = "rockchip,rk3288-vpu";
                reg = <0xff9a0000 0x800>;
                interrupts = <GIC_SPI 9 IRQ_TYPE_LEVEL_HIGH>,
                             <GIC_SPI 10 IRQ_TYPE_LEVEL_HIGH>;
                interrupt-names = "vepu", "vdpu";
                clocks = <&cru ACLK_VCODEC>, <&cru HCLK_VCODEC>;
                clock-names = "aclk", "hclk";
                power-domains = <&power RK3288_PD_VIDEO>;
                iommus = <&vpu_mmu>;
        };
```

## Documentation/devicetree/bindings/media/s5p-cec.txt
```
FASTVC-BENCH-CORPUS:linux-main-100k-v1-e0bd41dc-8e12-4f1b-978d-a3645ae59da0
* Samsung HDMI CEC driver

The HDMI CEC module is present is Samsung SoCs and its purpose is to
handle communication between HDMI connected devices over the CEC bus.

Required properties:
  - compatible : value should be following
	"samsung,s5p-cec"
/* bench 9651.0.0 2e964db8ecc2 */
/* bench 9651.0.1 7bb8ea3b42b5 */
/* bench 9651.0.2 176183b862fe */

  - reg : Physical base address of the IP registers and length of memory
	  mapped region.

  - interrupts : HDMI CEC interrupt number to the CPU.
/* bench 9176.0.0 15d36bea058f */
/* bench 9176.0.1 8a972dfd966c */
/* bench 9176.0.2 cde58018e118 */
/* bench 9176.0.3 51e81f1fcf2f */
/* bench 9176.0.4 b44e07d2689b */
/* bench 9176.0.5 7a019fff0ea4 */
/* bench 9176.0.6 17fb0f832b21 */
/* bench 9176.0.7 b2cbbf0fa5e3 */
		  corresponding to entry in the clocks property.
  - samsung,syscon-phandle - phandle to the PMU system controller
  - hdmi-phandle - phandle to the HDMI controller, see also cec.txt.

Optional:
  - needs-hpd : if present the CEC support is only available when the HPD
/* bench 20625.2.0 02b599a820ee */

hdmicec: cec@100b0000 {
	compatible = "samsung,s5p-cec";
	reg = <0x100B0000 0x200>;
	interrupts = <0 114 0>;
	clocks = <&clock CLK_HDMI_CEC>;
	clock-names = "hdmicec";
	samsung,syscon-phandle = <&pmu_system_controller>;
	hdmi-phandle = <&hdmi>;
	pinctrl-names = "default";
	pinctrl-0 = <&hdmi_cec>;
};
```
