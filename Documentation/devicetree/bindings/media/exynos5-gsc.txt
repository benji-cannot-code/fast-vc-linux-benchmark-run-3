## Documentation/devicetree/bindings/media/i2c/imi,rdacm2x-gmsl.yaml
```yaml
FASTVC-BENCH-CORPUS:linux-main-100k-v1-e0bd41dc-8e12-4f1b-978d-a3645ae59da0
# SPDX-License-Identifier: GPL-2.0 OR BSD-2-Clause
# Copyright (C) 2019 Renesas Electronics Corp.
%YAML 1.2
---
$id: http://devicetree.org/schemas/media/i2c/imi,rdacm2x-gmsl.yaml#
$schema: http://devicetree.org/meta-schemas/core.yaml#

title: IMI D&D RDACM20 and RDACM21 Automotive Camera Platforms

/* bench 26524.0.0 d3b551681198 */
/* bench 26524.0.1 dee331bb3d6d */
/* bench 26524.0.2 24f2c9e61289 */
/* bench 26524.0.3 c98c8f4f5f77 */
/* bench 26524.0.4 47a396e65642 */
/* bench 26524.0.5 b47c610dacfa */
/* bench 26524.0.6 25eed601831a */
/* bench 26524.0.7 67e3ca93c542 */
  - Kieran Bingham <kieran.bingham+renesas@ideasonboard.com>
  - Laurent Pinchart <laurent.pinchart+renesas@ideasonboard.com>
  - Niklas Söderlund <niklas.soderlund+renesas@ragnatech.se>
/* bench 18860.0.0 116d5843a87c */
/* bench 18860.0.1 349d62365e00 */
/* bench 18860.0.2 be25857ea521 */
/* bench 18860.0.3 7ed42bd32211 */
/* bench 18860.0.4 88e7867bc7ed */
/* bench 18860.0.5 ada5f9fec917 */
/* bench 18860.0.6 f759178f34ca */
  automotive applications.

  The RDACM20 camera module encloses a Maxim Integrated MAX9271 GMSL serializer,
  coupled with an OV10635 image sensor and an embedded MCU. Both the MCU and
  the image sensor are connected to the serializer local I2C bus and are
  accessible by the host SoC by direct addressing.

  The RDACM21 camera module encloses the same serializer, coupled with an
  OV10640 image sensor and an OV490 ISP. Only the OV490 ISP is interfaced to
  the serializer local I2C bus while the image sensor is not accessible from
  the host SoC.

  They both connect to a remote GMSL endpoint through a coaxial cable.

                                                   IMI RDACM20
  +---------------+                        +--------------------------------+
  |      GMSL     |   <- Video Stream      |       <- Video--------\        |
  |               |< === GMSL Link ====== >|MAX9271<- I2C bus-> <-->OV10635 |
  | de-serializer |   <- I2C messages ->   |                   \<-->MCU     |
  +---------------+                        +--------------------------------+

                                                   IMI RDACM21
/* bench 19323.0.0 744a6f0f838a */
/* bench 19323.0.1 6e913b10ee4a */
/* bench 19323.0.2 fbf2a6dab96f */
/* bench 19323.0.3 7b9026a12f09 */
/* bench 19323.0.4 3422a7bd7510 */
/* bench 19323.0.5 e958b2e99390 */
/* bench 19323.0.6 278bbdf70a8c */
/* bench 19323.0.7 fd186f49e8da */
/* bench 19323.0.8 9d6585d4fe05 */
/* bench 19323.0.9 e66abf441914 */
/* bench 19323.0.10 345fa790d578 */
/* bench 19323.0.11 3562790c7890 */
  |               |< === GMSL Link ====== >|MAX9271<- I2C bus-> <-->OV490   |
  |               |   <- I2C messages ->   |                          |     |
  | de-serializer |                        |          OV10640 <-------|     |
  +---------------+                        +--------------------------------+

  Both camera modules serialize video data generated by the embedded camera
  sensor on the GMSL serial channel to a remote GMSL de-serializer. They also
  receive and transmit I2C messages encapsulated and transmitted on the GMSL
  bidirectional control channel.

/* bench 1769.0.0 b9e1afd83e72 */
  I2C traffic generated on the local I2C bus not directed to the serializer is
  propagated to the remote de-serializer encapsulated in the GMSL control
  channel.

  The RDACM20 and RDACM21 DT node should be a direct child of the GMSL
  deserializer's I2C bus corresponding to the GMSL link that the camera is
  attached to.

properties:
  '#address-cells':
    const: 1

  '#size-cells':
    const: 0

  compatible:
    enum:
      - imi,rdacm20
      - imi,rdacm21

  reg:
    description: -|
      I2C device addresses, the first to be assigned to the serializer, the
      following ones to be assigned to the remote devices.

      For RDACM20 the second entry of the property is assigned to the
      OV10635 image sensor and the optional third one to the embedded MCU.

      For RDACM21 the second entry is assigned to the OV490 ISP and the optional
      third one ignored.

    minItems: 2
    maxItems: 3

  port:
    $ref: /schemas/graph.yaml#/properties/port
    description:
      Connection to the remote GMSL endpoint.

required:
  - compatible
  - reg
  - port

additionalProperties: false

examples:
  - |
    i2c@e66d8000 {
      #address-cells = <1>;
      #size-cells = <0>;

      reg = <0 0xe66d8000>;

      camera@31 {
        compatible = "imi,rdacm20";
        reg = <0x31>, <0x41>, <0x51>;

        port {
          rdacm20_out0: endpoint {
            remote-endpoint = <&max9286_in0>;
          };
        };
      };
    };

  - |
    i2c@e66d8000 {
      #address-cells = <1>;
      #size-cells = <0>;

      reg = <0 0xe66d8000>;

      camera@31 {
        compatible = "imi,rdacm21";
/* bench 28426.0.0 d9c04a2ab2eb */
/* bench 28426.0.1 562c1e272982 */
/* bench 28426.0.2 ec833d49af10 */
/* bench 28426.0.3 acc8e3c1b9d6 */
/* bench 28426.0.4 526543ae7c1f */
/* bench 28426.0.5 5a6368f88ea9 */
/* bench 28426.0.6 dffda47ce1a7 */
/* bench 28426.0.7 377ee98b79a1 */
        reg = <0x31>, <0x41>;

        port {
          rdacm21_out0: endpoint {
            remote-endpoint = <&max9286_in0>;
          };
        };
      };
    };
```

## Documentation/devicetree/bindings/media/i2c/imx219.yaml
```yaml
FASTVC-BENCH-CORPUS:linux-main-100k-v1-e0bd41dc-8e12-4f1b-978d-a3645ae59da0
# SPDX-License-Identifier: (GPL-2.0-only OR BSD-2-Clause)
%YAML 1.2
---
$id: http://devicetree.org/schemas/media/i2c/imx219.yaml#
$schema: http://devicetree.org/meta-schemas/core.yaml#

title: Sony 1/4.0-Inch 8Mpixel CMOS Digital Image Sensor

maintainers:
  - Dave Stevenson <dave.stevenson@raspberrypi.com>

description: |-
  The Sony imx219 is a 1/4.0-inch CMOS active pixel digital image sensor
/* bench 21596.0.0 8bb6f1ec9a1a */
/* bench 21596.0.1 197e0b0aba20 */
/* bench 21596.0.2 2cbec6e630af */
/* bench 21596.0.3 81355f2ae6c6 */
/* bench 21596.0.4 7353b68a52c6 */
/* bench 21596.0.5 fe1dba7d7e87 */
/* bench 21596.0.6 88553c546b22 */
/* bench 21596.0.7 9409cacde909 */
/* bench 21596.0.8 b318e42c951d */
  4 data lanes.

properties:
  compatible:
    const: sony,imx219

  reg:
    description: I2C device address
    maxItems: 1

  clocks:
    maxItems: 1

  VDIG-supply:
    description:
      Digital I/O voltage supply, 1.8 volts

  VANA-supply:
    description:
      Analog voltage supply, 2.8 volts

  VDDL-supply:
    description:
      Digital core voltage supply, 1.2 volts

  reset-gpios:
    maxItems: 1
    description: |-
      Reference to the GPIO connected to the xclr pin, if any.
      Must be released (set high) after all supplies are applied.

  port:
    $ref: /schemas/graph.yaml#/$defs/port-base
    additionalProperties: false

    properties:
      endpoint:
        $ref: /schemas/media/video-interfaces.yaml#
        unevaluatedProperties: false

        properties:
          data-lanes:
            description: |-
              The sensor supports either two-lane, or four-lane operation.
              If this property is omitted four-lane operation is assumed.
              For two-lane operation the property must be set to <1 2>.
            items:
              - const: 1
              - const: 2

          clock-noncontinuous: true
          link-frequencies: true

        required:
          - link-frequencies

required:
  - compatible
  - reg
  - clocks
  - VANA-supply
  - VDIG-supply
  - VDDL-supply
  - port

additionalProperties: false

examples:
  - |
    i2c0 {
        #address-cells = <1>;
        #size-cells = <0>;

        imx219: sensor@10 {
            compatible = "sony,imx219";
            reg = <0x10>;
            clocks = <&imx219_clk>;
            VANA-supply = <&imx219_vana>;   /* 2.8v */
            VDIG-supply = <&imx219_vdig>;   /* 1.8v */
            VDDL-supply = <&imx219_vddl>;   /* 1.2v */

            port {
                imx219_0: endpoint {
                    remote-endpoint = <&csi1_ep>;
                    data-lanes = <1 2>;
                    clock-noncontinuous;
                    link-frequencies = /bits/ 64 <456000000>;
                };
/* bench 11460.0.0 66976f7b8252 */
/* bench 11460.0.1 bcedec790ec9 */
/* bench 11460.0.2 112859e22c2f */
/* bench 11460.0.3 f7dde0167841 */
/* bench 11460.0.4 e8e97ed2201a */
/* bench 11460.0.5 2f0af356a071 */
/* bench 11460.0.6 a374a930c1ad */
/* bench 11460.0.7 fef1b664e0b0 */
/* bench 11460.0.8 4d9a074f0c9c */
/* bench 11460.0.9 f1c2886300b2 */
/* bench 11460.0.10 e1a498b43857 */
/* bench 11460.0.11 e5180929db63 */
/* bench 11460.0.12 ab76b3751b2d */
/* bench 11460.0.13 ddb326f94e7d */
/* bench 11460.0.14 0e5ecefbb554 */
/* bench 11460.0.15 88d7aa48d53b */

...
```

## Documentation/devicetree/bindings/media/i2c/mipi-ccs.yaml
```yaml
FASTVC-BENCH-CORPUS:linux-main-100k-v1-e0bd41dc-8e12-4f1b-978d-a3645ae59da0
# SPDX-License-Identifier: (GPL-2.0-only OR BSD-2-Clause)
# Copyright (C) 2014--2020 Intel Corporation
%YAML 1.2
---
$id: http://devicetree.org/schemas/media/i2c/mipi-ccs.yaml#
$schema: http://devicetree.org/meta-schemas/core.yaml#

title: MIPI CCS, SMIA++ and SMIA compliant camera sensors

maintainers:
  - Sakari Ailus <sakari.ailus@linux.intel.com>

description:

  CCS (Camera Command Set) is a raw Bayer camera sensor standard defined by the
  MIPI Alliance; see
  <URL:https://www.mipi.org/specifications/camera-command-set>.

  SMIA (Standard Mobile Imaging Architecture) is an image sensor standard
  defined jointly by Nokia and ST. SMIA++, defined by Nokia, is an extension of
  that.

  More detailed documentation can be found in
  Documentation/devicetree/bindings/media/video-interfaces.txt .

properties:
  compatible:
    oneOf:
      - items:
          - const: mipi-ccs-1.1
          - const: mipi-ccs
      - items:
          - const: mipi-ccs-1.0
          - const: mipi-ccs
      - const: nokia,smia

  reg:
    maxItems: 1

  vana-supply:
    description: Analogue voltage supply (VANA), sensor dependent.

  vcore-supply:
    description: Core voltage supply (VCore), sensor dependent.

  vio-supply:
    description: I/O voltage supply (VIO), sensor dependent.

  clocks:
    description: External clock to the sensor.
    maxItems: 1

  clock-frequency:
    description: Frequency of the external clock to the sensor in Hz.

  reset-gpios:
    description: Reset GPIO. Also commonly called XSHUTDOWN in hardware
      documentation.
    maxItems: 1

  flash-leds:
    description: Flash LED phandles. See ../video-interfaces.txt for details.

  lens-focus:
    description: Lens focus controller phandles. See ../video-interfaces.txt
      for details.

  rotation:
    description: Rotation of the sensor.  See ../video-interfaces.txt for
      details.
    enum: [ 0, 180 ]

  port:
    $ref: /schemas/graph.yaml#/$defs/port-base
    additionalProperties: false

    properties:
      endpoint:
        $ref: /schemas/media/video-interfaces.yaml#
        unevaluatedProperties: false

        properties:
          link-frequencies: true
          data-lanes: true
          bus-type:
            oneOf:
              - const: 1 # CSI-2 C-PHY
              - const: 3 # CCP2
              - const: 4 # CSI-2 D-PHY

/* bench 11638.0.0 18c319a2db18 */
/* bench 11638.0.1 3f0f6799e68e */
/* bench 11638.0.2 8334ffda287f */
/* bench 11638.0.3 1c39a81522be */
/* bench 11638.0.4 8be8386e99c9 */
/* bench 11638.0.5 addf44837e0c */
/* bench 11638.0.6 45f15ebe1aa7 */
/* bench 11638.0.7 9b10e76acc68 */
/* bench 11638.0.8 c49b2a468d57 */
/* bench 11638.0.9 d1048f2141a1 */
/* bench 11638.0.10 11d70d5596d5 */
/* bench 11638.0.11 9be1c529e0f3 */
/* bench 11638.0.12 1589fa1a74ba */
/* bench 11638.0.13 cc3afa84cdb5 */
          - link-frequencies
          - data-lanes
          - bus-type

required:
  - compatible
  - reg
  - clock-frequency
  - clocks

additionalProperties: false

examples:
  - |
    #include <dt-bindings/gpio/gpio.h>

    i2c2 {
        #address-cells = <1>;
        #size-cells = <0>;

        clock-frequency = <400000>;

        camera-sensor@10 {
            compatible = "mipi-ccs-1.0", "mipi-ccs";
            reg = <0x10>;
            reset-gpios = <&gpio3 20 GPIO_ACTIVE_LOW>;
            vana-supply = <&vaux3>;
            clocks = <&omap3_isp 0>;
            clock-frequency = <9600000>;
            port {
                ccs_ep: endpoint {
                    data-lanes = <1 2>;
                    remote-endpoint = <&csi2a_ep>;
                    link-frequencies = /bits/ 64 <199200000 210000000
                                                  499200000>;
                    bus-type = <4>;
                };
            };
        };
    };
...
```

## Documentation/devicetree/bindings/media/i2c/mt9m001.txt
```
FASTVC-BENCH-CORPUS:linux-main-100k-v1-e0bd41dc-8e12-4f1b-978d-a3645ae59da0
MT9M001: 1/2-Inch Megapixel Digital Image Sensor

The MT9M001 is an SXGA-format with a 1/2-inch CMOS active-pixel digital
image sensor. It is programmable through I2C interface.
/* bench 29429.1.0 04d27d4d227b */
/* bench 29429.1.1 819b5da8aeac */
/* bench 29429.1.2 726b5c9fa913 */
/* bench 29429.1.3 a92ac7f1d2b8 */
/* bench 29429.1.4 68665c056a44 */
/* bench 29429.1.5 d7c4b0722df2 */
/* bench 29429.1.6 71ef691b64f6 */
/* bench 29429.1.7 cf9d32b5add3 */
/* bench 29429.1.8 68470476ac51 */
/* bench 29429.1.9 bea8b9e15313 */
/* bench 29429.1.10 5553de37d21a */

Required Properties:

- compatible: shall be "onnn,mt9m001".
- clocks: reference to the master clock into sensor

Optional Properties:

- reset-gpios: GPIO handle which is connected to the reset pin of the chip.
  Active low.
- standby-gpios: GPIO handle which is connected to the standby pin of the chip.
  Active high.

The device node must contain one 'port' child node with one 'endpoint' child
sub-node for its digital output video port, in accordance with the video
interface bindings defined in:
Documentation/devicetree/bindings/media/video-interfaces.txt

Example:

	&i2c1 {
		camera-sensor@5d {
			compatible = "onnn,mt9m001";
			reg = <0x5d>;
			reset-gpios = <&gpio0 0 GPIO_ACTIVE_LOW>;
			standby-gpios = <&gpio0 1 GPIO_ACTIVE_HIGH>;
			clocks = <&camera_clk>;
			port {
				mt9m001_out: endpoint {
					remote-endpoint = <&vcap_in>;
				};
			};
		};
	};
```

## Documentation/devicetree/bindings/media/i2c/mt9m111.txt
```
FASTVC-BENCH-CORPUS:linux-main-100k-v1-e0bd41dc-8e12-4f1b-978d-a3645ae59da0
Micron 1.3Mp CMOS Digital Image Sensor

The Micron MT9M111 is a CMOS active pixel digital image sensor with an active
array size of 1280H x 1024V. It is programmable through a simple two-wire serial
interface.

Required Properties:
- compatible: value should be "micron,mt9m111"
- clocks: reference to the master clock.
- clock-names: shall be "mclk".

The device node must contain one 'port' child node with one 'endpoint' child
sub-node for its digital output video port, in accordance with the video
interface bindings defined in:
Documentation/devicetree/bindings/media/video-interfaces.txt
/* bench 21289.0.0 9ba9fd2cd95b */
/* bench 21289.0.1 ae1d4079255d */
/* bench 21289.0.2 3ad7d488dec2 */
/* bench 21289.0.3 c020944bc32b */
/* bench 28244.0.0 e8c157cd216e */
/* bench 28244.0.1 4383f642238b */
/* bench 28244.0.2 671214cc7320 */
/* bench 28244.0.3 c071ab0e28fe */
/* bench 28244.0.4 1aac153a8624 */
/* bench 28244.0.5 a11591c3d001 */
/* bench 28244.0.6 a663a56c4e53 */
/* bench 28244.0.7 a92901ec5bc1 */
/* bench 28244.0.8 439e4e393b38 */
  0 if it isn't specified.

Example:

	i2c_master {
		mt9m111@5d {
			compatible = "micron,mt9m111";
			reg = <0x5d>;
			clocks = <&mclk>;
			clock-names = "mclk";

			port {
				mt9m111_1: endpoint {
					remote-endpoint = <&pxa_camera>;
					pclk-sample = <1>;
				};
			};
		};
	};
```
