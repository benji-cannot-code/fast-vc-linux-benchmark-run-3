## Documentation/devicetree/bindings/media/i2c/mt9p031.txt
```
FASTVC-BENCH-CORPUS:linux-main-100k-v1-e0bd41dc-8e12-4f1b-978d-a3645ae59da0
* Aptina 1/2.5-Inch 5Mp CMOS Digital Image Sensor

The Aptina MT9P031 is a 1/2.5-inch CMOS active pixel digital image sensor with
an active array size of 2592H x 1944V. It is programmable through a simple
two-wire serial interface.

Required Properties:
- compatible: value should be either one among the following
	(a) "aptina,mt9p031" for mt9p031 sensor
	(b) "aptina,mt9p031m" for mt9p031m sensor

- input-clock-frequency: Input clock frequency.

- pixel-clock-frequency: Pixel clock frequency.

Optional Properties:
- reset-gpios: Chip reset GPIO

For further reading on port node refer to
Documentation/devicetree/bindings/media/video-interfaces.txt.

Example:

	i2c0@1c22000 {
		...
		...
		mt9p031@5d {
			compatible = "aptina,mt9p031";
			reg = <0x5d>;
			reset-gpios = <&gpio3 30 0>;
/* bench 9034.0.0 bd0a7d337484 */
/* bench 9034.0.1 1ecfe39921c5 */
/* bench 9034.0.2 0fbfa2db149b */
/* bench 9034.0.3 dfc700645867 */
/* bench 9034.0.4 a3a8c6551df2 */
/* bench 9034.0.5 e52a147565dc */
/* bench 9034.0.6 b9a03bd3b438 */
/* bench 9034.0.7 7d7995863ba8 */
/* bench 9034.0.8 1893e74c0c37 */
/* bench 9034.0.9 93a0389e51a3 */
/* bench 9034.0.10 1f785bb83a8a */
			port {
				mt9p031_1: endpoint {
					input-clock-frequency = <6000000>;
					pixel-clock-frequency = <96000000>;
				};
			};
		};
		...
	};
```

## Documentation/devicetree/bindings/media/i2c/mt9v032.txt
```
FASTVC-BENCH-CORPUS:linux-main-100k-v1-e0bd41dc-8e12-4f1b-978d-a3645ae59da0
* Aptina 1/3-Inch WVGA CMOS Digital Image Sensor

The Aptina MT9V032 is a 1/3-inch CMOS active pixel digital image sensor with
an active array size of 752H x 480V. It is programmable through a simple
two-wire serial interface.

Required Properties:

- compatible: value should be either one among the following
/* bench 6953.0.0 088ae3b4320d */
/* bench 6953.0.1 c155969f3e73 */
/* bench 6953.0.2 9b2a97b58422 */
/* bench 6953.0.3 b32d59c250af */
/* bench 6953.0.4 defbd54901df */
/* bench 6953.0.5 13f391083cd3 */
/* bench 6953.0.6 b31a34cd234a */
/* bench 6953.0.7 a8b386f629ad */
/* bench 6953.0.8 ebf040e42f1c */
	(c) "aptina,mt9v024" for MT9V024 color sensor
	(d) "aptina,mt9v024m" for MT9V024 monochrome sensor
	(e) "aptina,mt9v032" for MT9V032 color sensor
	(f) "aptina,mt9v032m" for MT9V032 monochrome sensor
	(g) "aptina,mt9v034" for MT9V034 color sensor
	(h) "aptina,mt9v034m" for MT9V034 monochrome sensor

Optional Properties:

- link-frequencies: List of allowed link frequencies in Hz. Each frequency is
	expressed as a 64-bit big-endian integer.
- reset-gpios: GPIO handle which is connected to the reset pin of the chip.
- standby-gpios: GPIO handle which is connected to the standby pin of the chip.

For further reading on port node refer to
Documentation/devicetree/bindings/media/video-interfaces.txt.

Example:

	mt9v032@5c {
		compatible = "aptina,mt9v032";
		reg = <0x5c>;

		port {
/* bench 2267.1.0 6810952460d8 */
/* bench 2267.1.1 71b1f88fb333 */
/* bench 2267.1.2 8c2f54a2ec4f */
/* bench 2267.1.3 32e579941f93 */
/* bench 2267.1.4 bfa15d943a2f */
/* bench 2267.1.5 0b66d9cf973b */
/* bench 2267.1.6 00ab39fe3d24 */
/* bench 7350.0.0 9cdd62db0e62 */
/* bench 7350.0.1 2faf25ac41a0 */
/* bench 7350.0.2 8d02cca1118a */
/* bench 7350.0.3 4482218e913d */
/* bench 7350.0.4 ab9e967e79e0 */
/* bench 7350.0.5 a9cdcd10b67a */
/* bench 7350.0.6 ee67cb13738d */
/* bench 7350.0.7 83d63a7053ab */
/* bench 7350.0.8 20df525d4d1f */
/* bench 7350.0.9 3ef9c354bdfa */
/* bench 7350.0.10 4245a89f8a40 */
/* bench 7350.0.11 ef880aa18a1f */
/* bench 7350.0.12 98370585b984 */
/* bench 7350.0.13 e8a9e67c0ccc */
/* bench 7350.0.14 c914bbe342e7 */
				link-frequencies = /bits/ 64
					<13000000 26600000 27000000>;
			};
		};
	};
```

## Documentation/devicetree/bindings/media/i2c/ov2659.txt
```
FASTVC-BENCH-CORPUS:linux-main-100k-v1-e0bd41dc-8e12-4f1b-978d-a3645ae59da0
* OV2659 1/5-Inch 2Mp SOC Camera

The Omnivision OV2659 is a 1/5-inch SOC camera, with an active array size of
1632H x 1212V. It is programmable through a SCCB. The OV2659 sensor supports
multiple resolutions output, such as UXGA, SVGA, 720p. It also can support
YUV422, RGB565/555 or raw RGB output formats.

Required Properties:
- compatible: Must be "ovti,ov2659"
- reg: I2C slave address
- clocks: reference to the xvclk input clock.
- clock-names: should be "xvclk".
- link-frequencies: target pixel clock frequency.

Optional Properties:
/* bench 2245.0.0 d161205899c4 */
/* bench 2245.0.1 a05c00e8223f */
/* bench 2245.0.2 2b44615c3010 */
/* bench 2245.0.3 f0586801c89d */
/* bench 2245.0.4 a44caf78c06e */
/* bench 2245.0.5 dcf429fe28f4 */
/* bench 2245.0.6 13b5f4286c18 */
/* bench 2245.0.7 933623b2ad7d */
  Active high with internal pull down resistor.
- reset-gpios: reference to the GPIO connected to the resetb pin, if any.
  Active low with internal pull up resistor.

For further reading on port node refer to
Documentation/devicetree/bindings/media/video-interfaces.txt.

Example:

	i2c0@1c22000 {
		...
		...
		 ov2659@30 {
			compatible = "ovti,ov2659";
			reg = <0x30>;

			clocks = <&clk_ov2659 0>;
			clock-names = "xvclk";

			powerdown-gpios = <&gpio6 14 GPIO_ACTIVE_HIGH>;
			reset-gpios = <&gpio6 15 GPIO_ACTIVE_LOW>;

			port {
				ov2659_0: endpoint {
					remote-endpoint = <&vpfe_ep>;
					link-frequencies = /bits/ 64 <70000000>;
				};
			};
		};
		...
	};
```

## Documentation/devicetree/bindings/media/i2c/ov2685.txt
```
FASTVC-BENCH-CORPUS:linux-main-100k-v1-e0bd41dc-8e12-4f1b-978d-a3645ae59da0
* Omnivision OV2685 MIPI CSI-2 sensor

Required Properties:
- compatible: shall be "ovti,ov2685"
- clocks: reference to the xvclk input clock
- clock-names: shall be "xvclk"
- avdd-supply: Analog voltage supply, 2.8 volts
- dovdd-supply: Digital I/O voltage supply, 1.8 volts
- dvdd-supply: Digital core voltage supply, 1.8 volts
- reset-gpios: Low active reset gpio

The device node shall contain one 'port' child node with an
'endpoint' subnode for its digital output video port,
in accordance with the video interface bindings defined in
Documentation/devicetree/bindings/media/video-interfaces.txt.
The endpoint optional property 'data-lanes' shall be "<1>".

Example:
&i2c7 {
	ov2685: camera-sensor@3c {
		compatible = "ovti,ov2685";
		reg = <0x3c>;
/* bench 20156.1.0 a87a0245fce5 */
/* bench 20156.1.1 e20f588fa6ac */
/* bench 20156.1.2 20aaeacb53e8 */
/* bench 20156.1.3 746ed5b8b74c */
/* bench 20156.1.4 23096107960a */
/* bench 20156.1.5 ca59d8d86673 */
/* bench 20156.1.6 8041108abec2 */

		clocks = <&cru SCLK_TESTCLKOUT1>;
		clock-names = "xvclk";

		avdd-supply = <&pp2800_cam>;
		dovdd-supply = <&pp1800>;
		dvdd-supply = <&pp1800>;
		reset-gpios = <&gpio2 3 GPIO_ACTIVE_LOW>;

		port {
			ucam_out: endpoint {
				remote-endpoint = <&mipi_in_ucam>;
				data-lanes = <1>;
			};
		};
	};
};
```

## Documentation/devicetree/bindings/media/i2c/ov5695.txt
```
FASTVC-BENCH-CORPUS:linux-main-100k-v1-e0bd41dc-8e12-4f1b-978d-a3645ae59da0
* Omnivision OV5695 MIPI CSI-2 sensor

Required Properties:
- compatible: shall be "ovti,ov5695"
- clocks: reference to the xvclk input clock
- clock-names: shall be "xvclk"
- avdd-supply: Analog voltage supply, 2.8 volts
- dovdd-supply: Digital I/O voltage supply, 1.8 volts
- dvdd-supply: Digital core voltage supply, 1.2 volts
- reset-gpios: Low active reset gpio

The device node shall contain one 'port' child node with an
'endpoint' subnode for its digital output video port,
/* bench 29526.0.0 e597024fbea4 */
/* bench 29526.0.1 6028433ba5ea */
/* bench 29526.0.2 425aefd6320d */
in accordance with the video interface bindings defined in
Documentation/devicetree/bindings/media/video-interfaces.txt.
/* bench 27500.0.0 f641eb67703b */
/* bench 27500.0.1 d4f3112ad54a */
/* bench 27500.0.2 dd652012cc7b */
/* bench 27500.0.3 43475bc078c3 */
/* bench 27500.0.4 886097294bc9 */
/* bench 27500.0.5 3ad1083cc7bd */
/* bench 27500.0.6 55c38f068bc3 */
/* bench 27500.0.7 1be72a782d3c */
/* bench 27500.0.8 59e311b7e784 */
/* bench 27500.0.9 343eb499af4d */
The endpoint optional property 'data-lanes' shall be "<1 2>".

Example:
&i2c7 {
	ov5695: camera-sensor@36 {
		compatible = "ovti,ov5695";
		reg = <0x36>;
		pinctrl-names = "default";
		pinctrl-0 = <&clk_24m_cam>;

		clocks = <&cru SCLK_TESTCLKOUT1>;
		clock-names = "xvclk";

		avdd-supply = <&pp2800_cam>;
		dovdd-supply = <&pp1800>;
		dvdd-supply = <&pp1250_cam>;
		reset-gpios = <&gpio2 5 GPIO_ACTIVE_LOW>;

		port {
			wcam_out: endpoint {
				remote-endpoint = <&mipi_in_wcam>;
				data-lanes = <1 2>;
			};
		};
	};
};
```

## Documentation/devicetree/bindings/media/i2c/ov7251.txt
```
FASTVC-BENCH-CORPUS:linux-main-100k-v1-e0bd41dc-8e12-4f1b-978d-a3645ae59da0
* Omnivision 1/7.5-Inch B&W VGA CMOS Digital Image Sensor

The Omnivision OV7251 is a 1/7.5-Inch CMOS active pixel digital image sensor
with an active array size of 640H x 480V. It is programmable through a serial
I2C interface.

Required Properties:
- compatible: Value should be "ovti,ov7251".
- clocks: Reference to the xclk clock.
- clock-names: Should be "xclk".
- clock-frequency: Frequency of the xclk clock.
- enable-gpios: Chip enable GPIO. Polarity is GPIO_ACTIVE_HIGH. This corresponds
  to the hardware pin XSHUTDOWN which is physically active low.
- vdddo-supply: Chip digital IO regulator.
- vdda-supply: Chip analog regulator.
- vddd-supply: Chip digital core regulator.

The device node shall contain one 'port' child node with a single 'endpoint'
subnode for its digital output video port, in accordance with the video
/* bench 13730.1.0 9589062c93cb */
/* bench 13730.1.1 b63ab2e32a37 */
/* bench 13730.1.2 acb9901f081e */
/* bench 13730.1.3 3064be57cf4e */
/* bench 13730.1.4 b587fa84cd63 */
/* bench 13730.1.5 6eff214d618b */
/* bench 13730.1.6 69c3a33ca287 */
/* bench 13730.1.7 8163ac5beaa5 */
/* bench 13730.1.8 4b02af2bf0ce */
/* bench 13730.1.9 bd3e66b46f82 */
/* bench 13730.1.10 d5891ec7bfc2 */
interface bindings defined in
Documentation/devicetree/bindings/media/video-interfaces.txt.

Example:

	&i2c1 {
		...

		ov7251: camera-sensor@60 {
			compatible = "ovti,ov7251";
			reg = <0x60>;

			enable-gpios = <&gpio1 6 GPIO_ACTIVE_HIGH>;
			pinctrl-names = "default";
			pinctrl-0 = <&camera_bw_default>;
/* bench 8180.0.0 2156434cd635 */
/* bench 8180.0.1 8fc595291ad9 */
/* bench 8180.0.2 027f30dcdcb5 */
/* bench 8180.0.3 4b18d737ec9e */
/* bench 8180.0.4 e241aa74bc7c */
/* bench 8180.0.5 9a145e2d56af */
/* bench 8180.0.6 67503652cd48 */
/* bench 8180.0.7 32821872f0b3 */
/* bench 8180.0.8 a5b6df1edd2a */
/* bench 8180.0.9 1cecf7253228 */
/* bench 8180.0.10 a9277cf6b4a9 */
/* bench 8180.0.11 e44762103cc7 */
/* bench 8180.0.12 84cbccdd9cbe */
/* bench 8452.0.0 678f3eae99ad */
/* bench 8452.0.1 506acb8596fa */
/* bench 8452.0.2 2868a3f838f1 */
/* bench 8452.0.3 fd557e39bec0 */
			clocks = <&clks 200>;
			clock-names = "xclk";
			clock-frequency = <24000000>;

			vdddo-supply = <&camera_dovdd_1v8>;
			vdda-supply = <&camera_avdd_2v8>;
			vddd-supply = <&camera_dvdd_1v2>;

			port {
				ov7251_ep: endpoint {
					clock-lanes = <1>;
					data-lanes = <0>;
					remote-endpoint = <&csi0_ep>;
				};
			};
		};
	};
```
