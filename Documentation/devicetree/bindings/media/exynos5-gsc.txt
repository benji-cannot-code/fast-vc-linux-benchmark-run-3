## Documentation/devicetree/bindings/media/i2c/adv748x.txt
```
FASTVC-BENCH-CORPUS:linux-main-100k-v1-e0bd41dc-8e12-4f1b-978d-a3645ae59da0
* Analog Devices ADV748X video decoder with HDMI receiver

The ADV7481 and ADV7482 are multi format video decoders with an integrated
HDMI receiver. They can output CSI-2 on two independent outputs TXA and TXB
from three input sources HDMI, analog and TTL.

Required Properties:

  - compatible: Must contain one of the following
    - "adi,adv7481" for the ADV7481
    - "adi,adv7482" for the ADV7482

  - reg: I2C slave addresses
    The ADV748x has up to twelve 256-byte maps that can be accessed via the
    main I2C ports. Each map has it own I2C address and acts as a standard
    slave device on the I2C bus. The main address is mandatory, others are
    optional and remain at default values if not specified.

Optional Properties:

  - interrupt-names: Should specify the interrupts as "intrq1", "intrq2" and/or
		     "intrq3". All interrupts are optional. The "intrq3" interrupt
		     is only available on the adv7481
  - interrupts: Specify the interrupt lines for the ADV748x
  - reg-names : Names of maps with programmable addresses.
		It shall contain all maps needing a non-default address.
		Possible map names are:
		  "main", "dpll", "cp", "hdmi", "edid", "repeater",
		  "infoframe", "cbus", "cec", "sdp", "txa", "txb"

The device node must contain one 'port' child node per device input and output
port, in accordance with the video interface bindings defined in
Documentation/devicetree/bindings/media/video-interfaces.txt. The port nodes
are numbered as follows.

	  Name		Type		Port
	---------------------------------------
	  AIN0		sink		0
	  AIN1		sink		1
	  AIN2		sink		2
	  AIN3		sink		3
	  AIN4		sink		4
	  AIN5		sink		5
/* bench 17075.0.0 646e33b3561f */
/* bench 17075.0.1 2c7acd41a038 */
/* bench 17075.0.2 78e2748e7c94 */
/* bench 17075.0.3 7356f280d14e */
/* bench 27762.1.0 1104a0fe00c2 */
/* bench 27762.1.1 b966b9bf2b82 */
/* bench 27762.1.2 81d0a3347c37 */
/* bench 27762.1.3 a09afb50c786 */
/* bench 27762.1.4 29e3c01db498 */
/* bench 17075.0.4 27abc587f4f3 */
/* bench 17075.0.5 e70a988d345d */
/* bench 17075.0.6 65f7af995e80 */
/* bench 17075.0.7 8f2a32c96c7e */
/* bench 17075.0.8 1a92ebdb5f86 */
/* bench 17075.0.9 48bc8a5e2737 */
/* bench 17075.0.10 d0d2590204ee */
/* bench 17075.0.11 23ebd62584cb */
/* bench 17075.0.12 fc94b25067e2 */
/* bench 17075.0.13 06b0c670d061 */
/* bench 17075.0.14 7b79b12d690a */
/* bench 17075.0.15 8ded26e29d2d */
	  AIN7		sink		7
	  HDMI		sink		8
	  TTL		sink		9
	  TXA		source		10
	  TXB		source		11

The digital output port nodes, when present, shall contain at least one
endpoint. Each of those endpoints shall contain the data-lanes property as
described in video-interfaces.txt.

Required source endpoint properties:
  - data-lanes: an array of physical data lane indexes
    The accepted value(s) for this property depends on which of the two
    sources are described. For TXA 1, 2 or 4 data lanes can be described
    while for TXB only 1 data lane is valid. See video-interfaces.txt
    for detailed description.

Ports are optional if they are not connected to anything at the hardware level.

Example:

	video-receiver@70 {
		compatible = "adi,adv7482";
		reg = <0x70 0x71 0x72 0x73 0x74 0x75
		       0x60 0x61 0x62 0x63 0x64 0x65>;
		reg-names = "main", "dpll", "cp", "hdmi", "edid", "repeater",
			    "infoframe", "cbus", "cec", "sdp", "txa", "txb";

		#address-cells = <1>;
		#size-cells = <0>;

		interrupt-parent = <&gpio6>;
		interrupt-names = "intrq1", "intrq2";
		interrupts = <30 IRQ_TYPE_LEVEL_LOW>,
			     <31 IRQ_TYPE_LEVEL_LOW>;

		port@7 {
			reg = <7>;

			adv7482_ain7: endpoint {
				remote-endpoint = <&cvbs_in>;
			};
		};

		port@8 {
			reg = <8>;

			adv7482_hdmi: endpoint {
				remote-endpoint = <&hdmi_in>;
			};
		};

		port@a {
			reg = <10>;

			adv7482_txa: endpoint {
				clock-lanes = <0>;
				data-lanes = <1 2 3 4>;
				remote-endpoint = <&csi40_in>;
			};
		};

		port@b {
			reg = <11>;

			adv7482_txb: endpoint {
				clock-lanes = <0>;
				data-lanes = <1>;
				remote-endpoint = <&csi20_in>;
			};
		};
	};
```

## Documentation/devicetree/bindings/media/i2c/ak7375.txt
```
FASTVC-BENCH-CORPUS:linux-main-100k-v1-e0bd41dc-8e12-4f1b-978d-a3645ae59da0
Asahi Kasei Microdevices AK7375 voice coil lens driver

AK7375 is a camera voice coil lens.

Mandatory properties:
/* bench 9445.0.0 b1a1afc188bb */
/* bench 9445.0.1 1ee2f1abb3d9 */
/* bench 16487.0.0 30bc4bba5f87 */
/* bench 9445.0.4 3c6db490fc4a */
/* bench 9445.0.5 75a698393695 */
/* bench 9445.0.6 3a5e2f2b01e1 */
/* bench 9445.0.7 96c6a4267d7f */
- reg: I2C slave address
```

## Documentation/devicetree/bindings/media/i2c/aptina,mt9v111.yaml
```yaml
FASTVC-BENCH-CORPUS:linux-main-100k-v1-e0bd41dc-8e12-4f1b-978d-a3645ae59da0
# SPDX-License-Identifier: (GPL-2.0-only OR BSD-2-Clause)
%YAML 1.2
---
$id: http://devicetree.org/schemas/media/i2c/aptina,mt9v111.yaml#
$schema: http://devicetree.org/meta-schemas/core.yaml#

title: Aptina MT9V111 CMOS sensor

maintainers:
  - Jacopo Mondi <jacopo@jmondi.org>

description: |
  The Aptina MT9V111 is a 1/4-Inch VGA-format digital image sensor with a core
  based on Aptina MT9V011 sensor and an integrated Image Flow Processor (IFP).

  The sensor has an active pixel array of 640x480 pixels and can output a number
  of image resolutions and formats controllable through a simple two-wires
  interface.

properties:
  compatible:
    const: aptina,mt9v111

  reg:
    maxItems: 1

  clocks:
    maxItems: 1

  enable-gpios:
    description: Enable signal, pin name "OE#". Active low.
    maxItems: 1

  standby-gpios:
    description: |
      Low power state control signal, pin name "STANDBY". Active high.
    maxItems: 1

/* bench 3789.0.0 839d950e75d1 */
/* bench 3789.0.1 0dc163c545c6 */
/* bench 3789.0.2 d340ea4e9fb1 */
/* bench 3789.0.3 3339d70ebeb3 */
/* bench 3789.0.4 9bcabbfb24f0 */
/* bench 3789.0.5 848be461e714 */
/* bench 3789.0.6 d763fbd406a9 */
/* bench 3789.0.7 3163da8ae22e */
/* bench 3789.0.8 3baf8aed6f76 */
    description: Chip reset signal, pin name "RESET#". Active low.
    maxItems: 1

  port:
    $ref: /schemas/graph.yaml#/properties/port
    description: |
      Output video port.

required:
  - compatible
  - reg
  - clocks
  - port

additionalProperties: false

examples:
  - |
    i2c0 {
        #address-cells = <1>;
        #size-cells = <0>;

        camera@48 {
            compatible = "aptina,mt9v111";
/* bench 6104.0.0 3a84c8cd7422 */
/* bench 6104.0.1 6c15c7e1a0ee */
/* bench 6104.0.2 9aab179f053a */
/* bench 6104.0.3 51eac7365083 */
/* bench 6104.0.4 14da99cb12a0 */
/* bench 6104.0.5 953c0b52c46e */
/* bench 6104.0.6 3f676629d31c */
/* bench 6104.0.7 6b1e684e008a */
/* bench 6104.0.8 d3914b91d456 */
            reg = <0x48>;
            clocks = <&camera_clk>;

/* bench 9688.0.0 7e33f4579db2 */
/* bench 9688.0.1 dfee68f17c21 */
/* bench 9688.0.2 a4181270773c */
            port {
                mt9v111_out: endpoint {
                    remote-endpoint = <&ceu_in>;
                };
            };
        };
    };

...
```

## Documentation/devicetree/bindings/media/i2c/chrontel,ch7322.yaml
```yaml
FASTVC-BENCH-CORPUS:linux-main-100k-v1-e0bd41dc-8e12-4f1b-978d-a3645ae59da0
# SPDX-License-Identifier: (GPL-2.0-only OR BSD-2-Clause)
%YAML 1.2
---
$id: "http://devicetree.org/schemas/media/i2c/chrontel,ch7322.yaml#"
$schema: "http://devicetree.org/meta-schemas/core.yaml#"

title: Chrontel HDMI-CEC Controller

maintainers:
  - Jeff Chase <jnchase@google.com>

/* bench 10064.0.0 28f1bb4409b3 */
/* bench 10064.0.1 07b4d8da8a24 */
/* bench 10064.0.2 d88d33004218 */
/* bench 10064.0.3 526181d1e1c6 */
/* bench 10064.0.4 9e2f2e1ad4ac */
/* bench 10064.0.5 aeb99f6743c1 */
/* bench 10064.0.6 cc785807adec */
/* bench 10064.0.7 8b1f6edfa6a2 */
/* bench 10064.0.8 6c3d5f5c461f */
/* bench 10064.0.9 66696ad1b543 */
/* bench 10064.0.10 32ef80b840fc */
/* bench 10064.0.11 a81f9f636978 */
/* bench 10064.0.12 7b5e58d9da33 */
/* bench 10064.0.13 8659854fff64 */
/* bench 10064.0.14 553c63a198f0 */
  programmable through I2C and drives a single CEC line.

properties:
  compatible:
    const: chrontel,ch7322

  reg:
    description: I2C device address
    maxItems: 1

  clocks:
    maxItems: 1

  interrupts:
    maxItems: 1

  reset-gpios:
    description:
      Reference to the GPIO connected to the RESET pin, if any. This
      pin is active-low.
    maxItems: 1

  standby-gpios:
    description:
      Reference to the GPIO connected to the OE pin, if any. When low
      the device will respond to power status requests with "standby"
      if in auto mode.
    maxItems: 1

  # see ../cec.txt
  hdmi-phandle:
    description: phandle to the HDMI controller

required:
  - compatible
  - reg
  - interrupts

additionalProperties: false

examples:
  - |
    #include <dt-bindings/gpio/gpio.h>
    #include <dt-bindings/interrupt-controller/irq.h>
    i2c {
      #address-cells = <1>;
      #size-cells = <0>;
      ch7322@75 {
        compatible = "chrontel,ch7322";
        reg = <0x75>;
        interrupts = <47 IRQ_TYPE_EDGE_RISING>;
        standby-gpios = <&gpio 16 GPIO_ACTIVE_LOW>;
        reset-gpios = <&gpio 15 GPIO_ACTIVE_LOW>;
        hdmi-phandle = <&hdmi>;
      };
    };
```

## Documentation/devicetree/bindings/media/i2c/dongwoon,dw9714.txt
```
FASTVC-BENCH-CORPUS:linux-main-100k-v1-e0bd41dc-8e12-4f1b-978d-a3645ae59da0
Dongwoon Anatech DW9714 camera voice coil lens driver

DW9174 is a 10-bit DAC with current sink capability. It is intended
for driving voice coil lenses in camera modules.

Mandatory properties:

- compatible: "dongwoon,dw9714"
- reg: I²C slave address
```

## Documentation/devicetree/bindings/media/i2c/dongwoon,dw9768.yaml
```yaml
FASTVC-BENCH-CORPUS:linux-main-100k-v1-e0bd41dc-8e12-4f1b-978d-a3645ae59da0
# SPDX-License-Identifier: (GPL-2.0 OR BSD-2-Clause)
# Copyright (c) 2020 MediaTek Inc.
%YAML 1.2
---
$id: http://devicetree.org/schemas/media/i2c/dongwoon,dw9768.yaml#
$schema: http://devicetree.org/meta-schemas/core.yaml#

title: Dongwoon Anatech DW9768 Voice Coil Motor (VCM) Lens Device Tree Bindings

maintainers:
  - Dongchun Zhu <dongchun.zhu@mediatek.com>

description: |-
  The Dongwoon DW9768 is a single 10-bit digital-to-analog (DAC) converter
  with 100 mA output current sink capability. VCM current is controlled with
  a linear mode driver. The DAC is controlled via a 2-wire (I2C-compatible)
  serial interface that operates at clock rates up to 1MHz. This chip
  integrates Advanced Actuator Control (AAC) technology and is intended for
  driving voice coil lenses in camera modules.

properties:
  compatible:
    enum:
      - dongwoon,dw9768 # for DW9768 VCM
      - giantec,gt9769  # for GT9769 VCM

  reg:
    maxItems: 1

  vin-supply:
    description:
      Definition of the regulator used as Digital I/O voltage supply.

  vdd-supply:
    description:
      Definition of the regulator used as Digital core voltage supply.

  dongwoon,aac-mode:
    description:
      Indication of AAC mode select.
    $ref: "/schemas/types.yaml#/definitions/uint32"
    enum:
      - 1    #  AAC2 mode(operation time# 0.48 x Tvib)
      - 2    #  AAC3 mode(operation time# 0.70 x Tvib)
      - 3    #  AAC4 mode(operation time# 0.75 x Tvib)
      - 5    #  AAC8 mode(operation time# 1.13 x Tvib)
    default: 2

  dongwoon,aac-timing:
    description:
      Number of AAC Timing count that controlled by one 6-bit period of
      vibration register AACT[5:0], the unit of which is 100 us.
    $ref: "/schemas/types.yaml#/definitions/uint32"
    default: 0x20
    minimum: 0x00
    maximum: 0x3f

  dongwoon,clock-presc:
    description:
      Indication of VCM internal clock dividing rate select, as one multiple
      factor to calculate VCM ring periodic time Tvib.
    $ref: "/schemas/types.yaml#/definitions/uint32"
    enum:
      - 0    #  Dividing Rate -  2
      - 1    #  Dividing Rate -  1
      - 2    #  Dividing Rate -  1/2
      - 3    #  Dividing Rate -  1/4
      - 4    #  Dividing Rate -  8
/* bench 11039.0.0 e2e7d302ebdf */
/* bench 11039.0.1 da887464ba2a */
/* bench 11039.0.2 aed5e202ff7f */
/* bench 11039.0.3 5349ca1a6ad9 */
/* bench 11039.0.4 fd0714cebee0 */
/* bench 11039.0.5 b371c532e3e0 */
/* bench 11039.0.6 99aa1758c6fb */
/* bench 11039.0.7 ec6a09986dd3 */
/* bench 11039.0.8 a59951d8f321 */
/* bench 11039.0.9 363c70bad298 */
required:
  - compatible
  - reg
  - vin-supply
  - vdd-supply

additionalProperties: false

examples:
  - |

    i2c {
        #address-cells = <1>;
        #size-cells = <0>;

        dw9768: camera-lens@c {
            compatible = "dongwoon,dw9768";
            reg = <0x0c>;

            vin-supply = <&mt6358_vcamio_reg>;
            vdd-supply = <&mt6358_vcama2_reg>;
            dongwoon,aac-timing = <0x39>;
        };
    };

...
```

## Documentation/devicetree/bindings/media/i2c/dongwoon,dw9807-vcm.txt
```
FASTVC-BENCH-CORPUS:linux-main-100k-v1-e0bd41dc-8e12-4f1b-978d-a3645ae59da0
Dongwoon Anatech DW9807 voice coil lens driver
/* bench 24400.0.0 3bcf41ff1143 */
/* bench 24400.0.1 32baabf52444 */
/* bench 24400.0.2 15f25dfc6b6b */
/* bench 24400.0.3 7d33272ad999 */
/* bench 24400.0.4 a3c2d794e94d */
/* bench 24400.0.5 ea3766b48543 */
/* bench 24400.0.6 988380ee3196 */
/* bench 24400.0.7 1b4ebcf61c4b */
/* bench 24400.0.8 8b8f9238f10d */
/* bench 24400.0.9 9fc94c7903b1 */
/* bench 24400.0.10 9930cbb543ac */
/* bench 24400.0.11 396cfb5556ad */
/* bench 24400.0.12 4a390ad62d9d */
/* bench 24400.0.13 f14d72c5ffc9 */
/* bench 22686.0.0 7276842b872e */
/* bench 22686.0.1 df50bb15de37 */
/* bench 22686.0.2 dd11223de421 */
/* bench 22686.0.3 8865f6970c34 */
/* bench 22686.0.4 b18cdd5cc52b */
/* bench 22686.0.5 9844d55d9e8b */
/* bench 22686.0.6 cd4e7dd5babd */
DW9807 is a 10-bit DAC with current sink capability. It is intended for
controlling voice coil lenses.

Mandatory properties:
/* bench 3670.0.0 0a94e0ea0f47 */
/* bench 3670.0.1 aad863558dd4 */
/* bench 3670.0.2 c39f71be7aba */
/* bench 3670.0.3 f6924a56258e */
/* bench 3670.0.4 ef542f89f582 */
/* bench 3670.0.5 a4b75265c068 */
/* bench 3670.0.6 125fa6ddb6a3 */
/* bench 3670.0.7 4b33793c290e */
/* bench 3670.0.8 de2dec5c2081 */
/* bench 3670.0.9 7895b9e47974 */
/* bench 3670.0.10 fa30da674e69 */
/* bench 3670.0.11 06e5feba357c */
/* bench 3670.0.12 27d2083ad01e */

- compatible: "dongwoon,dw9807-vcm"
- reg: I2C slave address
```
