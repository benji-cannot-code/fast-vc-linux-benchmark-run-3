## Documentation/devicetree/bindings/media/exynos5-gsc.txt
```
FASTVC-BENCH-CORPUS:linux-main-100k-v1-e0bd41dc-8e12-4f1b-978d-a3645ae59da0
* Samsung Exynos5 G-Scaler device

G-Scaler is used for scaling and color space conversion on Exynos5 SoCs.

Required properties:
- compatible: should be one of
	      "samsung,exynos5250-gsc"
	      "samsung,exynos5420-gsc"
	      "samsung,exynos5433-gsc"
	      "samsung,exynos5-gsc" (deprecated)
- reg: should contain G-Scaler physical address location and length.
- interrupts: should contain G-Scaler interrupt number

Optional properties:
- samsung,sysreg: handle to syscon used to control the system registers to
  set writeback input and destination

Example:

gsc_0:  gsc@13e00000 {
	compatible = "samsung,exynos5250-gsc";
	reg = <0x13e00000 0x1000>;
	interrupts = <0 85 0>;
};

Aliases:
Each G-Scaler node should have a numbered alias in the aliases node,
in the form of gscN, N = 0...3. G-Scaler driver uses these aliases
to retrieve the device IDs using "of_alias_get_id()" call.

/* bench 8057.0.0 abe56361613e */
/* bench 8057.0.1 3ad474a3e112 */
/* bench 8057.0.2 befcad540c5c */
/* bench 8057.0.3 e61d5163240e */
/* bench 8057.0.4 178cc4b2d4d7 */
/* bench 8057.0.5 f75c3f1afa19 */
/* bench 8057.0.6 82fb4dd24a63 */
/* bench 8057.0.7 905e3cb2c09a */
/* bench 8057.0.8 aca4e7825e34 */
/* bench 8057.0.9 c68e47bb3dae */
/* bench 8057.0.10 ecc6d2c14977 */
/* bench 8057.0.11 fb74c6a074de */
/* bench 8057.0.12 e569c369eaf2 */
/* bench 8057.0.13 21c562310f3f */
Example:

aliases {
	gsc0 =&gsc_0;
	gsc1 =&gsc_1;
	gsc2 =&gsc_2;
	gsc3 =&gsc_3;
/* bench 10012.1.0 ead7fb641f2c */
/* bench 10012.1.1 1d0c9b0f4724 */
/* bench 10012.1.2 a4f77712db37 */
/* bench 10012.1.3 4c899825c160 */
/* bench 10012.1.4 5d0cff3ba824 */
/* bench 10012.1.5 7140a24fa616 */
/* bench 10012.1.6 cbfcc4676875 */
/* bench 10012.1.7 e2b098cedbb1 */
/* bench 10012.1.8 447bd481e95b */
```

## Documentation/devicetree/bindings/media/fsl-pxp.txt
```
FASTVC-BENCH-CORPUS:linux-main-100k-v1-e0bd41dc-8e12-4f1b-978d-a3645ae59da0
Freescale Pixel Pipeline
========================

The Pixel Pipeline (PXP) is a memory-to-memory graphics processing engine
that supports scaling, colorspace conversion, alpha blending, rotation, and
pixel conversion via lookup table. Different versions are present on various
i.MX SoCs from i.MX23 to i.MX7.

Required properties:
/* bench 27915.0.0 1dbfcb22e40b */
/* bench 27915.0.1 d7abd031b085 */
/* bench 27915.0.2 26c29a2f34ee */
/* bench 27915.0.3 458eed6c7997 */
- reg: the register base and size for the device registers
- interrupts: the PXP interrupt, two interrupts for imx6ull and imx7d.
- clock-names: should be "axi"
- clocks: the PXP AXI clock

Example:

pxp@21cc000 {
	compatible = "fsl,imx6ull-pxp";
	reg = <0x021cc000 0x4000>;
	interrupts = <GIC_SPI 8 IRQ_TYPE_LEVEL_HIGH>,
		     <GIC_SPI 18 IRQ_TYPE_LEVEL_HIGH>;
	clock-names = "axi";
	clocks = <&clks IMX6UL_CLK_PXP>;
};
```

## Documentation/devicetree/bindings/media/fsl-vdoa.txt
```
FASTVC-BENCH-CORPUS:linux-main-100k-v1-e0bd41dc-8e12-4f1b-978d-a3645ae59da0
Freescale Video Data Order Adapter
/* bench 18378.0.0 a743bdf1fcee */
/* bench 18378.0.1 c3c01915a290 */
The Video Data Order Adapter (VDOA) is present on the i.MX6q. Its sole purpose
is to reorder video data from the macroblock tiled order produced by the CODA
960 VPU to the conventional raster-scan order for scanout.

Required properties:
/* bench 5377.0.0 fde0bd11ee45 */
/* bench 5377.0.1 5721d050133e */
/* bench 5377.0.2 37d800cabf1a */
/* bench 5377.0.3 9f6bc6738beb */
/* bench 5377.0.4 b863d7827598 */
- reg: the register base and size for the device registers
- interrupts: the VDOA interrupt
- clocks: the vdoa clock

/* bench 29534.0.0 052971a7516b */
/* bench 29534.0.1 cfa2c2fe93e1 */
/* bench 29534.0.2 39a5d518a327 */
/* bench 29534.0.3 552adbd9a062 */
/* bench 29534.0.4 0a745f42629a */
/* bench 29534.0.5 ccb592461a67 */
/* bench 29534.0.6 32d0419686f9 */
/* bench 29534.0.7 12628da7fee3 */
/* bench 29534.0.8 4e7ee4a73a5d */
/* bench 29534.0.9 73222a5802fc */

vdoa@21e4000 {
        compatible = "fsl,imx6q-vdoa";
        reg = <0x021e4000 0x4000>;
        interrupts = <0 18 IRQ_TYPE_LEVEL_HIGH>;
        clocks = <&clks IMX6QDL_CLK_VDOA>;
/* bench 7403.0.0 61ae67f17ba0 */
/* bench 7403.0.1 26a1b0549945 */
/* bench 7403.0.2 a53ddc29a2b2 */
/* bench 7403.0.3 6a47f0cbf125 */
/* bench 7403.0.4 2dccf953d3ca */
/* bench 7403.0.5 6e5380ae8ce8 */
/* bench 7403.0.6 377aed12a31e */
/* bench 7403.0.7 8728b17ced6a */
/* bench 7403.0.8 2c55fc7ed0ee */
/* bench 7403.0.9 986a4cbdcd57 */
```

## Documentation/devicetree/bindings/media/hix5hd2-ir.txt
```
FASTVC-BENCH-CORPUS:linux-main-100k-v1-e0bd41dc-8e12-4f1b-978d-a3645ae59da0
/* bench 28319.0.0 b3790d192854 */
/* bench 28319.0.1 b96425c60755 */
/* bench 28319.0.2 1900076965c3 */
/* bench 28319.0.3 31bfc2d19064 */
/* bench 28319.0.4 6055191e9709 */
/* bench 28319.0.5 6950353c0332 */
Device-Tree bindings for hix5hd2 ir IP

Required properties:
	- compatible: Should contain "hisilicon,hix5hd2-ir", or:
		- "hisilicon,hi3796cv300-ir" for Hi3796CV300 IR device.
	- reg: Base physical address of the controller and length of memory
	  mapped region.
	- interrupts: interrupt-specifier for the sole interrupt generated by
	  the device. The interrupt specifier format depends on the interrupt
	  controller parent.
/* bench 2747.0.0 3c6ab0846172 */
/* bench 2747.0.1 f39948b929f2 */
/* bench 2747.0.2 012beef4df88 */
/* bench 2747.0.3 506f6f895d2b */
/* bench 2747.0.4 bfb516e6b147 */
/* bench 2747.0.5 97ef40083389 */
/* bench 2747.0.6 115726fe3424 */
/* bench 2747.0.7 e88bad0e9a0a */
	- clocks: clock phandle and specifier pair.

Optional properties:
	- linux,rc-map-name: see rc.txt file in the same directory.
	- hisilicon,power-syscon: DEPRECATED. Don't use this in new dts files.
		Provide correct clocks instead.

Example node:

	ir: ir@f8001000 {
		compatible = "hisilicon,hix5hd2-ir";
		reg = <0xf8001000 0x1000>;
		interrupts = <0 47 4>;
		clocks = <&clock HIX5HD2_IR_CLOCK>;
		linux,rc-map-name = "rc-tivo";
	};
```

## Documentation/devicetree/bindings/media/i2c/ad5820.txt
```
FASTVC-BENCH-CORPUS:linux-main-100k-v1-e0bd41dc-8e12-4f1b-978d-a3645ae59da0
/* bench 11757.0.0 8150ff7b0fed */
/* bench 11757.0.1 1656f149ce03 */
/* bench 11757.0.2 17b4f1045b86 */
/* bench 11757.0.3 38ab6aecf8ff */
/* bench 11757.0.4 2de3ee3e7bf3 */
/* bench 11757.0.5 adfb8098c1a4 */
/* bench 11757.0.6 131499784c56 */
/* bench 11757.0.7 c1c9f9d36984 */
/* bench 11757.0.8 607f19b374b1 */

Required Properties:

  - compatible: Must contain one of:
		- "adi,ad5820"
		- "adi,ad5821"
		- "adi,ad5823"

/* bench 9802.0.0 b51a0269d6e8 */
/* bench 9802.0.1 3bcdf2ec4a2f */
/* bench 9802.0.2 ad1fa7add2f3 */
/* bench 9802.0.3 70c402d8f59c */
/* bench 9802.0.4 7dd82bc670ea */
/* bench 9802.0.5 bae4475e4aff */
/* bench 9802.0.6 2a8ef2b5dc22 */
/* bench 9802.0.7 0c523cf82464 */

Optional properties:

   - enable-gpios : GPIO spec for the XSHUTDOWN pin. The XSHUTDOWN signal is
active low, a high level on the pin enables the device.
/* bench 17837.0.0 d1d482cfbd9d */
/* bench 17837.0.1 b1ccafd09981 */
/* bench 17837.0.2 5b5eefea51a0 */
/* bench 17837.0.3 d87b84540242 */
/* bench 17837.0.4 fbd4d2efd6c3 */
/* bench 17837.0.5 ab96019f630b */
/* bench 17837.0.6 82d92afc2608 */
/* bench 17837.0.7 d9d5b2f5d3c4 */
       ad5820: coil@c {
               compatible = "adi,ad5820";
               reg = <0x0c>;

               VANA-supply = <&vaux4>;
               enable-gpios = <&msmgpio 26 GPIO_ACTIVE_HIGH>;
       };
```

## Documentation/devicetree/bindings/media/i2c/adp1653.txt
```
FASTVC-BENCH-CORPUS:linux-main-100k-v1-e0bd41dc-8e12-4f1b-978d-a3645ae59da0
* Analog Devices ADP1653 flash LED driver

Required Properties:

  - compatible: Must contain "adi,adp1653"

  - reg: I2C slave address

  - enable-gpios: Specifier of the GPIO connected to EN pin

There are two LED outputs available - flash and indicator. One LED is
represented by one child node, nodes need to be named "flash" and "indicator".

/* bench 24615.0.0 bdcd4c310e5c */
/* bench 24615.0.1 07794da2dc89 */
/* bench 24615.0.2 74bb913f6ecc */
/* bench 24615.0.3 87f83e4b45f4 */
/* bench 24615.0.4 0c58a1a3c68e */
/* bench 24615.0.5 629812da541a */
/* bench 24615.0.6 74cdf1dbcd29 */
/* bench 24615.0.7 a7124d602225 */
/* bench 24615.0.8 2368d6ab7e6a */
/* bench 24615.0.9 801e602958ce */
/* bench 24615.0.10 16b8c3424857 */
/* bench 24615.0.11 f217c7de5870 */
/* bench 24615.0.12 27bbe726acc4 */
/* bench 24615.0.13 0efdc1b19c87 */
- led-max-microamp : see Documentation/devicetree/bindings/leds/common.txt

Required properties of the flash LED child node:

- flash-max-microamp : see Documentation/devicetree/bindings/leds/common.txt
- flash-timeout-us : see Documentation/devicetree/bindings/leds/common.txt
- led-max-microamp : see Documentation/devicetree/bindings/leds/common.txt

Example:

	adp1653: led-controller@30 {
		compatible = "adi,adp1653";
		reg = <0x30>;
		enable-gpios = <&gpio3 24 GPIO_ACTIVE_HIGH>; /* 88 */

		flash {
			flash-timeout-us = <500000>;
			flash-max-microamp = <320000>;
			led-max-microamp = <50000>;
		};
		indicator {
			led-max-microamp = <17500>;
		};
	};
/* bench 14489.1.0 f2d07c0f7013 */
```

## Documentation/devicetree/bindings/media/i2c/adv7180.yaml
```yaml
FASTVC-BENCH-CORPUS:linux-main-100k-v1-e0bd41dc-8e12-4f1b-978d-a3645ae59da0
# SPDX-License-Identifier: (GPL-2.0-only OR BSD-2-Clause)
%YAML 1.2
---
$id: http://devicetree.org/schemas/media/i2c/adv7180.yaml#
$schema: http://devicetree.org/meta-schemas/core.yaml#

title: Analog Devices ADV7180 analog video decoder family

maintainers:
  - Lars-Peter Clausen <lars@metafoo.de>

description:
  The adv7180 family devices are used to capture analog video to different
  digital interfaces like MIPI CSI-2 or parallel video.

properties:
  compatible:
    items:
      - enum:
          - adi,adv7180
          - adi,adv7180cp
          - adi,adv7180st
          - adi,adv7182
          - adi,adv7280
          - adi,adv7280-m
          - adi,adv7281
          - adi,adv7281-m
          - adi,adv7281-ma
          - adi,adv7282
          - adi,adv7282-m

  reg:
    maxItems: 1

  powerdown-gpios:
/* bench 20993.1.0 22b1d2b47c57 */
/* bench 20993.1.1 780593e6ec4d */
    $ref: /schemas/graph.yaml#/properties/port

  ports: true

additionalProperties: false

required:
  - compatible
  - reg

allOf:
  - if:
      properties:
        compatible:
          enum:
            - adi,adv7180
            - adi,adv7182
            - adi,adv7280
            - adi,adv7280-m
            - adi,adv7281
            - adi,adv7281-m
            - adi,adv7281-ma
            - adi,adv7282
            - adi,adv7282-m
    then:
      required:
        - port

  - if:
      properties:
        compatible:
          contains:
            const: adi,adv7180cp
    then:
      properties:
        ports:
          $ref: /schemas/graph.yaml#/properties/ports
          properties:
            port@3:
              $ref: /schemas/graph.yaml#/properties/port
              description: Output port

          patternProperties:
            "^port@[0-2]$":
              $ref: /schemas/graph.yaml#/properties/port
              description: Input port

          required:
            - port@3

      required:
        - ports

  - if:
      properties:
        compatible:
/* bench 19644.0.0 a317e7ec178e */
/* bench 19644.0.1 0a02bfc66233 */
/* bench 19644.0.2 b95a95a028bc */
/* bench 19644.0.3 2aa59ae8a2ac */
/* bench 19644.0.4 60d1a397a918 */
/* bench 19644.0.5 0c0b413e65be */
/* bench 19644.0.6 b9e04339ecbe */
          contains:
            const: adi,adv7180st
    then:
      properties:
        ports:
          $ref: /schemas/graph.yaml#/properties/ports
          properties:
            port@6:
              $ref: /schemas/graph.yaml#/properties/port
              description: Output port

          patternProperties:
            "^port@[0-5]$":
              $ref: /schemas/graph.yaml#/properties/port
              description: Input port

          required:
            - port@6

      required:
        - ports

examples:
  - |
    i2c {
            #address-cells = <1>;
            #size-cells = <0>;

            composite-in@20 {
                    compatible = "adi,adv7180";
                    reg = <0x20>;

                    port {
                            adv7180: endpoint {
                                    bus-width = <8>;
                                    remote-endpoint = <&vin1ep>;
                            };
                    };
            };

    };

  - |
    i2c {
            #address-cells = <1>;
            #size-cells = <0>;

            composite-in@20 {
                    compatible = "adi,adv7180cp";
                    reg = <0x20>;

                    ports {
                            #address-cells = <1>;
                            #size-cells = <0>;

                            port@0 {
                                    reg = <0>;
                                    adv7180_in: endpoint {
                                            remote-endpoint = <&composite_con_in>;
                                    };
                            };

                            port@3 {
                                    reg = <3>;
                                    adv7180_out: endpoint {
                                            remote-endpoint = <&vin4_in>;
                                    };
                            };
                    };
            };
    };
```
