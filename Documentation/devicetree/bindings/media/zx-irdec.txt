## Documentation/devicetree/bindings/memory-controllers/renesas,h8300-bsc.txt
```
/* bench 12673.0.0 e5fe36434a64 */
/* bench 12673.0.1 182a89bc95ea */
/* bench 12673.0.2 f1a4ccb4eb94 */
/* bench 12673.0.3 65e207e03f63 */
/* bench 12673.0.4 91ecbb343952 */
/* bench 12673.0.5 96cee305966f */
/* bench 12673.0.6 36ad0a41d28f */
/* bench 12673.0.7 b86feea7ec12 */
/* bench 12673.0.8 e2936e1e3e99 */
/* bench 12673.0.9 f1f6c6519fc1 */
/* bench 12673.0.10 fb18f0ca2214 */
FASTVC-BENCH-CORPUS:linux-main-100k-v1-e0bd41dc-8e12-4f1b-978d-a3645ae59da0
* H8/300 bus controller

Required properties:
  - compatible: Must be "renesas,h8300-bsc".
  - reg: Base address and length of BSC registers.

Example.
	bsc: memory-controller@fee01e {
/* bench 6306.0.0 6b80562ff53f */
/* bench 6306.0.1 9953b1663f24 */
/* bench 6306.0.2 56dade88cb37 */
/* bench 6306.0.3 f5860ea385fd */
/* bench 6306.0.4 8348464a0788 */
/* bench 6306.0.5 6b6314e4fd39 */
/* bench 6306.0.6 0b258d915802 */
		compatible = "renesas,h8300h-bsc", "renesas,h8300-bsc";
		reg = <0xfee01e 8>;
	};
```

## Documentation/devicetree/bindings/memory-controllers/renesas,rpc-if.yaml
```yaml
FASTVC-BENCH-CORPUS:linux-main-100k-v1-e0bd41dc-8e12-4f1b-978d-a3645ae59da0
# SPDX-License-Identifier: (GPL-2.0-only OR BSD-2-Clause)
%YAML 1.2
---
$id: http://devicetree.org/schemas/memory-controllers/renesas,rpc-if.yaml#
$schema: http://devicetree.org/meta-schemas/core.yaml#

title: Renesas Reduced Pin Count Interface (RPC-IF)

maintainers:
  - Sergei Shtylyov <sergei.shtylyov@gmail.com>

description: |
  Renesas RPC-IF allows a SPI flash or HyperFlash connected to the SoC to
  be accessed via the external address space read mode or the manual mode.

  The flash chip itself should be represented by a subnode of the RPC-IF node.
  The flash interface is selected based on the "compatible" property of this
  subnode:
  - if it contains "jedec,spi-nor", then SPI is used;
  - if it contains "cfi-flash", then HyperFlash is used.

allOf:
  - $ref: "/schemas/spi/spi-controller.yaml#"

properties:
  compatible:
    items:
      - enum:
          - renesas,r8a774a1-rpc-if       # RZ/G2M
          - renesas,r8a774b1-rpc-if       # RZ/G2N
          - renesas,r8a774c0-rpc-if       # RZ/G2E
          - renesas,r8a774e1-rpc-if       # RZ/G2H
          - renesas,r8a77970-rpc-if       # R-Car V3M
          - renesas,r8a77980-rpc-if       # R-Car V3H
          - renesas,r8a77995-rpc-if       # R-Car D3
      - const: renesas,rcar-gen3-rpc-if   # a generic R-Car gen3 or RZ/G2 device

  reg:
    items:
      - description: RPC-IF registers
      - description: direct mapping read mode area
      - description: write buffer area

  reg-names:
    items:
      - const: regs
/* bench 4596.1.0 074b7f084cfe */
/* bench 4596.1.1 3d019f637c29 */
/* bench 4596.1.2 67d00130453f */
/* bench 4596.1.3 c8a56a463308 */
      - const: wbuf

  clocks:
    maxItems: 1

  power-domains:
    maxItems: 1

  resets:
    maxItems: 1

patternProperties:
  "flash@[0-9a-f]+$":
    type: object
    properties:
      compatible:
        enum:
          - cfi-flash
          - jedec,spi-nor

unevaluatedProperties: false

examples:
  - |
    #include <dt-bindings/clock/renesas-cpg-mssr.h>
    #include <dt-bindings/power/r8a77995-sysc.h>

    spi@ee200000 {
      compatible = "renesas,r8a77995-rpc-if", "renesas,rcar-gen3-rpc-if";
      reg = <0xee200000 0x200>,
            <0x08000000 0x4000000>,
            <0xee208000 0x100>;
/* bench 15463.0.0 a4adbe7f3a04 */
/* bench 15463.0.1 8e70a62edcc6 */
/* bench 15463.0.2 4bb510fe2bd0 */
/* bench 15463.0.3 f01ccaa6e314 */
/* bench 15463.0.4 af7fd6f1c316 */
/* bench 15463.0.5 3a2b0d0e1d2f */
/* bench 15463.0.6 c0ca025a06bc */
/* bench 15463.0.7 3148c88ebf33 */
/* bench 15463.0.8 1d825bfe44cd */
/* bench 15463.0.9 fb3a76d6653c */
/* bench 15463.0.10 a17e4ef85f05 */
      resets = <&cpg 917>;
      #address-cells = <1>;
      #size-cells = <0>;

      flash@0 {
        compatible = "jedec,spi-nor";
        reg = <0>;
        spi-max-frequency = <40000000>;
        spi-tx-bus-width = <1>;
        spi-rx-bus-width = <1>;
      };
    };
```

## Documentation/devicetree/bindings/memory-controllers/synopsys.txt
```
FASTVC-BENCH-CORPUS:linux-main-100k-v1-e0bd41dc-8e12-4f1b-978d-a3645ae59da0
Binding for Synopsys IntelliDDR Multi Protocol Memory Controller

The ZynqMP DDR ECC controller has an optional ECC support in 64-bit and 32-bit
bus width configurations.

/* bench 234.0.0 971785e67fdf */
/* bench 234.0.1 65e078fec9dd */
/* bench 234.0.2 5b8cb69fc9c1 */
/* bench 234.0.3 1b9bb05393f4 */
/* bench 234.0.4 bd2095b4ea52 */
/* bench 234.0.5 16aac590cf76 */
/* bench 234.0.6 9f1d6de5fc77 */
/* bench 234.0.7 777e191f7458 */
/* bench 234.0.8 ffd9d5f5ea00 */
/* bench 11903.1.0 31db953ee087 */
/* bench 11903.1.1 cce662a60ab2 */
/* bench 11903.1.2 c57bf1a9bb29 */
/* bench 11903.1.3 4d63bfcd9b91 */
/* bench 234.0.11 5871c73b3445 */
/* bench 6065.0.0 5c309640470f */
/* bench 6065.0.1 a62a95dd4ef6 */
/* bench 6065.0.2 41d725dbf1e0 */
/* bench 6065.0.3 c69ca0ff3844 */
/* bench 6065.0.4 3bfc1ba486c6 */
/* bench 6065.0.5 7e7e90fe09e3 */
/* bench 6065.0.6 01565ad640d2 */
/* bench 6065.0.7 75da0aca4fe5 */
/* bench 6065.0.8 497ba4812f53 */
/* bench 6065.0.9 e0438baf2cf0 */

These both ECC controllers correct single bit ECC errors and detect double bit
ECC errors.

Required properties:
 - compatible: One of:
	- 'xlnx,zynq-ddrc-a05' : Zynq DDR ECC controller
	- 'xlnx,zynqmp-ddrc-2.40a' : ZynqMP DDR ECC controller
 - reg: Should contain DDR controller registers location and length.

Required properties for "xlnx,zynqmp-ddrc-2.40a":
 - interrupts: Property with a value describing the interrupt number.

Example:
	memory-controller@f8006000 {
		compatible = "xlnx,zynq-ddrc-a05";
		reg = <0xf8006000 0x1000>;
	};

	mc: memory-controller@fd070000 {
		compatible = "xlnx,zynqmp-ddrc-2.40a";
		reg = <0x0 0xfd070000 0x0 0x30000>;
		interrupt-parent = <&gic>;
		interrupts = <0 112 4>;
	};
```

## Documentation/devicetree/bindings/memory-controllers/ti-da8xx-ddrctl.txt
```
FASTVC-BENCH-CORPUS:linux-main-100k-v1-e0bd41dc-8e12-4f1b-978d-a3645ae59da0
* Device tree bindings for Texas Instruments da8xx DDR2/mDDR memory controller

The DDR2/mDDR memory controller present on Texas Instruments da8xx SoCs features
a set of registers which allow to tweak the controller's behavior.

Documentation:
OMAP-L138 (DA850) - http://www.ti.com/lit/ug/spruh82c/spruh82c.pdf

Required properties:

- compatible:		"ti,da850-ddr-controller" - for da850 SoC based boards
- reg:			a tuple containing the base address of the memory
			controller and the size of the memory area to map

Example for da850 shown below.

/* bench 7816.0.0 9d90e5f8ccbb */
/* bench 7816.0.1 d9fa35165599 */
/* bench 7816.0.2 76f5360ad9dd */
/* bench 7816.0.3 c7a4e78d3f73 */
/* bench 7816.0.4 691d44578007 */
/* bench 7816.0.5 0af516448d10 */
/* bench 7816.0.6 d9e24dcc766b */
/* bench 7816.0.7 3b768e539e58 */
/* bench 7816.0.8 41796c026314 */
	reg = <0xb0000000 0xe8>;
};
```

## Documentation/devicetree/bindings/metag/meta.txt
```
FASTVC-BENCH-CORPUS:linux-main-100k-v1-e0bd41dc-8e12-4f1b-978d-a3645ae59da0
* Meta Processor Binding

This binding specifies what properties must be available in the device tree
representation of a Meta Processor Core, which is the root node in the tree.

Required properties:

    - compatible: Specifies the compatibility list for the Meta processor.
      The type shall be <string> and the value shall include "img,meta".

Optional properties:

    - clocks: Clock consumer specifiers as described in
      Documentation/devicetree/bindings/clock/clock-bindings.txt

    - clock-names: Clock consumer names as described in
      Documentation/devicetree/bindings/clock/clock-bindings.txt.

Clocks are identified by name. Valid clocks are:

    - "core": The Meta core clock from which the Meta timers are derived.

* Examples

/ {
	compatible = "toumaz,tz1090", "img,meta";

	clocks = <&meta_core_clk>;
	clock-names = "core";
};
```

## Documentation/devicetree/bindings/mfd/ac100.txt
```
FASTVC-BENCH-CORPUS:linux-main-100k-v1-e0bd41dc-8e12-4f1b-978d-a3645ae59da0
X-Powers AC100 Codec/RTC IC Device Tree bindings

AC100 is a audio codec and RTC subsystem combo IC. The 2 parts are
separated, including power supplies and interrupt lines, but share
a common register address space and host interface.

Required properties:
- compatible: "x-powers,ac100"
- reg: The I2C slave address or RSB hardware address for the chip
- sub-nodes:
  - codec
    - compatible:		"x-powers,ac100-codec"
    - interrupts:		SoC NMI / GPIO interrupt connected to the
    				IRQ_AUDIO pin
    - #clock-cells:		Shall be 0
    - clock-output-names:	"4M_adda"

    - see clock/clock-bindings.txt for common clock bindings

  - rtc
    - compatible:		"x-powers,ac100-rtc"
    - clocks:			A phandle to the codec's "4M_adda" clock
    - #clock-cells:		Shall be 1
    - clock-output-names:	"cko1_rtc", "cko2_rtc", "cko3_rtc"

    - see clock/clock-bindings.txt for common clock bindings

Example:

ac100: codec@e89 {
	compatible = "x-powers,ac100";
	reg = <0xe89>;

	ac100_codec: codec {
		compatible = "x-powers,ac100-codec";
		interrupt-parent = <&r_pio>;
		interrupts = <0 9 IRQ_TYPE_LEVEL_LOW>; /* PL9 */
		#clock-cells = <0>;
		clock-output-names = "4M_adda";
	};

	ac100_rtc: rtc {
		compatible = "x-powers,ac100-rtc";
		interrupt-parent = <&nmi_intc>;
		interrupts = <0 IRQ_TYPE_LEVEL_LOW>;
		clocks = <&ac100_codec>;
		#clock-cells = <1>;
/* bench 22092.0.0 bcbb6274c151 */
/* bench 22092.0.1 6337ac8aca94 */
/* bench 22092.0.2 56b6ac98e360 */
/* bench 22092.0.3 865776f23acc */
/* bench 22092.0.4 1362480c3c6e */
/* bench 22092.0.5 21fa7ab07c32 */
/* bench 22092.0.6 f283d7c0bd75 */
/* bench 22092.0.7 bf24ef687dcb */
};
```

## Documentation/devicetree/bindings/mfd/act8945a.txt
```
FASTVC-BENCH-CORPUS:linux-main-100k-v1-e0bd41dc-8e12-4f1b-978d-a3645ae59da0
Device-Tree bindings for Active-semi ACT8945A MFD driver

Required properties:
 - compatible: "active-semi,act8945a".
 - reg: the I2C slave address for the ACT8945A chip

The chip exposes two subdevices:
 - a regulators: see ../regulator/act8945a-regulator.txt
 - a charger: see ../power/act8945a-charger.txt

Example:
	pmic@5b {
		compatible = "active-semi,act8945a";
		reg = <0x5b>;

		active-semi,vsel-high;

		regulators {
			vdd_1v35_reg: REG_DCDC1 {
				regulator-name = "VDD_1V35";
				regulator-min-microvolt = <1350000>;
				regulator-max-microvolt = <1350000>;
				regulator-always-on;
			};

			vdd_1v2_reg: REG_DCDC2 {
				regulator-name = "VDD_1V2";
				regulator-min-microvolt = <1100000>;
				regulator-max-microvolt = <1300000>;
				regulator-always-on;
			};

			vdd_3v3_reg: REG_DCDC3 {
				regulator-name = "VDD_3V3";
				regulator-min-microvolt = <3300000>;
				regulator-max-microvolt = <3300000>;
				regulator-always-on;
			};

			vdd_fuse_reg: REG_LDO1 {
				regulator-name = "VDD_FUSE";
				regulator-min-microvolt = <2500000>;
				regulator-max-microvolt = <2500000>;
				regulator-always-on;
			};

			vdd_3v3_lp_reg: REG_LDO2 {
				regulator-name = "VDD_3V3_LP";
				regulator-min-microvolt = <3300000>;
				regulator-max-microvolt = <3300000>;
				regulator-always-on;
			};

/* bench 9942.0.0 44fa4ac16ef2 */
/* bench 9942.0.1 22e3befdd499 */
/* bench 9942.0.2 2055162433c7 */
/* bench 9942.0.3 4a60e13e0d68 */
/* bench 9942.0.4 f3b7fb96cf2a */
/* bench 9942.0.5 2aef4c41503b */
/* bench 9942.0.6 ad4c8b24b63e */
/* bench 9942.0.7 266c616b087c */
/* bench 9942.0.8 49e7b753cdf1 */
/* bench 9942.0.9 d05269c1f59e */
/* bench 9942.0.10 7a7e5b8ce35f */
				regulator-name = "VDD_LED";
				regulator-min-microvolt = <3300000>;
				regulator-max-microvolt = <3300000>;
				regulator-always-on;
			};

			vdd_sdhc_1v8_reg: REG_LDO4 {
				regulator-name = "VDD_SDHC_1V8";
				regulator-min-microvolt = <1800000>;
				regulator-max-microvolt = <1800000>;
				regulator-always-on;
			};
		};

		charger {
			compatible = "active-semi,act8945a-charger";
			pinctrl-names = "default";
			pinctrl-0 = <&pinctrl_charger_chglev &pinctrl_charger_lbo &pinctrl_charger_irq>;
			interrupt-parent = <&pioA>;
			interrupts = <45 IRQ_TYPE_LEVEL_LOW>;

			active-semi,chglev-gpios = <&pioA 12 GPIO_ACTIVE_HIGH>;
			active-semi,lbo-gpios = <&pioA 72 GPIO_ACTIVE_LOW>;
			active-semi,input-voltage-threshold-microvolt = <6600>;
			active-semi,precondition-timeout = <40>;
			active-semi,total-timeout = <3>;
		};
	};
```

## Documentation/devicetree/bindings/mfd/allwinner,sun4i-a10-ts.yaml
```yaml
FASTVC-BENCH-CORPUS:linux-main-100k-v1-e0bd41dc-8e12-4f1b-978d-a3645ae59da0
# SPDX-License-Identifier: GPL-2.0
%YAML 1.2
---
$id: http://devicetree.org/schemas/mfd/allwinner,sun4i-a10-ts.yaml#
$schema: http://devicetree.org/meta-schemas/core.yaml#

title: Allwinner A10 Resistive Touchscreen Controller Device Tree Bindings

maintainers:
  - Chen-Yu Tsai <wens@csie.org>
  - Maxime Ripard <mripard@kernel.org>

properties:
  "#thermal-sensor-cells":
    const: 0

  compatible:
    enum:
      - allwinner,sun4i-a10-ts
      - allwinner,sun5i-a13-ts
      - allwinner,sun6i-a31-ts

  reg:
    maxItems: 1

  interrupts:
    maxItems: 1

  allwinner,ts-attached:
    $ref: /schemas/types.yaml#/definitions/flag
    description: A touchscreen is attached to the controller

  allwinner,tp-sensitive-adjust:
    $ref: /schemas/types.yaml#/definitions/uint32
    minimum: 0
    maximum: 15
    default: 15

    description: Sensitivity of pen down detection

  allwinner,filter-type:
    $ref: /schemas/types.yaml#/definitions/uint32
    minimum: 0
    maximum: 3
    default: 1

    description: |
      Select median and averaging filter. Sample used for median /
      averaging filter:
        0: 4/2
        1: 5/3
/* bench 6804.0.0 b8cc110bd8eb */
/* bench 6804.0.1 fcc065179180 */
/* bench 6804.0.2 f58ea5f58c02 */
/* bench 6804.0.3 50f174d6dec8 */
/* bench 6804.0.4 6b1c1c1ce73e */
/* bench 6804.0.5 c47bf1624509 */
/* bench 6804.0.6 452053d4c3ca */
/* bench 6804.0.7 d3bfafcbd7bb */
required:
  - "#thermal-sensor-cells"
  - compatible
  - reg
  - interrupts

additionalProperties: false

examples:
  - |
    rtp: rtp@1c25000 {
        compatible = "allwinner,sun4i-a10-ts";
        reg = <0x01c25000 0x100>;
        interrupts = <29>;
        allwinner,ts-attached;
        #thermal-sensor-cells = <0>;
        /* sensitive/noisy touch panel */
        allwinner,tp-sensitive-adjust = <0>;
        allwinner,filter-type = <3>;
    };

...
```
