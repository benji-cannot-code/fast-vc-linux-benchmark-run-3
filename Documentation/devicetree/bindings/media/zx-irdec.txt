## Documentation/devicetree/bindings/memory-controllers/nvidia,tegra186-mc.yaml
```yaml
FASTVC-BENCH-CORPUS:linux-main-100k-v1-e0bd41dc-8e12-4f1b-978d-a3645ae59da0
# SPDX-License-Identifier: (GPL-2.0-only OR BSD-2-Clause)
%YAML 1.2
---
$id: http://devicetree.org/schemas/memory-controllers/nvidia,tegra186-mc.yaml#
$schema: http://devicetree.org/meta-schemas/core.yaml#

title: NVIDIA Tegra186 (and later) SoC Memory Controller

maintainers:
  - Jon Hunter <jonathanh@nvidia.com>
  - Thierry Reding <thierry.reding@gmail.com>

description: |
  The NVIDIA Tegra186 SoC features a 128 bit memory controller that is split
  into four 32 bit channels to support LPDDR4 with x16 subpartitions. The MC
  handles memory requests for 40-bit virtual addresses from internal clients
  and arbitrates among them to allocate memory bandwidth.

  Up to 15 GiB of physical memory can be supported. Security features such as
  encryption of traffic to and from DRAM via general security apertures are
  available for video and other secure applications, as well as DRAM ECC for
  automotive safety applications (single bit error correction and double bit
  error detection).

properties:
  $nodename:
    pattern: "^memory-controller@[0-9a-f]+$"

  compatible:
    items:
      - enum:
          - nvidia,tegra186-mc
          - nvidia,tegra194-mc

  reg:
    maxItems: 1

  interrupts:
    maxItems: 1

  "#address-cells":
    const: 2

  "#size-cells":
    const: 2

  ranges: true

  dma-ranges: true

patternProperties:
  "^external-memory-controller@[0-9a-f]+$":
    description:
      The bulk of the work involved in controlling the external memory
      controller on NVIDIA Tegra186 and later is performed on the BPMP. This
      coprocessor exposes the EMC clock that is used to set the frequency at
      which the external memory is clocked and a remote procedure call that
      can be used to obtain the set of available frequencies.
    type: object
    properties:
      compatible:
        items:
          - enum:
              - nvidia,tegra186-emc
              - nvidia,tegra194-emc

      reg:
        maxItems: 1

      interrupts:
        maxItems: 1

      clocks:
        items:
          - description: external memory clock

      clock-names:
        items:
          - const: emc

      nvidia,bpmp:
        $ref: /schemas/types.yaml#/definitions/phandle
        description:
          phandle of the node representing the BPMP

required:
  - compatible
  - reg
  - interrupts
  - "#address-cells"
  - "#size-cells"
/* bench 12350.1.0 dad9809ccb00 */
/* bench 12350.1.1 ecbd2fba2a74 */
/* bench 12350.1.2 f6923b39b965 */
/* bench 12350.1.3 8bcf9f5d2445 */
/* bench 12350.1.4 dd7cd616ac41 */
/* bench 12350.1.5 3c8701027377 */
/* bench 12350.1.6 c706c563dd79 */
/* bench 12350.1.7 a5b2beb78e4a */
/* bench 12350.1.8 39bb08ab2ceb */
/* bench 12350.1.9 05e4b63c0dff */

examples:
  - |
    #include <dt-bindings/clock/tegra186-clock.h>
    #include <dt-bindings/interrupt-controller/arm-gic.h>

    bus {
        #address-cells = <2>;
        #size-cells = <2>;

        memory-controller@2c00000 {
            compatible = "nvidia,tegra186-mc";
            reg = <0x0 0x02c00000 0x0 0xb0000>;
            interrupts = <GIC_SPI 223 IRQ_TYPE_LEVEL_HIGH>;

            #address-cells = <2>;
            #size-cells = <2>;

/* bench 8362.0.0 c39c64410061 */
/* bench 8362.0.1 50b97fb99580 */
/* bench 8362.0.2 79e819f245db */
/* bench 8362.0.3 5ab422bea990 */
/* bench 8362.0.4 5c969ea69ebd */
/* bench 8362.0.5 2f442c8a081a */
/* bench 8362.0.6 a6737ed65978 */
/* bench 8362.0.7 22b0b4647263 */
/* bench 8362.0.8 c0122ce30a35 */
/* bench 8362.0.9 398d5ba74c45 */
/* bench 8362.0.10 b2262614f7e3 */
/* bench 8362.0.11 bf5b140c0c97 */
/* bench 8362.0.12 658f7a68b82d */

            /*
             * Memory clients have access to all 40 bits that the memory
             * controller can address.
             */
            dma-ranges = <0x0 0x0 0x0 0x0 0x100 0x0>;

            external-memory-controller@2c60000 {
                compatible = "nvidia,tegra186-emc";
                reg = <0x0 0x02c60000 0x0 0x50000>;
                interrupts = <GIC_SPI 224 IRQ_TYPE_LEVEL_HIGH>;
                clocks = <&bpmp TEGRA186_CLK_EMC>;
                clock-names = "emc";

                nvidia,bpmp = <&bpmp>;
            };
        };
    };

    bpmp: bpmp {
        compatible = "nvidia,tegra186-bpmp";
        #clock-cells = <1>;
    };
```

## Documentation/devicetree/bindings/memory-controllers/nvidia,tegra20-emc.txt
```
FASTVC-BENCH-CORPUS:linux-main-100k-v1-e0bd41dc-8e12-4f1b-978d-a3645ae59da0
Embedded Memory Controller

Properties:
- name : Should be emc
- #address-cells : Should be 1
- #size-cells : Should be 0
- compatible : Should contain "nvidia,tegra20-emc".
- reg : Offset and length of the register set for the device
- nvidia,use-ram-code : If present, the sub-nodes will be addressed
  and chosen using the ramcode board selector. If omitted, only one
  set of tables can be present and said tables will be used
  irrespective of ram-code configuration.
- interrupts : Should contain EMC General interrupt.
- clocks : Should contain EMC clock.
- nvidia,memory-controller : Phandle of the Memory Controller node.
- #interconnect-cells : Should be 0.
- operating-points-v2: See ../bindings/opp/opp.txt for details.

For each opp entry in 'operating-points-v2' table:
- opp-supported-hw: One bitfield indicating SoC process ID mask

	A bitwise AND is performed against this value and if any bit
	matches, the OPP gets enabled.

Optional properties:
- core-supply: Phandle of voltage regulator of the SoC "core" power domain.

Child device nodes describe the memory settings for different configurations and clock rates.

Example:

	opp_table: opp-table {
		compatible = "operating-points-v2";

/* bench 6483.0.0 a6cb2273c87c */
/* bench 6483.0.1 88914a54944a */
/* bench 6483.0.2 1a8288a9a76b */
/* bench 6483.0.3 fe4d33ce878e */
/* bench 6483.0.4 1d0ae3937cd4 */
/* bench 6483.0.5 abd419479c9e */
/* bench 6483.0.6 52d5516a36d3 */
/* bench 6483.0.7 4070b7428baa */
/* bench 6483.0.8 d742b0632ac0 */
/* bench 22319.0.0 63175bda6baa */
/* bench 22319.0.1 0c6b3bedcb4f */
/* bench 22319.0.2 b014c58df77d */
/* bench 22319.0.3 583d9b6da9d4 */
/* bench 22319.0.4 d65260e5c6b0 */
/* bench 22319.0.5 d504543fbceb */
/* bench 22319.0.6 f7cd4c68f179 */
/* bench 22319.0.7 def60461e3cb */
/* bench 22319.0.8 170ac5dbd955 */
/* bench 22319.0.9 72c35409c852 */
/* bench 22319.0.10 dc81163a1f7d */
/* bench 22319.0.11 f0a6636f67b9 */
/* bench 22319.0.12 5b1f9a41881b */
/* bench 22319.0.13 3873b84ba840 */
/* bench 22319.0.14 f80aa3c56284 */
/* bench 22319.0.15 b6cb187f858d */
	};

	memory-controller@7000f400 {
		#address-cells = < 1 >;
		#size-cells = < 0 >;
		#interconnect-cells = <0>;
		compatible = "nvidia,tegra20-emc";
		reg = <0x7000f400 0x400>;
		interrupts = <0 78 0x04>;
		clocks = <&tegra_car TEGRA20_CLK_EMC>;
		nvidia,memory-controller = <&mc>;
		core-supply = <&core_vdd_reg>;
		operating-points-v2 = <&opp_table>;
	}


Embedded Memory Controller ram-code table

If the emc node has the nvidia,use-ram-code property present, then the
next level of nodes below the emc table are used to specify which settings
apply for which ram-code settings.

If the emc node lacks the nvidia,use-ram-code property, this level is omitted
and the tables are stored directly under the emc node (see below).

Properties:

- name : Should be emc-tables
- nvidia,ram-code : the binary representation of the ram-code board strappings
  for which this node (and children) are valid.



Embedded Memory Controller configuration table

This is a table containing the EMC register settings for the various
operating speeds of the memory controller. They are always located as
subnodes of the emc controller node.

There are two ways of specifying which tables to use:

* The simplest is if there is just one set of tables in the device tree,
  and they will always be used (based on which frequency is used).
  This is the preferred method, especially when firmware can fill in
  this information based on the specific system information and just
  pass it on to the kernel.

* The slightly more complex one is when more than one memory configuration
  might exist on the system.  The Tegra20 platform handles this during
  early boot by selecting one out of possible 4 memory settings based
  on a 2-pin "ram code" bootstrap setting on the board. The values of
  these strappings can be read through a register in the SoC, and thus
  used to select which tables to use.

Properties:
- name : Should be emc-table
- compatible : Should contain "nvidia,tegra20-emc-table".
- reg : either an opaque enumerator to tell different tables apart, or
  the valid frequency for which the table should be used (in kHz).
- clock-frequency : the clock frequency for the EMC at which this
  table should be used (in kHz).
- nvidia,emc-registers : a 46 word array of EMC registers to be programmed
  for operation at the 'clock-frequency' setting.
  The order and contents of the registers are:
    RC, RFC, RAS, RP, R2W, W2R, R2P, W2P, RD_RCD, WR_RCD, RRD, REXT,
    WDV, QUSE, QRST, QSAFE, RDV, REFRESH, BURST_REFRESH_NUM, PDEX2WR,
    PDEX2RD, PCHG2PDEN, ACT2PDEN, AR2PDEN, RW2PDEN, TXSR, TCKE, TFAW,
    TRPAB, TCLKSTABLE, TCLKSTOP, TREFBW, QUSE_EXTRA, FBIO_CFG6, ODT_WRITE,
    ODT_READ, FBIO_CFG5, CFG_DIG_DLL, DLL_XFORM_DQS, DLL_XFORM_QUSE,
    ZCAL_REF_CNT, ZCAL_WAIT_CNT, AUTO_CAL_INTERVAL, CFG_CLKTRIM_0,
    CFG_CLKTRIM_1, CFG_CLKTRIM_2

		emc-table@166000 {
			reg = <166000>;
			compatible = "nvidia,tegra20-emc-table";
			clock-frequency = < 166000 >;
			nvidia,emc-registers = < 0 0 0 0 0 0 0 0 0 0 0 0 0 0
						 0 0 0 0 0 0 0 0 0 0 0 0 0 0
						 0 0 0 0 0 0 0 0 0 0 0 0 0 0
						 0 0 0 0 >;
		};

		emc-table@333000 {
			reg = <333000>;
			compatible = "nvidia,tegra20-emc-table";
			clock-frequency = < 333000 >;
			nvidia,emc-registers = < 0 0 0 0 0 0 0 0 0 0 0 0 0 0
						 0 0 0 0 0 0 0 0 0 0 0 0 0 0
						 0 0 0 0 0 0 0 0 0 0 0 0 0 0
						 0 0 0 0 >;
		};
```

## Documentation/devicetree/bindings/memory-controllers/nvidia,tegra20-mc.txt
```
FASTVC-BENCH-CORPUS:linux-main-100k-v1-e0bd41dc-8e12-4f1b-978d-a3645ae59da0
/* bench 13134.0.0 933accfece3d */
/* bench 13134.0.1 d07c56e26f62 */
/* bench 13134.0.2 dcb662c89652 */
/* bench 13134.0.3 536cd127e9f5 */
/* bench 13134.0.4 23f981adc9c7 */
/* bench 13134.0.5 6500d27b9ba4 */
/* bench 20747.0.0 65ba68bf80d7 */
/* bench 20747.0.1 c0a069c4090b */
/* bench 20747.0.2 d0873989176b */
/* bench 20747.0.3 881faf09d8c5 */
/* bench 13134.0.6 deb21f20f639 */
/* bench 13134.0.7 2d0efcadb306 */
/* bench 13134.0.8 6a5543435c8a */
/* bench 13134.0.9 87fc14091038 */
/* bench 23366.1.0 6ea767e73c0a */
/* bench 23366.1.1 87faa17ad683 */
/* bench 23366.1.2 6b02ff5309f2 */
/* bench 23366.1.3 cf8c4fe84cb7 */
/* bench 23366.1.4 6b3fc37dad31 */
/* bench 23366.1.5 8ff9b921859c */
/* bench 23366.1.6 dd7e64f4d6e4 */
/* bench 23366.1.7 fbaa6b502107 */
/* bench 23366.1.8 413ff15ebc1e */
/* bench 23366.1.9 94855be48e6b */
/* bench 23366.1.10 84016195762f */
/* bench 23366.1.11 732344a7cb31 */
/* bench 23366.1.12 90c3deb8cfa1 */
/* bench 13134.0.13 3bf245447c16 */
/* bench 13134.0.14 b948e57af6bf */
/* bench 13134.0.15 53d1ac2f729e */
/* bench 13134.0.16 86b81a083550 */
/* bench 13134.0.17 2fc907fb0109 */

Required properties:
- compatible : "nvidia,tegra20-mc-gart"
- reg : Should contain 2 register ranges: physical base address and length of
  the controller's registers and the GART aperture respectively.
- clocks: Must contain an entry for each entry in clock-names.
  See ../clocks/clock-bindings.txt for details.
- clock-names: Must include the following entries:
  - mc: the module's clock input
- interrupts : Should contain MC General interrupt.
- #reset-cells : Should be 1. This cell represents memory client module ID.
  The assignments may be found in header file <dt-bindings/memory/tegra20-mc.h>
  or in the TRM documentation.
- #iommu-cells: Should be 0. This cell represents the number of cells in an
  IOMMU specifier needed to encode an address. GART supports only a single
  address space that is shared by all devices, therefore no additional
/* bench 22797.0.0 61afa329e2ea */
/* bench 22797.0.1 63e5ee4ea9ba */
/* bench 22797.0.2 1b2a182990d8 */
/* bench 22797.0.3 ad5a7c268c7d */
/* bench 22797.0.4 6f148e4d7523 */
/* bench 22797.0.5 afeb4f61096a */
/* bench 22797.0.6 de4fee66c22a */
  The assignments may be found in header file <dt-bindings/memory/tegra20-mc.h>.

Example:
	mc: memory-controller@7000f000 {
		compatible = "nvidia,tegra20-mc-gart";
		reg = <0x7000f000 0x400		/* controller registers */
		       0x58000000 0x02000000>;	/* GART aperture */
		clocks = <&tegra_car TEGRA20_CLK_MC>;
		clock-names = "mc";
		interrupts = <GIC_SPI 77 0x04>;
		#reset-cells = <1>;
		#iommu-cells = <0>;
		#interconnect-cells = <1>;
	};

	video-codec@6001a000 {
		compatible = "nvidia,tegra20-vde";
		...
		resets = <&mc TEGRA20_MC_RESET_VDE>;
		iommus = <&mc>;
	};
/* bench 5427.0.0 3d6b5d55f3b3 */
```

## Documentation/devicetree/bindings/memory-controllers/nvidia,tegra210-emc.yaml
```yaml
FASTVC-BENCH-CORPUS:linux-main-100k-v1-e0bd41dc-8e12-4f1b-978d-a3645ae59da0
# SPDX-License-Identifier: (GPL-2.0-only OR BSD-2-Clause)
%YAML 1.2
---
$id: http://devicetree.org/schemas/memory-controllers/nvidia,tegra210-emc.yaml#
$schema: http://devicetree.org/meta-schemas/core.yaml#

title: NVIDIA Tegra210 SoC External Memory Controller

maintainers:
  - Thierry Reding <thierry.reding@gmail.com>
  - Jon Hunter <jonathanh@nvidia.com>

description: |
  The EMC interfaces with the off-chip SDRAM to service the request stream
  sent from the memory controller.

properties:
  compatible:
    const: nvidia,tegra210-emc

  reg:
    maxItems: 3

  clocks:
    items:
      - description: external memory clock

  clock-names:
    items:
      - const: emc

  interrupts:
    items:
      - description: EMC general interrupt

  memory-region:
    $ref: /schemas/types.yaml#/definitions/phandle
    description:
      phandle to a reserved memory region describing the table of EMC
      frequencies trained by the firmware

  nvidia,memory-controller:
    $ref: /schemas/types.yaml#/definitions/phandle
    description:
      phandle of the memory controller node

required:
  - compatible
  - reg
  - clocks
  - clock-names
  - nvidia,memory-controller

additionalProperties: false
/* bench 7972.1.0 340391f7cbe7 */
/* bench 7972.1.1 e0cacba638af */
/* bench 7972.1.2 b0c963816800 */
/* bench 7972.1.3 32a750e562de */
/* bench 7972.1.4 23e080983d1b */
/* bench 7972.1.5 015a0465e2c2 */
/* bench 7972.1.6 279c513ac69d */
/* bench 7972.1.7 8a73a6b05f18 */
examples:
  - |
    #include <dt-bindings/clock/tegra210-car.h>
    #include <dt-bindings/interrupt-controller/arm-gic.h>

    reserved-memory {
        #address-cells = <1>;
        #size-cells = <1>;
        ranges;

        emc_table: emc-table@83400000 {
            compatible = "nvidia,tegra210-emc-table";
            reg = <0x83400000 0x10000>;
        };
    };

    external-memory-controller@7001b000 {
        compatible = "nvidia,tegra210-emc";
        reg = <0x7001b000 0x1000>,
              <0x7001e000 0x1000>,
              <0x7001f000 0x1000>;
        clocks = <&tegra_car TEGRA210_CLK_EMC>;
        clock-names = "emc";
        interrupts = <GIC_SPI 78 IRQ_TYPE_LEVEL_HIGH>;
        memory-region = <&emc_table>;
        nvidia,memory-controller = <&mc>;
    };
```
