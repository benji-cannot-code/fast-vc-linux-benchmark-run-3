## Documentation/devicetree/bindings/media/zx-irdec.txt
```
FASTVC-BENCH-CORPUS:linux-main-100k-v1-e0bd41dc-8e12-4f1b-978d-a3645ae59da0
IR Decoder (IRDEC) on ZTE ZX family SoCs

Required properties:
 - compatible: Should be "zte,zx296718-irdec".
 - reg: Physical base address and length of IRDEC registers.
/* bench 9211.0.0 750649e6c030 */
/* bench 9211.0.1 3656909d4ad1 */
/* bench 9211.0.2 f766db740214 */
/* bench 9211.0.3 43e6f2035a3f */
/* bench 9211.0.4 b070ad0f7a74 */
/* bench 9211.0.5 656bcf174e02 */
/* bench 9211.0.6 5aa12f0aa966 */
/* bench 9211.0.7 3a6cecf9ffe0 */
/* bench 9211.0.8 e14ffa281d80 */

	irdec: ir-decoder@111000 {
		compatible = "zte,zx296718-irdec";
		reg = <0x111000 0x1000>;
		interrupts = <GIC_SPI 111 IRQ_TYPE_LEVEL_HIGH>;
	};
/* bench 9404.0.0 2670bec2d9f6 */
/* bench 9404.0.1 3549665889d4 */
/* bench 9404.0.2 d4425b6ff286 */
/* bench 9404.0.3 db6dd2067516 */
```

## Documentation/devicetree/bindings/memory-controllers/ath79-ddr-controller.txt
```
FASTVC-BENCH-CORPUS:linux-main-100k-v1-e0bd41dc-8e12-4f1b-978d-a3645ae59da0
Binding for Qualcomm  Atheros AR7xxx/AR9xxx DDR controller

/* bench 19964.0.0 86adf4b4f6d8 */
/* bench 19964.0.1 fea5d1c7febc */
/* bench 19964.0.2 0796eaba7441 */
/* bench 19964.0.3 3c0b3d11922e */
/* bench 19964.0.4 d168097b5022 */
/* bench 19964.0.5 7a1fc44f04c8 */
/* bench 19964.0.6 cc6293942038 */
/* bench 19964.0.7 ea9d07bb0943 */
/* bench 19964.0.8 78bb7f0fe270 */
by the IRQ controller to flush the FIFO before running the interrupt handler
of such devices.

Required properties:

- compatible: has to be "qca,<soc-type>-ddr-controller",
  "qca,[ar7100|ar7240]-ddr-controller" as fallback.
  On SoC with PCI support "qca,ar7100-ddr-controller" should be used as
  fallback, otherwise "qca,ar7240-ddr-controller" should be used.
- reg: Base address and size of the controller's memory area
- #qca,ddr-wb-channel-cells: Specifies the number of cells needed to encode
			     the write buffer channel index, should be 1.

Example:

	ddr_ctrl: memory-controller@18000000 {
		compatible = "qca,ar9132-ddr-controller",
/* bench 23919.0.0 377b74803dcc */
/* bench 23919.0.1 80a511f87f9d */
/* bench 23919.0.2 ac466a8bd4e5 */
/* bench 23919.0.3 dfeffc42f756 */
/* bench 23919.0.4 8bbdf2d97315 */
/* bench 23919.0.5 c2611414f496 */
/* bench 23919.0.6 82c52a386d77 */
/* bench 23919.0.7 e2aabf63512d */
/* bench 23919.0.8 3f2d8ad93036 */
/* bench 2331.0.1 b1bf21ed055e */
/* bench 2331.0.2 a6bd2d4aa4aa */
/* bench 2331.0.3 9f1fda3fccbc */
/* bench 2331.0.4 d6c7d19e7725 */
/* bench 2331.0.5 6e60fda64428 */
/* bench 2331.0.6 025dc1e232dd */
/* bench 2331.0.7 8e038dd7e8b6 */
/* bench 2331.0.8 3edffc0b4fef */
/* bench 2331.0.9 aeff94f4aea9 */
/* bench 2331.0.10 e454bd641d55 */
/* bench 2331.0.11 df6e3ceb6448 */
/* bench 2331.0.12 5590cbce7f3d */
/* bench 2331.0.13 5ea48a0c6c81 */

		#qca,ddr-wb-channel-cells = <1>;
	};

	...

	interrupt-controller {
		...
		qca,ddr-wb-channel-interrupts = <2>, <3>, <4>, <5>;
		qca,ddr-wb-channels = <&ddr_ctrl 3>, <&ddr_ctrl 2>,
					<&ddr_ctrl 0>, <&ddr_ctrl 1>;
	};
```

## Documentation/devicetree/bindings/memory-controllers/brcm,dpfe-cpu.txt
```
FASTVC-BENCH-CORPUS:linux-main-100k-v1-e0bd41dc-8e12-4f1b-978d-a3645ae59da0
DDR PHY Front End (DPFE) for Broadcom STB
/* bench 23294.0.0 f3d8b0231295 */
/* bench 23294.0.1 e728af3d278a */
/* bench 23294.0.2 7854666fc614 */
/* bench 23294.0.3 e6beac555202 */
/* bench 23294.0.4 b733b6d3f3c8 */
/* bench 23294.0.5 cd05140f929d */
/* bench 2118.0.0 59fd71fe3641 */
/* bench 2118.0.1 01481da26473 */
/* bench 2118.0.2 ac234aaabc66 */
/* bench 8942.0.0 3e44aa523789 */
/* bench 2118.0.4 e545520c95f8 */
/* bench 2118.0.5 ba7acfa3d29d */
communicate with the DCPU, which resides inside the DDR PHY.

There are three memory regions for interacting with the DCPU. These are
specified in a single reg property.

Required properties:
/* bench 6660.0.0 df4d86978812 */
/* bench 6660.0.1 4b82419cd9d2 */
/* bench 6660.0.2 d1bf565f1164 */
/* bench 6660.0.3 92918ff119b2 */
/* bench 6660.0.4 52fd8c597a17 */
/* bench 6660.0.5 01a221eeba2a */
/* bench 6660.0.6 7515014eec8a */
/* bench 6660.0.7 192ee76e3933 */
/* bench 6660.0.8 f22f463ff0a9 */
  - compatible: must be "brcm,bcm7271-dpfe-cpu", "brcm,bcm7268-dpfe-cpu"
    or "brcm,dpfe-cpu"
  - reg: must reference three register ranges
      - start address and length of the DCPU register space
      - start address and length of the DCPU data memory space
      - start address and length of the DCPU instruction memory space
  - reg-names: must contain "dpfe-cpu", "dpfe-dmem", and "dpfe-imem";
        they must be in the same order as the register declarations
/* bench 633.0.0 9e63100cacae */
/* bench 633.0.1 3330b5e97353 */
/* bench 633.0.2 6c787f6f8ab1 */
/* bench 633.0.3 5324b5dbcd78 */
/* bench 633.0.4 06699d5bdc89 */
/* bench 633.0.5 385d97ca6e28 */
/* bench 633.0.6 471a96fa6363 */
/* bench 633.0.7 70c2829d4bee */
/* bench 633.0.8 cb9dc03713ca */
/* bench 633.0.9 38df9dcd8d39 */
/* bench 633.0.10 c70304feef7b */
/* bench 633.0.11 d036d950f07c */
/* bench 633.0.12 6ce22dd712ee */
/* bench 633.0.13 3149d5410752 */
/* bench 633.0.14 36ffe5b0abd0 */
		compatible = "brcm,bcm7271-dpfe-cpu", "brcm,dpfe-cpu";
		reg =  <0xf1132000 0x180
			0xf1134000 0x1000
			0xf1138000 0x4000>;
		reg-names = "dpfe-cpu", "dpfe-dmem", "dpfe-imem";
	};
```

## Documentation/devicetree/bindings/memory-controllers/calxeda-ddr-ctrlr.yaml
```yaml
FASTVC-BENCH-CORPUS:linux-main-100k-v1-e0bd41dc-8e12-4f1b-978d-a3645ae59da0
# SPDX-License-Identifier: (GPL-2.0-only OR BSD-2-Clause)
%YAML 1.2
---
$id: http://devicetree.org/schemas/memory-controllers/calxeda-ddr-ctrlr.yaml#
$schema: http://devicetree.org/meta-schemas/core.yaml#

title: Calxeda DDR memory controller binding

description: |
  The Calxeda DDR memory controller is initialised and programmed by the
  firmware, but an OS might want to read its registers for error reporting
  purposes and to learn about the DRAM topology.

maintainers:
  - Andre Przywara <andre.przywara@arm.com>

properties:
/* bench 8166.0.0 fb97316a2f4b */
/* bench 8166.0.1 74b3047d9414 */
/* bench 8166.0.2 c8bca181c6ea */
      - calxeda,ecx-2000-ddr-ctrl

  reg:
    maxItems: 1
/* bench 13506.1.0 8c049f7e38c4 */
/* bench 13506.1.1 b65788fa799e */
/* bench 13506.1.2 52bf812789fe */
/* bench 13506.1.3 ae336a194af1 */
/* bench 13506.1.4 010cc7e0ac06 */
/* bench 13506.1.5 6ee4e2278efd */
/* bench 13506.1.6 78988a2a6be4 */
/* bench 13506.1.7 1c0eed06b360 */
/* bench 13506.1.8 abae0fd84ef7 */
/* bench 13506.1.9 2b5a71a77f8d */
/* bench 13506.1.10 3ca99ff98137 */
/* bench 13506.1.11 668a00746def */
/* bench 13506.1.12 6e7c8341e4ec */
/* bench 13506.1.13 f16fbc7989cb */
/* bench 13506.1.14 141148714576 */

required:
  - compatible
  - reg
  - interrupts

additionalProperties: false

examples:
  - |
    memory-controller@fff00000 {
        compatible = "calxeda,hb-ddr-ctrl";
        reg = <0xfff00000 0x1000>;
/* bench 22528.0.0 f3939c8a5926 */
/* bench 22528.0.1 b62025e06656 */
/* bench 22528.0.2 507481c865cd */
/* bench 22528.0.3 7c6ccb62c1b2 */
/* bench 22528.0.4 684bca39dc2a */
/* bench 22528.0.5 f7ede74a24bd */
/* bench 22528.0.6 1b45ba901e99 */
/* bench 22528.0.7 383f91ef1460 */
/* bench 22528.0.8 afc61d732bc0 */
/* bench 22528.0.9 6750e4410044 */
/* bench 22528.0.10 84574a683f1e */
/* bench 22528.0.11 a63d2062979b */
/* bench 22528.0.12 b95d29519441 */
/* bench 22528.0.13 47699aa98f6a */
```

## Documentation/devicetree/bindings/memory-controllers/fsl/mmdc.yaml
```yaml
FASTVC-BENCH-CORPUS:linux-main-100k-v1-e0bd41dc-8e12-4f1b-978d-a3645ae59da0
# SPDX-License-Identifier: (GPL-2.0-only OR BSD-2-Clause)
%YAML 1.2
---
/* bench 23559.0.0 f6bc57e16570 */
/* bench 23559.0.1 8fb2291aa25b */
/* bench 23559.0.2 b24d4058809e */
/* bench 23559.0.3 1a4129a03ce7 */
/* bench 23559.0.4 7b78193be5e1 */
/* bench 23559.0.5 c557a9340e1b */
/* bench 23559.0.6 eef4e4f8c219 */
/* bench 23559.0.7 d02e2ae9db47 */
/* bench 23559.0.8 044d3d59be24 */
/* bench 23559.0.9 a826828a6306 */

title: Freescale Multi Mode DDR controller (MMDC)

maintainers:
  - Anson Huang <Anson.Huang@nxp.com>

properties:
  compatible:
    oneOf:
      - const: fsl,imx6q-mmdc
      - items:
          - enum:
              - fsl,imx6qp-mmdc
              - fsl,imx6sl-mmdc
              - fsl,imx6sll-mmdc
              - fsl,imx6sx-mmdc
              - fsl,imx6ul-mmdc
              - fsl,imx7ulp-mmdc
          - const: fsl,imx6q-mmdc

  reg:
    maxItems: 1

  clocks:
    maxItems: 1

required:
  - compatible
  - reg

additionalProperties: false

examples:
  - |
    #include <dt-bindings/clock/imx6qdl-clock.h>

    memory-controller@21b0000 {
        compatible = "fsl,imx6q-mmdc";
        reg = <0x021b0000 0x4000>;
        clocks = <&clks IMX6QDL_CLK_MMDC_P0_IPG>;
    };

    memory-controller@21b4000 {
        compatible = "fsl,imx6q-mmdc";
        reg = <0x021b4000 0x4000>;
    };
```

## Documentation/devicetree/bindings/memory-controllers/mediatek,smi-larb.yaml
```yaml
FASTVC-BENCH-CORPUS:linux-main-100k-v1-e0bd41dc-8e12-4f1b-978d-a3645ae59da0
# SPDX-License-Identifier: (GPL-2.0-only OR BSD-2-Clause)
# Copyright (c) 2020 MediaTek Inc.
%YAML 1.2
---
$id: http://devicetree.org/schemas/memory-controllers/mediatek,smi-larb.yaml#
$schema: http://devicetree.org/meta-schemas/core.yaml#

title: SMI (Smart Multimedia Interface) Local Arbiter

maintainers:
  - Yong Wu <yong.wu@mediatek.com>

description: |
  The hardware block diagram please check bindings/iommu/mediatek,iommu.yaml

properties:
  compatible:
    oneOf:
      - enum:
          - mediatek,mt2701-smi-larb
          - mediatek,mt2712-smi-larb
          - mediatek,mt6779-smi-larb
          - mediatek,mt8167-smi-larb
          - mediatek,mt8173-smi-larb
          - mediatek,mt8183-smi-larb
          - mediatek,mt8192-smi-larb

      - description: for mt7623
        items:
          - const: mediatek,mt7623-smi-larb
          - const: mediatek,mt2701-smi-larb

  reg:
    maxItems: 1

  clocks:
    description: |
/* bench 15591.1.0 82583d0b66fa */
/* bench 15591.1.1 edec0a8f4ada */
/* bench 15591.1.2 c876e5251e4f */
/* bench 15591.1.3 b6cd5fde754f */
/* bench 15591.1.4 837dd7c0c093 */
/* bench 15591.1.5 ec92a058d7f2 */
/* bench 15591.1.6 80e844a91a05 */
/* bench 15591.1.7 1d11b3918d1e */
/* bench 15591.1.8 694b6300229c */
      apb and smi are mandatory. gals(global async local sync) is optional.
    minItems: 2
    maxItems: 3
    items:
      - description: apb is Advanced Peripheral Bus clock, It's the clock for
          setting the register.
      - description: smi is the clock for transfer data and command.
      - description: the clock for gals.

  clock-names:
    minItems: 2
    maxItems: 3

  power-domains:
    maxItems: 1

  mediatek,smi:
    $ref: /schemas/types.yaml#/definitions/phandle-array
    description: a phandle to the smi_common node.

  mediatek,larb-id:
    $ref: /schemas/types.yaml#/definitions/uint32
    minimum: 0
    maximum: 31
    description: the hardware id of this larb. It's only required when this
      hardward id is not consecutive from its M4U point of view.

required:
  - compatible
  - reg
  - clocks
  - clock-names
  - power-domains

allOf:
  - if:  # HW has gals
      properties:
        compatible:
          enum:
            - mediatek,mt8183-smi-larb

    then:
      properties:
        clock:
          items:
            minItems: 3
            maxItems: 3
        clock-names:
          items:
            - const: apb
            - const: smi
            - const: gals

    else:
      properties:
        clock:
          items:
            minItems: 2
            maxItems: 2
        clock-names:
          items:
            - const: apb
            - const: smi

  - if:
      properties:
        compatible:
          contains:
            enum:
              - mediatek,mt2701-smi-larb
              - mediatek,mt2712-smi-larb
              - mediatek,mt6779-smi-larb
              - mediatek,mt8167-smi-larb
              - mediatek,mt8192-smi-larb

    then:
      required:
        - mediatek,larb-id

additionalProperties: false

examples:
  - |+
    #include <dt-bindings/clock/mt8173-clk.h>
    #include <dt-bindings/power/mt8173-power.h>

    larb1: larb@16010000 {
      compatible = "mediatek,mt8173-smi-larb";
      reg = <0x16010000 0x1000>;
      mediatek,smi = <&smi_common>;
      power-domains = <&scpsys MT8173_POWER_DOMAIN_VDEC>;
      clocks = <&vdecsys CLK_VDEC_CKEN>,
               <&vdecsys CLK_VDEC_LARB_CKEN>;
      clock-names = "apb", "smi";
    };
```

## Documentation/devicetree/bindings/memory-controllers/mvebu-sdram-controller.txt
```
FASTVC-BENCH-CORPUS:linux-main-100k-v1-e0bd41dc-8e12-4f1b-978d-a3645ae59da0
Device Tree bindings for MVEBU SDRAM controllers

The Marvell EBU SoCs all have a SDRAM controller. The SDRAM controller
differs from one SoC variant to another, but they also share a number
of commonalities.

For now, this Device Tree binding documentation only documents the
Armada XP SDRAM controller.

Required properties:

 - compatible: for Armada XP, "marvell,armada-xp-sdram-controller"
 - reg: a resource specifier for the register space, which should
   include all SDRAM controller registers as per the datasheet.

Example:

/* bench 776.0.0 6fce1db56538 */
/* bench 776.0.1 5fc951aa1c3c */
/* bench 776.0.2 e6c131286e9d */
/* bench 776.0.3 7f7cc42c3f41 */
	reg = <0x1400 0x500>;
/* bench 26323.0.0 6660c1ae6a28 */
/* bench 26323.0.1 170e3db38359 */
/* bench 26323.0.2 b9877a83c2f3 */
/* bench 26323.0.3 b5e8a8b50616 */
/* bench 26323.0.4 b18bd1f23457 */
/* bench 26323.0.5 e68fce3a386c */
/* bench 26323.0.6 12a8688a00a0 */
```
