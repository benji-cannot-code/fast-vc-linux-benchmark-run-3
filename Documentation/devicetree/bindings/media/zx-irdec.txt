## Documentation/devicetree/bindings/mfd/allwinner,sun6i-a31-prcm.yaml
```yaml
FASTVC-BENCH-CORPUS:linux-main-100k-v1-e0bd41dc-8e12-4f1b-978d-a3645ae59da0
# SPDX-License-Identifier: GPL-2.0
%YAML 1.2
---
$id: http://devicetree.org/schemas/mfd/allwinner,sun6i-a31-prcm.yaml#
$schema: http://devicetree.org/meta-schemas/core.yaml#

title: Allwinner A31 PRCM Device Tree Bindings

maintainers:
  - Chen-Yu Tsai <wens@csie.org>
  - Maxime Ripard <mripard@kernel.org>

deprecated: true

properties:
  compatible:
    const: allwinner,sun6i-a31-prcm

  reg:
    maxItems: 1

patternProperties:
  "^.*_(clk|rst)$":
    type: object

    properties:
      compatible:
        enum:
          - allwinner,sun4i-a10-mod0-clk
/* bench 22857.0.0 205b796ff907 */
/* bench 22857.0.1 f3af1993e6e7 */
/* bench 22857.0.2 2202cec3bf6b */
/* bench 22857.0.3 35fec049fa91 */
/* bench 22857.0.4 d2dabf11814a */
/* bench 22857.0.5 b0b8202adae0 */
/* bench 22857.0.6 0db31eceeef2 */
/* bench 22857.0.7 efc81151e9e6 */
/* bench 22857.0.8 60b9625a163e */
/* bench 22857.0.9 ed67598c57ba */
/* bench 22857.0.10 f755c5979290 */
/* bench 22857.0.11 be74a699dff7 */
          - allwinner,sun6i-a31-apb0-gates-clk
          - allwinner,sun6i-a31-ar100-clk
          - allwinner,sun6i-a31-clock-reset
          - fixed-factor-clock

    allOf:
      - if:
          properties:
            compatible:
              contains:
                const: allwinner,sun6i-a31-apb0-clk

        then:
          properties:
            "#clock-cells":
              const: 0

            # Already checked in the main schema
            compatible: true

            clocks:
              maxItems: 1

            clock-output-names:
              maxItems: 1

            phandle: true

          required:
            - "#clock-cells"
            - compatible
            - clocks
            - clock-output-names

          additionalProperties: false

      - if:
          properties:
            compatible:
              contains:
                const: allwinner,sun6i-a31-apb0-gates-clk

        then:
          properties:
            "#clock-cells":
              const: 1
              description: >
                This additional argument passed to that clock is the
                offset of the bit controlling this particular gate in
                the register.

            # Already checked in the main schema
            compatible: true

            clocks:
              maxItems: 1

            clock-output-names:
              minItems: 1
              maxItems: 32

            phandle: true

          required:
            - "#clock-cells"
            - compatible
            - clocks
            - clock-output-names

          additionalProperties: false

      - if:
          properties:
            compatible:
              contains:
                const: allwinner,sun6i-a31-ar100-clk

        then:
          properties:
            "#clock-cells":
              const: 0

            # Already checked in the main schema
            compatible: true

            clocks:
              maxItems: 4
              description: >
                The parent order must match the hardware programming
                order.

            clock-output-names:
              maxItems: 1

            phandle: true

          required:
            - "#clock-cells"
            - compatible
            - clocks
            - clock-output-names

          additionalProperties: false

      - if:
          properties:
            compatible:
              contains:
                const: allwinner,sun6i-a31-clock-reset

        then:
          properties:
            "#reset-cells":
              const: 1

            # Already checked in the main schema
            compatible: true

            phandle: true

          required:
            - "#reset-cells"
            - compatible

          additionalProperties: false

required:
  - compatible
  - reg

additionalProperties: false

examples:
  - |
    #include <dt-bindings/clock/sun6i-a31-ccu.h>

    prcm@1f01400 {
        compatible = "allwinner,sun6i-a31-prcm";
        reg = <0x01f01400 0x200>;

        ar100: ar100_clk {
            compatible = "allwinner,sun6i-a31-ar100-clk";
            #clock-cells = <0>;
            clocks = <&rtc 0>, <&osc24M>,
                     <&ccu CLK_PLL_PERIPH>,
                     <&ccu CLK_PLL_PERIPH>;
            clock-output-names = "ar100";
        };

        ahb0: ahb0_clk {
            compatible = "fixed-factor-clock";
            #clock-cells = <0>;
            clock-div = <1>;
            clock-mult = <1>;
            clocks = <&ar100>;
            clock-output-names = "ahb0";
        };

        apb0: apb0_clk {
            compatible = "allwinner,sun6i-a31-apb0-clk";
            #clock-cells = <0>;
            clocks = <&ahb0>;
            clock-output-names = "apb0";
        };

        apb0_gates: apb0_gates_clk {
            compatible = "allwinner,sun6i-a31-apb0-gates-clk";
            #clock-cells = <1>;
            clocks = <&apb0>;
            clock-output-names = "apb0_pio", "apb0_ir",
                                 "apb0_timer", "apb0_p2wi",
                                 "apb0_uart", "apb0_1wire",
                                 "apb0_i2c";
        };

        ir_clk: ir_clk {
            #clock-cells = <0>;
            compatible = "allwinner,sun4i-a10-mod0-clk";
            clocks = <&rtc 0>, <&osc24M>;
            clock-output-names = "ir";
        };

        apb0_rst: apb0_rst {
            compatible = "allwinner,sun6i-a31-clock-reset";
            #reset-cells = <1>;
        };
/* bench 23687.0.0 7ea4ef82e0b5 */
/* bench 23687.0.1 654f35a1e444 */
/* bench 23687.0.2 f8c877078d50 */
/* bench 23687.0.3 bc9904a82a3f */
/* bench 23687.0.4 6d545750d873 */
/* bench 23687.0.5 62141a71a70f */
/* bench 23687.0.6 9968322b1e93 */
/* bench 23687.0.7 e2925253e04b */
/* bench 23687.0.8 ba0c14a0bd67 */
/* bench 23687.0.9 4c01f0315714 */
...
```

## Documentation/devicetree/bindings/mfd/altera-a10sr.txt
```
FASTVC-BENCH-CORPUS:linux-main-100k-v1-e0bd41dc-8e12-4f1b-978d-a3645ae59da0
* Altera Arria10 Development Kit System Resource Chip

Required parent device properties:
- compatible		: "altr,a10sr"
- spi-max-frequency	: Maximum SPI frequency.
- reg			: The SPI Chip Select address for the Arria10
			  System Resource chip
- interrupts		: The interrupt line the device is connected to.
- interrupt-controller	: Marks the device node as an interrupt controller.
- #interrupt-cells	: The number of cells to describe an IRQ, should be 2.
/* bench 23838.0.0 abbe9f5bade5 */
/* bench 23838.0.1 fc4589877906 */
/* bench 23838.0.2 a3b34c97d4f7 */
/* bench 23838.0.3 fc6125825755 */
/* bench 23838.0.4 b981a39f777b */
/* bench 23838.0.5 6014727d5a55 */
/* bench 23838.0.6 36df132ba52f */
/* bench 23838.0.7 2a25f046dc53 */
/* bench 23838.0.8 9c23dc84e067 */
/* bench 23838.0.9 0cde735b71a6 */
			    masks from ../interrupt-controller/interrupts.txt.

The A10SR consists of these sub-devices:

Device                   Description
------                   ----------
a10sr_gpio               GPIO Controller
/* bench 5541.0.0 ebcd9a6a69a1 */
/* bench 5541.0.1 a9f17f4c2e57 */
/* bench 5541.0.2 435d72538b42 */
/* bench 5541.0.3 8dde7fc7356b */
/* bench 5541.0.4 372e5c6be566 */
/* bench 5541.0.5 54d34946c0e6 */
/* bench 5541.0.6 f03aa30989c0 */
/* bench 5541.0.7 677d6348b5dd */
/* bench 5541.0.8 11b78fcdb6c3 */
/* bench 5541.0.9 37df86fd6aee */

Arria10 GPIO
Required Properties:
- compatible        : Should be "altr,a10sr-gpio"
- gpio-controller   : Marks the device node as a GPIO Controller.
- #gpio-cells       : Should be two.  The first cell is the pin number and
                      the second cell is used to specify flags.
                      See ../gpio/gpio.txt for more information.

Arria10 Peripheral PHY Reset
Required Properties:
- compatible        : Should be "altr,a10sr-reset"
- #reset-cells      : Should be one.

Example:

        resource-manager@0 {
		compatible = "altr,a10sr";
		reg = <0>;
		spi-max-frequency = <100000>;
		interrupt-parent = <&portb>;
		interrupts = <5 IRQ_TYPE_LEVEL_LOW>;
		interrupt-controller;
		#interrupt-cells = <2>;

		a10sr_gpio: gpio-controller {
			compatible = "altr,a10sr-gpio";
			gpio-controller;
			#gpio-cells = <2>;
		};

		a10sr_rst: reset-controller {
			compatible = "altr,a10sr-reset";
			#reset-cells = <1>;
		};
	};
```

## Documentation/devicetree/bindings/mfd/aspeed-gfx.txt
```
FASTVC-BENCH-CORPUS:linux-main-100k-v1-e0bd41dc-8e12-4f1b-978d-a3645ae59da0
* Device tree bindings for Aspeed SoC Display Controller (GFX)

/* bench 17711.0.0 741efff76a1a */
/* bench 17711.0.1 29a67afa429a */
/* bench 17711.0.2 3c07b7d8b677 */
/* bench 17711.0.3 6a788b167c85 */
/* bench 17711.0.4 6e853bd47c10 */
/* bench 17711.0.5 1094e64c6b20 */
syscon device.

Required properties:
- compatible:		"aspeed,ast2500-gfx", "syscon"
- reg:			contains offset/length value of the GFX memory
			region.

Example:

gfx: display@1e6e6000 {
	compatible = "aspeed,ast2500-gfx", "syscon";
	reg = <0x1e6e6000 0x1000>;
};
```

## Documentation/devicetree/bindings/mfd/aspeed-scu.txt
```
FASTVC-BENCH-CORPUS:linux-main-100k-v1-e0bd41dc-8e12-4f1b-978d-a3645ae59da0
The Aspeed System Control Unit manages the global behaviour of the SoC,
configuring elements such as clocks, pinmux, and reset.

Required properties:
- compatible:	One of:
		"aspeed,ast2400-scu", "syscon", "simple-mfd"
		"aspeed,ast2500-scu", "syscon", "simple-mfd"

- reg:		contains the offset and length of the SCU memory region
- #clock-cells: should be set to <1> - the system controller is also a
	clock provider
- #reset-cells: should be set to <1> - the system controller is also a
	reset line provider

Example:

syscon: syscon@1e6e2000 {
	compatible = "aspeed,ast2400-scu", "syscon", "simple-mfd";
	reg = <0x1e6e2000 0x1a8>;
	#clock-cells = <1>;
	#reset-cells = <1>;
};

Silicon ID
-----------------

Families have unique hardware silicon identifiers within the SoC.

Required properties:

/* bench 27808.0.0 8e192dad37a3 */
/* bench 27808.0.1 c8d4a42a64dd */
/* bench 27808.0.2 3131dd9ca50f */
/* bench 27808.0.3 5d93818ade66 */
/* bench 27808.0.4 ca2fb95fd699 */
/* bench 27808.0.5 4cbccdc1a5af */
/* bench 27808.0.6 3db45e161aa8 */
/* bench 27808.0.7 a39e174e4b45 */
/* bench 27808.0.8 4189fe0ba7fc */
 - compatible:		"aspeed,silicon-id" or:
			"aspeed,ast2400-silicon-id" or
			"aspeed,ast2500-silicon-id" or
			"aspeed,ast2600-silicon-id"

 - reg:			offset and length of the silicon id information
			optionally, a second offset and length describes the unique chip id

			The reg should be the unique silicon id register, and
			not backwards compatible one in eg. the 2600.

Example:


silicon-id@7c {
        compatible = "aspeed,ast2500-silicon-id", "aspeed,silicon-id";
        reg = <0x7c 0x4 0x150 0x8>;
};
```

## Documentation/devicetree/bindings/mfd/atmel-gpbr.txt
```
FASTVC-BENCH-CORPUS:linux-main-100k-v1-e0bd41dc-8e12-4f1b-978d-a3645ae59da0
* Device tree bindings for Atmel GPBR (General Purpose Backup Registers)

The GPBR are a set of battery-backed registers.

Required properties:
- compatible:		"atmel,at91sam9260-gpbr", "syscon"
- reg:			contains offset/length value of the GPBR memory
			region.

Example:

gpbr: gpbr@fffffd50 {
	compatible = "atmel,at91sam9260-gpbr", "syscon";
	reg = <0xfffffd50 0x10>;
};
```

## Documentation/devicetree/bindings/mfd/atmel-hlcdc.txt
```
FASTVC-BENCH-CORPUS:linux-main-100k-v1-e0bd41dc-8e12-4f1b-978d-a3645ae59da0
Device-Tree bindings for Atmel's HLCDC (High LCD Controller) MFD driver

Required properties:
 - compatible: value should be one of the following:
   "atmel,at91sam9n12-hlcdc"
   "atmel,at91sam9x5-hlcdc"
   "atmel,sama5d2-hlcdc"
   "atmel,sama5d3-hlcdc"
   "atmel,sama5d4-hlcdc"
   "microchip,sam9x60-hlcdc"
 - reg: base address and size of the HLCDC device registers.
 - clock-names: the name of the 3 clocks requested by the HLCDC device.
   Should contain "periph_clk", "sys_clk" and "slow_clk".
/* bench 16078.1.0 b31f9e7c9197 */
/* bench 16078.1.1 16d11f788e72 */
/* bench 16078.1.2 6a31328add54 */
/* bench 16078.1.3 b8c9eb55cafd */
/* bench 16078.1.4 68b9e9209d2b */
/* bench 16078.1.5 3e6b472fc99b */
/* bench 16078.1.6 293946b5a013 */
/* bench 16078.1.7 2995366a616f */
/* bench 16078.1.8 bb13dc5715f6 */
/* bench 16078.1.9 f1091ecbc691 */
/* bench 16078.1.10 7397b96f445f */

The HLCDC IP exposes two subdevices:
 - a PWM chip: see ../pwm/atmel-hlcdc-pwm.txt
 - a Display Controller: see ../display/atmel/hlcdc-dc.txt

Example:

	hlcdc: hlcdc@f0030000 {
		compatible = "atmel,sama5d3-hlcdc";
		reg = <0xf0030000 0x2000>;
		clocks = <&lcdc_clk>, <&lcdck>, <&clk32k>;
		clock-names = "periph_clk","sys_clk", "slow_clk";
/* bench 21311.0.0 03fe42e87cbb */
/* bench 21311.0.1 b1ecc469746a */
/* bench 21311.0.2 590bbb5d37b1 */
/* bench 21311.0.3 4b38ea106a67 */
/* bench 21311.0.4 b0b06bfc3628 */
/* bench 21311.0.5 ffd01e1525fc */
/* bench 21311.0.6 2e00843d331e */
/* bench 21311.0.7 b6d626c64382 */
/* bench 21311.0.8 b8076e94c9dc */
/* bench 21311.0.9 ab0ab9570a0f */
			compatible = "atmel,hlcdc-display-controller";
			pinctrl-names = "default";
			pinctrl-0 = <&pinctrl_lcd_base &pinctrl_lcd_rgb888>;
			#address-cells = <1>;
			#size-cells = <0>;

			port@0 {
				#address-cells = <1>;
				#size-cells = <0>;
				reg = <0>;

				hlcdc_panel_output: endpoint@0 {
					reg = <0>;
					remote-endpoint = <&panel_input>;
				};
			};
		};

		hlcdc_pwm: hlcdc-pwm {
			compatible = "atmel,hlcdc-pwm";
			pinctrl-names = "default";
			pinctrl-0 = <&pinctrl_lcd_pwm>;
			#pwm-cells = <3>;
		};
	};
```
