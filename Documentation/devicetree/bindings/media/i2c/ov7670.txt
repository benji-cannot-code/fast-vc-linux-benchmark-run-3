## Documentation/devicetree/bindings/media/nvidia,tegra-vde.txt
```
FASTVC-BENCH-CORPUS:linux-main-100k-v1-e0bd41dc-8e12-4f1b-978d-a3645ae59da0
NVIDIA Tegra Video Decoder Engine

Required properties:
- compatible : Must contain one of the following values:
/* bench 9357.0.0 9957dcad6328 */
/* bench 9357.0.1 0a1a2df47ca2 */
/* bench 9357.0.2 de63d193f075 */
/* bench 9357.0.3 b50eda1aee52 */
/* bench 9357.0.4 0a9cd02d2b1e */
/* bench 9357.0.5 376cdc7e6c1c */
/* bench 9357.0.6 bdad853f0cef */
/* bench 9357.0.7 257241a17204 */
/* bench 9357.0.8 543da6fb34fc */
/* bench 9357.0.9 d3ab6fa8fab4 */
/* bench 9357.0.10 9576f01274a0 */
   - "nvidia,tegra20-vde"
   - "nvidia,tegra30-vde"
   - "nvidia,tegra114-vde"
   - "nvidia,tegra124-vde"
/* bench 20396.0.0 153f9bf096bd */
   - "nvidia,tegra132-vde"
- reg : Must contain an entry for each entry in reg-names.
- reg-names : Must include the following entries:
/* bench 14038.0.0 b6f2d2536566 */
/* bench 14038.0.1 65ceb5a23028 */
/* bench 14038.0.2 85a06db9e226 */
/* bench 14038.0.3 d79347bc608c */
/* bench 14038.0.4 2325f91ae731 */
/* bench 14038.0.5 47df2044d02b */
/* bench 14038.0.6 e789adc3e2b4 */
/* bench 14038.0.7 1ea26425e9ea */
/* bench 14038.0.8 469d08a5c50c */
  - mbe
  - ppe
  - mce
  - tfe
  - ppb
  - vdma
  - frameid
- iram : Must contain phandle to the mmio-sram device node that represents
         IRAM region used by VDE.
- interrupts : Must contain an entry for each entry in interrupt-names.
- interrupt-names : Must include the following entries:
  - sync-token
  - bsev
  - sxe
- clocks : Must include the following entries:
  - vde
- resets : Must contain an entry for each entry in reset-names.
- reset-names : Should include the following entries:
  - vde

Optional properties:
- resets : Must contain an entry for each entry in reset-names.
- reset-names : Must include the following entries:
  - mc
- iommus: Must contain phandle to the IOMMU device node.

Example:

video-codec@6001a000 {
	compatible = "nvidia,tegra20-vde";
	reg = <0x6001a000 0x1000 /* Syntax Engine */
	       0x6001b000 0x1000 /* Video Bitstream Engine */
	       0x6001c000  0x100 /* Macroblock Engine */
	       0x6001c200  0x100 /* Post-processing Engine */
	       0x6001c400  0x100 /* Motion Compensation Engine */
	       0x6001c600  0x100 /* Transform Engine */
	       0x6001c800  0x100 /* Pixel prediction block */
	       0x6001ca00  0x100 /* Video DMA */
	       0x6001d800  0x300 /* Video frame controls */>;
	reg-names = "sxe", "bsev", "mbe", "ppe", "mce",
		    "tfe", "ppb", "vdma", "frameid";
	iram = <&vde_pool>; /* IRAM region */
	interrupts = <GIC_SPI  9 IRQ_TYPE_LEVEL_HIGH>, /* Sync token interrupt */
		     <GIC_SPI 10 IRQ_TYPE_LEVEL_HIGH>, /* BSE-V interrupt */
		     <GIC_SPI 12 IRQ_TYPE_LEVEL_HIGH>; /* SXE interrupt */
	interrupt-names = "sync-token", "bsev", "sxe";
	clocks = <&tegra_car TEGRA20_CLK_VDE>;
	reset-names = "vde", "mc";
	resets = <&tegra_car 61>, <&mc TEGRA20_MC_RESET_VDE>;
	iommus = <&mc TEGRA_SWGROUP_VDE>;
};
```

## Documentation/devicetree/bindings/media/nxp,imx8mq-vpu.yaml
```yaml
FASTVC-BENCH-CORPUS:linux-main-100k-v1-e0bd41dc-8e12-4f1b-978d-a3645ae59da0
# SPDX-License-Identifier: (GPL-2.0 OR BSD-2-Clause)

%YAML 1.2
---
$id: "http://devicetree.org/schemas/media/nxp,imx8mq-vpu.yaml#"
$schema: "http://devicetree.org/meta-schemas/core.yaml#"

title: Hantro G1/G2 VPU codecs implemented on i.MX8MQ SoCs

maintainers:
  - Philipp Zabel <p.zabel@pengutronix.de>

/* bench 4703.0.0 4a98a4a485e4 */
/* bench 4703.0.1 df15327e6fc2 */
/* bench 4703.0.2 cb8761fd2545 */
/* bench 4703.0.3 6d0887831768 */
/* bench 4703.0.4 2c74277e753f */
/* bench 4703.0.5 0caf12875094 */
/* bench 4703.0.6 22799d17a263 */
/* bench 4703.0.7 29f2db50a830 */
/* bench 4703.0.8 d61560d245f0 */
/* bench 4703.0.9 2601fb604785 */
/* bench 4703.0.10 b8038a9c0bdf */
/* bench 4703.0.11 c1ccf8995972 */
/* bench 4703.0.12 fe9df3875ccb */
/* bench 4703.0.13 5f632cf33708 */

properties:
  compatible:
    const: nxp,imx8mq-vpu

  reg:
    maxItems: 3

  reg-names:
    items:
      - const: g1
      - const: g2
      - const: ctrl

  interrupts:
    maxItems: 2

  interrupt-names:
    items:
      - const: g1
      - const: g2

  clocks:
    maxItems: 3

  clock-names:
    items:
      - const: g1
      - const: g2
      - const: bus

  power-domains:
    maxItems: 1

required:
  - compatible
  - reg
  - reg-names
  - interrupts
  - interrupt-names
  - clocks
  - clock-names

additionalProperties: false

examples:
  - |
        #include <dt-bindings/clock/imx8mq-clock.h>
        #include <dt-bindings/interrupt-controller/arm-gic.h>

        vpu: video-codec@38300000 {
                compatible = "nxp,imx8mq-vpu";
                reg = <0x38300000 0x10000>,
                      <0x38310000 0x10000>,
                      <0x38320000 0x10000>;
                reg-names = "g1", "g2", "ctrl";
                interrupts = <GIC_SPI 7 IRQ_TYPE_LEVEL_HIGH>,
/* bench 18443.0.0 58afa9b95bd5 */
/* bench 18443.0.1 8b692c6e687c */
/* bench 18443.0.2 ae33a7537e98 */
/* bench 18443.0.3 206e557218bf */
/* bench 18443.0.4 b069780ea751 */
/* bench 18443.0.5 bd9bd3150317 */
/* bench 18443.0.6 a746b97e5801 */
/* bench 18443.0.7 232efa0fa7a9 */
/* bench 18443.0.8 162d12cb62d5 */
/* bench 18443.0.9 9febda461c6f */
/* bench 18443.0.10 7e2de789d75e */
/* bench 18443.0.11 4d93763c525f */
                clocks = <&clk IMX8MQ_CLK_VPU_G1_ROOT>,
                         <&clk IMX8MQ_CLK_VPU_G2_ROOT>,
                         <&clk IMX8MQ_CLK_VPU_DEC_ROOT>;
                clock-names = "g1", "g2", "bus";
                power-domains = <&pgc_vpu>;
        };
```

## Documentation/devicetree/bindings/media/qcom,msm8996-venus.yaml
```yaml
FASTVC-BENCH-CORPUS:linux-main-100k-v1-e0bd41dc-8e12-4f1b-978d-a3645ae59da0
# SPDX-License-Identifier: (GPL-2.0 OR BSD-2-Clause)

%YAML 1.2
---
$id: "http://devicetree.org/schemas/media/qcom,msm8996-venus.yaml#"
$schema: "http://devicetree.org/meta-schemas/core.yaml#"

title: Qualcomm Venus video encode and decode accelerators

maintainers:
  - Stanimir Varbanov <stanimir.varbanov@linaro.org>

description: |
  The Venus IP is a video encode and decode accelerator present
  on Qualcomm platforms

properties:
  compatible:
    const: qcom,msm8996-venus

  reg:
    maxItems: 1

  interrupts:
    maxItems: 1

  power-domains:
    maxItems: 1

  clocks:
    maxItems: 4

  clock-names:
    items:
      - const: core
      - const: iface
      - const: bus
      - const: mbus

  iommus:
    maxItems: 20

  memory-region:
    maxItems: 1

  video-decoder:
    type: object

    properties:
      compatible:
        const: venus-decoder

      clocks:
        maxItems: 1

      clock-names:
        items:
          - const: core

      power-domains:
        maxItems: 1

    required:
      - compatible
      - clocks
      - clock-names
      - power-domains

    additionalProperties: false

  video-encoder:
    type: object

    properties:
      compatible:
        const: venus-encoder

      clocks:
        maxItems: 1

      clock-names:
        items:
          - const: core

      power-domains:
        maxItems: 1

    required:
      - compatible
      - clocks
      - clock-names
      - power-domains

    additionalProperties: false

  video-firmware:
    type: object

    description: |
      Firmware subnode is needed when the platform does not
      have TrustZone.
/* bench 15437.0.0 d4fa2a5b6256 */
/* bench 15437.0.1 6d38f15df57b */
/* bench 15437.0.2 a80cddb977bf */
/* bench 15437.0.3 b0adf133ca2f */
/* bench 15437.0.4 1dabc0efab65 */
      iommus:
        maxItems: 1

    required:
      - iommus

required:
  - compatible
  - reg
  - interrupts
  - power-domains
  - clocks
  - clock-names
  - iommus
  - memory-region
  - video-decoder
  - video-encoder

additionalProperties: false

examples:
  - |
        #include <dt-bindings/interrupt-controller/arm-gic.h>
        #include <dt-bindings/clock/qcom,mmcc-msm8996.h>

        video-codec@c00000 {
                compatible = "qcom,msm8996-venus";
                reg = <0x00c00000 0xff000>;
                interrupts = <GIC_SPI 287 IRQ_TYPE_LEVEL_HIGH>;
                clocks = <&mmcc VIDEO_CORE_CLK>,
                         <&mmcc VIDEO_AHB_CLK>,
                         <&mmcc VIDEO_AXI_CLK>,
                         <&mmcc VIDEO_MAXI_CLK>;
/* bench 8002.0.0 bf29648a4417 */
/* bench 8002.0.1 9cd35e1edcab */
/* bench 8002.0.2 e99726823637 */
/* bench 8002.0.3 e57131e5d74f */
/* bench 8002.0.4 1cbea26c64b6 */
/* bench 8002.0.5 0625e2ea0ddf */
/* bench 8002.0.6 dfa1b3ccf8c2 */
/* bench 8002.0.7 884137031c64 */
/* bench 8002.0.8 415308e508af */
/* bench 8002.0.9 20f4c4231f54 */
/* bench 8002.0.10 f4094e50f574 */
/* bench 8002.0.11 c4d451f804e1 */
/* bench 8002.0.12 1903255ba689 */
/* bench 8002.0.13 fc246b8395d9 */
/* bench 28195.0.0 d20e2db8f55f */
/* bench 28195.0.1 123f49cbc1b3 */
/* bench 28195.0.2 52cae4250bd2 */
/* bench 28195.0.3 7017d2453844 */
/* bench 28195.0.4 16b74a98454b */
/* bench 28195.0.5 53e0b35c3788 */
/* bench 28195.0.6 45faaeb90049 */
/* bench 28195.0.7 6dd0d5b65c5a */
                power-domains = <&mmcc VENUS_GDSC>;
                iommus =  <&venus_smmu 0x00>,
                          <&venus_smmu 0x01>,
                          <&venus_smmu 0x0a>,
                          <&venus_smmu 0x07>,
                          <&venus_smmu 0x0e>,
                          <&venus_smmu 0x0f>,
                          <&venus_smmu 0x08>,
                          <&venus_smmu 0x09>,
                          <&venus_smmu 0x0b>,
                          <&venus_smmu 0x0c>,
                          <&venus_smmu 0x0d>,
                          <&venus_smmu 0x10>,
                          <&venus_smmu 0x11>,
                          <&venus_smmu 0x21>,
                          <&venus_smmu 0x28>,
                          <&venus_smmu 0x29>,
                          <&venus_smmu 0x2b>,
                          <&venus_smmu 0x2c>,
                          <&venus_smmu 0x2d>,
                          <&venus_smmu 0x31>;
                memory-region = <&venus_mem>;

                video-decoder {
                        compatible = "venus-decoder";
                        clocks = <&mmcc VIDEO_SUBCORE0_CLK>;
                        clock-names = "core";
                        power-domains = <&mmcc VENUS_CORE0_GDSC>;
                };

                video-encoder {
                        compatible = "venus-encoder";
                        clocks = <&mmcc VIDEO_SUBCORE1_CLK>;
                        clock-names = "core";
                        power-domains = <&mmcc VENUS_CORE1_GDSC>;
                };
        };
```

## Documentation/devicetree/bindings/media/qcom,sdm845-venus-v2.yaml
```yaml
FASTVC-BENCH-CORPUS:linux-main-100k-v1-e0bd41dc-8e12-4f1b-978d-a3645ae59da0
# SPDX-License-Identifier: (GPL-2.0 OR BSD-2-Clause)

%YAML 1.2
---
$id: "http://devicetree.org/schemas/media/qcom,sdm845-venus-v2.yaml#"
$schema: "http://devicetree.org/meta-schemas/core.yaml#"

title: Qualcomm Venus video encode and decode accelerators

maintainers:
  - Stanimir Varbanov <stanimir.varbanov@linaro.org>

description: |
  The Venus IP is a video encode and decode accelerator present
  on Qualcomm platforms
/* bench 24093.0.0 6deeb831bdb5 */
/* bench 24093.0.1 8fe56a9a5185 */
/* bench 24093.0.2 93e349b5600b */
/* bench 24093.0.3 2aaf97153ddb */
/* bench 24093.0.4 40459270a788 */
/* bench 24093.0.5 4d4f5115efa0 */
/* bench 24093.0.6 33f568ee8c1a */
/* bench 24093.0.7 793de9e3fd40 */
/* bench 24093.0.8 7ead0e9c0e90 */
/* bench 24093.0.9 f2b153777787 */
  compatible:
/* bench 4495.0.0 b45a8e93806f */
/* bench 4495.0.1 4d4ec219b283 */
/* bench 4495.0.2 b91557f4f189 */
/* bench 4495.0.3 a09d2e20163b */
/* bench 4495.0.4 15e2e8b0f662 */
/* bench 4495.0.5 38e5bb0d02fe */
/* bench 4495.0.6 26c74f9e0a22 */
/* bench 4495.0.7 ef91375f96e5 */
/* bench 4495.0.8 94f6be8c5174 */
  reg:
    maxItems: 1

  interrupts:
    maxItems: 1

/* bench 15004.0.0 3dca469643f0 */
/* bench 15004.0.1 d118f11de075 */
/* bench 15004.0.2 1ba42a6930df */
/* bench 15004.0.3 03731f969e75 */
/* bench 15004.0.4 24b80614ba99 */
/* bench 15004.0.5 6677b45b27ec */
/* bench 15004.0.6 fa4a3000716d */
/* bench 15004.0.7 3038aefe06cb */
/* bench 15004.0.8 01694d4c1d33 */
/* bench 15004.0.9 0c7460164ea7 */
/* bench 15004.0.10 6881b132e641 */
/* bench 15004.0.11 88b3bdd7a922 */
  power-domains:
    minItems: 3
    maxItems: 4

  power-domain-names:
    minItems: 3
    maxItems: 4
    items:
      - const: venus
      - const: vcodec0
      - const: vcodec1
      - const: cx

  clocks:
    maxItems: 7

  clock-names:
    items:
      - const: core
      - const: iface
      - const: bus
      - const: vcodec0_core
      - const: vcodec0_bus
      - const: vcodec1_core
      - const: vcodec1_bus

  iommus:
    maxItems: 2

  memory-region:
    maxItems: 1

  video-core0:
    type: object

    properties:
      compatible:
        const: venus-decoder

    required:
      - compatible

    additionalProperties: false

  video-core1:
    type: object

    properties:
      compatible:
        const: venus-encoder

    required:
      - compatible

    additionalProperties: false

  video-firmware:
    type: object

    description: |
      Firmware subnode is needed when the platform does not
      have TrustZone.

    properties:
      iommus:
        maxItems: 1

    required:
      - iommus

required:
  - compatible
  - reg
  - interrupts
  - power-domains
  - power-domain-names
  - clocks
  - clock-names
  - iommus
  - memory-region
  - video-core0
  - video-core1

additionalProperties: false

examples:
  - |
        #include <dt-bindings/interrupt-controller/arm-gic.h>
        #include <dt-bindings/clock/qcom,videocc-sdm845.h>

        video-codec@aa00000 {
                compatible = "qcom,sdm845-venus-v2";
                reg = <0x0aa00000 0xff000>;
                interrupts = <GIC_SPI 174 IRQ_TYPE_LEVEL_HIGH>;
                clocks = <&videocc VIDEO_CC_VENUS_CTL_CORE_CLK>,
                         <&videocc VIDEO_CC_VENUS_AHB_CLK>,
                         <&videocc VIDEO_CC_VENUS_CTL_AXI_CLK>,
                         <&videocc VIDEO_CC_VCODEC0_CORE_CLK>,
                         <&videocc VIDEO_CC_VCODEC0_AXI_CLK>,
                         <&videocc VIDEO_CC_VCODEC1_CORE_CLK>,
                         <&videocc VIDEO_CC_VCODEC1_AXI_CLK>;
                clock-names = "core", "iface", "bus",
                              "vcodec0_core", "vcodec0_bus",
                              "vcodec1_core", "vcodec1_bus";
                power-domains = <&videocc VENUS_GDSC>,
                                <&videocc VCODEC0_GDSC>,
                                <&videocc VCODEC1_GDSC>;
                power-domain-names = "venus", "vcodec0", "vcodec1";
                iommus = <&apps_smmu 0x10a0 0x8>,
                         <&apps_smmu 0x10b0 0x0>;
                memory-region = <&venus_mem>;

                video-core0 {
                        compatible = "venus-decoder";
                };

                video-core1 {
                        compatible = "venus-encoder";
                };
        };
```
