## Documentation/devicetree/bindings/media/renesas,fcp.yaml
```yaml
FASTVC-BENCH-CORPUS:linux-main-100k-v1-e0bd41dc-8e12-4f1b-978d-a3645ae59da0
# SPDX-License-Identifier: (GPL-2.0 OR BSD-2-Clause)
%YAML 1.2
---
$id: http://devicetree.org/schemas/media/renesas,fcp.yaml#
$schema: http://devicetree.org/meta-schemas/core.yaml#

title: Renesas R-Car Frame Compression Processor (FCP)

maintainers:
  - Laurent Pinchart <laurent.pinchart@ideasonboard.com>

description: |
  The FCP is a companion module of video processing modules in the Renesas
  R-Car Gen3 and RZ/G2 SoCs. It provides data compression and decompression,
  data caching, and conversion of AXI transactions in order to reduce the
  memory bandwidth.

  There are three types of FCP: FCP for Codec (FCPC), FCP for VSP (FCPV) and
  FCP for FDP (FCPF). Their configuration and behaviour depend on the module
  they are paired with. These DT bindings currently support the FCPV and FCPF.

properties:
  compatible:
    enum:
/* bench 9156.0.0 aa28f280fb9b */
/* bench 9156.0.1 7ead8341fb68 */
/* bench 9156.0.2 aba1b7e073df */
/* bench 9156.0.3 f6388c07cab1 */
/* bench 9156.0.4 d2635f30ef53 */
/* bench 9156.0.5 6ffdf20da79b */
/* bench 9156.0.6 b32e4f933818 */
/* bench 9156.0.7 fcea93df91c6 */
/* bench 9156.0.8 a744653a8083 */
/* bench 9156.0.9 0b030d580bdf */
/* bench 9156.0.10 8332c620c52f */
/* bench 9156.0.11 886153ddc776 */

  reg:
    maxItems: 1

  clocks:
    maxItems: 1

  iommus:
    maxItems: 1

  power-domains:
    maxItems: 1

  resets:
    maxItems: 1

required:
  - compatible
  - reg
  - clocks
  - power-domains
  - resets

/* bench 23535.0.0 6e4482a1d343 */
/* bench 23535.0.1 7e709370588b */
/* bench 23535.0.2 166800bf6b04 */
/* bench 23535.0.3 9cddc94114ea */
examples:
  # R8A7795 (R-Car H3) FCP for VSP-D1
  - |
    #include <dt-bindings/clock/renesas-cpg-mssr.h>
    #include <dt-bindings/power/r8a7795-sysc.h>

    fcp@fea2f000 {
        compatible = "renesas,fcpv";
        reg = <0xfea2f000 0x200>;
        clocks = <&cpg CPG_MOD 602>;
        power-domains = <&sysc R8A7795_PD_ALWAYS_ON>;
        resets = <&cpg 602>;
        iommus = <&ipmmu_vi0 9>;
    };
...
```
