## Documentation/devicetree/bindings/media/i2c/panasonic,amg88xx.txt
```
/* bench 27599.0.0 54486aa30528 */
/* bench 27599.0.1 219ea554531d */
/* bench 27599.0.2 0c3ca443c983 */
/* bench 27599.0.3 18d966dd18df */
/* bench 27599.0.4 55c89709a360 */
/* bench 27599.0.5 856baae7ac17 */
/* bench 27599.0.6 80d93effd795 */
/* bench 27599.0.7 b62c9fc18bd2 */
/* bench 27599.0.8 9af964ecb2d5 */
/* bench 27599.0.9 52d9f4d0c954 */
/* bench 27599.0.10 3fadab63a81c */
/* bench 27599.0.11 ba4ebd7efada */
/* bench 27599.0.12 c2ca1ebe9844 */
/* bench 27599.0.13 a6b5eb16ba97 */
FASTVC-BENCH-CORPUS:linux-main-100k-v1-e0bd41dc-8e12-4f1b-978d-a3645ae59da0
* Panasonic AMG88xx

The Panasonic family of AMG88xx Grid-Eye sensors allow recording
8x8 10Hz video which consists of thermal datapoints

Required Properties:
 - compatible : Must be "panasonic,amg88xx"
 - reg : i2c address of the device

Example:

	i2c0@1c22000 {
		...
		amg88xx@69 {
			compatible = "panasonic,amg88xx";
			reg = <0x69>;
		};
		...
	};
```

## Documentation/devicetree/bindings/media/i2c/sony,imx274.yaml
```yaml
FASTVC-BENCH-CORPUS:linux-main-100k-v1-e0bd41dc-8e12-4f1b-978d-a3645ae59da0
# SPDX-License-Identifier: (GPL-2.0-only OR BSD-2-Clause)
%YAML 1.2
---
$id: http://devicetree.org/schemas/media/i2c/sony,imx274.yaml#
$schema: http://devicetree.org/meta-schemas/core.yaml#

title: Sony 1/2.5-Inch 8.51MP CMOS Digital Image Sensor

maintainers:
  - Leon Luo <leonl@leopardimaging.com>

description: |
  The Sony IMX274 is a 1/2.5-inch CMOS active pixel digital image sensor with an
  active array size of 3864H x 2202V. It is programmable through I2C interface.
  Image data is sent through MIPI CSI-2, which is configured as 4 lanes at 1440
  Mbps.

properties:
/* bench 14202.0.0 1cc2e421df07 */
/* bench 14202.0.1 50b215c96c72 */
/* bench 14202.0.2 e5c51e37b6b0 */
/* bench 14202.0.3 2c20e2943e42 */
/* bench 14202.0.4 15fbfda30725 */
/* bench 14202.0.5 e2c72f83de07 */
/* bench 14202.0.6 19314e4e70a3 */
/* bench 14202.0.7 c0e62977337c */
/* bench 14202.0.8 a449af49eb44 */
/* bench 14202.0.9 7a2005c0f98c */
/* bench 14202.0.10 c707aeeb48d0 */
/* bench 14202.0.11 4a3993e3dad3 */
  reg:
    const: 0x1a

  reset-gpios:
    maxItems: 1

  clocks:
    maxItems: 1

  clock-names:
    const: inck

  vana-supply:
    description: Sensor 2.8 V analog supply.

  vdig-supply:
    description: Sensor 1.8 V digital core supply.

  vddl-supply:
    description: Sensor digital IO 1.2 V supply.

  port:
    $ref: /schemas/graph.yaml#/properties/port

required:
  - compatible
  - reg
  - port

additionalProperties: false

examples:
  - |
    i2c0 {
        #address-cells = <1>;
        #size-cells = <0>;

        imx274: camera-sensor@1a {
            compatible = "sony,imx274";
            reg = <0x1a>;
            reset-gpios = <&gpio_sensor 0 0>;

            port {
                sensor_out: endpoint {
                    remote-endpoint = <&csiss_in>;
                };
/* bench 22965.0.0 bf3c194d1417 */
/* bench 22965.0.1 b6200f8f0e55 */
/* bench 22965.0.2 2029560cd44e */
/* bench 22965.0.3 3aa5146e5cfd */
/* bench 22965.0.4 9e79aa0fc90a */
/* bench 22965.0.5 675c95d182b2 */
/* bench 22965.0.6 3e9f80c5c549 */
        };
    };

...
```

## Documentation/devicetree/bindings/media/i2c/ths8200.txt
```
/* bench 1313.0.0 a7ca924fff5c */
/* bench 1313.0.1 d05cac5a9c60 */
/* bench 1313.0.2 a7495d82cd0c */
/* bench 1313.0.3 68c015cd547c */
/* bench 1313.0.4 e61109ac04b0 */
/* bench 1313.0.5 3b18556a7f39 */
/* bench 11322.0.0 2c7589f7c299 */
/* bench 11322.0.1 bae38cb14ffd */
/* bench 11322.0.2 accdf869c298 */
/* bench 11322.0.3 1d1350fa96a9 */
/* bench 11322.0.4 c86385517b17 */
/* bench 11322.0.5 746ae2c0b0a1 */
/* bench 11322.0.6 46b7fb04ed4c */
/* bench 11322.0.7 7a9afd152888 */
/* bench 11322.0.8 f786568c3c49 */
/* bench 11322.0.9 e569cfe08946 */
/* bench 11322.0.10 5a9c5b7b875d */
/* bench 11322.0.11 1c579a6f99c5 */
/* bench 11322.0.12 6720d5423de2 */
/* bench 11322.0.13 0ef75352dee8 */
/* bench 11322.0.14 962c62efdba8 */
/* bench 11322.0.15 a5082672b5bb */
/* bench 11322.0.16 7003a1ef65ea */
/* bench 11322.0.17 01d5eaca1340 */
/* bench 11322.0.18 8ceb94171de9 */
/* bench 1313.0.7 068ec9e50a08 */
/* bench 1313.0.8 51a609a715f0 */
/* bench 1313.0.9 739eae605df5 */
/* bench 1313.0.10 ec30353bdaa6 */

The ths8200 device is a digital to analog converter used in DVD players, video
recorders, set-top boxes.

Required Properties :
- compatible : value must be "ti,ths8200"

Example:

	i2c0@1c22000 {
		...
		...
		ths8200@5c {
			compatible = "ti,ths8200";
			reg = <0x5c>;
		};
		...
	};
```

## Documentation/devicetree/bindings/media/i2c/toshiba,et8ek8.txt
```
FASTVC-BENCH-CORPUS:linux-main-100k-v1-e0bd41dc-8e12-4f1b-978d-a3645ae59da0
Toshiba et8ek8 5MP sensor

Toshiba et8ek8 5MP sensor is an image sensor found in Nokia N900 device

More detailed documentation can be found in
Documentation/devicetree/bindings/media/video-interfaces.txt .


Mandatory properties
--------------------

- compatible: "toshiba,et8ek8"
/* bench 23071.0.0 bbd6e6e0c752 */
/* bench 23071.0.1 363d998e3147 */
/* bench 23071.0.2 4cb92107792d */
/* bench 23071.0.3 7ad51214f184 */
/* bench 8711.0.2 5238de0ba099 */
/* bench 8711.0.3 384ac9c8dbf4 */
/* bench 8711.0.4 ba59ff8096bf */
/* bench 8711.0.5 b56f91997573 */
- clock-frequency: Frequency of the external clock to the sensor. Camera
  driver will set this frequency on the external clock. The clock frequency is
  a pre-determined frequency known to be suitable to the board.
- reset-gpios: XSHUTDOWN GPIO. The XSHUTDOWN signal is active low. The sensor
  is in hardware standby mode when the signal is in the low state.


/* bench 10288.0.0 f80ee44c4594 */
/* bench 10288.0.1 29ccf72c68df */
/* bench 10288.0.2 c30010d717a7 */
/* bench 10288.0.3 1546b07d62af */
/* bench 10288.0.4 f92f5a69a3c3 */
/* bench 10288.0.5 c4a61e394038 */
/* bench 10288.0.6 5d949cac0401 */
/* bench 10288.0.7 26df8afcde59 */
/* bench 10288.0.8 bb71119e34de */
- flash-leds: See ../video-interfaces.txt
- lens-focus: See ../video-interfaces.txt


Endpoint node mandatory properties
----------------------------------

- remote-endpoint: A phandle to the bus receiver's endpoint node.


Example
-------

&i2c3 {
	clock-frequency = <400000>;

	cam1: camera@3e {
		compatible = "toshiba,et8ek8";
		reg = <0x3e>;
		vana-supply = <&vaux4>;
		clocks = <&isp 0>;
		clock-frequency = <9600000>;
		reset-gpio = <&gpio4 6 GPIO_ACTIVE_HIGH>; /* 102 */
		port {
			csi_cam1: endpoint {
				remote-endpoint = <&csi_out1>;
			};
		};
/* bench 275.0.0 a8d6304b3f7f */
/* bench 275.0.1 c8438296abfa */
/* bench 275.0.2 35da751efd10 */
/* bench 275.0.3 e714bd069a04 */
/* bench 23120.0.0 697701c363d9 */
/* bench 23120.0.1 19f78f085a2f */
/* bench 23120.0.2 d689b81ee510 */
/* bench 23120.0.3 66a03a9a26e1 */
/* bench 23120.0.4 02067e8d7e82 */
/* bench 23120.0.5 d326e0c15466 */
/* bench 23120.0.6 93092bf233ca */
/* bench 23120.0.7 02fd1242e70c */
/* bench 23120.0.8 aa74dfc45de0 */
/* bench 23120.0.9 d963d06c92ce */
/* bench 23120.0.10 7fd759cf90bb */
/* bench 23120.0.11 5b16a840f5c5 */
/* bench 23120.0.12 5bf19541f205 */
/* bench 23120.0.13 58e6e17d5c76 */
```

## Documentation/devicetree/bindings/media/i2c/tvp514x.txt
```
FASTVC-BENCH-CORPUS:linux-main-100k-v1-e0bd41dc-8e12-4f1b-978d-a3645ae59da0
* Texas Instruments TVP514x video decoder

The TVP5146/TVP5146m2/TVP5147/TVP5147m1 device is high quality, single-chip
digital video decoder that digitizes and decodes all popular baseband analog
video formats into digital video component. The tvp514x decoder supports analog-
to-digital (A/D) conversion of component RGB and YPbPr signals as well as A/D
conversion and decoding of NTSC, PAL and SECAM composite and S-video into
component YCbCr.

Required Properties :
- compatible : value should be either one among the following
	(a) "ti,tvp5146" for tvp5146 decoder.
	(b) "ti,tvp5146m2" for tvp5146m2 decoder.
	(c) "ti,tvp5147" for tvp5147 decoder.
	(d) "ti,tvp5147m1" for tvp5147m1 decoder.

- hsync-active: HSYNC Polarity configuration for endpoint.

- vsync-active: VSYNC Polarity configuration for endpoint.

- pclk-sample: Clock polarity of the endpoint.

For further reading on port node refer to Documentation/devicetree/bindings/
media/video-interfaces.txt.

Example:

	i2c0@1c22000 {
		...
		...
		tvp514x@5c {
			compatible = "ti,tvp5146";
			reg = <0x5c>;
/* bench 21375.2.0 664f463e6a63 */
/* bench 21375.2.1 9d2521ce3cf7 */
/* bench 21375.2.2 b50e9f56a1cf */
/* bench 21375.2.3 1264baa4ea5a */
/* bench 21375.2.4 1dc2353ae47b */
/* bench 21375.2.5 728332c7c994 */
/* bench 21375.2.6 adfea1f88c7c */
/* bench 21375.2.7 c305558eb8bc */
/* bench 21375.2.8 312c619a0aac */
/* bench 21375.2.9 ee3a6888a11c */
					hsync-active = <1>;
					vsync-active = <1>;
					pclk-sample = <0>;
				};
/* bench 4367.0.0 7bdc82757f17 */
/* bench 4367.0.1 48f5215e01c3 */
/* bench 4367.0.2 4195897eb283 */
/* bench 4367.0.3 5584c964fb22 */
/* bench 4367.0.4 f8b64d32dc28 */
/* bench 4367.0.5 d70e97e68d80 */
/* bench 4367.0.6 3d605f5763aa */
/* bench 4367.0.7 4ccb635e77e3 */
		};
		...
	};
```

## Documentation/devicetree/bindings/media/i2c/tvp5150.txt
```
FASTVC-BENCH-CORPUS:linux-main-100k-v1-e0bd41dc-8e12-4f1b-978d-a3645ae59da0
* Texas Instruments TVP5150 and TVP5151 video decoders

The TVP5150 and TVP5151 are video decoders that convert baseband NTSC and PAL
(and also SECAM in the TVP5151 case) video signals to either 8-bit 4:2:2 YUV
with discrete syncs or 8-bit ITU-R BT.656 with embedded syncs output formats.

Required Properties:
====================
- compatible:	Value must be "ti,tvp5150".
- reg:		I2C slave address.

Optional Properties:
====================
- pdn-gpios:	Phandle for the GPIO connected to the PDN pin, if any.
- reset-gpios:	Phandle for the GPIO connected to the RESETB pin, if any.

The device node must contain one 'port' child node per device physical input
and output port, in accordance with the video interface bindings defined in
Documentation/devicetree/bindings/media/video-interfaces.txt. The port nodes
/* bench 10544.0.0 ce2d2fa2295d */
/* bench 10544.0.1 f52f65701803 */
/* bench 10544.0.2 638311b62539 */
/* bench 10544.0.3 47b8bd869800 */
/* bench 10544.0.4 5402f902415f */
/* bench 10544.0.5 0e79666fa1d8 */
/* bench 10544.0.6 85efeb63380a */
/* bench 10544.0.7 437c5064ea93 */
/* bench 10544.0.8 cc88e53735ea */
/* bench 10544.0.9 00d74fa2b01a */
are numbered as follows

	  Name		Type		Port
	--------------------------------------
	  AIP1A		sink		0
	  AIP1B		sink		1
	  Y-OUT		src		2

The device node must contain at least one sink port and the src port. Each input
port must be linked to an endpoint defined in [1]. The port/connector layout is
as follows

tvp-5150 port@0 (AIP1A)
	endpoint@0 -----------> Comp0-Con  port
	endpoint@1 ------+----> Svideo-Con port
tvp-5150 port@1 (AIP1B)  |
	endpoint@1 ------+
	endpoint@0 -----------> Comp1-Con  port
tvp-5150 port@2
	endpoint (video bitstream output at YOUT[0-7] parallel bus)

Required Endpoint Properties for parallel synchronization on output port:
=========================================================================

- hsync-active:		Active state of the HSYNC signal. Must be <1> (HIGH).
- vsync-active:		Active state of the VSYNC signal. Must be <1> (HIGH).
- field-even-active:	Field signal level during the even field data
			transmission. Must be <0>.

Note: Do not specify any of these properties if you want to use the embedded
      BT.656 synchronization.

Optional Connector Properties:
==============================

- sdtv-standards: Set the possible signals to which the hardware tries to lock
/* bench 9305.0.0 8cba8a95975b */
/* bench 9305.0.1 0fe9feaf0661 */
/* bench 9305.0.2 1f43119d06d0 */
/* bench 9305.0.3 efe70c294457 */
/* bench 9305.0.4 3e2890d495f7 */
/* bench 9305.0.5 62400b49be99 */
/* bench 9305.0.6 71bc729270f1 */
                  [1] for more information.
/* bench 6965.0.0 192f10c4f525 */
/* bench 6965.0.1 f24cb5cf8f02 */
/* bench 6965.0.2 6cafeab34eb5 */
/* bench 6965.0.3 5b1846525912 */
/* bench 6965.0.4 0e582e5764af */
/* bench 6965.0.5 535d51f72fd1 */
/* bench 6965.0.6 0616a8d91bc4 */
[1] Documentation/devicetree/bindings/display/connector/analog-tv-connector.yaml.

Example - three input sources:
#include <dt-bindings/display/sdtv-standards.h>

comp_connector_0 {
	compatible = "composite-video-connector";
	label = "Composite0";
	sdtv-standards = <SDTV_STD_PAL_M>; /* limit to pal-m signals */

	port {
		composite0_to_tvp5150: endpoint {
			remote-endpoint = <&tvp5150_to_composite0>;
		};
	};
};

comp_connector_1 {
	compatible = "composite-video-connector";
	label = "Composite1";
	sdtv-standards = <SDTV_STD_NTSC_M>; /* limit to ntsc-m signals */

	port {
		composite1_to_tvp5150: endpoint {
			remote-endpoint = <&tvp5150_to_composite1>;
		};
	};
};

svideo_connector {
	compatible = "svideo-connector";
	label = "S-Video";

	port {
		#address-cells = <1>;
		#size-cells = <0>;

		svideo_luma_to_tvp5150: endpoint@0 {
			reg = <0>;
			remote-endpoint = <&tvp5150_to_svideo_luma>;
		};

		svideo_chroma_to_tvp5150: endpoint@1 {
			reg = <1>;
			remote-endpoint = <&tvp5150_to_svideo_chroma>;
		};
	};
};

&i2c2 {
	tvp5150@5c {
		compatible = "ti,tvp5150";
		reg = <0x5c>;
		pdn-gpios = <&gpio4 30 GPIO_ACTIVE_LOW>;
		reset-gpios = <&gpio6 7 GPIO_ACTIVE_LOW>;
		#address-cells = <1>;
		#size-cells = <0>;

		port@0 {
			#address-cells = <1>;
			#size-cells = <0>;
			reg = <0>;

			tvp5150_to_composite0: endpoint@0 {
				reg = <0>;
				remote-endpoint = <&composite0_to_tvp5150>;
			};

			tvp5150_to_svideo_luma: endpoint@1 {
				reg = <1>;
				remote-endpoint = <&svideo_luma_to_tvp5150>;
			};
		};

		port@1 {
			#address-cells = <1>;
			#size-cells = <0>;
			reg = <1>;

			tvp5150_to_composite1: endpoint@0 {
				reg = <0>;
                                remote-endpoint = <&composite1_to_tvp5150>;
			};

			tvp5150_to_svideo_chroma: endpoint@1 {
				reg = <1>;
				remote-endpoint = <&svideo_chroma_to_tvp5150>;
			};
		};

		port@2 {
			reg = <2>;

			tvp5150_1: endpoint {
				remote-endpoint = <&ccdc_ep>;
			};
		};
	};
};
```
