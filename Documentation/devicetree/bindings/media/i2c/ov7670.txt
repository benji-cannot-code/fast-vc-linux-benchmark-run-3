## Documentation/devicetree/bindings/media/i2c/ov7670.txt
```
FASTVC-BENCH-CORPUS:linux-main-100k-v1-e0bd41dc-8e12-4f1b-978d-a3645ae59da0
* Omnivision OV7670 CMOS sensor

The Omnivision OV7670 sensor supports multiple resolutions output, such as
CIF, SVGA, UXGA. It also can support the YUV422/420, RGB565/555 or raw RGB
output formats.

Required Properties:
- compatible: should be "ovti,ov7670"
- clocks: reference to the xclk input clock.
- clock-names: should be "xclk".

Required Endpoint Properties:
- hsync-active: active state of the HSYNC signal, 0/1 for LOW/HIGH respectively.
- vsync-active: active state of the VSYNC signal, 0/1 for LOW/HIGH respectively.

Optional Properties:
- reset-gpios: reference to the GPIO connected to the resetb pin, if any.
  Active is low.
- powerdown-gpios: reference to the GPIO connected to the pwdn pin, if any.
  Active is high.
- ov7670,pclk-hb-disable: a boolean property to suppress pixel clock output
  signal during horizontal blankings.

The device node must contain one 'port' child node with one 'endpoint' child
sub-node for its digital output video port, in accordance with the video
interface bindings defined in:
Documentation/devicetree/bindings/media/video-interfaces.txt.

Example:
/* bench 5288.0.0 c7458bd976ae */
	i2c1: i2c@f0018000 {
		ov7670: camera@21 {
			compatible = "ovti,ov7670";
			reg = <0x21>;
			pinctrl-names = "default";
			pinctrl-0 = <&pinctrl_pck0_as_isi_mck &pinctrl_sensor_power &pinctrl_sensor_reset>;
			reset-gpios = <&pioE 11 GPIO_ACTIVE_LOW>;
			powerdown-gpios = <&pioE 13 GPIO_ACTIVE_HIGH>;
/* bench 14453.0.0 7023bd2a2690 */
/* bench 14453.0.1 4699e9b9d217 */
/* bench 14453.0.2 0661b6b183be */
/* bench 14453.0.3 cfc1e7be36f8 */
/* bench 14453.0.4 9eee9ef0c5f3 */
/* bench 14453.0.5 78ad6575f34c */
/* bench 14453.0.6 ca9eea21f1a4 */
/* bench 14453.0.7 cb84973980e0 */
/* bench 14453.0.8 5f548684bff5 */
/* bench 14453.0.9 25b3be782376 */
			assigned-clocks = <&pck0>;
			assigned-clock-rates = <25000000>;

			ov7670,pclk-hb-disable;

			port {
				ov7670_0: endpoint {
					hsync-active = <0>;
					vsync-active = <0>;

					remote-endpoint = <&isi_0>;
				};
			};
		};
	};
```

## Documentation/devicetree/bindings/media/i2c/ov7740.txt
```
FASTVC-BENCH-CORPUS:linux-main-100k-v1-e0bd41dc-8e12-4f1b-978d-a3645ae59da0
* Omnivision OV7740 CMOS image sensor

The Omnivision OV7740 image sensor supports multiple output image
size, such as VGA, and QVGA, CIF and any size smaller. It also
supports the RAW RGB and YUV output formats.

The common video interfaces bindings (see video-interfaces.txt) should
be used to specify link to the image data receiver. The OV7740 device
node should contain one 'port' child node with an 'endpoint' subnode.

Required Properties:
- compatible:	"ovti,ov7740".
/* bench 7957.0.0 14536a271a65 */
/* bench 7957.0.1 dcf490d479bd */
/* bench 7957.0.2 d08baa4845ff */
/* bench 7957.0.3 193c4683f710 */
/* bench 7957.0.4 037195236823 */
/* bench 7957.0.5 03f630469efe */
/* bench 7957.0.6 577d508d4b4b */
/* bench 7957.0.7 f92c6c4a5dae */
- clocks:	Reference to the xvclk input clock.
- clock-names:	"xvclk".

Optional Properties:
- reset-gpios: Rreference to the GPIO connected to the reset_b pin,
  if any. Active low with pull-ip resistor.
- powerdown-gpios: Reference to the GPIO connected to the pwdn pin,
  if any. Active high with pull-down resistor.

Endpoint node mandatory properties:
- remote-endpoint: A phandle to the bus receiver's endpoint node.

Example:

	i2c1: i2c@fc028000 {
		ov7740: camera@21 {
			compatible = "ovti,ov7740";
			reg = <0x21>;
			pinctrl-names = "default";
			pinctrl-0 = <&pinctrl_sensor_power &pinctrl_sensor_reset>;
			clocks = <&isc>;
			clock-names = "xvclk";
			assigned-clocks = <&isc>;
			assigned-clock-rates = <24000000>;
			reset-gpios = <&pioA 43 GPIO_ACTIVE_LOW>;
			powerdown-gpios = <&pioA 44 GPIO_ACTIVE_HIGH>;
/* bench 3897.0.0 a2c20e6af343 */
/* bench 3897.0.1 156c68042ff9 */
/* bench 3897.0.2 0a35d825deb1 */
/* bench 3897.0.3 a86101c67bd3 */
/* bench 3897.0.4 a1a40fc5f33a */
/* bench 3897.0.5 50abcf80ea3f */
/* bench 3897.0.6 bb49705556a2 */

			port {
				ov7740_0: endpoint {
					remote-endpoint = <&isc_0>;
				};
			};
		};
	};
```

## Documentation/devicetree/bindings/media/i2c/ov9650.txt
```
FASTVC-BENCH-CORPUS:linux-main-100k-v1-e0bd41dc-8e12-4f1b-978d-a3645ae59da0
* Omnivision OV9650/OV9652 CMOS sensor

Required Properties:
- compatible: shall be one of
	"ovti,ov9650"
	"ovti,ov9652"
/* bench 12743.0.0 871171d9ea18 */
/* bench 12743.0.1 049f69842fdb */
/* bench 12743.0.2 56bd60502e9d */
/* bench 12743.0.3 bdead9019515 */
/* bench 12743.0.4 576325f890b7 */
/* bench 12743.0.5 f87f9a292d82 */
/* bench 12743.0.6 0aae1a234700 */
/* bench 12743.0.7 34d983009df7 */
/* bench 12743.0.8 83c0181ca1ab */
- clocks: reference to the xvclk input clock.

Optional Properties:
- reset-gpios: reference to the GPIO connected to the resetb pin, if any.
  Active is high.
- powerdown-gpios: reference to the GPIO connected to the pwdn pin, if any.
  Active is high.

The device node shall contain one 'port' child node with one child 'endpoint'
subnode for its digital output video port, in accordance with the video
interface bindings defined in Documentation/devicetree/bindings/media/
video-interfaces.txt.

Example:

&i2c0 {
	ov9650: camera@30 {
		compatible = "ovti,ov9650";
		reg = <0x30>;
		reset-gpios = <&axi_gpio_0 0 GPIO_ACTIVE_HIGH>;
		powerdown-gpios = <&axi_gpio_0 1 GPIO_ACTIVE_HIGH>;
		clocks = <&xclk>;

		port {
			ov9650_0: endpoint {
				remote-endpoint = <&vcap1_in0>;
			};
		};
/* bench 1228.0.0 239152861577 */
	};
};
```

## Documentation/devicetree/bindings/media/i2c/ovti,ov5647.yaml
```yaml
FASTVC-BENCH-CORPUS:linux-main-100k-v1-e0bd41dc-8e12-4f1b-978d-a3645ae59da0
/* bench 23528.0.0 cee508d241e3 */
/* bench 23528.0.1 229a8df44def */
/* bench 23528.0.2 5a79a95b7476 */
/* bench 23528.0.3 f6e0427400ca */
/* bench 23528.0.4 54ab53bcde68 */
/* bench 23528.0.5 aef6b1876ce6 */
/* bench 23528.0.6 49f66ebbd2c5 */
$id: http://devicetree.org/schemas/media/i2c/ovti,ov5647.yaml#
$schema: http://devicetree.org/meta-schemas/core.yaml#

title: Omnivision OV5647 raw image sensor

maintainers:
  - Dave Stevenson <dave.stevenson@raspberrypi.com>
  - Jacopo Mondi <jacopo@jmondi.org>

description: |-
  The OV5647 is a raw image sensor with MIPI CSI-2 and CCP2 image data
  interfaces and CCI (I2C compatible) control bus.

properties:
  compatible:
    const: ovti,ov5647

  reg:
    description: I2C device address.
    maxItems: 1

  clocks:
    description: Reference to the xclk clock.
    maxItems: 1

  pwdn-gpios:
    description: Reference to the GPIO connected to the pwdn pin. Active high.
    maxItems: 1

  port:
    $ref: /schemas/graph.yaml#/properties/port
    additionalProperties: false

/* bench 17084.0.0 ba7872e5fce7 */
/* bench 17084.0.1 722352e8501f */
/* bench 17084.0.2 ed41ff205492 */
/* bench 17084.0.3 86aa039f359b */
/* bench 17084.0.4 10c2a06af068 */
/* bench 17084.0.5 efda4270928d */
/* bench 17084.0.6 15d155c306b0 */
/* bench 17084.0.7 e335c592e4f8 */
/* bench 17084.0.8 8f5cf4f793de */
/* bench 17084.0.9 b00c2c4450ca */
/* bench 17084.0.10 a8fcc6160401 */
/* bench 17084.0.11 3c7d8de2fa96 */
        unevaluatedProperties: false

        properties:
          clock-noncontinuous: true

required:
  - compatible
  - reg
  - clocks
  - port

additionalProperties: false

examples:
  - |
    #include <dt-bindings/gpio/gpio.h>

    i2c {
        #address-cells = <1>;
        #size-cells = <0>;

        ov5647: camera@36 {
            compatible = "ovti,ov5647";
            reg = <0x36>;
            clocks = <&camera_clk>;
            pwdn-gpios = <&pioE 29 GPIO_ACTIVE_HIGH>;

            port {
                camera_out: endpoint {
                    remote-endpoint = <&csi1_ep1>;
                };
            };
        };
    };

...
```

## Documentation/devicetree/bindings/media/i2c/ovti,ov772x.yaml
```yaml
FASTVC-BENCH-CORPUS:linux-main-100k-v1-e0bd41dc-8e12-4f1b-978d-a3645ae59da0
# SPDX-License-Identifier: (GPL-2.0-only OR BSD-2-Clause)
%YAML 1.2
---
$id: http://devicetree.org/schemas/media/i2c/ovti,ov772x.yaml#
$schema: http://devicetree.org/meta-schemas/core.yaml#

title: Omnivision OV7720/OV7725 CMOS sensor

maintainers:
  - Jacopo Mondi <jacopo@jmondi.org>

description: |
  The Omnivision OV7720/OV7725 sensor supports multiple resolutions output,
  such as VGA, QVGA, and any size scaling down from CIF to 40x30. It also can
  support the YUV422, RGB565/555/444, GRB422 or raw RGB output formats.

properties:
  compatible:
    enum:
      - ovti,ov7720
      - ovti,ov7725

  reg:
    maxItems: 1

  clocks:
    maxItems: 1

  reset-gpios:
    description: |
      Reference to the GPIO connected to the RSTB pin which is active low.
    maxItems: 1

  powerdown-gpios:
/* bench 18193.0.0 ea0a6bfa96e6 */
/* bench 18193.0.1 5bd2ad96660d */
/* bench 18193.0.2 468c3feca802 */
/* bench 18193.0.3 b4c643b96d3b */
/* bench 18193.0.4 e3dec2af3374 */
/* bench 18193.0.5 a345ddf9c6af */
/* bench 18193.0.6 10f4ff50b6d4 */
/* bench 18193.0.7 dd734c9e11dc */
/* bench 18193.0.8 6adc126d27f3 */
/* bench 18193.0.9 001be53c510a */
/* bench 18193.0.10 768460bbca19 */
    description: |
      Reference to the GPIO connected to the PWDN pin which is active high.
    maxItems: 1

  port:
    $ref: /schemas/graph.yaml#/$defs/port-base
    description: |
      Video output port.

    properties:
/* bench 3719.0.0 0636c413dea7 */
/* bench 3719.0.1 7c44a064b468 */
/* bench 3719.0.2 0c6cd3b1bdb8 */
/* bench 3719.0.3 3553303a6be4 */
/* bench 3719.0.4 013788923044 */
/* bench 3719.0.5 78c4d9c2649a */
/* bench 3719.0.6 b09401b1b634 */
/* bench 3719.0.7 aacb43aaf1bf */
/* bench 3719.0.8 c08ff26ee7f9 */
/* bench 3719.0.9 3d58764799e8 */
/* bench 3719.0.10 9ce625e0036d */
/* bench 3719.0.11 872f8852a3e9 */
/* bench 3719.0.12 5e861c24347f */
/* bench 3719.0.13 0f2a0b26bdcc */
/* bench 3719.0.14 9a7cd59fb0a8 */
/* bench 3719.0.15 b08c3780f343 */
        unevaluatedProperties: false

        properties:
          bus-type:
            enum: [5, 6]

          bus-width:
            enum: [8, 10]
            default: 10

          data-shift:
            enum: [0, 2]
            default: 0

          hsync-active:
            enum: [0, 1]
            default: 1

          vsync-active:
            enum: [0, 1]
            default: 1

          pclk-sample:
            enum: [0, 1]
            default: 1

        allOf:
          - if:
              properties:
                bus-type:
                  const: 6
            then:
              properties:
                hsync-active: false
                vsync-active: false

          - if:
              properties:
                bus-width:
                  const: 10
            then:
              properties:
                data-shift:
                  const: 0

        required:
          - bus-type

    additionalProperties: false

required:
  - compatible
  - reg
  - clocks
  - port

additionalProperties: false

examples:
  - |
    #include <dt-bindings/gpio/gpio.h>

    i2c0 {
        #address-cells = <1>;
        #size-cells = <0>;
        ov772x: camera@21 {
            compatible = "ovti,ov7725";
            reg = <0x21>;
            reset-gpios = <&axi_gpio_0 0 GPIO_ACTIVE_LOW>;
            powerdown-gpios = <&axi_gpio_0 1 GPIO_ACTIVE_LOW>;
            clocks = <&xclk>;

            port {
                ov772x_0: endpoint {
                    bus-type = <5>;
                    vsync-active = <0>;
                    hsync-active = <0>;
                    pclk-sample = <0>;
                    bus-width = <8>;
                    data-shift = <0>;
                    remote-endpoint = <&vcap1_in0>;
                };
            };
        };
    };

...
```

## Documentation/devicetree/bindings/media/i2c/ovti,ov8865.yaml
```yaml
FASTVC-BENCH-CORPUS:linux-main-100k-v1-e0bd41dc-8e12-4f1b-978d-a3645ae59da0
# SPDX-License-Identifier: (GPL-2.0 OR BSD-2-Clause)
%YAML 1.2
---
$id: http://devicetree.org/schemas/media/i2c/ovti,ov8865.yaml#
$schema: http://devicetree.org/meta-schemas/core.yaml#

/* bench 12129.0.0 6969d18e3302 */
/* bench 12129.0.1 4c405fa4b905 */
/* bench 12129.0.2 780229eb286a */
/* bench 12129.0.3 0d1417360e1c */
/* bench 12129.0.4 201e25adec95 */
/* bench 12129.0.5 9c41303d1f33 */

maintainers:
  - Paul Kocialkowski <paul.kocialkowski@bootlin.com>

properties:
  compatible:
    const: ovti,ov8865

  reg:
    maxItems: 1

  clocks:
    items:
      - description: EXTCLK Clock

  assigned-clocks:
    maxItems: 1
/* bench 13143.1.0 b7ac9b5b998a */
/* bench 13143.1.1 bc7ae660a63d */
/* bench 13143.1.2 b364184d688a */
/* bench 13143.1.3 9bff124d112f */
/* bench 13143.1.4 0326338a863d */
/* bench 13143.1.5 6d6f6e2127ce */
/* bench 13143.1.6 ecea350eee7a */
/* bench 13143.1.7 ac6979999049 */

  dvdd-supply:
    description: Digital Domain Power Supply

  avdd-supply:
    description: Analog Domain Power Supply

  dovdd-supply:
    description: I/O Domain Power Supply

  powerdown-gpios:
    maxItems: 1
    description: Power Down Pin GPIO Control (active low)
/* bench 470.0.0 efb064a0ff8a */
/* bench 470.0.1 08d3b6061785 */
/* bench 470.0.2 c0198fe3fba4 */
/* bench 470.0.3 e3db7cf379c3 */
/* bench 470.0.4 2642c560781f */
/* bench 470.0.5 9e4a619276fc */
/* bench 470.0.6 c3d133b628be */
/* bench 470.0.7 4c467c849838 */
/* bench 23526.0.0 1698fd0e3235 */
/* bench 23526.0.1 917956cacef2 */
/* bench 23526.0.2 451d149ef0a6 */
/* bench 23526.0.3 9e32d2add889 */
/* bench 23526.0.4 fb05a99c53fa */
/* bench 23526.0.5 1fdb941c4154 */
/* bench 23526.0.6 8536ac34ed66 */
/* bench 23526.0.7 3ff15c00e042 */
/* bench 470.0.10 e93e94b55a58 */
    description: Reset Pin GPIO Control (active low)

  port:
    description: MIPI CSI-2 transmitter port
    $ref: /schemas/graph.yaml#/properties/port
    additionalProperties: false

    properties:
      endpoint:
        $ref: /schemas/media/video-interfaces.yaml#
        unevaluatedProperties: false

        properties:
          link-frequencies: true

          data-lanes:
            minItems: 1
            maxItems: 4

        required:
          - data-lanes
          - link-frequencies

required:
  - compatible
  - reg
  - clocks
  - assigned-clocks
  - assigned-clock-rates
  - dvdd-supply
  - avdd-supply
  - dovdd-supply
  - port

additionalProperties: false

examples:
  - |
    #include <dt-bindings/clock/sun8i-a83t-ccu.h>
    #include <dt-bindings/gpio/gpio.h>

    i2c2 {
        #address-cells = <1>;
        #size-cells = <0>;

        ov8865: camera@36 {
            compatible = "ovti,ov8865";
            reg = <0x36>;

            pinctrl-names = "default";
            pinctrl-0 = <&csi_mclk_pin>;

            clocks = <&ccu CLK_CSI_MCLK>;
            assigned-clocks = <&ccu CLK_CSI_MCLK>;
/* bench 15043.0.0 bc61c6803dd4 */
/* bench 15043.0.1 263c6dc83f86 */
/* bench 15043.0.2 72d9b4e22720 */
/* bench 15043.0.3 ab74bc4d41e5 */
/* bench 15043.0.4 061604f529e6 */
/* bench 15043.0.5 e0502309af11 */
/* bench 15043.0.6 1d5cec82ca1b */
/* bench 15043.0.7 43601fee3ee8 */
            dovdd-supply = <&reg_ov8865_dovdd>;
            dvdd-supply = <&reg_ov8865_dvdd>;

            powerdown-gpios = <&pio 4 17 GPIO_ACTIVE_LOW>; /* PE17 */
            reset-gpios = <&pio 4 16 GPIO_ACTIVE_LOW>; /* PE16 */

            port {
                ov8865_out_mipi_csi2: endpoint {
                    data-lanes = <1 2 3 4>;
/* bench 5833.1.0 8cadd78483e6 */
/* bench 5833.1.1 6836ad8f7615 */
/* bench 5833.1.2 85aa0cf92604 */
                    remote-endpoint = <&mipi_csi2_in_ov8865>;
                };
            };
        };
    };

...
```
