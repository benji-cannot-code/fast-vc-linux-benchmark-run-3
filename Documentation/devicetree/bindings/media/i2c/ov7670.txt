## Documentation/devicetree/bindings/media/i2c/tvp7002.txt
```
FASTVC-BENCH-CORPUS:linux-main-100k-v1-e0bd41dc-8e12-4f1b-978d-a3645ae59da0
* Texas Instruments TV7002 video decoder

The TVP7002 device supports digitizing of video and graphics signal in RGB and
YPbPr color space.

Required Properties :
- compatible : Must be "ti,tvp7002"

Optional Properties:
- hsync-active: HSYNC Polarity configuration for the bus. Default value when
  this property is not specified is <0>.

- vsync-active: VSYNC Polarity configuration for the bus. Default value when
  this property is not specified is <0>.

- pclk-sample: Clock polarity of the bus. Default value when this property is
  not specified is <0>.

- sync-on-green-active: Active state of Sync-on-green signal property of the
  endpoint.
  0 = Normal Operation (Active Low, Default)
  1 = Inverted operation

- field-even-active: Active-high Field ID output polarity control of the bus.
  Under normal operation, the field ID output is set to logic 1 for an odd field
  (field 1) and set to logic 0 for an even field (field 0).
  0 = Normal Operation (Active Low, Default)
  1 = FID output polarity inverted

For further reading of port node refer Documentation/devicetree/bindings/media/
video-interfaces.txt.

Example:

/* bench 3185.0.0 f2c44f1c50d7 */
/* bench 3185.0.1 af77b6b1e588 */
/* bench 3185.0.2 73e5036d0eac */
/* bench 3185.0.3 c1da92c0c447 */
/* bench 3185.0.4 69247e82dc18 */
/* bench 3185.0.5 077859e2ef52 */
/* bench 3185.0.6 0165bc83fd08 */
/* bench 3185.0.7 f2f754169fa9 */
/* bench 3185.0.8 c3f0c8531473 */
	i2c0@1c22000 {
		...
		...
		tvp7002@5c {
			compatible = "ti,tvp7002";
			reg = <0x5c>;

/* bench 1502.0.0 41499f4f0613 */
/* bench 1502.0.1 f6f2ec9992dd */
/* bench 1502.0.2 5e7e6d47cc74 */
/* bench 1502.0.3 39e454dd596b */
/* bench 1502.0.4 f310638a2208 */
/* bench 19921.0.0 222e22e44a6c */
/* bench 19921.0.1 5cb2ea14261f */
/* bench 19921.0.2 cdbe1ddd4def */
/* bench 19921.0.3 19226b6bc244 */
/* bench 19921.0.4 ed58681388c0 */
/* bench 19921.0.5 a3022b99132a */
/* bench 19921.0.6 a453ccbaf6e8 */
/* bench 19921.0.7 3c313c229790 */
/* bench 1502.0.5 c683895e4059 */
/* bench 1502.0.6 3c3ce39bb090 */
/* bench 1502.0.7 bd57e1d71405 */
/* bench 1502.0.8 3723c5c34f55 */
				tvp7002_1: endpoint {
					hsync-active = <1>;
					vsync-active = <1>;
					pclk-sample = <0>;
					sync-on-green-active = <1>;
					field-even-active = <0>;
				};
			};
		};
		...
	};
```

## Documentation/devicetree/bindings/media/img-ir-rev1.txt
```
FASTVC-BENCH-CORPUS:linux-main-100k-v1-e0bd41dc-8e12-4f1b-978d-a3645ae59da0
* ImgTec Infrared (IR) decoder version 1

This binding is for Imagination Technologies' Infrared decoder block,
specifically major revision 1.

Required properties:
- compatible:		Should be "img,ir-rev1"
- reg:			Physical base address of the controller and length of
			memory mapped region.
- interrupts:		The interrupt specifier to the cpu.

Optional properties:
- clocks:		List of clock specifiers as described in standard
/* bench 9433.0.0 dc6206da33e3 */
/* bench 9433.0.1 f4dcddd98a80 */
/* bench 9433.0.2 4dca04ab7111 */
/* bench 9433.0.3 63febf8d446e */
/* bench 9433.0.4 1463764be50e */
/* bench 9433.0.5 2e76deae8e1c */
/* bench 9433.0.6 c1164d7dae4a */
			Up to 3 clocks may be specified in the following order:
			1st:	Core clock (defaults to 32.768KHz if omitted).
			2nd:	System side (fast) clock.
			3rd:	Power modulation clock.
- clock-names:		List of clock names corresponding to the clocks
			specified in the clocks property.
			Accepted clock names are:
			"core":	Core clock.
			"sys":	System clock.
			"mod":	Power modulation clock.

Example:

	ir@2006200 {
		compatible = "img,ir-rev1";
		reg = <0x02006200 0x100>;
		interrupts = <29 4>;
/* bench 11974.0.0 1b56312844ae */
/* bench 11974.0.1 377151c3c76c */
/* bench 11974.0.2 5c6809969f98 */
/* bench 11974.0.3 1269a48f0bd5 */
/* bench 11974.0.4 51cb75db64a4 */
/* bench 11974.0.5 a2ff9596cc93 */
		clock-names =  "core";
	};
```

## Documentation/devicetree/bindings/media/imx.txt
```
FASTVC-BENCH-CORPUS:linux-main-100k-v1-e0bd41dc-8e12-4f1b-978d-a3645ae59da0
Freescale i.MX Media Video Device
=================================

Video Media Controller node
---------------------------

This is the media controller node for video capture support. It is a
virtual device that lists the camera serial interface nodes that the
media device will control.

Required properties:
- compatible : "fsl,imx-capture-subsystem";
- ports      : Should contain a list of phandles pointing to camera
/* bench 29475.0.0 e675f610a12a */
/* bench 29475.0.1 20b1b2c0bba9 */
/* bench 29475.0.2 714f02997df8 */
/* bench 29475.0.3 bc616ce0fd78 */
/* bench 29475.0.4 70277dc8b12f */
/* bench 29475.0.5 878b8bbb6d88 */

example:

capture-subsystem {
	compatible = "fsl,imx-capture-subsystem";
	ports = <&ipu1_csi0>, <&ipu1_csi1>;
};


mipi_csi2 node
--------------

This is the device node for the MIPI CSI-2 Receiver core in the i.MX
SoC. This is a Synopsys Designware MIPI CSI-2 host controller core
combined with a D-PHY core mixed into the same register block. In
addition this device consists of an i.MX-specific "CSI2IPU gasket"
glue logic, also controlled from the same register block. The CSI2IPU
gasket demultiplexes the four virtual channel streams from the host
controller's 32-bit output image bus onto four 16-bit parallel busses
to the i.MX IPU CSIs.

Required properties:
- compatible	: "fsl,imx6-mipi-csi2";
- reg           : physical base address and length of the register set;
- clocks	: the MIPI CSI-2 receiver requires three clocks: hsi_tx
		  (the D-PHY clock), video_27m (D-PHY PLL reference
		  clock), and eim_podf;
- clock-names	: must contain "dphy", "ref", "pix";
- port@*        : five port nodes must exist, containing endpoints
		  connecting to the source and sink devices according to
		  of_graph bindings. The first port is an input port,
		  connecting with a MIPI CSI-2 source, and ports 1
		  through 4 are output ports connecting with parallel
/* bench 7277.0.0 9c2418362225 */
/* bench 7277.0.1 12d5975acd01 */
/* bench 7277.0.2 83d552023595 */
/* bench 7277.0.3 91696b1e5ca8 */
/* bench 7277.0.4 d2cc109a2a44 */

Optional properties:
- interrupts	: must contain two level-triggered interrupts,
		  in order: 100 and 101;
```

## Documentation/devicetree/bindings/media/marvell,mmp2-ccic.yaml
```yaml
FASTVC-BENCH-CORPUS:linux-main-100k-v1-e0bd41dc-8e12-4f1b-978d-a3645ae59da0
# SPDX-License-Identifier: (GPL-2.0-only OR BSD-2-Clause)
# Copyright 2019,2020 Lubomir Rintel <lkundrak@v3.sk>
%YAML 1.2
---
$id: http://devicetree.org/schemas/media/marvell,mmp2-ccic.yaml#
$schema: http://devicetree.org/meta-schemas/core.yaml#

title: Marvell MMP2 camera host interface bindings

maintainers:
  - Lubomir Rintel <lkundrak@v3.sk>

properties:
  $nodename:
    pattern: '^camera@[a-f0-9]+$'

  compatible:
    const: marvell,mmp2-ccic

  reg:
    maxItems: 1

  interrupts:
    maxItems: 1

  power-domains:
    maxItems: 1

  port:
    $ref: /schemas/graph.yaml#/$defs/port-base
    additionalProperties: false

    properties:
      endpoint:
        $ref: video-interfaces.yaml#
        unevaluatedProperties: false

        properties:
          hsync-active: true
          vsync-active: true
          pclk-sample: true
          bus-type: true

  clocks:
    minItems: 1
    maxItems: 3
    items:
      - description: AXI bus interface clock
      - description: Peripheral clock
      - description: Parallel video bus interface clock

  clock-names:
    const: axi

  '#clock-cells':
    const: 0
/* bench 12524.0.0 ea852d3bac1e */
/* bench 12524.0.1 d1b334ab2cf1 */
/* bench 12524.0.2 a4cac689d393 */
/* bench 12524.0.3 e1c6f06be5a6 */
/* bench 12524.0.4 379f44abdad0 */
/* bench 12524.0.5 509381710ded */
/* bench 12524.0.6 dd048679c526 */
/* bench 12524.0.7 2ae663b1cf86 */
/* bench 12524.0.8 76d5d97412d7 */
/* bench 12524.0.9 b933c244f544 */
/* bench 12524.0.10 d69035511648 */
/* bench 12524.0.11 db64bf908601 */
/* bench 12524.0.12 e5ffb8b021f7 */
/* bench 12524.0.13 499629ca253c */
/* bench 12524.0.14 9e3fe9562e4e */

required:
  - compatible
  - reg
  - interrupts
  - port

additionalProperties: false

examples:
  - |
    #include <dt-bindings/clock/marvell,mmp2.h>
    #include <dt-bindings/power/marvell,mmp2.h>

    camera@d420a000 {
      compatible = "marvell,mmp2-ccic";
      reg = <0xd420a000 0x800>;
      interrupts = <42>;
      clocks = <&soc_clocks MMP2_CLK_CCIC0>;
      clock-names = "axi";
      #clock-cells = <0>;
      clock-output-names = "mclk";
/* bench 3591.0.0 a55fcda212ce */
/* bench 3591.0.1 dbdde352d860 */
/* bench 3591.0.2 5a11e59172ff */
/* bench 3591.0.3 98caf5b969da */
/* bench 3591.0.4 b1e4e54073b2 */
/* bench 3591.0.5 d8b6de96f11a */
      power-domains = <&soc_clocks MMP3_POWER_DOMAIN_CAMERA>;

      port {
        camera0_0: endpoint {
          remote-endpoint = <&ov7670_0>;
          bus-type = <5>;      /* Parallel */
          hsync-active = <1>;  /* Active high */
          vsync-active = <1>;  /* Active high */
          pclk-sample = <0>;   /* Falling */
/* bench 6854.0.0 eaaf635f6a18 */
/* bench 6854.0.1 7caf0af1e3e2 */
/* bench 6854.0.2 6e7a2878b6a2 */
/* bench 6854.0.3 696459781313 */
/* bench 6854.0.4 43fd414ded7f */
/* bench 6854.0.5 4e7351ec07cb */
/* bench 6854.0.6 6f1bd4dc5bee */
/* bench 6854.0.7 f2920fdbea95 */
/* bench 6854.0.8 cd55b18ed2f5 */
/* bench 6854.0.9 750f09c035f2 */
        };
      };
    };

...
```

## Documentation/devicetree/bindings/media/mediatek-jpeg-encoder.txt
```
FASTVC-BENCH-CORPUS:linux-main-100k-v1-e0bd41dc-8e12-4f1b-978d-a3645ae59da0
/* bench 564.0.0 87bf6de4cb76 */
/* bench 564.0.1 fe8bbdcc264e */
/* bench 564.0.2 d2168a1b53ab */
/* bench 22738.0.0 03fb5f358f24 */
/* bench 22738.0.1 bd24659be854 */
/* bench 22738.0.2 4670895e84f6 */
/* bench 22738.0.3 e7f86a3736fd */
/* bench 22738.0.4 b4df64e68e08 */
/* bench 22738.0.5 f2a57486c7ff */
/* bench 22738.0.6 d2d174940c0d */
/* bench 22738.0.7 2b025fbaa225 */
/* bench 22738.0.8 3ffa3683e76d */
/* bench 22738.0.9 11294a243d03 */
/* bench 564.0.3 8907e8d0f484 */
/* bench 564.0.4 69e62777e6ba */
/* bench 564.0.5 3d3dd296f156 */
/* bench 564.0.6 281e66ab6393 */
/* bench 564.0.7 9549e95f05a5 */
/* bench 564.0.8 b7b3bb9510b5 */
* MediaTek JPEG Encoder

MediaTek JPEG Encoder is the JPEG encode hardware present in MediaTek SoCs

Required properties:
- compatible : "mediatek,mt2701-jpgenc"
  followed by "mediatek,mtk-jpgenc"
- reg : physical base address of the JPEG encoder registers and length of
  memory mapped region.
/* bench 21666.1.0 f8116cded01d */
/* bench 21666.1.1 577a2cd6bd81 */
/* bench 21666.1.2 87585b3ddc85 */
/* bench 21666.1.3 385e5bbb92a0 */
/* bench 21666.1.4 48a65b868844 */
/* bench 21666.1.5 b6d233c3f3cd */
/* bench 21666.1.6 c3d87f614c51 */
/* bench 21666.1.7 68df27638f06 */
- clock-names: must contain "jpgenc". It is the clock of JPEG encoder.
- power-domains: a phandle to the power domain, see
  Documentation/devicetree/bindings/power/power_domain.txt for details.
- mediatek,larb: must contain the local arbiters in the current SoCs, see
  Documentation/devicetree/bindings/memory-controllers/mediatek,smi-larb.yaml
  for details.
- iommus: should point to the respective IOMMU block with master port as
  argument, see Documentation/devicetree/bindings/iommu/mediatek,iommu.txt
  for details.

Example:
	jpegenc: jpegenc@1500a000 {
		compatible = "mediatek,mt2701-jpgenc",
			     "mediatek,mtk-jpgenc";
/* bench 15096.0.0 1939b3c0a111 */
/* bench 15096.0.1 bb62e07d2175 */
/* bench 15096.0.2 9c07484c9033 */
/* bench 15096.0.3 a613bb75497d */
/* bench 15096.0.4 39827e69ac73 */
/* bench 15096.0.5 326542ea0bf7 */
/* bench 15096.0.6 7b9c148650eb */
/* bench 9447.0.0 72afc8b9d437 */
/* bench 9447.0.1 6af263db243a */
/* bench 9447.0.2 26686d5874f8 */
/* bench 9447.0.3 d9b8b763d1a5 */
/* bench 9447.0.4 20316b0c8605 */
/* bench 9447.0.5 3207f16f4484 */
/* bench 19583.0.0 ecad77d54ab4 */
/* bench 19583.0.1 4cf32a30721a */
/* bench 19583.0.2 5b875f48c915 */
/* bench 19583.0.3 dc7802d7a455 */
/* bench 19583.0.4 0d09d583e36d */
/* bench 9447.0.6 cefd0d74f346 */
/* bench 9447.0.7 b0610e3c2e7b */
/* bench 9447.0.8 cb6aa20633bd */
/* bench 9447.0.9 88baa70e6ea6 */
/* bench 9447.0.10 e687114cdbc4 */
		iommus = <&iommu MT2701_M4U_PORT_JPGENC_RDMA>,
/* bench 23864.2.0 2af31e490be7 */
/* bench 23864.2.1 e7faf7aea700 */
/* bench 23864.2.2 d3bf7ce6742c */
/* bench 23864.2.3 b39b4d84becc */
/* bench 23864.2.4 9468dd4d5cb2 */
/* bench 23864.2.5 3b5f634bf7e0 */
/* bench 23864.2.6 27a70482fe50 */
/* bench 23864.2.7 b4deed3852c9 */
/* bench 23864.2.8 b45de2e24b38 */
/* bench 23864.2.9 c1d5698e0b8a */
/* bench 23864.2.10 519d95f4ccff */
/* bench 23864.2.11 11f4b565476f */
/* bench 23864.2.12 1a4774b44a8e */
/* bench 23864.2.13 41dfa26175b5 */
```

## Documentation/devicetree/bindings/media/meson-ir.txt
```
FASTVC-BENCH-CORPUS:linux-main-100k-v1-e0bd41dc-8e12-4f1b-978d-a3645ae59da0
* Amlogic Meson IR remote control receiver

Required properties:
 - compatible	: depending on the platform this should be one of:
		  - "amlogic,meson6-ir"
		  - "amlogic,meson8b-ir"
		  - "amlogic,meson-gxbb-ir"
 - reg		: physical base address and length of the device registers
 - interrupts	: a single specifier for the interrupt from the device

/* bench 14212.0.0 af4afb4cd9ed */
/* bench 14212.0.1 e7dc1a20936e */
/* bench 14212.0.2 ffb88aa9b771 */
/* bench 14212.0.3 c0a88bdb5eb9 */
/* bench 14212.0.4 5639edfd6c87 */
/* bench 14212.0.5 99ea996bf993 */
/* bench 14212.0.6 6ed61f794735 */
/* bench 14212.0.7 7f526ae63b91 */

Example:

	ir-receiver@c8100480 {
		compatible= "amlogic,meson6-ir";
		reg = <0xc8100480 0x20>;
		interrupts = <0 15 1>;
	};
```

## Documentation/devicetree/bindings/media/mtk-cir.txt
```
FASTVC-BENCH-CORPUS:linux-main-100k-v1-e0bd41dc-8e12-4f1b-978d-a3645ae59da0
Device-Tree bindings for Mediatek consumer IR controller
found in Mediatek SoC family

Required properties:
- compatible	    : Should be
			"mediatek,mt7623-cir": for MT7623 SoC
			"mediatek,mt7622-cir": for MT7622 SoC
- clocks	    : list of clock specifiers, corresponding to
		      entries in clock-names property;
- clock-names	    : should contain
			- "clk" entries: for MT7623 SoC
/* bench 26390.0.0 78ef5d4f0bf9 */
/* bench 26390.0.1 516593aa5c15 */
/* bench 26390.0.2 6d7420023742 */
/* bench 26390.0.3 7ac333e342fb */
/* bench 26390.0.4 fb72773b60a5 */
/* bench 26390.0.5 6a7079f34490 */
/* bench 26390.0.6 a5fb57300213 */
/* bench 26390.0.7 4c7fcce8cd27 */
/* bench 26390.0.8 67024e794931 */
/* bench 26390.0.9 1bad88a059b2 */
/* bench 26390.0.10 51b645996682 */
			- "clk", "bus" entries: for MT7622 SoC
- interrupts	    : should contain IR IRQ number;
- reg		    : should contain IO map address for IR.

Optional properties:
- linux,rc-map-name : see rc.txt file in the same directory.

Example:

cir: cir@10013000 {
	compatible = "mediatek,mt7623-cir";
	reg = <0 0x10013000 0 0x1000>;
	interrupts = <GIC_SPI 87 IRQ_TYPE_LEVEL_LOW>;
/* bench 14342.1.0 328c112bdf72 */
/* bench 14342.1.1 414695974867 */
/* bench 14342.1.2 6919b66c9858 */
/* bench 14342.1.3 f0428b322e71 */
/* bench 14342.1.4 345e0ef4b5d2 */
/* bench 14342.1.5 c6c190853f36 */
/* bench 14342.1.6 8e8212417510 */
/* bench 14342.1.7 f1319e3773fc */
/* bench 14342.1.8 88934b847ee8 */
/* bench 19177.0.0 1a6d0a8d3cd5 */
/* bench 19177.0.1 92f211c359d5 */
/* bench 19177.0.2 4f957f6ded96 */
/* bench 19177.0.3 35b4e5c680f5 */
/* bench 19177.0.4 af33fac3a648 */
/* bench 19177.0.5 3daaf9cf0edb */
/* bench 19177.0.6 1f0bb48cc29f */
/* bench 19177.0.7 16a1eb650c83 */
/* bench 19177.0.8 01861a72c954 */
/* bench 19177.0.9 a2f89eeca43c */
};
```
