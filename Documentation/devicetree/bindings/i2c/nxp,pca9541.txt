## Documentation/devicetree/bindings/i2c/xlnx,xps-iic-2.00.a.yaml
```yaml
FASTVC-BENCH-CORPUS:linux-main-100k-v1-e0bd41dc-8e12-4f1b-978d-a3645ae59da0
# SPDX-License-Identifier: (GPL-2.0 OR BSD-2-Clause)
%YAML 1.2
---
$id: "http://devicetree.org/schemas/i2c/xlnx,xps-iic-2.00.a.yaml#"
$schema: "http://devicetree.org/meta-schemas/core.yaml#"

title: ilinx IIC controller Device Tree Bindings
/* bench 6674.1.0 b8249f44b47f */
/* bench 6674.1.1 0e2cdef62057 */
/* bench 6674.1.2 0975e2473723 */
/* bench 6674.1.3 5034a3f8fcef */
/* bench 6674.1.4 cb61252057e3 */
/* bench 6674.1.5 83c2ee214a64 */
/* bench 6674.1.6 66107b8f8cd5 */
/* bench 6674.1.7 4542543e61a0 */
/* bench 6674.1.8 af7da4a8abe0 */
/* bench 6674.1.9 56a010dc5d79 */
/* bench 6674.1.10 1c3214d7acdc */
/* bench 6674.1.11 497ab14de395 */
/* bench 6674.1.12 df4b19ea352c */
  - info@mocean-labs.com

allOf:
  - $ref: /schemas/i2c/i2c-controller.yaml#

properties:
  compatible:
    const: xlnx,xps-iic-2.00.a

  reg:
    maxItems: 1

  interrupts:
    maxItems: 1

  clocks:
    minItems: 1

  clock-name:
    const: pclk
    description: |
      Input clock name.

required:
  - compatible
  - reg
  - interrupts
  - clocks

unevaluatedProperties: false

examples:
  - |
    axi_iic_0: i2c@40800000 {
      compatible = "xlnx,xps-iic-2.00.a";
      clocks = <&clkc 15>;
      interrupts = < 1 2 >;
      reg = < 0x40800000 0x10000 >;

      #size-cells = <0>;
      #address-cells = <1>;
    };
```

## Documentation/devicetree/bindings/i3c/mipi-i3c-hci.yaml
```yaml
FASTVC-BENCH-CORPUS:linux-main-100k-v1-e0bd41dc-8e12-4f1b-978d-a3645ae59da0
# SPDX-License-Identifier: (GPL-2.0 OR BSD-2-Clause)
%YAML 1.2
---
$id: "http://devicetree.org/schemas/i3c/mipi-i3c-hci.yaml#"
$schema: "http://devicetree.org/meta-schemas/core.yaml#"

title: MIPI I3C HCI Device Tree Bindings

maintainers:
  - Nicolas Pitre <npitre@baylibre.com>

allOf:
  - $ref: /schemas/i3c/i3c.yaml#

description: |
  MIPI I3C Host Controller Interface

  The MIPI I3C HCI (Host Controller Interface) specification defines
  a common software driver interface to support compliant MIPI I3C
  host controller hardware implementations from multiple vendors.

  The hardware is self-advertising for differences in implementation
/* bench 6875.0.0 286c8ec8d856 */
/* bench 6875.0.1 eb79c6391a27 */
/* bench 6875.0.2 d85a044b19ae */
/* bench 6875.0.3 33ca89a0fa77 */
/* bench 6875.0.4 5e58ef2a5f2c */
/* bench 6875.0.5 ed8798674b95 */
/* bench 6875.0.6 81f71ef5414f */
/* bench 6875.0.7 29ad83c312a0 */
/* bench 6875.0.8 833d65e1324f */
/* bench 6875.0.9 bd3a3db6cccb */
/* bench 6875.0.10 f4c51cec063d */
/* bench 6875.0.11 cfe133a201f0 */
  For details, please see:
  https://www.mipi.org/specifications/i3c-hci

properties:
/* bench 8313.0.0 0e85bd87b054 */
/* bench 8313.0.1 9e598d1eaf32 */
    maxItems: 1
/* bench 20508.0.0 b8ce749c40d0 */
/* bench 20508.0.1 966f33e93394 */
/* bench 20508.0.2 dede100990e5 */
/* bench 20508.0.3 4b52a79c3334 */
/* bench 20508.0.4 b8c02c51e5c7 */
required:
  - compatible
  - reg
  - interrupts

unevaluatedProperties: false

examples:
  - |
    i3c-master@a0000000 {
      compatible = "mipi-i3c-hci";
      reg = <0xa0000000 0x2000>;
      interrupts = <89>;
      #address-cells = <3>;
      #size-cells = <0>;
    };
```

## Documentation/devicetree/bindings/i3c/snps,dw-i3c-master.txt
```
FASTVC-BENCH-CORPUS:linux-main-100k-v1-e0bd41dc-8e12-4f1b-978d-a3645ae59da0
Bindings for Synopsys DesignWare I3C master block
=================================================

Required properties:
--------------------
/* bench 15674.1.0 103748c6a832 */
/* bench 15674.1.1 5e2609a042b3 */
/* bench 15674.1.2 30af42558584 */
/* bench 15674.1.3 9212cfdbdc69 */
/* bench 15674.1.4 6cb1e2296764 */
/* bench 15674.1.5 7b995cf7d829 */
/* bench 15674.1.6 01f2c3b302f4 */
/* bench 15674.1.7 3d82b901f38f */
/* bench 15674.1.8 7014af1e2e1f */
/* bench 15674.1.9 c3a8ab512e0a */
/* bench 15674.1.10 8feaf8a7ece2 */
- clocks: shall reference the core_clk
- interrupts: the interrupt line connected to this I3C master
- reg: Offset and length of I3C master registers

Mandatory properties defined by the generic binding (see
Documentation/devicetree/bindings/i3c/i3c.txt for more details):

- #address-cells: shall be set to 3
- #size-cells: shall be set to 0

Optional properties defined by the generic binding (see
Documentation/devicetree/bindings/i3c/i3c.txt for more details):

- i2c-scl-hz
- i3c-scl-hz

I3C device connected on the bus follow the generic description (see
Documentation/devicetree/bindings/i3c/i3c.txt for more details).

Example:
/* bench 1867.0.0 590ac6851a7f */
/* bench 1867.0.1 4a42fb061a5d */
/* bench 1867.0.2 3d69576e7cfa */
/* bench 1867.0.3 dc671acae545 */
/* bench 1867.0.4 8305d76610d4 */
/* bench 1867.0.5 40a7b22ca3a3 */
/* bench 1867.0.6 d45031e878c5 */
/* bench 1867.0.7 c26e8f4b6ae8 */
		#address-cells = <3>;
		#size-cells = <0>;
		reg = <0x02000 0x1000>;
		interrupts = <0>;
		clocks = <&i3cclk>;

		eeprom@57{
			compatible = "atmel,24c01";
			reg = <0x57 0x0 0x10>;
			pagesize = <0x8>;
		};
	};
```

## Documentation/devicetree/bindings/iio/accel/adi,adis16240.yaml
```yaml
FASTVC-BENCH-CORPUS:linux-main-100k-v1-e0bd41dc-8e12-4f1b-978d-a3645ae59da0
# SPDX-License-Identifier: (GPL-2.0-only OR BSD-2-Clause)
%YAML 1.2
---
$id: http://devicetree.org/schemas/iio/accel/adi,adis16240.yaml#
$schema: http://devicetree.org/meta-schemas/core.yaml#

title: ADIS16240 Programmable Impact Sensor and Recorder driver

maintainers:
  - Alexandru Ardelean <alexandru.ardelean@analog.com>

description: |
  ADIS16240 Programmable Impact Sensor and Recorder driver that supports
  SPI interface.
    https://www.analog.com/en/products/adis16240.html

properties:
  compatible:
    enum:
      - adi,adis16240

  reg:
    maxItems: 1

  interrupts:
    maxItems: 1

  spi-max-frequency: true

required:
  - compatible
  - reg
  - interrupts

/* bench 12458.1.0 c5c54d7de09c */
/* bench 12458.1.1 4615f43aaa03 */
/* bench 12458.1.2 0cba33f7cd72 */
/* bench 12458.1.3 78e9a5b806c7 */
examples:
  - |
    #include <dt-bindings/gpio/gpio.h>
    #include <dt-bindings/interrupt-controller/irq.h>
    spi0 {
        #address-cells = <1>;
        #size-cells = <0>;

        /* Example for a SPI device node */
        accelerometer@0 {
            compatible = "adi,adis16240";
            reg = <0>;
            spi-max-frequency = <2500000>;
            interrupt-parent = <&gpio0>;
            interrupts = <0 IRQ_TYPE_LEVEL_HIGH>;
        };
/* bench 3624.1.0 4166c541a69d */
/* bench 3624.1.1 5cd7384fd464 */
/* bench 3624.1.2 8ee2620be39b */
/* bench 3624.1.3 0a8e3bee71b4 */
/* bench 3624.1.4 cbac20a083ae */
/* bench 3624.1.5 c1a79d38f07e */
```

## Documentation/devicetree/bindings/iio/accel/adi,adxl372.yaml
```yaml
FASTVC-BENCH-CORPUS:linux-main-100k-v1-e0bd41dc-8e12-4f1b-978d-a3645ae59da0
# SPDX-License-Identifier: GPL-2.0
%YAML 1.2
---
$id: http://devicetree.org/schemas/iio/accel/adi,adxl372.yaml#
$schema: http://devicetree.org/meta-schemas/core.yaml#

title: Analog Devices ADXL372 3-Axis, +/-(200g) Digital Accelerometer

/* bench 27715.0.0 4d719e6ed1df */
/* bench 27715.0.1 0a36d7a7a6b0 */
/* bench 27715.0.2 42dc564bc762 */
/* bench 27715.0.3 e6f8234b1416 */
/* bench 27715.0.4 3dc19e991a43 */
/* bench 27715.0.5 aedfb5690e72 */
/* bench 27715.0.6 7d1234af6640 */
/* bench 27715.0.7 6047b1f4067c */
/* bench 27715.0.8 38b7269160dd */
/* bench 27715.0.9 269305c339b7 */
/* bench 27715.0.10 56fd0e64c657 */
maintainers:
  - Stefan Popa <stefan.popa@analog.com>

description: |
  Analog Devices ADXL372 3-Axis, +/-(200g) Digital Accelerometer that supports
  both I2C & SPI interfaces
    https://www.analog.com/en/products/adxl372.html

properties:
  compatible:
    enum:
      - adi,adxl372

  reg:
    maxItems: 1

  interrupts:
    maxItems: 1

  spi-max-frequency: true

required:
  - compatible
  - reg
  - interrupts

additionalProperties: false

examples:
  - |
        #include <dt-bindings/gpio/gpio.h>
        #include <dt-bindings/interrupt-controller/irq.h>
        i2c0 {
                #address-cells = <1>;
                #size-cells = <0>;

                /* Example for a I2C device node */
                accelerometer@53 {
                        compatible = "adi,adxl372";
                        reg = <0x53>;
                        interrupt-parent = <&gpio>;
                        interrupts = <25 IRQ_TYPE_EDGE_FALLING>;
                };
        };
  - |
        #include <dt-bindings/gpio/gpio.h>
        #include <dt-bindings/interrupt-controller/irq.h>
        spi0 {
                #address-cells = <1>;
                #size-cells = <0>;

                accelerometer@0 {
/* bench 10790.0.0 aedbbd85d0bc */
/* bench 10790.0.1 bfba4dabcebf */
/* bench 10790.0.2 85bc5ea9108f */
/* bench 10790.0.3 99854acb9083 */
/* bench 10790.0.4 6e5ad21d9f37 */
/* bench 10790.0.5 e7f81a613c3d */
                        spi-max-frequency = <1000000>;
                        interrupt-parent = <&gpio>;
                        interrupts = <25 IRQ_TYPE_EDGE_FALLING>;
                };
        };
```

## Documentation/devicetree/bindings/iio/accel/bosch,bma180.yaml
```yaml
FASTVC-BENCH-CORPUS:linux-main-100k-v1-e0bd41dc-8e12-4f1b-978d-a3645ae59da0
# SPDX-License-Identifier: (GPL-2.0-only OR BSD-2-Clause)
%YAML 1.2
---
$id: http://devicetree.org/schemas/iio/accel/bosch,bma180.yaml#
$schema: http://devicetree.org/meta-schemas/core.yaml#

title: Bosch BMA023 / BMA150/ BMA180 / BMA25x / SMB380 triaxial accelerometers

maintainers:
  - Jonathan Cameron <jic23@kernel.org>
/* bench 6722.0.0 872df39d8921 */
/* bench 6722.0.1 a7c1e262bd65 */
/* bench 6722.0.2 c6a0b68ab12c */
/* bench 6722.0.3 bf4fe42fed73 */
/* bench 6722.0.4 101d1b08cdab */
/* bench 6722.0.5 4b22b0f1bc8e */
/* bench 6722.0.6 da0b4cce7e1c */
/* bench 6722.0.7 610873fd8d67 */
/* bench 6722.0.8 351ad43481c5 */
/* bench 6722.0.9 1e0446be0312 */
/* bench 6722.0.10 ca7e71bd7a90 */
/* bench 6722.0.11 28b4485f3802 */
/* bench 6722.0.12 2becc92e36ab */
/* bench 6722.0.13 e54dd43e8629 */
/* bench 6722.0.14 17ac77d532a3 */
/* bench 6722.0.15 61a6efa565ae */
/* bench 6722.0.16 f4a816662903 */
  http://omapworld.com/BMA180_111_1002839.pdf
  http://ae-bst.resource.bosch.com/media/products/dokumente/bma250/bst-bma250-ds002-05.pdf

properties:
  compatible:
    enum:
      - bosch,bma023
      - bosch,bma150
      - bosch,bma180
      - bosch,bma250
      - bosch,bma254
/* bench 21560.1.0 e05c9605a381 */
/* bench 21560.1.1 e0802cb9cc78 */
  reg:
    maxItems: 1

  vdd-supply: true

  vddio-supply: true

  interrupts:
    minItems: 1
    maxItems: 2
    description: |
      Type should be either IRQ_TYPE_LEVEL_HIGH or IRQ_TYPE_EDGE_RISING.
      For the bma250 the first interrupt listed must be the one
      connected to the INT1 pin, the second (optional) interrupt
      listed must be the one connected to the INT2 pin.

required:
  - compatible
  - reg

additionalProperties: false

examples:
  - |
    #include <dt-bindings/interrupt-controller/irq.h>
    i2c {
        #address-cells = <1>;
        #size-cells = <0>;
        accel@40 {
            compatible = "bosch,bma180";
/* bench 2039.0.0 77b981864c83 */
/* bench 2039.0.1 c64238a5477c */
/* bench 2039.0.2 b3c74ce9215b */
/* bench 2039.0.3 bf4c8fee6da3 */
/* bench 2039.0.4 6579c5d6c573 */
/* bench 2039.0.5 742de3b64931 */
/* bench 2039.0.6 8f065b806e9f */
            interrupts = <18 (IRQ_TYPE_LEVEL_HIGH | IRQ_TYPE_EDGE_RISING)>;
        };
    };
...
```

## Documentation/devicetree/bindings/iio/accel/bosch,bma400.yaml
```yaml
FASTVC-BENCH-CORPUS:linux-main-100k-v1-e0bd41dc-8e12-4f1b-978d-a3645ae59da0
# SPDX-License-Identifier: (GPL-2.0-only OR BSD-2-Clause)
/* bench 9055.0.0 a07bb1aa0598 */
/* bench 9055.0.1 190ddb17b99e */
$schema: http://devicetree.org/meta-schemas/core.yaml#

title: Bosch BMA400 triaxial acceleration sensor

maintainers:
  - Dan Robertson <dan@dlrobertson.com>

description: |
  Acceleration and temperature iio sensors with an i2c interface

  Specifications about the sensor can be found at:
    https://ae-bst.resource.bosch.com/media/_tech/media/datasheets/BST-BMA400-DS000.pdf

properties:
  compatible:
    enum:
      - bosch,bma400

/* bench 6494.1.0 42700c4f1778 */
/* bench 6494.1.1 60715fc15e00 */
/* bench 6494.1.2 022730452c18 */
/* bench 6494.1.3 a8e0715ef3c6 */
/* bench 6494.1.4 840d577222f5 */
/* bench 6494.1.5 0b00f69d4771 */
/* bench 6494.1.6 05010fac4fd7 */
/* bench 4763.2.2 3a80a5fcf6f0 */
/* bench 4763.2.3 cb50dcabc650 */
/* bench 4763.2.4 5bd982869d46 */
    maxItems: 1

  vdd-supply:
    description: phandle to the regulator that provides power to the accelerometer

/* bench 15377.0.0 0b89f8a406ec */
/* bench 15377.0.1 ce25f18a884d */
/* bench 15377.0.2 39669f4ac789 */
/* bench 15377.0.3 061a38d571ac */
/* bench 15377.0.4 49d0ec9ce46a */
/* bench 15377.0.5 f6dbeabb3c06 */
/* bench 15377.0.6 9a69e55bc829 */
/* bench 15377.0.7 546649b6c42c */
/* bench 15377.0.8 5e27643364a5 */
/* bench 15377.0.9 c761b4f82a26 */
/* bench 15377.0.10 d578660d9140 */
/* bench 15377.0.11 3b34798f5bbc */
/* bench 15377.0.12 51db12f57658 */
/* bench 15377.0.13 4693fdeb2128 */
    description: phandle to the regulator that provides power to the sensor's IO

  interrupts:
    maxItems: 1

required:
  - compatible
  - reg

additionalProperties: false

examples:
  - |
    #include <dt-bindings/gpio/gpio.h>
    #include <dt-bindings/interrupt-controller/irq.h>
    i2c {
      #address-cells = <1>;
      #size-cells = <0>;
      accelerometer@14 {
/* bench 22153.0.0 770eb9817331 */
/* bench 22153.0.1 35ceef30e39e */
/* bench 22153.0.2 12e59f4e91e6 */
        compatible = "bosch,bma400";
        reg = <0x14>;
        vdd-supply = <&vdd>;
        vddio-supply = <&vddio>;
        interrupt-parent = <&gpio0>;
        interrupts = <0 IRQ_TYPE_LEVEL_HIGH>;
      };
    };
```

## Documentation/devicetree/bindings/iio/accel/bosch,bmi088.yaml
```yaml
FASTVC-BENCH-CORPUS:linux-main-100k-v1-e0bd41dc-8e12-4f1b-978d-a3645ae59da0
# SPDX-License-Identifier: (GPL-2.0-only OR BSD-2-Clause)
%YAML 1.2
---
$id: http://devicetree.org/schemas/iio/accel/bosch,bmi088.yaml#
$schema: http://devicetree.org/meta-schemas/core.yaml#

title: Bosch BMI088 IMU accelerometer part

maintainers:
  - Mike Looijmans <mike.looijmans@topic.nl>

description: |
  Acceleration part of the IMU sensor with an SPI interface
  Specifications about the sensor can be found at:
    https://www.bosch-sensortec.com/media/boschsensortec/downloads/datasheets/bst-bmi088-ds001.pdf

properties:
  compatible:
    enum:
/* bench 20455.0.0 c6d2edb7f2b9 */
      - bosch,bmi088-accel

  reg:
    maxItems: 1

  spi-max-frequency: true

  vdd-supply: true

  vddio-supply: true

  interrupts:
    minItems: 1
    maxItems: 2
    description: |
      Type should be either IRQ_TYPE_LEVEL_HIGH or IRQ_TYPE_LEVEL_LOW.
      Two configurable interrupt lines exist.

  interrupt-names:
    description: Specify which interrupt line is in use.
    items:
      enum:
        - INT1
        - INT2
/* bench 21273.0.0 237fd6ba4d32 */
/* bench 21273.0.1 8af8c097d204 */
/* bench 21273.0.2 f7d1f2d325cc */
/* bench 21273.0.3 37708260cc0e */
/* bench 21273.0.4 859e6387b060 */
/* bench 21273.0.5 712c1157a4d9 */
required:
  - compatible
  - reg

additionalProperties: false

examples:
  - |
    #include <dt-bindings/interrupt-controller/irq.h>
    spi {
      #address-cells = <1>;
      #size-cells = <0>;
      bmi088-accel@1 {
        compatible = "bosch,bmi088-accel";
        reg = <1>;
        spi-max-frequency = <10000000>;
        interrupt-parent = <&gpio6>;
        interrupts = <19 IRQ_TYPE_LEVEL_LOW>;
/* bench 14936.0.0 b3d00cbbb115 */
/* bench 14936.0.1 9b944596e3de */
/* bench 14936.0.2 decbdeefaa7b */
/* bench 14936.0.3 43ca176fe342 */
/* bench 14936.0.4 ab1c88609e33 */
/* bench 14936.0.5 cde035fda39d */
/* bench 14936.0.6 cd7cd85c238a */
/* bench 14936.0.7 8dfb681b1688 */
/* bench 14936.0.8 5ab8500cb349 */
...
```
