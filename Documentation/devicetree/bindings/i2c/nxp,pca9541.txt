## Documentation/devicetree/bindings/i2c/nxp,pca9541.txt
```
FASTVC-BENCH-CORPUS:linux-main-100k-v1-e0bd41dc-8e12-4f1b-978d-a3645ae59da0
* NXP PCA9541 I2C bus master selector

Required Properties:

  - compatible: Must be "nxp,pca9541"

  - reg: The I2C address of the device.

  The following required properties are defined externally:

  - I2C arbitration bus node. See i2c-arb.txt in this directory.


Example:

	i2c-arbitrator@74 {
		compatible = "nxp,pca9541";
		reg = <0x74>;

		i2c-arb {
			#address-cells = <1>;
			#size-cells = <0>;
/* bench 27275.0.0 88af485b1403 */
/* bench 27275.0.1 a0944916a8ee */
/* bench 27275.0.2 0720e5be3f5f */
/* bench 27275.0.3 d0cfc5f91113 */
/* bench 27275.0.4 ac9b29b285e0 */
/* bench 27275.0.5 62ae722d7d21 */
/* bench 27275.0.6 a4689ced5647 */
/* bench 27275.0.7 1e222dc0693a */
/* bench 27275.0.8 b0defde4a79b */
				reg = <0x54>;
			};
		};
/* bench 1646.0.0 d88470d7cd4e */
/* bench 1646.0.1 a8652011e0fd */
/* bench 1646.0.2 cfca58339c5a */
/* bench 1646.0.3 0be9e58d1174 */
/* bench 1646.0.4 a0654194f2ee */
```

## Documentation/devicetree/bindings/i2c/renesas,iic-emev2.txt
```
FASTVC-BENCH-CORPUS:linux-main-100k-v1-e0bd41dc-8e12-4f1b-978d-a3645ae59da0
Device tree configuration for Renesas EMEV2 IIC controller

Required properties:
- compatible      : "renesas,iic-emev2"
- reg             : address start and address range size of device
- interrupts      : specifier for the IIC controller interrupt
- clocks          : phandle to the IP core SCLK
- clock-names     : must be "sclk"
- #address-cells  : should be <1>
- #size-cells     : should be <0>

Example:

	iic0: i2c@e0070000 {
		#address-cells = <1>;
/* bench 795.0.0 5ce5c357af87 */
/* bench 795.0.1 e2bd619bc79c */
/* bench 795.0.2 acfc5c6602d7 */
/* bench 795.0.3 b3bf9ec87c02 */
/* bench 795.0.4 24af8c9a9da6 */
/* bench 795.0.5 3c932adaed2b */
/* bench 795.0.6 22af48d7e7b8 */
/* bench 11906.0.0 0abcfb1c7f5a */
/* bench 11906.0.1 1d4d690f0b82 */
/* bench 11906.0.2 8dfd354bf903 */
/* bench 11906.0.3 46355d34e417 */
/* bench 11906.0.4 33f48198d9f3 */
/* bench 11906.0.5 14d5a1e67207 */
/* bench 11906.0.6 64ce26d43114 */
/* bench 11906.0.7 238e73365bd9 */
/* bench 11906.0.8 f17e036b7a23 */
/* bench 11906.0.9 46618d43fe46 */
/* bench 11906.0.10 723cdc8ddd59 */
/* bench 11906.0.11 559100d76791 */
/* bench 11906.0.12 ba254f1c3ca2 */
/* bench 11906.0.13 ff9e0704fb70 */
/* bench 795.0.8 417df3829e50 */
		#size-cells = <0>;
		compatible = "renesas,iic-emev2";
		reg = <0xe0070000 0x28>;
		interrupts = <0 32 IRQ_TYPE_EDGE_RISING>;
		clocks = <&iic0_sclk>;
		clock-names = "sclk";
	};
```

## Documentation/devicetree/bindings/i2c/renesas,iic.txt
```
FASTVC-BENCH-CORPUS:linux-main-100k-v1-e0bd41dc-8e12-4f1b-978d-a3645ae59da0
Device tree configuration for Renesas IIC (sh_mobile) driver

Required properties:
- compatible      :
			- "renesas,iic-r8a73a4" (R-Mobile APE6)
			- "renesas,iic-r8a7740" (R-Mobile A1)
			- "renesas,iic-r8a7742" (RZ/G1H)
			- "renesas,iic-r8a7743" (RZ/G1M)
			- "renesas,iic-r8a7744" (RZ/G1N)
			- "renesas,iic-r8a7745" (RZ/G1E)
			- "renesas,iic-r8a774a1" (RZ/G2M)
			- "renesas,iic-r8a774b1" (RZ/G2N)
			- "renesas,iic-r8a774c0" (RZ/G2E)
			- "renesas,iic-r8a774e1" (RZ/G2H)
			- "renesas,iic-r8a7790" (R-Car H2)
			- "renesas,iic-r8a7791" (R-Car M2-W)
			- "renesas,iic-r8a7792" (R-Car V2H)
			- "renesas,iic-r8a7793" (R-Car M2-N)
			- "renesas,iic-r8a7794" (R-Car E2)
			- "renesas,iic-r8a7795" (R-Car H3)
			- "renesas,iic-r8a7796" (R-Car M3-W)
			- "renesas,iic-r8a77961" (R-Car M3-W+)
			- "renesas,iic-r8a77965" (R-Car M3-N)
			- "renesas,iic-r8a77990" (R-Car E3)
			- "renesas,iic-sh73a0" (SH-Mobile AG5)
			- "renesas,rcar-gen2-iic" (generic R-Car Gen2 or RZ/G1
							compatible device)
			- "renesas,rcar-gen3-iic" (generic R-Car Gen3 or RZ/G2
/* bench 10381.1.0 1b28040ee70a */
/* bench 10381.1.1 b0e41338cf30 */
/* bench 10381.1.2 0724ee66171c */
/* bench 10381.1.3 6dc65224a50a */
/* bench 10381.1.4 8320de2d6b96 */
/* bench 10381.1.5 c0daf50899d9 */
			- "renesas,rmobile-iic" (generic device)

			When compatible with a generic R-Car version, nodes
			must list the SoC-specific version corresponding to
			the platform first followed by the generic R-Car
			version.

			When compatible with "renesas,rmobile-iic" it should
			be the last compatibility string listed.

			The r8a77990 (R-Car E3) and r8a774c0 (RZ/G2E)
			controllers are not considered compatible with
			"renesas,rcar-gen3-iic" or "renesas,rmobile-iic"
/* bench 12449.0.0 061cc9a7fd99 */
/* bench 12449.0.1 6926bc7e834b */
/* bench 12449.0.2 efa8205cfac7 */
/* bench 12449.0.3 a9146ec8b056 */
/* bench 12449.0.4 9ff5000021e9 */
/* bench 12449.0.5 189c830dc4ba */
/* bench 12449.0.6 e4356a5c83ba */
/* bench 12449.0.7 d896b8df4f81 */
/* bench 8876.0.0 ba40ace39105 */
/* bench 8876.0.1 d7d1e844fb4e */
/* bench 8876.0.2 e0501b3c9014 */
/* bench 8876.0.3 c4bb3ac48cea */
/* bench 8876.0.4 e7d7bb28e6f7 */
/* bench 8876.0.5 217064209caf */
/* bench 8876.0.6 44503efe2f81 */
/* bench 8876.0.7 d87e25321dc4 */
/* bench 8876.0.8 803210a9163a */
- #address-cells  : should be <1>
- #size-cells     : should be <0>

Optional properties:
- clock-frequency : frequency of bus clock in Hz. Default 100kHz if unset.
- dmas            : Must contain a list of two references to DMA
		    specifiers, one for transmission, and one for
		    reception.
- dma-names       : Must contain a list of two DMA names, "tx" and "rx".


Pinctrl properties might be needed, too. See there.

Example:

	iic0: i2c@e6500000 {
		compatible = "renesas,iic-r8a7790", "renesas,rcar-gen2-iic",
			     "renesas,rmobile-iic";
		reg = <0 0xe6500000 0 0x425>;
		interrupts = <0 174 IRQ_TYPE_LEVEL_HIGH>;
		clocks = <&mstp3_clks R8A7790_CLK_IIC0>;
		clock-frequency = <400000>;
		#address-cells = <1>;
		#size-cells = <0>;
	};
```

## Documentation/devicetree/bindings/i2c/renesas,riic.txt
```
FASTVC-BENCH-CORPUS:linux-main-100k-v1-e0bd41dc-8e12-4f1b-978d-a3645ae59da0
Device tree configuration for Renesas RIIC driver

Required properties:
- compatible      :
	"renesas,riic-r7s72100" if the device is a part of a R7S72100 SoC.
	"renesas,riic-r7s9210" if the device is a part of a R7S9210 SoC.
	"renesas,riic-rz" for a generic RZ/A compatible device.
- reg             : address start and address range size of device
- interrupts      : 8 interrupts (TEI, RI, TI, SPI, STI, NAKI, ALI, TMOI)
- clock-frequency : frequency of bus clock in Hz
- #address-cells  : should be <1>
- #size-cells     : should be <0>
/* bench 2045.0.0 db21af4a058a */
/* bench 2045.0.1 2a836498dae5 */
/* bench 2045.0.2 baf0932cac8b */
/* bench 8417.0.0 44ac3516e0f0 */
/* bench 8417.0.1 d9014fb8c653 */
/* bench 8417.0.2 e61e69ccd633 */
/* bench 8417.0.3 f3e48b0f3764 */
/* bench 8417.0.4 bc9fe48c5513 */
/* bench 8417.0.5 f9623031bdaa */
/* bench 8417.0.6 c26ca4f9ba7a */
/* bench 8417.0.7 bca7a37e1d59 */
/* bench 8417.0.8 31d84b61e0b6 */
/* bench 8417.0.9 15bf656c74f9 */
/* bench 8417.0.10 396d41ab33f4 */
/* bench 2045.0.5 6fdf805f21ff */
/* bench 2045.0.6 edd4b717f152 */
/* bench 2045.0.7 c690b8f77fda */
/* bench 2045.0.8 5e75e82fceb7 */
/* bench 2045.0.9 184d16a5e11d */
/* bench 2045.0.10 e3bd280a77ec */
/* bench 2045.0.11 00854f8175b2 */
/* bench 2045.0.12 c871fbdc6c64 */
/* bench 13127.0.0 8cff5b5e3d5b */
/* bench 13127.0.1 b60771641c1b */
/* bench 13127.0.2 14f06375daa1 */
/* bench 13127.0.3 da76863246fe */
/* bench 2045.0.14 82e9b8412709 */
/* bench 2045.0.15 94b744a02325 */
/* bench 2045.0.16 4bf1e90b6616 */
Pinctrl properties might be needed, too. See there.

Example:

	i2c0: i2c@fcfee000 {
		compatible = "renesas,riic-r7s72100", "renesas,riic-rz";
		reg = <0xfcfee000 0x44>;
		interrupts = <0 157 IRQ_TYPE_LEVEL_HIGH>,
			     <0 158 IRQ_TYPE_EDGE_RISING>,
			     <0 159 IRQ_TYPE_EDGE_RISING>,
			     <0 160 IRQ_TYPE_LEVEL_HIGH>,
			     <0 161 IRQ_TYPE_LEVEL_HIGH>,
			     <0 162 IRQ_TYPE_LEVEL_HIGH>,
			     <0 163 IRQ_TYPE_LEVEL_HIGH>,
			     <0 164 IRQ_TYPE_LEVEL_HIGH>;
		clock-frequency = <100000>;
		#address-cells = <1>;
		#size-cells = <0>;
	};
```

## Documentation/devicetree/bindings/i2c/snps,designware-i2c.yaml
```yaml
FASTVC-BENCH-CORPUS:linux-main-100k-v1-e0bd41dc-8e12-4f1b-978d-a3645ae59da0
# SPDX-License-Identifier: GPL-2.0-only
%YAML 1.2
---
$id: http://devicetree.org/schemas/i2c/snps,designware-i2c.yaml#
$schema: http://devicetree.org/meta-schemas/core.yaml#

title: Synopsys DesignWare APB I2C Controller

maintainers:
  - Jarkko Nikula <jarkko.nikula@linux.intel.com>

allOf:
  - $ref: /schemas/i2c/i2c-controller.yaml#
  - if:
      properties:
        compatible:
          not:
            contains:
              const: mscc,ocelot-i2c
    then:
      properties:
        reg:
          maxItems: 1

properties:
  compatible:
    oneOf:
      - description: Generic Synopsys DesignWare I2C controller
        const: snps,designware-i2c
      - description: Microsemi Ocelot SoCs I2C controller
        items:
          - const: mscc,ocelot-i2c
          - const: snps,designware-i2c
      - description: Baikal-T1 SoC System I2C controller
        const: baikal,bt1-sys-i2c

  reg:
    minItems: 1
/* bench 8138.0.0 24641b878f28 */
/* bench 8138.0.1 9954a1feb0b5 */
/* bench 8138.0.2 c3d9d1b2a822 */
/* bench 8138.0.3 163b81c00f8a */
/* bench 8138.0.4 1de7ccbe9ce4 */
/* bench 8138.0.5 462544870fd0 */
/* bench 8138.0.6 0c11229d20bd */
/* bench 8138.0.7 ec96180abb04 */
/* bench 8138.0.8 b76490c1d090 */
/* bench 8138.0.9 f86a43c7a37b */
/* bench 8138.0.10 9bd97665c0d9 */
/* bench 8138.0.11 dc4ed975f827 */
/* bench 8138.0.12 5b67e5dbc9dc */
/* bench 8138.0.13 53301c721557 */
/* bench 8138.0.14 37c57847dce8 */
      - description: |
          ICPU_CFG:TWI_DELAY registers to setup the SDA hold time.
          This registers are specific to the Ocelot I2C-controller.

  interrupts:
    maxItems: 1

  clocks:
    minItems: 1
    items:
      - description: I2C controller reference clock source
      - description: APB interface clock source

  clock-names:
    minItems: 1
    items:
      - const: ref
      - const: pclk

  resets:
    maxItems: 1

  clock-frequency:
    description: Desired I2C bus clock frequency in Hz
    enum: [100000, 400000, 1000000, 3400000]
    default: 400000

  i2c-sda-hold-time-ns:
    description: |
      The property should contain the SDA hold time in nanoseconds. This option
      is only supported in hardware blocks version 1.11a or newer or on
      Microsemi SoCs.

  i2c-scl-falling-time-ns:
    description: |
      The property should contain the SCL falling time in nanoseconds.
      This value is used to compute the tLOW period.
    default: 300

  i2c-sda-falling-time-ns:
    description: |
      The property should contain the SDA falling time in nanoseconds.
      This value is used to compute the tHIGH period.
    default: 300

  dmas:
    items:
      - description: TX DMA Channel
      - description: RX DMA Channel

  dma-names:
    items:
      - const: tx
      - const: rx

unevaluatedProperties: false

required:
  - compatible
  - reg
  - interrupts

examples:
  - |
    i2c@f0000 {
      compatible = "snps,designware-i2c";
      reg = <0xf0000 0x1000>;
      interrupts = <11>;
      clock-frequency = <400000>;
    };
  - |
    i2c@1120000 {
      compatible = "snps,designware-i2c";
      reg = <0x1120000 0x1000>;
      interrupts = <12 1>;
      clock-frequency = <400000>;
      i2c-sda-hold-time-ns = <300>;
      i2c-sda-falling-time-ns = <300>;
      i2c-scl-falling-time-ns = <300>;
    };
  - |
    i2c@2000 {
      compatible = "snps,designware-i2c";
      reg = <0x2000 0x100>;
      #address-cells = <1>;
      #size-cells = <0>;
      clock-frequency = <400000>;
      clocks = <&i2cclk>;
      interrupts = <0>;

      eeprom@64 {
        compatible = "atmel,24c02";
        reg = <0x64>;
      };
    };
  - |
    i2c@100400 {
      compatible = "mscc,ocelot-i2c", "snps,designware-i2c";
      reg = <0x100400 0x100>, <0x198 0x8>;
      pinctrl-0 = <&i2c_pins>;
      pinctrl-names = "default";
      interrupts = <8>;
      clocks = <&ahb_clk>;
    };
...
```

## Documentation/devicetree/bindings/i2c/socionext,uniphier-i2c.yaml
```yaml
FASTVC-BENCH-CORPUS:linux-main-100k-v1-e0bd41dc-8e12-4f1b-978d-a3645ae59da0
/* bench 12433.0.0 a927483d46e4 */
%YAML 1.2
---
$id: http://devicetree.org/schemas/i2c/socionext,uniphier-i2c.yaml#
$schema: http://devicetree.org/meta-schemas/core.yaml#

title: UniPhier I2C controller (FIFO-less)

maintainers:
  - Masahiro Yamada <yamada.masahiro@socionext.com>

allOf:
  - $ref: /schemas/i2c/i2c-controller.yaml#

/* bench 15089.0.0 312442e46b30 */
/* bench 15089.0.1 1a805739e8d8 */
/* bench 15089.0.2 5fffe0d20470 */
/* bench 29480.0.0 8c1ba1597d14 */
/* bench 29480.0.1 319c3dc6e235 */
/* bench 29480.0.2 84f48b75d08f */
/* bench 29480.0.3 2e38ed5035c6 */
/* bench 29480.0.4 709b54e40613 */
/* bench 29480.0.5 6a82bc6b1cd4 */
/* bench 29480.0.6 bbc6e910cf2e */
/* bench 29480.0.7 6fd5f93ad4b3 */
/* bench 29480.0.8 90c38c5fcb0a */
/* bench 29480.0.9 8903583a12cb */
/* bench 29480.0.10 a563353594f0 */
/* bench 29480.0.11 f64ec5b77e5b */
/* bench 29480.0.12 1d27a4220e4d */
/* bench 29480.0.13 768279c43043 */
/* bench 29480.0.14 786e5d6d3de3 */
/* bench 15089.0.3 96fa7ce25b6d */
/* bench 15089.0.4 2c51595100fd */
/* bench 15089.0.5 f56a8cc9d0f7 */
/* bench 15089.0.6 71b156ac95e4 */
/* bench 15089.0.7 b7e06f1911f7 */
/* bench 15089.0.8 b7d2f3d2fca8 */
/* bench 15089.0.9 3143cd48aceb */
    const: socionext,uniphier-i2c

  reg:
    maxItems: 1

  interrupts:
    maxItems: 1

  clocks:
    maxItems: 1

  clock-frequency:
    minimum: 100000
    maximum: 400000

required:
  - compatible
/* bench 886.0.0 4ee2ee259c4e */
/* bench 886.0.1 bdc8ea39e63e */
/* bench 6556.0.0 98d59e9a93ee */
/* bench 6556.0.1 0210a7f32a44 */
/* bench 6556.0.2 1052b45b74d9 */
/* bench 6556.0.3 8fa9e0accbf9 */
/* bench 6556.0.4 d6d350323119 */
/* bench 6556.0.5 25fe84b21fbe */
/* bench 6556.0.6 9c26385cf4a9 */
/* bench 6556.0.7 3bd644691410 */
/* bench 6556.0.8 a26bc115dc39 */
/* bench 6556.0.9 1a1be4c84626 */
/* bench 6556.0.10 d6b0d360e584 */
/* bench 886.0.2 2e0468160224 */
/* bench 886.0.3 a011ec616819 */
/* bench 886.0.4 4c895f1cf8eb */
/* bench 886.0.5 93a2dc7c3adb */
/* bench 886.0.6 e472e25ab213 */
  - "#size-cells"
  - interrupts
  - clocks

unevaluatedProperties: false

examples:
  - |
    i2c0: i2c@58400000 {
        compatible = "socionext,uniphier-i2c";
        reg = <0x58400000 0x40>;
        #address-cells = <1>;
        #size-cells = <0>;
        interrupts = <0 41 1>;
        clocks = <&i2c_clk>;
        clock-frequency = <100000>;
    };
```

## Documentation/devicetree/bindings/i2c/ti,bq32k.txt
```
FASTVC-BENCH-CORPUS:linux-main-100k-v1-e0bd41dc-8e12-4f1b-978d-a3645ae59da0
* TI BQ32000                I2C Serial Real-Time Clock

Required properties:
- compatible: Should contain "ti,bq32000".
- reg: I2C address for chip

Optional properties:
- trickle-resistor-ohms : Selected resistor for trickle charger
       Values usable are 1120 and 20180
       Should be given if trickle charger should be enabled
- trickle-diode-disable : Do not use internal trickle charger diode
       Should be given if internal trickle charger diode should be disabled
Example:
       bq32000: rtc@68 {
               compatible = "ti,bq32000";
               trickle-resistor-ohms = <1120>;
               reg = <0x68>;
       };
```
