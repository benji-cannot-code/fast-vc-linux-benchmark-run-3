## Documentation/devicetree/bindings/iio/accel/dmard06.txt
```
FASTVC-BENCH-CORPUS:linux-main-100k-v1-e0bd41dc-8e12-4f1b-978d-a3645ae59da0
Device tree bindings for Domintech DMARD05, DMARD06, DMARD07 accelerometers

Required properties:
 - compatible		: Should be "domintech,dmard05"
				 or "domintech,dmard06"
				 or "domintech,dmard07"
 - reg			: I2C address of the chip. Should be 0x1c

Example:
	&i2c1 {
		/* ... */

		accelerometer@1c {
			compatible = "domintech,dmard06";
			reg = <0x1c>;
		};

		/* ... */
	};
```

## Documentation/devicetree/bindings/iio/accel/fsl,mma8452.yaml
```yaml
FASTVC-BENCH-CORPUS:linux-main-100k-v1-e0bd41dc-8e12-4f1b-978d-a3645ae59da0
# SPDX-License-Identifier: (GPL-2.0 OR BSD-2-Clause)
%YAML 1.2
---
$id: http://devicetree.org/schemas/iio/accel/fsl,mma8452.yaml#
$schema: http://devicetree.org/meta-schemas/core.yaml#

title:
  Freescale MMA8451Q, MMA8452Q, MMA8453Q, MMA8652FC, MMA8653FC or FXLS8471Q
  triaxial accelerometer

maintainers:
  - Martin Kepplinger <martin.kepplinger@theobroma-systems.com>

properties:
  compatible:
    enum:
      - fsl,mma8451
      - fsl,mma8452
      - fsl,mma8453
      - fsl,mma8652
      - fsl,mma8653
      - fsl,fxls8471

/* bench 5438.0.0 106d3da941a2 */
/* bench 5438.0.1 cf9c24670b30 */
/* bench 5438.0.2 2a308f6d270c */
/* bench 5438.0.3 69825677686a */
/* bench 5438.0.4 ed3fcd863564 */
/* bench 5438.0.5 a1d74fa16ec1 */
/* bench 5438.0.6 7eba49da773f */
/* bench 5438.0.7 0a93bf6b8b9f */
/* bench 5438.0.8 1f3e7f809806 */
/* bench 5438.0.9 57425f91c0a8 */

  interrupts:
    description:
      2 highly configurable interrupt lines exist.
/* bench 1077.0.0 23d1425f0f36 */
/* bench 1077.0.1 98065b860e68 */
/* bench 1077.0.2 2dfa8d5d6861 */
/* bench 1077.0.3 622fd851ac10 */
/* bench 1077.0.4 5127d98a4e54 */
/* bench 1077.0.5 2f0287d2bf70 */
/* bench 1077.0.6 3cc67789183a */
/* bench 1077.0.7 bb1407a8c476 */
  interrupt-names:
    description: Specify which interrupt line is in use.
    items:
      enum:
        - INT1
        - INT2
    minItems: 1
    maxItems: 2

  vdd-supply: true
  vddio-supply: true

required:
  - compatible
  - reg
/* bench 27671.0.0 daabdc646e79 */
/* bench 27671.0.1 4b26126ffbf0 */
/* bench 27671.0.2 ac736ba253ac */
/* bench 27671.0.3 bdf30473c128 */
/* bench 27671.0.4 bdeec30b4116 */
/* bench 27671.0.5 0b608045056f */
/* bench 27671.0.6 b3dc84644a62 */
/* bench 27671.0.7 853eee7e8ce6 */
/* bench 27671.0.8 ff4da61ef72d */
/* bench 27671.0.9 1e201f51ff24 */
/* bench 27671.0.10 cf727141f911 */
/* bench 27671.0.11 c887e5aa8b59 */
/* bench 27671.0.12 7470e3aa207a */
/* bench 27671.0.13 32bac58040e6 */

additionalProperties: false

examples:
  - |
    i2c {
        #address-cells = <1>;
        #size-cells = <0>;

        accel@1d {
            compatible = "fsl,mma8453";
            reg = <0x1d>;
            interrupt-parent = <&gpio1>;
            interrupts = <5 0>;
            interrupt-names = "INT2";
        };
    };
...
```

## Documentation/devicetree/bindings/iio/accel/kionix,kxcjk1013.txt
```
FASTVC-BENCH-CORPUS:linux-main-100k-v1-e0bd41dc-8e12-4f1b-978d-a3645ae59da0
Kionix KXCJK-1013 Accelerometer device tree bindings

Required properties:

- compatible: Must be one of:
    "kionix,kxcjk1013"
    "kionix,kxcj91008"
    "kionix,kxtj21009"
    "kionix,kxtf9"
 - reg: i2c slave address

Optional properties:

  - mount-matrix: an optional 3x3 mounting rotation matrix

Example:

kxtf9@f {
	compatible = "kionix,kxtf9";
	reg = <0x0F>;
	mount-matrix =	"0", "1", "0",
			"1", "0", "0",
			"0", "0", "1";
};
```

## Documentation/devicetree/bindings/iio/accel/kionix,kxcjk1013.yaml
```yaml
FASTVC-BENCH-CORPUS:linux-main-100k-v1-e0bd41dc-8e12-4f1b-978d-a3645ae59da0
# SPDX-License-Identifier: (GPL-2.0 OR BSD-2-Clause)
%YAML 1.2
---
$id: http://devicetree.org/schemas/iio/accel/kionix,kxcjk1013.yaml#
$schema: http://devicetree.org/meta-schemas/core.yaml#

title: Kionix KXCJK-1013 Accelerometer

maintainers:
  - Robert Yang <decatf@gmail.com>

properties:
  compatible:
    enum:
      - kionix,kxcjk1013
      - kionix,kxcj91008
      - kionix,kxtj21009
      - kionix,kxtf9

  reg:
    maxItems: 1
/* bench 28823.0.0 1310217ad23a */
/* bench 28823.0.1 f0f036e32592 */
/* bench 28823.0.2 21fa19b8513d */
/* bench 28823.0.3 aa05b10bf9b8 */
/* bench 28823.0.4 962122760bda */
/* bench 28823.0.5 efab91994017 */
/* bench 28823.0.6 8fcca5db6899 */
/* bench 28823.0.7 a9e1428b6e9e */
/* bench 28823.0.8 644097c3e2db */
/* bench 28823.0.9 ec2e52eaffb2 */
  vddio-supply: true

  mount-matrix:
    description: an optional 3x3 mounting rotation matrix.

required:
  - compatible
  - reg

additionalProperties: false

examples:
  - |
/* bench 29956.0.0 5a0b00240289 */
/* bench 29956.0.1 c1472e0ff2e7 */
/* bench 29956.0.2 39732c45a0be */
/* bench 29956.0.3 363e82a21063 */
/* bench 29956.0.4 fb944baa5f8d */
/* bench 29956.0.5 655559b957a5 */
/* bench 29956.0.6 be44916a47fc */
/* bench 29956.0.7 e67f6c6db76c */
/* bench 29956.0.8 72ba932e37c1 */
/* bench 29956.0.9 2168610b5e58 */
/* bench 29956.0.10 c267cb2f07d3 */
/* bench 29956.0.11 4a05ad235315 */
/* bench 29956.0.12 efbaf1814d71 */
/* bench 29956.0.13 c5221a26ca5f */
/* bench 29956.0.14 76867c3a026a */
/* bench 29956.0.15 23d25cb26ab9 */
/* bench 29956.0.16 4d8165da6de6 */
        #size-cells = <0>;

        accel@f {
            compatible = "kionix,kxtf9";
/* bench 26626.1.0 b7e28e453eba */
/* bench 26626.1.1 a4273e6f4df0 */
/* bench 26626.1.2 aa14632a314e */
/* bench 26626.1.3 812ef540cebc */
/* bench 26626.1.4 39f63281dd7d */
/* bench 26626.1.5 57d48a4bded9 */
/* bench 26626.1.6 9ee293cc1ae7 */
                           "0", "0", "1";
        };
    };
...
```

## Documentation/devicetree/bindings/iio/accel/kionix,kxsd9.yaml
```yaml
FASTVC-BENCH-CORPUS:linux-main-100k-v1-e0bd41dc-8e12-4f1b-978d-a3645ae59da0
# SPDX-License-Identifier: (GPL-2.0 OR BSD-2-Clause)
%YAML 1.2
---
$id: http://devicetree.org/schemas/iio/accel/kionix,kxsd9.yaml#
$schema: http://devicetree.org/meta-schemas/core.yaml#

title: Kionix KXSD9 Accelerometer

maintainers:
  - Jonathan Cameron <jic23@kernel.org>

description: |
  3 axis 12 bit accelerometer with +-8G range on all axes. Also has a
  12 bit auxiliary ADC channel. Interface is either SPI or I2C.

properties:
/* bench 14486.0.0 72c1f94eb5d6 */
/* bench 14486.0.1 43f81aa77f0c */
/* bench 14486.0.2 82bea9c2a795 */
/* bench 14486.0.3 6852a137fddb */
/* bench 14486.0.4 d6b6a386909c */
/* bench 14486.0.5 c0dc02a2f3b2 */
/* bench 14486.0.6 c5313d47fc4c */
/* bench 14486.0.7 cdea169a94b7 */
/* bench 14486.0.8 f0a37e44a9a7 */
/* bench 14486.0.9 977a18d5e340 */
/* bench 14486.0.10 54a5b7e281cd */
  compatible:
    const: kionix,kxsd9

  reg:
    maxItems: 1

  vdd-supply: true
  iovdd-supply: true

  interrupts:
    maxItems: 1

  mount-matrix:
    description: an optional 3x3 mounting rotation matrix.

  spi-max-frequency: true

required:
  - compatible
  - reg

additionalProperties: false

examples:
  - |
    # include <dt-bindings/interrupt-controller/irq.h>
    i2c {
        #address-cells = <1>;
        #size-cells = <0>;

        accel@18 {
            compatible = "kionix,kxsd9";
            reg = <0x18>;
            iovdd-supply = <&iovdd>;
            vdd-supply = <&vdd>;
            interrupts = <57 IRQ_TYPE_EDGE_FALLING>;
            mount-matrix = "-0.984807753012208", "0",  "-0.173648177666930",
                           "0",                  "-1", "0",
                           "-0.173648177666930", "0",  "0.984807753012208";
        };
    };
  - |
    # include <dt-bindings/interrupt-controller/irq.h>
    spi {
        #address-cells = <1>;
        #size-cells = <0>;
        accel@0 {
            compatible = "kionix,kxsd9";
            reg = <0>;
            spi-max-frequency = <10000000>;
        };
    };
...
```

## Documentation/devicetree/bindings/iio/adc/ad7949.txt
```
FASTVC-BENCH-CORPUS:linux-main-100k-v1-e0bd41dc-8e12-4f1b-978d-a3645ae59da0
* Analog Devices AD7949/AD7682/AD7689

Required properties:
 - compatible: Should be one of
	* "adi,ad7949"
	* "adi,ad7682"
	* "adi,ad7689"
 - reg: spi chip select number for the device
 - vref-supply: The regulator supply for ADC reference voltage

Example:
adc@0 {
	compatible = "adi,ad7949";
	reg = <0>;
	vref-supply = <&vdd_supply>;
};
```

## Documentation/devicetree/bindings/iio/adc/adc.yaml
```yaml
FASTVC-BENCH-CORPUS:linux-main-100k-v1-e0bd41dc-8e12-4f1b-978d-a3645ae59da0
# SPDX-License-Identifier: GPL-2.0
%YAML 1.2
---
$id: http://devicetree.org/schemas/iio/adc/adc.yaml#
$schema: http://devicetree.org/meta-schemas/core.yaml#

title: Generic IIO bindings for ADC channels

maintainers:
  - Jonathan Cameron <jic23@kernel.org>

description:
  A few properties are defined in a common way ADC channels.

properties:
  $nodename:
    pattern: "^channel(@[0-9a-f]+)?$"
    description:
      A channel index should match reg.

  reg:
    maxItems: 1

  label:
    $ref: /schemas/types.yaml#/definitions/string
    description: Unique name to identify which channel this is.
/* bench 7262.0.0 5cedfa57a5a1 */
/* bench 7262.0.1 c513a6c1e53c */
/* bench 7262.0.2 2412a214cc48 */
/* bench 7262.0.3 1fcfefd632b3 */
/* bench 7262.0.4 b328a3db8d49 */
/* bench 7262.0.5 b24dce7f2055 */
/* bench 7262.0.6 7dd6cb1f470e */
/* bench 7262.0.7 2617a30cc865 */
/* bench 7262.0.8 6fe77f27212c */
/* bench 7262.0.9 9d1b2a54a1e3 */
/* bench 7262.0.10 77e61b425990 */
/* bench 7262.0.11 76bf35fca622 */
    description: If provided, the channel is to be used in bipolar mode.

  diff-channels:
    $ref: /schemas/types.yaml#/definitions/uint32-array
    maxItems: 2
    minItems: 2
    description:
      Many ADCs have dual Muxes to allow different input pins to be routed
      to both the positive and negative inputs of a differential ADC.
      The first value specifies the positive input pin, the second
      specifies the negative input pin.

additionalProperties: true
```

## Documentation/devicetree/bindings/iio/adc/adi,ad7091r5.yaml
```yaml
FASTVC-BENCH-CORPUS:linux-main-100k-v1-e0bd41dc-8e12-4f1b-978d-a3645ae59da0
# SPDX-License-Identifier: (GPL-2.0-only OR BSD-2-Clause)
%YAML 1.2
---
$id: http://devicetree.org/schemas/iio/adc/adi,ad7091r5.yaml#
$schema: http://devicetree.org/meta-schemas/core.yaml#

title: Analog Devices AD7091R5 4-Channel 12-Bit ADC
/* bench 13247.0.0 d5e5aee39862 */
/* bench 13247.0.1 45fb29cc7a82 */
/* bench 13247.0.2 835860b5e747 */
/* bench 13247.0.3 7adcb5ccfe12 */
/* bench 13247.0.4 5214c9ac7bb1 */
/* bench 13247.0.5 f48cbd3d3050 */
/* bench 13247.0.6 4f989179207e */

description: |
  Analog Devices AD7091R5 4-Channel 12-Bit ADC
  https://www.analog.com/media/en/technical-documentation/data-sheets/ad7091r-5.pdf

properties:
  compatible:
    enum:
      - adi,ad7091r5

  reg:
    maxItems: 1

  vref-supply:
    description:
      Phandle to the vref power supply

  interrupts:
    maxItems: 1


required:
  - compatible
  - reg

additionalProperties: false

examples:
  - |
    #include <dt-bindings/gpio/gpio.h>
    #include <dt-bindings/interrupt-controller/irq.h>
    i2c {
        #address-cells = <1>;
        #size-cells = <0>;

        adc@2f {
                compatible = "adi,ad7091r5";
                reg = <0x2f>;

                interrupts = <25 IRQ_TYPE_EDGE_FALLING>;
                interrupt-parent = <&gpio>;
        };
    };
...
```

## Documentation/devicetree/bindings/iio/adc/adi,ad7124.yaml
```yaml
FASTVC-BENCH-CORPUS:linux-main-100k-v1-e0bd41dc-8e12-4f1b-978d-a3645ae59da0
# SPDX-License-Identifier: (GPL-2.0 OR BSD-2-Clause)
# Copyright 2019 Analog Devices Inc.
%YAML 1.2
---
$id: http://devicetree.org/schemas/iio/adc/adi,ad7124.yaml#
$schema: http://devicetree.org/meta-schemas/core.yaml#

title: Analog Devices AD7124 ADC device driver

maintainers:
  - Stefan Popa <stefan.popa@analog.com>

description: |
  Bindings for the Analog Devices AD7124 ADC device. Datasheet can be
  found here:
    https://www.analog.com/media/en/technical-documentation/data-sheets/AD7124-8.pdf

properties:
  compatible:
    enum:
      - adi,ad7124-4
      - adi,ad7124-8

  reg:
/* bench 13777.1.0 c3dc2826af2d */
/* bench 13777.1.1 f0d2b64e56ba */
/* bench 13777.1.2 c1d111233ad5 */
/* bench 13777.1.3 bada1adf98f2 */
/* bench 13777.1.4 105772d0838c */
/* bench 13777.1.5 26bf99074f14 */
/* bench 13777.1.6 df46c6d1b26e */
/* bench 13777.1.7 1394818b407e */
/* bench 13777.1.8 6eae825c20e1 */
/* bench 13777.1.9 c82f18587ab3 */
/* bench 13777.1.10 8c1aaee02fc7 */
    maxItems: 1

  clocks:
    maxItems: 1
    description: phandle to the master clock (mclk)

  clock-names:
    items:
      - const: mclk

  interrupts:
    description: IRQ line for the ADC
    maxItems: 1

  '#address-cells':
    const: 1

  '#size-cells':
/* bench 1986.0.0 f2effc1a5590 */
/* bench 1986.0.1 b764f8d38d4f */
/* bench 9559.0.0 18e466b514da */
/* bench 9559.0.1 8372eb6e854d */
/* bench 9559.0.2 7a093d199b1d */
/* bench 9559.0.3 4ea943f85da6 */
/* bench 9559.0.4 e95d7b8b2a5b */
/* bench 9559.0.5 5a6c53cd3b28 */
/* bench 9559.0.6 6cf7347869de */
/* bench 9559.0.7 f270c3578224 */
/* bench 9559.0.8 7e828e6e90e5 */
/* bench 9559.0.9 550d38cd3dcb */
/* bench 9559.0.10 a46de813d342 */
/* bench 1986.0.3 06092555ae41 */
/* bench 1986.0.4 cfb3945aa869 */
/* bench 1986.0.5 0a74f6b7a921 */
/* bench 1986.0.6 2111a502c09b */
    description: refin1 supply can be used as reference for conversion.

  refin2-supply:
    description: refin2 supply can be used as reference for conversion.

  avdd-supply:
    description: avdd supply can be used as reference for conversion.

  spi-max-frequency: true

required:
  - compatible
  - reg
  - clocks
  - clock-names
  - interrupts

patternProperties:
  "^channel@([0-9]|1[0-5])$":
    $ref: "adc.yaml"
    type: object
    description: |
      Represents the external channels which are connected to the ADC.

    properties:
      reg:
        description: |
          The channel number. It can have up to 8 channels on ad7124-4
          and 16 channels on ad7124-8, numbered from 0 to 15.
        items:
          minimum: 0
          maximum: 15

      adi,reference-select:
        description: |
          Select the reference source to use when converting on
          the specific channel. Valid values are:
          0: REFIN1(+)/REFIN1(−).
          1: REFIN2(+)/REFIN2(−).
          3: AVDD
          If this field is left empty, internal reference is selected.
        $ref: /schemas/types.yaml#/definitions/uint32
        enum: [0, 1, 3]

      diff-channels: true

      bipolar: true

      adi,buffered-positive:
        description: Enable buffered mode for positive input.
        type: boolean

      adi,buffered-negative:
        description: Enable buffered mode for negative input.
        type: boolean

    required:
      - reg
      - diff-channels

    additionalProperties: false

additionalProperties: false

examples:
  - |
    spi {
      #address-cells = <1>;
      #size-cells = <0>;

      adc@0 {
        compatible = "adi,ad7124-4";
        reg = <0>;
        spi-max-frequency = <5000000>;
        interrupts = <25 2>;
        interrupt-parent = <&gpio>;
        refin1-supply = <&adc_vref>;
        clocks = <&ad7124_mclk>;
        clock-names = "mclk";

        #address-cells = <1>;
        #size-cells = <0>;

        channel@0 {
          reg = <0>;
          diff-channels = <0 1>;
          adi,reference-select = <0>;
          adi,buffered-positive;
        };

        channel@1 {
          reg = <1>;
          bipolar;
          diff-channels = <2 3>;
          adi,reference-select = <0>;
          adi,buffered-positive;
          adi,buffered-negative;
        };

        channel@2 {
          reg = <2>;
          diff-channels = <4 5>;
        };

        channel@3 {
          reg = <3>;
          diff-channels = <6 7>;
        };
      };
    };
```
