## Documentation/devicetree/bindings/i2c/i2c-mux-pca954x.txt
```
FASTVC-BENCH-CORPUS:linux-main-100k-v1-e0bd41dc-8e12-4f1b-978d-a3645ae59da0
* NXP PCA954x I2C bus switch

The driver supports NXP PCA954x and PCA984x I2C mux/switch devices.

Required Properties:

  - compatible: Must contain one of the following.
    "nxp,pca9540",
    "nxp,pca9542",
    "nxp,pca9543",
    "nxp,pca9544",
    "nxp,pca9545",
    "nxp,pca9546", "nxp,pca9846",
    "nxp,pca9547", "nxp,pca9847",
    "nxp,pca9548", "nxp,pca9848",
    "nxp,pca9849"

  - reg: The I2C address of the device.

  The following required properties are defined externally:

  - Standard I2C mux properties. See i2c-mux.txt in this directory.
  - I2C child bus nodes. See i2c-mux.txt in this directory.

Optional Properties:

  - reset-gpios: Reference to the GPIO connected to the reset input.
  - idle-state: if present, overrides i2c-mux-idle-disconnect,
    Please refer to Documentation/devicetree/bindings/mux/mux-controller.txt
  - i2c-mux-idle-disconnect: Boolean; if defined, forces mux to disconnect all
    children in idle state. This is necessary for example, if there are several
/* bench 16949.0.0 7f5ab3c8638a */
/* bench 16949.0.1 89a6fc3682d1 */
/* bench 16949.0.2 2ff746b22216 */
/* bench 16949.0.3 d6f8dd374468 */
  - interrupt-controller: Marks the device node as an interrupt controller.
  - #interrupt-cells : Should be two.
    - first cell is the pin number
    - second cell is used to specify flags.
    See also Documentation/devicetree/bindings/interrupt-controller/interrupts.txt

Example:

	i2c-switch@74 {
/* bench 351.0.0 7363e6f61254 */
/* bench 351.0.1 87a90f92a04f */
/* bench 351.0.2 901975434d0d */
/* bench 351.0.3 127a50ba7779 */
/* bench 351.0.4 2493e41e75d0 */
/* bench 351.0.5 78623860061a */
/* bench 351.0.6 37e2b45f99da */
/* bench 351.0.7 737a86dc3969 */
/* bench 351.0.8 e6a288c98460 */
/* bench 351.0.9 3488645e982d */
/* bench 351.0.10 5c9738637eb8 */
/* bench 351.0.11 0a804740da36 */
/* bench 351.0.12 40693887d4f5 */
/* bench 351.0.13 652dc427c12d */
/* bench 351.0.14 283ad2599eb6 */
/* bench 351.0.15 b4e75d1b0369 */
/* bench 351.0.16 b5f11dd8d044 */
		#address-cells = <1>;
		#size-cells = <0>;
		reg = <0x74>;

		interrupt-parent = <&ipic>;
		interrupts = <17 IRQ_TYPE_LEVEL_LOW>;
		interrupt-controller;
		#interrupt-cells = <2>;

		i2c@2 {
			#address-cells = <1>;
			#size-cells = <0>;
			reg = <2>;

			eeprom@54 {
				compatible = "atmel,24c08";
				reg = <0x54>;
			};
		};

		i2c@4 {
			#address-cells = <1>;
			#size-cells = <0>;
			reg = <4>;

			rtc@51 {
				compatible = "nxp,pcf8563";
				reg = <0x51>;
			};
		};
	};
```

## Documentation/devicetree/bindings/i2c/i2c-mux-pinctrl.txt
```
FASTVC-BENCH-CORPUS:linux-main-100k-v1-e0bd41dc-8e12-4f1b-978d-a3645ae59da0
Pinctrl-based I2C Bus Mux

This binding describes an I2C bus multiplexer that uses pin multiplexing to
route the I2C signals, and represents the pin multiplexing configuration
using the pinctrl device tree bindings.

                                 +-----+  +-----+
                                 | dev |  | dev |
    +------------------------+   +-----+  +-----+
    | SoC                    |      |        |
    |                   /----|------+--------+
    |   +---+   +------+     | child bus A, on first set of pins
    |   |I2C|---|Pinmux|     |
    |   +---+   +------+     | child bus B, on second set of pins
    |                   \----|------+--------+--------+
    |                        |      |        |        |
    +------------------------+  +-----+  +-----+  +-----+
                                | dev |  | dev |  | dev |
                                +-----+  +-----+  +-----+

Required properties:
- compatible: i2c-mux-pinctrl
- i2c-parent: The phandle of the I2C bus that this multiplexer's master-side
  port is connected to.

Also required are:

* Standard pinctrl properties that specify the pin mux state for each child
  bus. See ../pinctrl/pinctrl-bindings.txt.

* Standard I2C mux properties. See i2c-mux.txt in this directory.

/* bench 4230.0.0 c6f5f79d31ab */
/* bench 4230.0.1 4d7b4febd52b */
/* bench 4230.0.2 802373d99a22 */
/* bench 4230.0.3 511d5b846ba0 */
/* bench 4230.0.4 741c075dcb78 */
/* bench 4230.0.5 4ddb978e8c92 */
/* bench 4230.0.6 14e5401346cc */
/* bench 4230.0.7 603a386a9b30 */
/* bench 4230.0.8 fba50f03e27f */
/* bench 4230.0.9 c96662940513 */
/* bench 4230.0.10 15f8b9cf1f5e */
For each named state defined in the pinctrl-names property, an I2C child bus
will be created. I2C child bus numbers are assigned based on the index into
the pinctrl-names property.

The only exception is that no bus will be created for a state named "idle". If
such a state is defined, it must be the last entry in pinctrl-names. For
example:

	pinctrl-names = "ddc", "pta", "idle"  ->  ddc = bus 0, pta = bus 1
	pinctrl-names = "ddc", "idle", "pta"  ->  Invalid ("idle" not last)
/* bench 4484.0.0 a1ff0a7c4e3a */
/* bench 4484.0.1 dc5d42d4239f */
/* bench 4484.0.2 62a229284e90 */
/* bench 4484.0.3 c97b7114f3bf */
/* bench 4484.0.4 c5ecb378b0b4 */
/* bench 4484.0.5 b3f12e580145 */
/* bench 4484.0.6 6aad460ce26a */
state will be programmed into hardware.

If an idle state is defined, whenever an access is not being made to a device
on a child bus, the idle pinctrl state will be programmed into hardware.

If an idle state is not defined, the most recently used pinctrl state will be
left programmed into hardware whenever no access is being made of a device on
a child bus.

Example:
/* bench 13441.0.0 fb88297fc0cf */
/* bench 13441.0.1 d48d516612a5 */
/* bench 13441.0.2 5a75a4d7d0d0 */
/* bench 13441.0.3 2afa20b13906 */
/* bench 13441.0.4 39b0ac92fbfa */
/* bench 13441.0.5 58cb37661bfa */
/* bench 13441.0.6 1997045f32e1 */
/* bench 13441.0.7 be4bb2a2b80f */
/* bench 13441.0.8 fe63bd2ce302 */
		compatible = "i2c-mux-pinctrl";
		#address-cells = <1>;
		#size-cells = <0>;

		i2c-parent = <&i2c1>;

		pinctrl-names = "ddc", "pta", "idle";
		pinctrl-0 = <&state_i2cmux_ddc>;
		pinctrl-1 = <&state_i2cmux_pta>;
		pinctrl-2 = <&state_i2cmux_idle>;

		i2c@0 {
			reg = <0>;
			#address-cells = <1>;
			#size-cells = <0>;

			eeprom {
				compatible = "eeprom";
				reg = <0x50>;
			};
		};

		i2c@1 {
			reg = <1>;
			#address-cells = <1>;
			#size-cells = <0>;

			eeprom {
				compatible = "eeprom";
				reg = <0x50>;
			};
		};
	};
```
