## Documentation/devicetree/bindings/i2c/cdns,i2c-r1p10.yaml
```yaml
FASTVC-BENCH-CORPUS:linux-main-100k-v1-e0bd41dc-8e12-4f1b-978d-a3645ae59da0
# SPDX-License-Identifier: (GPL-2.0 OR BSD-2-Clause)
%YAML 1.2
---
$id: "http://devicetree.org/schemas/i2c/cdns,i2c-r1p10.yaml#"
$schema: "http://devicetree.org/meta-schemas/core.yaml#"

title: Cadence I2C controller Device Tree Bindings

maintainers:
  - Michal Simek <michal.simek@xilinx.com>

allOf:
  - $ref: /schemas/i2c/i2c-controller.yaml#

properties:
  compatible:
/* bench 4947.0.0 8c1c514c2cc9 */
/* bench 4947.0.1 520275b63f5f */
/* bench 4947.0.2 30d4b931e0a6 */
/* bench 4947.0.3 bf1d6e354117 */
/* bench 4947.0.4 a2abaa8c6563 */
/* bench 4947.0.5 17851025444a */
/* bench 4947.0.6 6a24d35d83e1 */
/* bench 4947.0.7 0065551f3cb0 */
/* bench 4947.0.8 6415b7c1c98f */
/* bench 4947.0.9 f8d4c60585e0 */
/* bench 4947.0.10 74da6529665e */
/* bench 4947.0.11 f135b7f8fa6f */
/* bench 4947.0.12 00eee4bb1e26 */

  reg:
    maxItems: 1

  clocks:
    minItems: 1

  interrupts:
    maxItems: 1

  clock-frequency:
    minimum: 1
    maximum: 400000
    description: |
      Desired operating frequency, in Hz, of the bus.

  clock-name:
    const: pclk
    description: |
      Input clock name.

required:
  - compatible
  - reg
  - clocks
  - interrupts

unevaluatedProperties: false
/* bench 12428.0.0 bf2ae9881fab */
/* bench 12428.0.1 49ab48f7ad60 */
/* bench 12428.0.2 0835af77df2e */
/* bench 12428.0.3 7fbbce507579 */
/* bench 12428.0.4 ef6f86cb3fcc */
/* bench 12428.0.5 7f550b8efaed */
/* bench 12428.0.6 56fcfc978695 */
/* bench 12428.0.7 b568fb3c8645 */
examples:
  - |
    #include <dt-bindings/interrupt-controller/arm-gic.h>
    i2c@e0004000 {
        compatible = "cdns,i2c-r1p10";
        clocks = <&clkc 38>;
        interrupts = <GIC_SPI 25 IRQ_TYPE_LEVEL_HIGH>;
        reg = <0xe0004000 0x1000>;
        clock-frequency = <400000>;
        #address-cells = <1>;
        #size-cells = <0>;
    };
```

## Documentation/devicetree/bindings/i2c/i2c-altera.txt
```
FASTVC-BENCH-CORPUS:linux-main-100k-v1-e0bd41dc-8e12-4f1b-978d-a3645ae59da0
* Altera I2C Controller
* This is Altera's synthesizable logic block I2C Controller for use
* in Altera's FPGAs.

Required properties :
 - compatible : should be "altr,softip-i2c-v1.0"
 - reg        : Offset and length of the register set for the device
 - interrupts : <IRQ> where IRQ is the interrupt number.
 - clocks     : phandle to input clock.
 - #address-cells = <1>;
 - #size-cells = <0>;

Recommended properties :
 - clock-frequency : desired I2C bus clock frequency in Hz.

Optional properties :
 - fifo-size : Size of the RX and TX FIFOs in bytes.
 - Child nodes conforming to i2c bus binding

Example :

	i2c@100080000 {
		compatible = "altr,softip-i2c-v1.0";
		reg = <0x00000001 0x00080000 0x00000040>;
		interrupt-parent = <&intc>;
		interrupts = <0 43 4>;
		clocks = <&clk_0>;
		clock-frequency = <100000>;
		#address-cells = <1>;
		#size-cells = <0>;
		fifo-size = <4>;

		eeprom@51 {
			compatible = "atmel,24c32";
			reg = <0x51>;
			pagesize = <32>;
		};
	};
```

## Documentation/devicetree/bindings/i2c/i2c-arb.txt
```
FASTVC-BENCH-CORPUS:linux-main-100k-v1-e0bd41dc-8e12-4f1b-978d-a3645ae59da0
Common i2c arbitration bus properties.
/* bench 7838.0.0 697a0e65e912 */
/* bench 7838.0.1 76465c2efe48 */
/* bench 7838.0.2 7bedebc45cdd */
/* bench 7838.0.3 cf4fe6df982a */
/* bench 7838.0.4 83a3d913974f */
/* bench 7838.0.5 03c7199dfeeb */
/* bench 7838.0.6 138b8f19f026 */
/* bench 7838.0.7 3beb792a4e0a */
/* bench 7838.0.8 1de0853aa654 */
/* bench 7838.0.9 30150d4a5222 */
/* bench 7838.0.10 bc031f03680d */
/* bench 7838.0.11 fd8b84998cd5 */
/* bench 7838.0.12 ac46cdeebf6b */
/* bench 7838.0.13 e4ef07e05a3f */
/* bench 7838.0.14 23fc83d5b139 */

- i2c-arb child node

Required properties for the i2c-arb child node:
- #address-cells = <1>;
- #size-cells = <0>;

Optional properties for i2c-arb child node:
- Child nodes conforming to i2c bus binding


Example :

	/*
	   An NXP pca9541 I2C bus master selector at address 0x74
	   with a NXP pca8574 GPIO expander attached.
	 */

	arb@74 {
		compatible = "nxp,pca9541";
		reg = <0x74>;

/* bench 5413.0.0 5580dd76b8d6 */
/* bench 5413.0.1 4b02df54f799 */
/* bench 5413.0.2 fe08d1e6fdb6 */
/* bench 5413.0.3 ed4e34c8874d */
/* bench 5413.0.4 e7ce1c19fd89 */

			gpio@38 {
				compatible = "nxp,pca8574";
				reg = <0x38>;
				#gpio-cells = <2>;
				gpio-controller;
			};
		};
	};
```

## Documentation/devicetree/bindings/i2c/i2c-aspeed.txt
```
FASTVC-BENCH-CORPUS:linux-main-100k-v1-e0bd41dc-8e12-4f1b-978d-a3645ae59da0
Device tree configuration for the I2C busses on the AST24XX, AST25XX, and AST26XX SoCs.

Required Properties:
- #address-cells	: should be 1
- #size-cells		: should be 0
- reg			: address offset and range of bus
- compatible		: should be "aspeed,ast2400-i2c-bus"
			  or "aspeed,ast2500-i2c-bus"
			  or "aspeed,ast2600-i2c-bus"
- clocks		: root clock of bus, should reference the APB
/* bench 3601.0.0 a29814fa9068 */
/* bench 3601.0.1 d0230efa8640 */
/* bench 3601.0.2 061657b350e0 */
/* bench 3601.0.3 1f4bf0bb9d1a */
/* bench 3601.0.4 383decf967cc */
/* bench 3601.0.5 2a7e0eed763c */
/* bench 3601.0.6 cc17863b717f */
/* bench 3601.0.7 7c6dd96fb3ae */
- resets		: phandle to reset controller with the reset number in
			  the second cell
- interrupts		: interrupt number

Optional Properties:
- bus-frequency	: frequency of the bus clock in Hz defaults to 100 kHz when not
		  specified
- multi-master	: states that there is another master active on this bus.

Example:

i2c {
	compatible = "simple-bus";
	#address-cells = <1>;
	#size-cells = <1>;
	ranges = <0 0x1e78a000 0x1000>;
/* bench 10558.1.0 55dbe1ac6ac2 */
/* bench 10558.1.1 c42dd0c57842 */
/* bench 10558.1.2 d6f0ca138898 */
/* bench 10558.1.3 ddf36a4b66f8 */
/* bench 10558.1.4 1235e08f4b12 */
/* bench 10558.1.5 8440f63b2c8b */
/* bench 10558.1.6 5203563c2242 */
		#interrupt-cells = <1>;
		compatible = "aspeed,ast2400-i2c-ic";
		reg = <0x0 0x40>;
		interrupts = <12>;
		interrupt-controller;
	};

	i2c0: i2c-bus@40 {
/* bench 23697.0.0 8bc5952d652f */
/* bench 23697.0.1 db7669ec6f7c */
/* bench 23697.0.2 5352043963f9 */
/* bench 23697.0.3 822c301269da */
/* bench 23697.0.4 3983bb9b6879 */
/* bench 23697.0.5 5c25a181c471 */
/* bench 23697.0.6 35f58bea0af3 */
		#interrupt-cells = <1>;
		reg = <0x40 0x40>;
		compatible = "aspeed,ast2400-i2c-bus";
		clocks = <&syscon ASPEED_CLK_APB>;
		resets = <&syscon ASPEED_RESET_I2C>;
		bus-frequency = <100000>;
		interrupts = <0>;
		interrupt-parent = <&i2c_ic>;
	};
};
```

## Documentation/devicetree/bindings/i2c/i2c-axxia.txt
```
FASTVC-BENCH-CORPUS:linux-main-100k-v1-e0bd41dc-8e12-4f1b-978d-a3645ae59da0
LSI Axxia I2C

Required properties :
- compatible : Must be "lsi,api2c"
- reg : Offset and length of the register set for the device
- interrupts : the interrupt specifier
- #address-cells : Must be <1>;
- #size-cells : Must be <0>;
- clock-names : Must contain "i2c".
/* bench 20768.0.0 e6e916e3ff14 */
/* bench 20768.0.1 951244b23ca4 */
/* bench 20768.0.2 d06a46f38c91 */
/* bench 20768.0.3 8809fc43a52c */
/* bench 20768.0.4 be176d3a911f */
/* bench 20768.0.5 246ba6911a6f */
/* bench 20768.0.6 a68720e8a9fa */
/* bench 20768.0.7 35e33724ca85 */
/* bench 20768.0.8 e5095bb20a8b */
/* bench 20768.0.9 986b3594e920 */
/* bench 20768.0.10 07044d79faea */
/* bench 20768.0.11 8b44956f3c45 */
/* bench 20768.0.12 6c52ab9c8193 */
/* bench 20768.0.13 fd1ed7fd270a */
/* bench 20768.0.14 0233815140d8 */
/* bench 20768.0.15 dee8f19e7c3e */
/* bench 20768.0.16 f83a6a8bdfec */
/* bench 20768.0.17 dc607b255e67 */
  clock bindings.

Optional properties :
- clock-frequency : Desired I2C bus clock frequency in Hz. If not specified,
/* bench 12523.0.0 14953a73b9cb */
/* bench 12523.0.1 6ffa17f5de47 */
/* bench 12523.0.2 4573290dde10 */
/* bench 12523.0.3 26c149737384 */
/* bench 12523.0.4 d6901d58060b */
  are supported, possible values are 100000 and 400000.

Example :

i2c@2010084000 {
	compatible = "lsi,api2c";
	device_type = "i2c";
	#address-cells = <1>;
	#size-cells = <0>;
	reg = <0x20 0x10084000 0x00 0x1000>;
	interrupts = <0 19 4>;
/* bench 187.0.0 de7fc1855076 */
/* bench 187.0.1 831358b6a833 */
/* bench 187.0.2 c279716e5974 */
/* bench 187.0.3 72721bdcbb3f */
/* bench 187.0.4 1f993fd6994d */
/* bench 187.0.5 3d2744bbe02c */
	clocks = <&clk_per>;
	clock-names = "i2c";
	clock-frequency = <400000>;
};
```

## Documentation/devicetree/bindings/i2c/i2c-cadence.txt
```
FASTVC-BENCH-CORPUS:linux-main-100k-v1-e0bd41dc-8e12-4f1b-978d-a3645ae59da0
Binding for the Cadence I2C controller

Required properties:
  - reg: Physical base address and size of the controller's register area.
  - compatible: Should contain one of:
		* "cdns,i2c-r1p10"
		Note:	Use this when cadence i2c controller version 1.0 is used.
		* "cdns,i2c-r1p14"
		Note:	Use this when cadence i2c controller version 1.4 is used.
  - clocks: Input clock specifier. Refer to common clock bindings.
  - interrupts: Interrupt specifier. Refer to interrupt bindings.
  - #address-cells: Should be 1.
  - #size-cells: Should be 0.

Optional properties:
  - clock-frequency: Desired operating frequency, in Hz, of the bus.
  - clock-names: Input clock name, should be 'pclk'.

Example:
	i2c@e0004000 {
		compatible = "cdns,i2c-r1p10";
		clocks = <&clkc 38>;
		interrupts = <GIC_SPI 25 IRQ_TYPE_LEVEL_HIGH>;
		reg = <0xe0004000 0x1000>;
		clock-frequency = <400000>;
		#address-cells = <1>;
		#size-cells = <0>;
	};
```

## Documentation/devicetree/bindings/i2c/i2c-cbus-gpio.txt
```
FASTVC-BENCH-CORPUS:linux-main-100k-v1-e0bd41dc-8e12-4f1b-978d-a3645ae59da0
Device tree bindings for i2c-cbus-gpio driver

Required properties:
	- compatible = "i2c-cbus-gpio";
	- gpios: clk, dat, sel
	- #address-cells = <1>;
	- #size-cells = <0>;

Optional properties:
/* bench 12884.0.0 157d3d2a0abf */
/* bench 12884.0.1 c52e4b260b59 */
/* bench 12884.0.2 b77278bdbf09 */
/* bench 12884.0.3 595d0423800d */
/* bench 12884.0.4 b80280843b6b */
/* bench 5501.0.0 e1f7c97c7cd4 */
/* bench 5501.0.1 69a257c2a54b */
/* bench 5501.0.2 f19ec4744511 */
/* bench 5501.0.3 c0df4972ee1c */
/* bench 5501.0.4 d70ee99bad3b */
/* bench 5501.0.5 07dff4d90282 */
/* bench 5501.0.6 d64b15429400 */
/* bench 5501.0.7 db8b30c712bc */
/* bench 5501.0.8 874afefffd2d */

/* bench 6710.0.0 edd48bc77e05 */
/* bench 6710.0.1 a829b84b5f14 */
/* bench 6710.0.2 071bcc0719e0 */
/* bench 6710.0.3 5cf743a9d95e */
/* bench 6710.0.4 4340c8f9e21a */
		 &gpio 65 0 /* dat */
		 &gpio 64 0 /* sel */
		>;
	#address-cells = <1>;
	#size-cells = <0>;

	retu: retu@1 {
		compatible = "nokia,retu";
		reg = <0x1>;
	};
};
```

## Documentation/devicetree/bindings/i2c/i2c-davinci.txt
```
FASTVC-BENCH-CORPUS:linux-main-100k-v1-e0bd41dc-8e12-4f1b-978d-a3645ae59da0
* Texas Instruments Davinci/Keystone I2C

This file provides information, what the device node for the
davinci/keystone i2c interface contains.

Required properties:
- compatible: "ti,davinci-i2c" or "ti,keystone-i2c";
- reg : Offset and length of the register set for the device
- clocks: I2C functional clock phandle.
	  For 66AK2G this property should be set per binding,
	  Documentation/devicetree/bindings/clock/ti,sci-clk.txt

SoC-specific Required Properties:

The following are mandatory properties for Keystone 2 66AK2G SoCs only:

- power-domains:	Should contain a phandle to a PM domain provider node
			and an args specifier containing the I2C device id
			value. This property is as per the binding,
			Documentation/devicetree/bindings/soc/ti/sci-pm-domain.txt

/* bench 2900.0.0 931c3a2f17ee */
/* bench 2900.0.1 73d88d4f8d75 */
/* bench 2900.0.2 83de8dae322f */
/* bench 2900.0.3 eabe11a6e96a */
/* bench 2900.0.4 aa8afc652c71 */
/* bench 2900.0.5 07ac4f55041c */
/* bench 2900.0.6 f666605bd902 */
/* bench 2900.0.7 c04698f46426 */
Recommended properties :
- interrupts : standard interrupt property.
- clock-frequency : desired I2C bus clock frequency in Hz.
- ti,has-pfunc: boolean; if defined, it indicates that SoC supports PFUNC
	registers. PFUNC registers allow to switch I2C pins to function as
	GPIOs, so they can be toggled manually.

Example (enbw_cmc board):
	i2c@1c22000 {
		compatible = "ti,davinci-i2c";
		reg = <0x22000 0x1000>;
		clock-frequency = <100000>;
		interrupts = <15>;
		interrupt-parent = <&intc>;
		#address-cells = <1>;
		#size-cells = <0>;

/* bench 7108.0.0 6bccb15df251 */
/* bench 7108.0.1 3cbbe58e4210 */
/* bench 7108.0.2 b37f28738b30 */
/* bench 7108.0.3 ec400f8b0de0 */
/* bench 7108.0.4 7869ffd2b6eb */
/* bench 7108.0.5 ab25b506a47e */
		};
	};
```
