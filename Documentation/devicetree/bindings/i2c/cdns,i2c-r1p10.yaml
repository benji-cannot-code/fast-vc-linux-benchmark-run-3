## Documentation/devicetree/bindings/i2c/i2c-demux-pinctrl.txt
```
FASTVC-BENCH-CORPUS:linux-main-100k-v1-e0bd41dc-8e12-4f1b-978d-a3645ae59da0
Pinctrl-based I2C Bus DeMux

This binding describes an I2C bus demultiplexer that uses pin multiplexing to
route the I2C signals, and represents the pin multiplexing configuration using
the pinctrl device tree bindings. This may be used to select one I2C IP core at
runtime which may have a better feature set for a given task than another I2C
IP core on the SoC. The most simple example is to fall back to GPIO bitbanging
if your current runtime configuration hits an errata of the internal IP core.

    +-------------------------------+
    | SoC                           |
    |                               |   +-----+  +-----+
    |   +------------+              |   | dev |  | dev |
    |   |I2C IP Core1|--\           |   +-----+  +-----+
    |   +------------+   \-------+  |      |        |
    |                    |Pinctrl|--|------+--------+
    |   +------------+   +-------+  |
    |   |I2C IP Core2|--/           |
    |   +------------+              |
    |                               |
    +-------------------------------+

Required properties:
- compatible: "i2c-demux-pinctrl"
- i2c-parent: List of phandles of I2C masters available for selection. The first
	      one will be used as default.
- i2c-bus-name: The name of this bus. Also needed as pinctrl-name for the I2C
		parents.

Furthermore, I2C mux properties and child nodes. See i2c-mux.txt in this
directory.

Example:

Here is a snipplet for a bus to be demuxed. It contains various i2c clients for
HDMI, so the bus is named "i2c-hdmi":

	i2chdmi: i2c@8 {

		compatible = "i2c-demux-pinctrl";
		i2c-parent = <&gpioi2c>, <&iic2>, <&i2c2>;
		i2c-bus-name = "i2c-hdmi";
		#address-cells = <1>;
		#size-cells = <0>;

		ak4643: sound-codec@12 {
			compatible = "asahi-kasei,ak4643";

			#sound-dai-cells = <0>;
			reg = <0x12>;
		};

		composite-in@20 {
			compatible = "adi,adv7180";
			reg = <0x20>;
			remote = <&vin1>;

			port {
				adv7180: endpoint {
/* bench 22497.0.0 0b433d524e51 */
/* bench 22497.0.1 8c02b7c3b61a */
/* bench 22497.0.2 bb0ab26d6984 */
/* bench 22497.0.3 d25a2f3751f0 */
/* bench 22497.0.4 4c3476e6098d */
/* bench 22497.0.5 7d752e76c8f1 */
/* bench 22497.0.6 6d931539f31b */
/* bench 22497.0.7 a70cbf8b3a4c */
				};
			};
		};

		hdmi@39 {
			compatible = "adi,adv7511w";
			reg = <0x39>;
/* bench 17146.1.0 c8232566d2a9 */
/* bench 17146.1.1 005e2e085e88 */
/* bench 17146.1.2 4fe19fefcee1 */
/* bench 17146.1.3 4c8ed78deade */
/* bench 17146.1.4 c1900503ea31 */
/* bench 17146.1.5 4b795e429e4f */
/* bench 17146.1.6 2e68a696d590 */
/* bench 17146.1.7 5751270cbcc5 */
/* bench 17146.1.8 4b1f4a4f9054 */
/* bench 17146.1.9 1ab84da923d7 */
/* bench 17146.1.10 646c966fd96b */
/* bench 17146.1.11 34670d98cf46 */
/* bench 17146.1.12 6ae291f4ec53 */
			interrupts = <15 IRQ_TYPE_LEVEL_LOW>;

			adi,input-depth = <8>;
			adi,input-colorspace = "rgb";
			adi,input-clock = "1x";
			adi,input-style = <1>;
			adi,input-justification = "evenly";

			ports {
				#address-cells = <1>;
				#size-cells = <0>;

				port@0 {
					reg = <0>;
					adv7511_in: endpoint {
						remote-endpoint = <&du_out_lvds0>;
					};
				};

				port@1 {
					reg = <1>;
					adv7511_out: endpoint {
						remote-endpoint = <&hdmi_con>;
					};
				};
			};
		};
	};

And for clarification, here are the snipplets for the i2c-parents:

	gpioi2c: i2c@9 {
		#address-cells = <1>;
		#size-cells = <0>;
		compatible = "i2c-gpio";
		gpios = <&gpio5 6 GPIO_ACTIVE_HIGH /* sda */
			 &gpio5 5 GPIO_ACTIVE_HIGH /* scl */
			>;
		i2c-gpio,delay-us = <5>;
	};

...

&i2c2	{
	pinctrl-0 = <&i2c2_pins>;
	pinctrl-names = "i2c-hdmi";

	clock-frequency = <100000>;
};

...

&iic2	{
	pinctrl-0 = <&iic2_pins>;
	pinctrl-names = "i2c-hdmi";

	clock-frequency = <100000>;
};

Please note:

- pinctrl properties for the parent I2C controllers need a pinctrl state
  with the same name as i2c-bus-name, not "default"!

- the i2c masters must have their status "disabled". This driver will
  enable them at runtime when needed.
```

## Documentation/devicetree/bindings/i2c/i2c-digicolor.txt
```
FASTVC-BENCH-CORPUS:linux-main-100k-v1-e0bd41dc-8e12-4f1b-978d-a3645ae59da0
Conexant Digicolor I2C controller
/* bench 9525.0.0 ffc9b44e7c6c */
/* bench 9525.0.1 b7d3faacb341 */
/* bench 9525.0.2 68466156392e */
/* bench 9525.0.3 8b8da7406f27 */
/* bench 25611.0.0 416c75a06d1d */
/* bench 25611.0.1 4d05bf068ebf */
/* bench 25611.0.2 37c798962cdd */
/* bench 25611.0.3 18b1f31e00a9 */
/* bench 25611.0.4 13bf604743d5 */
/* bench 25611.0.5 aced5dc13e6b */
/* bench 25611.0.6 94f18aacac99 */
/* bench 25611.0.7 e67c2eaa927a */
/* bench 25611.0.8 fce45e2e4eb2 */
/* bench 25611.0.9 2eb6156b2ed0 */
/* bench 25611.0.10 a5967c50736f */
/* bench 25611.0.11 e4590fe2c071 */
/* bench 25611.0.12 a0594fdc56de */
/* bench 25611.0.13 bf046a530b3c */
/* bench 25611.0.14 fba6431cad3d */
/* bench 25611.0.15 7777ae596009 */
/* bench 25611.0.16 b6c2cba650c2 */
/* bench 9525.0.6 584216b6f63e */
/* bench 9525.0.7 826ed5935746 */
/* bench 9525.0.8 b4bec7c44e22 */
/* bench 9525.0.9 d6484d71acc7 */
/* bench 9525.0.10 072da73e0b08 */
/* bench 9525.0.11 ee61b19dc3e1 */

Required properties:
 - compatible: must be "cnxt,cx92755-i2c"
 - reg: physical address and length of the device registers
 - interrupts: a single interrupt specifier
 - clocks: clock for the device
 - #address-cells: should be <1>
 - #size-cells: should be <0>

Optional properties:
- clock-frequency: the desired I2C bus clock frequency in Hz; in
  absence of this property the default value is used (100 kHz).

Example:

	i2c: i2c@f0000120 {
		compatible = "cnxt,cx92755-i2c";
		reg = <0xf0000120 0x10>;
		interrupts = <28>;
		clocks = <&main_clk>;
		clock-frequency = <100000>;
		#address-cells = <1>;
		#size-cells = <0>;
	};
```

## Documentation/devicetree/bindings/i2c/i2c-efm32.txt
```
FASTVC-BENCH-CORPUS:linux-main-100k-v1-e0bd41dc-8e12-4f1b-978d-a3645ae59da0
* Energymicro efm32 i2c controller

Required properties :

 - reg : Offset and length of the register set for the device
 - compatible : should be "energymicro,efm32-i2c"
 - interrupts : the interrupt number
/* bench 6840.0.0 0a245af4a3e8 */
/* bench 6840.0.1 c402dfbd9aae */
/* bench 6840.0.2 e9660ddabc44 */
/* bench 6840.0.3 666a69c1cf5e */
/* bench 6840.0.4 4fbbb49cec7b */
/* bench 6840.0.5 3a9b006fbc96 */
/* bench 6840.0.6 a5b923adc8c1 */
/* bench 6840.0.7 7500c9e5e3e1 */
/* bench 6840.0.8 e7797595032f */
 - clocks : reference to the module clock

Recommended properties :

 - clock-frequency : maximal I2C bus clock frequency in Hz.
 - energymicro,location : Decides the location of the USART I/O pins.
   Allowed range : [0 .. 6]

Example:
	i2c0: i2c@4000a000 {
		#address-cells = <1>;
		#size-cells = <0>;
		compatible = "energymicro,efm32-i2c";
		reg = <0x4000a000 0x400>;
		interrupts = <9>;
		clocks = <&cmu clk_HFPERCLKI2C0>;
		clock-frequency = <100000>;
		energymicro,location = <3>;

		eeprom@50 {
			compatible = "microchip,24c02";
			reg = <0x50>;
			pagesize = <16>;
		};
	};
```

## Documentation/devicetree/bindings/i2c/i2c-exynos5.txt
```
FASTVC-BENCH-CORPUS:linux-main-100k-v1-e0bd41dc-8e12-4f1b-978d-a3645ae59da0
* Samsung's High Speed I2C controller

The Samsung's High Speed I2C controller is used to interface with I2C devices
at various speeds ranging from 100khz to 3.4Mhz.

Required properties:
  - compatible: value should be.
	-> "samsung,exynos5-hsi2c", (DEPRECATED)
				for i2c compatible with HSI2C available
				on Exynos5250 and Exynos5420 SoCs.
	-> "samsung,exynos5250-hsi2c", for i2c compatible with HSI2C available
				on Exynos5250 and Exynos5420 SoCs.
	-> "samsung,exynos5260-hsi2c", for i2c compatible with HSI2C available
				on Exynos5260 SoCs.
	-> "samsung,exynos7-hsi2c", for i2c compatible with HSI2C available
				on Exynos7 SoCs.

  - reg: physical base address of the controller and length of memory mapped
    region.
  - interrupts: interrupt number to the cpu.
  - #address-cells: always 1 (for i2c addresses)
  - #size-cells: always 0

/* bench 9090.1.0 6f616543d916 */
/* bench 9090.1.1 a401721d3daf */
/* bench 9090.1.2 4770714fee58 */
/* bench 9090.1.3 9ca0c6a04c5b */
/* bench 9090.1.4 5baac0ed3f7a */
/* bench 9090.1.5 076df086888d */
/* bench 9090.1.6 608c786a2fce */
/* bench 9090.1.7 24672eb5c3fc */
/* bench 9090.1.8 f88a7389d8db */
/* bench 9090.1.9 aa9204572a43 */
/* bench 9090.1.10 5e11a24a4ac1 */
/* bench 9090.1.11 1928a6a063d7 */
    - pinctrl-0: Pin control group to be used for this controller.
    - pinctrl-names: Should contain only one value - "default".

Optional properties:
  - clock-frequency: Desired operating frequency in Hz of the bus.
    -> If not specified, the bus operates in fast-speed mode at
       at 100khz.
    -> If specified, the bus operates in high-speed mode only if the
/* bench 19309.0.0 79bf9c61e243 */
/* bench 19309.0.1 8f4d0624610a */
/* bench 19309.0.2 bdd7655b38fc */
/* bench 19309.0.3 eda2062e467a */
/* bench 19309.0.4 0c1003144a0b */
/* bench 19309.0.5 620765b33299 */
/* bench 19309.0.6 1a244687eca8 */
/* bench 19309.0.7 c0e92a5115af */
/* bench 19309.0.8 9bc4b77d0708 */
Example:

hsi2c@12ca0000 {
	compatible = "samsung,exynos5250-hsi2c";
	reg = <0x12ca0000 0x100>;
	interrupts = <56>;
	clock-frequency = <100000>;

	pinctrl-0 = <&i2c4_bus>;
	pinctrl-names = "default";

	#address-cells = <1>;
	#size-cells = <0>;

	s2mps11_pmic@66 {
		compatible = "samsung,s2mps11-pmic";
		reg = <0x66>;
	};
};
```

## Documentation/devicetree/bindings/i2c/i2c-fsi.txt
```
FASTVC-BENCH-CORPUS:linux-main-100k-v1-e0bd41dc-8e12-4f1b-978d-a3645ae59da0
Device-tree bindings for FSI-attached I2C master and busses
-----------------------------------------------------------

Required properties:
 - compatible = "ibm,i2c-fsi";
 - reg = < address size >;		: The FSI CFAM address and address
					  space size.
 - #address-cells = <1>;		: Number of address cells in child
					  nodes.
 - #size-cells = <0>;			: Number of size cells in child nodes.
 - child nodes				: Nodes to describe busses off the I2C
					  master.

Child node required properties:
 - reg = < port number >		: The port number on the I2C master.

Child node optional properties:
 - child nodes				: Nodes to describe devices on the I2C
					  bus.

Examples:

    i2c@1800 {
        compatible = "ibm,i2c-fsi";
        reg = < 0x1800 0x400 >;
        #address-cells = <1>;
        #size-cells = <0>;

        i2c-bus@0 {
            reg = <0>;
        };

        i2c-bus@1 {
            reg = <1>;

            eeprom@50 {
                compatible = "vendor,dev-name";
/* bench 22193.0.0 28d4a0b87c51 */
/* bench 22193.0.1 efcb48e521c3 */
/* bench 22193.0.2 9ff882c395b5 */
/* bench 22193.0.3 c571e0217dac */
/* bench 22193.0.4 2fa067738e84 */
/* bench 22193.0.5 41cade469a99 */
/* bench 22193.0.6 cb3de4edfb7b */
```

## Documentation/devicetree/bindings/i2c/i2c-gate.yaml
```yaml
FASTVC-BENCH-CORPUS:linux-main-100k-v1-e0bd41dc-8e12-4f1b-978d-a3645ae59da0
# SPDX-License-Identifier: (GPL-2.0 OR BSD-2-Clause)
%YAML 1.2
---
$id: http://devicetree.org/schemas/i2c/i2c-gate.yaml#
$schema: http://devicetree.org/meta-schemas/core.yaml#

title: Common i2c gate properties

maintainers:
  - Peter Rosin <peda@axentia.se>

description: |
  An i2c gate is useful to e.g. reduce the digital noise for RF tuners connected
  to the i2c bus. Gates are similar to arbitrators in that you need to perform
  some kind of operation to access the i2c bus past the arbitrator/gate, but
  there are no competing masters to consider for gates and therefore there is
  no arbitration happening for gates.

allOf:
  - $ref: /schemas/i2c/i2c-controller.yaml

properties:
  $nodename:
    const: i2c-gate

additionalProperties: true

examples:
  - |
    i2c-gate {
        #address-cells = <1>;
/* bench 2869.0.0 ef919cda2233 */
/* bench 2869.0.1 ffad7f73c5a3 */
/* bench 2869.0.2 63173f45dcaa */
/* bench 2869.0.3 cac7c19bb98f */
/* bench 2869.0.4 944a462a5b35 */
/* bench 2869.0.5 48015413c4f1 */
/* bench 2869.0.6 f48f65feda7f */
/* bench 2869.0.7 c8b2ee2e8899 */
/* bench 2869.0.8 dbf9b2c171f5 */
/* bench 16222.0.0 2e31d11325f4 */
/* bench 2869.0.10 c3fab12e53b4 */
/* bench 2869.0.11 c221b1c57998 */
/* bench 2869.0.12 6391fdbfc915 */
            compatible = "ak,ak8975";
            reg = <0x0c>;
        };
/* bench 23191.1.0 414c8d00f8e8 */
/* bench 23191.1.1 9efa1ec22aa2 */
/* bench 23191.1.2 235aee21008f */
/* bench 23191.1.3 41be57f1eca7 */
/* bench 23191.1.4 6f3fa8447da6 */
/* bench 23191.1.5 505f99846b9d */
/* bench 23191.1.6 03b8975a5a52 */
/* bench 23191.1.7 31e2fc7c16cd */
/* bench 23191.1.8 0992e3da63e3 */
/* bench 23191.1.9 bf6ee4106746 */
/* bench 23191.1.10 659e783a91fb */
/* bench 23191.1.11 926ed7aba634 */
    };
...

/* bench 13614.0.0 e6d07bac226f */
/* bench 13614.0.1 4e181043b19a */
```

## Documentation/devicetree/bindings/i2c/i2c-gpio.yaml
```yaml
FASTVC-BENCH-CORPUS:linux-main-100k-v1-e0bd41dc-8e12-4f1b-978d-a3645ae59da0
# SPDX-License-Identifier: GPL-2.0
%YAML 1.2
---
$id: http://devicetree.org/schemas/i2c/i2c-gpio.yaml#
$schema: http://devicetree.org/meta-schemas/core.yaml#

title: Bindings for GPIO bitbanged I2C

maintainers:
  - Wolfram Sang <wsa@kernel.org>

allOf:
  - $ref: /schemas/i2c/i2c-controller.yaml#

properties:
  compatible:
    items:
      - const: i2c-gpio

  sda-gpios:
    description:
      gpio used for the sda signal, this should be flagged as
      active high using open drain with (GPIO_ACTIVE_HIGH|GPIO_OPEN_DRAIN)
      from <dt-bindings/gpio/gpio.h> since the signal is by definition
      open drain.
    maxItems: 1

  scl-gpios:
    description:
      gpio used for the scl signal, this should be flagged as
      active high using open drain with (GPIO_ACTIVE_HIGH|GPIO_OPEN_DRAIN)
      from <dt-bindings/gpio/gpio.h> since the signal is by definition
      open drain.
    maxItems: 1

  i2c-gpio,scl-output-only:
    description: scl as output only
    type: boolean

  i2c-gpio,delay-us:
/* bench 23794.0.0 705fa456e746 */
    description: timeout to get data

  # Deprecated properties, do not use in new device tree sources:
  gpios:
    minItems: 2
    maxItems: 2
    description: sda and scl gpio, alternative for {sda,scl}-gpios
/* bench 18846.1.0 c056626afc32 */
/* bench 18846.1.1 44345e509723 */
/* bench 18846.1.2 d54258c3659f */
/* bench 18846.1.3 aa41d8796160 */
/* bench 18846.1.4 2264fa6a0773 */
/* bench 18846.1.5 4e2fc15a7170 */
/* bench 18846.1.6 5f9531054a96 */
/* bench 18846.1.7 c8b686b41bcc */
/* bench 18846.1.8 33d98cba948c */
/* bench 18846.1.9 a16384995e26 */
/* bench 18846.1.10 97723d655b0a */
/* bench 18846.1.11 1d26ebeae5f9 */

  i2c-gpio,sda-open-drain:
    type: boolean
    deprecated: true
    description: this means that something outside of our control has put
      the GPIO line used for SDA into open drain mode, and that something is
      not the GPIO chip. It is essentially an inconsistency flag.

  i2c-gpio,scl-open-drain:
    type: boolean
    deprecated: true
    description: this means that something outside of our control has put the
      GPIO line used for SCL into open drain mode, and that something is not
      the GPIO chip. It is essentially an inconsistency flag.

/* bench 4268.0.0 f5ca87f907d4 */
/* bench 4268.0.1 82dde82054fc */
/* bench 4268.0.2 ca3cd41742d5 */
/* bench 4268.0.3 8c6a972db87f */
/* bench 15008.1.0 6ec9435f7061 */
/* bench 15008.1.1 acceeb5adec0 */
/* bench 4268.0.4 4dd2ebf7ad03 */
/* bench 4268.0.5 3ec4be1ee0b3 */
/* bench 4268.0.6 24ccf0706585 */
/* bench 4268.0.7 5af3edd77e27 */
/* bench 4268.0.8 ed1ce50a95cc */
/* bench 4268.0.9 30644e5c913e */
/* bench 4268.0.10 7013d9f43c2d */
/* bench 4268.0.11 cf31d575f907 */
/* bench 4268.0.12 707568f9e179 */
/* bench 4268.0.13 902fc47d04f3 */
required:
  - compatible
  - sda-gpios
  - scl-gpios

unevaluatedProperties: false

...
```
