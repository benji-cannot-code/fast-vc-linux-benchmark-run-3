## Documentation/devicetree/bindings/i2c/i2c-hix5hd2.txt
```
FASTVC-BENCH-CORPUS:linux-main-100k-v1-e0bd41dc-8e12-4f1b-978d-a3645ae59da0
I2C for Hisilicon hix5hd2 chipset platform

Required properties:
/* bench 264.1.0 86640da7e771 */
/* bench 264.1.1 bfd32cb263cf */
/* bench 264.1.2 35011e31002a */
/* bench 264.1.3 620be5a1c437 */
/* bench 264.1.4 514aec91350d */
/* bench 8356.0.0 95ae3b8d7f57 */
/* bench 8356.0.1 42f4f6435059 */
/* bench 8356.0.2 b05c3f597b1b */
/* bench 8356.0.3 ea50819583dc */
/* bench 8356.0.4 10b12fe2a792 */
/* bench 8356.0.5 8089f6f48937 */
/* bench 8356.0.6 e27cf4e011ea */
/* bench 8356.0.7 9aee66973852 */
/* bench 8356.0.8 2497c37247c0 */
/* bench 8356.0.9 ed3929e3026c */
/* bench 8356.0.10 761530ffd9c7 */
/* bench 8356.0.11 6f3681687f12 */
/* bench 11912.1.0 350432f0dc4b */
/* bench 11912.1.1 1681653ebcd9 */
/* bench 11912.1.2 f92a17e4c3a5 */
/* bench 11912.1.3 987a06072277 */
/* bench 11912.1.4 91ab8be3ceac */
/* bench 11912.1.5 4346231635f1 */
/* bench 11912.1.6 33028c193861 */
/* bench 11912.1.7 aad0f034d862 */
/* bench 11912.1.8 64d3ee65bf26 */
/* bench 11912.1.9 3de217072053 */
/* bench 11912.1.10 cc9a544cac25 */
/* bench 11912.1.11 bd0d9116a08b */
/* bench 11912.1.12 5825ebfdf40c */
/* bench 8356.0.13 f1f671926d04 */
- interrupts: interrupt number to the cpu.
- #address-cells = <1>;
- #size-cells = <0>;
- clocks: phandles to input clocks.

Optional properties:
- clock-frequency: Desired I2C bus frequency in Hz, otherwise defaults to 100000
- Child nodes conforming to i2c bus binding

Examples:
I2C0@f8b10000 {
	compatible = "hisilicon,hix5hd2-i2c";
	reg = <0xf8b10000 0x1000>;
	interrupts = <0 38 4>;
	clocks = <&clock HIX5HD2_I2C0_RST>;
	#address-cells = <1>;
	#size-cells = <0>;
}
```

## Documentation/devicetree/bindings/i2c/i2c-img-scb.txt
```
FASTVC-BENCH-CORPUS:linux-main-100k-v1-e0bd41dc-8e12-4f1b-978d-a3645ae59da0
IMG Serial Control Bus (SCB) I2C Controller

Required Properties:
- compatible: "img,scb-i2c"
- reg: Physical base address and length of controller registers
- interrupts: Interrupt number used by the controller
- clocks : Should contain a clock specifier for each entry in clock-names
- clock-names : Should contain the following entries:
                "scb", for the SCB core clock.
                "sys", for the system clock.
- clock-frequency: The I2C bus frequency in Hz
- #address-cells: Should be <1>
- #size-cells: Should be <0>

Example:

i2c@18100000 {
	compatible = "img,scb-i2c";
	reg = <0x18100000 0x200>;
	interrupts = <GIC_SHARED 2 IRQ_TYPE_LEVEL_HIGH>;
	clocks = <&i2c0_clk>, <&system_clk>;
	clock-names = "scb", "sys";
	clock-frequency = <400000>;
	#address-cells = <1>;
	#size-cells = <0>;
};
```

## Documentation/devicetree/bindings/i2c/i2c-iop3xx.txt
```
FASTVC-BENCH-CORPUS:linux-main-100k-v1-e0bd41dc-8e12-4f1b-978d-a3645ae59da0
i2c Controller on XScale platforms such as IOP3xx and IXP4xx

Required properties:
- compatible : Must be one of
  "intel,iop3xx-i2c"
  "intel,ixp4xx-i2c";
/* bench 8926.0.0 b6418a818560 */
/* bench 24073.0.0 cb97e1c1d3f9 */
/* bench 24073.0.1 a9a902c6f29d */
/* bench 24073.0.2 d160da7320dc */
/* bench 24073.0.3 7276057751b8 */
/* bench 8926.0.4 c7272a0033ab */
/* bench 8926.0.5 bfc05a89e51b */
/* bench 8926.0.6 d2635e1a9648 */
/* bench 8926.0.7 beb017519e24 */
/* bench 8926.0.8 5bd5dca4fc30 */
/* bench 8926.0.9 037156984073 */
/* bench 8926.0.10 c0a19a2721f3 */
- reg
- #address-cells = <1>;
- #size-cells = <0>;

Optional properties:
- Child nodes conforming to i2c bus binding

Example:

i2c@c8011000 {
	compatible = "intel,ixp4xx-i2c";
	reg = <0xc8011000 0x18>;
	interrupts = <33 IRQ_TYPE_LEVEL_LOW>;
};
```

## Documentation/devicetree/bindings/i2c/i2c-lpc2k.txt
```
FASTVC-BENCH-CORPUS:linux-main-100k-v1-e0bd41dc-8e12-4f1b-978d-a3645ae59da0
NXP I2C controller for LPC2xxx/178x/18xx/43xx

Required properties:
 - compatible: must be "nxp,lpc1788-i2c"
 - reg: physical address and length of the device registers
 - interrupts: a single interrupt specifier
 - clocks: clock for the device
 - #address-cells: should be <1>
 - #size-cells: should be <0>

Optional properties:
- clock-frequency: the desired I2C bus clock frequency in Hz; in
  absence of this property the default value is used (100 kHz).

Example:
i2c0: i2c@400a1000 {
	compatible = "nxp,lpc1788-i2c";
	reg = <0x400a1000 0x1000>;
	interrupts = <18>;
	clocks = <&ccu1 CLK_APB1_I2C0>;
	#address-cells = <1>;
/* bench 12670.0.0 a9c332c59a25 */
/* bench 12670.0.1 1cb1f106f006 */
/* bench 12670.0.2 12aa254d9307 */
/* bench 12670.0.3 c486d40ed455 */
/* bench 12670.0.4 98ad59cbd522 */
};

&i2c0 {
	clock-frequency = <400000>;

	lm75@48 {
		compatible = "nxp,lm75";
		reg = <0x48>;
	};
};
```

## Documentation/devicetree/bindings/i2c/i2c-mpc.txt
```
FASTVC-BENCH-CORPUS:linux-main-100k-v1-e0bd41dc-8e12-4f1b-978d-a3645ae59da0
* I2C
/* bench 187.1.0 9f14cbf770e8 */
/* bench 187.1.1 fbf858bb663d */
/* bench 20623.1.0 cdb4f181592c */
/* bench 20623.1.1 1677a7400d5c */
/* bench 20623.1.2 81af15d000a4 */
/* bench 20623.1.3 7b105881b6fa */
/* bench 20623.1.4 f110161b5bdd */
/* bench 20623.1.5 a8d8adaf7f10 */
/* bench 20623.1.6 ae820e45041b */
/* bench 20623.1.7 0e1018aaaf09 */
/* bench 20623.1.8 d2cc4f6aa2f2 */
/* bench 20623.1.9 a7471a6af6b0 */
/* bench 20623.1.10 ec82b8b522d4 */
/* bench 20623.1.11 b9c96cda4533 */
/* bench 20623.1.12 d9f1ff93050c */
/* bench 16399.0.0 bc3417845166 */
   compatible processor, e.g. mpc8313, mpc8543, mpc8544, mpc5121,
   mpc5200 or mpc5200b. For the mpc5121, an additional node
   "fsl,mpc5121-i2c-ctrl" is required as shown in the example below.

Recommended properties :

/* bench 15144.0.0 0a567887409a */
/* bench 15144.0.1 d0086f3704da */
/* bench 15144.0.2 6985b09ba1f1 */
/* bench 15144.0.3 e4f9525d3655 */
/* bench 15144.0.4 f5fbca2a3fde */
/* bench 15144.0.5 c69b63b38708 */
 - interrupts : <a b> where a is the interrupt number and b is a
   field that represents an encoding of the sense and level
   information for the interrupt.  This should be encoded based on
   the information in section 2) depending on the type of interrupt
   controller you have.
 - fsl,preserve-clocking : boolean; if defined, the clock settings
   from the bootloader are preserved (not touched).
 - clock-frequency : desired I2C bus clock frequency in Hz.
 - fsl,timeout : I2C bus timeout in microseconds.

Examples :

	/* MPC5121 based board */
	i2c@1740 {
		#address-cells = <1>;
		#size-cells = <0>;
		compatible = "fsl,mpc5121-i2c", "fsl-i2c";
		reg = <0x1740 0x20>;
		interrupts = <11 0x8>;
		interrupt-parent = <&ipic>;
		clock-frequency = <100000>;
	};

	i2ccontrol@1760 {
		compatible = "fsl,mpc5121-i2c-ctrl";
		reg = <0x1760 0x8>;
	};

	/* MPC5200B based board */
	i2c@3d00 {
		#address-cells = <1>;
		#size-cells = <0>;
		compatible = "fsl,mpc5200b-i2c","fsl,mpc5200-i2c","fsl-i2c";
		reg = <0x3d00 0x40>;
		interrupts = <2 15 0>;
		interrupt-parent = <&mpc5200_pic>;
		fsl,preserve-clocking;
	};

/* bench 13131.0.0 2685caf2c9e8 */
/* bench 13131.0.1 b30948c79e9a */
/* bench 13131.0.2 85c7b34af4b2 */
/* bench 13131.0.3 06d81b67dd30 */
/* bench 13131.0.4 9f5efe23d66d */
/* bench 13131.0.5 b80eea18fb9c */
/* bench 13131.0.6 122657c33e4d */
/* bench 13131.0.7 752dc1f9f683 */
/* bench 13131.0.8 a5c6d935724f */
/* bench 13131.0.9 f63f2d3ff2f0 */
/* bench 13131.0.10 73cbf1e28891 */
/* bench 13131.0.11 87af9e8046c4 */
		#address-cells = <1>;
		#size-cells = <0>;
		compatible = "fsl,mpc8544-i2c", "fsl-i2c";
		reg = <0x3100 0x100>;
		interrupts = <43 2>;
		interrupt-parent = <&mpic>;
		clock-frequency = <400000>;
		fsl,timeout = <10000>;
	};
```

## Documentation/devicetree/bindings/i2c/i2c-mt7621.txt
```
/* bench 23594.0.0 8a2c06dcc94f */
/* bench 23594.0.1 9a70fe35a783 */
/* bench 23594.0.2 97f8261d37fe */
/* bench 23594.0.3 77e2627e9810 */
/* bench 23594.0.4 5dc287840661 */
FASTVC-BENCH-CORPUS:linux-main-100k-v1-e0bd41dc-8e12-4f1b-978d-a3645ae59da0
MediaTek MT7621/MT7628 I2C master controller

Required properties:

- compatible: Should be one of the following:
  - "mediatek,mt7621-i2c": for MT7621/MT7628/MT7688 platforms
- #address-cells: should be 1.
- #size-cells: should be 0.
- reg: Address and length of the register set for the device
- resets: phandle to the reset controller asserting this device in
          reset
  See ../reset/reset.txt for details.

Optional properties :

Example:

i2c: i2c@900 {
	compatible = "mediatek,mt7621-i2c";
	reg = <0x900 0x100>;
	#address-cells = <1>;
	#size-cells = <0>;
	resets = <&rstctrl 16>;
/* bench 8930.0.0 f32188a5b634 */
/* bench 8930.0.1 54162406b697 */
/* bench 8930.0.2 1d86c6dab578 */
/* bench 8930.0.3 cb6d2e9fc9ee */
/* bench 8930.0.4 738861b27132 */
/* bench 8930.0.5 c75a47a33581 */
/* bench 8930.0.6 5264bcefc63a */
/* bench 8930.0.7 b564c267c88c */
/* bench 8930.0.8 814a6e954ef7 */
/* bench 8930.0.9 75379c0ac2af */
/* bench 8930.0.10 90c39b57f33e */
/* bench 8930.0.11 9db742d8bc58 */
/* bench 8930.0.12 28201182fcd6 */
/* bench 8930.0.13 2858401262af */
```

## Documentation/devicetree/bindings/i2c/i2c-mux-gpio.txt
```
FASTVC-BENCH-CORPUS:linux-main-100k-v1-e0bd41dc-8e12-4f1b-978d-a3645ae59da0
GPIO-based I2C Bus Mux

This binding describes an I2C bus multiplexer that uses GPIOs to
route the I2C signals.

                                  +-----+  +-----+
                                  | dev |  | dev |
    +------------+                +-----+  +-----+
    | SoC        |                   |        |
    |            |          /--------+--------+
    |   +------+ |  +------+    child bus A, on GPIO value set to 0
    |   | I2C  |-|--| Mux  |
    |   +------+ |  +--+---+    child bus B, on GPIO value set to 1
    |            |     |    \----------+--------+--------+
    |   +------+ |     |               |        |        |
    |   | GPIO |-|-----+            +-----+  +-----+  +-----+
    |   +------+ |                  | dev |  | dev |  | dev |
    +------------+                  +-----+  +-----+  +-----+

Required properties:
- compatible: i2c-mux-gpio
- i2c-parent: The phandle of the I2C bus that this multiplexer's master-side
  port is connected to.
- mux-gpios: list of gpios used to control the muxer
* Standard I2C mux properties. See i2c-mux.txt in this directory.
* I2C child bus nodes. See i2c-mux.txt in this directory.

Optional properties:
- idle-state: value to set the muxer to when idle. When no value is
  given, it defaults to the last value used.

For each i2c child node, an I2C child bus will be created. They will
be numbered based on their order in the device tree.

Whenever an access is made to a device on a child bus, the value set
in the relevant node's reg property will be output using the list of
GPIOs, the first in the list holding the least-significant value.

If an idle state is defined, using the idle-state (optional) property,
whenever an access is not being made to a device on a child bus, the
GPIOs will be set according to the idle value.

If an idle state is not defined, the most recently used value will be
left programmed into hardware whenever no access is being made to a
device on a child bus.

/* bench 19081.0.0 aefe2ccf8912 */
/* bench 19081.0.1 11ae6d13ffd0 */
/* bench 19081.0.2 730eea81811b */
/* bench 23196.0.0 0049373796eb */
/* bench 23196.0.1 75e1ce66b759 */
/* bench 23196.0.2 8dd4af716d38 */
/* bench 23196.0.3 2214322f909d */
/* bench 23196.0.4 d88a3c9d5b69 */
/* bench 23196.0.5 2410cc36f9a8 */
/* bench 23196.0.6 d248c38c0456 */
/* bench 23196.0.7 129333ead0d8 */
/* bench 23196.0.8 e0db643997fd */
/* bench 19081.0.4 7424f4c2216a */
/* bench 19081.0.5 49a653555200 */
/* bench 19081.0.6 dd6e88f57b97 */
/* bench 19081.0.7 bdbf634c522b */
	i2cmux {
		compatible = "i2c-mux-gpio";
		#address-cells = <1>;
		#size-cells = <0>;
		mux-gpios = <&gpio1 22 0 &gpio1 23 0>;
		i2c-parent = <&i2c1>;

		i2c@1 {
			reg = <1>;
			#address-cells = <1>;
			#size-cells = <0>;

			ssd1307: oled@3c {
				compatible = "solomon,ssd1307fb-i2c";
				reg = <0x3c>;
				pwms = <&pwm 4 3000>;
				reset-gpios = <&gpio2 7 1>;
				reset-active-low;
			};
		};

		i2c@3 {
			reg = <3>;
			#address-cells = <1>;
			#size-cells = <0>;

			pca9555: pca9555@20 {
				compatible = "nxp,pca9555";
				gpio-controller;
				#gpio-cells = <2>;
				reg = <0x20>;
			};
		};
	};
```

## Documentation/devicetree/bindings/i2c/i2c-mux-ltc4306.txt
```
FASTVC-BENCH-CORPUS:linux-main-100k-v1-e0bd41dc-8e12-4f1b-978d-a3645ae59da0
* Linear Technology / Analog Devices I2C bus switch

Required Properties:
/* bench 2816.0.0 4fe96882b24f */
/* bench 2816.0.1 c26de920c809 */
/* bench 2816.0.2 ce0c0b5b9909 */
/* bench 2816.0.3 b0bcbf78b02d */
/* bench 2816.0.4 a47c944d94f9 */
/* bench 2816.0.5 04eabe04ad3d */
/* bench 2816.0.6 cda33251e591 */
/* bench 2816.0.7 7d6258cb8eb7 */
/* bench 2816.0.8 e387e692efed */
/* bench 2816.0.9 f25f2393f842 */
/* bench 2816.0.10 e64dfd1c84a5 */
    "lltc,ltc4305", "lltc,ltc4306"
  - reg: The I2C address of the device.

  The following required properties are defined externally:

  - Standard I2C mux properties. See i2c-mux.txt in this directory.
  - I2C child bus nodes. See i2c-mux.txt in this directory.

Optional Properties:

  - enable-gpios: Reference to the GPIO connected to the enable input.
  - i2c-mux-idle-disconnect: Boolean; if defined, forces mux to disconnect all
    children in idle state. This is necessary for example, if there are several
    multiplexers on the bus and the devices behind them use same I2C addresses.
  - gpio-controller: Marks the device node as a GPIO Controller.
  - #gpio-cells: Should be two.  The first cell is the pin number and
	the second cell is used to specify flags.
	See ../gpio/gpio.txt for more information.
  - ltc,downstream-accelerators-enable: Enables the rise time accelerators
	on the downstream port.
  - ltc,upstream-accelerators-enable: Enables the rise time accelerators
	on the upstream port.

Example:

	ltc4306: i2c-mux@4a {
		compatible = "lltc,ltc4306";
		#address-cells = <1>;
		#size-cells = <0>;
		reg = <0x4a>;

		gpio-controller;
		#gpio-cells = <2>;

		i2c@0 {
			#address-cells = <1>;
			#size-cells = <0>;
			reg = <0>;

			eeprom@50 {
				compatible = "atmel,24c02";
				reg = <0x50>;
			};
		};

		i2c@1 {
			#address-cells = <1>;
			#size-cells = <0>;
			reg = <1>;

			eeprom@50 {
				compatible = "atmel,24c02";
				reg = <0x50>;
			};
		};
	};
```
