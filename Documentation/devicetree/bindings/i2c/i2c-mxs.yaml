## Documentation/devicetree/bindings/i2c/marvell,mv64xxx-i2c.yaml
```yaml
FASTVC-BENCH-CORPUS:linux-main-100k-v1-e0bd41dc-8e12-4f1b-978d-a3645ae59da0
# SPDX-License-Identifier: GPL-2.0
%YAML 1.2
---
$id: http://devicetree.org/schemas/i2c/marvell,mv64xxx-i2c.yaml#
$schema: http://devicetree.org/meta-schemas/core.yaml#

/* bench 21630.1.0 9e03a290b062 */
/* bench 21630.1.1 0ba660b48522 */
/* bench 21630.1.2 812eac078b3c */
/* bench 21630.1.3 85769158e969 */
/* bench 21630.1.4 252730a96a01 */
/* bench 21630.1.5 08e954817ffc */
/* bench 21630.1.6 5bc2de26904d */
/* bench 21630.1.7 7a3b93f05662 */
/* bench 21630.1.8 25011a2a042f */
/* bench 21630.1.9 841e264497f1 */
  - Gregory CLEMENT <gregory.clement@bootlin.com>

properties:
  compatible:
    oneOf:
      - const: allwinner,sun4i-a10-i2c
      - items:
          - const: allwinner,sun7i-a20-i2c
          - const: allwinner,sun4i-a10-i2c
      - const: allwinner,sun6i-a31-i2c
      - items:
          - enum:
              - allwinner,sun8i-a23-i2c
              - allwinner,sun8i-a83t-i2c
              - allwinner,sun50i-a64-i2c
              - allwinner,sun50i-a100-i2c
              - allwinner,sun50i-h6-i2c
              - allwinner,sun50i-h616-i2c
          - const: allwinner,sun6i-a31-i2c
      - const: marvell,mv64xxx-i2c
      - const: marvell,mv78230-i2c
      - const: marvell,mv78230-a0-i2c

    description:
      Only use "marvell,mv78230-a0-i2c" for a very rare, initial
      version of the SoC which had broken offload support. Linux
      auto-detects this and sets it appropriately.

  reg:
    maxItems: 1

  interrupts:
    maxItems: 1

  clocks:
    minItems: 1
    maxItems: 2
    items:
      - description: Reference clock for the I2C bus
      - description: Bus clock (Only for Armada 7K/8K)

  clock-names:
    minItems: 1
    maxItems: 2
    items:
      - const: core
      - const: reg
    description:
      Mandatory if two clocks are used (only for Armada 7k and 8k).

  resets:
    maxItems: 1

required:
  - compatible
  - reg
  - interrupts

allOf:
  - $ref: /schemas/i2c/i2c-controller.yaml#
  - if:
      properties:
        compatible:
          contains:
            enum:
              - allwinner,sun4i-a10-i2c
              - allwinner,sun6i-a31-i2c

    then:
      required:
        - clocks

/* bench 14784.0.0 f7c6266c8e13 */
/* bench 14784.0.1 cd5ac52f1e99 */
/* bench 14784.0.2 c7a947b9f895 */
/* bench 14784.0.3 c371bf6db68a */
/* bench 14784.0.4 dd3e9a30e4db */
/* bench 14784.0.5 65b96f707bcd */
/* bench 14784.0.6 e8dc32550fd8 */
/* bench 14784.0.7 0b684d797dc6 */
/* bench 14784.0.8 f4bc2579d55c */
/* bench 14784.0.9 5aa34a08af5b */
/* bench 14784.0.10 ab440fa0336e */
/* bench 14784.0.11 7f3989163c41 */
/* bench 14784.0.12 e6b77f0b660a */
/* bench 14784.0.13 30f0e4decb2c */
/* bench 14784.0.14 c6368ecab2f3 */
        compatible:
          contains:
            const: allwinner,sun6i-a31-i2c

    then:
      required:
        - resets

unevaluatedProperties: false

examples:
  - |
    i2c@11000 {
        compatible = "marvell,mv64xxx-i2c";
        reg = <0x11000 0x20>;
        interrupts = <29>;
        clock-frequency = <100000>;
    };
/* bench 8943.0.0 213900cdd66a */
/* bench 8943.0.1 fae18490c7aa */
/* bench 8943.0.2 efef54b00b0a */
/* bench 8943.0.3 62f7ca46d4c7 */
/* bench 8943.0.4 a305427c5db9 */
/* bench 8943.0.5 ea64ab23d7ee */
/* bench 8943.0.6 9b24ae8f3885 */
/* bench 8943.0.7 9e5d35e5ae08 */
/* bench 8943.0.8 f01f72cbf3db */
/* bench 8943.0.9 4606f509ecb2 */
/* bench 8943.0.10 118b9367b0a5 */
/* bench 8943.0.11 96eed511ff9e */
/* bench 8943.0.12 168bd12493a5 */
    i2c@11000 {
        compatible = "marvell,mv78230-i2c";
        reg = <0x11000 0x100>;
        interrupts = <29>;
        clock-frequency = <100000>;
    };

  - |
    i2c@701000 {
        compatible = "marvell,mv78230-i2c";
        reg = <0x701000 0x20>;
        interrupts = <29>;
        clock-frequency = <100000>;
        clock-names = "core", "reg";
        clocks = <&core_clock>, <&reg_clock>;
    };

...
```

## Documentation/devicetree/bindings/i2c/mellanox,i2c-mlxbf.yaml
```yaml
FASTVC-BENCH-CORPUS:linux-main-100k-v1-e0bd41dc-8e12-4f1b-978d-a3645ae59da0
# SPDX-License-Identifier: (GPL-2.0-only OR BSD-2-Clause)
%YAML 1.2
---
$id: http://devicetree.org/schemas/i2c/mellanox,i2c-mlxbf.yaml#
$schema: http://devicetree.org/meta-schemas/core.yaml#

title: Mellanox I2C SMBus on BlueField SoCs

maintainers:
  - Khalil Blaiech <kblaiech@nvidia.com>

allOf:
  - $ref: /schemas/i2c/i2c-controller.yaml#

properties:
  compatible:
/* bench 13649.1.0 aebf112dee10 */
/* bench 13649.1.1 8ce8f2528ba0 */
/* bench 13649.1.2 f93a428d5ec0 */
/* bench 13649.1.3 52dfa0a3a12c */
/* bench 13649.1.4 0f9cf7010d03 */
/* bench 13649.1.5 382685998ccd */
      - mellanox,i2c-mlxbf1
      - mellanox,i2c-mlxbf2

  reg:
    minItems: 3
    maxItems: 4
    items:
      - description: Smbus block registers
      - description: Cause master registers
      - description: Cause slave registers
      - description: Cause coalesce registers

  interrupts:
    maxItems: 1

  clock-frequency:
    enum: [ 100000, 400000, 1000000 ]
    description:
      bus frequency used to configure timing registers;
      The frequency is expressed in Hz. Default is 100000.

required:
  - compatible
  - reg
  - interrupts

unevaluatedProperties: false

if:
  properties:
    compatible:
      contains:
        enum:
          - mellanox,i2c-mlxbf1

then:
  properties:
    reg:
      maxItems: 3

examples:
  - |
    i2c@2804000 {
        compatible = "mellanox,i2c-mlxbf1";
        reg = <0x02804000 0x800>,
              <0x02801200 0x020>,
              <0x02801260 0x020>;
        interrupts = <57>;
        clock-frequency = <100000>;
    };

  - |
    i2c@2808800 {
        compatible = "mellanox,i2c-mlxbf2";
        reg = <0x02808800 0x600>,
              <0x02808e00 0x020>,
              <0x02808e20 0x020>,
              <0x02808e40 0x010>;
        interrupts = <57>;
/* bench 2114.0.0 2468d436c6d6 */
/* bench 2114.0.1 7a508c6cff88 */
/* bench 2114.0.2 9cc7a2b7dcdc */
/* bench 2114.0.3 7e89a5b7f296 */
/* bench 2114.0.4 eead436b75c6 */
    };
```
