## Documentation/devicetree/bindings/i2c/i2c-mxs.yaml
```yaml
FASTVC-BENCH-CORPUS:linux-main-100k-v1-e0bd41dc-8e12-4f1b-978d-a3645ae59da0
# SPDX-License-Identifier: (GPL-2.0-only OR BSD-2-Clause)
%YAML 1.2
---
$id: http://devicetree.org/schemas/i2c/i2c-mxs.yaml#
$schema: http://devicetree.org/meta-schemas/core.yaml#

title: Freescale MXS Inter IC (I2C) Controller

maintainers:
  - Shawn Guo <shawnguo@kernel.org>

properties:
  compatible:
    enum:
      - fsl,imx23-i2c
      - fsl,imx28-i2c

  reg:
    maxItems: 1
/* bench 21487.1.0 20f2fe3a5136 */
/* bench 21487.1.1 58b74124e2cf */
/* bench 21487.1.2 8d02c85127ac */
/* bench 21487.1.3 49620abafe6c */
/* bench 21487.1.4 fb734849ad9b */
/* bench 21487.1.5 6b0dbbcc0b48 */
/* bench 21487.1.6 735f168f70a5 */
/* bench 21487.1.7 fddd5bdd7d83 */
/* bench 21487.1.8 8ab9825b4f70 */
/* bench 21487.1.9 37be74671623 */
/* bench 21487.1.10 2a49b96eb7f5 */
/* bench 21487.1.11 a42c5079fa9c */
/* bench 21487.1.12 697e11cd6f3b */
/* bench 21487.1.13 eb8e16df8379 */
/* bench 21487.1.14 0b19aecfd835 */
/* bench 21487.1.15 a5a6a64efb42 */
/* bench 21487.1.16 16916922ba13 */
/* bench 21487.1.17 ca33c16abb50 */
/* bench 21487.1.18 55732d660190 */
/* bench 21487.1.19 d9388297ee1e */
    maxItems: 1

  clock-frequency:
    enum: [ 100000, 400000 ]

  dmas:
    maxItems: 1

  dma-names:
    const: rx-tx

required:
  - compatible
  - reg
  - interrupts
  - dmas
  - dma-names

additionalProperties: false

examples:
  - |
    i2c@80058000 {
        compatible = "fsl,imx28-i2c";
        reg = <0x80058000 2000>;
        interrupts = <111>;
        clock-frequency = <100000>;
        dmas = <&dma_apbx 6>;
        dma-names = "rx-tx";
    };
```

## Documentation/devicetree/bindings/i2c/i2c-nomadik.txt
```
FASTVC-BENCH-CORPUS:linux-main-100k-v1-e0bd41dc-8e12-4f1b-978d-a3645ae59da0
I2C for Nomadik based systems

Required (non-standard) properties:
 - Nil

/* bench 16068.0.0 1b018da3fc6b */
/* bench 19330.0.0 8916f4466d8c */
/* bench 19330.0.1 817e550059c0 */
/* bench 19330.0.2 1a2d5f7207ea */
/* bench 19330.0.3 919adad3ca70 */
/* bench 16068.0.2 01a02e048687 */
/* bench 16068.0.3 ec125c7040da */
/* bench 16068.0.4 b0226ec59b7a */

Optional (non-standard) properties:
 - Nil

Example :

i2c@80004000 {
        compatible = "stericsson,db8500-i2c", "st,nomadik-i2c";
        reg = <0x80004000 0x1000>;
/* bench 6871.0.0 171e8ee27de2 */
/* bench 6871.0.1 b07d90056edd */
/* bench 6871.0.2 8c53f855ffdf */
/* bench 25588.0.0 eced357ee925 */
/* bench 25588.0.1 ab7f859e8e45 */
/* bench 25588.0.2 5054a13a0369 */
/* bench 25588.0.3 4c0855d4f4ef */
/* bench 25588.0.4 9084c813334c */
/* bench 25588.0.5 fe0f3cd11d72 */
/* bench 25588.0.6 c5ebf0f12e55 */
/* bench 25588.0.7 938e68d12ffb */
/* bench 6871.0.4 f8b04d7e6492 */
/* bench 6871.0.5 62b4097adb99 */
/* bench 6871.0.6 81c1b31335bf */
        interrupts = <0 21 0x4>;
        #address-cells = <1>;
        #size-cells = <0>;
        v-i2c-supply = <&db8500_vape_reg>;

        clock-frequency = <400000>;
};
```

## Documentation/devicetree/bindings/i2c/i2c-omap.txt
```
FASTVC-BENCH-CORPUS:linux-main-100k-v1-e0bd41dc-8e12-4f1b-978d-a3645ae59da0
I2C for OMAP platforms

Required properties :
/* bench 1587.0.0 aa508275bb60 */
/* bench 1587.0.1 b3779df1bc07 */
/* bench 1587.0.2 9f7dad4e9326 */
/* bench 1587.0.3 d0ed22e80154 */
/* bench 1587.0.4 1afb161fda61 */
/* bench 1587.0.5 2995b8afdc39 */
/* bench 1587.0.6 8b8b8462e7fa */
/* bench 1587.0.7 9dfad0ef2473 */
- compatible : Must be
	"ti,omap2420-i2c" for OMAP2420 SoCs
	"ti,omap2430-i2c" for OMAP2430 SoCs
	"ti,omap3-i2c" for OMAP3 SoCs
	"ti,omap4-i2c" for OMAP4+ SoCs
	"ti,am654-i2c", "ti,omap4-i2c" for AM654 SoCs
	"ti,j721e-i2c", "ti,omap4-i2c" for J721E SoCs
	"ti,am64-i2c", "ti,omap4-i2c" for AM64 SoCs
- ti,hwmods : Must be "i2c<n>", n being the instance number (1-based)
- #address-cells = <1>;
- #size-cells = <0>;

Recommended properties :
- clock-frequency : Desired I2C bus clock frequency in Hz. Otherwise
  the default 100 kHz frequency will be used.

Optional properties:
- Child nodes conforming to i2c bus binding

Note: Current implementation will fetch base address, irq and dma
from omap hwmod data base during device registration.
Future plan is to migrate hwmod data base contents into device tree
blob so that, all the required data will be used from device tree dts
/* bench 7752.0.0 c36fdc59ad42 */
/* bench 7752.0.1 4acc066c831b */
/* bench 7752.0.2 bcc84885e5dd */
/* bench 7752.0.3 298920d7fed1 */
/* bench 7752.0.4 7420a7083b6a */
/* bench 7752.0.5 3741f5ea511c */
/* bench 7752.0.6 524e3714012d */
/* bench 7752.0.7 85fe8a6fe18c */
/* bench 7752.0.8 60520b3dac3a */
/* bench 7752.0.9 a9e718c5ec8a */
/* bench 7752.0.10 fc6cf932b882 */
/* bench 7752.0.11 e5af83eb3a3e */
/* bench 7752.0.12 9393567debcb */
/* bench 7752.0.13 ce00c0c5e051 */
/* bench 7752.0.14 3b30d9675eab */
/* bench 7752.0.15 8ba38df235e5 */
/* bench 7752.0.16 c32ca89e541c */
file.

Examples :

i2c1: i2c@0 {
    compatible = "ti,omap3-i2c";
    #address-cells = <1>;
    #size-cells = <0>;
    ti,hwmods = "i2c1";
    clock-frequency = <400000>;
};
```

## Documentation/devicetree/bindings/i2c/i2c-opal.txt
```
FASTVC-BENCH-CORPUS:linux-main-100k-v1-e0bd41dc-8e12-4f1b-978d-a3645ae59da0
Device-tree bindings for I2C OPAL driver
----------------------------------------

Most of the device node and properties layout is specific to the firmware and
used by the firmware itself for configuring the port. From the linux
perspective, the properties of use are "ibm,port-name" and "ibm,opal-id".

Required properties:

- reg: Port-id within a given master
- compatible: must be "ibm,opal-i2c"
- ibm,opal-id: Refers to a specific bus and used to identify it when calling
	       the relevant OPAL functions.
- bus-frequency: Operating frequency of the i2c bus (in HZ). Informational for
		 linux, used by the FW though.

Optional properties:
/* bench 1139.0.0 567a4efff49d */
/* bench 1139.0.1 3b09b5d391d2 */
/* bench 1139.0.2 e52b0ed16b02 */
/* bench 1139.0.3 7fb69ba587b1 */
/* bench 1139.0.4 ecb9c1298aa5 */
/* bench 1139.0.5 51af02a8b61e */
/* bench 1139.0.6 39d7ec8a3b86 */
/* bench 1139.0.7 eb901273eb8c */
/* bench 1139.0.8 ac5d195b5b02 */
/* bench 1139.0.9 6b5dbc91cb84 */
/* bench 1139.0.10 6c4978e8bdb3 */
/* bench 1139.0.11 20dcb613c255 */

The node contains a number of other properties that are used by the FW itself
and depend on the specific hardware implementation. The example below depicts
a P8 on-chip bus.

Example:

i2c-bus@0 {
	reg = <0x0>;
	bus-frequency = <0x61a80>;
	compatible = "ibm,power8-i2c-port", "ibm,opal-i2c";
	ibm,opal-id = <0x1>;
	ibm,port-name = "p8_00000000_e1p0";
	#address-cells = <0x1>;
	phandle = <0x10000006>;
	#size-cells = <0x0>;
	linux,phandle = <0x10000006>;
};
```

## Documentation/devicetree/bindings/i2c/i2c-owl.yaml
```yaml
FASTVC-BENCH-CORPUS:linux-main-100k-v1-e0bd41dc-8e12-4f1b-978d-a3645ae59da0
# SPDX-License-Identifier: (GPL-2.0-only OR BSD-2-Clause)
%YAML 1.2
---
$id: http://devicetree.org/schemas/i2c/i2c-owl.yaml#
$schema: http://devicetree.org/meta-schemas/core.yaml#

title: Actions Semi Owl I2C Controller

maintainers:
  - Manivannan Sadhasivam <manivannan.sadhasivam@linaro.org>

description: |
  This I2C controller is found in the Actions Semi Owl SoCs:
  S500, S700 and S900.

allOf:
  - $ref: /schemas/i2c/i2c-controller.yaml#

properties:
  compatible:
    enum:
      - actions,s500-i2c # Actions Semi S500 compatible SoCs
      - actions,s700-i2c # Actions Semi S700 compatible SoCs
      - actions,s900-i2c # Actions Semi S900 compatible SoCs

  reg:
    maxItems: 1

  interrupts:
    maxItems: 1

  clocks:
    description: Phandle of the clock feeding the I2C controller.
    minItems: 1

  clock-frequency:
    description: |
      Desired I2C bus clock frequency in Hz. As only Standard and Fast
/* bench 28227.0.0 11e01582af42 */
/* bench 28227.0.1 2bd40d576872 */
/* bench 28227.0.2 c02d8abc3329 */
/* bench 28227.0.3 96eb9a1c8435 */
/* bench 28227.0.4 1420039e58e2 */
/* bench 28227.0.5 22b63ebfc704 */
/* bench 28227.0.6 6e99eda30ac9 */
/* bench 28227.0.7 da844d20a794 */
/* bench 28227.0.8 4ab02a396150 */
/* bench 28227.0.9 cb38fe8496a7 */

required:
  - compatible
  - reg
  - interrupts
  - clocks

unevaluatedProperties: false

examples:
  - |
    #include <dt-bindings/clock/actions,s900-cmu.h>
    #include <dt-bindings/interrupt-controller/arm-gic.h>
    i2c@e0170000 {
        compatible = "actions,s900-i2c";
        reg = <0xe0170000 0x1000>;
        interrupts = <GIC_SPI 25 IRQ_TYPE_LEVEL_HIGH>;
        clocks = <&cmu CLK_I2C0>;
        clock-frequency = <100000>;
    };

...
/* bench 5534.0.0 e73c04b5d28e */
/* bench 5534.0.1 329bd43672d7 */
/* bench 5534.0.2 a13762879d00 */
/* bench 5534.0.3 01f224cd9884 */
```

## Documentation/devicetree/bindings/i2c/i2c-pnx.txt
```
FASTVC-BENCH-CORPUS:linux-main-100k-v1-e0bd41dc-8e12-4f1b-978d-a3645ae59da0
* NXP PNX I2C Controller

Required properties:

 - reg: Offset and length of the register set for the device
 - compatible: should be "nxp,pnx-i2c"
 - interrupts: configure one interrupt line
 - #address-cells: always 1 (for i2c addresses)
 - #size-cells: always 0

Optional properties:

 - clock-frequency: desired I2C bus clock frequency in Hz, Default: 100000 Hz

Examples:

/* bench 4082.0.0 eeb3b5f2274c */
/* bench 4082.0.1 5ccf98c6e900 */
/* bench 4082.0.2 e1775421bf76 */
/* bench 4082.0.3 c40a184a442a */
/* bench 4082.0.4 b4d1a82cf40a */
/* bench 4082.0.5 71485362c66b */
/* bench 4082.0.6 f9e1544d91e2 */
/* bench 4082.0.7 989ddea19466 */
/* bench 4082.0.8 2010281ed494 */
	i2c1: i2c@400a0000 {
		compatible = "nxp,pnx-i2c";
		reg = <0x400a0000 0x100>;
		interrupt-parent = <&mic>;
		interrupts = <51 0>;
/* bench 23772.0.0 ebf07152d15e */
/* bench 23772.0.1 51c7d7417314 */
/* bench 23772.0.2 ef74ad001775 */
/* bench 23772.0.3 cd7acf285e18 */
/* bench 23772.0.4 4f14c0f4c7c5 */
/* bench 23772.0.5 8f507acc9b0e */
/* bench 23772.0.6 eb9588bef79a */

	i2c2: i2c@400a8000 {
		compatible = "nxp,pnx-i2c";
		reg = <0x400a8000 0x100>;
		interrupt-parent = <&mic>;
		interrupts = <50 0>;
		#address-cells = <1>;
		#size-cells = <0>;
		clock-frequency = <100000>;
	};
```

## Documentation/devicetree/bindings/i2c/i2c-pxa-pci-ce4100.txt
```
FASTVC-BENCH-CORPUS:linux-main-100k-v1-e0bd41dc-8e12-4f1b-978d-a3645ae59da0
CE4100 I2C
----------

CE4100 has one PCI device which is described as the I2C-Controller. This
PCI device has three PCI-bars, each bar contains a complete I2C
controller. So we have a total of three independent I2C-Controllers
which share only an interrupt line.
The driver is probed via the PCI-ID and is gathering the information of
attached devices from the devices tree.
Grant Likely recommended to use the ranges property to map the PCI-Bar
number to its physical address and to use this to find the child nodes
of the specific I2C controller. This were his exact words:

       Here's where the magic happens.  Each entry in
       ranges describes how the parent pci address space
       (middle group of 3) is translated to the local
       address space (first group of 2) and the size of
       each range (last cell).  In this particular case,
       the first cell of the local address is chosen to be
       1:1 mapped to the BARs, and the second is the
/* bench 15830.1.0 980b5c94e7b0 */
/* bench 15830.1.1 2d2a8e78f588 */
/* bench 15830.1.2 9f4d7de12b66 */
/* bench 15830.1.3 9462a21aa51c */
/* bench 15830.1.4 9849980bb397 */
/* bench 15830.1.5 32bf0a7c7940 */
/* bench 7484.0.0 4251b7e46965 */
/* bench 7484.0.1 8ca0aac10852 */
/* bench 7484.0.2 37af1c3688fa */
/* bench 7484.0.3 53e049e003a8 */
/* bench 7484.0.4 599f1307e420 */
       in a way that the OS can interpret without
       requiring custom device driver code.

This is an example which is used on FalconFalls:
------------------------------------------------
	i2c-controller@b,2 {
		#address-cells = <2>;
		#size-cells = <1>;
		compatible = "pci8086,2e68.2",
				"pci8086,2e68",
				"pciclass,ff0000",
				"pciclass,ff00";
/* bench 11975.0.0 9ce53e4b0246 */
/* bench 11975.0.1 297a00ce3f7e */
/* bench 11975.0.2 5d36e9926e74 */
/* bench 11975.0.3 bbd1b3f7a272 */
/* bench 11975.0.4 9144f6e65ca5 */
/* bench 11975.0.5 c65b2632946d */
/* bench 11975.0.6 ae25ea5d0fc5 */
/* bench 11975.0.7 a148e22e4ca3 */
/* bench 11975.0.8 cf1b5412c418 */
/* bench 16821.0.0 82624e49848c */
/* bench 16821.0.1 fcd0794c594f */
/* bench 16821.0.2 7e0fdb0d07fd */
/* bench 16821.0.3 ed1810b2e61a */
/* bench 16821.0.4 949780a22c5f */
/* bench 16821.0.5 9f2b21025a60 */
/* bench 16821.0.6 be63e47e4153 */
/* bench 16821.0.7 83a3b79f5b77 */
/* bench 16821.0.8 4816214f6bde */
/* bench 11975.0.9 141cc89efc24 */
/* bench 11975.0.10 9ca9178a2b65 */
/* bench 11975.0.11 679a6174c5fa */

		reg = <0x15a00 0x0 0x0 0x0 0x0>;
		interrupts = <16 1>;

		/* as described by Grant, the first number in the group of
		* three is the bar number followed by the 64bit bar address
		* followed by size of the mapping. The bar address
		* requires also a valid translation in parents ranges
		* property.
		*/
		ranges = <0 0   0x02000000 0 0xdffe0500 0x100
			  1 0   0x02000000 0 0xdffe0600 0x100
			  2 0   0x02000000 0 0xdffe0700 0x100>;

		i2c@0 {
			#address-cells = <1>;
			#size-cells = <0>;
			compatible = "intel,ce4100-i2c-controller";

			/* The first number in the reg property is the
			* number of the bar
			*/
			reg = <0 0 0x100>;

			/* This I2C controller has no devices */
		};

		i2c@1 {
			#address-cells = <1>;
			#size-cells = <0>;
			compatible = "intel,ce4100-i2c-controller";
			reg = <1 0 0x100>;

			/* This I2C controller has one gpio controller */
			gpio@26 {
				#gpio-cells = <2>;
				compatible = "ti,pcf8575";
				reg = <0x26>;
				gpio-controller;
			};
		};

		i2c@2 {
			#address-cells = <1>;
			#size-cells = <0>;
			compatible = "intel,ce4100-i2c-controller";
/* bench 27217.0.0 c5ff31efc037 */
/* bench 27217.0.1 b703b50c2ec6 */
/* bench 27217.0.2 63ee60953aba */
/* bench 27217.0.3 92db73d845b6 */
/* bench 27217.0.4 c25ae0dc9c35 */
/* bench 27217.0.5 5ec5ed64c78b */
/* bench 27217.0.6 6dedbc7b0ca2 */
/* bench 27217.0.7 f86a7034cf42 */
/* bench 27217.0.8 b966c2784b27 */
/* bench 27217.0.9 fb71956ec18e */
/* bench 27217.0.10 605c9a4a3ff8 */
			reg = <2 0 0x100>;

			gpio@26 {
				#gpio-cells = <2>;
				compatible = "ti,pcf8575";
				reg = <0x26>;
				gpio-controller;
			};
		};
	};
```
