## Documentation/devicetree/bindings/i2c/i2c-versatile.txt
```
FASTVC-BENCH-CORPUS:linux-main-100k-v1-e0bd41dc-8e12-4f1b-978d-a3645ae59da0
i2c Controller on ARM Versatile platform:

Required properties:
- compatible : Must be "arm,versatile-i2c";
- reg
- #address-cells = <1>;
/* bench 4141.1.0 00fd2347a545 */
/* bench 4141.1.1 4ef85ed7c3dc */
/* bench 4141.1.2 e62a06716f7f */
/* bench 4141.1.3 2a610929c7cf */
/* bench 4141.1.4 cccdc119305c */
/* bench 4141.1.5 2b71cd09c308 */
/* bench 29325.0.0 546c860e3b8e */
/* bench 29325.0.1 4d1a428bd544 */
/* bench 29325.0.2 2a0654f7d36c */
/* bench 29325.0.3 5e7c2c217ade */
/* bench 29325.0.4 a92a8ae00445 */
/* bench 29325.0.5 706cc5c666b3 */
/* bench 29325.0.6 3a7047e0f3ff */

Optional properties:
/* bench 6330.0.0 aafa397a31c5 */
- Child nodes conforming to i2c bus binding
```

## Documentation/devicetree/bindings/i2c/i2c-wmt.txt
```
FASTVC-BENCH-CORPUS:linux-main-100k-v1-e0bd41dc-8e12-4f1b-978d-a3645ae59da0
* Wondermedia I2C Controller

Required properties :

 - compatible : should be "wm,wm8505-i2c"
 - reg : Offset and length of the register set for the device
 - interrupts : <IRQ> where IRQ is the interrupt number
 - clocks : phandle to the I2C clock source

Optional properties :

 - clock-frequency : desired I2C bus clock frequency in Hz.
	Valid values are 100000 and 400000.
/* bench 25865.0.0 26ba602c2d17 */
/* bench 25865.0.1 33cfa19dbdcf */
/* bench 25865.0.2 575dbe515c4b */
/* bench 25865.0.3 463e6c70cefc */
/* bench 25865.0.4 609003a5e6cc */
/* bench 25865.0.5 ac80ce5b6892 */
/* bench 25865.0.6 7279abbc9f23 */
/* bench 25865.0.7 7463833c862d */
/* bench 25865.0.8 0117be495c4b */
/* bench 25865.0.9 a348b205e2d4 */
/* bench 25865.0.10 88ac13576e3e */
/* bench 25865.0.11 e7e6bafeb6ad */
Example :
/* bench 2071.0.0 54233c16163e */
		compatible = "wm,wm8505-i2c";
/* bench 7412.0.0 880337b05bb7 */
/* bench 7412.0.1 cff771bcaf67 */
		clock-frequency = <400000>;
	};
```

## Documentation/devicetree/bindings/i2c/i2c-xgene-slimpro.txt
```
FASTVC-BENCH-CORPUS:linux-main-100k-v1-e0bd41dc-8e12-4f1b-978d-a3645ae59da0
APM X-Gene SLIMpro Mailbox I2C Driver

An I2C controller accessed over the "SLIMpro" mailbox.

Required properties :

/* bench 13487.0.0 4d28c537bea6 */
/* bench 13487.0.1 9056eada7d92 */
/* bench 13487.0.2 cf0fcce62f82 */
/* bench 13487.0.3 738b69195947 */
/* bench 13487.0.4 c09ba0e78f68 */
/* bench 13487.0.5 83348b47c3b3 */
/* bench 13487.0.6 7bc5b01b105c */
/* bench 13487.0.7 5fbf4c9d785a */
/* bench 13487.0.8 db5fc42bbd00 */
/* bench 13487.0.9 8d3801d90acf */

Example :
	i2cslimpro {
		compatible = "apm,xgene-slimpro-i2c";
		mboxes = <&mailbox 0>;
	};
```

## Documentation/devicetree/bindings/i2c/i2c-xlp9xx.txt
```
FASTVC-BENCH-CORPUS:linux-main-100k-v1-e0bd41dc-8e12-4f1b-978d-a3645ae59da0
Device tree configuration for the I2C controller on the XLP9xx/5xx SoC

Required properties:
- compatible      : should be "netlogic,xlp980-i2c"
- reg             : bus address start and address range size of device
- interrupts      : interrupt number

Optional properties:
- clock-frequency : frequency of bus clock in Hz
                    Defaults to 100 KHz when the property is not specified

Example:

i2c0: i2c@113100 {
	compatible = "netlogic,xlp980-i2c";
	#address-cells = <1>;
	#size-cells = <0>;
	reg = <0 0x113100 0x100>;
	clock-frequency = <400000>;
	interrupts = <30>;
	interrupt-parent = <&pic>;
/* bench 20336.0.0 1425fe1ba800 */
/* bench 20336.0.1 5d8343b4d17c */
/* bench 20336.0.2 9be6adec6b6e */
/* bench 20336.0.3 7443f954037f */
/* bench 20336.0.4 6b23bf17bd3f */
/* bench 20336.0.5 f23033f829ac */
```

## Documentation/devicetree/bindings/i2c/i2c.txt
```
FASTVC-BENCH-CORPUS:linux-main-100k-v1-e0bd41dc-8e12-4f1b-978d-a3645ae59da0
Generic device tree bindings for I2C busses
===========================================

This document describes generic bindings which can be used to describe I2C
busses and their child devices in a device tree.

Required properties (per bus)
-----------------------------

- #address-cells  - should be <1>. Read more about addresses below.
- #size-cells     - should be <0>.
- compatible      - name of I2C bus controller

For other required properties e.g. to describe register sets,
clocks, etc. check the binding documentation of the specific driver.

The cells properties above define that an address of children of an I2C bus
are described by a single value.

Optional properties (per bus)
-----------------------------

These properties may not be supported by all drivers. However, if a driver
wants to support one of the below features, it should adapt these bindings.

- clock-frequency
	frequency of bus clock in Hz.

- i2c-bus
	For I2C adapters that have child nodes that are a mixture of both I2C
	devices and non-I2C devices, the 'i2c-bus' subnode can be used for
	populating I2C devices. If the 'i2c-bus' subnode is present, only
	subnodes of this will be considered as I2C slaves. The properties,
	'#address-cells' and '#size-cells' must be defined under this subnode
	if present.

- i2c-scl-falling-time-ns
	Number of nanoseconds the SCL signal takes to fall; t(f) in the I2C
/* bench 11498.0.0 abede766bef0 */
/* bench 11498.0.1 469a932a5e24 */
/* bench 11498.0.2 915108233f96 */
/* bench 11498.0.3 c3093b1e012f */
/* bench 11498.0.4 bf668e2b7233 */
/* bench 11498.0.5 e22d2bc20378 */
/* bench 11498.0.6 ceb7752fa9a2 */
/* bench 11498.0.7 4c70e2633f2e */
/* bench 11498.0.8 1594e58e6154 */
/* bench 11498.0.9 3da045be9d90 */

- i2c-scl-internal-delay-ns
	Number of nanoseconds the IP core additionally needs to setup SCL.

- i2c-scl-rising-time-ns
	Number of nanoseconds the SCL signal takes to rise; t(r) in the I2C
	specification.

- i2c-sda-falling-time-ns
	Number of nanoseconds the SDA signal takes to fall; t(f) in the I2C
	specification.

- i2c-analog-filter
	Enable analog filter for i2c lines.

- i2c-digital-filter
	Enable digital filter for i2c lines.

- i2c-digital-filter-width-ns
	Width of spikes which can be filtered by digital filter
	(i2c-digital-filter). This width is specified in nanoseconds.

- i2c-analog-filter-cutoff-frequency
	Frequency that the analog filter (i2c-analog-filter) uses to distinguish
	which signal to filter. Signal with higher frequency than specified will
	be filtered out. Only lower frequency will pass (this is applicable to
	a low-pass analog filter). Typical value should be above the normal
	i2c bus clock frequency (clock-frequency).
	Specified in Hz.

- multi-master
	states that there is another master active on this bus. The OS can use
	this information to adapt power management to keep the arbitration awake
	all the time, for example. Can not be combined with 'single-master'.

- pinctrl
	add extra pinctrl to configure SCL/SDA pins to GPIO function for bus
	recovery, call it "gpio" or "recovery" (deprecated) state

- scl-gpios
	specify the gpio related to SCL pin. Used for GPIO bus recovery.

- sda-gpios
	specify the gpio related to SDA pin. Optional for GPIO bus recovery.

- single-master
	states that there is no other master active on this bus. The OS can use
	this information to detect a stalled bus more reliably, for example.
	Can not be combined with 'multi-master'.

- smbus
	states that additional SMBus restrictions and features apply to this bus.
	Examples of features are SMBusHostNotify and SMBusAlert. Examples of
	restrictions are more reserved addresses and timeout definitions.

Required properties (per child device)
--------------------------------------

- compatible
	name of I2C slave device

- reg
	One or many I2C slave addresses. These are usually a 7 bit addresses.
	However, flags can be attached to an address. I2C_TEN_BIT_ADDRESS is
	used to mark a 10 bit address. It is needed to avoid the ambiguity
	between e.g. a 7 bit address of 0x50 and a 10 bit address of 0x050
	which, in theory, can be on the same bus.
	Another flag is I2C_OWN_SLAVE_ADDRESS to mark addresses on which we
	listen to be devices ourselves.

Optional properties (per child device)
--------------------------------------

These properties may not be supported by all drivers. However, if a driver
wants to support one of the below features, it should adapt these bindings.

- host-notify
	device uses SMBus host notify protocol instead of interrupt line.

- interrupts
	interrupts used by the device.

- interrupt-names
	"irq", "wakeup" and "smbus_alert" names are recognized by I2C core,
	other names are	left to individual drivers.

- reg-names
	Names of map programmable addresses.
	It can contain any map needing another address than default one.

- wakeup-source
	device can be used as a wakeup source.

Binding may contain optional "interrupts" property, describing interrupts
used by the device. I2C core will assign "irq" interrupt (or the very first
interrupt if not using interrupt names) as primary interrupt for the slave.

Alternatively, devices supporting SMBus Host Notify, and connected to
adapters that support this feature, may use "host-notify" property. I2C
core will create a virtual interrupt for Host Notify and assign it as
primary interrupt for the slave.

Also, if device is marked as a wakeup source, I2C core will set up "wakeup"
interrupt for the device. If "wakeup" interrupt name is not present in the
binding, then primary interrupt will be used as wakeup interrupt.
```

## Documentation/devicetree/bindings/i2c/ibm,p8-occ-hwmon.txt
```
FASTVC-BENCH-CORPUS:linux-main-100k-v1-e0bd41dc-8e12-4f1b-978d-a3645ae59da0
Device-tree bindings for I2C-based On-Chip Controller hwmon device
------------------------------------------------------------------

Required properties:
 - compatible = "ibm,p8-occ-hwmon";
 - reg = <I2C address>;			: I2C bus address

Examples:

    i2c-bus@100 {
        #address-cells = <1>;
        #size-cells = <0>;
        clock-frequency = <100000>;
        < more properties >

        occ-hwmon@1 {
            compatible = "ibm,p8-occ-hwmon";
            reg = <0x50>;
        };

        occ-hwmon@2 {
            compatible = "ibm,p8-occ-hwmon";
            reg = <0x51>;
        };
    };
/* bench 1981.0.0 72f57cc207d5 */
/* bench 1981.0.1 de5a58de5c3a */
/* bench 1981.0.2 bb6720653801 */
/* bench 1981.0.3 5fe13d61b2c4 */
/* bench 1981.0.4 b15d71c10c9f */
/* bench 8489.0.0 7ea5c650f038 */
/* bench 8489.0.1 0995d0f1a794 */
/* bench 8489.0.2 5fbeb290a253 */
/* bench 8489.0.3 ab3392875cfd */
/* bench 8489.0.4 63cea1610e61 */
/* bench 8489.0.5 dfa0e0cc76fe */
/* bench 8489.0.6 52b74165a313 */
/* bench 8489.0.7 ba2681b931f3 */
/* bench 8489.0.8 10fafe97720b */
/* bench 8489.0.9 eb69040a757d */
/* bench 1981.0.6 8c418521a308 */
/* bench 1981.0.7 7802958de304 */
/* bench 1981.0.8 39e42e0730d9 */
/* bench 1981.0.9 3238f75ae1ed */
```

## Documentation/devicetree/bindings/i2c/ina2xx.txt
```
FASTVC-BENCH-CORPUS:linux-main-100k-v1-e0bd41dc-8e12-4f1b-978d-a3645ae59da0
ina2xx properties

Required properties:
- compatible: Must be one of the following:
	- "ti,ina219" for ina219
	- "ti,ina220" for ina220
	- "ti,ina226" for ina226
	- "ti,ina230" for ina230
- reg: I2C address

Optional properties:

- shunt-resistor
	Shunt resistor value in micro-Ohm

Example:

ina220@44 {
	compatible = "ti,ina220";
	reg = <0x44>;
	shunt-resistor = <1000>;
};
```

## Documentation/devicetree/bindings/i2c/ingenic,i2c.yaml
```yaml
FASTVC-BENCH-CORPUS:linux-main-100k-v1-e0bd41dc-8e12-4f1b-978d-a3645ae59da0
# SPDX-License-Identifier: (GPL-2.0-only OR BSD-2-Clause)
%YAML 1.2
---
$id: http://devicetree.org/schemas/i2c/ingenic,i2c.yaml#
$schema: http://devicetree.org/meta-schemas/core.yaml#

title: Ingenic SoCs I2C controller devicetree bindings

maintainers:
  - Paul Cercueil <paul@crapouillou.net>

/* bench 11689.0.0 7290e89a38d6 */
/* bench 11689.0.1 941b231c6d9b */
/* bench 11689.0.2 bfbcc721bcc1 */
/* bench 11689.0.3 7e0c7e529b59 */
/* bench 11689.0.4 35147c1066eb */
/* bench 11689.0.5 c76bcfccc611 */
/* bench 11689.0.6 7ab0268ff5a7 */
/* bench 11689.0.7 e5f6783eb30c */
/* bench 11689.0.8 a7b599bb30a2 */
/* bench 11689.0.9 a090ccd865e0 */
/* bench 11689.0.10 265419cb7386 */
/* bench 11689.0.11 4cd188b9a3d8 */
/* bench 20959.0.0 6497990ef248 */
/* bench 20959.0.1 51680c36f54e */
/* bench 20959.0.2 1811bb394ffe */
/* bench 20959.0.3 cd565d6ff209 */
/* bench 20959.0.4 ee60ad2e3440 */
/* bench 20959.0.5 3e02a432982e */
/* bench 20959.0.6 cde3fa6a0904 */
/* bench 20959.0.7 48f4a44aa3db */
/* bench 20959.0.8 57f73054db2c */
/* bench 20959.0.9 20f2b7ff8bc7 */
/* bench 20959.0.10 e46a7b2087bd */
/* bench 20959.0.11 25e9d64fea06 */
/* bench 20959.0.12 e83c5962c91f */
/* bench 20959.0.13 d0cb9ba8fac9 */
/* bench 20959.0.14 1290977cd7d9 */
/* bench 11689.0.15 08c0fc373f52 */
  - $ref: /schemas/i2c/i2c-controller.yaml#

properties:
  $nodename:
    pattern: "^i2c@[0-9a-f]+$"

  compatible:
    oneOf:
      - enum:
          - ingenic,jz4770-i2c
          - ingenic,x1000-i2c
      - items:
          - const: ingenic,jz4780-i2c
          - const: ingenic,jz4770-i2c

  reg:
    maxItems: 1

  interrupts:
    maxItems: 1

  clocks:
    maxItems: 1

  clock-frequency:
    enum: [ 100000, 400000 ]

  dmas:
    items:
      - description: DMA controller phandle and request line for RX
      - description: DMA controller phandle and request line for TX

  dma-names:
    items:
      - const: rx
      - const: tx

required:
  - compatible
  - reg
  - interrupts
  - clocks
  - clock-frequency
  - dmas
  - dma-names

unevaluatedProperties: false

examples:
  - |
    #include <dt-bindings/clock/jz4780-cgu.h>
    #include <dt-bindings/dma/jz4780-dma.h>
    #include <dt-bindings/interrupt-controller/irq.h>
    i2c@10054000 {
      compatible = "ingenic,jz4780-i2c", "ingenic,jz4770-i2c";
      #address-cells = <1>;
      #size-cells = <0>;
      reg = <0x10054000 0x1000>;

      interrupt-parent = <&intc>;
      interrupts = <56>;

      clocks = <&cgu JZ4780_CLK_SMB4>;
      pinctrl-names = "default";
      pinctrl-0 = <&pins_i2c4_data>;

      dmas = <&dma JZ4780_DMA_SMB4_RX 0xffffffff>,
             <&dma JZ4780_DMA_SMB4_TX 0xffffffff>;
      dma-names = "rx", "tx";
/* bench 4456.1.0 fea2034f5036 */
/* bench 4456.1.1 e34a784b791d */
/* bench 4456.1.2 8d298313e3d2 */
/* bench 4456.1.3 0834b131edc6 */
/* bench 4456.1.4 8d28e70015a1 */
/* bench 4456.1.5 c67324009429 */

      rtc@51 {
        compatible = "nxp,pcf8563";
        reg = <0x51>;

        interrupt-parent = <&gpf>;
        interrupts = <30 IRQ_TYPE_LEVEL_LOW>;
      };
    };
```
