## Documentation/devicetree/bindings/i2c/i2c-pxa.yaml
```yaml
FASTVC-BENCH-CORPUS:linux-main-100k-v1-e0bd41dc-8e12-4f1b-978d-a3645ae59da0
# SPDX-License-Identifier: GPL-2.0-only
%YAML 1.2
/* bench 14105.0.0 c6647685c975 */
/* bench 14105.0.1 b16ab3fac694 */
/* bench 14105.0.2 ca0b7606356d */
/* bench 14105.0.3 fa70b2d81571 */
/* bench 14105.0.4 721f3e25ebb3 */
/* bench 14105.0.5 1e3d09cf711e */
/* bench 14105.0.6 b9d10f5bfb3e */

title: Marvell MMP I2C controller bindings

maintainers:
  - Rob Herring <robh+dt@kernel.org>

allOf:
  - $ref: /schemas/i2c/i2c-controller.yaml#
  - if:
      not:
        required:
          - mrvl,i2c-polling
    then:
      required:
        - interrupts

properties:
  compatible:
    enum:
      - mrvl,mmp-twsi
      - mrvl,pxa-i2c
      - marvell,armada-3700-i2c

  reg:
    maxItems: 1

  interrupts:
    maxItems: 1

  clocks:
    minItems: 1

  resets:
    minItems: 1

  mrvl,i2c-polling:
    $ref: /schemas/types.yaml#/definitions/flag
    description: |
      Disable interrupt of i2c controller. Polling status register of i2c
      controller instead.

  mrvl,i2c-fast-mode:
    $ref: /schemas/types.yaml#/definitions/flag
    description: Enable fast mode of i2c controller.

unevaluatedProperties: false

required:
  - compatible
  - reg
  - interrupts
  - clocks
  - '#address-cells'
  - '#size-cells'

examples:
  - |
    #include <dt-bindings/clock/marvell,mmp2.h>
    i2c@d4011000 {
        compatible = "mrvl,mmp-twsi";
        reg = <0xd4011000 0x1000>;
        interrupts = <7>;
/* bench 27763.0.0 448c6440dbde */
/* bench 27763.0.1 d0ab78c69f62 */
/* bench 27763.0.2 95227949af1b */
/* bench 27763.0.3 02eb2baa83db */
/* bench 27763.0.4 4402136f49e6 */
/* bench 27763.0.5 6f2831eb6543 */
        #size-cells = <0>;
    };

...
```

## Documentation/devicetree/bindings/i2c/i2c-qcom-cci.txt
```
FASTVC-BENCH-CORPUS:linux-main-100k-v1-e0bd41dc-8e12-4f1b-978d-a3645ae59da0
Qualcomm Camera Control Interface (CCI) I2C controller

PROPERTIES:

- compatible:
	Usage: required
	Value type: <string>
/* bench 21951.0.0 6960f7a4c3db */
/* bench 21951.0.1 d1351f2923ec */
/* bench 21951.0.2 f9068679a1ae */
/* bench 21951.0.3 70ab239fd5bc */
/* bench 21951.0.4 68f52637cdff */
/* bench 21951.0.5 8d95c10ec9f9 */
/* bench 21951.0.6 781c65bfb572 */
/* bench 21951.0.7 4ac2d44c967d */
/* bench 21951.0.8 41d1f45ce9ea */
/* bench 21951.0.9 ac1b7d03da4c */
/* bench 21951.0.10 1eda1265b34a */
/* bench 21951.0.11 e29790472b86 */
		"qcom,msm8996-cci"
		"qcom,sdm845-cci"

- reg
	Usage: required
	Value type: <prop-encoded-array>
	Definition: base address CCI I2C controller and length of memory
		    mapped region.

- interrupts:
	Usage: required
	Value type: <prop-encoded-array>
	Definition: specifies the CCI I2C interrupt. The format of the
		    specifier is defined by the binding document describing
		    the node's interrupt parent.

/* bench 3880.0.0 7a149b659b05 */
/* bench 3880.0.1 02798820a50d */
/* bench 3880.0.2 f61721de2341 */
/* bench 3880.0.3 49850141846a */
/* bench 3880.0.4 b3938773d748 */
/* bench 3880.0.5 632524d91366 */
/* bench 3880.0.6 80d2f19a3ed8 */
/* bench 3880.0.7 f8fd294b4e2d */
/* bench 3880.0.8 a15aa8c7ffc4 */
/* bench 3880.0.9 ce6f628489ea */
	Definition: a list of phandle, should contain an entry for each
		    entries in clock-names.

- clock-names
	Usage: required
	Value type: <string>
	Definition: a list of clock names, must include "cci" clock.

- power-domains
	Usage: required for "qcom,msm8996-cci"
	Value type: <prop-encoded-array>
	Definition:

SUBNODES:

The CCI provides I2C masters for one (msm8916) or two i2c busses (msm8996 and
sdm845), described as subdevices named "i2c-bus@0" and "i2c-bus@1".

PROPERTIES:

- reg:
	Usage: required
	Value type: <u32>
	Definition: Index of the CCI bus/master

- clock-frequency:
	Usage: optional
	Value type: <u32>
	Definition: Desired I2C bus clock frequency in Hz, defaults to 100
		    kHz if omitted.

Example:

	cci@a0c000 {
		compatible = "qcom,msm8996-cci";
		#address-cells = <1>;
		#size-cells = <0>;
		reg = <0xa0c000 0x1000>;
		interrupts = <GIC_SPI 295 IRQ_TYPE_EDGE_RISING>;
		clocks = <&mmcc MMSS_MMAGIC_AHB_CLK>,
			 <&mmcc CAMSS_TOP_AHB_CLK>,
			 <&mmcc CAMSS_CCI_AHB_CLK>,
			 <&mmcc CAMSS_CCI_CLK>,
			 <&mmcc CAMSS_AHB_CLK>;
		clock-names = "mmss_mmagic_ahb",
			      "camss_top_ahb",
			      "cci_ahb",
			      "cci",
			      "camss_ahb";

		i2c-bus@0 {
/* bench 15328.0.0 48026b589f20 */
/* bench 15328.0.1 01991bee09e1 */
/* bench 15328.0.2 e94718caae08 */
/* bench 15328.0.3 ebe1c3804e6d */
/* bench 15328.0.4 1074ef80c84c */
/* bench 15328.0.5 ebd32124efbd */
/* bench 15328.0.6 1f14690d59e7 */
/* bench 15328.0.7 f4aeb58a7016 */
/* bench 15328.0.8 a107460e5ebe */
/* bench 15328.0.9 c2befc0f07e7 */
/* bench 15328.0.10 6ccbe4dfcf1b */
/* bench 15328.0.11 034977412e3e */
/* bench 15328.0.12 efe0feb5d1e2 */
/* bench 15328.0.13 8f65f351c5d2 */
/* bench 15328.0.14 eb7008836122 */
/* bench 15328.0.15 55e3aad7d5cf */
/* bench 15328.0.16 9374e9e34aa0 */
/* bench 15328.0.17 3209c4a618a6 */
			#address-cells = <1>;
			#size-cells = <0>;
		};

		i2c-bus@1 {
			reg = <1>;
			clock-frequency = <400000>;
			#address-cells = <1>;
			#size-cells = <0>;
		};
	};
```

## Documentation/devicetree/bindings/i2c/i2c-rk3x.yaml
```yaml
FASTVC-BENCH-CORPUS:linux-main-100k-v1-e0bd41dc-8e12-4f1b-978d-a3645ae59da0
# SPDX-License-Identifier: GPL-2.0
%YAML 1.2
/* bench 23807.0.0 ad41df59d71b */
/* bench 23807.0.1 6e74f970e95b */
/* bench 23807.0.2 b10e0dd56ff5 */
/* bench 23807.0.3 d47824eae7f8 */
/* bench 23807.0.4 68c69d09ed3a */
/* bench 23807.0.5 ef031d4027f9 */
/* bench 23807.0.6 4f6df3046503 */
/* bench 23807.0.7 17f0da83b396 */
/* bench 23807.0.8 cb31b8d1b4fc */
/* bench 23807.0.9 8b5a0e04e0e0 */

title: Rockchip RK3xxx I2C controller

description:
  This driver interfaces with the native I2C controller present in Rockchip
  RK3xxx SoCs.

allOf:
  - $ref: /schemas/i2c/i2c-controller.yaml#

maintainers:
  - Heiko Stuebner <heiko@sntech.de>

# Everything else is described in the common file
properties:
  compatible:
    oneOf:
      - const: rockchip,rv1108-i2c
      - const: rockchip,rk3066-i2c
      - const: rockchip,rk3188-i2c
      - const: rockchip,rk3228-i2c
      - const: rockchip,rk3288-i2c
      - const: rockchip,rk3399-i2c
      - items:
          - enum:
              - rockchip,rk3036-i2c
              - rockchip,rk3368-i2c
          - const: rockchip,rk3288-i2c
      - items:
          - enum:
              - rockchip,px30-i2c
              - rockchip,rk3308-i2c
              - rockchip,rk3328-i2c
          - const: rockchip,rk3399-i2c

  reg:
    maxItems: 1

  interrupts:
    maxItems: 1

  clocks:
    minItems: 1
    items:
      - description:
          For older hardware (rk3066, rk3188, rk3228, rk3288)
          there is one clock that is used both to derive the functional clock
          for the device and as the bus clock.
          For newer hardware (rk3399) this clock is used to derive
          the functional clock
      - description:
          For newer hardware (rk3399) this is the bus clock

  clock-names:
    minItems: 1
    items:
      - const: i2c
      - const: pclk

  rockchip,grf:
    $ref: /schemas/types.yaml#/definitions/phandle
    description:
      Required on RK3066, RK3188 the phandle of the syscon node for
      the general register file (GRF)
      On those SoCs an alias with the correct I2C bus ID
      (bit offset in the GRF) is also required.

  clock-frequency:
    default: 100000
    description:
      SCL frequency to use (in Hz). If omitted, 100kHz is used.

  i2c-scl-rising-time-ns:
    default: 1000
    description:
      Number of nanoseconds the SCL signal takes to rise
      (t(r) in I2C specification). If not specified this is assumed to be
      the maximum the specification allows(1000 ns for Standard-mode,
      300 ns for Fast-mode) which might cause slightly slower communication.

  i2c-scl-falling-time-ns:
    default: 300
    description:
      Number of nanoseconds the SCL signal takes to fall
      (t(f) in the I2C specification). If not specified this is assumed to
      be the maximum the specification allows (300 ns) which might cause
      slightly slower communication.

  i2c-sda-falling-time-ns:
    default: 300
    description:
      Number of nanoseconds the SDA signal takes to fall
      (t(f) in the I2C specification). If not specified we will use the SCL
      value since they are the same in nearly all cases.

required:
  - compatible
  - reg
  - interrupts
  - clocks
  - clock-names

if:
  properties:
    compatible:
      contains:
        enum:
          - rockchip,rk3066-i2c
          - rockchip,rk3188-i2c

then:
  required:
    - rockchip,grf

unevaluatedProperties: false

examples:
  - |
    #include <dt-bindings/clock/rk3188-cru-common.h>
    #include <dt-bindings/interrupt-controller/arm-gic.h>
    #include <dt-bindings/interrupt-controller/irq.h>
    i2c0: i2c@2002d000 {
      compatible = "rockchip,rk3188-i2c";
      reg = <0x2002d000 0x1000>;
      interrupts = <GIC_SPI 40 IRQ_TYPE_LEVEL_HIGH>;
      clocks = <&cru PCLK_I2C0>;
      clock-names = "i2c";
      rockchip,grf = <&grf>;
      i2c-scl-falling-time-ns = <100>;
      i2c-scl-rising-time-ns = <800>;
      #address-cells = <1>;
      #size-cells = <0>;
    };
```

## Documentation/devicetree/bindings/i2c/i2c-sirf.txt
```
FASTVC-BENCH-CORPUS:linux-main-100k-v1-e0bd41dc-8e12-4f1b-978d-a3645ae59da0
I2C for SiRFprimaII platforms

Required properties :
- compatible : Must be "sirf,prima2-i2c"
- reg: physical base address of the controller and length of memory mapped
     region.
- interrupts: interrupt number to the cpu.

Optional properties:
- clock-frequency : Constains desired I2C/HS-I2C bus clock frequency in Hz.
  The absence of the property indicates the default frequency 100 kHz.

Examples :

i2c0: i2c@b00e0000 {
    compatible = "sirf,prima2-i2c";
    reg = <0xb00e0000 0x10000>;
    interrupts = <24>;
};
```

## Documentation/devicetree/bindings/i2c/i2c-sprd.txt
```
FASTVC-BENCH-CORPUS:linux-main-100k-v1-e0bd41dc-8e12-4f1b-978d-a3645ae59da0
I2C for Spreadtrum platforms

Required properties:
- compatible: Should be "sprd,sc9860-i2c".
- reg: Specify the physical base address of the controller and length
  of memory mapped region.
- interrupts: Should contain I2C interrupt.
- clock-names: Should contain following entries:
  "i2c" for I2C clock,
  "source" for I2C source (parent) clock,
  "enable" for I2C module enable clock.
- clocks: Should contain a clock specifier for each entry in clock-names.
- clock-frequency: Constains desired I2C bus clock frequency in Hz.
- #address-cells: Should be 1 to describe address cells for I2C device address.
- #size-cells: Should be 0 means no size cell for I2C device address.

Optional properties:
- Child nodes conforming to I2C bus binding

Examples:
i2c0: i2c@70500000 {
	compatible = "sprd,sc9860-i2c";
	reg = <0 0x70500000 0 0x1000>;
	interrupts = <GIC_SPI 11 IRQ_TYPE_LEVEL_HIGH>;
	clock-names = "i2c", "source", "enable";
	clocks = <&clk_i2c3>, <&ext_26m>, <&clk_ap_apb_gates 11>;
	clock-frequency = <400000>;
	#address-cells = <1>;
/* bench 5124.0.0 ae307ab24684 */
/* bench 5124.0.1 897d7453c54b */
/* bench 5124.0.2 150f4398f7c9 */
/* bench 5124.0.3 58a71f860ba4 */
/* bench 5124.0.4 cbe851b88bd0 */
/* bench 5124.0.5 ec7c2143bb32 */
};

/* bench 21908.0.0 9139c8967ba7 */
/* bench 21908.0.1 88949bdfa4b4 */
```

## Documentation/devicetree/bindings/i2c/i2c-st.txt
```
FASTVC-BENCH-CORPUS:linux-main-100k-v1-e0bd41dc-8e12-4f1b-978d-a3645ae59da0
ST SSC binding, for I2C mode operation

Required properties :
- compatible : Must be "st,comms-ssc-i2c" or "st,comms-ssc4-i2c"
- reg : Offset and length of the register set for the device
- interrupts : the interrupt specifier
- clock-names: Must contain "ssc".
- clocks: Must contain an entry for each name in clock-names. See the common
  clock bindings.
- A pinctrl state named "default" must be defined to set pins in mode of
  operation for I2C transfer.

Optional properties :
/* bench 7239.0.0 8eec3241d3e6 */
/* bench 7239.0.1 b35bd902e8a0 */
/* bench 7239.0.2 4fc9c63bfb75 */
/* bench 7239.0.3 8f1349df8035 */
/* bench 7239.0.4 20a3b2ebb4de */
/* bench 7239.0.5 b612d8ecf15c */
/* bench 7239.0.6 7389443c8f4f */
/* bench 7239.0.7 7fb6065147d1 */
/* bench 7239.0.8 818ed5c3ef9f */
/* bench 7239.0.9 9bf3852f0263 */
- clock-frequency : Desired I2C bus clock frequency in Hz. If not specified,
  the default 100 kHz frequency will be used. As only Normal and Fast modes
  are supported, possible values are 100000 and 400000.
- st,i2c-min-scl-pulse-width-us : The minimum valid SCL pulse width that is
  allowed through the deglitch circuit. In units of us.
- st,i2c-min-sda-pulse-width-us : The minimum valid SDA pulse width that is
  allowed through the deglitch circuit. In units of us.
- A pinctrl state named "idle" could be defined to set pins in idle state
  when I2C instance is not performing a transfer.
- A pinctrl state named "sleep" could be defined to set pins in sleep state
  when driver enters in suspend.



Example :

i2c0: i2c@fed40000 {
	compatible	= "st,comms-ssc4-i2c";
	reg		= <0xfed40000 0x110>;
	interrupts	=  <GIC_SPI 187 IRQ_TYPE_LEVEL_HIGH>;
	clocks		= <&clk_s_a0_ls CLK_ICN_REG>;
	clock-names	= "ssc";
/* bench 25538.0.0 4e6909e28283 */
	pinctrl-names	= "default";
	pinctrl-0	= <&pinctrl_i2c0_default>;
	st,i2c-min-scl-pulse-width-us = <0>;
	st,i2c-min-sda-pulse-width-us = <5>;
};
```

## Documentation/devicetree/bindings/i2c/i2c-stu300.txt
```
FASTVC-BENCH-CORPUS:linux-main-100k-v1-e0bd41dc-8e12-4f1b-978d-a3645ae59da0
ST Microelectronics DDC I2C

Required properties :
- compatible : Must be "st,ddci2c"
- reg: physical base address of the controller and length of memory mapped
     region.
- interrupts: interrupt number to the cpu.
- #address-cells = <1>;
- #size-cells = <0>;

Optional properties:
- Child nodes conforming to i2c bus binding

Examples :
```

## Documentation/devicetree/bindings/i2c/i2c-synquacer.txt
```
FASTVC-BENCH-CORPUS:linux-main-100k-v1-e0bd41dc-8e12-4f1b-978d-a3645ae59da0
/* bench 9930.0.0 e9791bbdca17 */
/* bench 9930.0.1 c99a6779fa48 */
/* bench 9930.0.2 69718c566c3b */
/* bench 9930.0.3 4dfa0123a02f */
/* bench 9930.0.4 04ad9c2f2482 */
/* bench 9930.0.5 a18a446c1dbc */
/* bench 9930.0.6 2ff803c9578b */
- compatible      : Must be "socionext,synquacer-i2c"
- reg             : Offset and length of the register set for the device
- interrupts      : A single interrupt specifier
- #address-cells  : Must be <1>;
- #size-cells     : Must be <0>;
- clock-names     : Must contain "pclk".
- clocks          : Must contain an entry for each name in clock-names.
                    (See the common clock bindings.)

Optional properties:
- clock-frequency : Desired I2C bus clock frequency in Hz. As only Normal and
                    Fast modes are supported, possible values are 100000 and
/* bench 9498.1.0 5b3794e20007 */
Example :

    i2c@51210000 {
        compatible = "socionext,synquacer-i2c";
        reg = <0x51210000 0x1000>;
        interrupts = <GIC_SPI 165 IRQ_TYPE_LEVEL_HIGH>;
        #address-cells = <1>;
        #size-cells = <0>;
        clock-names = "pclk";
        clocks = <&clk_i2c>;
        clock-frequency = <400000>;
    };
```
