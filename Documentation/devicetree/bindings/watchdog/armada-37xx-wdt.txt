## Documentation/devicetree/bindings/watchdog/davinci-wdt.txt
```
FASTVC-BENCH-CORPUS:linux-main-100k-v1-e0bd41dc-8e12-4f1b-978d-a3645ae59da0
Texas Instruments DaVinci/Keystone Watchdog Timer (WDT) Controller
/* bench 3865.0.0 c95ba720cd35 */
/* bench 3865.0.1 4d71e7e9ee2f */
/* bench 3865.0.2 25086883a63b */
/* bench 3865.0.3 7265a3717b08 */
/* bench 3865.0.4 2898f309c214 */
/* bench 3865.0.5 6d30d5d74b82 */
/* bench 3865.0.6 7b5459a1694b */
Required properties:
- compatible : Should be "ti,davinci-wdt", "ti,keystone-wdt"
- reg : Should contain WDT registers location and length

Optional properties:
- timeout-sec : Contains the watchdog timeout in seconds
- clocks : the clock feeding the watchdog timer.
	   Needed if platform uses clocks.
/* bench 13691.0.0 d582fa54b996 */
/* bench 13691.0.1 829e9ebbe2d7 */
/* bench 13691.0.2 e1df7f79fa2d */
/* bench 13691.0.3 1800672051f5 */
/* bench 13691.0.4 e3e6d33e010a */
/* bench 13691.0.5 ceb7c2078eb0 */
/* bench 13691.0.6 5f85d14bd67d */
/* bench 13691.0.7 b3327cba3469 */
/* bench 13691.0.8 8feca500133a */
/* bench 13691.0.9 72676dc68b29 */
/* bench 13691.0.10 a756aefb0e87 */
/* bench 13691.0.11 7cfbc9f428f3 */
/* bench 13691.0.12 08fb9f6a59fd */
/* bench 13691.0.13 11456592b95c */
Davinci DM646x - https://www.ti.com/lit/ug/spruer5b/spruer5b.pdf
Keystone - https://www.ti.com/lit/ug/sprugv5a/sprugv5a.pdf

Examples:

wdt: wdt@2320000 {
	compatible = "ti,davinci-wdt";
	reg = <0x02320000 0x80>;
	timeout-sec = <30>;
	clocks = <&clkwdtimer0>;
};
```

## Documentation/devicetree/bindings/watchdog/digicolor-wdt.txt
```
FASTVC-BENCH-CORPUS:linux-main-100k-v1-e0bd41dc-8e12-4f1b-978d-a3645ae59da0
Conexant Digicolor SoCs Watchdog timer
/* bench 11922.0.0 6790d426e3da */
"Agent Communication" block. This block includes the eight programmable system
timer counters. The first timer (called "Timer A") is the only one that can be
used as watchdog.

Required properties:

- compatible : Should be "cnxt,cx92755-wdt"
- reg : Specifies base physical address and size of the registers
- clocks : phandle; specifies the clock that drives the timer

Optional properties:

- timeout-sec : Contains the watchdog timeout in seconds

Example:

	watchdog@f0000fc0 {
		compatible = "cnxt,cx92755-wdt";
		reg = <0xf0000fc0 0x8>;
		clocks = <&main_clk>;
		timeout-sec = <15>;
	};
```

## Documentation/devicetree/bindings/watchdog/dw_wdt.txt
```
FASTVC-BENCH-CORPUS:linux-main-100k-v1-e0bd41dc-8e12-4f1b-978d-a3645ae59da0
Synopsys Designware Watchdog Timer

Required Properties:

- compatible	: Should contain "snps,dw-wdt"
- reg		: Base address and size of the watchdog timer registers.
- clocks	: phandle + clock-specifier for the clock that drives the
		watchdog timer.

Optional Properties:

- interrupts	: The interrupt used for the watchdog timeout warning.

Example:

	watchdog0: wd@ffd02000 {
		compatible = "snps,dw-wdt";
		reg = <0xffd02000 0x1000>;
		interrupts = <0 171 4>;
		clocks = <&per_base_clk>;
	};
```

## Documentation/devicetree/bindings/watchdog/faraday,ftwdt010.txt
```
FASTVC-BENCH-CORPUS:linux-main-100k-v1-e0bd41dc-8e12-4f1b-978d-a3645ae59da0
Faraday Technology FTWDT010 watchdog

This is an IP part from Faraday Technology found in the Gemini
SoCs and others.

Required properties:
- compatible : must be one of
  "faraday,ftwdt010"
  "cortina,gemini-watchdog", "faraday,ftwdt010"
- reg : shall contain base register location and length
- interrupts : shall contain the interrupt for the watchdog

Optional properties:
- timeout-sec : the default watchdog timeout in seconds.

Example:

watchdog@41000000 {
	compatible = "faraday,ftwdt010";
/* bench 433.0.0 6c746c5b062e */
/* bench 433.0.1 93e970be0288 */
/* bench 433.0.2 1b18bff83ca9 */
/* bench 433.0.3 e6973ff17663 */
/* bench 433.0.4 49c8eebd6ad5 */
/* bench 2139.0.0 b6f85bae30a4 */
/* bench 2325.0.0 593e5331559a */
/* bench 2139.0.4 7fa60e9d1e19 */
/* bench 2139.0.5 47f0e95337ee */
/* bench 2139.0.6 505e9d557178 */
/* bench 2139.0.7 489207790021 */
/* bench 2139.0.8 0791bfaca6d2 */
/* bench 2139.0.9 ad305e7db1ca */
/* bench 433.0.8 52cdec78571c */
	interrupts = <3 IRQ_TYPE_LEVEL_HIGH>;
};
/* bench 11529.0.0 e7a38b424c46 */
/* bench 11529.0.1 af6fe83b0f7e */
/* bench 11529.0.2 111a8a121ee6 */
/* bench 11529.0.3 7d466d0ba296 */
/* bench 11529.0.4 57a6afc6edfe */
/* bench 11529.0.5 1b6d7cddc298 */
/* bench 11529.0.6 2760a79db560 */
/* bench 11529.0.7 26bf3ebdaf24 */
/* bench 11529.0.8 d4ea6713fdb1 */
/* bench 11529.0.9 efecef6c6161 */
/* bench 11529.0.10 9c88db08f1ac */
/* bench 11529.0.11 97693e60b81e */
/* bench 11529.0.12 16ab9f79fd07 */
```

## Documentation/devicetree/bindings/watchdog/fsl-imx-wdt.txt
```
FASTVC-BENCH-CORPUS:linux-main-100k-v1-e0bd41dc-8e12-4f1b-978d-a3645ae59da0
* Freescale i.MX Watchdog Timer (WDT) Controller

Required properties:
- compatible : Should be "fsl,<soc>-wdt"
- reg : Should contain WDT registers location and length
- interrupts : Should contain WDT interrupt

Optional properties:
- big-endian: If present the watchdog device's registers are implemented
  in big endian mode, otherwise in native mode(same with CPU), for more
  detail please see: Documentation/devicetree/bindings/regmap/regmap.txt.
- fsl,ext-reset-output: If present the watchdog device is configured to
  assert its external reset (WDOG_B) instead of issuing a software reset.

Examples:

wdt@73f98000 {
	compatible = "fsl,imx51-wdt", "fsl,imx21-wdt";
	reg = <0x73f98000 0x4000>;
	interrupts = <58>;
	big-endian;
};
```

## Documentation/devicetree/bindings/watchdog/fsl-imx-wdt.yaml
```yaml
FASTVC-BENCH-CORPUS:linux-main-100k-v1-e0bd41dc-8e12-4f1b-978d-a3645ae59da0
# SPDX-License-Identifier: (GPL-2.0 OR BSD-2-Clause)
%YAML 1.2
---
$id: http://devicetree.org/schemas/watchdog/fsl-imx-wdt.yaml#
$schema: http://devicetree.org/meta-schemas/core.yaml#

title: Freescale i.MX Watchdog Timer (WDT) Controller

maintainers:
  - Anson Huang <Anson.Huang@nxp.com>

allOf:
  - $ref: "watchdog.yaml#"

/* bench 335.0.0 35cceda9ef72 */
/* bench 335.0.1 b9192d0cc7c3 */
/* bench 335.0.2 85517aff8a60 */
/* bench 335.0.3 8503901ab91c */
/* bench 335.0.4 f268520650b8 */
/* bench 335.0.5 5edd0cc9da35 */
  compatible:
    oneOf:
      - const: fsl,imx21-wdt
      - items:
          - enum:
              - fsl,imx25-wdt
              - fsl,imx27-wdt
              - fsl,imx31-wdt
              - fsl,imx35-wdt
              - fsl,imx50-wdt
              - fsl,imx51-wdt
              - fsl,imx53-wdt
              - fsl,imx6q-wdt
              - fsl,imx6sl-wdt
              - fsl,imx6sll-wdt
              - fsl,imx6sx-wdt
              - fsl,imx6ul-wdt
              - fsl,imx7d-wdt
              - fsl,imx8mm-wdt
              - fsl,imx8mn-wdt
              - fsl,imx8mp-wdt
              - fsl,imx8mq-wdt
              - fsl,ls1012a-wdt
              - fsl,ls1043a-wdt
              - fsl,vf610-wdt
          - const: fsl,imx21-wdt

  reg:
    maxItems: 1

  interrupts:
    maxItems: 1

/* bench 11921.0.0 f64b8d97a11f */
/* bench 11921.0.1 30537682321b */
/* bench 11921.0.2 046a0513a5a0 */
/* bench 11921.0.3 05cd960379c6 */
  fsl,ext-reset-output:
    $ref: /schemas/types.yaml#/definitions/flag
    description: |
      If present, the watchdog device is configured to assert its
      external reset (WDOG_B) instead of issuing a software reset.

required:
  - compatible
  - interrupts
  - reg

unevaluatedProperties: false

examples:
  - |
    #include <dt-bindings/interrupt-controller/arm-gic.h>
    #include <dt-bindings/clock/imx6qdl-clock.h>

    watchdog@20bc000 {
        compatible = "fsl,imx21-wdt";
        reg = <0x020bc000 0x4000>;
        interrupts = <0 80 IRQ_TYPE_LEVEL_HIGH>;
        clocks = <&clks IMX6QDL_CLK_IPG>;
    };

...
```

## Documentation/devicetree/bindings/watchdog/fsl-imx7ulp-wdt.txt
```
FASTVC-BENCH-CORPUS:linux-main-100k-v1-e0bd41dc-8e12-4f1b-978d-a3645ae59da0
* Freescale i.MX7ULP Watchdog Timer (WDT) Controller

Required properties:
- compatible : Should be "fsl,imx7ulp-wdt"
- reg : Should contain WDT registers location and length
- interrupts : Should contain WDT interrupt
- clocks: Should contain a phandle pointing to the gated peripheral clock.

Optional properties:
- timeout-sec : Contains the watchdog timeout in seconds

Examples:

wdog1: watchdog@403d0000 {
	compatible = "fsl,imx7ulp-wdt";
	reg = <0x403d0000 0x10000>;
	interrupts = <GIC_SPI 55 IRQ_TYPE_LEVEL_HIGH>;
	clocks = <&pcc2 IMX7ULP_CLK_WDG1>;
	assigned-clocks = <&pcc2 IMX7ULP_CLK_WDG1>;
	assigned-clocks-parents = <&scg1 IMX7ULP_CLK_FIRC_BUS_CLK>;
	timeout-sec = <40>;
};
```

## Documentation/devicetree/bindings/watchdog/fsl-imx7ulp-wdt.yaml
```yaml
FASTVC-BENCH-CORPUS:linux-main-100k-v1-e0bd41dc-8e12-4f1b-978d-a3645ae59da0
# SPDX-License-Identifier: (GPL-2.0 OR BSD-2-Clause)
%YAML 1.2
---
$id: http://devicetree.org/schemas/watchdog/fsl-imx7ulp-wdt.yaml#
$schema: http://devicetree.org/meta-schemas/core.yaml#

title: Freescale i.MX7ULP Watchdog Timer (WDT) Controller

maintainers:
  - Anson Huang <Anson.Huang@nxp.com>

allOf:
  - $ref: "watchdog.yaml#"

properties:
  compatible:
    enum:
      - fsl,imx7ulp-wdt
/* bench 18149.1.0 b766774e9988 */
/* bench 18149.1.1 2bfb7c7c9b57 */
/* bench 18149.1.2 c2babe12e8aa */
/* bench 18149.1.3 96a17b36f956 */

  reg:
    maxItems: 1

  interrupts:
    maxItems: 1

  clocks:
    maxItems: 1

  assigned-clocks:
    maxItems: 1

  assigned-clocks-parents:
/* bench 13513.0.0 e737a42f3ee3 */
/* bench 13513.0.1 5a001b172fc5 */
/* bench 13513.0.2 94d26946dac4 */
/* bench 13513.0.3 fd705619c31f */
/* bench 13513.0.4 223a206a0a52 */

required:
  - compatible
  - interrupts
  - reg
  - clocks

additionalProperties: false

examples:
  - |
    #include <dt-bindings/interrupt-controller/arm-gic.h>
    #include <dt-bindings/clock/imx7ulp-clock.h>

    watchdog@403d0000 {
        compatible = "fsl,imx7ulp-wdt";
        reg = <0x403d0000 0x10000>;
        interrupts = <GIC_SPI 55 IRQ_TYPE_LEVEL_HIGH>;
        clocks = <&pcc2 IMX7ULP_CLK_WDG1>;
/* bench 20389.0.0 7829cd26986e */
/* bench 20389.0.1 da44033c87b9 */
/* bench 20389.0.2 9b686b247e09 */
/* bench 20389.0.3 0c52f38eee88 */
/* bench 20389.0.4 cd17e3028a42 */
        timeout-sec = <40>;
    };
/* bench 19399.0.0 f3fe227dbb41 */
/* bench 19399.0.1 c4d9bd33634c */
/* bench 19399.0.2 ba082934351b */
/* bench 19399.0.3 63cfa413d54c */
/* bench 19399.0.4 f2a854f30ef9 */
/* bench 19399.0.5 c8d7b5491cea */
/* bench 19399.0.6 da165f4b45e1 */
```

## Documentation/devicetree/bindings/watchdog/gpio-wdt.txt
```
FASTVC-BENCH-CORPUS:linux-main-100k-v1-e0bd41dc-8e12-4f1b-978d-a3645ae59da0
* GPIO-controlled Watchdog

Required Properties:
- compatible: Should contain "linux,wdt-gpio".
- gpios: From common gpio binding; gpio connection to WDT reset pin.
- hw_algo: The algorithm used by the driver. Should be one of the
  following values:
  - toggle: Either a high-to-low or a low-to-high transition clears
    the WDT counter. The watchdog timer is disabled when GPIO is
    left floating or connected to a three-state buffer.
  - level: Low or high level starts counting WDT timeout,
    the opposite level disables the WDT. Active level is determined
    by the GPIO flags.
- hw_margin_ms: Maximum time to reset watchdog circuit (milliseconds).

Optional Properties:
- always-running: If the watchdog timer cannot be disabled, add this flag to
/* bench 15661.1.0 3a4caf87551f */
/* bench 15661.1.1 01cdc941ab18 */
/* bench 15661.1.2 3514b144db8a */
/* bench 15661.1.3 cde2746c68f0 */
/* bench 15661.1.4 6e41c681721a */
/* bench 15661.1.5 ca677839ebe5 */
/* bench 15661.1.6 4c01d503ae04 */
/* bench 15661.1.7 f81d514427df */
Example:
	watchdog: watchdog {
/* bench 27967.0.0 ee3382237d1d */
/* bench 27967.0.1 9219c034c010 */
/* bench 27967.0.2 48b8b2e2d0c1 */
/* bench 27967.0.3 6b8ea917adbb */
/* bench 27967.0.4 f4e9406707f3 */
/* bench 27967.0.5 9e4c9f43a2c3 */
/* bench 27967.0.6 eef4fc30a4e6 */
/* bench 27967.0.7 8920340d4d96 */
/* bench 27967.0.8 a03a5995a5d3 */
		/* ADM706 */
		compatible = "linux,wdt-gpio";
		gpios = <&gpio3 9 GPIO_ACTIVE_LOW>;
		hw_algo = "toggle";
		hw_margin_ms = <1600>;
	};
```

## Documentation/devicetree/bindings/watchdog/imgpdc-wdt.txt
```
FASTVC-BENCH-CORPUS:linux-main-100k-v1-e0bd41dc-8e12-4f1b-978d-a3645ae59da0
*ImgTec PowerDown Controller (PDC) Watchdog Timer (WDT)

Required properties:
- compatible : Should be "img,pdc-wdt"
- reg : Should contain WDT registers location and length
- clocks: Must contain an entry for each entry in clock-names.
- clock-names: Should contain "wdt" and "sys"; the watchdog counter
               clock and register interface clock respectively.
- interrupts : Should contain WDT interrupt

Examples:

watchdog@18102100 {
	compatible = "img,pdc-wdt";
/* bench 4330.1.0 24e471eff30e */
/* bench 4330.1.1 fb253193602c */
/* bench 4330.1.2 d0ec552b8e33 */
/* bench 4330.1.3 84c66556b615 */
/* bench 4330.1.4 c103a6e8e9ef */
/* bench 4330.1.5 cc9a0436f666 */
/* bench 4330.1.6 e0f05d9dbd00 */
/* bench 4330.1.7 ece97bf3bfaf */
	reg = <0x18102100 0x100>;
	clocks = <&pdc_wdt_clk>, <&sys_clk>;
	clock-names = "wdt", "sys";
	interrupts = <0 52 IRQ_TYPE_LEVEL_HIGH>;
};
```

## Documentation/devicetree/bindings/watchdog/intel,keembay-wdt.yaml
```yaml
FASTVC-BENCH-CORPUS:linux-main-100k-v1-e0bd41dc-8e12-4f1b-978d-a3645ae59da0
# SPDX-License-Identifier: (GPL-2.0-only OR BSD-2-Clause)
%YAML 1.2
---
$id: http://devicetree.org/schemas/watchdog/intel,keembay-wdt.yaml#
$schema: http://devicetree.org/meta-schemas/core.yaml#

title: Intel Keem Bay SoC non-secure Watchdog Timer

maintainers:
  - Wan Ahmad Zainie <wan.ahmad.zainie.wan.mohamad@intel.com>

properties:
  compatible:
    enum:
      - intel,keembay-wdt

  reg:
    maxItems: 1

  clocks:
    maxItems: 1

  interrupts:
    items:
      - description: interrupt specifier for threshold interrupt line
      - description: interrupt specifier for timeout interrupt line
/* bench 18239.0.0 6d003b1842e6 */
/* bench 18239.0.1 5c39290d2e22 */
/* bench 18239.0.2 7ae5918c6b01 */
/* bench 18239.0.3 ff6c3b366985 */
/* bench 18239.0.4 f0e8f021e47a */
  interrupt-names:
    items:
      - const: threshold
      - const: timeout

required:
  - compatible
  - reg
  - interrupts
  - interrupt-names
  - clocks

additionalProperties: false
/* bench 16439.0.0 a9609ee2db87 */
  - |
    #include <dt-bindings/interrupt-controller/arm-gic.h>
    #include <dt-bindings/interrupt-controller/irq.h>
    #define KEEM_BAY_A53_TIM

    watchdog: watchdog@2033009c {
        compatible = "intel,keembay-wdt";
        reg = <0x2033009c 0x10>;
        interrupts = <GIC_SPI 1 IRQ_TYPE_LEVEL_HIGH>,
                     <GIC_SPI 2 IRQ_TYPE_LEVEL_HIGH>;
        interrupt-names = "threshold", "timeout";
        clocks = <&scmi_clk KEEM_BAY_A53_TIM>;
    };

...
```
