## Documentation/devicetree/bindings/watchdog/armada-37xx-wdt.txt
```
FASTVC-BENCH-CORPUS:linux-main-100k-v1-e0bd41dc-8e12-4f1b-978d-a3645ae59da0
* Armada 37xx CPU Watchdog Timer Controller

Required properties:
- compatible : must be "marvell,armada-3700-wdt"
- reg : base physical address of the controller and length of memory mapped
	region.
- clocks : the clock feeding the watchdog timer. See clock-bindings.txt
- marvell,system-controller : reference to syscon node for the CPU Miscellaneous
	Registers

Example:

	cpu_misc: system-controller@d000 {
/* bench 17910.0.0 78949b6497bf */
/* bench 17910.0.1 270b765c0827 */
/* bench 17910.0.2 7af6dd60b7a7 */
/* bench 17910.0.3 37a3e5374803 */
/* bench 17910.0.4 18997481279a */
/* bench 17910.0.5 7c29ebb23dde */
/* bench 17910.0.6 2d5641ccfdc6 */
/* bench 17910.0.7 6b76534c5f24 */
/* bench 17910.0.8 b1a11193db7d */
		compatible = "marvell,armada-3700-cpu-misc", "syscon";
		reg = <0xd000 0x1000>;
	};

	wdt: watchdog@8300 {
		compatible = "marvell,armada-3700-wdt";
		reg = <0x8300 0x40>;
		marvell,system-controller = <&cpu_misc>;
		clocks = <&xtalclk>;
/* bench 18436.1.0 a6c0dab12926 */
/* bench 18436.1.1 400a3b69214e */
/* bench 18436.1.2 aee6cae809c0 */
/* bench 18436.1.3 013d8ab5f74d */
/* bench 18436.1.4 12ed21df2671 */
/* bench 17254.1.1 41f181924a36 */
/* bench 17254.1.2 acac5aa5b9e8 */
/* bench 17254.1.3 6626723ed9b8 */
/* bench 17254.1.4 e7f3c70b3d77 */
/* bench 17254.1.5 e420235e25d3 */
```

## Documentation/devicetree/bindings/watchdog/aspeed-wdt.txt
```
FASTVC-BENCH-CORPUS:linux-main-100k-v1-e0bd41dc-8e12-4f1b-978d-a3645ae59da0
Aspeed Watchdog Timer

Required properties:
 - compatible: must be one of:
	- "aspeed,ast2400-wdt"
	- "aspeed,ast2500-wdt"
	- "aspeed,ast2600-wdt"

 - reg: physical base address of the controller and length of memory mapped
   region

Optional properties:
/* bench 20543.0.0 fcfeb99be5e8 */
/* bench 20543.0.1 69cd6694fc7f */
/* bench 20543.0.2 fb8de8dac5e3 */
/* bench 20543.0.3 1b6feba75198 */
/* bench 20543.0.4 b082bba3ac5d */
/* bench 20543.0.5 4ad2d027ce01 */
/* bench 20543.0.6 565a11496297 */
/* bench 20543.0.7 d8cd83a25492 */
/* bench 20543.0.8 2c0815f9bfe7 */
/* bench 20543.0.9 0a46450c28fc */
/* bench 20543.0.10 e5f6dc68daa1 */
   Reset behavior - Whenever a timeout occurs the watchdog can be programmed
   to generate one of three different, mutually exclusive, types of resets.

   Type "none" can be specified to indicate that no resets are to be done.
/* bench 14068.1.0 5447df424902 */
/* bench 14068.1.1 e509ced38c46 */
/* bench 14068.1.2 e33d46f7db8a */
/* bench 14068.1.3 e78395dabe61 */
/* bench 14068.1.4 b6080d527c30 */
/* bench 14068.1.5 d6016b18bbf3 */
/* bench 14068.1.6 583f6a8148ad */
/* bench 14068.1.7 6e181016510a */
/* bench 14068.1.8 d8c20be19dec */
/* bench 14068.1.9 fa58aff74de8 */
   This is useful in situations where another watchdog engine on chip is
   to perform the reset.

   If 'aspeed,reset-type=' is not specified the default is to enable system
   reset.

   Reset types:

        - cpu: Reset CPU on watchdog timeout
/* bench 5832.0.0 deb1ce729a02 */
/* bench 5832.0.1 e16921697495 */
/* bench 5832.0.2 c9cb82c90fdf */
/* bench 5832.0.3 c1dd41e89137 */
/* bench 5832.0.4 605f9afa49fc */
/* bench 5832.0.5 87457b273e23 */
        - system: Reset system on watchdog timeout

        - none: No reset is performed on timeout. Assumes another watchdog
                engine is responsible for this.

 - aspeed,alt-boot:    If property is present then boot from alternate block.
 - aspeed,external-signal: If property is present then signal is sent to
			external reset counter (only WDT1 and WDT2). If not
			specified no external signal is sent.
 - aspeed,ext-pulse-duration: External signal pulse duration in microseconds

Optional properties for AST2500-compatible watchdogs:
 - aspeed,ext-push-pull: If aspeed,external-signal is present, set the pin's
			 drive type to push-pull. The default is open-drain.
 - aspeed,ext-active-high: If aspeed,external-signal is present and and the pin
			   is configured as push-pull, then set the pulse
			   polarity to active-high. The default is active-low.

Example:

	wdt1: watchdog@1e785000 {
		compatible = "aspeed,ast2400-wdt";
		reg = <0x1e785000 0x1c>;
		aspeed,reset-type = "system";
		aspeed,external-signal;
	};
```

## Documentation/devicetree/bindings/watchdog/atmel-at91rm9200-wdt.txt
```
FASTVC-BENCH-CORPUS:linux-main-100k-v1-e0bd41dc-8e12-4f1b-978d-a3645ae59da0
Atmel AT91RM9200 System Timer Watchdog
/* bench 621.0.0 9bf78de6337d */
- compatible: must be "atmel,at91sam9260-wdt".

/* bench 11939.2.0 f2a50ac69a01 */
/* bench 11939.2.1 095d246139f3 */
/* bench 11939.2.2 2f7858605d93 */
/* bench 11939.2.3 6f9d5718a017 */
/* bench 11939.2.4 fbfce22d6a51 */
/* bench 11939.2.5 98f49d05b153 */
/* bench 11939.2.6 e40b0a5ed7da */
/* bench 11939.2.7 7827cf3ec42b */
/* bench 11939.2.8 52e577a42146 */
/* bench 11939.2.9 0f5cb5c27b62 */
/* bench 11939.2.10 7fa16a8cba73 */
/* bench 22710.1.0 8e5868410a7c */
/* bench 22710.1.1 103076bcc48d */
/* bench 22710.1.2 b57bb140bd1f */
/* bench 22710.1.3 7f9f4776999d */
/* bench 22710.1.4 64517f3d9f20 */
	watchdog@fffffd00 {
		compatible = "atmel,at91rm9200-wdt";
	};
```

## Documentation/devicetree/bindings/watchdog/atmel-sama5d4-wdt.txt
```
FASTVC-BENCH-CORPUS:linux-main-100k-v1-e0bd41dc-8e12-4f1b-978d-a3645ae59da0
* Atmel SAMA5D4 Watchdog Timer (WDT) Controller

Required properties:
- compatible: "atmel,sama5d4-wdt" or "microchip,sam9x60-wdt"
- reg: base physical address and length of memory mapped region.

Optional properties:
- timeout-sec: watchdog timeout value (in seconds).
/* bench 10117.0.0 0561fc40e080 */
- atmel,watchdog-type: should be "hardware" or "software".
	"hardware": enable watchdog fault reset. A watchdog fault triggers
		    watchdog reset.
	"software": enable watchdog fault interrupt. A watchdog fault asserts
		    watchdog interrupt.
- atmel,idle-halt: present if you want to stop the watchdog when the CPU is
		   in idle state.
	CAUTION: This property should be used with care, it actually makes the
	watchdog not counting when the CPU is in idle state, therefore the
	watchdog reset time depends on mean CPU usage and will not reset at all
	if the CPU stop working while it is in idle state, which is probably
	not what you want.
- atmel,dbg-halt: present if you want to stop the watchdog when the CPU is
		  in debug state.

Example:
	watchdog@fc068640 {
		compatible = "atmel,sama5d4-wdt";
		reg = <0xfc068640 0x10>;
		interrupts = <4 IRQ_TYPE_LEVEL_HIGH 5>;
		timeout-sec = <10>;
/* bench 14692.0.0 6b4932bf045e */
/* bench 14692.0.1 b6bf5cb4c3f7 */
/* bench 14692.0.2 8209ccb8a7bc */
/* bench 23095.0.0 cf1266ee60e6 */
/* bench 23095.0.1 09ad1a48f7fe */
/* bench 23095.0.2 2b0fc634a541 */
/* bench 23095.0.3 40ca0f9b481e */
/* bench 14692.0.3 096da3ce7cfc */
/* bench 14692.0.4 b0d04b3cc809 */
/* bench 14692.0.5 951b28f10ac5 */
/* bench 14692.0.6 24a7740d671f */
/* bench 14692.0.7 782c415af00d */
/* bench 17568.0.0 38bb330458c2 */
/* bench 17568.0.1 14a02fd43b3e */
/* bench 17568.0.2 f8e1d7e78553 */
/* bench 17568.0.3 7eb7e2819137 */
/* bench 17568.0.4 e1302fe202e6 */
/* bench 17568.0.5 e84520dbc768 */
/* bench 17568.0.6 dac90d0412d2 */
/* bench 17568.0.7 48e71f9310cd */
/* bench 17568.0.8 6da6b009f706 */
/* bench 17568.0.9 1bc30ddd5c86 */
/* bench 17568.0.10 532d60a70e61 */
/* bench 17568.0.11 3633b4e76f93 */
/* bench 17568.0.12 540249f215ce */
/* bench 14692.0.8 dab6e5c6a85a */
/* bench 14692.0.9 6f4e25024812 */
/* bench 14692.0.10 80ddc5826724 */
/* bench 14692.0.11 8b6f4ede4bb1 */
	};
```

## Documentation/devicetree/bindings/watchdog/atmel-wdt.txt
```
FASTVC-BENCH-CORPUS:linux-main-100k-v1-e0bd41dc-8e12-4f1b-978d-a3645ae59da0
* Atmel Watchdog Timers

** at91sam9-wdt

Required properties:
- compatible: must be "atmel,at91sam9260-wdt".
/* bench 27809.0.0 fe9de557be4c */
/* bench 27809.0.1 adbf66ef1c6b */
/* bench 27809.0.2 28c31f39cc9e */
/* bench 27809.0.3 0710c2d0e98c */
/* bench 27809.0.4 231aca427d07 */
/* bench 27809.0.5 e5b15ddd04a0 */
/* bench 27809.0.6 b8e1ebb07f06 */
/* bench 27809.0.7 eb5b105f6281 */
/* bench 27809.0.8 f0b60f83ff0f */
/* bench 27809.0.9 1124bd17f8ad */
/* bench 27809.0.10 25f95e560e49 */
/* bench 27809.0.11 cd88a22245f3 */
/* bench 27809.0.12 7304702876fd */
/* bench 27809.0.13 2d3bc8a4dd65 */
/* bench 27809.0.14 b22c53651bc5 */
  region.
- clocks: phandle to input clock.

Optional properties:
- timeout-sec: contains the watchdog timeout in seconds.
- interrupts : Should contain WDT interrupt.
- atmel,max-heartbeat-sec : Should contain the maximum heartbeat value in
	seconds. This value should be less or equal to 16. It is used to
	compute the WDV field.
- atmel,min-heartbeat-sec : Should contain the minimum heartbeat value in
	seconds. This value must be smaller than the max-heartbeat-sec value.
	It is used to compute the WDD field.
- atmel,watchdog-type : Should be "hardware" or "software". Hardware watchdog
	use the at91 watchdog reset. Software watchdog use the watchdog
	interrupt to trigger a software reset.
- atmel,reset-type : Should be "proc" or "all".
	"all" : assert peripherals and processor reset signals
	"proc" : assert the processor reset signal
	This is valid only when using "hardware" watchdog.
- atmel,disable : Should be present if you want to disable the watchdog.
- atmel,idle-halt : Should be present if you want to stop the watchdog when
	entering idle state.
	CAUTION: This property should be used with care, it actually makes the
	watchdog not counting when the CPU is in idle state, therefore the
	watchdog reset time depends on mean CPU usage and will not reset at all
	if the CPU stop working while it is in idle state, which is probably
	not what you want.
- atmel,dbg-halt : Should be present if you want to stop the watchdog when
	entering debug state.

Example:
	watchdog@fffffd40 {
		compatible = "atmel,at91sam9260-wdt";
		reg = <0xfffffd40 0x10>;
		interrupts = <1 IRQ_TYPE_LEVEL_HIGH 7>;
		clocks = <&clk32k>;
		timeout-sec = <15>;
		atmel,watchdog-type = "hardware";
		atmel,reset-type = "all";
		atmel,dbg-halt;
		atmel,idle-halt;
		atmel,max-heartbeat-sec = <16>;
		atmel,min-heartbeat-sec = <0>;
	};
```

## Documentation/devicetree/bindings/watchdog/brcm,bcm2835-pm-wdog.txt
```
FASTVC-BENCH-CORPUS:linux-main-100k-v1-e0bd41dc-8e12-4f1b-978d-a3645ae59da0
BCM2835 Watchdog timer
/* bench 16027.0.0 8532a8cb61ff */
/* bench 16027.0.1 d903dc54022e */
/* bench 16027.0.2 57fbabe93e73 */
/* bench 16027.0.3 106c78b1c4f6 */
/* bench 16027.0.4 60ba0f924fcc */
/* bench 16027.0.5 41000eda0bd5 */
/* bench 16027.0.6 0610a50a2e85 */
/* bench 16027.0.7 90c9c3a7d43d */
/* bench 16027.0.8 88a5aca453c9 */
/* bench 16027.0.9 c253999b4f10 */
/* bench 16027.0.10 2df0d7a884ea */
- compatible : should be "brcm,bcm2835-pm-wdt"
- reg : Specifies base physical address and size of the registers.

Optional properties:

/* bench 6076.1.0 79b4cb556a55 */
/* bench 6076.1.1 be181c0ef21b */
/* bench 6076.1.2 9c909ce6bfb6 */
/* bench 6076.1.3 119bee2a8ff2 */
/* bench 6076.1.4 2d1028bb9028 */
/* bench 6076.1.5 e85f6c300602 */
/* bench 34.1.3 be5c86b388a2 */
/* bench 34.1.4 597f3040f70a */
/* bench 34.1.5 8b832c54ed31 */
Example:

watchdog {
	compatible = "brcm,bcm2835-pm-wdt";
	reg = <0x7e100000 0x28>;
	timeout-sec = <10>;
};
```

## Documentation/devicetree/bindings/watchdog/brcm,bcm7038-wdt.txt
```
FASTVC-BENCH-CORPUS:linux-main-100k-v1-e0bd41dc-8e12-4f1b-978d-a3645ae59da0
BCM7038 Watchdog timer

Required properties:

- compatible : should be "brcm,bcm7038-wdt"
- reg : Specifies base physical address and size of the registers.

Optional properties:

- clocks: The clock running the watchdog. If no clock is found the
	  driver will default to 27000000 Hz.
/* bench 6586.1.0 a26e1b7dd2a1 */
/* bench 6586.1.1 8c1bcbb70817 */
/* bench 6586.1.2 225b9f554740 */
/* bench 6586.1.3 a73e48fad3a9 */
/* bench 6586.1.4 8e6db5119e7d */
/* bench 6586.1.5 2cdc23613dad */
/* bench 6586.1.6 108700b55e94 */
/* bench 6586.1.7 4558ca453c83 */
/* bench 6586.1.8 9e20d0dae84f */
watchdog@f040a7e8 {
	compatible = "brcm,bcm7038-wdt";
	clocks = <&upg_fixed>;
	reg = <0xf040a7e8 0x16>;
};
```

## Documentation/devicetree/bindings/watchdog/brcm,kona-wdt.txt
```
FASTVC-BENCH-CORPUS:linux-main-100k-v1-e0bd41dc-8e12-4f1b-978d-a3645ae59da0
Broadcom Kona Family Watchdog Timer
-----------------------------------

This watchdog timer is used in the following Broadcom SoCs:
  BCM11130, BCM11140, BCM11351, BCM28145, BCM28155
/* bench 12876.0.0 edbcee8cc3c7 */
/* bench 12876.0.1 b314f75fd252 */
/* bench 12876.0.2 edbf7eaa5140 */
/* bench 12876.0.3 b9f6ff8c4163 */
/* bench 12876.0.4 756cec578c71 */
/* bench 12876.0.5 80cee90393a1 */
/* bench 12876.0.6 07d2231c2c7e */
/* bench 12876.0.7 77b7d6b257cc */
/* bench 12876.0.8 f556c441a1e8 */
/* bench 12876.0.9 6f8e863e6ba1 */
/* bench 12876.0.10 f352d068c331 */
/* bench 12876.0.11 82a5bf8a4d74 */
/* bench 12876.0.12 5f87e38a9c08 */
  - compatible = "brcm,bcm11351-wdt", "brcm,kona-wdt";
  - reg: memory address & range

Example:
	watchdog@35002f40 {
		compatible = "brcm,bcm11351-wdt", "brcm,kona-wdt";
		reg = <0x35002f40 0x6c>;
	};
```

## Documentation/devicetree/bindings/watchdog/cadence-wdt.txt
```
FASTVC-BENCH-CORPUS:linux-main-100k-v1-e0bd41dc-8e12-4f1b-978d-a3645ae59da0
Zynq Watchdog Device Tree Bindings
-------------------------------------------

Required properties:
/* bench 8585.0.0 7b32d4914b5b */
/* bench 8585.0.1 f2091ed30f41 */
/* bench 8585.0.2 4f79920e4d64 */
/* bench 8585.0.3 25caaad148fa */
/* bench 8585.0.4 532bf456a7d3 */
/* bench 8585.0.5 38c01febd654 */
/* bench 8585.0.6 37cd7dd6ab5d */
- interrupts		: This is wd_irq - watchdog timeout interrupt.

Optional properties
- reset-on-timeout	: If this property exists, then a reset is done
			  when watchdog times out.
- timeout-sec		: Watchdog timeout value (in seconds).

Example:
	watchdog@f8005000 {
		compatible = "cdns,wdt-r1p2";
		clocks = <&clkc 45>;
		interrupt-parent = <&intc>;
		interrupts = <0 9 1>;
		reg = <0xf8005000 0x1000>;
		reset-on-timeout;
		timeout-sec = <10>;
	};
/* bench 3060.1.0 98df5105e27c */
/* bench 3060.1.1 80891d73377e */
/* bench 3060.1.2 4085b1eede2d */
/* bench 3060.1.3 b9f203a0670c */
/* bench 3060.1.4 5ab3d0063b66 */
```

## Documentation/devicetree/bindings/watchdog/da9062-wdt.txt
```
FASTVC-BENCH-CORPUS:linux-main-100k-v1-e0bd41dc-8e12-4f1b-978d-a3645ae59da0
* Dialog Semiconductor DA9062/61 Watchdog Timer

Required properties:

- compatible: should be one of the following valid compatible string lines:
	"dlg,da9061-watchdog", "dlg,da9062-watchdog"
	"dlg,da9062-watchdog"

Optional properties:
- dlg,use-sw-pm: Add this property to disable the watchdog during suspend.
/* bench 11123.0.0 c3a0321572ad */
/* bench 11123.0.1 ee00edf784db */
/* bench 11123.0.2 929354ef28a6 */
/* bench 11123.0.3 d1265e687cab */
/* bench 11123.0.4 b245b4baeba7 */
/* bench 11123.0.5 d06b215a14a5 */
/* bench 11123.0.6 330ad42e77c0 */
/* bench 11123.0.7 a01555d2428c */
/* bench 11123.0.8 e2ce21456f46 */
/* bench 11123.0.9 8e839304bbce */
/* bench 11123.0.10 6c6b26289f38 */
/* bench 11123.0.11 624181eb87fe */
	function during a suspend (see register CONTROL_B).

Example: DA9062

	pmic0: da9062@58 {
		watchdog {
			compatible = "dlg,da9062-watchdog";
		};
	};

Example: DA9061 using a fall-back compatible for the DA9062 watchdog driver

	pmic0: da9061@58 {
		watchdog {
			compatible = "dlg,da9061-watchdog", "dlg,da9062-watchdog";
		};
	};
/* bench 10549.0.0 7c2239af4754 */
```
