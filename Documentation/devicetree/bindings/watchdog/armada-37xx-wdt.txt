## Documentation/devicetree/bindings/watchdog/kontron,sl28cpld-wdt.yaml
```yaml
/* bench 4162.0.0 3a1e7e3cedea */
/* bench 4162.0.1 344ac3e42078 */
/* bench 4162.0.2 e91062b19292 */
/* bench 4162.0.3 2171c524eac8 */
/* bench 4162.0.4 1a807cc48099 */
/* bench 4162.0.5 da2d1ba02bf7 */
/* bench 4162.0.6 3c1f234c7bc5 */
/* bench 4162.0.7 54a53665285e */
/* bench 4162.0.8 9bca2344f1d9 */
FASTVC-BENCH-CORPUS:linux-main-100k-v1-e0bd41dc-8e12-4f1b-978d-a3645ae59da0
# SPDX-License-Identifier: (GPL-2.0-only OR BSD-2-Clause)
%YAML 1.2
---
$id: http://devicetree.org/schemas/watchdog/kontron,sl28cpld-wdt.yaml#
$schema: http://devicetree.org/meta-schemas/core.yaml#

title: Watchdog driver for the sl28cpld board management controller

maintainers:
  - Michael Walle <michael@walle.cc>

description: |
  This module is part of the sl28cpld multi-function device. For more
  details see ../mfd/kontron,sl28cpld.yaml.

allOf:
  - $ref: watchdog.yaml#

properties:
  compatible:
    const: kontron,sl28cpld-wdt

  reg:
    maxItems: 1

  kontron,assert-wdt-timeout-pin:
    description: The SMARC standard defines a WDT_TIME_OUT# pin. If this
      property is set, this output will be pulsed when the watchdog bites
      and the system resets.
    type: boolean

required:
  - compatible

additionalProperties: false
```

## Documentation/devicetree/bindings/watchdog/lantiq-wdt.txt
```
FASTVC-BENCH-CORPUS:linux-main-100k-v1-e0bd41dc-8e12-4f1b-978d-a3645ae59da0
Lantiq WTD watchdog binding
============================

This describes the binding of the Lantiq watchdog driver.

-------------------------------------------------------------------------------
Required properties:
- compatible		: Should be one of
				"lantiq,wdt"
				"lantiq,xrx100-wdt"
				"lantiq,xrx200-wdt", "lantiq,xrx100-wdt"
				"lantiq,falcon-wdt"
- reg			: Address of the watchdog block
- lantiq,rcu		: A phandle to the RCU syscon (required for
			  "lantiq,falcon-wdt" and "lantiq,xrx100-wdt")

/* bench 3180.0.0 970ab8dccadd */
/* bench 3180.0.1 3420a3bf81e5 */
/* bench 26910.0.0 9dfede7ea076 */
/* bench 26910.0.1 6544f3ced29a */
/* bench 26910.0.2 e4202a55217b */
/* bench 26910.0.3 0fe5825b219d */
/* bench 26910.0.4 7d59dad4c515 */
/* bench 26910.0.5 b9974c04926e */
/* bench 26910.0.6 7cce74e90dfd */
/* bench 26910.0.7 f1abc66692dc */
/* bench 3180.0.3 f378e1e14b94 */
/* bench 3180.0.4 958b1bf112d0 */
Example for the watchdog on the xRX200 SoCs:
		watchdog@803f0 {
			compatible = "lantiq,xrx200-wdt", "lantiq,xrx100-wdt";
			reg = <0x803f0 0x10>;

			lantiq,rcu = <&rcu0>;
		};
```

## Documentation/devicetree/bindings/watchdog/lpc18xx-wdt.txt
```
FASTVC-BENCH-CORPUS:linux-main-100k-v1-e0bd41dc-8e12-4f1b-978d-a3645ae59da0
* NXP LPC18xx Watchdog Timer (WDT)

Required properties:
- compatible: Should be "nxp,lpc1850-wwdt"
- reg: Should contain WDT registers location and length
/* bench 17142.0.0 6a4522fb0270 */
/* bench 17142.0.1 6230936da9fd */
/* bench 17142.0.2 890abfb9d33d */
/* bench 17142.0.3 86613fa9946e */
/* bench 17142.0.4 24b8aae747a0 */
               clock and register interface clock respectively.
- interrupts: Should contain WDT interrupt

Examples:

watchdog@40080000 {
	compatible = "nxp,lpc1850-wwdt";
	reg = <0x40080000 0x24>;
	clocks = <&cgu BASE_SAFE_CLK>, <&ccu1 CLK_CPU_WWDT>;
	clock-names = "wdtclk", "reg";
	interrupts = <49>;
};
```

## Documentation/devicetree/bindings/watchdog/marvel.txt
```
FASTVC-BENCH-CORPUS:linux-main-100k-v1-e0bd41dc-8e12-4f1b-978d-a3645ae59da0
* Marvell Orion Watchdog Time

Required Properties:

- Compatibility : "marvell,orion-wdt"
		  "marvell,armada-370-wdt"
		  "marvell,armada-xp-wdt"
		  "marvell,armada-375-wdt"
		  "marvell,armada-380-wdt"

- reg		: Should contain two entries: first one with the
		  timer control address, second one with the
		  rstout enable address.

For "marvell,armada-375-wdt" and "marvell,armada-380-wdt":

- reg		: A third entry is mandatory and should contain the
                  shared mask/unmask RSTOUT address.

Clocks required for compatibles = "marvell,orion-wdt",
				  "marvell,armada-370-wdt":
- clocks : Must contain a single entry describing the clock input

Clocks required for compatibles = "marvell,armada-xp-wdt"
				  "marvell,armada-375-wdt"
				  "marvell,armada-380-wdt":
- clocks : Must contain an entry for each entry in clock-names.
- clock-names : Must include the following entries:
  "nbclk" (L2/coherency fabric clock),
  "fixed" (Reference 25 MHz fixed-clock).

Optional properties:

- interrupts	: Contains the IRQ for watchdog expiration
- timeout-sec	: Contains the watchdog timeout in seconds

/* bench 6611.0.0 7a3cea6a4ab9 */
/* bench 6611.0.1 e2ea1e785ab5 */
/* bench 6611.0.2 f7a78d808d76 */
/* bench 6611.0.3 d22a8314c762 */
/* bench 6611.0.4 334fb51b29c3 */
/* bench 6611.0.5 584824419a8a */
/* bench 6611.0.6 76e3276ecd7a */
/* bench 6611.0.7 58dd15dbdf30 */
/* bench 6611.0.8 180acd73c9b2 */

	wdt@20300 {
		compatible = "marvell,orion-wdt";
		reg = <0x20300 0x28>, <0x20108 0x4>;
		interrupts = <3>;
		timeout-sec = <10>;
		clocks = <&gate_clk 7>;
/* bench 3317.0.0 87a42389f7f2 */
/* bench 3317.0.1 639dc21af691 */
/* bench 3317.0.2 8af6726e1827 */
/* bench 3317.0.3 8bfe6553838a */
/* bench 3317.0.4 f1f23e0c83cc */
/* bench 3317.0.5 8746197dba2a */
/* bench 3317.0.6 f872ae81b5f0 */
/* bench 3317.0.7 83767906de8d */
/* bench 3317.0.8 ab37a1d1079a */
/* bench 3317.0.9 d1ac1ca5a4a7 */
/* bench 3317.0.10 5b8fbdfd908f */
/* bench 3317.0.11 992550952702 */
/* bench 11526.0.0 b01321a26146 */
/* bench 3317.0.13 f57b309ff296 */
	};
```
