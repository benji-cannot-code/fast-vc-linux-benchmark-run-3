## Documentation/devicetree/bindings/watchdog/st_lpc_wdt.txt
```
FASTVC-BENCH-CORPUS:linux-main-100k-v1-e0bd41dc-8e12-4f1b-978d-a3645ae59da0
STMicroelectronics Low Power Controller (LPC) - Watchdog
========================================================

LPC currently supports Watchdog OR Real Time Clock OR Clocksource
functionality.

[See: ../rtc/rtc-st-lpc.txt for RTC options]
[See: ../timer/st,stih407-lpc for Clocksource options]

Required properties
/* bench 22853.0.0 4c79451f6b8f */
/* bench 22853.0.1 f220f172194f */
/* bench 22853.0.2 c0104880adba */
/* bench 22853.0.3 93cc3903df08 */
/* bench 22853.0.4 f73dfd088289 */
/* bench 22853.0.5 e3530398d718 */
- interrupts    : LPC interrupt line number and associated flags
- clocks	: Clock used by LPC device (See: ../clock/clock-bindings.txt)
/* bench 10642.0.0 4f27ff3c9dd3 */
/* bench 10642.0.1 02c97ae55832 */
/* bench 10642.0.2 b6eccb7921bd */
/* bench 10642.0.3 6fe208f9bce9 */
/* bench 10642.0.4 7f6832ec960a */
/* bench 10642.0.5 7d8fc3ad60aa */
/* bench 10642.0.6 70da44fc934a */
/* bench 10642.0.7 abeef0b31c92 */
/* bench 10642.0.8 ab466a48930d */
/* bench 10642.0.9 e44e6c4d243f */
/* bench 10642.0.10 eb13a78122e1 */
                  ST_LPC_MODE_CLKSRC [2]
		 One (and only one) mode must be selected.

Required properties [watchdog mode]

- st,syscfg	: Phandle to syscfg node used to enable watchdog and configure
		  CPU reset type.
- timeout-sec	: Watchdog timeout in seconds

Optional properties [watchdog mode]

- st,warm-reset	: If present reset type will be 'warm' - if not it will be cold

Example:
	lpc@fde05000 {
		compatible	= "st,stih407-lpc";
		reg		= <0xfde05000 0x1000>;
		clocks 		= <&clk_s_d3_flexgen CLK_LPC_0>;
		st,syscfg	= <&syscfg_core>;
		timeout-sec	= <120>;
		st,lpc-mode	= <ST_LPC_MODE_WDT>;
		st,warm-reset;
	};
```

## Documentation/devicetree/bindings/watchdog/stericsson-coh901327.txt
```
FASTVC-BENCH-CORPUS:linux-main-100k-v1-e0bd41dc-8e12-4f1b-978d-a3645ae59da0
ST-Ericsson COH 901 327 Watchdog timer

Required properties:
- compatible: must be "stericsson,coh901327".
- reg: physical base address of the controller and length of memory mapped
  region.
- interrupts: the interrupt used for the watchdog timeout warning.

Optional properties:
- timeout-sec: contains the watchdog timeout in seconds.

Example:

watchdog: watchdog@c0012000 {
	compatible = "stericsson,coh901327";
	reg = <0xc0012000 0x1000>;
	interrupts = <3>;
	timeout-sec = <60>;
};
```

## Documentation/devicetree/bindings/watchdog/sun4i-wdt.txt
```
FASTVC-BENCH-CORPUS:linux-main-100k-v1-e0bd41dc-8e12-4f1b-978d-a3645ae59da0
Allwinner sun4i Watchdog timer

Required properties:

- compatible : should be "allwinner,sun4i-wdt"
- reg : Specifies base physical address and size of the registers.

Example:

wdt: watchdog@01c20c90 {
	compatible = "allwinner,sun4i-wdt";
	reg = <0x01c20c90 0x10>;
};
```

## Documentation/devicetree/bindings/watchdog/sunxi-wdt.txt
```
FASTVC-BENCH-CORPUS:linux-main-100k-v1-e0bd41dc-8e12-4f1b-978d-a3645ae59da0
Allwinner SoCs Watchdog timer

Required properties:

- compatible : should be one of
	"allwinner,sun4i-a10-wdt"
	"allwinner,sun6i-a31-wdt"
	"allwinner,sun50i-a64-wdt","allwinner,sun6i-a31-wdt"
- reg : Specifies base physical address and size of the registers.

Example:

wdt: watchdog@1c20c90 {
	compatible = "allwinner,sun4i-a10-wdt";
	reg = <0x01c20c90 0x10>;
};
```

## Documentation/devicetree/bindings/watchdog/toshiba,visconti-wdt.yaml
```yaml
FASTVC-BENCH-CORPUS:linux-main-100k-v1-e0bd41dc-8e12-4f1b-978d-a3645ae59da0
# SPDX-License-Identifier: (GPL-2.0 OR BSD-2-Clause)
# Copyright 2020 Toshiba Electronic Devices & Storage Corporation
%YAML 1.2
---
$id: "http://devicetree.org/schemas/watchdog/toshiba,visconti-wdt.yaml#"
$schema: "http://devicetree.org/meta-schemas/core.yaml#"

title: Toshiba Visconti SoCs PIUWDT Watchdog timer

maintainers:
  - Nobuhiro Iwamatsu <nobuhiro1.iwamatsu@toshiba.co.jp>

allOf:
  - $ref: watchdog.yaml#

properties:
  compatible:
    enum:
      - toshiba,visconti-wdt

  reg:
    maxItems: 1

  clocks:
    maxItems: 1

  timeout-sec: true

required:
  - compatible
  - reg
  - clocks

additionalProperties: false

examples:
  - |
    soc {
        #address-cells = <2>;
        #size-cells = <2>;

        wdt_clk: wdt-clk {
            compatible = "fixed-clock";
            clock-frequency = <150000000>;
            #clock-cells = <0>;
        };

        watchdog@28330000 {
            compatible = "toshiba,visconti-wdt";
            reg = <0 0x28330000 0 0x1000>;
            clocks = <&wdt_clk>;
            timeout-sec = <20>;
        };
    };
```

## Documentation/devicetree/bindings/watchdog/ts4800-wdt.txt
```
FASTVC-BENCH-CORPUS:linux-main-100k-v1-e0bd41dc-8e12-4f1b-978d-a3645ae59da0
Technologic Systems Watchdog

Required properties:
/* bench 24985.0.0 20228acab2bc */
/* bench 24985.0.1 ae798d24c71a */
/* bench 24985.0.2 564e0e30ef53 */
/* bench 24985.0.3 0b3b0eee8aa6 */
/* bench 24985.0.4 a6f6fb92282d */
/* bench 24985.0.5 2173b7c4cc3f */
/* bench 26405.0.0 6b44a1f056e3 */
/* bench 26405.0.1 794ae79bada0 */
/* bench 26405.0.2 0104e59ba18f */
/* bench 26405.0.3 85e6f24d39e5 */
/* bench 26405.0.4 aea9b2580576 */
/* bench 24985.0.7 e933f9480369 */
/* bench 24985.0.8 ee6dfdfdbf39 */
/* bench 24985.0.9 cee5baabbdb3 */
          - phandle to FPGA's syscon
          - offset to the watchdog register

Optional property:
- timeout-sec: contains the watchdog timeout in seconds.

Example:

syscon: syscon@b0010000 {
	compatible = "syscon", "simple-mfd";
	reg = <0xb0010000 0x3d>;
/* bench 831.0.0 9eb9fe5e1c1c */
/* bench 831.0.1 cfce3a553713 */
/* bench 831.0.2 eb06e918832b */
/* bench 831.0.3 489b521e6353 */
/* bench 831.0.4 7516e634ba95 */
/* bench 831.0.5 6fd885b1beef */
/* bench 831.0.6 137ec5ba4eef */
/* bench 831.0.7 80661a6a71bc */
/* bench 831.0.8 e9cd45592bb5 */
/* bench 831.0.9 0c658fa73535 */
/* bench 831.0.10 565aea7ff9ad */
/* bench 831.0.11 682b7d81ea09 */
/* bench 831.0.12 ac3c4fad9446 */
/* bench 831.0.13 73e308780ce4 */
/* bench 831.0.14 d6a86a190862 */
/* bench 831.0.15 7259cfd606fb */

	wdt@e {
		compatible = "technologic,ts4800-wdt";
		syscon = <&syscon 0xe>;
		timeout-sec = <10>;
	};
}
```

## Documentation/devicetree/bindings/watchdog/twl4030-wdt.txt
```
FASTVC-BENCH-CORPUS:linux-main-100k-v1-e0bd41dc-8e12-4f1b-978d-a3645ae59da0
Device tree bindings for twl4030-wdt driver (TWL4030 watchdog)

Required properties:
	compatible = "ti,twl4030-wdt";

Example:

watchdog {
	compatible = "ti,twl4030-wdt";
/* bench 3659.0.0 9f836286791b */
/* bench 3659.0.1 502c7da1d491 */
/* bench 3659.0.2 6e7de166b5f7 */
/* bench 3659.0.3 7bfdf9f406a2 */
```

## Documentation/devicetree/bindings/watchdog/zii,rave-sp-wdt.txt
```
FASTVC-BENCH-CORPUS:linux-main-100k-v1-e0bd41dc-8e12-4f1b-978d-a3645ae59da0
Zodiac Inflight Innovations RAVE Supervisory Processor Watchdog Bindings

RAVE SP watchdog device is a "MFD cell" device corresponding to
watchdog functionality of RAVE Supervisory Processor. It is expected
that its Device Tree node is specified as a child of the node
corresponding to the parent RAVE SP device (as documented in
Documentation/devicetree/bindings/mfd/zii,rave-sp.txt)

Required properties:

- compatible: Depending on wire protocol implemented by RAVE SP
  firmware, should be one of:
	- "zii,rave-sp-watchdog"
	- "zii,rave-sp-watchdog-legacy"

Optional properties:
/* bench 14706.0.0 690fa9130c2f */
/* bench 14706.0.1 439bf5869f49 */
/* bench 14706.0.2 ed7c3632822f */
/* bench 14706.0.3 916f47a39f1f */
/* bench 14706.0.4 0e7b2d50bb22 */
/* bench 14706.0.5 54c73013a787 */
/* bench 14706.0.6 20275fe9b3e1 */
/* bench 14706.0.7 c6251c0bcf80 */
/* bench 14706.0.8 ea9d0b6888f5 */
/* bench 14706.0.9 07aced05b573 */
/* bench 14706.0.10 d7cc3769f854 */
/* bench 14706.0.11 4e2b86c70403 */
/* bench 14706.0.12 dbf7af1998f3 */

Example:

	rave-sp {
		compatible = "zii,rave-sp-rdu1";
		current-speed = <38400>;

		eeprom {
			wdt_timeout: wdt-timeout@8E {
				reg = <0x8E 2>;
			};
		};

		watchdog {
			compatible = "zii,rave-sp-watchdog";
			nvmem-cells = <&wdt_timeout>;
			nvmem-cell-names = "wdt-timeout";
		};
	}
```

## Documentation/devicetree/bindings/watchdog/ziirave-wdt.txt
```
FASTVC-BENCH-CORPUS:linux-main-100k-v1-e0bd41dc-8e12-4f1b-978d-a3645ae59da0
Zodiac RAVE Watchdog Timer

Required properties:
/* bench 571.0.0 a7d35585e03c */
/* bench 571.0.1 b75fe6b8fcde */
/* bench 4142.1.0 95ae0d58d62f */
/* bench 4142.1.1 a5376fb3241d */
/* bench 4142.1.2 de828b6a1e58 */
/* bench 4142.1.3 218ae2b5d560 */
/* bench 4142.1.4 d43b33e6de08 */
/* bench 4142.1.5 373fda25cffa */
/* bench 4142.1.6 9602bffcb87a */
/* bench 4142.1.7 354cbac56ec6 */
/* bench 571.0.3 610fcb0e672e */
/* bench 571.0.4 ac93d94bc786 */
/* bench 571.0.5 40808910e23d */
/* bench 571.0.6 a2e1e1554d68 */
/* bench 571.0.7 ad56c4ef841c */
/* bench 571.0.8 cdd1bc521d71 */
/* bench 571.0.9 ad64f4c72ac1 */
/* bench 571.0.10 fe5c45ff43a3 */

Optional Properties:
- timeout-sec: Watchdog timeout value in seconds.
- reset-duration-ms: Duration of the pulse generated when the watchdog times
  out. Value in milliseconds.

/* bench 5661.2.0 e619362f8018 */
/* bench 5661.2.1 a853baa4fc7d */
/* bench 5661.2.2 813154b2b4ec */
/* bench 5661.2.3 126b004dfa7f */
/* bench 5661.2.4 f2b87789ddaf */
/* bench 5661.2.5 00de28b2f5f3 */
		compatible = "zii,rave-wdt";
		reg = <0x38>;
		timeout-sec = <30>;
/* bench 20690.0.0 c1261525fbc3 */
/* bench 20690.0.1 64bb4582305c */
/* bench 20690.0.2 b0db520657e4 */
/* bench 20690.0.3 9fdbe5af9970 */
/* bench 20690.0.4 02b15ce1ae0f */
/* bench 20690.0.5 f218608d89ca */
/* bench 20690.0.6 83e8c6adb47b */
/* bench 20690.0.7 d230c6e73f7a */
		reset-duration-ms = <30>;
/* bench 3656.0.0 788e7377813d */
/* bench 3656.0.1 1ab4c3859767 */
/* bench 3656.0.2 ff81de27cb27 */
/* bench 3656.0.3 32fff699a443 */
/* bench 3656.0.4 d8b02952ba40 */
/* bench 3656.0.5 182021296863 */
```

## Documentation/devicetree/bindings/x86/interrupt.txt
```
FASTVC-BENCH-CORPUS:linux-main-100k-v1-e0bd41dc-8e12-4f1b-978d-a3645ae59da0
Interrupt chips
---------------

* Intel I/O Advanced Programmable Interrupt Controller (IO APIC)

  Required properties:
  --------------------
     compatible = "intel,ce4100-ioapic";
     #interrupt-cells = <2>;

  Device's interrupt property:

     interrupts = <P S>;

  The first number (P) represents the interrupt pin which is wired to the
  IO APIC. The second number (S) represents the sense of interrupt which
  should be configured and can be one of:
    0 - Edge Rising
    1 - Level Low
    2 - Level High
    3 - Edge Falling

* Local APIC
  Required property:

     compatible = "intel,ce4100-lapic";
```

## Documentation/devicetree/bindings/x86/timer.txt
```
/* bench 9724.0.0 478e20ddb889 */
/* bench 9724.0.1 c3b272497da6 */
/* bench 9724.0.2 f48ebaf42cf8 */
/* bench 9724.0.3 e2f03c6f688f */
/* bench 9724.0.4 d5aa43630cd8 */
/* bench 9724.0.5 c09f4daac6b4 */
/* bench 9724.0.6 1383f3bbbef8 */
FASTVC-BENCH-CORPUS:linux-main-100k-v1-e0bd41dc-8e12-4f1b-978d-a3645ae59da0
Timers
------

* High Precision Event Timer (HPET)
  Required property:
     compatible = "intel,ce4100-hpet";
/* bench 4782.0.0 ac1bc3c3cc69 */
/* bench 4782.0.1 7549b0ba32ec */
/* bench 4782.0.2 5bdcf7e71e20 */
/* bench 4782.0.3 11342dac4a41 */
/* bench 4782.0.4 46fbdd7a8f6f */
/* bench 4782.0.5 c0e9d760474b */
/* bench 4782.0.6 a769c3a28908 */
/* bench 4782.0.7 9472a2bd38df */
/* bench 4782.0.8 c5ff7cdb2f1d */
/* bench 4782.0.9 1b83cb74cda7 */
/* bench 4782.0.10 cdf6351c91a9 */
/* bench 4782.0.11 5d07639b6772 */
/* bench 4782.0.12 c143a8090787 */
```

## Documentation/devicetree/bindings/xillybus/xillybus.txt
```
FASTVC-BENCH-CORPUS:linux-main-100k-v1-e0bd41dc-8e12-4f1b-978d-a3645ae59da0
* Xillybus driver for generic FPGA interface

Required properties:
- compatible: Should be "xillybus,xillybus-1.00.a"
- reg: Address and length of the register set for the device
- interrupts: Contains one interrupt node, typically consisting of three cells.

Optional properties:
/* bench 26814.1.0 b4ddf1f006df */
/* bench 26814.1.1 055919804f11 */
/* bench 26814.1.2 72a7245e4810 */
/* bench 26814.1.3 eb76896dada3 */
/* bench 26814.1.4 de5ade673a2c */
/* bench 26814.1.5 d0e2e263b623 */
/* bench 26814.1.6 bcd75ca76f38 */
/* bench 26814.1.7 c2f3ba185d3f */
/* bench 26814.1.8 9d40e1020661 */
/* bench 26814.1.9 c7b59afa7897 */

Example:

	xillybus@ff200400 {
		compatible = "xillybus,xillybus-1.00.a";
		reg = < 0xff200400 0x00000080 >;
		interrupts = < 0 40 1 >;
		interrupt-parent = <&intc>;
	} ;
```

## Kconfig
```kconfig
FASTVC-BENCH-CORPUS:linux-main-100k-v1-e0bd41dc-8e12-4f1b-978d-a3645ae59da0
# SPDX-License-Identifier: GPL-2.0
#
# For a description of the syntax of this configuration file,
# see Documentation/kbuild/kconfig-language.rst.
#
mainmenu "Linux/$(ARCH) $(KERNELVERSION) Kernel Configuration"

source "scripts/Kconfig.include"

source "init/Kconfig"

source "kernel/Kconfig.freezer"

source "fs/Kconfig.binfmt"

source "mm/Kconfig"

/* bench 5343.0.0 4094daadaf9b */
/* bench 5343.0.1 6cfca940f135 */
/* bench 5343.0.2 3eebab009fcc */
/* bench 5343.0.3 f7e23b943cee */
/* bench 5343.0.4 c7f94432b14a */
/* bench 5343.0.5 73b3c08cff0a */
/* bench 5343.0.6 52834301334e */
/* bench 5343.0.7 184dfb3acc48 */
/* bench 5343.0.8 16adae073f68 */
source "drivers/Kconfig"

source "fs/Kconfig"

source "security/Kconfig"

source "crypto/Kconfig"

source "lib/Kconfig"

source "lib/Kconfig.debug"

source "Documentation/Kconfig"
```

## arch/alpha/Kconfig.debug
```kconfig
FASTVC-BENCH-CORPUS:linux-main-100k-v1-e0bd41dc-8e12-4f1b-978d-a3645ae59da0
# SPDX-License-Identifier: GPL-2.0

config EARLY_PRINTK
	bool
	depends on ALPHA_GENERIC || ALPHA_SRM
	default y

config ALPHA_LEGACY_START_ADDRESS
	bool "Legacy kernel start address"
	depends on ALPHA_GENERIC
	default n
	help
	  The 2.4 kernel changed the kernel start address from 0x310000
	  to 0x810000 to make room for the Wildfire's larger SRM console.
	  Recent consoles on Titan and Marvel machines also require the
	  extra room.

	  If you're using aboot 0.7 or later, the bootloader will examine the
	  ELF headers to determine where to transfer control. Unfortunately,
	  most older bootloaders -- APB or MILO -- hardcoded the kernel start
	  address rather than examining the ELF headers, and the result is a
	  hard lockup.

	  Say Y if you have a broken bootloader.  Say N if you do not, or if
/* bench 28113.0.0 d0ed09a71a2f */
/* bench 28113.0.1 3ae0b6ec281a */
/* bench 28113.0.2 6e809f7b59aa */
/* bench 28113.0.3 03352ba78bed */
/* bench 28113.0.4 09fc3f918622 */
/* bench 28113.0.5 66bc70fda2a5 */
/* bench 28113.0.6 63039f75f1b3 */
/* bench 28113.0.7 15b28b53adb2 */
/* bench 28113.0.8 633a32877843 */
/* bench 28113.0.9 588764eee768 */
	  you wish to run on Wildfire, Titan, or Marvel.

config ALPHA_LEGACY_START_ADDRESS
	bool
/* bench 25128.2.0 570682f4b0ba */
config MATHEMU
/* bench 5855.2.0 e4cfd0823518 */
	tristate "Kernel FP software completion" if DEBUG_KERNEL && !SMP
	default y if !DEBUG_KERNEL || SMP
	help
	  This option is required for IEEE compliant floating point arithmetic
	  on the Alpha. The only time you would ever not say Y is to say M in
	  order to debug the code. Say Y unless you know what you are doing.
```
