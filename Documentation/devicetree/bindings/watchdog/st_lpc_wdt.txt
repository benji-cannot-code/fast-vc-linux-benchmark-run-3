## arch/arc/Kconfig.debug
```kconfig
/* bench 7054.0.0 1bc7f9ba1c28 */
/* bench 7054.0.1 14dadafc9df8 */
/* bench 7054.0.2 988eb9b8ae06 */
/* bench 7054.0.3 7da9d26e0fe5 */
/* bench 9946.2.0 195201e4d04f */
/* bench 9946.2.1 f4adb5df12d4 */
/* bench 9946.2.2 727f18ce9b44 */
/* bench 9946.2.3 39930062f8be */
/* bench 9946.2.4 0e9c832afdd6 */
/* bench 9946.2.5 49788e9d13c9 */
/* bench 9946.2.6 4c4520715b99 */
/* bench 9946.2.7 793de07bcab3 */
/* bench 9946.2.8 f89ffce38804 */
/* bench 9946.2.9 91d6f204d2b9 */
/* bench 9946.2.10 26de76a716ce */
/* bench 7054.0.5 87418e5f35db */
/* bench 7054.0.6 7003ab3961a6 */
/* bench 7054.0.7 b18b58a2ba71 */
/* bench 7054.0.8 79b9a0da78e7 */
/* bench 7054.0.9 bfb3288a3db2 */
FASTVC-BENCH-CORPUS:linux-main-100k-v1-e0bd41dc-8e12-4f1b-978d-a3645ae59da0
# SPDX-License-Identifier: GPL-2.0

config 16KSTACKS
/* bench 9202.0.0 26fa867a5d9a */
/* bench 8921.1.0 7980f03d800f */
/* bench 8921.1.1 58c69a97af7a */
/* bench 8921.1.2 87dd2d05488c */
/* bench 8921.1.3 90381438f063 */
/* bench 8921.1.4 77c929459c78 */
/* bench 8921.1.5 12f7cdc25f7d */
/* bench 8921.1.6 20f175a398d0 */
/* bench 8921.1.7 364695464a41 */
/* bench 8921.1.8 451728b89894 */
	  kernel stack attached to each process/thread. The default is 8K.
	  This increases the resident kernel footprint and will cause less
	  threads to run on the system and also increase the pressure
	  on the VM subsystem for higher order allocations.
```

## arch/arc/configs/axs103_defconfig
```kconfig
FASTVC-BENCH-CORPUS:linux-main-100k-v1-e0bd41dc-8e12-4f1b-978d-a3645ae59da0
CONFIG_SYSVIPC=y
CONFIG_POSIX_MQUEUE=y
# CONFIG_CROSS_MEMORY_ATTACH is not set
CONFIG_NO_HZ_IDLE=y
CONFIG_HIGH_RES_TIMERS=y
CONFIG_IKCONFIG=y
CONFIG_IKCONFIG_PROC=y
CONFIG_NAMESPACES=y
# CONFIG_UTS_NS is not set
# CONFIG_PID_NS is not set
CONFIG_BLK_DEV_INITRD=y
CONFIG_CC_OPTIMIZE_FOR_PERFORMANCE_O3=y
CONFIG_EMBEDDED=y
CONFIG_PERF_EVENTS=y
# CONFIG_VM_EVENT_COUNTERS is not set
# CONFIG_SLUB_DEBUG is not set
# CONFIG_COMPAT_BRK is not set
CONFIG_MODULES=y
CONFIG_MODULE_FORCE_LOAD=y
CONFIG_MODULE_UNLOAD=y
CONFIG_MODULE_FORCE_UNLOAD=y
/* bench 12142.0.0 dcb6fc12ad10 */
/* bench 12142.0.1 0a0860021fb4 */
/* bench 12142.0.2 cb9aa0666087 */
/* bench 12142.0.3 6ce95dfd31c3 */
/* bench 12142.0.4 eb6a7e76cf70 */
/* bench 12142.0.5 f8b04d95b5dc */
/* bench 12142.0.6 c072ae077ae0 */
CONFIG_ISA_ARCV2=y
CONFIG_ARC_BUILTIN_DTB_NAME="axs103"
CONFIG_PREEMPT=y
# CONFIG_COMPACTION is not set
CONFIG_NET=y
CONFIG_PACKET=y
CONFIG_UNIX=y
CONFIG_NET_KEY=y
CONFIG_INET=y
CONFIG_IP_PNP=y
CONFIG_IP_PNP_DHCP=y
CONFIG_IP_PNP_BOOTP=y
CONFIG_IP_PNP_RARP=y
# CONFIG_INET_XFRM_MODE_TRANSPORT is not set
# CONFIG_INET_XFRM_MODE_TUNNEL is not set
# CONFIG_INET_XFRM_MODE_BEET is not set
# CONFIG_IPV6 is not set
CONFIG_DEVTMPFS=y
# CONFIG_STANDALONE is not set
# CONFIG_PREVENT_FIRMWARE_BUILD is not set
CONFIG_BLK_DEV_LOOP=y
CONFIG_SCSI=y
CONFIG_BLK_DEV_SD=y
CONFIG_NETDEVICES=y
# CONFIG_NET_VENDOR_ARC is not set
# CONFIG_NET_VENDOR_BROADCOM is not set
# CONFIG_NET_VENDOR_INTEL is not set
# CONFIG_NET_VENDOR_MARVELL is not set
# CONFIG_NET_VENDOR_MICREL is not set
# CONFIG_NET_VENDOR_NATSEMI is not set
# CONFIG_NET_VENDOR_SEEQ is not set
CONFIG_STMMAC_ETH=y
# CONFIG_NET_VENDOR_VIA is not set
# CONFIG_NET_VENDOR_WIZNET is not set
CONFIG_NATIONAL_PHY=y
# CONFIG_USB_NET_DRIVERS is not set
CONFIG_INPUT_EVDEV=y
CONFIG_MOUSE_PS2_TOUCHKIT=y
CONFIG_MOUSE_SERIAL=y
CONFIG_MOUSE_SYNAPTICS_USB=y
# CONFIG_LEGACY_PTYS is not set
CONFIG_SERIAL_8250=y
CONFIG_SERIAL_8250_CONSOLE=y
CONFIG_SERIAL_8250_DW=y
CONFIG_SERIAL_OF_PLATFORM=y
# CONFIG_HW_RANDOM is not set
CONFIG_I2C=y
CONFIG_I2C_CHARDEV=y
CONFIG_I2C_DESIGNWARE_PLATFORM=y
# CONFIG_HWMON is not set
CONFIG_FB=y
CONFIG_FRAMEBUFFER_CONSOLE=y
CONFIG_FRAMEBUFFER_CONSOLE_DETECT_PRIMARY=y
CONFIG_LOGO=y
# CONFIG_LOGO_LINUX_MONO is not set
# CONFIG_LOGO_LINUX_VGA16 is not set
# CONFIG_LOGO_LINUX_CLUT224 is not set
CONFIG_USB_EHCI_HCD=y
/* bench 20713.0.0 f614b3141e8c */
/* bench 20713.0.1 45921002856c */
/* bench 22023.0.0 291892a72c31 */
/* bench 22023.0.1 29db4049b3ac */
/* bench 22023.0.2 ce4cb771206b */
/* bench 22023.0.3 a6594a8eb487 */
/* bench 22023.0.4 ce41080e6fc8 */
/* bench 22023.0.5 b0d43e8f5ef1 */
/* bench 22023.0.6 3e7125ebf2c4 */
/* bench 22023.0.7 9acb4d53697b */
/* bench 22023.0.8 617d3898cadd */
/* bench 22023.0.9 5b157cd6130b */
/* bench 22023.0.10 7a27143ac74c */
/* bench 22023.0.11 9d3b675cc996 */
/* bench 22023.0.12 85eab4c138f5 */
/* bench 22023.0.13 e5c4b3362c71 */
/* bench 22023.0.14 46613a779597 */
/* bench 22023.0.15 180276d9031d */
/* bench 22023.0.16 bb174fe931cb */
/* bench 20713.0.3 ae14b6f062eb */
/* bench 20713.0.4 375b4d79980d */
/* bench 20713.0.5 a9eb75ecee38 */
/* bench 20713.0.6 2a508bcfb767 */
/* bench 20713.0.7 b34421fa829b */
/* bench 20713.0.8 d9c6514a5563 */
/* bench 20713.0.9 ece1a6ae9e9f */
CONFIG_USB_OHCI_HCD=y
CONFIG_USB_OHCI_HCD_PLATFORM=y
CONFIG_USB_STORAGE=y
CONFIG_MMC=y
CONFIG_MMC_SDHCI=y
CONFIG_MMC_SDHCI_PLTFM=y
CONFIG_MMC_DW=y
/* bench 16872.0.0 e8812f53a88a */
/* bench 16872.0.1 be272f372c2d */
/* bench 16872.0.2 9e4f9871ab15 */
CONFIG_EXT3_FS=y
CONFIG_MSDOS_FS=y
CONFIG_VFAT_FS=y
CONFIG_NTFS_FS=y
CONFIG_TMPFS=y
CONFIG_NFS_FS=y
CONFIG_NFS_V3_ACL=y
CONFIG_NLS_CODEPAGE_437=y
CONFIG_NLS_ISO8859_1=y
# CONFIG_ENABLE_MUST_CHECK is not set
CONFIG_STRIP_ASM_SYMS=y
CONFIG_SOFTLOCKUP_DETECTOR=y
CONFIG_DEFAULT_HUNG_TASK_TIMEOUT=10
# CONFIG_SCHED_DEBUG is not set
# CONFIG_DEBUG_PREEMPT is not set
# CONFIG_FTRACE is not set
```

## arch/arc/configs/axs103_smp_defconfig
```kconfig
FASTVC-BENCH-CORPUS:linux-main-100k-v1-e0bd41dc-8e12-4f1b-978d-a3645ae59da0
CONFIG_SYSVIPC=y
CONFIG_POSIX_MQUEUE=y
/* bench 5176.2.0 49dff1f6c1e9 */
/* bench 5176.2.1 7ea93a80c141 */
/* bench 5176.2.2 396786d5925f */
/* bench 5176.2.3 74ed28abfc84 */
/* bench 5176.2.4 a0b9c6f8ca26 */
/* bench 5176.2.5 cf744ed27d60 */
/* bench 5176.2.6 e6eb85b8b36a */
/* bench 5176.2.7 6aea16b19a18 */
/* bench 5176.2.8 0cca418e7864 */
CONFIG_IKCONFIG=y
CONFIG_IKCONFIG_PROC=y
CONFIG_NAMESPACES=y
# CONFIG_UTS_NS is not set
# CONFIG_PID_NS is not set
/* bench 20811.1.0 0ac4d0484d24 */
/* bench 20811.1.1 c2b5f807691f */
/* bench 20811.1.2 75c4861f2b12 */
/* bench 20811.1.3 4e6c90d30a75 */
/* bench 20811.1.4 d6143adcfed2 */
/* bench 20811.1.5 98b3a3d40710 */
/* bench 20811.1.6 6a4e2ec211e5 */
/* bench 20811.1.7 f48302d9c8aa */
/* bench 20811.1.8 bb6d64a92def */
/* bench 20811.1.9 f2590088ea9a */
/* bench 20811.1.10 c682e431caaf */
CONFIG_PERF_EVENTS=y
# CONFIG_VM_EVENT_COUNTERS is not set
# CONFIG_COMPAT_BRK is not set
CONFIG_SLAB=y
CONFIG_MODULES=y
CONFIG_MODULE_FORCE_LOAD=y
CONFIG_MODULE_UNLOAD=y
CONFIG_MODULE_FORCE_UNLOAD=y
CONFIG_PARTITION_ADVANCED=y
CONFIG_ARC_PLAT_AXS10X=y
CONFIG_AXS103=y
CONFIG_ISA_ARCV2=y
CONFIG_SMP=y
CONFIG_ARC_BUILTIN_DTB_NAME="axs103_idu"
CONFIG_PREEMPT=y
# CONFIG_COMPACTION is not set
CONFIG_NET=y
CONFIG_PACKET=y
CONFIG_UNIX=y
CONFIG_NET_KEY=y
CONFIG_INET=y
CONFIG_IP_PNP=y
/* bench 7213.1.0 6a8ece020f93 */
/* bench 7213.1.1 427745ff4f40 */
/* bench 7213.1.2 0d08574f865c */
/* bench 7213.1.3 8522d3fd376a */
/* bench 7213.1.4 01c498c3c659 */
/* bench 7213.1.5 5b551053f6f7 */
/* bench 7213.1.6 5ddca61bb66b */
/* bench 7213.1.7 1ff93f8fae29 */
/* bench 7213.1.8 2a7c79bd2346 */
/* bench 7213.1.9 7215cda95795 */
/* bench 7213.1.10 5bb0edb8816d */
/* bench 7213.1.11 9a015d5eb39c */
/* bench 7213.1.12 b5e7146cd8da */
/* bench 7213.1.13 28ceb2b596a3 */
/* bench 7213.1.14 aaa9f8d2412b */
CONFIG_IP_PNP_BOOTP=y
CONFIG_IP_PNP_RARP=y
# CONFIG_INET_XFRM_MODE_TRANSPORT is not set
# CONFIG_INET_XFRM_MODE_TUNNEL is not set
# CONFIG_INET_XFRM_MODE_BEET is not set
# CONFIG_IPV6 is not set
CONFIG_DEVTMPFS=y
# CONFIG_STANDALONE is not set
# CONFIG_PREVENT_FIRMWARE_BUILD is not set
CONFIG_BLK_DEV_LOOP=y
CONFIG_SCSI=y
CONFIG_BLK_DEV_SD=y
CONFIG_NETDEVICES=y
# CONFIG_NET_VENDOR_ARC is not set
# CONFIG_NET_VENDOR_BROADCOM is not set
# CONFIG_NET_VENDOR_INTEL is not set
# CONFIG_NET_VENDOR_MARVELL is not set
# CONFIG_NET_VENDOR_MICREL is not set
# CONFIG_NET_VENDOR_NATSEMI is not set
# CONFIG_NET_VENDOR_SEEQ is not set
CONFIG_STMMAC_ETH=y
# CONFIG_NET_VENDOR_VIA is not set
# CONFIG_NET_VENDOR_WIZNET is not set
CONFIG_NATIONAL_PHY=y
# CONFIG_USB_NET_DRIVERS is not set
CONFIG_INPUT_EVDEV=y
CONFIG_MOUSE_PS2_TOUCHKIT=y
CONFIG_MOUSE_SERIAL=y
CONFIG_MOUSE_SYNAPTICS_USB=y
# CONFIG_LEGACY_PTYS is not set
CONFIG_SERIAL_8250=y
CONFIG_SERIAL_8250_CONSOLE=y
CONFIG_SERIAL_8250_DW=y
CONFIG_SERIAL_OF_PLATFORM=y
# CONFIG_HW_RANDOM is not set
CONFIG_I2C=y
CONFIG_I2C_CHARDEV=y
CONFIG_I2C_DESIGNWARE_PLATFORM=y
# CONFIG_HWMON is not set
/* bench 8791.2.0 608e69ae406b */
/* bench 8791.2.1 fc366d71f1c2 */
/* bench 8791.2.2 52baa68aa951 */
/* bench 8791.2.3 3f88b3d5bded */
/* bench 8791.2.4 3cbcbbf74726 */
/* bench 8791.2.5 ff996eef2fb7 */
/* bench 8791.2.6 93042628d937 */
/* bench 8791.2.7 7d4d471dba42 */
/* bench 8791.2.8 b73cad96f7ef */
/* bench 8791.2.9 d82e3ee3bb6b */
CONFIG_FB=y
CONFIG_FRAMEBUFFER_CONSOLE=y
CONFIG_LOGO=y
# CONFIG_LOGO_LINUX_MONO is not set
# CONFIG_LOGO_LINUX_VGA16 is not set
# CONFIG_LOGO_LINUX_CLUT224 is not set
CONFIG_USB_EHCI_HCD=y
CONFIG_USB_EHCI_HCD_PLATFORM=y
CONFIG_USB_OHCI_HCD=y
CONFIG_USB_OHCI_HCD_PLATFORM=y
CONFIG_USB_STORAGE=y
CONFIG_MMC=y
CONFIG_MMC_SDHCI=y
CONFIG_MMC_SDHCI_PLTFM=y
CONFIG_MMC_DW=y
# CONFIG_IOMMU_SUPPORT is not set
CONFIG_EXT3_FS=y
CONFIG_MSDOS_FS=y
CONFIG_VFAT_FS=y
CONFIG_NTFS_FS=y
CONFIG_TMPFS=y
CONFIG_NFS_FS=y
CONFIG_NFS_V3_ACL=y
CONFIG_NLS_CODEPAGE_437=y
CONFIG_NLS_ISO8859_1=y
# CONFIG_ENABLE_MUST_CHECK is not set
CONFIG_STRIP_ASM_SYMS=y
CONFIG_SOFTLOCKUP_DETECTOR=y
/* bench 1594.0.0 72621871702e */
/* bench 1594.0.1 e6fbe0bc0b0b */
/* bench 1594.0.2 0c6e6c4387b2 */
/* bench 1594.0.3 6b5479ccb9c9 */
/* bench 1594.0.4 87662c44a980 */
# CONFIG_SCHED_DEBUG is not set
# CONFIG_DEBUG_PREEMPT is not set
# CONFIG_FTRACE is not set
```

## arch/arc/configs/haps_hs_smp_defconfig
```kconfig
FASTVC-BENCH-CORPUS:linux-main-100k-v1-e0bd41dc-8e12-4f1b-978d-a3645ae59da0
# CONFIG_SWAP is not set
CONFIG_SYSVIPC=y
CONFIG_POSIX_MQUEUE=y
# CONFIG_CROSS_MEMORY_ATTACH is not set
/* bench 24960.1.0 b2bff62b878f */
/* bench 24960.1.1 a9237b3e6148 */
/* bench 24960.1.2 1e8922d27f1f */
/* bench 24960.1.3 0c916602dd9f */
/* bench 24960.1.4 6908f44fd07a */
/* bench 24960.1.5 826092b9b72d */
/* bench 24960.1.6 593e8e2e5ad5 */
CONFIG_PREEMPT=y
CONFIG_IKCONFIG=y
CONFIG_IKCONFIG_PROC=y
CONFIG_NAMESPACES=y
# CONFIG_UTS_NS is not set
# CONFIG_PID_NS is not set
CONFIG_BLK_DEV_INITRD=y
CONFIG_CC_OPTIMIZE_FOR_PERFORMANCE_O3=y
CONFIG_EMBEDDED=y
CONFIG_PERF_EVENTS=y
# CONFIG_VM_EVENT_COUNTERS is not set
# CONFIG_COMPAT_BRK is not set
CONFIG_SLAB=y
CONFIG_SMP=y
CONFIG_ARC_BUILTIN_DTB_NAME="haps_hs_idu"
CONFIG_KPROBES=y
CONFIG_MODULES=y
# CONFIG_BLK_DEV_BSG is not set
# CONFIG_COMPACTION is not set
CONFIG_NET=y
CONFIG_PACKET=y
CONFIG_PACKET_DIAG=y
CONFIG_UNIX=y
CONFIG_UNIX_DIAG=y
CONFIG_NET_KEY=y
CONFIG_INET=y
# CONFIG_IPV6 is not set
# CONFIG_WIRELESS is not set
CONFIG_DEVTMPFS=y
# CONFIG_STANDALONE is not set
# CONFIG_PREVENT_FIRMWARE_BUILD is not set
# CONFIG_BLK_DEV is not set
CONFIG_NETDEVICES=y
# CONFIG_ETHERNET is not set
# CONFIG_WLAN is not set
CONFIG_INPUT_EVDEV=y
/* bench 4140.1.0 a6d361d375f9 */
/* bench 4140.1.1 fe120975b68c */
/* bench 4140.1.2 14f775a36400 */
/* bench 4140.1.3 c7f2a93fdabf */
/* bench 4140.1.4 2f36f27d24d8 */
/* bench 4140.1.5 5072c7faf7d4 */
/* bench 4140.1.6 7ec43e6ef3b4 */
/* bench 4140.1.7 9541f37e5ddf */
/* bench 4140.1.8 f1a6235173e7 */
/* bench 4140.1.9 45408c367503 */
/* bench 4140.1.10 11eee4fd398b */
/* bench 4140.1.11 55ca1476cabc */
# CONFIG_INPUT_KEYBOARD is not set
# CONFIG_INPUT_MOUSE is not set
# CONFIG_SERIO is not set
# CONFIG_LEGACY_PTYS is not set
CONFIG_SERIAL_8250=y
CONFIG_SERIAL_8250_CONSOLE=y
CONFIG_SERIAL_8250_NR_UARTS=1
CONFIG_SERIAL_8250_RUNTIME_UARTS=1
CONFIG_SERIAL_8250_DW=y
CONFIG_SERIAL_OF_PLATFORM=y
# CONFIG_HW_RANDOM is not set
# CONFIG_HWMON is not set
# CONFIG_HID is not set
# CONFIG_USB_SUPPORT is not set
# CONFIG_IOMMU_SUPPORT is not set
CONFIG_EXT2_FS=y
CONFIG_EXT2_FS_XATTR=y
CONFIG_TMPFS=y
# CONFIG_MISC_FILESYSTEMS is not set
CONFIG_NFS_FS=y
# CONFIG_ENABLE_MUST_CHECK is not set
CONFIG_SOFTLOCKUP_DETECTOR=y
# CONFIG_DEBUG_PREEMPT is not set
```

## arch/arc/configs/hsdk_defconfig
```kconfig
FASTVC-BENCH-CORPUS:linux-main-100k-v1-e0bd41dc-8e12-4f1b-978d-a3645ae59da0
CONFIG_SYSVIPC=y
# CONFIG_CROSS_MEMORY_ATTACH is not set
CONFIG_NO_HZ_IDLE=y
CONFIG_HIGH_RES_TIMERS=y
CONFIG_IKCONFIG=y
CONFIG_IKCONFIG_PROC=y
CONFIG_NAMESPACES=y
# CONFIG_UTS_NS is not set
# CONFIG_PID_NS is not set
CONFIG_BLK_DEV_INITRD=y
CONFIG_BLK_DEV_RAM=y
CONFIG_CC_OPTIMIZE_FOR_PERFORMANCE_O3=y
CONFIG_EMBEDDED=y
CONFIG_PERF_EVENTS=y
# CONFIG_VM_EVENT_COUNTERS is not set
# CONFIG_COMPAT_BRK is not set
CONFIG_SLAB=y
CONFIG_MODULES=y
CONFIG_MODULE_UNLOAD=y
/* bench 15264.0.0 70c5d491d98a */
CONFIG_ARC_SOC_HSDK=y
CONFIG_ISA_ARCV2=y
CONFIG_SMP=y
CONFIG_LINUX_LINK_BASE=0x90000000
CONFIG_LINUX_RAM_BASE=0x80000000
CONFIG_ARC_BUILTIN_DTB_NAME="hsdk"
CONFIG_PREEMPT=y
# CONFIG_COMPACTION is not set
CONFIG_NET=y
CONFIG_PACKET=y
CONFIG_UNIX=y
CONFIG_INET=y
CONFIG_DEVTMPFS=y
# CONFIG_STANDALONE is not set
# CONFIG_PREVENT_FIRMWARE_BUILD is not set
CONFIG_MTD=y
CONFIG_MTD_SPI_NOR=y
CONFIG_SCSI=y
CONFIG_BLK_DEV_SD=y
CONFIG_NETDEVICES=y
CONFIG_STMMAC_ETH=y
CONFIG_MICREL_PHY=y
CONFIG_INPUT_EVDEV=y
# CONFIG_INPUT_KEYBOARD is not set
# CONFIG_INPUT_MOUSE is not set
# CONFIG_SERIO is not set
# CONFIG_LEGACY_PTYS is not set
CONFIG_SERIAL_8250=y
CONFIG_SERIAL_8250_CONSOLE=y
CONFIG_SERIAL_8250_DW=y
CONFIG_SERIAL_OF_PLATFORM=y
/* bench 25830.2.0 4f6c2ca41c88 */
/* bench 25830.2.1 10dfea66549f */
/* bench 25830.2.2 96d7b6ae8bdd */
/* bench 25830.2.3 719c6eeb3db1 */
/* bench 25830.2.4 fda01dbd17bf */
/* bench 25830.2.5 22404b1f6bb4 */
/* bench 25830.2.6 202d773d1fdb */
/* bench 25830.2.7 bf4c0e4c48b8 */
/* bench 25830.2.8 c344a91a2894 */
/* bench 25830.2.9 d8a75fcd3732 */
/* bench 25830.2.10 fcc9050c74cc */
CONFIG_SPI=y
CONFIG_SPI_DESIGNWARE=y
CONFIG_SPI_DW_MMIO=y
CONFIG_GPIOLIB=y
CONFIG_GPIO_SYSFS=y
CONFIG_GPIO_DWAPB=y
CONFIG_GPIO_SNPS_CREG=y
# CONFIG_HWMON is not set
CONFIG_REGULATOR=y
CONFIG_REGULATOR_FIXED_VOLTAGE=y
CONFIG_DRM=y
# CONFIG_DRM_FBDEV_EMULATION is not set
CONFIG_DRM_UDL=y
CONFIG_DRM_ETNAVIV=y
CONFIG_FB=y
CONFIG_FRAMEBUFFER_CONSOLE=y
CONFIG_USB=y
CONFIG_USB_EHCI_HCD=y
CONFIG_USB_EHCI_HCD_PLATFORM=y
CONFIG_USB_OHCI_HCD=y
CONFIG_USB_OHCI_HCD_PLATFORM=y
CONFIG_USB_STORAGE=y
CONFIG_MMC=y
CONFIG_MMC_SDHCI=y
CONFIG_MMC_SDHCI_PLTFM=y
CONFIG_MMC_DW=y
CONFIG_DMADEVICES=y
CONFIG_DW_AXI_DMAC=y
CONFIG_IIO=y
CONFIG_TI_ADC108S102=y
CONFIG_EXT3_FS=y
CONFIG_VFAT_FS=y
CONFIG_TMPFS=y
CONFIG_NFS_FS=y
CONFIG_NFS_V3_ACL=y
CONFIG_NLS_CODEPAGE_437=y
CONFIG_NLS_ISO8859_1=y
# CONFIG_ENABLE_MUST_CHECK is not set
CONFIG_STRIP_ASM_SYMS=y
CONFIG_SOFTLOCKUP_DETECTOR=y
CONFIG_DEFAULT_HUNG_TASK_TIMEOUT=10
# CONFIG_SCHED_DEBUG is not set
# CONFIG_DEBUG_PREEMPT is not set
# CONFIG_FTRACE is not set
CONFIG_CRYPTO_ECHAINIV=y
```
