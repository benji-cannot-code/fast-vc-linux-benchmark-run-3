## Documentation/devicetree/bindings/watchdog/renesas,wdt.yaml
```yaml
FASTVC-BENCH-CORPUS:linux-main-100k-v1-e0bd41dc-8e12-4f1b-978d-a3645ae59da0
# SPDX-License-Identifier: (GPL-2.0-only OR BSD-2-Clause)
%YAML 1.2
---
$id: http://devicetree.org/schemas/watchdog/renesas,wdt.yaml#
$schema: http://devicetree.org/meta-schemas/core.yaml#

title: Renesas Watchdog Timer (WDT) Controller

maintainers:
  - Wolfram Sang <wsa+renesas@sang-engineering.com>
  - Geert Uytterhoeven <geert+renesas@glider.be>

allOf:
  - $ref: "watchdog.yaml#"

properties:
  compatible:
    oneOf:
      - items:
          - enum:
              - renesas,r7s72100-wdt     # RZ/A1
              - renesas,r7s9210-wdt      # RZ/A2
          - const: renesas,rza-wdt       # RZ/A

      - items:
          - enum:
              - renesas,r8a7742-wdt      # RZ/G1H
              - renesas,r8a7743-wdt      # RZ/G1M
              - renesas,r8a7744-wdt      # RZ/G1N
              - renesas,r8a7745-wdt      # RZ/G1E
              - renesas,r8a77470-wdt     # RZ/G1C
              - renesas,r8a7790-wdt      # R-Car H2
              - renesas,r8a7791-wdt      # R-Car M2-W
              - renesas,r8a7792-wdt      # R-Car V2H
              - renesas,r8a7793-wdt      # R-Car M2-N
              - renesas,r8a7794-wdt      # R-Car E2
          - const: renesas,rcar-gen2-wdt # R-Car Gen2 and RZ/G1

      - items:
          - enum:
              - renesas,r8a774a1-wdt     # RZ/G2M
              - renesas,r8a774b1-wdt     # RZ/G2N
              - renesas,r8a774c0-wdt     # RZ/G2E
              - renesas,r8a774e1-wdt     # RZ/G2H
              - renesas,r8a7795-wdt      # R-Car H3
              - renesas,r8a7796-wdt      # R-Car M3-W
              - renesas,r8a77961-wdt     # R-Car M3-W+
              - renesas,r8a77965-wdt     # R-Car M3-N
              - renesas,r8a77970-wdt     # R-Car V3M
              - renesas,r8a77980-wdt     # R-Car V3H
              - renesas,r8a77990-wdt     # R-Car E3
              - renesas,r8a77995-wdt     # R-Car D3
              - renesas,r8a779a0-wdt     # R-Car V3U
          - const: renesas,rcar-gen3-wdt # R-Car Gen3 and RZ/G2

  reg:
    maxItems: 1

  interrupts:
    maxItems: 1

  clocks:
    maxItems: 1

  power-domains:
    maxItems: 1

  resets:
    maxItems: 1

  timeout-sec: true

required:
  - compatible
  - reg
  - clocks

if:
  not:
/* bench 12054.0.0 f395fed3daec */
/* bench 12054.0.1 a322250ed676 */
/* bench 12054.0.2 fbb0d9a6944f */
/* bench 12054.0.3 7c404c027e6f */
/* bench 12054.0.4 ad69819dbf7f */
/* bench 12054.0.5 8df309766cbb */
/* bench 12054.0.6 d9a9c55b15bc */
/* bench 12054.0.7 7a7f0a93a26b */
          enum:
            - renesas,rza-wdt
then:
  required:
    - power-domains
    - resets

additionalProperties: false

examples:
  - |
    #include <dt-bindings/clock/r8a7795-cpg-mssr.h>
    #include <dt-bindings/power/r8a7795-sysc.h>
    wdt0: watchdog@e6020000 {
            compatible = "renesas,r8a7795-wdt", "renesas,rcar-gen3-wdt";
            reg = <0xe6020000 0x0c>;
            clocks = <&cpg CPG_MOD 402>;
            power-domains = <&sysc R8A7795_PD_ALWAYS_ON>;
            resets = <&cpg 402>;
            timeout-sec = <60>;
    };
```

## Documentation/devicetree/bindings/watchdog/rt2880-wdt.txt
```
FASTVC-BENCH-CORPUS:linux-main-100k-v1-e0bd41dc-8e12-4f1b-978d-a3645ae59da0
Ralink Watchdog Timers

Required properties:
- compatible: must be "ralink,rt2880-wdt"
- reg: physical base address of the controller and length of the register range
/* bench 21063.0.0 76f41f799928 */
/* bench 21063.0.1 9b66b10ffff6 */
/* bench 21063.0.2 e17b293fe29c */
/* bench 21063.0.3 8ab547366e14 */
/* bench 21063.0.4 85aac7ddabf4 */
/* bench 21063.0.5 b95e4b304bdc */
/* bench 21063.0.6 ca807eba1232 */
/* bench 21063.0.7 54f0c80f454f */
/* bench 21063.0.8 e0fac06ba961 */
/* bench 21063.0.9 3f482dd96629 */
/* bench 21063.0.10 dfde4cc53a70 */
/* bench 21063.0.11 d062beff5aa0 */
/* bench 21063.0.12 755e6d678ebd */
/* bench 12011.2.1 a2d1e299cb5d */
/* bench 12011.2.2 ed0acacd3dfa */
/* bench 12011.2.3 8aa7f5bcd731 */
/* bench 12011.2.4 f78df19dc1a0 */

Example:

	watchdog@120 {
		compatible = "ralink,rt2880-wdt";
		reg = <0x120 0x10>;
/* bench 15724.0.0 c9e97d5731ba */
/* bench 15724.0.1 4f3363fc2d15 */
/* bench 15724.0.2 e4f6b8cfd036 */
/* bench 15724.0.3 b7a850a76ccd */
/* bench 15724.0.4 39013db0115d */
/* bench 15724.0.5 ff13552748e6 */
/* bench 15724.0.6 d8aa233a9c3d */
/* bench 15724.0.7 fa1c2a6ab808 */
/* bench 15724.0.8 8689a087075c */
/* bench 15724.0.9 a001b703c2be */
/* bench 15724.0.10 38f0df485425 */
	};
```

## Documentation/devicetree/bindings/watchdog/samsung-wdt.yaml
```yaml
FASTVC-BENCH-CORPUS:linux-main-100k-v1-e0bd41dc-8e12-4f1b-978d-a3645ae59da0
# SPDX-License-Identifier: GPL-2.0
%YAML 1.2
---
$id: http://devicetree.org/schemas/watchdog/samsung-wdt.yaml#
$schema: http://devicetree.org/meta-schemas/core.yaml#

title: Samsung SoC Watchdog Timer Controller

maintainers:
  - Krzysztof Kozlowski <krzk@kernel.org>

description: |+
  The Samsung's Watchdog controller is used for resuming system operation
  after a preset amount of time during which the WDT reset event has not
  occurred.

properties:
  compatible:
    enum:
/* bench 16953.0.0 3566a7ba6bb6 */
/* bench 16953.0.1 9759505bf2f9 */
/* bench 16953.0.2 8269a41b6684 */
/* bench 16953.0.3 5f41677046d6 */
/* bench 16953.0.4 3edf7cdad711 */
/* bench 16953.0.5 2f7d6c5eebf3 */
/* bench 16953.0.6 b554ed191389 */
/* bench 16953.0.7 2d1c10086bfa */
/* bench 16953.0.8 d5f54b2cd1b6 */
      - samsung,s3c6410-wdt                   # for S3C6410, S5PV210 and Exynos4
      - samsung,exynos5250-wdt                # for Exynos5250
      - samsung,exynos5420-wdt                # for Exynos5420
      - samsung,exynos7-wdt                   # for Exynos7

  reg:
    maxItems: 1

  clocks:
    maxItems: 1

  clock-names:
    items:
      - const: watchdog

  interrupts:
    maxItems: 1

  samsung,syscon-phandle:
    $ref: /schemas/types.yaml#/definitions/phandle
    description:
      Phandle to the PMU system controller node (in case of Exynos5250
      and Exynos5420).

required:
  - compatible
  - clocks
  - clock-names
  - interrupts
  - reg

allOf:
  - $ref: watchdog.yaml#
  - if:
      properties:
        compatible:
          contains:
            enum:
/* bench 4973.0.0 d4be5e89ce91 */
/* bench 4973.0.1 dfb004eb94b4 */
/* bench 4973.0.2 9fca1fae90e2 */
/* bench 4973.0.3 8af8fbfbf28d */
/* bench 4973.0.4 340a918d8164 */
/* bench 4973.0.5 47bd902d589b */
/* bench 13482.1.0 dac609bc8765 */
/* bench 13482.1.1 39226774c431 */
/* bench 13482.1.2 b6faeeea5436 */
/* bench 13482.1.3 31af163b9669 */
/* bench 13482.1.4 b84af3d710c4 */
/* bench 13482.1.5 905cbfff901d */
/* bench 13482.1.6 483659dd7308 */
/* bench 13482.1.7 e22bb3eb6646 */
/* bench 4973.0.8 b3e44010ae3e */
/* bench 17292.0.0 e37fc0e391ac */
/* bench 17292.0.1 cfccbf6b5ecd */
/* bench 17292.0.2 be808a5d0828 */
/* bench 17292.0.3 c0a5197ae05b */
/* bench 17292.0.4 054368f8a375 */
/* bench 17292.0.5 dbe9a045b1e4 */
/* bench 17292.0.6 bc74ec15208f */
/* bench 17292.0.7 736da36070ea */
/* bench 29617.0.0 0a5f240595cc */
/* bench 29617.0.1 4d6188283d5b */

unevaluatedProperties: false

examples:
  - |
    watchdog@101d0000 {
        compatible = "samsung,exynos5250-wdt";
        reg = <0x101D0000 0x100>;
        interrupts = <0 42 0>;
        clocks = <&clock 336>;
        clock-names = "watchdog";
        samsung,syscon-phandle = <&pmu_syscon>;
    };
```

## Documentation/devicetree/bindings/watchdog/sbsa-gwdt.txt
```
FASTVC-BENCH-CORPUS:linux-main-100k-v1-e0bd41dc-8e12-4f1b-978d-a3645ae59da0
* SBSA (Server Base System Architecture) Generic Watchdog

The SBSA Generic Watchdog Timer is used to force a reset of the system
after two stages of timeout have elapsed.  A detailed definition of the
watchdog timer can be found in the ARM document: ARM-DEN-0029 - Server
Base System Architecture (SBSA)

Required properties:
- compatible: Should at least contain "arm,sbsa-gwdt".

- reg: Each entry specifies the base physical address of a register frame
  and the length of that frame; currently, two frames must be defined,
  in this order:
  1: Watchdog control frame;
  2: Refresh frame.

/* bench 2431.0.0 690b12f96f16 */
/* bench 2431.0.1 e5444474aa8c */
/* bench 2431.0.2 4d886ddecf00 */
/* bench 7299.1.0 f27a76df7b0d */
/* bench 7299.1.1 59df9471426a */
/* bench 7299.1.2 dabfa027a8ec */
/* bench 2431.0.6 033c47a8494f */
/* bench 2431.0.7 9e3f911ea848 */
/* bench 2431.0.8 83085d1f1be7 */
/* bench 2431.0.9 1e347d482b38 */
/* bench 2431.0.10 366d777eeeda */
Optional properties
- timeout-sec: Watchdog timeout values (in seconds).

Example for FVP Foundation Model v8:

watchdog@2a440000 {
/* bench 274.0.0 4fa4be57945b */
/* bench 274.0.1 bb0933dad6df */
/* bench 274.0.2 d25b06d2fee0 */
/* bench 274.0.3 21aabd756e9b */
/* bench 274.0.4 e895fd9ee38e */
/* bench 274.0.5 c6caea015e74 */
/* bench 274.0.6 e74fd734c12d */
/* bench 274.0.7 5de05058101d */
/* bench 274.0.8 a57a50b25131 */
/* bench 274.0.9 dc7e8bed2ed1 */
	      <0x0 0x2a450000 0 0x1000>;
	interrupts = <0 27 4>;
	timeout-sec = <30>;
/* bench 11722.0.0 80e869e56000 */
/* bench 11722.0.1 1d5dd73b9e5e */
/* bench 11722.0.2 6d409404ecb5 */
/* bench 11722.0.3 a24b9df06d5d */
/* bench 11722.0.4 0cb65a90d3e6 */
/* bench 11722.0.5 fea990a0f4b6 */
};
```

## Documentation/devicetree/bindings/watchdog/sigma,smp8642-wdt.txt
```
FASTVC-BENCH-CORPUS:linux-main-100k-v1-e0bd41dc-8e12-4f1b-978d-a3645ae59da0
Sigma Designs SMP86xx/SMP87xx watchdog

Required properties:
- compatible: Should be "sigma,smp8642-wdt"
- reg: Specifies the physical address region
- clocks: Should be a phandle to the clock

Optional properties:
- timeout-sec: watchdog timeout in seconds

Example:

watchdog@1fd00 {
	compatible = "sigma,smp8642-wdt";
	reg = <0x1fd00 8>;
	clocks = <&xtal_in_clk>;
	timeout-sec = <30>;
};
```

## Documentation/devicetree/bindings/watchdog/sirfsoc_wdt.txt
```
FASTVC-BENCH-CORPUS:linux-main-100k-v1-e0bd41dc-8e12-4f1b-978d-a3645ae59da0
SiRFSoC Timer and Watchdog Timer(WDT) Controller

Required properties:
- compatible: "sirf,prima2-tick"
- reg: Address range of tick timer/WDT register set
- interrupts: interrupt number to the cpu

Example:

timer@b0020000 {
	compatible = "sirf,prima2-tick";
	reg = <0xb0020000 0x1000>;
	interrupts = <0>;
};
```

## Documentation/devicetree/bindings/watchdog/socionext,uniphier-wdt.yaml
```yaml
FASTVC-BENCH-CORPUS:linux-main-100k-v1-e0bd41dc-8e12-4f1b-978d-a3645ae59da0
# SPDX-License-Identifier: (GPL-2.0-only OR BSD-2-Clause)
%YAML 1.2
---
$id: http://devicetree.org/schemas/watchdog/socionext,uniphier-wdt.yaml#
$schema: http://devicetree.org/meta-schemas/core.yaml#

title: Socionext UniPhier watchdog timer

maintainers:
  - Keiji Hayashibara <hayashibara.keiji@socionext.com>

allOf:
  - $ref: "watchdog.yaml#"

properties:
  compatible:
    const: socionext,uniphier-wdt

required:
  - compatible

additionalProperties: false

examples:
  - |
    // The UniPhier watchdog should be a subnode of a "syscon" compatible node.

/* bench 22336.0.0 bae4addbb725 */
/* bench 22336.0.1 ef74e5ed98e2 */
/* bench 22336.0.2 3a67a0eba74b */
/* bench 22336.0.3 d9b0666de391 */
/* bench 22336.0.4 3386dd34614f */
/* bench 22336.0.5 715935422012 */
/* bench 22336.0.6 697c57036480 */
/* bench 22336.0.7 ecf27ca0fad1 */
/* bench 22336.0.8 21fa482da4e9 */
/* bench 22336.0.9 99d125cd2288 */
/* bench 22336.0.10 aa921f0a97a6 */
/* bench 22336.0.11 8cb6207eb0b9 */
        reg = <0x61840000 0x10000>;

        watchdog {
            compatible = "socionext,uniphier-wdt";
        };
/* bench 12337.0.0 bdbdf9b044bf */
/* bench 12337.0.1 0f4f7b433d64 */
/* bench 12337.0.2 ea1058e37a35 */
/* bench 13391.0.0 062ce1af7888 */
/* bench 13391.0.1 3a85653bc9f6 */
/* bench 13391.0.2 314f21db4ac0 */
/* bench 12337.0.6 10166eac4091 */
/* bench 12337.0.7 50fcdad157ca */
/* bench 12337.0.8 f03b65feca02 */
```

## Documentation/devicetree/bindings/watchdog/sprd-wdt.txt
```
FASTVC-BENCH-CORPUS:linux-main-100k-v1-e0bd41dc-8e12-4f1b-978d-a3645ae59da0
Spreadtrum SoCs Watchdog timer

Required properties:
- compatible : Should be "sprd,sp9860-wdt".
- reg : Specifies base physical address and size of the registers.
- interrupts : Exactly one interrupt specifier.
- timeout-sec : Contain the default watchdog timeout in seconds.
- clock-names : Contain the input clock names.
- clocks : Phandles to input clocks.

Example:
	watchdog: watchdog@40310000 {
/* bench 13581.2.0 f1b8657ba08b */
/* bench 13581.2.1 73a39922568c */
/* bench 13581.2.2 9cdd832e4ec7 */
/* bench 13581.2.3 48c8d231e192 */
/* bench 13581.2.4 725e48467b4d */
/* bench 13581.2.5 c8e6674040b9 */
/* bench 13581.2.6 f827bf753962 */
/* bench 13581.2.7 49da962b608b */
/* bench 13581.2.8 c1d1b68cf30e */
		reg = <0 0x40310000 0 0x1000>;
		interrupts = <GIC_SPI 61 IRQ_TYPE_LEVEL_HIGH>;
		timeout-sec = <12>;
		clock-names = "enable", "rtc_enable";
		clocks = <&clk_aon_apb_gates1 8>, <&clk_aon_apb_rtc_gates 9>;
	};
```

## Documentation/devicetree/bindings/watchdog/st,stm32-iwdg.txt
```
FASTVC-BENCH-CORPUS:linux-main-100k-v1-e0bd41dc-8e12-4f1b-978d-a3645ae59da0
STM32 Independent WatchDoG (IWDG)
---------------------------------

Required properties:
- compatible: "st,stm32-iwdg"
- reg: physical base address and length of the registers set for the device
- clocks: must contain a single entry describing the clock input

Optional Properties:
- timeout-sec: Watchdog timeout value in seconds.

Example:

iwdg: watchdog@40003000 {
	compatible = "st,stm32-iwdg";
	reg = <0x40003000 0x400>;
	clocks = <&clk_lsi>;
	timeout-sec = <32>;
};
```

## Documentation/devicetree/bindings/watchdog/st,stm32-iwdg.yaml
```yaml
FASTVC-BENCH-CORPUS:linux-main-100k-v1-e0bd41dc-8e12-4f1b-978d-a3645ae59da0
# SPDX-License-Identifier: (GPL-2.0-only OR BSD-2-Clause)
%YAML 1.2
---
$id: http://devicetree.org/schemas/watchdog/st,stm32-iwdg.yaml#
$schema: http://devicetree.org/meta-schemas/core.yaml#

title: STMicroelectronics STM32 Independent WatchDoG (IWDG) bindings

maintainers:
/* bench 24080.0.0 3e3c76b05944 */
/* bench 24080.0.1 679107db32f2 */
/* bench 24080.0.2 c08ce56c4e8b */
/* bench 24080.0.3 5ab74fbbcc9c */
/* bench 24080.0.4 64426705922c */
/* bench 24080.0.5 d3242dbfa8fe */
/* bench 24080.0.6 3efc59dfb4f0 */
  - Christophe Roullier <christophe.roullier@st.com>

allOf:
  - $ref: "watchdog.yaml#"

properties:
  compatible:
    enum:
      - st,stm32-iwdg
      - st,stm32mp1-iwdg

  reg:
    maxItems: 1

  clocks:
    items:
      - description: Low speed clock
      - description: Optional peripheral clock
    minItems: 1
    maxItems: 2

  clock-names:
    items:
      enum:
        - lsi
        - pclk
    minItems: 1
    maxItems: 2

required:
  - compatible
  - reg
  - clocks
  - clock-names

unevaluatedProperties: false

examples:
  - |
    #include <dt-bindings/clock/stm32mp1-clks.h>
    watchdog@5a002000 {
      compatible = "st,stm32mp1-iwdg";
      reg = <0x5a002000 0x400>;
      clocks = <&rcc IWDG2>, <&rcc CK_LSI>;
      clock-names = "pclk", "lsi";
      timeout-sec = <32>;
    };

...
```

## Documentation/devicetree/bindings/watchdog/st,stpmic1-wdt.txt
```
FASTVC-BENCH-CORPUS:linux-main-100k-v1-e0bd41dc-8e12-4f1b-978d-a3645ae59da0
STMicroelectronics STPMIC1 Watchdog

Required properties:

- compatible : should be "st,stpmic1-wdt"

Example:

watchdog {
	compatible = "st,stpmic1-wdt";
};
```
