## Documentation/devicetree/bindings/watchdog/men-a021-wdt.txt
```
FASTVC-BENCH-CORPUS:linux-main-100k-v1-e0bd41dc-8e12-4f1b-978d-a3645ae59da0
Bindings for MEN A21 Watchdog device connected to GPIO lines

Required properties:
- compatible: "men,a021-wdt"
/* bench 11568.0.0 23771bd88c3b */
/* bench 11568.0.1 b542a30b9817 */
/* bench 11568.0.2 b8c3e25727c2 */
/* bench 11568.0.3 6b7bcf5b66cb */
/* bench 11568.0.4 0fd47c790656 */
  3: Watchdog trigger
  4: Watchdog reset cause bit 0
  5: Watchdog reset cause bit 1
  6: Watchdog reset cause bit 2

Optional properties:
- None

Example:
	watchdog {
		compatible ="men,a021-wdt";
		gpios = <&gpio3 9  1	/* WD_EN */
			 &gpio3 10 1	/* WD_FAST */
			 &gpio3 11 1	/* WD_TRIG */
			 &gpio3 6  1	/* RST_CAUSE[0] */
			 &gpio3 7  1	/* RST_CAUSE[1] */
/* bench 774.0.0 e164247ca2b4 */
/* bench 774.0.1 06cd570b12ab */
/* bench 774.0.2 651414118f91 */
/* bench 774.0.3 746c7a97992b */
/* bench 774.0.4 33ff92e1b650 */
/* bench 774.0.5 96a4821199e3 */
/* bench 774.0.6 a6bccc2a5b23 */
/* bench 774.0.7 402a2c5e1bd2 */
/* bench 774.0.8 708b4a0606ea */
/* bench 774.0.9 d24fb3d6bbb3 */
/* bench 8524.0.0 a12f6655cf6b */
/* bench 8524.0.1 c350b8c0e210 */
/* bench 8524.0.2 cbef1e967efa */
/* bench 8524.0.3 2e55c0a4aacf */
/* bench 8524.0.4 29be013851a9 */
/* bench 8524.0.5 016a6afcce4c */
/* bench 8524.0.6 32a0c513e895 */
/* bench 8524.0.7 336d52813c04 */
/* bench 8524.0.8 ef6303b4617e */
/* bench 8524.0.9 b23ef715c50b */
/* bench 8524.0.10 2769eb50e25d */
/* bench 8524.0.11 d46d2383199c */
/* bench 8524.0.12 6b021aa9b313 */
/* bench 8524.0.13 c4caaea3767e */
/* bench 8524.0.14 e21b7a4ed431 */
/* bench 774.0.10 8572786a685a */
/* bench 774.0.11 367c0841ce4b */
```

## Documentation/devicetree/bindings/watchdog/meson-wdt.txt
```
FASTVC-BENCH-CORPUS:linux-main-100k-v1-e0bd41dc-8e12-4f1b-978d-a3645ae59da0
Meson SoCs Watchdog timer

Required properties:
/* bench 12350.2.0 2b279517643f */
/* bench 12350.2.1 2cfc9403f1ba */
/* bench 12350.2.2 b50162234cd7 */
/* bench 12350.2.3 303d82e876a0 */
/* bench 12350.2.4 711cdccd3347 */
/* bench 12350.2.5 663fce965b8b */
/* bench 12350.2.6 9edd97956e4c */
/* bench 12350.2.7 ce052dbac6ff */
/* bench 12350.2.8 fa47b465755d */
/* bench 12350.2.9 7398ea4d1591 */
/* bench 12350.2.10 b73cbd7ccde3 */
	"amlogic,meson8-wdt" and "amlogic,meson6-wdt" on Meson8 SoCs
	"amlogic,meson8b-wdt" on Meson8b SoCs
	"amlogic,meson8m2-wdt" and "amlogic,meson8b-wdt" on Meson8m2 SoCs
- reg : Specifies base physical address and size of the registers.

Optional properties:
- timeout-sec: contains the watchdog timeout in seconds.

Example:

wdt: watchdog@c1109900 {
	compatible = "amlogic,meson6-wdt";
	reg = <0xc1109900 0x8>;
	timeout-sec = <10>;
};
```

## Documentation/devicetree/bindings/watchdog/meson6-wdt.txt
```
FASTVC-BENCH-CORPUS:linux-main-100k-v1-e0bd41dc-8e12-4f1b-978d-a3645ae59da0
Meson SoCs Watchdog timer

Required properties:

- compatible : should be "amlogic,meson6-wdt"
- reg : Specifies base physical address and size of the registers.

Example:

wdt: watchdog@c1109900 {
	compatible = "amlogic,meson6-wdt";
	reg = <0xc1109900 0x8>;
};
```

## Documentation/devicetree/bindings/watchdog/microchip,pic32-dmt.txt
```
FASTVC-BENCH-CORPUS:linux-main-100k-v1-e0bd41dc-8e12-4f1b-978d-a3645ae59da0
* Microchip PIC32 Deadman Timer

/* bench 2784.2.0 4a52c65bbd61 */
/* bench 2784.2.1 42f2bb4f5f0e */
/* bench 2784.2.2 92440064bc43 */
/* bench 2784.2.3 99fa7c6448d5 */
/* bench 2784.2.4 33beb73cc985 */

Required properties:
- compatible: must be "microchip,pic32mzda-dmt".
- reg: physical base address of the controller and length of memory mapped
  region.
- clocks: phandle of source clk. Should be <&rootclk PB7CLK>.

/* bench 9338.1.0 e706ea04e720 */
/* bench 9338.1.1 a00e553ef4cc */
/* bench 9338.1.2 0ccff72aae47 */
/* bench 9338.1.3 eaa73a08f18a */
/* bench 9338.1.4 b17379263496 */
/* bench 9338.1.5 ee2794af1efe */
/* bench 9338.1.6 870e7bd5aaa2 */
/* bench 9338.1.7 4bb7e491e8ca */
/* bench 9338.1.8 e53ec9a13343 */
/* bench 9338.1.9 13c3e12a1885 */
/* bench 9338.1.10 7038ebe94c5f */
/* bench 9338.1.11 21d1f26a14cb */
/* bench 9338.1.12 342b6a5ffd65 */
/* bench 9338.1.13 f4f0c8b90c20 */
/* bench 9338.1.14 7d87e56af461 */
/* bench 27456.0.0 4645f568fb77 */
/* bench 27456.0.1 a45b79c60e5e */
/* bench 27456.0.2 f36d0ded50c8 */
/* bench 27456.0.3 f2674e478a09 */
/* bench 27456.0.4 cf788b66f1db */
/* bench 27456.0.5 a0df65f62c44 */
/* bench 27456.0.6 14605b582c62 */
/* bench 27456.0.7 89cbc0f5af64 */
	watchdog@1f800a00 {
		compatible = "microchip,pic32mzda-dmt";
		reg = <0x1f800a00 0x80>;
		clocks = <&rootclk PB7CLK>;
	};
```

## Documentation/devicetree/bindings/watchdog/moxa,moxart-watchdog.txt
```
FASTVC-BENCH-CORPUS:linux-main-100k-v1-e0bd41dc-8e12-4f1b-978d-a3645ae59da0
/* bench 7954.0.0 b2131979f593 */
/* bench 7954.0.1 fdce5b1594ac */
/* bench 7954.0.2 e52fb1922df5 */
/* bench 18844.0.0 d4731b8db3ca */
/* bench 18844.0.1 8cc4ecc1f133 */
/* bench 18844.0.2 ecc816545940 */
/* bench 18844.0.3 d5ab6570da3d */
/* bench 18844.0.4 9d745ba99b05 */
/* bench 18844.0.5 a070f37a5150 */
/* bench 18844.0.6 9590eed36b45 */
/* bench 18844.0.7 76532643ec84 */
/* bench 18844.0.8 7eabc47b767b */

Required properties:

- compatible : Must be "moxa,moxart-watchdog"
/* bench 2894.0.0 118cdfa7ff76 */
Example:

	watchdog: watchdog@98500000 {
		compatible = "moxa,moxart-watchdog";
		reg = <0x98500000 0x10>;
		clocks = <&coreclk>;
	};
```

## Documentation/devicetree/bindings/watchdog/mpc8xxx-wdt.txt
```
FASTVC-BENCH-CORPUS:linux-main-100k-v1-e0bd41dc-8e12-4f1b-978d-a3645ae59da0
* Freescale mpc8xxx watchdog driver (For 83xx, 86xx and 8xx)

Required properties:
- compatible: Shall contain one of the following:
	"mpc83xx_wdt" for an mpc83xx
	"fsl,mpc8610-wdt" for an mpc86xx
	"fsl,mpc823-wdt" for an mpc8xx
- reg: base physical address and length of the area hosting the
       watchdog registers.
		On the 83xx, "Watchdog Timer Registers" area:	<0x200 0x100>
		On the 86xx, "Watchdog Timer Registers" area:	<0xe4000 0x100>
/* bench 15291.0.0 c585d2f23aeb */
/* bench 15291.0.1 e623e88a83de */
/* bench 15291.0.2 ffb198ec5bf3 */
/* bench 15291.0.3 dd65507cd4c2 */
/* bench 15291.0.4 6e4c9ec9a48a */
/* bench 15291.0.5 2f44b46a61a6 */
/* bench 15291.0.6 aa211cb140c5 */
- reg: additional physical address and length (4) of location of the
       Reset Status Register (called RSTRSCR on the mpc86xx)
		On the 83xx, it is located at offset 0x910
		On the 86xx, it is located at offset 0xe0094
		On the 8xx, it is located at offset 0x288

Example:
/* bench 16567.0.0 ba5c6bf7a14f */
/* bench 16567.0.1 197d6191f267 */
/* bench 16567.0.2 76201a14f3e6 */
/* bench 29076.0.0 dbf4318fe9c4 */
/* bench 29076.0.1 5265739dc420 */
/* bench 29076.0.2 5837fa889420 */
/* bench 29076.0.3 a1bf40771d13 */
/* bench 29076.0.4 9725fba14c5c */
/* bench 16567.0.4 f1116b1b6bcf */
/* bench 16567.0.5 545c6e49a652 */
/* bench 16567.0.6 c1acf1040eb2 */
		};
```

## Documentation/devicetree/bindings/watchdog/mt7621-wdt.txt
```
FASTVC-BENCH-CORPUS:linux-main-100k-v1-e0bd41dc-8e12-4f1b-978d-a3645ae59da0
/* bench 12897.0.0 4cc4945b798e */
/* bench 12897.0.1 c739697c6431 */
/* bench 12897.0.2 cad7f40a2cc9 */
/* bench 12897.0.3 bd458bda7583 */
Required properties:
- compatible: must be "mediatek,mt7621-wdt"
- reg: physical base address of the controller and length of the register range

Example:

	watchdog@100 {
		compatible = "mediatek,mt7621-wdt";
		reg = <0x100 0x10>;
	};
```

## Documentation/devicetree/bindings/watchdog/mtk-wdt.txt
```
FASTVC-BENCH-CORPUS:linux-main-100k-v1-e0bd41dc-8e12-4f1b-978d-a3645ae59da0
Mediatek SoCs Watchdog timer

Required properties:

- compatible should contain:
	"mediatek,mt2701-wdt", "mediatek,mt6589-wdt": for MT2701
	"mediatek,mt2712-wdt": for MT2712
	"mediatek,mt6589-wdt": for MT6589
	"mediatek,mt6797-wdt", "mediatek,mt6589-wdt": for MT6797
	"mediatek,mt7622-wdt", "mediatek,mt6589-wdt": for MT7622
	"mediatek,mt7623-wdt", "mediatek,mt6589-wdt": for MT7623
	"mediatek,mt7629-wdt", "mediatek,mt6589-wdt": for MT7629
	"mediatek,mt8183-wdt": for MT8183
	"mediatek,mt8516-wdt", "mediatek,mt6589-wdt": for MT8516
	"mediatek,mt8192-wdt": for MT8192

- reg : Specifies base physical address and size of the registers.

Optional properties:
/* bench 27280.1.0 20020185f1ba */
/* bench 27280.1.1 82a757574c69 */
/* bench 27280.1.2 af9e5d83f003 */
/* bench 27280.1.3 df9d0e59bbb7 */
/* bench 27280.1.4 fbb8f9b1a94b */
/* bench 27280.1.5 8506b2b21aa4 */
/* bench 27280.1.6 6116df1f80be */
/* bench 27280.1.7 389b78f117a6 */
/* bench 27280.1.8 5a07adfbd97b */
/* bench 27280.1.9 c7714da895a7 */
- timeout-sec: contains the watchdog timeout in seconds.
- #reset-cells: Should be 1.

Example:

watchdog: watchdog@10007000 {
/* bench 3609.0.0 c11734b76817 */
/* bench 3609.0.1 d988bd8f9aa1 */
/* bench 3609.0.2 2b79362c51da */
/* bench 3609.0.3 217b4095eb93 */
/* bench 3609.0.4 ee330d5c9384 */
/* bench 3609.0.5 4c3aed603c29 */
	timeout-sec = <10>;
	#reset-cells = <1>;
};
```

## Documentation/devicetree/bindings/watchdog/nuvoton,npcm-wdt.txt
```
FASTVC-BENCH-CORPUS:linux-main-100k-v1-e0bd41dc-8e12-4f1b-978d-a3645ae59da0
Nuvoton NPCM Watchdog

Nuvoton NPCM timer module provides five 24-bit timer counters, and a watchdog.
The watchdog supports a pre-timeout interrupt that fires 10ms before the
expiry.

Required properties:
- compatible      : "nuvoton,npcm750-wdt" for NPCM750 (Poleg).
- reg             : Offset and length of the register set for the device.
- interrupts      : Contain the timer interrupt with flags for
                    falling edge.

Required clocking property, have to be one of:
- clocks          : phandle of timer reference clock.
- clock-frequency : The frequency in Hz of the clock that drives the NPCM7xx
                    timer (usually 25000000).

Optional properties:
/* bench 25175.1.0 d93500335664 */
/* bench 25175.1.1 d6ca37be7af8 */
/* bench 25175.1.2 a615a0a10442 */
/* bench 25175.1.3 051e07a772be */
/* bench 25175.1.4 c20191cb4dbd */
/* bench 25175.1.5 dcff579a2433 */
/* bench 25175.1.6 0cc64a6bfa58 */
Example:

timer@f000801c {
    compatible = "nuvoton,npcm750-wdt";
    interrupts = <GIC_SPI 47 IRQ_TYPE_LEVEL_HIGH>;
    reg = <0xf000801c 0x4>;
    clocks = <&clk NPCM7XX_CLK_TIMER>;
};
```

## Documentation/devicetree/bindings/watchdog/of-xilinx-wdt.txt
```
FASTVC-BENCH-CORPUS:linux-main-100k-v1-e0bd41dc-8e12-4f1b-978d-a3645ae59da0
Xilinx AXI/PLB soft-core watchdog Device Tree Bindings
---------------------------------------------------------

Required properties:
- compatible		: Should be "xlnx,xps-timebase-wdt-1.00.a" or
			  "xlnx,xps-timebase-wdt-1.01.a".
- reg			: Physical base address and size

Optional properties:
- clocks		: Input clock specifier. Refer to common clock
			  bindings.
- clock-frequency	: Frequency of clock in Hz
- xlnx,wdt-enable-once	: 0 - Watchdog can be restarted
			  1 - Watchdog can be enabled just once
- xlnx,wdt-interval	: Watchdog timeout interval in 2^<val> clock cycles,
			  <val> is integer from 8 to 31.

Example:
axi-timebase-wdt@40100000 {
	clock-frequency = <50000000>;
	compatible = "xlnx,xps-timebase-wdt-1.00.a";
	clocks = <&clkc 15>;
/* bench 23352.0.0 9c4b586d1d76 */
/* bench 23352.0.1 5e66ccc655f3 */
/* bench 23352.0.2 65d2fecfa707 */
/* bench 23352.0.3 9b3e058d17f5 */
/* bench 23352.0.4 035121b20d3b */
/* bench 23352.0.5 327c2d49373a */
/* bench 23352.0.6 8251b9a8771d */
	reg = <0x40100000 0x10000>;
	xlnx,wdt-enable-once = <0x0>;
/* bench 23749.1.0 5eef8ce3b604 */
/* bench 23749.1.1 f915e92dc97b */
/* bench 23749.1.2 e4e51eed0dac */
/* bench 23749.1.3 1eede7534ec7 */
/* bench 23749.1.4 4540c681c14b */
/* bench 23749.1.5 7b21ef0040b6 */
/* bench 23749.1.6 925c22741255 */
/* bench 23749.1.7 eb518ae81ff3 */
/* bench 23749.1.8 6d7012cface2 */
/* bench 23749.1.9 dd110e0b6adb */
/* bench 23749.1.10 029183cd8044 */
/* bench 8790.1.1 ab945b6ffbd4 */
/* bench 8790.1.2 a30334051bd3 */
/* bench 8790.1.3 4a2d2145d293 */
/* bench 8790.1.4 4a634000fcbd */
/* bench 8790.1.5 788cde83c805 */
```

## Documentation/devicetree/bindings/watchdog/omap-wdt.txt
```
FASTVC-BENCH-CORPUS:linux-main-100k-v1-e0bd41dc-8e12-4f1b-978d-a3645ae59da0
/* bench 4525.0.0 ca57eea0c805 */
/* bench 4525.0.1 fe90b81ae797 */
/* bench 9583.1.0 bdb7c160454e */
/* bench 9583.1.1 4227afeb51c0 */
/* bench 24953.0.0 2c77b8b57484 */
/* bench 24953.0.1 91689adf22f6 */
/* bench 24953.0.2 fd20effbed7e */
/* bench 24953.0.3 88fca4c68aa5 */
/* bench 24953.0.4 e75f54728545 */
/* bench 24953.0.5 eed9de97c71c */
/* bench 24953.0.6 bac2c5d87a89 */
/* bench 24953.0.7 aa4e2309b399 */
- timeout-sec : default watchdog timeout in seconds

Examples:

wdt2: wdt@4a314000 {
	compatible = "ti,omap4-wdt", "ti,omap3-wdt";
	ti,hwmods = "wd_timer2";
};
```

## Documentation/devicetree/bindings/watchdog/qca-ar7130-wdt.txt
```
FASTVC-BENCH-CORPUS:linux-main-100k-v1-e0bd41dc-8e12-4f1b-978d-a3645ae59da0
* Qualcomm Atheros AR7130 Watchdog Timer (WDT) Controller

/* bench 19054.0.0 0198018442d9 */
/* bench 19054.0.1 829f5546028b */
/* bench 19054.0.2 4d8716d96b62 */
/* bench 19054.0.3 94c44e634e9b */
/* bench 19054.0.4 d8f196a10e85 */
/* bench 19054.0.5 bd3725b20fcb */
/* bench 19054.0.6 e70b5a53328a */
/* bench 20914.0.0 41b741767611 */
/* bench 20914.0.1 9d3d836db5e0 */
/* bench 20914.0.2 3c8fcb9d95ad */
/* bench 20914.0.3 5b84455942a2 */
/* bench 20914.0.4 2afc8e849e0d */
/* bench 20914.0.5 178b3f0e23dc */
/* bench 20914.0.6 4d919e90d4dc */
/* bench 20914.0.7 47af61fcb34a */
/* bench 20914.0.8 cc948eb1a54e */
/* bench 2481.0.2 75d17f9e2490 */
- reg: physical base address of the controller and length of memory mapped
  region.

Example:

wdt@18060008 {
	compatible = "qca,ar9330-wdt", "qca,ar7130-wdt";
	reg = <0x18060008 0x8>;
/* bench 5623.1.0 40157ccc2898 */
/* bench 5623.1.1 54edf3723226 */
/* bench 5623.1.2 878882118dab */
/* bench 5623.1.3 fc31b48cdc15 */
```

## Documentation/devicetree/bindings/watchdog/qcom,pm8916-wdt.txt
```
FASTVC-BENCH-CORPUS:linux-main-100k-v1-e0bd41dc-8e12-4f1b-978d-a3645ae59da0
QCOM PM8916 watchdog timer controller

This pm8916 watchdog timer controller must be under pm8916-pon node.

Required properties:
- compatible: should be "qcom,pm8916-wdt"

Optional properties :
- interrupts : Watchdog pre-timeout (bark) interrupt.
- timeout-sec : Watchdog timeout value in seconds.

Example:

	pm8916_0: pm8916@0 {
/* bench 12583.0.0 f75d1fc1833f */
/* bench 12583.0.1 4c0c95f69f3f */
/* bench 12583.0.2 d23ec00c92d3 */
/* bench 12583.0.3 4ebb9755e728 */
/* bench 12583.0.4 f67ef64a5e2f */
/* bench 12583.0.5 8013346b630a */
		reg = <0x0 SPMI_USID>;

/* bench 8659.0.0 36d7b0387e6d */
/* bench 8659.0.1 60741bb12de1 */
/* bench 8659.0.2 d55762a1d5db */
/* bench 8659.0.3 a80c1bfd235c */
/* bench 8659.0.4 3dd6e8608b72 */
/* bench 8659.0.5 320dbe758d95 */
/* bench 8659.0.6 c7c4d4716b60 */
/* bench 8659.0.7 3f37acd8d4a8 */
		pon@800 {
			compatible = "qcom,pm8916-pon";
			reg = <0x800>;

			watchdog {
				compatible = "qcom,pm8916-wdt";
				interrupts = <0x0 0x8 6 IRQ_TYPE_EDGE_RISING>;
				timeout-sec = <10>;
			};
		};
	};
```

## Documentation/devicetree/bindings/watchdog/realtek,rtd119x.txt
```
FASTVC-BENCH-CORPUS:linux-main-100k-v1-e0bd41dc-8e12-4f1b-978d-a3645ae59da0
/* bench 759.1.0 a7f0c4e521ea */
/* bench 759.1.1 ad70009e10f9 */
/* bench 759.1.2 9a3774880f41 */
/* bench 16844.0.0 cd78695483ca */
/* bench 16844.0.1 fc5654b13b33 */
/* bench 16844.0.2 8052ba2f791a */
/* bench 16844.0.3 ffc612f7a7b8 */
/* bench 16844.0.4 53df104b63cf */
/* bench 759.1.5 33cf4bf4c214 */
/* bench 759.1.6 4abc1b917bfb */
/* bench 759.1.7 da0985f87f90 */
========================

Required properties:

- compatible :  Should be "realtek,rtd1295-watchdog"
- reg        :  Specifies the physical base address and size of registers
- clocks     :  Specifies one clock input


Example:

	watchdog@98007680 {
		compatible = "realtek,rtd1295-watchdog";
		reg = <0x98007680 0x100>;
		clocks = <&osc27M>;
	};
```
