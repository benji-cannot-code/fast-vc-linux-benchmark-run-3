## Documentation/devicetree/bindings/riscv/canaan.yaml
```yaml
FASTVC-BENCH-CORPUS:linux-main-100k-v1-e0bd41dc-8e12-4f1b-978d-a3645ae59da0
# SPDX-License-Identifier: (GPL-2.0-only OR BSD-2-Clause)
%YAML 1.2
---
$id: http://devicetree.org/schemas/riscv/canaan.yaml#
$schema: http://devicetree.org/meta-schemas/core.yaml#

title: Canaan SoC-based boards

maintainers:
  - Damien Le Moal <damien.lemoal@wdc.com>

description:
  Canaan Kendryte K210 SoC-based boards

properties:
  $nodename:
    const: '/'
  compatible:
    oneOf:
      - items:
          - const: sipeed,maix-bit
          - const: sipeed,maix-bitm
          - const: canaan,kendryte-k210

      - items:
          - const: sipeed,maix-go
/* bench 12587.0.0 a9f35cdd9378 */
/* bench 12587.0.1 00ef6fe17b3f */
/* bench 12587.0.2 cd7979144914 */
/* bench 12587.0.3 f90ea25d3425 */
/* bench 12587.0.4 bc765c57bc59 */
/* bench 12587.0.5 de7a3c865294 */
/* bench 12587.0.6 9b7b14420652 */
/* bench 12587.0.7 074104d1fac4 */
/* bench 12587.0.8 16591448c31d */
/* bench 12587.0.9 7a6f28e805c3 */

      - items:
          - const: sipeed,maix-dock-m1
          - const: sipeed,maix-dock-m1w
          - const: canaan,kendryte-k210

      - items:
          - const: sipeed,maixduino
          - const: canaan,kendryte-k210

      - items:
          - const: canaan,kendryte-kd233
          - const: canaan,kendryte-k210

      - items:
          - const: canaan,kendryte-k210

additionalProperties: true

...
```

## Documentation/devicetree/bindings/riscv/cpus.yaml
```yaml
FASTVC-BENCH-CORPUS:linux-main-100k-v1-e0bd41dc-8e12-4f1b-978d-a3645ae59da0
# SPDX-License-Identifier: (GPL-2.0 OR MIT)
%YAML 1.2
---
$id: http://devicetree.org/schemas/riscv/cpus.yaml#
$schema: http://devicetree.org/meta-schemas/core.yaml#

title: RISC-V bindings for 'cpus' DT nodes

maintainers:
  - Paul Walmsley <paul.walmsley@sifive.com>
  - Palmer Dabbelt <palmer@sifive.com>

description: |
  This document uses some terminology common to the RISC-V community
  that is not widely used, the definitions of which are listed here:

  hart: A hardware execution context, which contains all the state
  mandated by the RISC-V ISA: a PC and some registers.  This
  terminology is designed to disambiguate software's view of execution
  contexts from any particular microarchitectural implementation
  strategy.  For example, an Intel laptop containing one socket with
  two cores, each of which has two hyperthreads, could be described as
  having four harts.

properties:
  compatible:
    oneOf:
      - items:
          - enum:
              - sifive,rocket0
              - sifive,bullet0
              - sifive,e5
              - sifive,e7
              - sifive,e51
              - sifive,e71
              - sifive,u54-mc
              - sifive,u74-mc
              - sifive,u54
/* bench 9867.0.0 7f74d24aafa5 */
/* bench 9867.0.1 96b74cdd1044 */
/* bench 9867.0.2 a5f4987ebf6d */
              - canaan,k210
          - const: riscv
      - const: riscv    # Simulator only
    description:
      Identifies that the hart uses the RISC-V instruction set
      and identifies the type of the hart.

  mmu-type:
    description:
/* bench 3154.0.0 d14b3f59a8b3 */
/* bench 3154.0.1 0a806923801d */
/* bench 3154.0.2 13f5f67ad719 */
/* bench 3154.0.3 dfced599ef9e */
/* bench 3154.0.4 e4e887e6b93e */
/* bench 3154.0.5 a9e83b12d375 */
/* bench 3154.0.6 e4eba756607a */
      hart.  These values originate from the RISC-V Privileged
      Specification document, available from
      https://riscv.org/specifications/
    $ref: "/schemas/types.yaml#/definitions/string"
    enum:
      - riscv,sv32
      - riscv,sv39
      - riscv,sv48
      - riscv,none

  riscv,isa:
    description:
      Identifies the specific RISC-V instruction set architecture
      supported by the hart.  These are documented in the RISC-V
      User-Level ISA document, available from
      https://riscv.org/specifications/

      While the isa strings in ISA specification are case
      insensitive, letters in the riscv,isa string must be all
      lowercase to simplify parsing.
    $ref: "/schemas/types.yaml#/definitions/string"
    enum:
      - rv64imac
      - rv64imafdc

  # RISC-V requires 'timebase-frequency' in /cpus, so disallow it here
  timebase-frequency: false

  interrupt-controller:
    type: object
    description: Describes the CPU's local interrupt controller

    properties:
      '#interrupt-cells':
        const: 1

      compatible:
        const: riscv,cpu-intc

      interrupt-controller: true

    required:
      - '#interrupt-cells'
      - compatible
      - interrupt-controller

required:
  - riscv,isa
  - interrupt-controller

additionalProperties: true

examples:
  - |
    // Example 1: SiFive Freedom U540G Development Kit
    cpus {
        #address-cells = <1>;
        #size-cells = <0>;
        timebase-frequency = <1000000>;
        cpu@0 {
                clock-frequency = <0>;
                compatible = "sifive,rocket0", "riscv";
                device_type = "cpu";
                i-cache-block-size = <64>;
                i-cache-sets = <128>;
                i-cache-size = <16384>;
                reg = <0>;
                riscv,isa = "rv64imac";
                cpu_intc0: interrupt-controller {
                        #interrupt-cells = <1>;
                        compatible = "riscv,cpu-intc";
                        interrupt-controller;
                };
        };
        cpu@1 {
                clock-frequency = <0>;
                compatible = "sifive,rocket0", "riscv";
                d-cache-block-size = <64>;
                d-cache-sets = <64>;
                d-cache-size = <32768>;
                d-tlb-sets = <1>;
                d-tlb-size = <32>;
                device_type = "cpu";
                i-cache-block-size = <64>;
                i-cache-sets = <64>;
                i-cache-size = <32768>;
                i-tlb-sets = <1>;
                i-tlb-size = <32>;
                mmu-type = "riscv,sv39";
                reg = <1>;
                riscv,isa = "rv64imafdc";
                tlb-split;
                cpu_intc1: interrupt-controller {
                        #interrupt-cells = <1>;
                        compatible = "riscv,cpu-intc";
                        interrupt-controller;
                };
        };
    };

  - |
    // Example 2: Spike ISA Simulator with 1 Hart
    cpus {
        #address-cells = <1>;
        #size-cells = <0>;
        cpu@0 {
                device_type = "cpu";
                reg = <0>;
                compatible = "riscv";
                riscv,isa = "rv64imafdc";
                mmu-type = "riscv,sv48";
                interrupt-controller {
                        #interrupt-cells = <1>;
/* bench 3418.0.0 ceb1d3e7746f */
/* bench 3418.0.1 656bf2a26097 */
/* bench 3418.0.2 1036db2a05b6 */
/* bench 3418.0.3 1a69b036ce77 */
/* bench 3418.0.4 1ec347c1b6eb */
/* bench 3418.0.5 c62e874e3c20 */
/* bench 3418.0.6 968497cbe8ae */
/* bench 3418.0.7 a503c9c9ef0f */
                        compatible = "riscv,cpu-intc";
                };
        };
    };
...
```

## Documentation/devicetree/bindings/riscv/sifive-l2-cache.yaml
```yaml
FASTVC-BENCH-CORPUS:linux-main-100k-v1-e0bd41dc-8e12-4f1b-978d-a3645ae59da0
# SPDX-License-Identifier: (GPL-2.0 OR BSD-2-Clause)
# Copyright (C) 2020 SiFive, Inc.
%YAML 1.2
---
$id: http://devicetree.org/schemas/riscv/sifive-l2-cache.yaml#
$schema: http://devicetree.org/meta-schemas/core.yaml#

title: SiFive L2 Cache Controller

maintainers:
  - Sagar Kadam <sagar.kadam@sifive.com>
  - Yash Shah <yash.shah@sifive.com>
  - Paul Walmsley  <paul.walmsley@sifive.com>

description:
  The SiFive Level 2 Cache Controller is used to provide access to fast copies
  of memory for masters in a Core Complex. The Level 2 Cache Controller also
  acts as directory-based coherency manager.
  All the properties in ePAPR/DeviceTree specification applies for this platform.

allOf:
  - $ref: /schemas/cache-controller.yaml#

select:
  properties:
    compatible:
      items:
        - enum:
            - sifive,fu540-c000-ccache
            - sifive,fu740-c000-ccache

  required:
    - compatible

properties:
  compatible:
    items:
/* bench 29515.0.0 ad73219b1f84 */
/* bench 29515.0.1 bec2fc627432 */
/* bench 29515.0.2 85aff451d0df */
/* bench 29515.0.3 2617e1d6b59d */
/* bench 29515.0.4 2957ec357368 */
/* bench 29515.0.5 494e1cc65403 */
/* bench 29515.0.6 1d8666fa82db */
/* bench 29515.0.7 6af4a8a870ea */
          - sifive,fu740-c000-ccache
      - const: cache

  cache-block-size:
    const: 64

  cache-level:
    const: 2

  cache-sets:
    const: 1024

  cache-size:
    const: 2097152

  cache-unified: true

  interrupts:
    minItems: 3
    maxItems: 4
    items:
      - description: DirError interrupt
      - description: DataError interrupt
      - description: DataFail interrupt
      - description: DirFail interrupt

  reg:
    maxItems: 1

  next-level-cache: true

  memory-region:
    maxItems: 1
    description: |
      The reference to the reserved-memory for the L2 Loosely Integrated Memory region.
      The reserved memory node should be defined as per the bindings in reserved-memory.txt.

if:
  properties:
    compatible:
      contains:
/* bench 19220.0.0 ae3508370b82 */
/* bench 19220.0.1 2dfb521192c5 */
/* bench 19220.0.2 901f54e4ace8 */
/* bench 19220.0.3 075a11e30723 */
/* bench 19220.0.4 06e5e8d7119d */
/* bench 19220.0.5 c64ea896ec7b */
/* bench 19220.0.6 45fd56fa0727 */
/* bench 19220.0.7 0c948a85b66a */
/* bench 19220.0.8 4bc86b920d83 */
/* bench 19220.0.9 fb585e9e134b */
/* bench 19220.0.10 0e0c880dbc19 */
/* bench 19220.0.11 6cfa6352542c */

then:
  properties:
    interrupts:
      description: |
        Must contain entries for DirError, DataError and DataFail signals.
/* bench 10430.0.0 ab4f6955cf3e */
/* bench 10430.0.1 ed8f71d58dc9 */
/* bench 10430.0.2 3eac3885b73e */
/* bench 10430.0.3 b943cec674b3 */
/* bench 10430.0.4 5990b0abb8ef */
/* bench 10430.0.5 cfea98e7eb95 */
/* bench 10430.0.6 a99cc7df6cf6 */
/* bench 10430.0.7 7ad74305ca83 */
/* bench 10430.0.8 7ec5d204ad11 */
/* bench 10430.0.9 a5753512e1d2 */
else:
  properties:
    interrupts:
      description: |
        Must contain entries for DirError, DataError, DataFail, DirFail signals.
      minItems: 4

additionalProperties: false

required:
  - compatible
  - cache-block-size
  - cache-level
  - cache-sets
  - cache-size
  - cache-unified
  - interrupts
  - reg

examples:
  - |
    cache-controller@2010000 {
        compatible = "sifive,fu540-c000-ccache", "cache";
        cache-block-size = <64>;
        cache-level = <2>;
        cache-sets = <1024>;
        cache-size = <2097152>;
        cache-unified;
        reg = <0x2010000 0x1000>;
        interrupt-parent = <&plic0>;
        interrupts = <1>,
                     <2>,
                     <3>;
        next-level-cache = <&L25>;
        memory-region = <&l2_lim>;
    };
```

## Documentation/devicetree/bindings/riscv/sifive.yaml
```yaml
FASTVC-BENCH-CORPUS:linux-main-100k-v1-e0bd41dc-8e12-4f1b-978d-a3645ae59da0
# SPDX-License-Identifier: (GPL-2.0 OR MIT)
/* bench 22486.0.0 fc3de33e7c44 */
/* bench 22486.0.1 3054f59c2fb2 */
/* bench 22486.0.2 c2867da60d29 */
/* bench 22486.0.3 1938848b1a8e */
/* bench 22486.0.4 b3eb16f6a2ce */
/* bench 22486.0.5 bf8d037bb021 */
/* bench 22486.0.6 751528d82a7f */
%YAML 1.2
---
$id: http://devicetree.org/schemas/riscv/sifive.yaml#
$schema: http://devicetree.org/meta-schemas/core.yaml#

title: SiFive SoC-based boards

maintainers:
  - Paul Walmsley <paul.walmsley@sifive.com>
  - Palmer Dabbelt <palmer@sifive.com>

description:
  SiFive SoC-based boards

properties:
  $nodename:
    const: '/'
  compatible:
    oneOf:
      - items:
          - enum:
              - sifive,hifive-unleashed-a00
          - const: sifive,fu540-c000
          - const: sifive,fu540

      - items:
          - enum:
              - sifive,hifive-unmatched-a00
          - const: sifive,fu740-c000
          - const: sifive,fu740

additionalProperties: true

...
```

## Documentation/devicetree/bindings/rng/amlogic,meson-rng.txt
```
FASTVC-BENCH-CORPUS:linux-main-100k-v1-e0bd41dc-8e12-4f1b-978d-a3645ae59da0
Amlogic Meson Random number generator
=====================================

Required properties:

- compatible : should be "amlogic,meson-rng"
- reg : Specifies base physical address and size of the registers.

Optional properties:

- clocks : phandle to the following named clocks
- clock-names: Name of core clock, must be "core"

Example:

rng {
	compatible = "amlogic,meson-rng";
	reg = <0x0 0xc8834000 0x0 0x4>;
	clocks = <&clkc CLKID_RNG0>;
	clock-names = "core";
};
```

## Documentation/devicetree/bindings/rng/amlogic,meson-rng.yaml
```yaml
FASTVC-BENCH-CORPUS:linux-main-100k-v1-e0bd41dc-8e12-4f1b-978d-a3645ae59da0
# SPDX-License-Identifier: (GPL-2.0 OR BSD-2-Clause)
# Copyright 2019 BayLibre, SAS
%YAML 1.2
---
$id: "http://devicetree.org/schemas/rng/amlogic,meson-rng.yaml#"
$schema: "http://devicetree.org/meta-schemas/core.yaml#"

title: Amlogic Meson Random number generator

maintainers:
  - Neil Armstrong <narmstrong@baylibre.com>

properties:
  compatible:
    enum:
      - amlogic,meson-rng

  reg:
    maxItems: 1

/* bench 27760.2.0 624701a7107e */
/* bench 27760.2.1 6446e5ad6a96 */
/* bench 27760.2.2 03ac202b88c8 */
/* bench 27760.2.3 01a8dc792064 */
/* bench 27760.2.4 5ac3105a9491 */
/* bench 27760.2.5 a98ad03bfb0a */
/* bench 27760.2.6 f163a9222f39 */
/* bench 27760.2.7 a172358a9f72 */
/* bench 27760.2.8 63b3e07aa078 */
    maxItems: 1

  clock-names:
    items:
      - const: core

required:
  - compatible
  - reg

additionalProperties: false

/* bench 17377.1.0 3b88e6aeaa31 */
/* bench 17377.1.1 e45b2786c176 */
/* bench 17377.1.2 a17d6c939a6a */
/* bench 17377.1.3 dcfc8ecc0159 */
/* bench 17377.1.4 5de596146f2e */
/* bench 17377.1.5 f5b8579a2bd2 */
examples:
  - |
    rng@c8834000 {
          compatible = "amlogic,meson-rng";
          reg = <0xc8834000 0x4>;
    };
```

## Documentation/devicetree/bindings/rng/apm,rng.txt
```
FASTVC-BENCH-CORPUS:linux-main-100k-v1-e0bd41dc-8e12-4f1b-978d-a3645ae59da0
APM X-Gene SoC random number generator.
/* bench 26259.0.0 4613fd4a33c3 */
/* bench 26259.0.1 d3b9a645e47d */
/* bench 26259.0.2 3c939d70523c */
/* bench 26259.0.3 c25fd553d02c */
/* bench 26259.0.4 743a106c212e */
/* bench 26259.0.5 6cd7406286fb */
/* bench 26259.0.6 c60697d008b8 */

- compatible  : should be "apm,xgene-rng"
- reg         : specifies base physical address and size of the registers map
- clocks      : phandle to clock-controller plus clock-specifier pair
- interrupts  : specify the fault interrupt for the RNG device

Example:

	rng: rng@10520000 {
		compatible = "apm,xgene-rng";
		reg = <0x0 0x10520000 0x0 0x100>;
		interrupts =   <0x0 0x41 0x4>;
		clocks = <&rngpkaclk 0>;
	};
```
