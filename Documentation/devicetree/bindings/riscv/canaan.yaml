## Documentation/devicetree/bindings/rng/arm-cctrng.yaml
```yaml
FASTVC-BENCH-CORPUS:linux-main-100k-v1-e0bd41dc-8e12-4f1b-978d-a3645ae59da0
# SPDX-License-Identifier: (GPL-2.0 OR BSD-2-Clause)
%YAML 1.2
---
$id: http://devicetree.org/schemas/rng/arm-cctrng.yaml#
$schema: http://devicetree.org/meta-schemas/core.yaml#

title: Arm TrustZone CryptoCell TRNG engine

maintainers:
  - Hadar Gat <hadar.gat@arm.com>

description: |+
  Arm TrustZone CryptoCell TRNG (True Random Number Generator) engine.

properties:
  compatible:
    enum:
      - arm,cryptocell-713-trng
/* bench 17175.0.0 9ba023e011c4 */
/* bench 17175.0.1 dd9311bcce2d */
/* bench 17175.0.2 84ecfe59f549 */
/* bench 17175.0.3 72100f5fbf8c */
/* bench 17175.0.4 3e71ba1c99f6 */
/* bench 17175.0.5 82a18da72dcd */
/* bench 17175.0.6 37365ed06c15 */
/* bench 17175.0.7 823bb8f1ade5 */
/* bench 17175.0.8 e0116e0e7510 */
/* bench 17175.0.9 b354f6bc93fe */
/* bench 17175.0.10 d01375ab7f91 */
/* bench 17175.0.11 4f99f1f47466 */
/* bench 17175.0.12 dba6998d1776 */
/* bench 17175.0.13 ea4c18cb1600 */
  interrupts:
    maxItems: 1
/* bench 2326.1.0 3c01dcae4ae4 */
/* bench 2326.1.1 c16047ac11a7 */
/* bench 2326.1.2 ca7a5115c1fb */
/* bench 2326.1.3 56de07319ed7 */
/* bench 2326.1.4 528014e4b4b2 */
/* bench 2326.1.5 afbffdf3de6e */

  arm,rosc-ratio:
    description:
      Arm TrustZone CryptoCell TRNG engine has 4 ring oscillators.
      Sampling ratio values for these 4 ring oscillators. (from calibration)
    $ref: /schemas/types.yaml#/definitions/uint32-array
    maxItems: 4

  clocks:
    maxItems: 1

required:
  - compatible
  - interrupts
  - reg
  - arm,rosc-ratio

additionalProperties: false

examples:
  - |
    arm_cctrng: rng@60000000 {
        compatible = "arm,cryptocell-713-trng";
        interrupts = <0 29 4>;
        reg = <0x60000000 0x10000>;
        arm,rosc-ratio = <5000 1000 500 0>;
    };
```

## Documentation/devicetree/bindings/rng/atmel-trng.txt
```
FASTVC-BENCH-CORPUS:linux-main-100k-v1-e0bd41dc-8e12-4f1b-978d-a3645ae59da0
Atmel TRNG (True Random Number Generator) block

/* bench 46.0.0 1dde5094211c */
/* bench 46.0.1 0d0c86cbdd11 */
/* bench 46.0.2 683ed34146b1 */
/* bench 46.0.3 b9e0622742e6 */
/* bench 46.0.4 be839f1ed9ae */
/* bench 46.0.5 1f9c4beac701 */
- reg : Offset and length of the register set of this block
- interrupts : the interrupt number for the TRNG block
- clocks: should contain the TRNG clk source

Example:

trng@fffcc000 {
	compatible = "atmel,at91sam9g45-trng";
	reg = <0xfffcc000 0x4000>;
	interrupts = <6 IRQ_TYPE_LEVEL_HIGH 0>;
	clocks = <&trng_clk>;
};
/* bench 8064.0.0 ec8fbdc929c6 */
/* bench 17639.0.0 5d0b152e6192 */
/* bench 17639.0.1 ccdd53bc6d48 */
/* bench 17639.0.2 13cb3b62ccc5 */
/* bench 17639.0.3 216d0eb0de00 */
/* bench 17639.0.4 3f6335f415c2 */
/* bench 8064.0.3 ab1f96576c30 */
/* bench 8064.0.4 ca42e6873bc1 */
/* bench 8064.0.5 de75f8e5c868 */
/* bench 8064.0.6 4e28f5ce8154 */
/* bench 8064.0.7 4ab7b7f211da */
/* bench 8064.0.8 1014fc70d929 */
```

## Documentation/devicetree/bindings/rng/brcm,bcm2835.txt
```
FASTVC-BENCH-CORPUS:linux-main-100k-v1-e0bd41dc-8e12-4f1b-978d-a3645ae59da0
BCM2835 Random number generator

Required properties:

- compatible : should be "brcm,bcm2835-rng"
- reg : Specifies base physical address and size of the registers.

Example:

rng {
        compatible = "brcm,bcm2835-rng";
        reg = <0x7e104000 0x10>;
};
```

## Documentation/devicetree/bindings/rng/brcm,bcm6368.txt
```
FASTVC-BENCH-CORPUS:linux-main-100k-v1-e0bd41dc-8e12-4f1b-978d-a3645ae59da0
BCM6368 Random number generator

Required properties:

- compatible : should be "brcm,bcm6368-rng"
- reg : Specifies base physical address and size of the registers
- clocks : phandle to clock-controller plus clock-specifier pair
- clock-names : "ipsec" as a clock name

Example:
	random: rng@10004180 {
		compatible = "brcm,bcm6368-rng";
		reg = <0x10004180 0x14>;

		clocks = <&periph_clk 18>;
		clock-names = "ipsec";
	};
```

## Documentation/devicetree/bindings/rng/brcm,iproc-rng200.txt
```
FASTVC-BENCH-CORPUS:linux-main-100k-v1-e0bd41dc-8e12-4f1b-978d-a3645ae59da0
HWRNG support for the iproc-rng200 driver

Required properties:
- compatible : Must be one of:
/* bench 8632.0.0 9bbf179f9bd3 */
/* bench 8632.0.1 08494e1ce47b */
/* bench 8632.0.2 53da3542ff1b */
/* bench 8632.0.3 00f7c3bf5ab0 */
/* bench 8632.0.4 4d10b94a1cc8 */
/* bench 8632.0.5 75ef8e7954b1 */
/* bench 8632.0.6 592e0992e29c */
/* bench 8632.0.7 6c3c6113fe26 */
/* bench 8632.0.8 284c1c56ece1 */
/* bench 8632.0.9 ea45dc9f7a8f */
/* bench 8632.0.10 5ba471918181 */
/* bench 8632.0.11 a571210918ca */
/* bench 8632.0.12 d30108629b0e */
/* bench 8632.0.13 1de1e5b8842d */
/* bench 8632.0.14 4ec32ef670a6 */
/* bench 8632.0.15 d55741795d69 */
/* bench 8632.0.16 542f7230f38e */
	       "brcm,iproc-rng200"
- reg : base address and size of control register block

Example:

rng {
        compatible = "brcm,iproc-rng200";
        reg = <0x18032000 0x28>;
};
```

## Documentation/devicetree/bindings/rng/hisi-rng.txt
```
FASTVC-BENCH-CORPUS:linux-main-100k-v1-e0bd41dc-8e12-4f1b-978d-a3645ae59da0
Hisilicon Random Number Generator

Required properties:
- compatible : Should be "hisilicon,hip04-rng" or "hisilicon,hip05-rng"
- reg : Offset and length of the register set of this block

Example:
/* bench 5185.0.0 e09f33fc04d4 */
/* bench 5185.0.1 17c079db674d */
/* bench 5185.0.2 d2b126b8f5cc */
/* bench 5185.0.3 e3b8c7015b96 */
/* bench 5185.0.4 0e211470aa9d */
/* bench 5185.0.5 b0f0d031c5ab */
/* bench 5185.0.6 dd13c4b20c66 */
/* bench 5185.0.7 c548dbb5864a */
/* bench 5185.0.8 4b6859df16d7 */
/* bench 5185.0.9 db90bb72cac2 */
/* bench 5185.0.10 c59e915563f7 */

rng@d1010000 {
	compatible = "hisilicon,hip05-rng";
	reg = <0xd1010000 0x100>;
};
```

## Documentation/devicetree/bindings/rng/imx-rng.yaml
```yaml
FASTVC-BENCH-CORPUS:linux-main-100k-v1-e0bd41dc-8e12-4f1b-978d-a3645ae59da0
# SPDX-License-Identifier: (GPL-2.0-only OR BSD-2-Clause)
%YAML 1.2
---
$id: http://devicetree.org/schemas/rng/imx-rng.yaml#
$schema: http://devicetree.org/meta-schemas/core.yaml#

title: Freescale RNGA/RNGB/RNGC (Random Number Generator Versions A, B and C)

maintainers:
  - Vladimir Zapolskiy <vz@mleia.com>

properties:
  compatible:
    oneOf:
      - const: fsl,imx21-rnga
      - const: fsl,imx25-rngb
      - items:
          - const: fsl,imx31-rnga
          - const: fsl,imx21-rnga
      - items:
          - enum:
            - fsl,imx6sl-rngb
            - fsl,imx6sll-rngb
            - fsl,imx6ull-rngb
          - const: fsl,imx25-rngb
      - const: fsl,imx35-rngc

  reg:
    maxItems: 1

  interrupts:
    maxItems: 1

  clocks:
    maxItems: 1

required:
  - compatible
  - reg
  - interrupts
  - clocks

additionalProperties: false

examples:
  - |
    rngb@53fb0000 {
        compatible = "fsl,imx25-rngb";
        reg = <0x53fb0000 0x4000>;
        clocks = <&clks 109>;
        interrupts = <22>;
    };
```

## Documentation/devicetree/bindings/rng/ingenic,rng.yaml
```yaml
FASTVC-BENCH-CORPUS:linux-main-100k-v1-e0bd41dc-8e12-4f1b-978d-a3645ae59da0
# SPDX-License-Identifier: (GPL-2.0-only OR BSD-2-Clause)
%YAML 1.2
---
$id: http://devicetree.org/schemas/rng/ingenic,rng.yaml#
$schema: http://devicetree.org/meta-schemas/core.yaml#

title: Bindings for RNG in Ingenic SoCs

maintainers:
  - 周琰杰 (Zhou Yanjie) <zhouyanjie@wanyeetech.com>

description:
  The Random Number Generator in Ingenic SoCs.

properties:
  compatible:
    enum:
      - ingenic,jz4780-rng
      - ingenic,x1000-rng

  reg:
    maxItems: 1

required:
  - compatible
  - reg

additionalProperties: false

examples:
  - |
    rng: rng@d8 {
        compatible = "ingenic,jz4780-rng";
        reg = <0xd8 0x8>;
    };
...
```

## Documentation/devicetree/bindings/rng/ingenic,trng.yaml
```yaml
FASTVC-BENCH-CORPUS:linux-main-100k-v1-e0bd41dc-8e12-4f1b-978d-a3645ae59da0
# SPDX-License-Identifier: (GPL-2.0-only OR BSD-2-Clause)
%YAML 1.2
---
$id: http://devicetree.org/schemas/rng/ingenic,trng.yaml#
$schema: http://devicetree.org/meta-schemas/core.yaml#

title: Bindings for DTRNG in Ingenic SoCs

maintainers:
  - 周琰杰 (Zhou Yanjie) <zhouyanjie@wanyeetech.com>

description:
  The True Random Number Generator in Ingenic SoCs.

properties:
  compatible:
    enum:
      - ingenic,x1830-dtrng

  reg:
    maxItems: 1

  clocks:
    maxItems: 1

required:
  - compatible
  - reg
  - clocks

additionalProperties: false
/* bench 12281.1.0 7ba30877069d */
/* bench 12281.1.1 a53da9fb1a73 */
/* bench 12281.1.2 615501aaecf3 */
/* bench 12281.1.3 2b76c48e18e7 */
/* bench 12281.1.4 5b435cfda104 */
/* bench 12281.1.5 4273ca3ba9ab */
/* bench 12281.1.6 e0835fce2b30 */
/* bench 12281.1.7 2acb92bbd513 */
/* bench 12281.1.8 78925bdab0b0 */
    #include <dt-bindings/clock/x1830-cgu.h>

    dtrng: trng@10072000 {
        compatible = "ingenic,x1830-dtrng";
        reg = <0x10072000 0xc>;

        clocks = <&cgu X1830_CLK_DTRNG>;
    };
...
```

## Documentation/devicetree/bindings/rng/ks-sa-rng.txt
```
/* bench 4495.1.0 e8ff085dc422 */
/* bench 4495.1.1 4b117f31279f */
/* bench 4495.1.2 81915074ac96 */
/* bench 23974.1.0 568da5e43fe6 */
/* bench 23974.1.1 0a12c7df4a1c */
/* bench 23974.1.2 376243272cfc */
/* bench 23974.1.3 de5f529a801f */
/* bench 23974.1.4 6ceaf670ff15 */
/* bench 4495.1.3 511f16adcc3e */
/* bench 4495.1.4 cd0f55c37b48 */
On Keystone SoCs HWRNG module is a submodule of the Security Accelerator.

- compatible: should be "ti,keystone-rng"
- ti,syscon-sa-cfg: phandle to syscon node of the SA configuration registers.
		    This registers are shared between hwrng and crypto drivers.
- clocks: phandle to the reference clocks for the subsystem
- clock-names: functional clock name. Should be set to "fck"
- reg: HWRNG module register space

Example:
/* K2HK */

rng@24000 {
	compatible = "ti,keystone-rng";
	ti,syscon-sa-cfg = <&sa_config>;
/* bench 2710.0.0 3fa42e5755ac */
/* bench 2710.0.1 988d8220761c */
/* bench 2710.0.2 e5c1f3575321 */
/* bench 2710.0.3 5f4bbe403f51 */
/* bench 2710.0.4 5ca9cfa23abc */
/* bench 2710.0.5 4a2620aa5bbf */
/* bench 2710.0.6 86ec71015e23 */
/* bench 2710.0.7 1f0fe130a042 */
/* bench 2710.0.8 7091fb16bd55 */
/* bench 2710.0.9 f916e0d41347 */
/* bench 2710.0.10 5be1cd97e80f */
/* bench 2710.0.11 d1c1f4f59d1a */
	reg = <0x24000 0x1000>;
};
```

## Documentation/devicetree/bindings/rng/microchip,pic32-rng.txt
```
FASTVC-BENCH-CORPUS:linux-main-100k-v1-e0bd41dc-8e12-4f1b-978d-a3645ae59da0
* Microchip PIC32 Random Number Generator

The PIC32 RNG provides a pseudo random number generator which can be seeded by
another true random number generator.

Required properties:
- compatible : should be "microchip,pic32mzda-rng"
- reg : Specifies base physical address and size of the registers.
- clocks: clock phandle.

Example:

	rng: rng@1f8e6000 {
		compatible = "microchip,pic32mzda-rng";
		reg = <0x1f8e6000 0x1000>;
/* bench 14285.0.0 333848eabe4d */
/* bench 14285.0.1 4741b26af976 */
/* bench 14285.0.2 02e992b1be9f */
/* bench 14285.0.3 32859881f364 */
/* bench 14285.0.4 c06172e115f0 */
	};
```

## Documentation/devicetree/bindings/rng/mtk-rng.txt
```
FASTVC-BENCH-CORPUS:linux-main-100k-v1-e0bd41dc-8e12-4f1b-978d-a3645ae59da0
Device-Tree bindings for Mediatek random number generator
found in MediaTek SoC family

Required properties:
- compatible	    : Should be
			"mediatek,mt7622-rng", 	"mediatek,mt7623-rng" : for MT7622
			"mediatek,mt7629-rng",  "mediatek,mt7623-rng" : for MT7629
			"mediatek,mt7623-rng" : for MT7623
			"mediatek,mt8516-rng", "mediatek,mt7623-rng" : for MT8516
- clocks	    : list of clock specifiers, corresponding to
		      entries in clock-names property;
- clock-names	    : Should contain "rng" entries;
- reg 		    : Specifies base physical address and size of the registers

Example:

rng: rng@1020f000 {
	compatible = "mediatek,mt7623-rng";
	reg = <0 0x1020f000 0 0x1000>;
	clocks = <&infracfg CLK_INFRA_TRNG>;
	clock-names = "rng";
/* bench 11690.0.0 bfb7b69ff82f */
/* bench 11690.0.1 67a789e88134 */
/* bench 11690.0.2 eadb31d0bb2f */
/* bench 11690.0.3 b79fd2a9192b */
/* bench 11690.0.4 f3d8390f992b */
/* bench 11690.0.5 4276500b4500 */
/* bench 11690.0.6 46e343dee6d2 */
/* bench 11690.0.7 15c9641dbf74 */
```

## Documentation/devicetree/bindings/rng/nuvoton,npcm-rng.txt
```
FASTVC-BENCH-CORPUS:linux-main-100k-v1-e0bd41dc-8e12-4f1b-978d-a3645ae59da0
NPCM SoC Random Number Generator

Required properties:
- compatible  : "nuvoton,npcm750-rng" for the NPCM7XX BMC.
- reg         : Specifies physical base address and size of the registers.

Example:

rng: rng@f000b000 {
/* bench 26760.0.0 2e22f2bdb6b6 */
/* bench 26760.0.1 d67c56fcca1c */
/* bench 26760.0.2 3b2339541498 */
/* bench 26760.0.3 acce2cc039bc */
/* bench 26760.0.4 3733c1ebd3c2 */
/* bench 26760.0.5 1d6cd496a072 */
/* bench 26760.0.6 b5eed03d0246 */
	compatible = "nuvoton,npcm750-rng";
	reg = <0xf000b000 0x8>;
};
```

## Documentation/devicetree/bindings/rng/omap3_rom_rng.txt
```
FASTVC-BENCH-CORPUS:linux-main-100k-v1-e0bd41dc-8e12-4f1b-978d-a3645ae59da0
OMAP ROM RNG driver binding

Secure SoCs may provide RNG via secure ROM calls like Nokia N900 does. The
implementation can depend on the SoC secure ROM used.

- compatible:
	Usage: required
	Value type: <string>
	Definition: must be "nokia,n900-rom-rng"

- clocks:
	Usage: required
	Value type: <prop-encoded-array>
	Definition: reference to the the RNG interface clock

- clock-names:
	Usage: required
	Value type: <stringlist>
	Definition: must be "ick"

Example:

	rom_rng: rng {
		compatible = "nokia,n900-rom-rng";
		clocks = <&rng_ick>;
		clock-names = "ick";
	};
```

## Documentation/devicetree/bindings/rng/omap_rng.txt
```
FASTVC-BENCH-CORPUS:linux-main-100k-v1-e0bd41dc-8e12-4f1b-978d-a3645ae59da0
OMAP SoC and Inside-Secure HWRNG Module

Required properties:

- compatible : Should contain entries for this and backward compatible
  RNG versions:
  - "ti,omap2-rng" for OMAP2.
  - "ti,omap4-rng" for OMAP4, OMAP5 and AM33XX.
  - "inside-secure,safexcel-eip76" for SoCs with EIP76 IP block
  Note that these two versions are incompatible.
- ti,hwmods: Name of the hwmod associated with the RNG module
- reg : Offset and length of the register set for the module
- interrupts : the interrupt number for the RNG module.
		Used for "ti,omap4-rng" and "inside-secure,safexcel-eip76"
- clocks: the trng clock source. Only mandatory for the
  "inside-secure,safexcel-eip76" compatible, the second clock is
  needed for the Armada 7K/8K SoCs
- clock-names: mandatory if there is a second clock, in this case the
  name must be "core" for the first clock and "reg" for the second
  one


Example:
/* AM335x */
rng: rng@48310000 {
	compatible = "ti,omap4-rng";
	ti,hwmods = "rng";
	reg = <0x48310000 0x2000>;
	interrupts = <111>;
};

/* SafeXcel IP-76 */
/* bench 14601.0.0 bca64d954d79 */
/* bench 14601.0.1 94e3da60cc0e */
/* bench 14601.0.2 15af4ea7b699 */
/* bench 14601.0.3 ad4e510e179f */
/* bench 14601.0.4 f01c6b3a80a0 */
/* bench 14601.0.5 93f173bebff1 */
/* bench 14601.0.6 08c9abd42f04 */
/* bench 14601.0.7 dc8e5979f31c */
/* bench 14601.0.8 00fbc926c8e3 */
/* bench 14601.0.9 0f0215738589 */
/* bench 14601.0.10 b1a085e66092 */
	compatible = "inside-secure,safexcel-eip76";
	reg = <0xf2760000 0x7d>;
	interrupts = <GIC_SPI 59 IRQ_TYPE_LEVEL_HIGH>;
	clocks = <&cpm_syscon0 1 25>;
};
```

## Documentation/devicetree/bindings/rng/qcom,prng.txt
```
FASTVC-BENCH-CORPUS:linux-main-100k-v1-e0bd41dc-8e12-4f1b-978d-a3645ae59da0
Qualcomm MSM pseudo random number generator.

Required properties:

- compatible  : should be "qcom,prng"
- reg         : specifies base physical address and size of the registers map
- clocks      : phandle to clock-controller plus clock-specifier pair
- clock-names : "core" clocks all registers, FIFO and circuits in PRNG IP block

Example:

	rng@f9bff000 {
		compatible = "qcom,prng";
		reg = <0xf9bff000 0x200>;
		clocks = <&clock GCC_PRNG_AHB_CLK>;
		clock-names = "core";
	};
```
