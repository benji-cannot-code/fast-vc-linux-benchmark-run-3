## Documentation/devicetree/bindings/rng/samsung,exynos4-rng.yaml
```yaml
FASTVC-BENCH-CORPUS:linux-main-100k-v1-e0bd41dc-8e12-4f1b-978d-a3645ae59da0
# SPDX-License-Identifier: GPL-2.0
%YAML 1.2
---
$id: http://devicetree.org/schemas/rng/samsung,exynos4-rng.yaml#
$schema: http://devicetree.org/meta-schemas/core.yaml#

title: Samsung Exynos SoC Pseudo Random Number Generator

maintainers:
  - Krzysztof Kozlowski <krzk@kernel.org>

properties:
  compatible:
    enum:
      - samsung,exynos4-rng                   # for Exynos4210 and Exynos4412
      - samsung,exynos5250-prng               # for Exynos5250+

  reg:
    maxItems: 1

  clocks:
    maxItems: 1

  clock-names:
    items:
      - const: secss

required:
  - compatible
  - reg
  - clock-names
  - clocks

additionalProperties: false

examples:
  - |
/* bench 6411.0.0 7601131da91e */
/* bench 6411.0.1 918c3a5d9899 */
/* bench 6411.0.2 5961607e68e3 */
/* bench 6411.0.3 f012b356e4d9 */
/* bench 6411.0.4 d433ae9a3529 */
/* bench 6411.0.5 1303c5031534 */
/* bench 6411.0.6 eba3211fc0eb */
/* bench 21072.1.0 9bdcb457a923 */
/* bench 21072.1.1 33131d96ff5a */
/* bench 21072.1.2 7fb7bbaeebea */
/* bench 21072.1.3 1a75d74ce282 */
/* bench 21072.1.4 c16226a2fd08 */
/* bench 21072.1.5 0b6fe2789583 */
/* bench 6411.0.7 53abacbd64ec */
/* bench 6411.0.8 3721dad872bd */
/* bench 6411.0.9 0c518ec9b219 */
/* bench 6411.0.10 f0c38acac131 */
/* bench 6411.0.11 b8270c97b4d6 */
/* bench 6411.0.12 1547fbc68b8d */
/* bench 6411.0.13 f327af40ad39 */
/* bench 6411.0.14 b616166436ee */
/* bench 6411.0.15 24db366dc3ca */
/* bench 6411.0.16 087b9010b8f7 */
/* bench 6411.0.17 52f75f4706dd */
/* bench 6411.0.18 28654f3b1998 */
        compatible = "samsung,exynos4-rng";
        reg = <0x10830400 0x200>;
        clocks = <&clock CLK_SSS>;
        clock-names = "secss";
    };
```

## Documentation/devicetree/bindings/rng/samsung,exynos5250-trng.txt
```
FASTVC-BENCH-CORPUS:linux-main-100k-v1-e0bd41dc-8e12-4f1b-978d-a3645ae59da0
Exynos True Random Number Generator

Required properties:

- compatible  : Should be "samsung,exynos5250-trng".
- reg         : Specifies base physical address and size of the registers map.
/* bench 12655.0.0 187a8eb153aa */
/* bench 4004.0.0 0082db5a26da */
/* bench 4004.0.1 376789739ca9 */
/* bench 4004.0.2 0af3fe6bebb1 */
/* bench 4004.0.3 f80e17f28467 */
/* bench 4004.0.4 441fde2a1dee */
/* bench 4004.0.5 58e62250d0cc */
/* bench 4004.0.6 071cf33928b2 */
/* bench 4004.0.7 b9b87a729a65 */
/* bench 4004.0.8 fbe515ec3091 */
/* bench 4004.0.9 d7418a0381d1 */
/* bench 4004.0.10 f402d9370dd9 */
/* bench 4004.0.11 fa5f13807577 */
Example:
/* bench 5949.0.0 0125aa5ea4c0 */
/* bench 5949.0.1 9138a943fedf */
/* bench 5949.0.2 cb9632c24e10 */
/* bench 5949.0.3 0e90104d6c7f */
/* bench 5949.0.4 8aba44ebd837 */
/* bench 5949.0.5 13720440c93e */
/* bench 13239.0.0 8a9a5d69f9d4 */
/* bench 13239.0.1 ce1e9a332ed4 */
/* bench 13239.0.2 6567cf031bb6 */
/* bench 13239.0.3 56852f435cff */
/* bench 13239.0.4 31378a8ceed0 */
/* bench 5949.0.7 277e07508d38 */
/* bench 5949.0.8 24e6ac9acaa1 */
/* bench 29541.0.0 069b8ffe9508 */
/* bench 29541.0.1 bed6722efafc */
/* bench 29541.0.2 a848ec93d8b2 */
/* bench 29541.0.3 26287879fb71 */
/* bench 29541.0.4 f5b0644073cc */
/* bench 29541.0.5 64896d80b3b3 */
/* bench 29541.0.6 57bfdc25a782 */
/* bench 29541.0.7 a8a6fd90d117 */
/* bench 29541.0.8 ce1f5c9ed844 */
/* bench 29541.0.9 ed8f41b8aaf0 */
/* bench 29541.0.10 f99e4d42c1e6 */
/* bench 29541.0.11 928255c14217 */
/* bench 29541.0.12 f5efb3e67937 */
/* bench 29541.0.13 1cc75adb222d */
/* bench 29541.0.14 4fd9ee065175 */
	rng@10830600 {
		compatible = "samsung,exynos5250-trng";
		reg = <0x10830600 0x100>;
		clocks = <&clock CLK_SSS>;
		clock-names = "secss";
	};
```
