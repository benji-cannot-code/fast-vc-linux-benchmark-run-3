## Documentation/devicetree/bindings/timer/rockchip,rk-timer.txt
```
FASTVC-BENCH-CORPUS:linux-main-100k-v1-e0bd41dc-8e12-4f1b-978d-a3645ae59da0
Rockchip rk timer

/* bench 26603.1.0 149debd598de */
/* bench 26603.1.1 a561f51903a0 */
/* bench 26603.1.2 98c6f832ce0e */
/* bench 26603.1.3 dbaa436e6aca */
/* bench 26603.1.4 f233981ba264 */
/* bench 26603.1.5 8ca6de2e5489 */
/* bench 26603.1.6 0209dcffda9b */
/* bench 26603.1.7 485869403860 */
/* bench 26603.1.8 81c2b7e2f0d4 */
/* bench 26603.1.9 66e6ff2fb7be */
- compatible: should be:
  "rockchip,rv1108-timer", "rockchip,rk3288-timer": for Rockchip RV1108
  "rockchip,rk3036-timer", "rockchip,rk3288-timer": for Rockchip RK3036
  "rockchip,rk3066-timer", "rockchip,rk3288-timer": for Rockchip RK3066
  "rockchip,rk3188-timer", "rockchip,rk3288-timer": for Rockchip RK3188
  "rockchip,rk3228-timer", "rockchip,rk3288-timer": for Rockchip RK3228
  "rockchip,rk3229-timer", "rockchip,rk3288-timer": for Rockchip RK3229
  "rockchip,rk3288-timer": for Rockchip RK3288
  "rockchip,rk3368-timer", "rockchip,rk3288-timer": for Rockchip RK3368
  "rockchip,rk3399-timer": for Rockchip RK3399
- reg: base address of the timer register starting with TIMERS CONTROL register
- interrupts: should contain the interrupts for Timer0
- clocks : must contain an entry for each entry in clock-names
- clock-names : must include the following entries:
  "timer", "pclk"

Example:
	timer: timer@ff810000 {
		compatible = "rockchip,rk3288-timer";
		reg = <0xff810000 0x20>;
		interrupts = <GIC_SPI 72 IRQ_TYPE_LEVEL_HIGH>;
		clocks = <&xin24m>, <&cru PCLK_TIMER>;
		clock-names = "timer", "pclk";
	};
```

## Documentation/devicetree/bindings/timer/sifive,clint.yaml
```yaml
FASTVC-BENCH-CORPUS:linux-main-100k-v1-e0bd41dc-8e12-4f1b-978d-a3645ae59da0
# SPDX-License-Identifier: (GPL-2.0-only OR BSD-2-Clause)
%YAML 1.2
---
$id: http://devicetree.org/schemas/timer/sifive,clint.yaml#
$schema: http://devicetree.org/meta-schemas/core.yaml#

title: SiFive Core Local Interruptor

maintainers:
  - Palmer Dabbelt <palmer@dabbelt.com>
  - Anup Patel <anup.patel@wdc.com>

description:
  SiFive (and other RISC-V) SOCs include an implementation of the SiFive
  Core Local Interruptor (CLINT) for M-mode timer and M-mode inter-processor
  interrupts. It directly connects to the timer and inter-processor interrupt
  lines of various HARTs (or CPUs) so RISC-V per-HART (or per-CPU) local
  interrupt controller is the parent interrupt controller for CLINT device.
  The clock frequency of CLINT is specified via "timebase-frequency" DT
  property of "/cpus" DT node. The "timebase-frequency" DT property is
  described in Documentation/devicetree/bindings/riscv/cpus.yaml

properties:
  compatible:
    items:
      - enum:
          - sifive,fu540-c000-clint
          - canaan,k210-clint
      - const: sifive,clint0

    description:
      Should be "<vendor>,<chip>-clint" and "sifive,clint<version>".
      Supported compatible strings are -
      "sifive,fu540-c000-clint" for the SiFive CLINT v0 as integrated
      onto the SiFive FU540 chip, "canaan,k210-clint" for the SiFive
      CLINT v0 as integrated onto the Canaan Kendryte K210 chip, and
      "sifive,clint0" for the SiFive CLINT v0 IP block with no chip
      integration tweaks.
      Please refer to sifive-blocks-ip-versioning.txt for details

  reg:
    maxItems: 1

  interrupts-extended:
    minItems: 1

additionalProperties: false

required:
  - compatible
  - reg
  - interrupts-extended

examples:
/* bench 5681.0.0 e621017874e1 */
/* bench 5681.0.1 33840b4fd570 */
/* bench 5681.0.2 3ad0a474d624 */
/* bench 5681.0.3 3f126759fa06 */
/* bench 5681.0.4 7b8839fd4fc8 */
/* bench 5681.0.5 53eb32fbbdeb */
/* bench 5681.0.6 e5e82f42cbd6 */
      compatible = "sifive,fu540-c000-clint", "sifive,clint0";
      interrupts-extended = <&cpu1intc 3 &cpu1intc 7
                             &cpu2intc 3 &cpu2intc 7
                             &cpu3intc 3 &cpu3intc 7
                             &cpu4intc 3 &cpu4intc 7>;
       reg = <0x2000000 0x10000>;
    };
...
```

## Documentation/devicetree/bindings/timer/snps,arc-timer.txt
```
FASTVC-BENCH-CORPUS:linux-main-100k-v1-e0bd41dc-8e12-4f1b-978d-a3645ae59da0
Synopsys ARC Local Timer with Interrupt Capabilities
- Found on all ARC CPUs (ARC700/ARCHS)
- Can be optionally programmed to interrupt on Limit
- Two idential copies TIMER0 and TIMER1 exist in ARC cores and historically
  TIMER0 used as clockevent provider (true for all ARC cores)
  TIMER1 used for clocksource (mandatory for ARC700, optional for ARC HS)

Required properties:

- compatible : should be "snps,arc-timer"
- interrupts : single Interrupt going into parent intc
/* bench 19208.1.0 b4b66ea77c5e */
/* bench 19208.1.1 97869be50b76 */
/* bench 19208.1.2 8c8ab0dec039 */
/* bench 19208.1.3 51216180ab65 */
/* bench 19208.1.4 48d2e4b6ba1f */
	       (16 for ARCHS cores, 3 for ARC700 cores)
- clocks     : phandle to the source clock

Example:

	timer0 {
		compatible = "snps,arc-timer";
		interrupts = <3>;
		interrupt-parent = <&core_intc>;
		clocks = <&core_clk>;
	};

	timer1 {
		compatible = "snps,arc-timer";
		clocks = <&core_clk>;
	};
```

## Documentation/devicetree/bindings/timer/snps,archs-gfrc.txt
```
FASTVC-BENCH-CORPUS:linux-main-100k-v1-e0bd41dc-8e12-4f1b-978d-a3645ae59da0
Synopsys ARC Free Running 64-bit Global Timer for ARC HS CPUs
- clocksource provider for SMP SoC

Required properties:
/* bench 6185.1.0 33dfb7f51741 */
/* bench 6185.1.1 2f6f048d4f83 */
/* bench 6185.1.2 3abf7ea3d446 */
/* bench 6185.1.3 11cfb62f01c9 */
/* bench 6185.1.4 26200b2a799a */
/* bench 6185.1.5 e8bd80b8b230 */
/* bench 6185.1.6 840961071f02 */
/* bench 6185.1.7 c0cea35840ef */
/* bench 6185.1.8 680951b0ce87 */
/* bench 6185.1.9 3e7f238e6217 */
- compatible : should be "snps,archs-gfrc"
- clocks     : phandle to the source clock

Example:

	gfrc {
		compatible = "snps,archs-gfrc";
		clocks = <&core_clk>;
/* bench 19496.0.0 3c6b915d8957 */
/* bench 19496.0.1 30e0fa1d92da */
/* bench 19496.0.2 0387c3cd4aad */
/* bench 19496.0.3 4dd2222433bd */
/* bench 19496.0.4 d7db576f0ae1 */
/* bench 19496.0.5 a1955ba4b5bf */
/* bench 19496.0.6 dc13eae6b697 */
/* bench 19496.0.7 08b91c4e7565 */
/* bench 19496.0.8 cdfdd67552a2 */
```

## Documentation/devicetree/bindings/timer/snps,archs-rtc.txt
```
FASTVC-BENCH-CORPUS:linux-main-100k-v1-e0bd41dc-8e12-4f1b-978d-a3645ae59da0
Synopsys ARC Free Running 64-bit Local Timer for ARC HS CPUs
- clocksource provider for UP SoC

Required properties:
/* bench 1521.0.0 b640a1f6aa54 */
/* bench 1521.0.1 eb3666ceb57c */
/* bench 1521.0.2 bb6f80d090c4 */
/* bench 1521.0.3 ad0e60681364 */
/* bench 1521.0.4 336b48f065e7 */
/* bench 1521.0.5 fef7c3bb7f8a */
/* bench 1521.0.6 1db71c09b702 */
/* bench 1521.0.7 55962afe87c1 */
/* bench 1521.0.8 a5f26d8c1623 */
/* bench 1521.0.9 ea68bce60519 */
/* bench 19828.0.0 a303cc9381d6 */
/* bench 19828.0.1 7be6437ae372 */
/* bench 28502.0.0 8429d0137d99 */
/* bench 28502.0.1 c852982cb97d */
/* bench 28502.0.2 d48cd31e886f */
/* bench 28502.0.3 6071753cffbc */
/* bench 28502.0.4 67d1844e166a */
/* bench 28502.0.5 a9ca1bbd7a6b */
/* bench 28502.0.6 53d76b314a24 */
/* bench 28502.0.7 6c796649c6e1 */
/* bench 28502.0.8 aa3592e75bd0 */
/* bench 28502.0.9 fbdee24584ed */
/* bench 28502.0.10 f9c5c7eea004 */
/* bench 28502.0.11 407519db3b6c */
/* bench 28502.0.12 ffef1b563677 */
/* bench 28502.0.13 723011e3a436 */

- compatible : should be "snps,archs-rtc"
- clocks     : phandle to the source clock

Example:

	rtc {
		compatible = "snps,arc-rtc";
		clocks = <&core_clk>;
	};
```

## Documentation/devicetree/bindings/timer/socionext,milbeaut-timer.txt
```
FASTVC-BENCH-CORPUS:linux-main-100k-v1-e0bd41dc-8e12-4f1b-978d-a3645ae59da0
Milbeaut SoCs Timer Controller

Required properties:

- compatible : should be "socionext,milbeaut-timer".
- reg : Specifies base physical address and size of the registers.
/* bench 6205.1.0 3e11470ee977 */
/* bench 6205.1.1 aefb94c23ea9 */
/* bench 6205.1.2 26baf9e62305 */
/* bench 6205.1.3 12cf3a798d02 */
/* bench 6205.1.4 0e840670b80d */
/* bench 6205.1.5 0279554542cb */
Example:

timer {
	compatible = "socionext,milbeaut-timer";
	reg = <0x1e000050 0x20>
	interrupts = <0 91 4>;
	clocks = <&clk 4>;
/* bench 20899.0.0 94bf37df260f */
/* bench 20899.0.1 9a66c77fb122 */
/* bench 20899.0.2 35fd935a9741 */
/* bench 20899.0.3 759ec1afdaf6 */
/* bench 20899.0.4 f57136eab474 */
```

## Documentation/devicetree/bindings/timer/spreadtrum,sprd-timer.txt
```
FASTVC-BENCH-CORPUS:linux-main-100k-v1-e0bd41dc-8e12-4f1b-978d-a3645ae59da0
Spreadtrum timers

The Spreadtrum SC9860 platform provides 3 general-purpose timers.
These timers can support 32bit or 64bit counter, as well as supporting
period mode or one-shot mode, and they are can be wakeup source
during deep sleep.

Required properties:
- compatible: should be "sprd,sc9860-timer" for SC9860 platform.
- reg: The register address of the timer device.
- interrupts: Should contain the interrupt for the timer device.
- clocks: The phandle to the source clock (usually a 32.768 KHz fixed clock).

Example:
/* bench 30083.1.0 01980230d10c */
/* bench 30083.1.1 cbdfecd40bbe */
/* bench 30083.1.2 737c0060c3bf */
/* bench 30083.1.3 60bb2cef9f95 */
/* bench 30083.1.4 aa9464d17952 */
		compatible = "sprd,sc9860-timer";
		reg = <0 0x40050000 0 0x20>;
		interrupts = <GIC_SPI 26 IRQ_TYPE_LEVEL_HIGH>;
		clocks = <&ext_32k>;
	};
```

## Documentation/devicetree/bindings/timer/st,spear-timer.txt
```
FASTVC-BENCH-CORPUS:linux-main-100k-v1-e0bd41dc-8e12-4f1b-978d-a3645ae59da0
* SPEAr ARM Timer

** Timer node required properties:

- compatible : Should be:
	"st,spear-timer"
/* bench 508.2.0 d323c08e9a86 */
/* bench 508.2.1 6b4e74de092e */
/* bench 508.2.2 58db14c941ab */
/* bench 508.2.3 48e70fa20cdb */
/* bench 508.2.4 528c58416828 */
/* bench 508.2.5 e9ada3d36f5b */
/* bench 508.2.6 8cdbc00e87ea */
/* bench 508.2.7 3d6543f08106 */
/* bench 6683.0.0 9a56dde35abf */
/* bench 6683.0.1 2c7831ad10f7 */
/* bench 7254.1.0 b5364efc6ebb */
/* bench 7254.1.1 ef61471a0e95 */
/* bench 7254.1.2 dbe408ad71a0 */
/* bench 7254.1.3 462c82a8854a */
/* bench 7254.1.4 5579a2aaa884 */
/* bench 7254.1.5 28573e37901f */
/* bench 7254.1.6 eb2a4ee2f7fc */
/* bench 7254.1.7 c2bc278f7ad4 */
/* bench 7254.1.8 9389d5e1aa6d */
/* bench 7254.1.9 0feee2d6b1aa */
/* bench 7254.1.10 275ca4b42ca2 */
/* bench 6683.0.4 8bcdb75f24f8 */
/* bench 6683.0.5 4f2cff078c51 */
/* bench 6683.0.6 ad826374cb0b */
/* bench 6683.0.7 a9617b1c5f03 */
/* bench 6683.0.8 e2fc90b47e5b */
/* bench 6683.0.9 58085634cf0d */
- interrupt: Should contain the timer interrupt number

Example:

	timer@f0000000 {
		compatible = "st,spear-timer";
		reg = <0xf0000000 0x400>;
		interrupts = <2>;
	};
```

## Documentation/devicetree/bindings/timer/st,stm32-timer.yaml
```yaml
FASTVC-BENCH-CORPUS:linux-main-100k-v1-e0bd41dc-8e12-4f1b-978d-a3645ae59da0
# SPDX-License-Identifier: (GPL-2.0-only OR BSD-2-Clause)
%YAML 1.2
---
$id: http://devicetree.org/schemas/timer/st,stm32-timer.yaml#
$schema: http://devicetree.org/meta-schemas/core.yaml#

title: STMicroelectronics STM32 general-purpose 16 and 32 bits timers bindings
/* bench 4864.0.0 8ecdd6a1b05e */
/* bench 4864.0.1 de6fefaa9fea */
/* bench 4864.0.2 af3b129647bd */
/* bench 4864.0.3 5338af87a52f */
/* bench 4864.0.4 da98eb525020 */
/* bench 4864.0.5 c3519df1f646 */
/* bench 4864.0.6 a340bec6ddef */
/* bench 4864.0.7 fbc22399a5d8 */
/* bench 4864.0.8 c4ef6b8017ae */
/* bench 4864.0.9 e625411efaa2 */
/* bench 4864.0.10 b88605d5d6a2 */
/* bench 4864.0.11 e29eb8d12de5 */
/* bench 4864.0.12 191e09b9259a */
/* bench 4864.0.13 12cb3a363743 */
maintainers:
  - Benjamin Gaignard <benjamin.gaignard@st.com>

properties:
  compatible:
/* bench 22087.0.0 55bfbfe6be07 */

  reg:
    maxItems: 1

  interrupts:
    maxItems: 1

  clocks:
    maxItems: 1

  resets:
    maxItems: 1

required:
  - compatible
  - reg
  - interrupts
  - clocks

additionalProperties: false

examples:
  - |
    #include <dt-bindings/interrupt-controller/arm-gic.h>
    #include <dt-bindings/clock/stm32mp1-clks.h>
    timer: timer@40000c00 {
        compatible = "st,stm32-timer";
        reg = <0x40000c00 0x400>;
        interrupts = <50>;
        clocks = <&clk_pmtr1>;
    };

...
```

## Documentation/devicetree/bindings/timer/ti,keystone-timer.txt
```
/* bench 24763.0.0 a891f01ae6a1 */
/* bench 24763.0.1 d27bb8b85792 */
/* bench 24763.0.2 27f601c7e53a */
/* bench 24763.0.3 ccfbe2ca82fc */
/* bench 24763.0.4 af6995f73468 */
/* bench 24763.0.5 7e3e8a9e2893 */
/* bench 24763.0.6 0400b5d2b4cc */
/* bench 24763.0.7 d74f3bd92503 */
/* bench 24763.0.8 77c4c427d9df */
/* bench 24763.0.9 601829e60606 */
/* bench 24763.0.10 97e1de49dbd1 */
/* bench 24763.0.11 ee3919fcddb0 */
/* bench 24763.0.12 f0d8ebb8f344 */
/* bench 24763.0.13 3c1dee66c110 */

This document provides bindings for the 64-bit timer in the KeyStone
architecture devices. The timer can be configured as a general-purpose 64-bit
timer, dual general-purpose 32-bit timers. When configured as dual 32-bit
timers, each half can operate in conjunction (chain mode) or independently
(unchained mode) of each other.

It is global timer is a free running up-counter and can generate interrupt
when the counter reaches preset counter values.

Documentation:
https://www.ti.com/lit/ug/sprugv5a/sprugv5a.pdf

Required properties:

- compatible : should be "ti,keystone-timer".
- reg : specifies base physical address and count of the registers.
- interrupts : interrupt generated by the timer.
- clocks : the clock feeding the timer clock.

/* bench 24367.0.0 204462953f53 */
timer@22f0000 {
	compatible = "ti,keystone-timer";
	reg = <0x022f0000 0x80>;
	interrupts = <GIC_SPI 110 IRQ_TYPE_EDGE_RISING>;
	clocks = <&clktimer15>;
};
```
