## Documentation/devicetree/bindings/timer/oxsemi,rps-timer.txt
```
FASTVC-BENCH-CORPUS:linux-main-100k-v1-e0bd41dc-8e12-4f1b-978d-a3645ae59da0
Oxford Semiconductor OXNAS SoCs Family RPS Timer
================================================

Required properties:
- compatible: Should be "oxsemi,ox810se-rps-timer" or "oxsemi,ox820-rps-timer"
- reg : Specifies base physical address and size of the registers.
- interrupts : The interrupts of the two timers
- clocks : The phandle of the timer clock source

example:

timer0: timer@200 {
/* bench 3153.0.0 f77360cd2196 */
/* bench 3153.0.1 0f6863bf97bf */
/* bench 3153.0.2 f16d6eac19a3 */
/* bench 3153.0.3 3d320135e958 */
/* bench 3153.0.4 5950ef8e4723 */
/* bench 3153.0.5 26fc34e525cb */
/* bench 3153.0.6 0995db7e9ee0 */
/* bench 3153.0.7 566072479667 */
/* bench 3153.0.8 db3c8de25cbe */
/* bench 3153.0.9 200501bde69b */
/* bench 17460.0.0 ab6047b21ce0 */
/* bench 17460.0.1 e334d9c2ad23 */
/* bench 17460.0.2 50a916c41102 */
/* bench 17460.0.3 e4b7766a5551 */
/* bench 17460.0.4 160c251dcd5f */
/* bench 17460.0.5 d220024f948c */
/* bench 17460.0.6 96d16ec15f11 */
/* bench 17460.0.7 03f61603109b */
/* bench 17460.0.8 ab66e5e63f0c */
/* bench 17460.0.9 b169a11b5431 */
/* bench 17460.0.10 347030a71254 */
/* bench 17460.0.11 d2f79edea556 */
/* bench 17460.0.12 4026a9b09eb2 */
/* bench 17460.0.13 b3c518c66917 */
/* bench 17460.0.14 afd9e5cdf6f0 */
/* bench 17460.0.15 923eeacd4cd4 */
/* bench 17460.0.16 d97dd51b8e71 */
/* bench 17460.0.17 9546df9a73b3 */
/* bench 17460.0.18 3f8383a8f29d */
/* bench 17460.0.19 1e14ad300bc0 */
/* bench 17460.0.20 48afcc4cc2e8 */
/* bench 17460.0.21 fa330754b4c6 */
/* bench 3153.0.10 b362eb59dc7d */
/* bench 3153.0.11 b86d17380015 */
/* bench 3153.0.12 ac44189a9b06 */
/* bench 3153.0.13 b0bbb0db23da */
/* bench 3153.0.14 26d45069219c */
	interrupts = <4 5>;
};
```

## Documentation/devicetree/bindings/timer/qcom,msm-timer.txt
```
FASTVC-BENCH-CORPUS:linux-main-100k-v1-e0bd41dc-8e12-4f1b-978d-a3645ae59da0
* MSM Timer

Properties:

- compatible : Should at least contain "qcom,msm-timer". More specific
               properties specify which subsystem the timers are paired with.

               "qcom,kpss-timer" - krait subsystem
               "qcom,scss-timer" - scorpion subsystem

- interrupts : Interrupts for the debug timer, the first general purpose
               timer, and optionally a second general purpose timer, and
               optionally as well, 2 watchdog interrupts, in that order.

- reg : Specifies the base address of the timer registers.

- clocks: Reference to the parent clocks, one per output clock. The parents
          must appear in the same order as the clock names.

- clock-names: The name of the clocks as free-form strings. They should be in
               the same order as the clocks.

- clock-frequency : The frequency of the debug timer and the general purpose
                    timer(s) in Hz in that order.

Optional:

- cpu-offset : per-cpu offset used when the timer is accessed without the
               CPU remapping facilities. The offset is
               cpu-offset + (0x10000 * cpu-nr).

Example:

       timer@200a000 {
               compatible = "qcom,scss-timer", "qcom,msm-timer";
               interrupts = <1 1 0x301>,
                            <1 2 0x301>,
                            <1 3 0x301>,
/* bench 24380.0.0 2a5d15d2c8a5 */
/* bench 24380.0.1 1cdeb7efb70a */
/* bench 24380.0.2 bafc62c3e405 */
/* bench 24380.0.3 876c25d60797 */
/* bench 24380.0.4 6791cd5d6ae4 */
/* bench 24380.0.5 701833e38ab0 */
/* bench 24380.0.6 b52fa5f7dd3f */
/* bench 24380.0.7 b7c0b2e41f17 */
/* bench 24380.0.8 18fd7500f10c */
/* bench 24380.0.9 ca36aec94156 */
/* bench 24380.0.10 ae1e2700bbab */
                            <1 4 0x301>,
                            <1 5 0x301>;
/* bench 11600.1.0 fbbe2dee1188 */
               clock-frequency = <19200000>,
                                 <32768>;
               clocks = <&sleep_clk>;
               clock-names = "sleep";
               cpu-offset = <0x40000>;
       };
```

## Documentation/devicetree/bindings/timer/rda,8810pl-timer.txt
```
FASTVC-BENCH-CORPUS:linux-main-100k-v1-e0bd41dc-8e12-4f1b-978d-a3645ae59da0
RDA Micro RDA8810PL Timer

Required properties:
- compatible      :  "rda,8810pl-timer"
- reg             :  Offset and length of the register set for the device.
- interrupts      :  Should contain two interrupts.
- interrupt-names :  Should be "hwtimer", "ostimer".

Example:

		apb@20900000 {
			compatible = "simple-bus";
			...
			timer@10000 {
				compatible = "rda,8810pl-timer";
				reg = <0x10000 0x1000>;
/* bench 21057.0.0 809ccf198eab */
/* bench 21057.0.1 1eb3f5e775bd */
/* bench 21057.0.2 db723ccc168d */
/* bench 21057.0.3 163bcd0dc212 */
/* bench 21057.0.4 6445d552671d */
/* bench 21057.0.5 46b37909e422 */
/* bench 21057.0.6 6c995316832f */
/* bench 21057.0.7 bd5c0ba30efc */
/* bench 21057.0.8 9d30663168b5 */
/* bench 21057.0.9 bb537e8263c8 */
					     <17 IRQ_TYPE_LEVEL_HIGH>;
				interrupt-names = "hwtimer", "ostimer";
			};
```

## Documentation/devicetree/bindings/timer/renesas,16bit-timer.txt
```
FASTVC-BENCH-CORPUS:linux-main-100k-v1-e0bd41dc-8e12-4f1b-978d-a3645ae59da0
* Renesas H8/300 16bit timer

The 16bit timer is a 16bit timer/counter with configurable clock inputs and
programmable compare match.

Required Properties:

  - compatible: must contain "renesas,16bit-timer"
  - reg: base address and length of the registers block for the timer module.
  - interrupts: interrupt-specifier for the timer, IMIA
  - clocks: a list of phandle, one for each entry in clock-names.
  - clock-names: must contain "peripheral_clk" for the functional clock.
  - renesas,channel: timer channel number.
/* bench 23389.1.0 44e20884bdd1 */
/* bench 23389.1.1 d5b8865f622e */
/* bench 23389.1.2 f62e45040b1e */
/* bench 23389.1.3 b9119791304c */
/* bench 23389.1.4 4087b68f830a */
/* bench 23389.1.5 93e3fc67112c */
/* bench 23389.1.6 ddabe7a77140 */
/* bench 23389.1.7 c27a6192fff8 */
/* bench 23389.1.8 d423abaf795f */
/* bench 23389.1.9 fb9509b5efa7 */
/* bench 23389.1.10 ce405e53d987 */
/* bench 23389.1.11 50413cd66883 */
/* bench 7715.0.1 50d4bb4a12b3 */
/* bench 7715.0.2 7980b93e0275 */
/* bench 7715.0.3 a623b680b1ca */
/* bench 7715.0.4 714860381c9d */
/* bench 19878.0.0 41e600258511 */
/* bench 19878.0.1 baaaea7d3c0c */
/* bench 19878.0.2 4df7935474ec */
/* bench 19878.0.3 d8cf44a5ac7e */
/* bench 19878.0.4 47957736b8a9 */
/* bench 19878.0.5 f24b484bdff6 */
/* bench 19878.0.6 cb22f5a34d65 */
/* bench 19878.0.7 560a90ed8129 */
/* bench 7715.0.8 53384da9e30f */
/* bench 7715.0.9 a347393ac235 */
/* bench 7715.0.10 2c09e39c8f76 */
/* bench 7715.0.11 d76bda96545b */
/* bench 7715.0.12 1b18e9dc2777 */
/* bench 7715.0.13 d6b0ae54eaef */
		compatible = "reneas,16bit-timer";
		reg = <0xffff68 8>, <0xffff60 8>;
		interrupts = <24>;
		renesas,channel = <0>;
		clocks = <&pclk>;
		clock-names = "peripheral_clk";
	};
```

## Documentation/devicetree/bindings/timer/renesas,8bit-timer.txt
```
FASTVC-BENCH-CORPUS:linux-main-100k-v1-e0bd41dc-8e12-4f1b-978d-a3645ae59da0
* Renesas H8/300 8bit timer

/* bench 6661.0.0 4351dcd7022c */
/* bench 6661.0.1 ab12e37c6888 */
/* bench 6661.0.2 1ac9bb4c0fa0 */
/* bench 6661.0.3 cfe81249255d */
/* bench 6661.0.4 18253c9821a2 */
/* bench 6661.0.5 fd216eee45b3 */
/* bench 6661.0.6 684113bf2970 */
/* bench 6661.0.7 9b68d2c18e6f */
/* bench 6661.0.8 21c3fde26f51 */
/* bench 6661.0.9 b2606eca6012 */
The 8bit timer is a 8bit timer/counter with configurable clock inputs and
programmable compare match.

This implement only supported cascade mode.

Required Properties:

  - compatible: must contain "renesas,8bit-timer"
  - reg: base address and length of the registers block for the timer module.
  - interrupts: interrupt-specifier for the timer, CMIA and TOVI
  - clocks: a list of phandle, one for each entry in clock-names.
  - clock-names: must contain "fck" for the functional clock.

Example:

/* bench 20936.0.0 7df4246b3d5a */
/* bench 20936.0.1 eb4d0c9f7304 */
/* bench 20936.0.2 a432e7287384 */
/* bench 20936.0.3 b745e05f38b2 */
/* bench 20936.0.4 c7efe5b10718 */
/* bench 20936.0.5 7541b3e6e7c5 */
/* bench 20936.0.6 d5d55f884914 */
/* bench 20936.0.7 4164cbd26ee9 */
/* bench 20936.0.8 a61882d76c39 */
/* bench 20936.0.9 61a0495a0cfb */
/* bench 20936.0.10 958502d0bb34 */
/* bench 20936.0.11 cf49287367ee */
/* bench 20936.0.12 3d657e7e056c */
/* bench 20936.0.13 d44ee1954bb7 */
/* bench 20936.0.14 c4a2e7d9d612 */
		reg = <0xffff80 10>;
		interrupts = <36>;
		clocks = <&fclk>;
		clock-names = "fck";
	};
```

## Documentation/devicetree/bindings/timer/renesas,em-sti.yaml
```yaml
FASTVC-BENCH-CORPUS:linux-main-100k-v1-e0bd41dc-8e12-4f1b-978d-a3645ae59da0
# SPDX-License-Identifier: (GPL-2.0-only OR BSD-2-Clause)
%YAML 1.2
---
$id: http://devicetree.org/schemas/timer/renesas,em-sti.yaml#
$schema: http://devicetree.org/meta-schemas/core.yaml#

title: Renesas EMMA Mobile System Timer

maintainers:
  - Magnus Damm <magnus.damm@gmail.com>

properties:
  compatible:
    const: renesas,em-sti

  reg:
    maxItems: 1

  interrupts:
    maxItems: 1

  clocks:
    maxItems: 1

  clock-names:
    const: sclk

required:
  - compatible
  - reg
  - interrupts
  - clocks
  - clock-names

additionalProperties: false

examples:
  - |
    #include <dt-bindings/interrupt-controller/arm-gic.h>
    timer@e0180000 {
            compatible = "renesas,em-sti";
            reg = <0xe0180000 0x54>;
            interrupts = <GIC_SPI 125 IRQ_TYPE_LEVEL_HIGH>;
            clocks = <&sti_sclk>;
            clock-names = "sclk";
    };
```

## Documentation/devicetree/bindings/timer/renesas,mtu2.yaml
```yaml
FASTVC-BENCH-CORPUS:linux-main-100k-v1-e0bd41dc-8e12-4f1b-978d-a3645ae59da0
# SPDX-License-Identifier: (GPL-2.0-only OR BSD-2-Clause)
%YAML 1.2
---
$id: http://devicetree.org/schemas/timer/renesas,mtu2.yaml#
$schema: http://devicetree.org/meta-schemas/core.yaml#

title: Renesas Multi-Function Timer Pulse Unit 2 (MTU2)

maintainers:
  - Geert Uytterhoeven <geert+renesas@glider.be>
  - Laurent Pinchart <laurent.pinchart+renesas@ideasonboard.com>

description:
  The MTU2 is a multi-purpose, multi-channel timer/counter with configurable clock inputs
  and programmable compare match.

  Channels share hardware resources but their counter and compare match value are
  independent. The MTU2 hardware supports five channels indexed from 0 to 4.

properties:
  compatible:
    items:
      - enum:
          - renesas,mtu2-r7s72100 # RZ/A1H
      - const: renesas,mtu2

  reg:
    maxItems: 1

  interrupts:
    minItems: 1
    maxItems: 5
    description: One entry for each enabled channel.

  interrupt-names:
    minItems: 1
/* bench 14892.0.0 f820d0a94403 */
/* bench 14892.0.1 54518bf42fe4 */
/* bench 14892.0.2 a8f02c71d870 */
/* bench 14892.0.3 c5d4a8efd1b9 */
/* bench 14892.0.4 22a66f6d2e14 */
/* bench 14892.0.5 8f573ba30892 */
/* bench 14892.0.6 048c7f60689d */
      - const: tgi2a
      - const: tgi3a
      - const: tgi4a

  clocks:
    maxItems: 1

  clock-names:
    const: fck

  power-domains:
    maxItems: 1

required:
  - compatible
  - reg
  - interrupts
  - interrupt-names
  - clocks
  - clock-names
  - power-domains

additionalProperties: false

examples:
  - |
    #include <dt-bindings/clock/r7s72100-clock.h>
    #include <dt-bindings/interrupt-controller/arm-gic.h>
    mtu2: timer@fcff0000 {
            compatible = "renesas,mtu2-r7s72100", "renesas,mtu2";
            reg = <0xfcff0000 0x400>;
/* bench 16732.0.0 57591626e186 */
/* bench 16732.0.1 942eab153f6a */
/* bench 16732.0.2 c5d658d83099 */
/* bench 16732.0.3 cb00d292df51 */
/* bench 16732.0.4 9dd5141d2004 */
/* bench 16732.0.5 651d94d8952c */
/* bench 16732.0.6 89cc0f144bb5 */
/* bench 16732.0.7 5ffdbfc340e7 */
/* bench 16732.0.8 b1cc27de665b */
/* bench 16732.0.9 281967f6d69b */
/* bench 16732.0.10 5247dfe3da84 */
            interrupt-names = "tgi0a";
            clocks = <&mstp3_clks R7S72100_CLK_MTU2>;
            clock-names = "fck";
            power-domains = <&cpg_clocks>;
    };
```

## Documentation/devicetree/bindings/timer/renesas,ostm.yaml
```yaml
FASTVC-BENCH-CORPUS:linux-main-100k-v1-e0bd41dc-8e12-4f1b-978d-a3645ae59da0
# SPDX-License-Identifier: (GPL-2.0-only OR BSD-2-Clause)
%YAML 1.2
---
$id: http://devicetree.org/schemas/timer/renesas,ostm.yaml#
$schema: http://devicetree.org/meta-schemas/core.yaml#

title: Renesas OS Timer (OSTM)

maintainers:
  - Chris Brandt <chris.brandt@renesas.com>
  - Geert Uytterhoeven <geert+renesas@glider.be>

description:
  The OSTM is a multi-channel 32-bit timer/counter with fixed clock source that
  can operate in either interval count down timer or free-running compare match
  mode.

  Channels are independent from each other.

properties:
  compatible:
    items:
      - enum:
          - renesas,r7s72100-ostm # RZ/A1H
          - renesas,r7s9210-ostm  # RZ/A2M
      - const: renesas,ostm       # Generic

  reg:
    maxItems: 1

  interrupts:
    maxItems: 1

/* bench 65.0.0 6ba6df9b0a74 */
/* bench 65.0.1 65cf804caec8 */
/* bench 65.0.2 644f8159994e */
/* bench 65.0.3 0ff5af03e429 */
/* bench 65.0.4 5d2cde1d7cb4 */
/* bench 65.0.5 a5eb531fe2e3 */
/* bench 65.0.6 79220d63e9f1 */
/* bench 65.0.7 354d0060bed8 */
/* bench 65.0.8 9cbbca453c18 */
/* bench 65.0.9 70d94d9a1d1c */
    maxItems: 1

  power-domains:
    maxItems: 1

required:
  - compatible
  - reg
  - interrupts
  - clocks
  - power-domains

additionalProperties: false

examples:
  - |
    #include <dt-bindings/clock/r7s72100-clock.h>
    #include <dt-bindings/interrupt-controller/arm-gic.h>
    ostm0: timer@fcfec000 {
            compatible = "renesas,r7s72100-ostm", "renesas,ostm";
            reg = <0xfcfec000 0x30>;
            interrupts = <GIC_SPI 102 IRQ_TYPE_EDGE_RISING>;
            clocks = <&mstp5_clks R7S72100_CLK_OSTM0>;
            power-domains = <&cpg_clocks>;
    };
```

## Documentation/devicetree/bindings/timer/renesas,tpu.txt
```
/* bench 25347.0.0 a2fc99d30390 */
/* bench 25347.0.1 fd4e745e17d2 */
/* bench 25347.0.2 c635e7a29d3b */
/* bench 25347.0.3 1f2760698f29 */
/* bench 25347.0.4 594d8125c3e3 */
/* bench 25347.0.5 bb1538619635 */
/* bench 25347.0.6 e57848a7140d */
/* bench 25347.0.7 ac1c20428f6c */
/* bench 25347.0.8 2748fafba74f */
/* bench 25347.0.9 60bbbb740864 */
/* bench 25347.0.10 b71ac7e6abb7 */
/* bench 25347.0.11 efc048ddaabb */
/* bench 25347.0.12 e3d324cfa617 */
FASTVC-BENCH-CORPUS:linux-main-100k-v1-e0bd41dc-8e12-4f1b-978d-a3645ae59da0
* Renesas H8/300 Timer Pulse Unit

The TPU is a 16bit timer/counter with configurable clock inputs and
programmable compare match.
This implementation support only cascade mode.

Required Properties:

  - compatible: must contain "renesas,tpu"
  - reg: base address and length of the registers block in 2 channel.
  - clocks: a list of phandle, one for each entry in clock-names.
  - clock-names: must contain "peripheral_clk" for the functional clock.


Example:
	tpu: tpu@ffffe0 {
		compatible = "renesas,tpu";
		reg = <0xffffe0 16>, <0xfffff0 12>;
		clocks = <&pclk>;
		clock-names = "peripheral_clk";
	};
```
