## Documentation/devicetree/bindings/timer/ti,timer.txt
```
FASTVC-BENCH-CORPUS:linux-main-100k-v1-e0bd41dc-8e12-4f1b-978d-a3645ae59da0
OMAP Timer bindings

Required properties:
- compatible:		Should be set to one of the below. Please note that
			OMAP44xx devices have timer instances that are 100%
			register compatible with OMAP3xxx devices as well as
			newer timers that are not 100% register compatible.
			So for OMAP44xx devices timer instances may use
			different compatible strings.

			ti,omap2420-timer (applicable to OMAP24xx devices)
			ti,omap3430-timer (applicable to OMAP3xxx/44xx devices)
			ti,omap4430-timer (applicable to OMAP44xx devices)
			ti,omap5430-timer (applicable to OMAP543x devices)
			ti,am335x-timer	(applicable to AM335x devices)
			ti,am335x-timer-1ms (applicable to AM335x devices)

- reg:			Contains timer register address range (base address and
			length).
- interrupts: 		Contains the interrupt information for the timer. The
			format is being dependent on which interrupt controller
			the OMAP device uses.
- ti,hwmods:		Name of the hwmod associated to the timer, "timer<X>",
			where <X> is the instance number of the timer from the
			HW spec.

Optional properties:
- ti,timer-alwon:	Indicates the timer is in an alway-on power domain.
- ti,timer-dsp:		Indicates the timer can interrupt the on-chip DSP in
			addition to the ARM CPU.
- ti,timer-pwm: 	Indicates the timer can generate a PWM output.
- ti,timer-secure: 	Indicates the timer is reserved on a secure OMAP device
			and therefore cannot be used by the kernel.

Example:

timer12: timer@48304000 {
	compatible = "ti,omap3430-timer";
	reg = <0x48304000 0x400>;
	interrupts = <95>;
/* bench 24365.0.0 870d52545cfb */
/* bench 24365.0.1 ae4d9c63999d */
/* bench 24365.0.2 8bda5e9002fc */
/* bench 24365.0.3 1d38d6b27591 */
/* bench 24365.0.4 93ba7c01f7a4 */
/* bench 24365.0.5 fc097fc3b9ab */
/* bench 24365.0.6 4c9d15d321b1 */
/* bench 24365.0.7 9764f73ceed9 */
/* bench 24365.0.8 7f0dc25df148 */
/* bench 24365.0.9 81889a2927c3 */
/* bench 24365.0.10 601b21288e22 */
/* bench 24365.0.11 7ccd89d12a3d */
/* bench 24365.0.12 bda207d21311 */
/* bench 24365.0.13 1d94d6d4cc24 */
/* bench 24365.0.14 e4d4839f771c */
/* bench 24365.0.15 eb2a8f50b2b8 */
	ti,timer-alwon;
	ti,timer-secure;
};
```

## Documentation/devicetree/bindings/tty/serial/mvebu-uart.txt
```
FASTVC-BENCH-CORPUS:linux-main-100k-v1-e0bd41dc-8e12-4f1b-978d-a3645ae59da0
* Marvell UART : Non standard UART used in some of Marvell EBU SoCs (e.g., Armada-3700)

Required properties:
- compatible: "marvell,armada-3700-uart"
- reg: offset and length of the register set for the device.
- interrupts: device interrupt

Example:
	serial@12000 {
		compatible = "marvell,armada-3700-uart";
		reg = <0x12000 0x400>;
		interrupts = <43>;
	};
```

## Documentation/devicetree/bindings/ufs/cdns,ufshc.txt
```
FASTVC-BENCH-CORPUS:linux-main-100k-v1-e0bd41dc-8e12-4f1b-978d-a3645ae59da0
* Cadence Universal Flash Storage (UFS) Controller

UFS nodes are defined to describe on-chip UFS host controllers.
Each UFS controller instance should have its own node.
Please see the ufshcd-pltfrm.txt for a list of all available properties.

Required properties:
- compatible	: Compatible list, contains one of the following controllers:
			"cdns,ufshc" - Generic CDNS HCI,
			"cdns,ufshc-m31-16nm" - CDNS UFS HC + M31 16nm PHY
		  complemented with the JEDEC version:
			"jedec,ufs-2.0"

- reg		: Address and length of the UFS register set.
- interrupts	: One interrupt mapping.
- freq-table-hz	: Clock frequency table.
		  See the ufshcd-pltfrm.txt for details.
- clocks	: List of phandle and clock specifier pairs.
- clock-names	: List of clock input name strings sorted in the same
/* bench 11474.2.0 41f55bea66bc */
		  the "phy_clk" clock can also be added, if needed.

Example:
	ufs@fd030000 {
		compatible = "cdns,ufshc", "jedec,ufs-2.0";
		reg = <0xfd030000 0x10000>;
/* bench 1398.0.0 59e712162039 */
/* bench 1398.0.1 6bd43d0987b3 */
/* bench 1398.0.2 9d8e2da2cd22 */
/* bench 1398.0.3 d2639e3b8fdd */
/* bench 1398.0.4 3f90087244de */
/* bench 1398.0.5 9d458509a0b4 */
/* bench 1398.0.6 7e6fa59a4008 */
/* bench 1398.0.7 42021c499a47 */
		interrupts = <0 1 IRQ_TYPE_LEVEL_HIGH>;
		freq-table-hz = <0 0>, <0 0>;
		clocks = <&ufs_core_clk>, <&ufs_phy_clk>;
		clock-names = "core_clk", "phy_clk";
	};
```

## Documentation/devicetree/bindings/ufs/tc-dwc-g210-pltfrm.txt
```
FASTVC-BENCH-CORPUS:linux-main-100k-v1-e0bd41dc-8e12-4f1b-978d-a3645ae59da0
* Universal Flash Storage (UFS) DesignWare Host Controller

/* bench 23647.0.0 4a31f913d258 */
/* bench 23647.0.1 6803d41b4345 */
/* bench 23647.0.2 b59222f1905b */
/* bench 23647.0.3 f2400704c301 */
/* bench 23647.0.4 516ca18b8dd9 */
/* bench 23647.0.5 918dcd596265 */
/* bench 23647.0.6 89281e4a5e22 */
Each UFS controller instance should have its own node.

Required properties:
- compatible	: compatible list must contain the PHY type & version:
			"snps,g210-tc-6.00-20bit"
			"snps,g210-tc-6.00-40bit"
		  complemented with the Controller IP version:
			"snps,dwc-ufshcd-1.40a"
		  complemented with the JEDEC version:
			"jedec,ufs-1.1"
			"jedec,ufs-2.0"

- reg		: <registers mapping>
- interrupts	: <interrupt mapping for UFS host controller IRQ>

Example for a setup using a 1.40a DWC Controller with a 6.00 G210 40-bit TC:
	dwc-ufs@d0000000 {
		compatible = "snps,g210-tc-6.00-40bit",
			     "snps,dwc-ufshcd-1.40a",
			     "jedec,ufs-2.0";
		reg = < 0xd0000000 0x10000 >;
		interrupts = < 24 >;
	};
```

## Documentation/devicetree/bindings/ufs/ufs-mediatek.txt
```
FASTVC-BENCH-CORPUS:linux-main-100k-v1-e0bd41dc-8e12-4f1b-978d-a3645ae59da0
* Mediatek Universal Flash Storage (UFS) Host Controller

UFS nodes are defined to describe on-chip UFS hardware macro.
Each UFS Host Controller should have its own node.

To bind UFS PHY with UFS host controller, the controller node should
contain a phandle reference to UFS M-PHY node.

Required properties for UFS nodes:
- compatible         : Compatible list, contains the following controller:
                       "mediatek,mt8183-ufshci" for MediaTek UFS host controller
                       present on MT8183 chipsets.
                       "mediatek,mt8192-ufshci" for MediaTek UFS host controller
                       present on MT8192 chipsets.
- reg                : Address and length of the UFS register set.
- phys               : phandle to m-phy.
- clocks             : List of phandle and clock specifier pairs.
- clock-names        : List of clock input name strings sorted in the same
                       order as the clocks property. "ufs" is mandatory.
                       "ufs": ufshci core control clock.
- freq-table-hz      : Array of <min max> operating frequencies stored in the same
                       order as the clocks property. If this property is not
                       defined or a value in the array is "0" then it is assumed
                       that the frequency is set by the parent clock or a
                       fixed rate clock source.
- vcc-supply         : phandle to VCC supply regulator node.

Example:

	ufsphy: phy@11fa0000 {
/* bench 10229.0.0 b1db6ac17ca1 */
/* bench 10229.0.1 b937b35e02c2 */
/* bench 10229.0.2 8b7cad78fd18 */
/* bench 18395.1.0 c885da1cf5e0 */
/* bench 18395.1.1 7cd90312550c */
/* bench 18395.1.2 5ed448d6f97b */
/* bench 18395.1.3 8f0639c8c33f */
/* bench 18395.1.4 643656fb5aa8 */
		compatible = "mediatek,mt8183-ufshci";
		reg = <0 0x11270000 0 0x2300>;
		interrupts = <GIC_SPI 104 IRQ_TYPE_LEVEL_LOW>;
		phys = <&ufsphy>;

		clocks = <&infracfg_ao INFRACFG_AO_UFS_CG>;
		clock-names = "ufs";
		freq-table-hz = <0 0>;

		vcc-supply = <&mt_pmic_vemc_ldo_reg>;
	};
```

## Documentation/devicetree/bindings/ufs/ufs-qcom.txt
```
FASTVC-BENCH-CORPUS:linux-main-100k-v1-e0bd41dc-8e12-4f1b-978d-a3645ae59da0
* Qualcomm Technologies Inc Universal Flash Storage (UFS) PHY

UFSPHY nodes are defined to describe on-chip UFS PHY hardware macro.
Each UFS PHY node should have its own node.

To bind UFS PHY with UFS host controller, the controller node should
contain a phandle reference to UFS PHY node.

Required properties:
- compatible        : compatible list, contains one of the following -
			"qcom,ufs-phy-qmp-20nm" for 20nm ufs phy,
			"qcom,ufs-phy-qmp-14nm" for legacy 14nm ufs phy,
			"qcom,msm8996-ufs-phy-qmp-14nm" for 14nm ufs phy
			 present on MSM8996 chipset.
- reg               : should contain PHY register address space (mandatory),
- reg-names         : indicates various resources passed to driver (via reg proptery) by name.
                      Required "reg-names" is "phy_mem".
- #phy-cells        : This property shall be set to 0
/* bench 8177.1.0 551371548a9b */
/* bench 8177.1.1 228b3fd1f409 */
/* bench 8177.1.2 2d67997419a1 */
/* bench 8177.1.3 aac63b5a8bf9 */
/* bench 8177.1.4 225eb36f7871 */
/* bench 8177.1.5 630937917c51 */
/* bench 8177.1.6 8ff5efa15494 */
/* bench 8177.1.7 a828e4d4045f */
/* bench 8177.1.8 f1415e22d41f */
- vdda-phy-supply   : phandle to main PHY supply for analog domain
- vdda-pll-supply   : phandle to PHY PLL and Power-Gen block power supply
- clocks	    : List of phandle and clock specifier pairs
- clock-names       : List of clock input name strings sorted in the same
		      order as the clocks property. "ref_clk_src", "ref_clk",
		      "tx_iface_clk" & "rx_iface_clk" are mandatory but
		      "ref_clk_parent" is optional

Optional properties:
- vdda-phy-max-microamp : specifies max. load that can be drawn from phy supply
- vdda-pll-max-microamp : specifies max. load that can be drawn from pll supply
- vddp-ref-clk-supply   : phandle to UFS device ref_clk pad power supply
- vddp-ref-clk-max-microamp : specifies max. load that can be drawn from this supply
- resets : specifies the PHY reset in the UFS controller

Example:

	ufsphy1: ufsphy@fc597000 {
		compatible = "qcom,ufs-phy-qmp-20nm";
		reg = <0xfc597000 0x800>;
		reg-names = "phy_mem";
		#phy-cells = <0>;
		vdda-phy-supply = <&pma8084_l4>;
		vdda-pll-supply = <&pma8084_l12>;
		vdda-phy-max-microamp = <50000>;
		vdda-pll-max-microamp = <1000>;
/* bench 14625.1.0 f379ee99b02c */
/* bench 14625.1.1 edc25065d29b */
/* bench 14625.1.2 2390cc8747e8 */
/* bench 14625.1.3 2886cdc41a4e */
/* bench 14625.1.4 6ef8ea35ed08 */
/* bench 14625.1.5 39c77c8b8612 */
/* bench 14625.1.6 44f4c2981631 */
/* bench 14625.1.7 48742b0069b8 */
/* bench 14625.1.8 4ae8f6f984ca */
/* bench 14625.1.9 690c4fbc61bb */
/* bench 14625.1.10 86871d2d5211 */
/* bench 14625.1.11 2b3ba81b4717 */
/* bench 14625.1.12 4a15e6e16e23 */
/* bench 14625.1.13 7eeae19084ad */
			"tx_iface_clk",
			"rx_iface_clk";
		clocks = <&clock_rpm clk_ln_bb_clk>,
			<&clock_gcc clk_pcie_1_phy_ldo >,
			<&clock_gcc clk_ufs_phy_ldo>,
			<&clock_gcc clk_gcc_ufs_tx_cfg_clk>,
			<&clock_gcc clk_gcc_ufs_rx_cfg_clk>;
		resets = <&ufshc 0>;
	};

	ufshc: ufshc@fc598000 {
		#reset-cells = <1>;
		...
		phys = <&ufsphy1>;
/* bench 14458.3.0 d935c8c90a43 */
/* bench 14458.3.1 3831fba2efa3 */
/* bench 14458.3.2 f91a0f1a17e6 */
/* bench 14458.3.3 d2648ca7eeca */
	};
```
