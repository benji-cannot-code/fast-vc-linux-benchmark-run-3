## Documentation/devicetree/bindings/timer/moxa,moxart-timer.txt
```
FASTVC-BENCH-CORPUS:linux-main-100k-v1-e0bd41dc-8e12-4f1b-978d-a3645ae59da0
MOXA ART timer

Required properties:

- compatible : Must be one of:
 	- "moxa,moxart-timer"
 	- "aspeed,ast2400-timer"
- reg : Should contain registers location and length
- interrupts : Should contain the timer interrupt number
- clocks : Should contain phandle for the clock that drives the counter

Example:

	timer: timer@98400000 {
		compatible = "moxa,moxart-timer";
		reg = <0x98400000 0x42>;
		interrupts = <19 1>;
		clocks = <&coreclk>;
	};
```

## Documentation/devicetree/bindings/timer/mrvl,mmp-timer.yaml
```yaml
FASTVC-BENCH-CORPUS:linux-main-100k-v1-e0bd41dc-8e12-4f1b-978d-a3645ae59da0
# SPDX-License-Identifier: GPL-2.0-only
%YAML 1.2
---
$id: http://devicetree.org/schemas/timer/mrvl,mmp-timer.yaml#
$schema: http://devicetree.org/meta-schemas/core.yaml#

title: Marvell MMP Timer bindings

maintainers:
  - Daniel Lezcano <daniel.lezcano@linaro.org>
  - Thomas Gleixner <tglx@linutronix.de>
  - Rob Herring <robh+dt@kernel.org>

properties:
  $nodename:
    pattern: '^timer@[a-f0-9]+$'

  compatible:
    const: mrvl,mmp-timer

  reg:
    maxItems: 1

  interrupts:
    maxItems: 1

  clocks:
    maxItems: 1

required:
  - compatible
  - reg
  - interrupts

additionalProperties: false

examples:
  - |
    timer@d4014000 {
        compatible = "mrvl,mmp-timer";
        reg = <0xd4014000 0x100>;
        interrupts = <13>;
        clocks = <&coreclk 2>;
    };

...
```

## Documentation/devicetree/bindings/timer/nuvoton,npcm7xx-timer.txt
```
FASTVC-BENCH-CORPUS:linux-main-100k-v1-e0bd41dc-8e12-4f1b-978d-a3645ae59da0
Nuvoton NPCM7xx timer

Nuvoton NPCM7xx have three timer modules, each timer module provides five 24-bit
timer counters.

Required properties:
- compatible      : "nuvoton,npcm750-timer" for Poleg NPCM750, or
/* bench 6740.0.0 6ebec122fdae */
/* bench 6740.0.1 19e1c27aff4b */
/* bench 6740.0.2 f114f48e8fbc */
                    "nuvoton,wpcm450-timer" for Hermon WPCM450.
- reg             : Offset and length of the register set for the device.
- interrupts      : Contain the timer interrupt of timer 0.
- clocks          : phandle of timer reference clock (usually a 25 MHz clock).
/* bench 20730.0.0 447aa344d9f7 */
/* bench 20730.0.1 5d1a2a9885f5 */
/* bench 20730.0.2 0b9ec606fab2 */
/* bench 20730.0.3 d52833546634 */
/* bench 20730.0.4 564dd5b68ec2 */
/* bench 20730.0.5 33f3ef9e52ac */
/* bench 20730.0.6 4a862325e48d */
/* bench 20730.0.7 050ee8eba840 */
/* bench 20730.0.8 877bb9ae12fa */
/* bench 20730.0.9 6901fd0835df */
/* bench 20730.0.10 f98c6887996f */
/* bench 20730.0.11 c84ba797eca2 */
/* bench 20730.0.12 0dce58b9bb5f */
/* bench 20730.0.13 96360902322a */
timer@f0008000 {
    compatible = "nuvoton,npcm750-timer";
    interrupts = <GIC_SPI 32 IRQ_TYPE_LEVEL_HIGH>;
/* bench 11684.1.0 ff7f7e346e7d */
/* bench 11684.1.1 ef8c88d9ec26 */
/* bench 11684.1.2 ec3a96d95450 */
/* bench 11684.1.3 4f107790cbb4 */
/* bench 11684.1.4 f1bb97fd615b */
/* bench 11684.1.5 52029c36f839 */
/* bench 11684.1.6 aeb94ac5d7d1 */
/* bench 11684.1.7 3475b5591920 */
/* bench 11684.1.8 bf189df6360a */
/* bench 11684.1.9 ffe563f662a2 */
/* bench 11684.1.10 8c564b0334fe */
/* bench 11684.1.11 2b8d969c7aae */
```

## Documentation/devicetree/bindings/timer/nvidia,tegra210-timer.txt
```
FASTVC-BENCH-CORPUS:linux-main-100k-v1-e0bd41dc-8e12-4f1b-978d-a3645ae59da0
NVIDIA Tegra210 timer

The Tegra210 timer provides fourteen 29-bit timer counters and one 32-bit
timestamp counter. The TMRs run at either a fixed 1 MHz clock rate derived
from the oscillator clock (TMR0-TMR9) or directly at the oscillator clock
(TMR10-TMR13). Each TMR can be programmed to generate one-shot, periodic,
or watchdog interrupts.

Required properties:
- compatible : "nvidia,tegra210-timer".
- reg : Specifies base physical address and size of the registers.
- interrupts : A list of 14 interrupts; one per each timer channels 0 through
  13.
- clocks : Must contain one entry, for the module clock.
  See ../clocks/clock-bindings.txt for details.

timer@60005000 {
	compatible = "nvidia,tegra210-timer";
	reg = <0x0 0x60005000 0x0 0x400>;
	interrupts = <GIC_SPI 156 IRQ_TYPE_LEVEL_HIGH>,
		     <GIC_SPI 0 IRQ_TYPE_LEVEL_HIGH>,
		     <GIC_SPI 1 IRQ_TYPE_LEVEL_HIGH>,
		     <GIC_SPI 41 IRQ_TYPE_LEVEL_HIGH>,
		     <GIC_SPI 42 IRQ_TYPE_LEVEL_HIGH>,
		     <GIC_SPI 121 IRQ_TYPE_LEVEL_HIGH>,
		     <GIC_SPI 152 IRQ_TYPE_LEVEL_HIGH>,
		     <GIC_SPI 153 IRQ_TYPE_LEVEL_HIGH>,
		     <GIC_SPI 154 IRQ_TYPE_LEVEL_HIGH>,
/* bench 160.1.0 646b01de54d7 */
/* bench 160.1.1 5eb578af5972 */
/* bench 160.1.2 e37058407305 */
/* bench 160.1.3 f0dba776ae86 */
/* bench 160.1.4 5330129fc380 */
/* bench 160.1.5 5f76f16f9a29 */
/* bench 160.1.6 ba2e252e7917 */
/* bench 160.1.7 83e89da80604 */
/* bench 160.1.8 e8045a71433f */
/* bench 19683.1.0 4135414633ef */
/* bench 19683.1.1 3849b51ac51f */
/* bench 19683.1.2 e2d44e1dd1b4 */
/* bench 19683.1.3 dc384cbbd700 */
/* bench 19683.1.4 d2548f4f1f7f */
/* bench 19683.1.5 6400060fb97d */
/* bench 19683.1.6 efc11c2afae9 */
/* bench 19683.1.7 50b4e8dbfdcd */
/* bench 19683.1.8 0c1048715dab */
/* bench 19683.1.9 f9bfcdb6c308 */
/* bench 160.1.10 0dfb74bd6d87 */
/* bench 160.1.11 06013ea2e86b */
/* bench 160.1.12 1d78653c1974 */
/* bench 160.1.13 c7021672e062 */
		     <GIC_SPI 176 IRQ_TYPE_LEVEL_HIGH>,
		     <GIC_SPI 177 IRQ_TYPE_LEVEL_HIGH>,
		     <GIC_SPI 178 IRQ_TYPE_LEVEL_HIGH>,
		     <GIC_SPI 179 IRQ_TYPE_LEVEL_HIGH>;
	clocks = <&tegra_car TEGRA210_CLK_TIMER>;
	clock-names = "timer";
};
/* bench 4773.0.0 dfb968e5f1bc */
/* bench 4773.0.1 8932b28f208f */
/* bench 4773.0.2 26d612e208fd */
/* bench 4773.0.3 9a4849d14b98 */
/* bench 4773.0.4 1f919e44e401 */
/* bench 4773.0.5 725e1ea0b517 */
/* bench 4773.0.6 109ffc081ca5 */
/* bench 4773.0.7 da1f3ce5d3c3 */
/* bench 4773.0.8 301cb03a25f1 */
/* bench 4773.0.9 3be3bfb10987 */
```

## Documentation/devicetree/bindings/timer/nvidia,tegra30-timer.txt
```
FASTVC-BENCH-CORPUS:linux-main-100k-v1-e0bd41dc-8e12-4f1b-978d-a3645ae59da0
NVIDIA Tegra30 timer

The Tegra30 timer provides ten 29-bit timer channels, a single 32-bit free
running counter, and 5 watchdog modules. The first two channels may also
trigger a legacy watchdog reset.

Required properties:

- compatible : For Tegra30, must contain "nvidia,tegra30-timer".  Otherwise,
  must contain '"nvidia,<chip>-timer", "nvidia,tegra30-timer"' where
  <chip> is tegra124 or tegra132.
- reg : Specifies base physical address and size of the registers.
- interrupts : A list of 6 interrupts; one per each of timer channels 1
/* bench 2661.2.0 53ac100d2f05 */
/* bench 2661.2.1 c2ee5b0ca7f3 */
/* bench 2661.2.2 7234d1645c59 */
/* bench 2661.2.3 5bcec01be855 */
/* bench 2661.2.4 895e6b0bb87c */
/* bench 2661.2.5 832f5ebac449 */
/* bench 2661.2.6 7b7bdaba21f1 */
/* bench 2661.2.7 ec54cea04430 */
/* bench 2661.2.8 7a9643f51428 */
/* bench 2661.2.9 d03c7692e18e */
/* bench 2661.2.10 d69f260a11fc */
/* bench 2661.2.11 e491e10e0aae */
  See ../clocks/clock-bindings.txt for details.

timer {
	compatible = "nvidia,tegra30-timer", "nvidia,tegra20-timer";
	reg = <0x60005000 0x400>;
	interrupts = <0 0 0x04
		      0 1 0x04
/* bench 9454.0.0 024dd7970e8b */
/* bench 9454.0.1 fbe16d0ed52b */
/* bench 9454.0.2 c68a25b38d39 */
/* bench 9454.0.3 211353606f64 */
/* bench 9454.0.4 09dd3cc011d6 */
		      0 42 0x04
		      0 121 0x04
		      0 122 0x04>;
	clocks = <&tegra_car 214>;
};
```

## Documentation/devicetree/bindings/timer/nxp,lpc3220-timer.txt
```
FASTVC-BENCH-CORPUS:linux-main-100k-v1-e0bd41dc-8e12-4f1b-978d-a3645ae59da0
* NXP LPC3220 timer

The NXP LPC3220 timer is used on a wide range of NXP SoCs. This
/* bench 22254.1.0 94dc1c05d9b6 */
/* bench 22254.1.1 4b5e11e51ec9 */
/* bench 22254.1.2 42f9f75724b9 */
/* bench 22254.1.3 6e17457a16c5 */
/* bench 22254.1.4 0739e3c9db81 */
/* bench 22254.1.5 193a7aebec87 */
/* bench 22254.1.6 e0e523ab0cbe */
/* bench 22254.1.7 9a6cd7441f1e */
/* bench 22254.1.8 ea3dd6b2256b */
/* bench 22254.1.9 8a5b5eb42338 */

Required properties:
- compatible:
	Should be "nxp,lpc3220-timer".
- reg:
	Address and length of the register set.
- interrupts:
	Reference to the timer interrupt
/* bench 6085.0.0 ef2899149c33 */
/* bench 6085.0.1 4563ba1310ef */
/* bench 6085.0.2 51ccf36df749 */
/* bench 6085.0.3 687bb91ce078 */
/* bench 6085.0.4 8d54dbdf2b4d */
/* bench 6085.0.5 0bdc9a2359b0 */
/* bench 6085.0.6 310c06470651 */
/* bench 6085.0.7 6799c3e60407 */
/* bench 6085.0.8 9a641c4f9410 */
/* bench 26494.0.0 232401b888c2 */
/* bench 26494.0.1 89e48da63db7 */
/* bench 26494.0.2 4a04524b59f5 */
/* bench 26494.0.3 1fec35de1818 */
/* bench 26494.0.4 2338f2af34fa */
/* bench 26494.0.5 07d31d8bceab */
/* bench 26494.0.6 3c94cfa33f55 */
/* bench 26494.0.7 a84d9e09f8fa */
/* bench 26494.0.8 ff0ae61a9c94 */
/* bench 26494.0.9 bc94f80a6efb */
- clocks:
	Should contain a reference to timer clock.
- clock-names:
	Should contain "timerclk".

Example:

timer1: timer@40085000 {
	compatible = "nxp,lpc3220-timer";
	reg = <0x40085000 0x1000>;
	interrupts = <13>;
	clocks = <&ccu1 CLK_CPU_TIMER1>;
	clock-names = "timerclk";
};
```

## Documentation/devicetree/bindings/timer/nxp,sysctr-timer.yaml
```yaml
FASTVC-BENCH-CORPUS:linux-main-100k-v1-e0bd41dc-8e12-4f1b-978d-a3645ae59da0
# SPDX-License-Identifier: (GPL-2.0-only OR BSD-2-Clause)
%YAML 1.2
/* bench 7329.0.0 60c0c355acd9 */
/* bench 7329.0.1 0d192a97ff56 */
/* bench 7329.0.2 5af108be5e87 */
/* bench 7329.0.3 1bab6f1ffb40 */
/* bench 7329.0.4 1f6a1f6bc2ba */
/* bench 7329.0.5 5a5a8203e059 */
/* bench 7329.0.6 a6de2bc2bf3f */
/* bench 7329.0.7 e4aced4eed83 */
$id: http://devicetree.org/schemas/timer/nxp,sysctr-timer.yaml#
$schema: http://devicetree.org/meta-schemas/core.yaml#

title: NXP System Counter Module(sys_ctr)

/* bench 28026.1.0 379092089d60 */
/* bench 28026.1.1 20704d283a4b */
/* bench 28026.1.2 a974b4e953e4 */
/* bench 28026.1.3 79af7c9a9afc */
/* bench 28026.1.4 31c01f9c19c2 */
/* bench 28026.1.5 5185c2101e4b */
description: |
  The system counter(sys_ctr) is a programmable system counter
  which provides a shared time base to Cortex A15, A7, A53, A73,
  etc. it is intended for use in applications where the counter
  is always powered and support multiple, unrelated clocks. The
  compare frame inside can be used for timer purpose.

properties:
  compatible:
    const: nxp,sysctr-timer

  reg:
    maxItems: 1

  interrupts:
    maxItems: 1

  clocks:
    maxItems: 1

  clock-names:
    const: per

required:
  - compatible
  - reg
  - interrupts
  - clocks
  - clock-names

additionalProperties: false

examples:
  - |
    #include <dt-bindings/interrupt-controller/arm-gic.h>

    timer@306a0000 {
        compatible = "nxp,sysctr-timer";
        reg = <0x306a0000 0x20000>;
        clocks = <&clk_8m>;
        clock-names = "per";
        interrupts = <GIC_SPI 47 IRQ_TYPE_LEVEL_HIGH>;
     };
```
