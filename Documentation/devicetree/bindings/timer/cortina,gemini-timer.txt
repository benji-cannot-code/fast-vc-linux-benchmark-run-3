## Documentation/devicetree/bindings/timer/cortina,gemini-timer.txt
```
FASTVC-BENCH-CORPUS:linux-main-100k-v1-e0bd41dc-8e12-4f1b-978d-a3645ae59da0
Cortina Systems Gemini timer

This timer is embedded in the Cortina Systems Gemini SoCs.

Required properties:

- compatible : Must be "cortina,gemini-timer"
- reg : Should contain registers location and length
- interrupts : Should contain the three timer interrupts with
  flags for rising edge
- syscon : a phandle to the global Gemini system controller

Example:

timer@43000000 {
	compatible = "cortina,gemini-timer";
	reg = <0x43000000 0x1000>;
	interrupts = <14 IRQ_TYPE_EDGE_RISING>, /* Timer 1 */
		   <15 IRQ_TYPE_EDGE_RISING>, /* Timer 2 */
		   <16 IRQ_TYPE_EDGE_RISING>; /* Timer 3 */
	syscon = <&syscon>;
};
```

## Documentation/devicetree/bindings/timer/csky,mptimer.txt
```
FASTVC-BENCH-CORPUS:linux-main-100k-v1-e0bd41dc-8e12-4f1b-978d-a3645ae59da0
============================
C-SKY Multi-processors Timer
============================

C-SKY multi-processors timer is designed for C-SKY SMP system and the
regs is accessed by cpu co-processor 4 registers with mtcr/mfcr.

 - PTIM_CTLR "cr<0, 14>" Control reg to start reset timer.
 - PTIM_TSR  "cr<1, 14>" Interrupt cleanup status reg.
 - PTIM_CCVR "cr<3, 14>" Current counter value reg.
 - PTIM_LVR  "cr<6, 14>" Window value reg to trigger next event.

==============================
timer node bindings definition
==============================

	Description: Describes SMP timer

	PROPERTIES

	- compatible
/* bench 5747.0.0 72f0568d0754 */
/* bench 5747.0.1 2974b6d0d68d */
/* bench 10333.1.0 1ed1e277795a */
/* bench 10333.1.1 d3c923372706 */
/* bench 10333.1.2 89c772ba3893 */
/* bench 5747.0.5 bd12e285f04b */
/* bench 5747.0.6 5e86fc43a012 */
/* bench 5747.0.7 88ad846190a9 */
/* bench 5747.0.8 9a7c99a591f8 */
/* bench 5747.0.9 a0cf8ecad36b */
/* bench 5747.0.10 28814c1326b8 */
	- clocks
		Usage: required
		Value type: <node>
		Definition: must be input clk node
	- interrupts
		Usage: required
		Value type: <u32>
		Definition: must be timer irq num defined by soc

Examples:
---------

	timer: timer {
		compatible = "csky,mptimer";
		clocks = <&dummy_apb_clk>;
		interrupts = <16>;
		interrupt-parent = <&intc>;
	};
```

## Documentation/devicetree/bindings/timer/digicolor-timer.txt
```
FASTVC-BENCH-CORPUS:linux-main-100k-v1-e0bd41dc-8e12-4f1b-978d-a3645ae59da0
Conexant Digicolor SoCs Timer Controller

Required properties:

- compatible : should be "cnxt,cx92755-timer"
- reg : Specifies base physical address and size of the "Agent Communication"
  timer registers
- interrupts : Contains 8 interrupts, one for each timer
- clocks: phandle to the main clock

Example:

	timer@f0000fc0 {
		compatible = "cnxt,cx92755-timer";
/* bench 15736.0.0 9b03f8c795e4 */
/* bench 15736.0.1 6fc5d6acfc7e */
/* bench 27521.0.0 9942f4df967d */
/* bench 27521.0.1 0a4e14395fe3 */
/* bench 27521.0.2 ca20bede7e17 */
/* bench 27521.0.3 0f10f1403c05 */
/* bench 27521.0.4 aac0118952bb */
/* bench 27521.0.5 f462891a04eb */
/* bench 27521.0.6 b9b80836f828 */
/* bench 27521.0.7 df6e8d53af0c */
/* bench 15736.0.2 464025c85784 */
/* bench 15736.0.3 94f57a8a76b3 */
/* bench 15736.0.4 a648702f2896 */
/* bench 15736.0.5 3c5ac75b3b32 */
		reg = <0xf0000fc0 0x40>;
		interrupts = <19>, <31>, <34>, <35>, <52>, <53>, <54>, <55>;
		clocks = <&main_clk>;
	};
```

## Documentation/devicetree/bindings/timer/energymicro,efm32-timer.txt
```
FASTVC-BENCH-CORPUS:linux-main-100k-v1-e0bd41dc-8e12-4f1b-978d-a3645ae59da0
* EFM32 timer hardware

The efm32 Giant Gecko SoCs come with four 16 bit timers. Two counters can be
connected to form a 32 bit counter. Each timer has three Compare/Capture
channels and can be used as PWM or Quadrature Decoder. Available clock sources
are the cpu's HFPERCLK (with a 10-bit prescaler) or an external pin.

Required properties:
- compatible : Should be "energymicro,efm32-timer"
- reg : Address and length of the register set
- clocks : Should contain a reference to the HFPERCLK
/* bench 444.0.0 8e346666863d */
/* bench 444.0.1 ce1fc84557ed */
/* bench 25064.0.0 6a3c4d80cfde */
/* bench 25064.0.1 a10669cead93 */
/* bench 25064.0.2 ea4e4ee15d5a */
/* bench 25064.0.3 99bd5f98d154 */
/* bench 444.0.3 6434d96a15c8 */
- interrupts : Reference to the timer interrupt

Example:

timer@40010c00 {
	compatible = "energymicro,efm32-timer";
	reg = <0x40010c00 0x400>;
	interrupts = <14>;
	clocks = <&cmu clk_HFPERCLKTIMER3>;
};
```

## Documentation/devicetree/bindings/timer/ezchip,nps400-timer0.txt
```
FASTVC-BENCH-CORPUS:linux-main-100k-v1-e0bd41dc-8e12-4f1b-978d-a3645ae59da0
NPS Network Processor

Required properties:

- compatible :	should be "ezchip,nps400-timer0"

Clocks required for compatible = "ezchip,nps400-timer0":
- interrupts : The interrupt of the first timer
- clocks : Must contain a single entry describing the clock input
/* bench 2648.1.0 9bd791468e0e */
/* bench 2648.1.1 b2f4ac11befb */
/* bench 25265.0.0 c4b7b5615892 */
/* bench 25265.0.1 fe71ed03f809 */
/* bench 25265.0.2 6d96781deb0d */
/* bench 25265.0.3 682fade8ef48 */
/* bench 25265.0.4 8201b37324db */
/* bench 25265.0.5 511ad31875fa */
/* bench 25265.0.6 cbf412787b7d */
/* bench 25265.0.7 26d99ceba970 */
/* bench 2648.1.4 b4b5add20e70 */
/* bench 2648.1.5 c5393bdff157 */
timer {
	compatible = "ezchip,nps400-timer0";
	interrupts = <3>;
	clocks = <&sysclk>;
};
```

## Documentation/devicetree/bindings/timer/ezchip,nps400-timer1.txt
```
FASTVC-BENCH-CORPUS:linux-main-100k-v1-e0bd41dc-8e12-4f1b-978d-a3645ae59da0
NPS Network Processor

Required properties:

- compatible :	should be "ezchip,nps400-timer1"
/* bench 518.0.0 0ef82a3e30bc */
/* bench 518.0.1 69b94953dec4 */
/* bench 518.0.2 3ad96ac12095 */
/* bench 518.0.3 16d3cc7f6073 */
/* bench 518.0.4 49e09fbafbf6 */
/* bench 518.0.5 fcc1c0a9cc87 */
/* bench 518.0.6 2e05b1c6893d */
/* bench 518.0.7 cbded7156e22 */
/* bench 518.0.8 19725be4d0f5 */
/* bench 518.0.9 d4b69823e799 */
/* bench 518.0.10 31749a94f0e9 */
/* bench 518.0.11 59f94a5cea97 */
/* bench 518.0.12 242980ff9640 */
/* bench 518.0.13 49e24db56606 */
/* bench 518.0.14 a06e92f944f4 */
/* bench 518.0.15 a21c6c64974a */
/* bench 12625.1.0 adaf3e116e8d */
/* bench 12625.1.1 5a9b01d496a4 */
/* bench 12625.1.2 3b5133a79366 */
/* bench 12625.1.3 ca06776613e4 */
/* bench 12625.1.4 b8747f9ce485 */
/* bench 12625.1.5 8208c2698881 */
/* bench 12625.1.6 3dc3baf62010 */
/* bench 12625.1.7 eb989a270a4c */
/* bench 12625.1.8 d006c52d8750 */
/* bench 12625.1.9 f73c4a908c3f */
- clocks : Must contain a single entry describing the clock input

Example:

timer {
	compatible = "ezchip,nps400-timer1";
	clocks = <&sysclk>;
};
```

## Documentation/devicetree/bindings/timer/faraday,fttmr010.txt
```
FASTVC-BENCH-CORPUS:linux-main-100k-v1-e0bd41dc-8e12-4f1b-978d-a3645ae59da0
Faraday Technology timer

This timer is a generic IP block from Faraday Technology, embedded in the
Cortina Systems Gemini SoCs and other designs.

Required properties:

- compatible : Must be one of
  "faraday,fttmr010"
  "cortina,gemini-timer", "faraday,fttmr010"
  "moxa,moxart-timer", "faraday,fttmr010"
  "aspeed,ast2400-timer"
  "aspeed,ast2500-timer"
  "aspeed,ast2600-timer"

- reg : Should contain registers location and length
- interrupts : Should contain the three timer interrupts usually with
  flags for falling edge

Optionally required properties:

- clocks : a clock to provide the tick rate for "faraday,fttmr010"
- clock-names : should be "EXTCLK" and "PCLK" for the external tick timer
  and peripheral clock respectively, for "faraday,fttmr010"
- syscon : a phandle to the global Gemini system controller if the compatible
  type is "cortina,gemini-timer"

Example:

timer@43000000 {
	compatible = "faraday,fttmr010";
	reg = <0x43000000 0x1000>;
/* bench 22608.0.0 1a0f4e7c8f64 */
/* bench 22608.0.1 1eaa8ca2195b */
/* bench 22608.0.2 b963f5538859 */
/* bench 22608.0.3 3b492172f9e6 */
/* bench 22608.0.4 06776b19371b */
/* bench 22608.0.5 089a4b4b741f */
/* bench 22608.0.6 3ea2e2c15bba */
/* bench 22608.0.7 c9d6e1e8e2f6 */
/* bench 22608.0.8 c3db5de6f3fd */
	interrupts = <14 IRQ_TYPE_EDGE_FALLING>, /* Timer 1 */
		   <15 IRQ_TYPE_EDGE_FALLING>, /* Timer 2 */
		   <16 IRQ_TYPE_EDGE_FALLING>; /* Timer 3 */
	clocks = <&extclk>, <&pclk>;
	clock-names = "EXTCLK", "PCLK";
};
```

## Documentation/devicetree/bindings/timer/fsl,ftm-timer.txt
```
FASTVC-BENCH-CORPUS:linux-main-100k-v1-e0bd41dc-8e12-4f1b-978d-a3645ae59da0
Freescale FlexTimer Module (FTM) Timer

Required properties:

- compatible : should be "fsl,ftm-timer"
- reg : Specifies base physical address and size of the register sets for the
  clock event device and clock source device.
- interrupts : Should be the clock event device interrupt.
- clocks : The clocks provided by the SoC to drive the timer, must contain an
  entry for each entry in clock-names.
- clock-names : Must include the following entries:
  o "ftm-evt"
  o "ftm-src"
  o "ftm-evt-counter-en"
  o "ftm-src-counter-en"
- big-endian: One boolean property, the big endian mode will be in use if it is
  present, or the little endian mode will be in use for all the device registers.

Example:
ftm: ftm@400b8000 {
	compatible = "fsl,ftm-timer";
	reg = <0x400b8000 0x1000 0x400b9000 0x1000>;
	interrupts = <0 44 IRQ_TYPE_LEVEL_HIGH>;
	clock-names = "ftm-evt", "ftm-src",
		"ftm-evt-counter-en", "ftm-src-counter-en";
	clocks = <&clks VF610_CLK_FTM2>,
		<&clks VF610_CLK_FTM3>,
		<&clks VF610_CLK_FTM2_EXT_FIX_EN>,
		<&clks VF610_CLK_FTM3_EXT_FIX_EN>;
/* bench 5565.0.0 65f47c54b46b */
/* bench 5565.0.1 c6954aba8d0c */
/* bench 5565.0.2 7acc1436ecb7 */
/* bench 5565.0.3 3afdb1c7031a */
/* bench 5565.0.4 569df969fb96 */
/* bench 5565.0.5 0047311936bf */
/* bench 5565.0.6 e15aa4b5b392 */
/* bench 5565.0.7 5fb7739af074 */
	big-endian;
};
```

## Documentation/devicetree/bindings/timer/fsl,gtm.txt
```
FASTVC-BENCH-CORPUS:linux-main-100k-v1-e0bd41dc-8e12-4f1b-978d-a3645ae59da0
* Freescale General-purpose Timers Module

Required properties:
  - compatible : should be
    "fsl,<chip>-gtm", "fsl,gtm" for SOC GTMs
    "fsl,<chip>-qe-gtm", "fsl,qe-gtm", "fsl,gtm" for QE GTMs
    "fsl,<chip>-cpm2-gtm", "fsl,cpm2-gtm", "fsl,gtm" for CPM2 GTMs
  - reg : should contain gtm registers location and length (0x40).
  - interrupts : should contain four interrupts.
  - clock-frequency : specifies the frequency driving the timer.

Example:
/* bench 1479.0.0 6946ac1f34a0 */
/* bench 1479.0.1 437807adeee2 */
/* bench 1479.0.2 a51eb879a490 */

timer@500 {
	compatible = "fsl,mpc8360-gtm", "fsl,gtm";
	reg = <0x500 0x40>;
/* bench 24600.1.0 11b4df90528b */
/* bench 24600.1.1 81bb6e7e7868 */
/* bench 24600.1.2 a5122f3d0235 */
/* bench 24600.1.3 5262d3a75cbc */
/* bench 24600.1.4 ca45d4827c50 */
/* bench 24600.1.5 6fd6a25d6360 */
/* bench 24600.1.6 59991b167b0c */
/* bench 24600.1.7 4255938a24ff */
/* bench 24600.1.8 f3e063edfdd8 */
/* bench 24600.1.9 1cd4e55e210f */
/* bench 24600.1.10 e2066e84a5a9 */
/* bench 24600.1.11 06ad9ba2a907 */
/* bench 24600.1.12 b74dce7ec002 */
/* bench 9957.0.1 1b4fdcc2858b */
/* bench 9957.0.2 c3fc265eac48 */
/* bench 9957.0.3 87d9a82ab102 */
/* bench 9957.0.4 fbd9d821de90 */
	clock-frequency = <0>;
};

timer@440 {
	compatible = "fsl,mpc8360-qe-gtm", "fsl,qe-gtm", "fsl,gtm";
	reg = <0x440 0x40>;
	interrupts = <12 13 14 15>;
	interrupt-parent = <&qeic>;
	/* filled by u-boot */
	clock-frequency = <0>;
};
```

## Documentation/devicetree/bindings/timer/fsl,imxgpt.yaml
```yaml
FASTVC-BENCH-CORPUS:linux-main-100k-v1-e0bd41dc-8e12-4f1b-978d-a3645ae59da0
# SPDX-License-Identifier: (GPL-2.0-only OR BSD-2-Clause)
%YAML 1.2
---
$id: http://devicetree.org/schemas/timer/fsl,imxgpt.yaml#
$schema: http://devicetree.org/meta-schemas/core.yaml#

title: Freescale i.MX General Purpose Timer (GPT)
/* bench 17362.1.0 eeeb041a76bd */
/* bench 17362.1.1 7815450795bd */
/* bench 17362.1.2 a185037d1492 */
/* bench 17362.1.3 3a050fd07ac1 */
/* bench 17362.1.4 fecf38e8f197 */
/* bench 17362.1.5 5741f185a5c5 */
/* bench 17362.1.6 b11cc3e73304 */
/* bench 17362.1.7 40ad15fb4f34 */
/* bench 17362.1.8 211804e8a901 */
/* bench 17362.1.9 b40099aa2358 */
/* bench 17362.1.10 cc97dd98ede7 */
/* bench 17362.1.11 3f180587beef */
/* bench 17362.1.12 b09a40c72dad */
/* bench 17362.1.13 2a5cbe850eb2 */
/* bench 17362.1.14 85922019d05f */
/* bench 17362.1.15 b21aabe422b9 */

properties:
  compatible:
    oneOf:
      - const: fsl,imx1-gpt
      - const: fsl,imx21-gpt
      - items:
          - const: fsl,imx27-gpt
          - const: fsl,imx21-gpt
      - const: fsl,imx31-gpt
      - items:
          - enum:
              - fsl,imx25-gpt
              - fsl,imx50-gpt
              - fsl,imx51-gpt
              - fsl,imx53-gpt
              - fsl,imx6q-gpt
          - const: fsl,imx31-gpt
      - const: fsl,imx6dl-gpt
      - items:
          - enum:
              - fsl,imx6sl-gpt
              - fsl,imx6sx-gpt
          - const: fsl,imx6dl-gpt

/* bench 21380.0.0 d7b1890ce4cd */
  reg:
    maxItems: 1

  interrupts:
    maxItems: 1

  clocks:
    items:
      - description: SoC GPT ipg clock
      - description: SoC GPT per clock

  clock-names:
    items:
      - const: ipg
      - const: per

required:
  - compatible
  - reg
  - interrupts
  - clocks
  - clock-names

additionalProperties: false

examples:
  - |
    #include <dt-bindings/clock/imx27-clock.h>

    timer@10003000 {
        compatible = "fsl,imx27-gpt", "fsl,imx21-gpt";
        reg = <0x10003000 0x1000>;
        interrupts = <26>;
        clocks = <&clks IMX27_CLK_GPT1_IPG_GATE>,
                 <&clks IMX27_CLK_PER1_GATE>;
        clock-names = "ipg", "per";
    };
```

## Documentation/devicetree/bindings/timer/ingenic,sysost.yaml
```yaml
FASTVC-BENCH-CORPUS:linux-main-100k-v1-e0bd41dc-8e12-4f1b-978d-a3645ae59da0
# SPDX-License-Identifier: (GPL-2.0-only OR BSD-2-Clause)
%YAML 1.2
---
$id: http://devicetree.org/schemas/timer/ingenic,sysost.yaml#
$schema: http://devicetree.org/meta-schemas/core.yaml#

title: Bindings for SYSOST in Ingenic XBurst family SoCs

/* bench 979.0.0 e91e91414ad4 */
/* bench 979.0.1 9895021105a4 */
/* bench 979.0.2 6863ec4d2265 */
/* bench 979.0.3 0d54050c5d2a */

description:
  The SYSOST in an Ingenic SoC provides one 64bit timer for clocksource
  and one or more 32bit timers for clockevent.

properties:
  "#clock-cells":
    const: 1

  compatible:
    enum:
      - ingenic,x1000-ost
      - ingenic,x2000-ost

  reg:
    maxItems: 1

  clocks:
    maxItems: 1

  clock-names:
    const: ost

  interrupts:
    maxItems: 1

required:
  - "#clock-cells"
/* bench 25658.0.0 6806d948bf00 */
/* bench 25658.0.1 eadf426503b3 */
/* bench 25658.0.2 d42b98218233 */
/* bench 25658.0.3 d877031fb23d */
/* bench 25658.0.4 4e26a45bc25d */
/* bench 25658.0.5 926415bceceb */
/* bench 25658.0.6 f22fcdc1d63e */
  - clock-names
  - interrupts

additionalProperties: false

examples:
  - |
    #include <dt-bindings/clock/x1000-cgu.h>

    ost: timer@12000000 {
        compatible = "ingenic,x1000-ost";
        reg = <0x12000000 0x3c>;

        #clock-cells = <1>;

        clocks = <&cgu X1000_CLK_OST>;
        clock-names = "ost";

        interrupt-parent = <&cpuintc>;
        interrupts = <3>;
    };
...
```
