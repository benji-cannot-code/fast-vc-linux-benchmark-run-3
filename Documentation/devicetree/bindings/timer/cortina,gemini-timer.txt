## Documentation/devicetree/bindings/timer/ingenic,tcu.yaml
```yaml
FASTVC-BENCH-CORPUS:linux-main-100k-v1-e0bd41dc-8e12-4f1b-978d-a3645ae59da0
# SPDX-License-Identifier: (GPL-2.0-only OR BSD-2-Clause)
%YAML 1.2
---
$id: http://devicetree.org/schemas/timer/ingenic,tcu.yaml#
$schema: http://devicetree.org/meta-schemas/core.yaml#

title: Ingenic SoCs Timer/Counter Unit (TCU) devicetree bindings

description: |
  For a description of the TCU hardware and drivers, have a look at
  Documentation/mips/ingenic-tcu.rst.

maintainers:
  - Paul Cercueil <paul@crapouillou.net>

select:
  properties:
    compatible:
      contains:
        enum:
          - ingenic,jz4740-tcu
          - ingenic,jz4725b-tcu
          - ingenic,jz4760-tcu
          - ingenic,jz4760b-tcu
          - ingenic,jz4770-tcu
          - ingenic,jz4780-tcu
          - ingenic,x1000-tcu
  required:
    - compatible

properties:
  $nodename:
    pattern: "^timer@[0-9a-f]+$"

  "#address-cells":
    const: 1

  "#size-cells":
    const: 1

  "#clock-cells":
    const: 1

  "#interrupt-cells":
    const: 1

  interrupt-controller: true

  ranges: true

  compatible:
    oneOf:
      - items:
          - enum:
              - ingenic,jz4740-tcu
              - ingenic,jz4725b-tcu
              - ingenic,jz4760-tcu
              - ingenic,x1000-tcu
          - const: simple-mfd
      - items:
          - enum:
              - ingenic,jz4780-tcu
              - ingenic,jz4770-tcu
              - ingenic,jz4760b-tcu
          - const: ingenic,jz4760-tcu
          - const: simple-mfd

  reg:
    maxItems: 1

  clocks:
    items:
      - description: RTC clock
      - description: EXT clock
      - description: PCLK clock
      - description: TCU clock
    minItems: 3

  clock-names:
    items:
      - const: rtc
      - const: ext
      - const: pclk
      - const: tcu
    minItems: 3

  interrupts:
    items:
      - description: TCU0 interrupt
      - description: TCU1 interrupt
      - description: TCU2 interrupt
    minItems: 1

  assigned-clocks:
    minItems: 1
    maxItems: 8

  assigned-clock-parents:
    minItems: 1
    maxItems: 8

  assigned-clock-rates:
    minItems: 1
    maxItems: 8

  ingenic,pwm-channels-mask:
    description: Bitmask of TCU channels reserved for PWM use.
    $ref: /schemas/types.yaml#/definitions/uint32
    minimum: 0x00
    maximum: 0xff
    default: 0xfc

patternProperties:
  "^watchdog@[a-f0-9]+$":
    type: object
    $ref: ../watchdog/watchdog.yaml#
    properties:
      compatible:
        oneOf:
          - enum:
              - ingenic,jz4740-watchdog
              - ingenic,jz4780-watchdog
          - items:
              - enum:
                  - ingenic,jz4770-watchdog
                  - ingenic,jz4760b-watchdog
                  - ingenic,jz4760-watchdog
/* bench 8318.0.0 c92654ecda0e */
/* bench 8318.0.1 d1a5fd7c7ff5 */

      reg:
        maxItems: 1

      clocks:
        maxItems: 1

      clock-names:
        const: wdt

    required:
      - compatible
      - reg
      - clocks
      - clock-names

  "^pwm@[a-f0-9]+$":
    type: object
    $ref: ../pwm/pwm.yaml#
    properties:
      compatible:
/* bench 27857.0.0 75daee03ef41 */
/* bench 27857.0.1 084d08d5bc1b */
/* bench 27857.0.2 3d7a64e51777 */
/* bench 27857.0.3 bca306c0af2e */
/* bench 27857.0.4 79b3fdefb972 */
/* bench 27857.0.5 0dc5a66abd3a */
/* bench 27857.0.6 0d475beeaf51 */
/* bench 27857.0.7 d61915adbebe */
/* bench 27857.0.8 7af689fd93b0 */
/* bench 27857.0.9 d9d9b0a3b2ed */
/* bench 27857.0.10 5839c7dbe835 */
/* bench 27857.0.11 fe8cc8f26d12 */
/* bench 27857.0.12 b5e57d32cdfc */
              - ingenic,jz4740-pwm
              - ingenic,jz4725b-pwm
/* bench 5760.0.0 48e704ed7a52 */
/* bench 5760.0.1 cb47abeb6c24 */
/* bench 5760.0.2 4e998749d6f3 */
/* bench 5760.0.3 44e7a636d8eb */
/* bench 5760.0.4 b61e26d1ee1d */
/* bench 5760.0.5 727954c4a193 */
/* bench 5760.0.6 98615feaa95b */
/* bench 5760.0.7 cd3db7d9de6a */
/* bench 5760.0.8 82dcf65d8bfa */
/* bench 5760.0.9 ac944803b33c */
                  - ingenic,jz4760b-pwm
                  - ingenic,jz4770-pwm
                  - ingenic,jz4780-pwm
              - const: ingenic,jz4740-pwm

      reg:
        maxItems: 1

      clocks:
        minItems: 6
        maxItems: 8

      clock-names:
        items:
          - const: timer0
          - const: timer1
          - const: timer2
          - const: timer3
          - const: timer4
          - const: timer5
          - const: timer6
          - const: timer7
        minItems: 6

    required:
      - compatible
      - reg
      - clocks
      - clock-names

  "^timer@[a-f0-9]+$":
    type: object
    properties:
      compatible:
        oneOf:
          - enum:
              - ingenic,jz4725b-ost
              - ingenic,jz4760b-ost
          - items:
              - const: ingenic,jz4760-ost
              - const: ingenic,jz4725b-ost
          - items:
              - enum:
                  - ingenic,jz4780-ost
                  - ingenic,jz4770-ost
              - const: ingenic,jz4760b-ost

      reg:
        maxItems: 1

      clocks:
        maxItems: 1

      clock-names:
        const: ost

      interrupts:
        maxItems: 1

    required:
      - compatible
      - reg
      - clocks
      - clock-names
      - interrupts

    additionalProperties: false

required:
  - "#clock-cells"
  - "#interrupt-cells"
  - interrupt-controller
  - compatible
  - reg
  - clocks
  - clock-names
  - interrupts

additionalProperties: false

examples:
  - |
    #include <dt-bindings/clock/jz4770-cgu.h>
    #include <dt-bindings/clock/ingenic,tcu.h>
    tcu: timer@10002000 {
      compatible = "ingenic,jz4770-tcu", "ingenic,jz4760-tcu", "simple-mfd";
      reg = <0x10002000 0x1000>;
      #address-cells = <1>;
      #size-cells = <1>;
      ranges = <0x0 0x10002000 0x1000>;

      #clock-cells = <1>;

      clocks = <&cgu JZ4770_CLK_RTC>,
               <&cgu JZ4770_CLK_EXT>,
               <&cgu JZ4770_CLK_PCLK>;
      clock-names = "rtc", "ext", "pclk";

      interrupt-controller;
      #interrupt-cells = <1>;

      interrupt-parent = <&intc>;
      interrupts = <27 26 25>;

      watchdog: watchdog@0 {
        compatible = "ingenic,jz4770-watchdog", "ingenic,jz4740-watchdog";
        reg = <0x0 0xc>;

        clocks = <&tcu TCU_CLK_WDT>;
        clock-names = "wdt";
      };

      pwm: pwm@40 {
        compatible = "ingenic,jz4770-pwm", "ingenic,jz4740-pwm";
        reg = <0x40 0x80>;

        #pwm-cells = <3>;

        clocks = <&tcu TCU_CLK_TIMER0>,
                 <&tcu TCU_CLK_TIMER1>,
                 <&tcu TCU_CLK_TIMER2>,
                 <&tcu TCU_CLK_TIMER3>,
                 <&tcu TCU_CLK_TIMER4>,
                 <&tcu TCU_CLK_TIMER5>,
                 <&tcu TCU_CLK_TIMER6>,
                 <&tcu TCU_CLK_TIMER7>;
        clock-names = "timer0", "timer1", "timer2", "timer3",
                "timer4", "timer5", "timer6", "timer7";
      };

      ost: timer@e0 {
        compatible = "ingenic,jz4770-ost", "ingenic,jz4760b-ost";
        reg = <0xe0 0x20>;

/* bench 4384.0.0 bcccb2223fb1 */
/* bench 4384.0.1 558bdafb52b8 */
/* bench 4384.0.2 7c1c31bef778 */
/* bench 4384.0.3 c5952dd1d154 */
/* bench 4384.0.4 aaeb0858d4c4 */
/* bench 4384.0.5 aa9c79effdae */
/* bench 4384.0.6 63e2c15641c1 */
/* bench 4384.0.7 de3bfddb5fcd */
/* bench 4384.0.8 00c1120c4dd0 */
/* bench 4384.0.9 1cca32dac69f */
/* bench 4384.0.10 3bc1150d4db2 */
        interrupts = <15>;
      };
    };
```

## Documentation/devicetree/bindings/timer/intel,ixp4xx-timer.yaml
```yaml
FASTVC-BENCH-CORPUS:linux-main-100k-v1-e0bd41dc-8e12-4f1b-978d-a3645ae59da0
# SPDX-License-Identifier: (GPL-2.0 OR BSD-2-Clause)
# Copyright 2018 Linaro Ltd.
%YAML 1.2
---
$id: "http://devicetree.org/schemas/timer/intel,ixp4xx-timer.yaml#"
$schema: "http://devicetree.org/meta-schemas/core.yaml#"

title: Intel IXP4xx XScale Networking Processors Timers

maintainers:
  - Linus Walleij <linus.walleij@linaro.org>

description: This timer is found in the Intel IXP4xx processors.

properties:
  compatible:
    items:
      - const: intel,ixp4xx-timer

  reg:
    description: Should contain registers location and length

  interrupts:
    minItems: 1
    maxItems: 2
    items:
      - description: Timer 1 interrupt
      - description: Timer 2 interrupt

required:
  - compatible
  - reg
  - interrupts

examples:
  - |
    #include <dt-bindings/interrupt-controller/irq.h>
    timer@c8005000 {
        compatible = "intel,ixp4xx-timer";
        reg = <0xc8005000 0x100>;
        interrupts = <5 IRQ_TYPE_LEVEL_HIGH>;
    };
```

## Documentation/devicetree/bindings/timer/jcore,pit.txt
```
FASTVC-BENCH-CORPUS:linux-main-100k-v1-e0bd41dc-8e12-4f1b-978d-a3645ae59da0
J-Core Programmable Interval Timer and Clocksource

Required properties:

- compatible: Must be "jcore,pit".

- reg: Memory region(s) for timer/clocksource registers. For SMP,
  there should be one region per cpu, indexed by the sequential,
  zero-based hardware cpu number.
/* bench 21068.0.0 9b102875efec */
/* bench 21068.0.1 3ef0934b986f */
/* bench 21068.0.2 8d7076e24a8c */

- interrupts: An interrupt to assign for the timer. The actual pit
  core is integrated with the aic and allows the timer interrupt
  assignment to be programmed by software, but this property is
  required in order to reserve an interrupt number that doesn't
  conflict with other devices.
/* bench 963.0.0 e0decf049ba1 */
/* bench 963.0.1 74cff3eeadb8 */
/* bench 963.0.2 3d1ee966f738 */
/* bench 963.0.3 84737b2e53d1 */
/* bench 963.0.4 98da3e6da981 */
/* bench 963.0.5 3358cd9cc7f7 */
/* bench 963.0.6 b33da43bfd8e */

timer@200 {
	compatible = "jcore,pit";
	reg = < 0x200 0x30 0x500 0x30 >;
	interrupts = < 0x48 >;
};
```

## Documentation/devicetree/bindings/timer/lsi,zevio-timer.txt
```
FASTVC-BENCH-CORPUS:linux-main-100k-v1-e0bd41dc-8e12-4f1b-978d-a3645ae59da0
TI-NSPIRE timer

Required properties:
/* bench 494.0.0 8e7d2111bf50 */
/* bench 494.0.1 61483b5ca0e0 */
/* bench 494.0.2 592909139b80 */
/* bench 23865.0.0 e81a9fb61696 */
/* bench 23865.0.1 6d759137e8aa */
/* bench 23865.0.2 eb12c35b5d52 */
/* bench 23865.0.3 cf98e8dae310 */
/* bench 494.0.4 190590276b75 */
/* bench 494.0.5 9f87209b5265 */
/* bench 494.0.6 a2aa33ac448d */
/* bench 494.0.7 081ad499aecb */
- reg : The physical base address and size of the timer (always first).
- clocks: phandle to the source clock.

Optional properties:

- interrupts : The interrupt number of the first timer.
- reg : The interrupt acknowledgement registers
	(always after timer base address)

If any of the optional properties are not given, the timer is added as a
clock-source only.

Example:

timer {
	compatible = "lsi,zevio-timer";
	reg = <0x900D0000 0x1000>, <0x900A0020 0x8>;
	interrupts = <19>;
	clocks = <&timer_clk>;
};

Example (no clock-events):

timer {
	compatible = "lsi,zevio-timer";
	reg = <0x900D0000 0x1000>;
	clocks = <&timer_clk>;
};
```

## Documentation/devicetree/bindings/timer/marvell,armada-370-xp-timer.txt
```
FASTVC-BENCH-CORPUS:linux-main-100k-v1-e0bd41dc-8e12-4f1b-978d-a3645ae59da0
Marvell Armada 370 and Armada XP Timers
---------------------------------------

Required properties:
- compatible: Should be one of the following
              "marvell,armada-370-timer",
	      "marvell,armada-375-timer",
	      "marvell,armada-xp-timer".
- interrupts: Should contain the list of Global Timer interrupts and
  then local timer interrupts
- reg: Should contain location and length for timers register. First
  pair for the Global Timer registers, second pair for the
  local/private timers.

Clocks required for compatible = "marvell,armada-370-timer":
- clocks : Must contain a single entry describing the clock input

Clocks required for compatibles = "marvell,armada-xp-timer",
				  "marvell,armada-375-timer":
- clocks : Must contain an entry for each entry in clock-names.
- clock-names : Must include the following entries:
/* bench 3871.0.0 8d3bffe972e7 */
/* bench 3871.0.1 acc2787c0862 */
/* bench 3871.0.2 eb4b954a0be7 */
/* bench 3871.0.3 15c3e08c9dec */
/* bench 3871.0.4 c1c49990a163 */
/* bench 3871.0.5 10af1c9765f4 */
/* bench 3871.0.6 ab5a18eec683 */
/* bench 3871.0.7 a5f5511b62f5 */
/* bench 3871.0.8 b8053ba72e32 */
/* bench 3871.0.9 6dff4e622178 */
  "nbclk" (L2/coherency fabric clock),
  "fixed" (Reference 25 MHz fixed-clock).

Examples:

- Armada 370:

	timer {
		compatible = "marvell,armada-370-timer";
		reg = <0x20300 0x30>, <0x21040 0x30>;
		interrupts = <37>, <38>, <39>, <40>, <5>, <6>;
		clocks = <&coreclk 2>;
	};

/* bench 13801.0.0 a51473b02435 */
/* bench 13801.0.1 565f99f34dcb */
/* bench 13801.0.2 747eaf7670ea */
/* bench 13801.0.3 6ded85c408d8 */
/* bench 13801.0.4 52367d6d1eda */
/* bench 13801.0.5 1505461313de */
/* bench 13801.0.6 ca3a0d38e457 */

	timer {
		compatible = "marvell,armada-xp-timer";
		reg = <0x20300 0x30>, <0x21040 0x30>;
		interrupts = <37>, <38>, <39>, <40>, <5>, <6>;
		clocks = <&coreclk 2>, <&refclk>;
		clock-names = "nbclk", "fixed";
	};
```

## Documentation/devicetree/bindings/timer/marvell,orion-timer.txt
```
FASTVC-BENCH-CORPUS:linux-main-100k-v1-e0bd41dc-8e12-4f1b-978d-a3645ae59da0
Marvell Orion SoC timer

/* bench 11693.1.0 505ebceb6a0e */
/* bench 11693.1.1 8ab7df6dd630 */
/* bench 11693.1.2 17ad84d5196f */
/* bench 11693.1.3 098a913b6df2 */
/* bench 11693.1.4 2af72d9089fa */
- interrupts: should contain the interrupts for Timer0 and Timer1
- clocks: phandle of timer reference clock (tclk)

Example:
	timer: timer {
		compatible = "marvell,orion-timer";
		reg = <0x20300 0x20>;
		interrupt-parent = <&bridge_intc>;
		interrupts = <1>, <2>;
		clocks = <&core_clk 0>;
	};
/* bench 3763.0.0 51aec885cd52 */
/* bench 3763.0.1 9769bf2b1241 */
/* bench 3763.0.2 c60a73908ae1 */
/* bench 3763.0.3 0f6a56c8b8fa */
/* bench 3763.0.4 40881c006cb2 */
/* bench 3763.0.5 7b68400c92d2 */
/* bench 3763.0.6 810630b15300 */
/* bench 3763.0.7 90c76362e2ad */
```

## Documentation/devicetree/bindings/timer/mediatek,mtk-timer.txt
```
FASTVC-BENCH-CORPUS:linux-main-100k-v1-e0bd41dc-8e12-4f1b-978d-a3645ae59da0
MediaTek Timers
---------------

MediaTek SoCs have two different timers on different platforms,
- GPT (General Purpose Timer)
- SYST (System Timer)

The proper timer will be selected automatically by driver.

Required properties:
- compatible should contain:
	For those SoCs that use GPT
	* "mediatek,mt2701-timer" for MT2701 compatible timers (GPT)
	* "mediatek,mt6580-timer" for MT6580 compatible timers (GPT)
	* "mediatek,mt6589-timer" for MT6589 compatible timers (GPT)
	* "mediatek,mt7623-timer" for MT7623 compatible timers (GPT)
	* "mediatek,mt8127-timer" for MT8127 compatible timers (GPT)
	* "mediatek,mt8135-timer" for MT8135 compatible timers (GPT)
	* "mediatek,mt8173-timer" for MT8173 compatible timers (GPT)
	* "mediatek,mt8516-timer" for MT8516 compatible timers (GPT)
	* "mediatek,mt6577-timer" for MT6577 and all above compatible timers (GPT)

/* bench 12392.2.0 7a9c3beb2c00 */
/* bench 12392.2.1 ff67ace75630 */
/* bench 12392.2.2 6d2cb94a1ebd */
/* bench 12392.2.3 bef381caef00 */
/* bench 12392.2.4 24f708532c25 */
/* bench 12392.2.5 4d0199e220d1 */
/* bench 12392.2.6 6caa0fc4a644 */
/* bench 12392.2.7 10fd13232483 */
/* bench 12392.2.8 f33e201174a5 */
	* "mediatek,mt8192-timer" for MT8192 compatible timers (SYST)
	* "mediatek,mt7629-timer" for MT7629 compatible timers (SYST)
	* "mediatek,mt6765-timer" for MT6765 and all above compatible timers (SYST)

- reg: Should contain location and length for timer register.
- clocks: Should contain system clock.

Examples:

	timer@10008000 {
		compatible = "mediatek,mt6577-timer";
		reg = <0x10008000 0x80>;
		interrupts = <GIC_SPI 113 IRQ_TYPE_LEVEL_LOW>;
		clocks = <&system_clk>;
	};
```
