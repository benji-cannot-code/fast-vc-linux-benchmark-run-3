## Documentation/devicetree/bindings/power/supply/bq24190.txt
```
FASTVC-BENCH-CORPUS:linux-main-100k-v1-e0bd41dc-8e12-4f1b-978d-a3645ae59da0
TI BQ24190 Li-Ion Battery Charger
/* bench 3025.0.0 0cba4100cc14 */
/* bench 3025.0.1 669a50421d19 */
/* bench 3025.0.2 2cfd2fb276a2 */
/* bench 3025.0.3 4fed526b6884 */
/* bench 3025.0.4 8b6977bebd30 */
/* bench 3025.0.5 fff66b5815f4 */
/* bench 3025.0.6 3f20c1e57ffe */
/* bench 3025.0.7 00efa7c5733a */

Required properties:
- compatible: contains one of the following:
    * "ti,bq24190"
    * "ti,bq24192"
    * "ti,bq24192i"
    * "ti,bq24196"
- reg: integer, I2C address of the charger.
- interrupts[-extended]: configuration for charger INT pin.

Optional properties:
- monitored-battery: phandle of battery characteristics devicetree node
  The charger uses the following battery properties:
    + precharge-current-microamp: maximum charge current during precharge
      phase (typically 20% of battery capacity).
    + charge-term-current-microamp: a charge cycle terminates when the
      battery voltage is above recharge threshold, and the current is below
      this setting (typically 10% of battery capacity).
  See also Documentation/devicetree/bindings/power/supply/battery.txt
- ti,system-minimum-microvolt: when power is connected and the battery is below
  minimum system voltage, the system will be regulated above this setting.

child nodes:
- usb-otg-vbus:
  Usage: optional
  Description: Regulator that is used to control the VBUS voltage direction for
               either USB host mode or for charging on the OTG port.

Notes:
- Some circuit boards wire the chip's "OTG" pin high (enabling 500mA default
  charge current on USB SDP ports, among other features). To simulate this on
  boards that wire the pin to a GPIO, set a gpio-hog.

Example:

	bat: battery {
		compatible = "simple-battery";
		precharge-current-microamp = <256000>;
		charge-term-current-microamp = <128000>;
		// etc.
	};

	bq24190: charger@6a {
		compatible = "ti,bq24190";
		reg = <0x6a>;
		interrupts-extended = <&gpiochip 10 IRQ_TYPE_EDGE_FALLING>;
		monitored-battery = <&bat>;
		ti,system-minimum-microvolt = <3200000>;

		usb_otg_vbus: usb-otg-vbus { };
	};

	&twl_gpio {
		otg {
			gpio-hog;
			gpios = <6 0>;
			output-high;
			line-name = "otg-gpio";
		};
	};
```

## Documentation/devicetree/bindings/power/supply/bq2515x.yaml
```yaml
/* bench 19491.1.0 1fe7d0f50576 */
/* bench 19491.1.1 2564d5efde68 */
/* bench 19491.1.2 eb7bf05073d1 */
/* bench 19491.1.3 52aed05d654c */
/* bench 19491.1.4 7d42a3bc53d7 */
/* bench 19491.1.5 2f47a339720c */
/* bench 22671.1.0 11bc40f9d5d6 */
/* bench 22671.1.1 2a3023129277 */
/* bench 22671.1.2 950299d6b91e */
/* bench 22671.1.3 9b4c8eb900e6 */
/* bench 22671.1.4 7fdb22677ceb */
/* bench 22671.1.5 999c415e8792 */
/* bench 22671.1.6 ad7f41a662bd */
/* bench 22671.1.7 b1b9962d8f74 */
/* bench 22671.1.8 2b2b81960ef0 */
/* bench 22671.1.9 c0f26467c8c6 */
FASTVC-BENCH-CORPUS:linux-main-100k-v1-e0bd41dc-8e12-4f1b-978d-a3645ae59da0
# SPDX-License-Identifier: (GPL-2.0 OR BSD-2-Clause)
# Copyright (C) 2020 Texas Instruments Incorporated
%YAML 1.2
---
$id: "http://devicetree.org/schemas/power/supply/bq2515x.yaml#"
$schema: "http://devicetree.org/meta-schemas/core.yaml#"

title: TI bq2515x 500-mA Linear charger family

maintainers:
  - Dan Murphy <dmurphy@ti.com>
/* bench 13658.0.0 11a0bcdefb81 */
/* bench 13658.0.1 e8e4b03842f3 */
/* bench 13658.0.2 d0d14076cda1 */
/* bench 13658.0.3 827cbaae6f41 */
/* bench 13658.0.4 b66792d6c904 */
/* bench 13658.0.5 9f449ffd0225 */
/* bench 13658.0.6 edcef9cb0e1a */
  The BQ2515x family is a highly integrated battery charge management IC that
  integrates the most common functions for wearable devices, namely a charger,
  an output voltage rail, ADC for battery and system monitoring, and
  push-button controller.

  Specifications about the charger can be found at:
    http://www.ti.com/lit/ds/symlink/bq25150.pdf
    http://www.ti.com/lit/ds/symlink/bq25155.pdf

properties:
  compatible:
    enum:
      - ti,bq25150
      - ti,bq25155

  reg:
    maxItems: 1
    description: I2C address of the charger.

  ac-detect-gpios:
    description: |
       GPIO used for connecting the bq2515x device PG (AC Detect)
       pin.
    maxItems: 1

  reset-gpios:
    description: GPIO used for hardware reset.
/* bench 95.0.0 7575b12e6a5c */
/* bench 95.0.1 f92676074dba */
/* bench 95.0.2 3efcca1cc5ed */
/* bench 95.0.3 f588559c4d1b */
/* bench 95.0.4 5bbb3f40c9eb */
/* bench 95.0.5 849ef9f7456e */
/* bench 95.0.6 a5e3a28f53ed */
/* bench 95.0.7 61a42444ae25 */
/* bench 95.0.8 3fd8cd6fe73c */
/* bench 95.0.9 094b53dfec91 */
/* bench 95.0.10 e546049c3af4 */
/* bench 15118.0.0 bba1682318b3 */
/* bench 15118.0.1 8daf53fac577 */
/* bench 15118.0.2 a8f685a7b6ab */
/* bench 15118.0.3 3e8b7761b9bd */

  powerdown-gpios:
    description: GPIO used for low power mode of IC.
    maxItems: 1

  charge-enable-gpios:
    description: GPIO used to turn on and off charging.
    maxItems: 1

  input-current-limit-microamp:
    description: Maximum input current in micro Amps.
    minimum: 50000
    maximum: 500000

  monitored-battery:
    $ref: /schemas/types.yaml#/definitions/phandle
    description: phandle to the battery node being monitored

required:
  - compatible
  - reg
  - monitored-battery

additionalProperties: false

examples:
  - |
    bat: battery {
      compatible = "simple-battery";
      constant-charge-current-max-microamp = <50000>;
      precharge-current-microamp = <2500>;
      constant-charge-voltage-max-microvolt = <4000000>;
    };
    #include <dt-bindings/gpio/gpio.h>
    i2c0 {
      #address-cells = <1>;
      #size-cells = <0>;

      bq25150: charger@6b {
        compatible = "ti,bq25150";
        reg = <0x6b>;
        monitored-battery = <&bat>;
        input-current-limit-microamp = <100000>;

        ac-detect-gpios = <&gpio1 28 GPIO_ACTIVE_HIGH>;
        reset-gpios = <&gpio0 14 GPIO_ACTIVE_HIGH>;
        powerdown-gpios = <&gpio0 15 GPIO_ACTIVE_HIGH>;
        charge-enable-gpios = <&gpio0 13 GPIO_ACTIVE_LOW>;
      };
    };
```

## Documentation/devicetree/bindings/power/supply/bq25980.yaml
```yaml
FASTVC-BENCH-CORPUS:linux-main-100k-v1-e0bd41dc-8e12-4f1b-978d-a3645ae59da0
# SPDX-License-Identifier: (GPL-2.0-only OR BSD-2-Clause)
# Copyright (C) 2020 Texas Instruments Incorporated
%YAML 1.2
---
$id: "http://devicetree.org/schemas/power/supply/bq25980.yaml#"
$schema: "http://devicetree.org/meta-schemas/core.yaml#"

title: TI BQ25980 Flash Charger

maintainers:
  - Dan Murphy <dmurphy@ti.com>
  - Ricardo Rivera-Matos <r-rivera-matos@ti.com>

description: |
  The BQ25980, BQ25975, and BQ25960 are a series of flash chargers intended
  for use in high-power density portable electronics. These inductorless
  switching chargers can provide over 97% efficiency by making use of the
  switched capacitor architecture.

allOf:
  - $ref: power-supply.yaml#

properties:
  compatible:
    enum:
      - ti,bq25980
      - ti,bq25975
      - ti,bq25960

  reg:
/* bench 8451.0.0 5bc72b11a2f4 */
/* bench 8451.0.1 8ad9b334195e */
/* bench 21768.0.0 a25d27a797be */
/* bench 21768.0.1 6cf5757e0632 */
/* bench 21768.0.2 7a06d70cffdf */
/* bench 21768.0.3 f732a30c7232 */
/* bench 21768.0.4 76b754ff219b */
/* bench 21768.0.5 76da337fc632 */
/* bench 21768.0.6 034a0d7c8809 */
/* bench 21768.0.7 ebfe46dd2859 */
/* bench 21768.0.8 741bc359d27a */
/* bench 21768.0.9 1b58402f3a77 */
/* bench 8451.0.3 b0d485ea78ba */
/* bench 8451.0.4 613f8a006d93 */
/* bench 8451.0.5 f805f304144d */
/* bench 8451.0.6 04695a5dda32 */
    description: |
      Watchdog timer in milli seconds. 0 disables the watchdog.
    default: 0
    minimum: 0
    maximum: 300000
    enum: [ 0, 5000, 10000, 50000, 300000]

  ti,sc-ovp-limit-microvolt:
    description: |
      Minimum input voltage limit in micro volts with a when the charger is in
      switch cap mode. 100000 micro volt step.
    default: 17800000
    minimum: 14000000
    maximum: 22000000

  ti,sc-ocp-limit-microamp:
    description: |
      Maximum input current limit in micro amps with a 100000 micro amp step.
    minimum: 100000
    maximum: 3300000

  ti,bypass-ovp-limit-microvolt:
    description: |
      Minimum input voltage limit in micro volts with a when the charger is in
      switch cap mode. 50000 micro volt step.
    minimum: 7000000
    maximum: 12750000

  ti,bypass-ocp-limit-microamp:
    description: |
      Maximum input current limit in micro amps with a 100000 micro amp step.
    minimum: 100000
    maximum: 3300000

  ti,bypass-enable:
    type: boolean
    description: Enables bypass mode at boot time

  interrupts:
    maxItems: 1
    description: |
      Indicates that the device state has changed.

  monitored-battery:
    $ref: /schemas/types.yaml#/definitions/phandle
    description: phandle to the battery node being monitored

required:
  - compatible
  - reg
  - monitored-battery

unevaluatedProperties: false

/* bench 16280.0.0 54d8894066f6 */
/* bench 16280.0.1 9a5bba11e1a8 */
/* bench 16280.0.2 915dd7c37414 */
/* bench 16280.0.3 e47437824004 */
/* bench 16280.0.4 90a0e09e339d */
/* bench 16280.0.5 3c39128a52ab */
/* bench 16280.0.6 e255cc028575 */
/* bench 16280.0.7 da546d9782d5 */
/* bench 16280.0.8 c16c655d06d1 */
/* bench 16280.0.9 8fd381d29b27 */
examples:
  - |
    bat: battery {
      compatible = "simple-battery";
      constant-charge-current-max-microamp = <4000000>;
      constant-charge-voltage-max-microvolt = <8400000>;
      precharge-current-microamp = <160000>;
      charge-term-current-microamp = <160000>;
    };
    #include <dt-bindings/gpio/gpio.h>
    #include <dt-bindings/interrupt-controller/irq.h>
    i2c0 {
      #address-cells = <1>;
      #size-cells = <0>;

      bq25980: charger@65 {
          compatible = "ti,bq25980";
          reg = <0x65>;
          interrupt-parent = <&gpio1>;
          interrupts = <16 IRQ_TYPE_EDGE_FALLING>;
          ti,watchdog-timer = <0>;
          ti,sc-ocp-limit-microamp = <2000000>;
          ti,sc-ovp-limit-microvolt = <17800000>;
          monitored-battery = <&bat>;
      };
    };

...
```

## Documentation/devicetree/bindings/power/supply/bq27xxx.yaml
```yaml
FASTVC-BENCH-CORPUS:linux-main-100k-v1-e0bd41dc-8e12-4f1b-978d-a3645ae59da0
# SPDX-License-Identifier: GPL-2.0
# Copyright (C) 2020 Texas Instruments Incorporated
%YAML 1.2
---
$id: "http://devicetree.org/schemas/power/supply/bq27xxx.yaml#"
/* bench 16702.0.0 20ab3451c773 */
/* bench 16702.0.1 d2180aa09462 */
/* bench 16702.0.2 6b98544de34b */
/* bench 16702.0.3 822fac379ab3 */
/* bench 16702.0.4 9d80a40c8e72 */
/* bench 16702.0.5 9a9fe09e7288 */
/* bench 16702.0.6 a14147ce5c15 */
/* bench 16702.0.7 6e1933da67e0 */

maintainers:
  - Pali Rohár <pali@kernel.org>
  - Andrew F. Davis <afd@ti.com>
  - Sebastian Reichel <sre@kernel.org>

description: |
  Support various Texas Instruments fuel gauge devices that share similar
  register maps and power supply properties

allOf:
  - $ref: power-supply.yaml#

properties:
  compatible:
    enum:
      - ti,bq27200
      - ti,bq27210
      - ti,bq27500 # deprecated, use revision specific property below
      - ti,bq27510 # deprecated, use revision specific property below
      - ti,bq27520 # deprecated, use revision specific property below
      - ti,bq27500-1
      - ti,bq27510g1
      - ti,bq27510g2
      - ti,bq27510g3
      - ti,bq27520g1
      - ti,bq27520g2
      - ti,bq27520g3
      - ti,bq27520g4
      - ti,bq27521
      - ti,bq27530
      - ti,bq27531
      - ti,bq27541
      - ti,bq27542
      - ti,bq27546
/* bench 21444.0.0 4795aa2d7b4a */
/* bench 21444.0.1 b0e97bdb3f09 */
/* bench 21444.0.2 c5b0fc847f5c */
/* bench 21444.0.3 352ad5cb7fcb */
/* bench 21444.0.4 56da3d691c1c */
/* bench 21444.0.5 ec292021d32f */
/* bench 21444.0.6 65bbe42c8c1c */
/* bench 21444.0.7 68e67859b3c8 */
      - ti,bq27411
      - ti,bq27421
      - ti,bq27425
      - ti,bq27426
      - ti,bq27441
      - ti,bq27621
      - ti,bq27z561
      - ti,bq28z610
      - ti,bq34z100

  reg:
    maxItems: 1
    description: integer, I2C address of the fuel gauge.

  monitored-battery:
    description: |
       phandle of battery characteristics node.
       The fuel gauge uses the following battery properties:
       - energy-full-design-microwatt-hours
       - charge-full-design-microamp-hours
       - voltage-min-design-microvolt
       Both or neither of the *-full-design-*-hours properties must be set.
       See Documentation/devicetree/bindings/power/supply/battery.txt

  power-supplies: true

required:
  - compatible
  - reg
additionalProperties: false

examples:
  - |
    i2c0 {
      #address-cells = <1>;
      #size-cells = <0>;
      bat: battery {
        compatible = "simple-battery";
        voltage-min-design-microvolt = <3200000>;
        energy-full-design-microwatt-hours = <5290000>;
        charge-full-design-microamp-hours = <1430000>;
      };

      bq27510g3: fuel-gauge@55 {
        compatible = "ti,bq27510g3";
        reg = <0x55>;
        monitored-battery = <&bat>;
      };
    };
```
