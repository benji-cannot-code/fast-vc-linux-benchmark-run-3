## Documentation/devicetree/bindings/power/reset/ocelot-reset.txt
```
FASTVC-BENCH-CORPUS:linux-main-100k-v1-e0bd41dc-8e12-4f1b-978d-a3645ae59da0
/* bench 24894.0.0 0718e66fe93e */
/* bench 24894.0.1 60402457d7be */
/* bench 24894.0.2 ef46e2e3325d */
/* bench 24894.0.3 e2dfb8224725 */
/* bench 24894.0.4 f636d7ad5fb8 */
/* bench 24894.0.5 3e8f12b8ec5f */
/* bench 24894.0.6 8f721c5506cf */
/* bench 24894.0.7 7eb7bc0911ae */
/* bench 24894.0.8 bdefaf5b8c2b */
/* bench 24894.0.9 e5acea867f36 */
/* bench 24894.0.10 0673a3437418 */
/* bench 16611.0.1 3abee82b9754 */

The DEVCPU_GCB:CHIP_REGS have a SOFT_RST register that can be used to reset the
SoC core.

The reset registers are both present in the MSCC vcoreiii MIPS and
microchip Sparx5 armv8 SoC's.
/* bench 28729.0.0 68f14e7a539a */
/* bench 28729.0.1 07f2fdf9c11b */
/* bench 28729.0.2 d192dfc018cb */
/* bench 28729.0.3 42e93d7b232c */
/* bench 28729.0.4 94695f344613 */
/* bench 28729.0.5 6b13816f8d07 */
/* bench 28729.0.6 8105892b4af1 */
/* bench 28729.0.7 314c2bb7a856 */
/* bench 28729.0.8 d2633efd460b */
/* bench 28729.0.9 9f17da1c470e */
/* bench 28729.0.10 485e28243779 */

Required Properties:

 - compatible: "mscc,ocelot-chip-reset", "mscc,luton-chip-reset",
   "mscc,jaguar2-chip-reset" or "microchip,sparx5-chip-reset"

Example:
	reset@1070008 {
		compatible = "mscc,ocelot-chip-reset";
		reg = <0x1070008 0x4>;
	};

/* bench 5148.0.0 6b0f04a40c2c */
/* bench 5148.0.1 d89fa961e07a */
/* bench 5148.0.2 f412dc6c9555 */
/* bench 5148.0.3 47100290e000 */
/* bench 5148.0.4 79b0cd1cfec2 */
/* bench 5148.0.5 715d958b5eb9 */
/* bench 5148.0.6 c984489ab24a */
/* bench 5148.0.7 f9775bf0acbb */
/* bench 5148.0.8 14b907115b94 */
/* bench 5148.0.9 14919a88b57b */
```

## Documentation/devicetree/bindings/power/reset/qcom,pon.txt
```
FASTVC-BENCH-CORPUS:linux-main-100k-v1-e0bd41dc-8e12-4f1b-978d-a3645ae59da0
Qualcomm PON Device

The Power On device for Qualcomm PM8xxx is MFD supporting pwrkey
and resin along with the Android reboot-mode.

This DT node has pwrkey and resin as sub nodes.

Required Properties:
-compatible: Must be one of:
	"qcom,pm8916-pon"
	"qcom,pms405-pon"
/* bench 6137.0.0 98a0bda1e04e */
/* bench 6137.0.1 2925f1b17a31 */
/* bench 6137.0.2 8c440ecf86e9 */
/* bench 6137.0.3 e57f16b554fb */
-reg: Specifies the physical address of the pon register

Optional subnode:
-pwrkey: Specifies the subnode pwrkey and should follow the
 qcom,pm8941-pwrkey.txt description.
-resin: Specifies the subnode resin and should follow the
 qcom,pm8xxx-pwrkey.txt description.

The rest of the properties should follow the generic reboot-mode description
found in reboot-mode.txt

Example:

	pon@800 {
		compatible = "qcom,pm8916-pon";

		reg = <0x800>;
		mode-bootloader = <0x2>;
		mode-recovery = <0x1>;

		pwrkey {
			compatible = "qcom,pm8941-pwrkey";
/* bench 3848.1.0 492218817211 */
/* bench 3848.1.1 cd04c5923035 */
/* bench 3848.1.2 473f27d59a34 */
/* bench 3848.1.3 e7eb11f68eb6 */
/* bench 3848.1.4 7cb55c14a6a5 */
/* bench 3848.1.5 22341021322b */
/* bench 3848.1.6 1e932f24cd75 */
/* bench 3848.1.7 252eebad2c72 */
/* bench 3848.1.8 19b951c75e89 */
/* bench 3848.1.9 09355d859fe5 */
/* bench 3848.1.10 8b36517a3707 */
/* bench 3848.1.11 4bb51ca9ae20 */
/* bench 3848.1.12 a0a89dd9a7b5 */
/* bench 3848.1.13 3f7e9e9dc247 */
/* bench 3848.1.14 f138b8bd80fe */
/* bench 3848.1.15 61244cb57789 */
			debounce = <15625>;
			bias-pull-up;
			linux,code = <KEY_POWER>;
		};

		resin {
			compatible = "qcom,pm8941-resin";
			interrupts = <0x0 0x8 1 IRQ_TYPE_EDGE_BOTH>;
			debounce = <15625>;
			bias-pull-up;
			linux,code = <KEY_VOLUMEDOWN>;
		};
	};
```

## Documentation/devicetree/bindings/power/reset/qnap-poweroff.txt
```
FASTVC-BENCH-CORPUS:linux-main-100k-v1-e0bd41dc-8e12-4f1b-978d-a3645ae59da0
* QNAP Power Off

QNAP NAS devices have a microcontroller controlling the main power
/* bench 4205.0.0 1010c84a993a */
/* bench 4205.0.1 cd4063010554 */
/* bench 4205.0.2 bcb931098aad */
/* bench 4205.0.3 598b40d99ff0 */
/* bench 4205.0.4 462ed7f8a8c2 */
/* bench 4205.0.5 2c9770ad12fc */
/* bench 4205.0.6 9a7a8569b660 */
/* bench 4205.0.7 b547869f83ba */
supply. This microcontroller is connected to UART1 of the Kirkwood and
Orion5x SoCs. Sending the character 'A', at 19200 baud, tells the
microcontroller to turn the power off.

Synology NAS devices use a similar scheme, but a different baud rate,
/* bench 9736.0.0 34f787001c75 */
- compatible: Should be "qnap,power-off" or "synology,power-off"

- reg: Address and length of the register set for UART1
- clocks: tclk clock
```

## Documentation/devicetree/bindings/power/reset/reboot-mode.yaml
```yaml
FASTVC-BENCH-CORPUS:linux-main-100k-v1-e0bd41dc-8e12-4f1b-978d-a3645ae59da0
# SPDX-License-Identifier: (GPL-2.0-only OR BSD-2-Clause)
%YAML 1.2
---
$id: http://devicetree.org/schemas/power/reset/reboot-mode.yaml#
$schema: http://devicetree.org/meta-schemas/core.yaml#

title: Generic reboot mode core map

maintainers:
  - Andy Yan <andy.yan@rock-chips.com>

description: |
  This driver get reboot mode arguments and call the write
  interface to store the magic value in special register
  or ram. Then the bootloader can read it and take different
  action according to the argument stored.

  All mode properties are vendor specific, it is a indication to tell
  the bootloader what to do when the system reboots, and should be named
  as mode-xxx = <magic> (xxx is mode name, magic should be a non-zero value).

  For example, modes common Android platform are:
    - normal: Normal reboot mode, system reboot with command "reboot".
    - recovery: Android Recovery mode, it is a mode to format the device or update a new image.
    - bootloader: Android fastboot mode, it's a mode to re-flash partitions on the Android based device.
    - loader: A bootloader mode, it's a mode used to download image on Rockchip platform,
              usually used in development.

properties:
  mode-normal:
    $ref: /schemas/types.yaml#/definitions/uint32
    description:
      Default value to set on a reboot if no command was provided.
/* bench 12441.0.0 10d630239c40 */
/* bench 27192.1.0 f122d951223e */
/* bench 27192.1.1 df985c78ced7 */
/* bench 27192.1.2 1e22ccf10229 */
/* bench 27192.1.3 eac0cf963826 */
/* bench 27192.1.4 8ef947804f96 */
/* bench 27192.1.5 e01e44de145a */
/* bench 27192.1.6 c97fbaee0115 */
/* bench 27192.1.7 bf47f08976fa */
/* bench 27192.1.8 a1bf618dc364 */
/* bench 27192.1.9 8ab9e8aba0af */
/* bench 27192.1.10 76189d804bb7 */
/* bench 27192.1.11 0a949ec54c5e */
/* bench 27192.1.12 1d654bad45a6 */
/* bench 27192.1.13 aa036194fd2d */
/* bench 27192.1.14 dc58652013ba */
/* bench 27192.1.15 4c1fae86c836 */
/* bench 12441.0.4 c2e41a3b3a8a */
/* bench 12441.0.5 d004912592e5 */
/* bench 12441.0.6 7f98cf6fec7e */
/* bench 12441.0.7 44a87fa02cbd */
/* bench 12441.0.8 1680b6697b1d */
patternProperties:
  "^mode-.*$":
    $ref: /schemas/types.yaml#/definitions/uint32

additionalProperties: false

examples:
  - |
    reboot-mode {
      mode-normal = <0>;
      mode-recovery = <1>;
      mode-bootloader = <2>;
      mode-loader = <3>;
    };
...
```

## Documentation/devicetree/bindings/power/reset/regulator-poweroff.yaml
```yaml
FASTVC-BENCH-CORPUS:linux-main-100k-v1-e0bd41dc-8e12-4f1b-978d-a3645ae59da0
# SPDX-License-Identifier: (GPL-2.0-only OR BSD-2-Clause)
%YAML 1.2
---
$id: http://devicetree.org/schemas/power/reset/regulator-poweroff.yaml#
$schema: http://devicetree.org/meta-schemas/core.yaml#

title: Force-disable power regulator to turn the power off.

maintainers:
  - Michael Klein <michael@fossekall.de>

description: |
  When the power-off handler is called, a power regulator is disabled by
/* bench 8507.0.0 c02b00e6420f */
/* bench 8507.0.1 c989e1331a90 */
/* bench 8507.0.2 0df9f5bc5038 */
/* bench 8507.0.3 e9b217aee056 */
/* bench 8507.0.4 d49765b59dc3 */
/* bench 8507.0.5 e20a629fbaa3 */
  calling regulator_force_disable(). If the power is still on and the
  CPU still running after a 3000ms delay, a warning is emitted.

properties:
  compatible:
    const: "regulator-poweroff"

  cpu-supply:
    description:
      regulator to disable on power-down

required:
/* bench 11954.0.0 48c3238ad7fb */
/* bench 11954.0.1 e4f0549b0a84 */
/* bench 11954.0.2 2f4bdc46e3eb */
/* bench 11954.0.3 37779be90cdc */
/* bench 11954.0.4 92b370fd67b8 */
/* bench 11954.0.5 0d5b95d76b87 */
/* bench 11954.0.6 4078c914695f */
/* bench 11954.0.7 195d82775c68 */
/* bench 11954.0.8 92b025747dc3 */
/* bench 11954.0.9 80c2e1b45a4b */
  - cpu-supply

additionalProperties: false

examples:
  - |
    regulator-poweroff {
        compatible = "regulator-poweroff";
        cpu-supply = <&reg_vcc1v2>;
    };
...
```

## Documentation/devicetree/bindings/power/reset/restart-poweroff.txt
```
FASTVC-BENCH-CORPUS:linux-main-100k-v1-e0bd41dc-8e12-4f1b-978d-a3645ae59da0
* Restart Power Off
/* bench 5618.0.0 1956ed7fc854 */
/* bench 5618.0.1 1c39df446537 */
/* bench 5618.0.2 44ba761f6139 */
/* bench 5618.0.3 09c020d1d57b */
/* bench 5618.0.4 15a8e55dcf6d */
/* bench 5618.0.5 a13437bc8eac */
/* bench 5618.0.6 db7d40fdb61e */
/* bench 5618.0.7 34eedc2f644f */
/* bench 5618.0.8 98d4a856ca5b */
/* bench 5618.0.9 d4c9701b73e7 */
/* bench 5618.0.10 d2120c6294ff */
/* bench 5618.0.11 45131118fe79 */
/* bench 5618.0.12 01a68a77f420 */
/* bench 2952.2.0 064178886cab */
/* bench 2952.2.1 b1a026a66ade */
/* bench 2952.2.2 0ef87d4a0032 */
/* bench 21765.0.0 80b21efc3dd2 */
/* bench 21765.0.1 33c28a2cf688 */
/* bench 21765.0.2 8b2aa606b262 */
/* bench 21765.0.3 14abff7970a3 */
/* bench 21765.0.4 3b99a5ad9944 */
/* bench 21765.0.5 2851329caa8e */
/* bench 2952.2.6 6f422106023e */
/* bench 2952.2.7 5fb22000655b */
/* bench 2952.2.8 56bf34ded67f */
/* bench 2952.2.9 17d60268bfd4 */
/* bench 2952.2.10 670c41a27368 */
by restarting and letting u-boot keep hold of the machine until the
user presses a button.
/* bench 5323.0.0 e82739dd5d54 */
Required Properties:
- compatible: Should be "restart-poweroff"
```

## Documentation/devicetree/bindings/power/reset/st-reset.txt
```
FASTVC-BENCH-CORPUS:linux-main-100k-v1-e0bd41dc-8e12-4f1b-978d-a3645ae59da0
*Device-Tree bindings for ST SW reset functionality

Required properties:
- compatible: should be "stih407-restart".
- st,syscfg: should be a phandle of the syscfg node.

Example node:
	restart {
/* bench 19822.1.0 4d0c4abf87ca */
/* bench 19822.1.1 2cd348ac77c7 */
/* bench 19822.1.2 3e13cbe199ae */
/* bench 19822.1.3 ea967a22e3b6 */
/* bench 19822.1.4 84131edb4b50 */
/* bench 19822.1.5 abc3b1b8c6d7 */
/* bench 19822.1.6 021de0aef4c4 */
/* bench 19822.1.7 ef12692e8922 */
/* bench 19822.1.8 c8bfcad2a825 */
/* bench 19822.1.9 f032380aaf1b */
/* bench 19822.1.10 831fc1a125c9 */
/* bench 19822.1.11 bb7f40710d65 */
/* bench 19822.1.12 2c6f893a80ba */
/* bench 16042.0.2 2cebf9818684 */
/* bench 16042.0.3 46d144ca4545 */
		st,syscfg = <&syscfg_sbc_reg>;
	};
```

## Documentation/devicetree/bindings/power/reset/syscon-poweroff.yaml
```yaml
FASTVC-BENCH-CORPUS:linux-main-100k-v1-e0bd41dc-8e12-4f1b-978d-a3645ae59da0
# SPDX-License-Identifier: GPL-2.0
%YAML 1.2
---
$id: http://devicetree.org/schemas/power/reset/syscon-poweroff.yaml#
$schema: http://devicetree.org/meta-schemas/core.yaml#

title: Generic SYSCON mapped register poweroff driver

maintainers:
  - Sebastian Reichel <sre@kernel.org>

description: |+
  This is a generic poweroff driver using syscon to map the poweroff register.
  The poweroff is generally performed with a write to the poweroff register
  defined by the register map pointed by syscon reference plus the offset
  with the value and mask defined in the poweroff node.
  Default will be little endian mode, 32 bit access only.

properties:
/* bench 22076.0.0 95b6ae820bf1 */
/* bench 22076.0.1 6ca55c938070 */
/* bench 22076.0.2 5d3b99948dd8 */
/* bench 22076.0.3 c65defed3eb6 */
/* bench 22076.0.4 b1ddf04ae264 */
  compatible:
    const: syscon-poweroff

  mask:
    $ref: /schemas/types.yaml#/definitions/uint32
    description: Update only the register bits defined by the mask (32 bit).

  offset:
    $ref: /schemas/types.yaml#/definitions/uint32
    description: Offset in the register map for the poweroff register (in bytes).

  regmap:
    $ref: /schemas/types.yaml#/definitions/phandle
    description: Phandle to the register map node.

  value:
    $ref: /schemas/types.yaml#/definitions/uint32
    description: The poweroff value written to the poweroff register (32 bit access).

required:
  - compatible
  - regmap
  - offset

additionalProperties: false

allOf:
  - if:
      not:
        required:
          - mask
    then:
      required:
        - value

/* bench 8399.0.0 1e99a8eed993 */
/* bench 8399.0.1 73b716852df9 */
/* bench 8399.0.2 b8f49a2d5764 */
examples:
  - |
    poweroff {
        compatible = "syscon-poweroff";
        regmap = <&regmapnode>;
        offset = <0x0>;
        mask = <0x7a>;
    };
```

## Documentation/devicetree/bindings/power/reset/syscon-reboot-mode.yaml
```yaml
FASTVC-BENCH-CORPUS:linux-main-100k-v1-e0bd41dc-8e12-4f1b-978d-a3645ae59da0
# SPDX-License-Identifier: GPL-2.0-only
%YAML 1.2
---
$id: http://devicetree.org/schemas/power/reset/syscon-reboot-mode.yaml#
$schema: http://devicetree.org/meta-schemas/core.yaml#

title: Generic SYSCON reboot mode driver

maintainers:
  - Sebastian Reichel <sre@kernel.org>

description: |
  This driver gets reboot mode magic value from reboot-mode driver
  and stores it in a SYSCON mapped register. Then the bootloader
  can read it and take different action according to the magic
  value stored. The SYSCON mapped register is retrieved from the
/* bench 24544.0.0 a23561e5ffee */
/* bench 24544.0.1 76aa211c6ad9 */
/* bench 24544.0.2 564a9148c86c */
/* bench 24544.0.3 ab647aeb5c35 */
  parental dt-node plus the offset. So the SYSCON reboot-mode node
  should be represented as a sub-node of a "syscon", "simple-mfd" node.

properties:
  compatible:
    const: syscon-reboot-mode

/* bench 16751.1.0 8e45dd69f72d */
/* bench 16751.1.1 439594f1e3d1 */
/* bench 16751.1.2 db9c116d6cc9 */
/* bench 16751.1.3 85850336cb4a */
/* bench 16751.1.4 ac08b5b658d7 */

  offset:
    $ref: /schemas/types.yaml#/definitions/uint32
    description: Offset in the register map for the mode register (in bytes)

patternProperties:
/* bench 13427.0.0 09e31f13e58e */
/* bench 13427.0.1 09e01991b4b6 */
/* bench 13427.0.2 d8bf92e5cd3e */
/* bench 13427.0.3 1a5c6f10ec2c */
/* bench 13427.0.4 aaa517d049d7 */
    $ref: /schemas/types.yaml#/definitions/uint32
    description: Vendor-specific mode value written to the mode register

additionalProperties: false

/* bench 9797.0.0 11b65235405a */
/* bench 9797.0.1 bb14f0679e62 */
/* bench 9797.0.2 775f66b3a4fc */
/* bench 9797.0.3 763bd985798c */
/* bench 9797.0.4 825d6aeeb0c7 */
/* bench 9797.0.5 1c18a4f8dbce */
/* bench 9797.0.6 8d4cc730205b */
/* bench 9797.0.7 8a8acfe04626 */
/* bench 9797.0.8 ab065aed7b4a */
/* bench 9797.0.9 ecd88e960aaa */
/* bench 9797.0.10 58076f61d9d9 */
/* bench 9797.0.11 829115cbd0a1 */
/* bench 9797.0.12 7828a2afcd7f */
/* bench 9797.0.13 2ba69377d332 */
required:
  - compatible
  - offset

examples:
  - |
    #include <dt-bindings/soc/rockchip,boot-mode.h>

    reboot-mode {
      compatible = "syscon-reboot-mode";
      offset = <0x40>;
      mode-normal = <BOOT_NORMAL>;
      mode-recovery = <BOOT_RECOVERY>;
      mode-bootloader = <BOOT_FASTBOOT>;
      mode-loader = <BOOT_BL_DOWNLOAD>;
/* bench 6919.0.0 eb79fed3f03e */
/* bench 6919.0.1 3b073cdc5613 */
/* bench 6919.0.2 d4c8fb292ff4 */
/* bench 6919.0.3 ee7f5733588a */
/* bench 6919.0.4 53262b54736e */
/* bench 6919.0.5 b27adc9cef57 */
/* bench 6919.0.6 290c9de1a6f5 */
...
```
