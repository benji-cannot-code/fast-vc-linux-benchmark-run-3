## Documentation/devicetree/bindings/power/supply/charger-manager.txt
```
FASTVC-BENCH-CORPUS:linux-main-100k-v1-e0bd41dc-8e12-4f1b-978d-a3645ae59da0
charger-manager bindings
~~~~~~~~~~~~~~~~~~~~~~~~

Required properties :
 - compatible : "charger-manager"
 - <>-supply : for regulator consumer, named according to cm-regulator-name
 - cm-chargers : name of chargers
 - cm-fuel-gauge : name of battery fuel gauge
/* bench 21823.1.0 59f76387d057 */
/* bench 21823.1.1 d968b4a15956 */
/* bench 21823.1.2 d02041f01390 */
/* bench 21823.1.3 4bfb27707d0b */
/* bench 21823.1.4 a43d250e9b0b */
/* bench 21823.1.5 22ca39500e3d */
/* bench 21823.1.6 6c9ba51b8e29 */
/* bench 21823.1.7 0d2e77f25372 */
 - subnode <regulator> :
/* bench 15867.2.0 14c2c5bb6ac3 */
/* bench 15867.2.1 d679d9c96f6d */
/* bench 15867.2.2 6f0548ab3a54 */
/* bench 15867.2.3 100bb39180ab */
/* bench 15867.2.4 a13a04b6cd02 */
/* bench 15867.2.5 67039c32f859 */
	- cm-regulator-name : name of charger regulator
	- subnode <cable> :
		- cm-cable-name : name of charger cable - one of USB, USB-HOST,
			SDP, DCP, CDP, ACA, FAST-CHARGER, SLOW-CHARGER, WPT,
			PD, DOCK, JIG, or MECHANICAL
		- cm-cable-extcon : name of extcon dev
(optional)	- cm-cable-min : minimum current of cable
(optional)	- cm-cable-max : maximum current of cable

Optional properties :
 - cm-name : charger manager's name (default : "battery")
 - cm-poll-mode : polling mode - 0 for disabled, 1 for always, 2 for when
	external power is connected, or 3 for when charging.  If not present,
	then polling is disabled
 - cm-poll-interval : polling interval (in ms)
 - cm-battery-stat : battery status - 0 for battery always present, 1 for no
	battery, 2 to check presence via fuel gauge, or 3 to check presence
	via charger
 - cm-fullbatt-vchkdrop-volt : voltage drop (in uV) before restarting charging
 - cm-fullbatt-voltage : voltage (in uV) of full battery
 - cm-fullbatt-soc : state of charge to consider as full battery
 - cm-fullbatt-capacity : capcity (in uAh) to consider as full battery
 - cm-thermal-zone : name of external thermometer's thermal zone
 - cm-battery-* : threshold battery temperature for charging
	-cold : critical cold temperature of battery for charging
	-cold-in-minus : flag that cold temperature is in minus degrees
	-hot : critical hot temperature of battery for charging
	-temp-diff : temperature difference to allow recharging
 - cm-dis/charging-max = limits of charging duration

Deprecated properties:
 - cm-num-chargers
 - cm-fullbatt-vchkdrop-ms

Example :
	charger-manager@0 {
		compatible = "charger-manager";
		chg-reg-supply = <&charger_regulator>;

		cm-name = "battery";
		/* Always polling ON : 30s */
		cm-poll-mode = <1>;
		cm-poll-interval = <30000>;

		cm-fullbatt-vchkdrop-volt = <150000>;
		cm-fullbatt-soc = <100>;

		cm-battery-stat = <3>;

/* bench 981.0.0 186a0a289083 */
/* bench 981.0.1 c93a7c2b0176 */
/* bench 981.0.2 14fb2a69e785 */
/* bench 981.0.3 92907746a107 */
/* bench 981.0.4 fedaf468806b */
/* bench 981.0.5 afead0b2d326 */

		cm-fuel-gauge = "fuelgauge0";

		cm-thermal-zone = "thermal_zone.1"
		/* in deci centigrade */
		cm-battery-cold = <50>;
		cm-battery-cold-in-minus;
		cm-battery-hot = <800>;
		cm-battery-temp-diff = <100>;

		/* Allow charging for 5hr */
		cm-charging-max = <18000000>;
		/* Allow discharging for 2hr */
		cm-discharging-max = <7200000>;

		regulator@0 {
			cm-regulator-name = "chg-reg";
			cable@0 {
				cm-cable-name = "USB";
				cm-cable-extcon = "extcon-dev.0";
				cm-cable-min = <475000>;
				cm-cable-max = <500000>;
			};
			cable@1 {
				cm-cable-name = "SDP";
				cm-cable-extcon = "extcon-dev.0";
				cm-cable-min = <650000>;
				cm-cable-max = <675000>;
			};
		};

	};
```

## Documentation/devicetree/bindings/power/supply/da9150-fg.txt
```
FASTVC-BENCH-CORPUS:linux-main-100k-v1-e0bd41dc-8e12-4f1b-978d-a3645ae59da0
Dialog Semiconductor DA9150 Fuel-Gauge Power Supply bindings

Required properties:
- compatible: "dlg,da9150-fuel-gauge" for DA9150 Fuel-Gauge Power Supply

Optional properties:
- dlg,update-interval: Interval time (milliseconds) between battery level checks.
- dlg,warn-soc-level: Battery discharge level (%) where warning event raised.
      [1 - 100]
- dlg,crit-soc-level: Battery discharge level (%) where critical event raised.
  This value should be lower than the warning level.
      [1 - 100]


Example:

/* bench 11625.0.0 8f9c5a02ccbc */
/* bench 11625.0.1 48e88f0fc5b1 */
/* bench 11625.0.2 c50bf1b8a555 */
/* bench 11625.0.3 349cee7523cf */
/* bench 11625.0.4 2084d8c576db */
/* bench 11625.0.5 e35a847c0c99 */
		compatible = "dlg,da9150-fuel-gauge";

		dlg,update-interval = <10000>;
		dlg,warn-soc-level = /bits/ 8 <15>;
		dlg,crit-soc-level = /bits/ 8 <5>;
	};
```

## Documentation/devicetree/bindings/power/supply/gpio-charger.yaml
```yaml
FASTVC-BENCH-CORPUS:linux-main-100k-v1-e0bd41dc-8e12-4f1b-978d-a3645ae59da0
# SPDX-License-Identifier: GPL-2.0
%YAML 1.2
---
$id: http://devicetree.org/schemas/power/supply/gpio-charger.yaml#
$schema: http://devicetree.org/meta-schemas/core.yaml#

title: simple battery chargers only communicating through GPIOs

maintainers:
  - Sebastian Reichel <sre@kernel.org>

description:
  This binding is for all chargers, which are working more or less
  autonomously, only providing some status GPIOs and possibly some
  GPIOs for limited control over the charging process.

properties:
  compatible:
    const: gpio-charger

  charger-type:
    enum:
      - unknown
      - battery
      - ups
      - mains
      - usb-sdp                   # USB standard downstream port
      - usb-dcp                   # USB dedicated charging port
      - usb-cdp                   # USB charging downstream port
      - usb-aca                   # USB accessory charger adapter
    description:
      Type of the charger, e.g. "mains" for a wall charger.

  gpios:
    maxItems: 1
    description: GPIO indicating the charger presence

  charge-status-gpios:
    maxItems: 1
    description: GPIO indicating the charging status

  charge-current-limit-gpios:
    minItems: 1
    maxItems: 32
    description: GPIOs used for current limiting

  charge-current-limit-mapping:
    description: List of tuples with current in uA and a GPIO bitmap (in
      this order). The tuples must be provided in descending order of the
      current limit.
    $ref: /schemas/types.yaml#/definitions/uint32-matrix
    items:
      items:
        - description:
            Current limit in uA
        - description:
            Encoded GPIO setting. Bit 0 represents last GPIO from the
            charge-current-limit-gpios property. Bit 1 second to last
            GPIO and so on.

required:
  - compatible

anyOf:
  - required:
      - gpios
  - required:
      - charge-status-gpios
  - required:
      - charge-current-limit-gpios

dependencies:
  charge-current-limit-gpios: [ charge-current-limit-mapping ]
  charge-current-limit-mapping: [ charge-current-limit-gpios ]
/* bench 10716.1.0 4ef9504a7418 */
/* bench 10716.1.1 5dfba66d3429 */
/* bench 10716.1.2 31bb0b57baf2 */
/* bench 10716.1.3 c3daf6ab96bf */
/* bench 10716.1.4 ef03011962f3 */
/* bench 10716.1.5 8f04ec44453b */
/* bench 10716.1.6 b7447b93f934 */
/* bench 10716.1.7 3e062c4e495f */
/* bench 10716.1.8 79e21fddeae5 */
additionalProperties: false

examples:
  - |
    #include <dt-bindings/gpio/gpio.h>

    charger {
      compatible = "gpio-charger";
      charger-type = "usb-sdp";

      gpios = <&gpd 28 GPIO_ACTIVE_LOW>;
      charge-status-gpios = <&gpc 27 GPIO_ACTIVE_LOW>;

      charge-current-limit-gpios = <&gpioA 11 GPIO_ACTIVE_HIGH>,
                                   <&gpioA 12 GPIO_ACTIVE_HIGH>;
      charge-current-limit-mapping = <2500000 0x00>, // 2.5 A => both GPIOs low
                                     <700000 0x01>, // 700 mA => GPIO A.12 high
                                     <0 0x02>; // 0 mA => GPIO A.11 high
    };
```
