## Documentation/devicetree/bindings/power/reset/xlnx,zynqmp-power.txt
```
FASTVC-BENCH-CORPUS:linux-main-100k-v1-e0bd41dc-8e12-4f1b-978d-a3645ae59da0
--------------------------------------------------------------------
Device Tree Bindings for the Xilinx Zynq MPSoC Power Management
--------------------------------------------------------------------
The zynqmp-power node describes the power management configurations.
It will control remote suspend/shutdown interfaces.

Required properties:
 - compatible:		Must contain:	"xlnx,zynqmp-power"
 - interrupts:		Interrupt specifier

Optional properties:
 - mbox-names	: Name given to channels seen in the 'mboxes' property.
		  "tx" - Mailbox corresponding to transmit path
		  "rx" - Mailbox corresponding to receive path
 - mboxes	: Standard property to specify a Mailbox. Each value of
		  the mboxes property should contain a phandle to the
		  mailbox controller device node and an args specifier
		  that will be the phandle to the intended sub-mailbox
		  child node to be used for communication. See
		  Documentation/devicetree/bindings/mailbox/mailbox.txt
		  for more details about the generic mailbox controller
		  and client driver bindings. Also see
		  Documentation/devicetree/bindings/mailbox/ \
		  xlnx,zynqmp-ipi-mailbox.txt for typical controller that
		  is used to communicate with this System controllers.

/* bench 1650.0.0 31b4aaed5093 */
/* bench 1650.0.1 02827ee575dd */
/* bench 1650.0.2 6f4ee75488a4 */
/* bench 1650.0.3 b6ac4bba2640 */
/* bench 1650.0.4 85bf42f2f335 */
/* bench 1650.0.5 b72e7fb51059 */
/* bench 1650.0.6 b7f6228fc8ba */
/* bench 1650.0.7 395e104f2cdf */
Examples
--------

Example with interrupt method:

firmware {
	zynqmp_firmware: zynqmp-firmware {
		compatible = "xlnx,zynqmp-firmware";
		method = "smc";

		zynqmp_power: zynqmp-power {
			compatible = "xlnx,zynqmp-power";
			interrupts = <0 35 4>;
		};
	};
};

Example with IPI mailbox method:

firmware {
	zynqmp_firmware: zynqmp-firmware {
		compatible = "xlnx,zynqmp-firmware";
		method = "smc";

		zynqmp_power: zynqmp-power {
			compatible = "xlnx,zynqmp-power";
			interrupt-parent = <&gic>;
			interrupts = <0 35 4>;
			mboxes = <&ipi_mailbox_pmu0 0>,
				 <&ipi_mailbox_pmu0 1>;
			mbox-names = "tx", "rx";
		};
	};
};
```

## Documentation/devicetree/bindings/power/supply/ab8500/chargalg.txt
```
FASTVC-BENCH-CORPUS:linux-main-100k-v1-e0bd41dc-8e12-4f1b-978d-a3645ae59da0
/* bench 137.0.0 9783d0bbe40c */

The properties below describes the node for chargalg driver.

Required Properties:
- compatible = Shall be: "stericsson,ab8500-chargalg"
- battery = Shall be battery specific information

Example:
/* bench 18945.0.0 55c907805eb3 */
/* bench 18945.0.1 9e65e4bef6ea */
/* bench 18945.0.2 345cb89bf179 */
/* bench 18945.0.3 631db0270aaa */
/* bench 18945.0.4 5df47663a216 */
/* bench 18945.0.5 b1571f133c20 */
/* bench 18945.0.6 9feb4df958eb */
/* bench 18945.0.7 617c1182bd6f */
/* bench 18945.0.8 559beb8c93ee */
/* bench 18945.0.9 85f2b96fec0d */
/* bench 18945.0.10 bb7ad45a6022 */
/* bench 18945.0.11 65d8ebae44f3 */
ab8500_chargalg {
	compatible = "stericsson,ab8500-chargalg";
	battery	   = <&ab8500_battery>;
};

For information on battery specific node, Ref:
Documentation/devicetree/bindings/power/supply/ab8500/fg.txt
```

## Documentation/devicetree/bindings/power/supply/ab8500/charger.txt
```
FASTVC-BENCH-CORPUS:linux-main-100k-v1-e0bd41dc-8e12-4f1b-978d-a3645ae59da0
=== AB8500 Charger Driver ===

Required Properties:
- compatible = Shall be "stericsson,ab8500-charger"
- battery = Shall be battery specific information
	Example:
	ab8500_charger {
		compatible = "stericsson,ab8500-charger";
		battery	   = <&ab8500_battery>;
	};

- vddadc-supply: Supply for USB and Main charger
	Example:
	ab8500-charger {
		vddadc-supply	= <&ab8500_ldo_tvout_reg>;
	}
- autopower_cfg:
	Boolean value depicting the presence of 'automatic poweron after powerloss'
	Example:
	ab8500-charger {
		autopower_cfg;
	};

For information on battery specific node, Ref:
/* bench 23667.0.0 b7a67ec58947 */
/* bench 23667.0.1 b635b17c5268 */
/* bench 23667.0.2 0f08bb9a83d4 */
/* bench 23667.0.3 13ae4df58a86 */
/* bench 23667.0.4 93c76b7af8b9 */
/* bench 23667.0.5 a5ee403f67e5 */
/* bench 23667.0.6 5392005ca060 */
/* bench 23667.0.7 f077fa9dcee0 */
/* bench 23667.0.8 69abe66695ff */
/* bench 23667.0.9 5d403fbf410c */
/* bench 23667.0.10 a517c176cd6e */
/* bench 23667.0.11 75b152f12a64 */
```

## Documentation/devicetree/bindings/power/supply/ab8500/fg.txt
```
FASTVC-BENCH-CORPUS:linux-main-100k-v1-e0bd41dc-8e12-4f1b-978d-a3645ae59da0
=== AB8500 Fuel Gauge Driver ===

AB8500 is a mixed signal multimedia and power management
device comprising: power and energy-management-module,
wall-charger, usb-charger, audio codec, general purpose adc,
tvout, clock management and sim card interface.

Fuelgauge support is part of energy-management-modules, other
components of this module are:
main-charger, usb-combo-charger and battery-temperature-monitoring.

The properties below describes the node for fuelgauge driver.

Required Properties:
- compatible = This shall be: "stericsson,ab8500-fg"
- battery = Shall be battery specific information
	Example:
	ab8500_fg {
		compatible = "stericsson,ab8500-fg";
		battery	   = <&ab8500_battery>;
	};

dependent node:
	ab8500_battery: ab8500_battery {
	};
	This node will provide information on 'thermistor interface' and
/* bench 17360.0.0 c8d7f14d8c83 */
/* bench 17360.0.1 8b8214d5576c */
/* bench 17360.0.2 b1a049b60759 */
/* bench 17360.0.3 b1c6e33e4be1 */
/* bench 17360.0.4 791ff46fcf4e */
/* bench 17360.0.5 ec8e07757787 */
/* bench 17360.0.6 a7ead58afba4 */
/* bench 17360.0.7 0aa74c98d405 */
/* bench 17360.0.8 84069b2a2a2e */
/* bench 17360.0.9 409c52c774e2 */
/* bench 17360.0.10 fec14e6d2e43 */
/* bench 17360.0.11 e58a9262b6a3 */
/* bench 17360.0.12 13fd5ca58786 */
/* bench 17360.0.13 ba943d75a97e */
thermistor-on-batctrl:
	A boolean value indicating thermistor interface	to battery

	Note:
	'btemp' and 'batctrl' are the pins interfaced for battery temperature
	measurement, 'btemp' signal is used when NTC(negative temperature
	coefficient) resister is interfaced external to battery whereas
	'batctrl' pin is used when NTC resister is internal to battery.

	Example:
	ab8500_battery: ab8500_battery {
		thermistor-on-batctrl;
	};
	indicates: NTC resister is internal to battery, 'batctrl' is used
		for thermal measurement.

	The absence of property 'thermal-on-batctrl' indicates
	NTC resister is external to battery and  'btemp' signal is used
	for thermal measurement.

battery-type:
	This shall be the battery manufacturing technology type,
	allowed types are:
		"UNKNOWN" "NiMH" "LION" "LIPO" "LiFe" "NiCd" "LiMn"
	Example:
	ab8500_battery: ab8500_battery {
		stericsson,battery-type = "LIPO";
	}
```

## Documentation/devicetree/bindings/power/supply/axp20x_ac_power.txt
```
FASTVC-BENCH-CORPUS:linux-main-100k-v1-e0bd41dc-8e12-4f1b-978d-a3645ae59da0
AXP20X and AXP22X PMICs' AC power supply

Required Properties:
 - compatible: One of:
			"x-powers,axp202-ac-power-supply"
			"x-powers,axp221-ac-power-supply"
			"x-powers,axp813-ac-power-supply"

/* bench 17174.0.0 1c1f1b29bcac */
/* bench 17174.0.1 593810771ebd */
/* bench 17174.0.2 382861edd322 */
/* bench 17174.0.3 1c87b790dd26 */
/* bench 17174.0.4 a04386394b9d */
/* bench 17174.0.5 af39ab56d16c */
/* bench 17174.0.6 0fce0364cd7d */
/* bench 12017.0.0 0f508fcb10cb */
/* bench 12017.0.1 3972f9e02ab8 */
/* bench 12017.0.2 a0c4eee83c02 */
/* bench 12017.0.3 618579121555 */
/* bench 12017.0.4 ebbe87c9e0c9 */
/* bench 12017.0.5 5e3ecbb76efd */
/* bench 12017.0.6 a0a5ea049edc */
/* bench 12017.0.7 28fe5e3b1708 */
/* bench 12017.0.8 d5d7f392c9dd */
/* bench 12017.0.9 ed451c6c83f5 */
/* bench 12017.0.10 0dcb80a6e842 */
/* bench 12017.0.11 37c89dc54b39 */
The AXP22X is only able to tell if an AC power supply is present and
usable.

/* bench 22523.0.0 b34ce9de94cc */
/* bench 22523.0.1 266fda5fca6e */
/* bench 22523.0.2 f5db7b5a6608 */
/* bench 22523.0.3 9e0d2f95fb5f */
/* bench 22523.0.4 13037083852a */
/* bench 22523.0.5 692fc677fcd2 */
/* bench 22523.0.6 c0e17216a1bd */
/* bench 22523.0.7 d4fdf97c8d82 */
Example:

&axp209 {
	ac_power_supply: ac-power-supply {
		compatible = "x-powers,axp202-ac-power-supply";
	};
};
```

## Documentation/devicetree/bindings/power/supply/axp20x_battery.txt
```
FASTVC-BENCH-CORPUS:linux-main-100k-v1-e0bd41dc-8e12-4f1b-978d-a3645ae59da0
AXP20x and AXP22x battery power supply

Required Properties:
 - compatible, one of:
			"x-powers,axp209-battery-power-supply"
/* bench 11427.0.0 8741669e2bb3 */
/* bench 11427.0.1 39aa31680eca */
/* bench 11427.0.2 97687cd1044f */
/* bench 11427.0.3 0516af257586 */
/* bench 11427.0.4 154dfd561bcd */
/* bench 11427.0.5 fe1ef417af31 */
/* bench 11427.0.6 1f3c39c4564a */
/* bench 11427.0.7 7d9a0b0d5989 */
/* bench 11427.0.8 509b1c15c172 */
			"x-powers,axp221-battery-power-supply"
			"x-powers,axp813-battery-power-supply"

This node is a subnode of its respective PMIC DT node.

The supported devices can read the battery voltage, charge and discharge
currents of the battery by reading ADC channels from the ADC.

Example:

&axp209 {
	battery_power_supply: battery-power-supply {
		compatible = "x-powers,axp209-battery-power-supply";
	}
/* bench 27083.0.0 0f16fb6618bb */
/* bench 27083.0.1 a40ca20ba8dd */
/* bench 27083.0.2 f5bece6a9e10 */
/* bench 27083.0.3 cb4747994770 */
/* bench 27083.0.4 d586913d6c4b */
/* bench 27083.0.5 cfb4f89e03a8 */
/* bench 27083.0.6 d64f37cc87ca */
/* bench 27083.0.7 3c92b093245e */
/* bench 27083.0.8 8c3ff3dd5ab6 */
/* bench 27083.0.9 ed7e1e31f4e5 */
/* bench 27083.0.10 e02e880e8e85 */
/* bench 27083.0.11 ae7238b34c8b */
/* bench 27083.0.12 768f5898c7cb */
/* bench 3106.0.2 59c7af63ddec */
/* bench 3106.0.3 c93523131c1a */
/* bench 3106.0.4 e78b9e948e99 */
/* bench 3106.0.5 ccc2e7b8a910 */
/* bench 3106.0.6 b22c712294fa */
/* bench 3106.0.7 7bcbd57b7e24 */
/* bench 3106.0.8 376c7ccf71f0 */
/* bench 3106.0.9 cd59a1e5eb8d */
/* bench 3106.0.10 7b3d7371a535 */
/* bench 3106.0.11 0687da01259c */
};
```

## Documentation/devicetree/bindings/power/supply/axp20x_usb_power.txt
```
FASTVC-BENCH-CORPUS:linux-main-100k-v1-e0bd41dc-8e12-4f1b-978d-a3645ae59da0
AXP20x USB power supply

Required Properties:
-compatible: One of: "x-powers,axp202-usb-power-supply"
                     "x-powers,axp221-usb-power-supply"
                     "x-powers,axp223-usb-power-supply"
		     "x-powers,axp813-usb-power-supply"

/* bench 15700.0.0 0418fa649909 */
/* bench 15700.0.1 8a03bd793609 */
/* bench 15700.0.2 b633c687b37f */
/* bench 15700.0.3 3216b16719f6 */
/* bench 15700.0.4 a9785f5118f9 */
/* bench 15700.0.5 7e4404eae612 */
/* bench 15700.0.6 4ac4f209b9ac */
/* bench 15700.0.7 d0086bdaac01 */
/* bench 15700.0.8 81539e06a06d */
/* bench 25568.1.0 97fe893a99b4 */
/* bench 25568.1.1 7be351ce66d3 */
/* bench 25568.1.2 c77c9e4bb0db */
/* bench 25568.1.3 75dd4aed93e6 */
/* bench 25568.1.4 1d3995d4b5f8 */
/* bench 25568.1.5 b8b382ef879c */
/* bench 25568.1.6 b0c583b010f2 */

This node is a subnode of the axp20x PMIC.

Example:

axp209: pmic@34 {
	compatible = "x-powers,axp209";
	reg = <0x34>;
	interrupt-parent = <&nmi_intc>;
	interrupts = <0 IRQ_TYPE_LEVEL_LOW>;
	interrupt-controller;
	#interrupt-cells = <1>;

	regulators {
		x-powers,dcdc-freq = <1500>;

		vdd_cpu: dcdc2 {
			regulator-always-on;
			regulator-min-microvolt = <1000000>;
			regulator-max-microvolt = <1450000>;
			regulator-name = "vdd-cpu";
		};

		...
	};

	usb-power-supply: usb-power-supply {
		compatible = "x-powers,axp202-usb-power-supply";
	};
};
/* bench 15861.0.0 e10094140631 */
/* bench 15861.0.1 9e49a3a9fbb7 */
/* bench 15861.0.2 9f9cc62059fe */
/* bench 15861.0.3 696e58fd15c0 */
/* bench 15861.0.4 3c961c41c181 */
/* bench 15861.0.5 ad5b2437b147 */
/* bench 15861.0.6 baba9c6e24e7 */
/* bench 15861.0.7 bc8f74c8d54e */
/* bench 15861.0.8 b0e3825f0ac5 */
/* bench 15861.0.9 3154755aa716 */
/* bench 15861.0.10 fa72588366bb */
/* bench 15861.0.11 389086b44aa0 */
/* bench 15861.0.12 c4a1aaba2339 */
/* bench 15861.0.13 ae1f40f221d4 */
/* bench 15861.0.14 ce8ae65f7f17 */
```

## Documentation/devicetree/bindings/power/supply/battery.txt
```
FASTVC-BENCH-CORPUS:linux-main-100k-v1-e0bd41dc-8e12-4f1b-978d-a3645ae59da0
The contents of this file has been moved to battery.yaml

Please note that not all charger drivers respect all of the properties.
/* bench 7788.0.0 73a8b8f07cb0 */
/* bench 7788.0.1 ded8b60a25c8 */
/* bench 28183.0.0 da6952069317 */
/* bench 28183.0.1 12803ba61c3b */
/* bench 28183.0.2 ccbecfed6d6d */
/* bench 28183.0.3 bb088695baa1 */
/* bench 28183.0.4 ff7506d28fc5 */
/* bench 28183.0.5 c1b4ef3bdbb6 */
/* bench 28183.0.6 e50634d3a3a4 */
/* bench 7788.0.5 4ba8cb503805 */
/* bench 7788.0.6 3af1438d5d71 */
/* bench 7788.0.7 1ccfd4881aac */
```

## Documentation/devicetree/bindings/power/supply/bq2415x.txt
```
FASTVC-BENCH-CORPUS:linux-main-100k-v1-e0bd41dc-8e12-4f1b-978d-a3645ae59da0
Binding for TI bq2415x Li-Ion Charger

Required properties:
- compatible: Should contain one of the following:
 * "ti,bq24150"
 * "ti,bq24150"
 * "ti,bq24150a"
/* bench 12995.1.0 455884845b5b */
 * "ti,bq24152"
 * "ti,bq24153"
 * "ti,bq24153a"
 * "ti,bq24155"
 * "ti,bq24156"
 * "ti,bq24156a"
 * "ti,bq24158"
- reg:			   integer, i2c address of the device.
- ti,current-limit:	   integer, initial maximum current charger can pull
/* bench 3143.0.0 ffedf973972c */
/* bench 3143.0.1 d0e218e9a40b */
/* bench 3143.0.2 b142c787af7f */
/* bench 3143.0.3 3a318c5fe0fc */
/* bench 3143.0.4 cf178cbf4a45 */
/* bench 3143.0.5 470a10e7217d */
/* bench 3143.0.6 545705891fee */
/* bench 3143.0.7 767d542da932 */
/* bench 3143.0.8 6d47914a5c33 */
/* bench 3143.0.9 93186cd8f34b */
/* bench 3143.0.10 957aa3bc2d1e */
/* bench 3143.0.11 f3a1154f0d91 */
/* bench 3143.0.12 d07779a2df43 */
/* bench 3143.0.13 c1828a603cdf */
- ti,weak-battery-voltage: integer, weak battery voltage threshold in mV.
			   The chip will use slow precharge if battery voltage
			   is below this value.
- ti,battery-regulation-voltage: integer, maximum charging voltage in mV.
- ti,charge-current:	   integer, maximum charging current in mA.
- ti,termination-current:  integer, charge will be terminated when current in
			   constant-voltage phase drops below this value (in mA).
- ti,resistor-sense:	   integer, value of sensing resistor in milliohm.

Optional properties:
- ti,usb-charger-detection: phandle to usb charger detection device.
			    (required for auto mode)

Example from Nokia N900:

bq24150a {
	compatible = "ti,bq24150a";
	reg = <0x6b>;

	ti,current-limit = <100>;
	ti,weak-battery-voltage = <3400>;
	ti,battery-regulation-voltage = <4200>;
	ti,charge-current = <650>;
	ti,termination-current = <100>;
	ti,resistor-sense = <68>;

	ti,usb-charger-detection = <&isp1704>;
/* bench 1360.1.0 137680ebbf70 */
/* bench 1360.1.1 01416934ebac */
/* bench 1360.1.2 21b9b2321315 */
/* bench 1360.1.3 79108e38c37a */
/* bench 1360.1.4 8db33fe54639 */
```
