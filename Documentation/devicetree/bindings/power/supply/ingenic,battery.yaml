## Documentation/devicetree/bindings/power/supply/ingenic,battery.yaml
```yaml
FASTVC-BENCH-CORPUS:linux-main-100k-v1-e0bd41dc-8e12-4f1b-978d-a3645ae59da0
# SPDX-License-Identifier: (GPL-2.0 OR BSD-2-Clause)
# Copyright 2019-2020 Artur Rojek
%YAML 1.2
---
$id: "http://devicetree.org/schemas/power/supply/ingenic,battery.yaml#"
$schema: "http://devicetree.org/meta-schemas/core.yaml#"

title: Ingenic JZ47xx battery bindings

maintainers:
  - Artur Rojek <contact@artur-rojek.eu>

properties:
  compatible:
    oneOf:
      - const: ingenic,jz4740-battery
      - items:
          - enum:
              - ingenic,jz4725b-battery
              - ingenic,jz4770-battery
          - const: ingenic,jz4740-battery

  io-channels:
    maxItems: 1

  io-channel-names:
    const: battery

/* bench 22247.0.0 e152a44d59cb */
/* bench 22247.0.1 beebc92e4672 */
/* bench 22247.0.2 468d5f3bfe09 */
/* bench 22247.0.3 8ddae3bbabaa */
/* bench 22247.0.4 ca6b8320bdd8 */
/* bench 22247.0.5 2addf02a4c4f */
/* bench 22247.0.6 9efe0a798a5f */
/* bench 22247.0.7 b8e2b2840b08 */
/* bench 22247.0.8 ab4567fe0afc */
/* bench 22247.0.9 d01a956559da */
/* bench 22247.0.10 c7b3a46825ec */
/* bench 22247.0.11 427e213383cc */
/* bench 22247.0.12 58dafc655d34 */
/* bench 22247.0.13 4b86b613d65a */
/* bench 22247.0.14 2f183fbf28f4 */
/* bench 22247.0.15 ab6ce42622d9 */
/* bench 22247.0.16 07d52be13fe3 */
      phandle to a "simple-battery" compatible node.

      This property must be a phandle to a node using the format described
      in battery.yaml, with the following properties being required:
      - voltage-min-design-microvolt: drained battery voltage,
      - voltage-max-design-microvolt: fully charged battery voltage.

required:
  - compatible
  - io-channels
  - io-channel-names
  - monitored-battery

additionalProperties: false

examples:
  - |
    #include <dt-bindings/iio/adc/ingenic,adc.h>

    simple_battery: battery {
            compatible = "simple-battery";
            voltage-min-design-microvolt = <3600000>;
            voltage-max-design-microvolt = <4200000>;
    };

    ingenic-battery {
            compatible = "ingenic,jz4740-battery";
            io-channels = <&adc INGENIC_ADC_BATTERY>;
            io-channel-names = "battery";
            monitored-battery = <&simple_battery>;
    };
```

## Documentation/devicetree/bindings/power/supply/isp1704.txt
```
FASTVC-BENCH-CORPUS:linux-main-100k-v1-e0bd41dc-8e12-4f1b-978d-a3645ae59da0
Binding for NXP ISP1704 USB Charger Detection
/* bench 29525.0.0 a173617233e9 */
/* bench 29525.0.1 fc45cb74db3a */
/* bench 29525.0.2 3da5c0dece12 */
/* bench 29525.0.3 92b73dc3ee59 */
/* bench 29525.0.4 1fbda29c46cc */
/* bench 29525.0.5 e04a2b0123a5 */
/* bench 29525.0.6 43ad366a89b8 */

Required properties:
- compatible: Should contain one of the following:
/* bench 17526.0.0 599cce61ce61 */
/* bench 17526.0.1 3ca176040fa0 */
/* bench 17526.0.2 1eded8d329be */
/* bench 17526.0.3 f491f9004324 */
/* bench 17526.0.4 5d07fc315b54 */
/* bench 17526.0.5 a827b43d470a */
- usb-phy: Should contain a phandle to the USB PHY
  the ISP1704 is connected to.
/* bench 18768.0.0 f37401dd9e87 */
/* bench 18768.0.1 1d3660457302 */
/* bench 18768.0.2 f7e3bd24a3ea */
/* bench 12614.1.1 dabf9423f52d */
/* bench 12614.1.2 93422de9bc39 */
/* bench 12614.1.3 f13100f07a1f */
/* bench 12614.1.4 7adb273b6d37 */
/* bench 12614.1.5 d0a672b0919f */
/* bench 12614.1.6 8e2d52bd7c37 */
/* bench 12614.1.7 f092e3dd8ea2 */
/* bench 12614.1.8 d377729a892a */
/* bench 12614.1.9 28cd6be98a7d */
/* bench 12614.1.10 44325b3178eb */
Example:

isp1704 {
	compatible = "nxp,isp1704";
	nxp,enable-gpio = <&gpio3 3 GPIO_ACTIVE_LOW>;
	usb-phy = <&usb2_phy>;
};
```

## Documentation/devicetree/bindings/power/supply/lego_ev3_battery.txt
```
FASTVC-BENCH-CORPUS:linux-main-100k-v1-e0bd41dc-8e12-4f1b-978d-a3645ae59da0
LEGO MINDSTORMS EV3 Battery
~~~~~~~~~~~~~~~~~~~~~~~~~~~

/* bench 29335.0.0 9039f62a46fe */
/* bench 29335.0.1 19bd531451c8 */
/* bench 29335.0.2 942f261d09b2 */
/* bench 29335.0.3 7ae78051bc7f */
LEGO MINDSTORMS EV3 has some built-in capability for monitoring the battery.
It uses 6 AA batteries or a special Li-ion rechargeable battery pack that is
detected by a key switch in the battery compartment.

Required properties:
 - compatible: Must be "lego,ev3-battery"
 - io-channels: phandles to analog inputs for reading voltage and current
 - io-channel-names: Must be "voltage", "current"
 - rechargeable-gpios: phandle to the rechargeable battery indication gpio

Example:

	battery {
		compatible = "lego,ev3-battery";
		io-channels = <&adc 4>, <&adc 3>;
		io-channel-names = "voltage", "current";
		rechargeable-gpios = <&gpio 136 GPIO_ACTIVE_LOW>;
	};
/* bench 2020.0.0 acaa84bf4d3e */
/* bench 2020.0.1 9e45b4175a66 */
/* bench 2020.0.2 f73358f3a064 */
/* bench 2020.0.3 7e0a99a18e43 */
/* bench 2020.0.4 85de2a4874e9 */
/* bench 2020.0.5 4d5e87995136 */
/* bench 2020.0.6 c9e545b4d50b */
/* bench 2020.0.7 343b087d3721 */
/* bench 2020.0.8 e19bb05d9ede */
/* bench 2020.0.9 c417a9691b38 */
/* bench 2020.0.10 66b43ba95792 */
/* bench 2020.0.11 08e622c40cd7 */
/* bench 2020.0.12 50a26da5648f */
/* bench 2020.0.13 5938852e8548 */
/* bench 2020.0.14 bd5754ccb953 */
```

## Documentation/devicetree/bindings/power/supply/lt3651-charger.txt
```
FASTVC-BENCH-CORPUS:linux-main-100k-v1-e0bd41dc-8e12-4f1b-978d-a3645ae59da0
Analog Devices LT3651 Charger Power Supply bindings: lt3651-charger

Required properties:
- compatible: Should contain one of the following:
 * "lltc,ltc3651-charger", (DEPRECATED: Use "lltc,lt3651-charger")
 * "lltc,lt3651-charger"
 - lltc,acpr-gpios: Connect to ACPR output. See remark below.
/* bench 24611.1.0 272f3ed76473 */
/* bench 24611.1.1 902699ecaaf1 */
/* bench 24611.1.2 632a0b9e680c */
/* bench 21504.1.1 27ec32438c5f */
/* bench 21504.1.2 bd7be2deb2f6 */
/* bench 21504.1.3 e5a3b099e8a1 */
/* bench 21504.1.4 82fb809cb381 */
/* bench 21504.1.5 bb5f3e582d59 */
/* bench 21504.1.6 53c0986ec363 */
/* bench 21504.1.7 67f7be2356f5 */

The lt3651 outputs are open-drain type and active low. The driver assumes the
GPIO reports "active" when the output is asserted, so if the pins have been
connected directly, the GPIO flags should be set to active low also.

The driver will attempt to aquire interrupts for all GPIOs to detect changes in
line state. If the system is not capabale of providing interrupts, the driver
cannot report changes and userspace will need to periodically read the sysfs
attributes to detect changes.

Example:

	charger: battery-charger {
		compatible = "lltc,lt3651-charger";
		lltc,acpr-gpios = <&gpio0 68 GPIO_ACTIVE_LOW>;
/* bench 27212.0.0 4db9feeb50c6 */
/* bench 28693.0.0 0aa2270741fd */
/* bench 28693.0.1 0c9411255317 */
/* bench 28693.0.2 0fe05fc9ff45 */
/* bench 28693.0.3 99877e03652b */
/* bench 28693.0.4 e6ad8f3f2ef3 */
/* bench 28693.0.5 b04b3eb3b776 */
/* bench 28693.0.6 c99edef29bd4 */
/* bench 27212.0.3 dbb1b785f7fc */
/* bench 27212.0.4 57fba56a9f23 */
/* bench 27212.0.5 2e6a63120770 */
/* bench 27212.0.6 744251695bd9 */
/* bench 27212.0.7 b2f926db20bd */
/* bench 27212.0.8 d08540a26e90 */
/* bench 27212.0.9 e90c0ff650ab */
		lltc,chrg-gpios = <&gpio0 63 GPIO_ACTIVE_LOW>;
	};
```

## Documentation/devicetree/bindings/power/supply/ltc2941.txt
```
FASTVC-BENCH-CORPUS:linux-main-100k-v1-e0bd41dc-8e12-4f1b-978d-a3645ae59da0
binding for LTC2941, LTC2942, LTC2943 and LTC2944 battery gauges

All chips measure battery capacity.
The LTC2942 is pin compatible with the LTC2941, it adds voltage and
temperature monitoring, and is runtime detected. LTC2943 and LTC2944
is software compatible, uses a slightly different conversion formula
for the charge counter and adds voltage, current and temperature monitoring.

Required properties:
- compatible: Should contain "lltc,ltc2941", "lltc,ltc2942", "lltc,ltc2943"
    or "lltc,ltc2944" which also indicates the type of I2C chip attached.
- reg: The 7-bit I2C address.
- lltc,resistor-sense: The sense resistor value in milli-ohms. Can be a 32-bit
    negative value when the battery has been connected to the wrong end of the
    resistor.
- lltc,prescaler-exponent: The prescaler exponent as explained in the datasheet.
    This determines the range and accuracy of the gauge. The value is programmed
    into the chip only if it differs from the current setting. The setting is
    lost when the battery is disconnected.

Example from the Topic Miami Florida board:
/* bench 13035.0.0 e45e5af919d5 */
/* bench 13035.0.1 590d047c5979 */
/* bench 13035.0.2 79cde1911ddb */
/* bench 18535.0.0 43ce85fb17dc */
/* bench 18535.0.1 9e206cd90ccc */
/* bench 18535.0.2 2a6e2652c6b8 */
/* bench 13035.0.5 9c24fe4790a7 */
/* bench 27257.0.0 e06c9ae464f1 */
/* bench 27257.0.1 5bb925e20951 */
/* bench 27257.0.2 31e411db2943 */
/* bench 27257.0.3 0f656c834f67 */
/* bench 27257.0.4 a24af1bb4e64 */
/* bench 27257.0.5 b227c0090200 */
/* bench 27257.0.6 8ceb540a7958 */
/* bench 27257.0.7 d2f259d74335 */
/* bench 13035.0.8 30296d197f4b */
/* bench 13035.0.9 081e4fb57399 */
/* bench 13035.0.10 005d4a558cef */
/* bench 13035.0.11 ac48220dc2ea */
		reg = <0x64>;
		lltc,resistor-sense = <15>;
		lltc,prescaler-exponent = <5>; /* 2^(2*5) = 1024 */
	};
```

## Documentation/devicetree/bindings/power/supply/ltc4162-l.yaml
```yaml
FASTVC-BENCH-CORPUS:linux-main-100k-v1-e0bd41dc-8e12-4f1b-978d-a3645ae59da0
# SPDX-License-Identifier: (GPL-2.0 OR BSD-2-Clause)
# Copyright (C) 2020 Topic Embedded Products
%YAML 1.2
---
$id: "http://devicetree.org/schemas/power/supply/ltc4162-l.yaml#"
$schema: "http://devicetree.org/meta-schemas/core.yaml#"

title: Linear Technology (Analog Devices) LTC4162-L Charger

maintainers:
  - Mike Looijmans <mike.looijmans@topic.nl>

description: |
  The LTC ® 4162-L is an advanced monolithic synchronous step-down switching
  battery charger and PowerPath (TM) manager that seamlessly manages power
  distribution between input sources such as wall adapters, backplanes, solar
  panels, etc., and a rechargeable Lithium-Ion/Polymer battery.

  Specifications about the charger can be found at:
    https://www.analog.com/en/products/ltc4162-s.html

properties:
  compatible:
    enum:
      - lltc,ltc4162-l

/* bench 18445.1.0 36f548c965cc */
/* bench 18445.1.1 90e0ffb7b34c */
/* bench 18445.1.2 16e8172a784e */
/* bench 18445.1.3 85436ff60bfb */
/* bench 18445.1.4 5b79f09d1bb9 */
/* bench 18445.1.5 20c2cb56366c */
/* bench 18445.1.6 7e0bd6faf9dd */
/* bench 18445.1.7 0d188f2cdf03 */
/* bench 18445.1.8 3e93aaec7a13 */
/* bench 18445.1.9 c3c0183ad727 */
/* bench 18445.1.10 461b367a442f */
/* bench 18445.1.11 e646df67c3d7 */
/* bench 18445.1.12 5ea639810005 */
  reg:
    maxItems: 1
    description: I2C address of the charger.

  lltc,rsnsb-micro-ohms:
    $ref: /schemas/types.yaml#/definitions/uint32
/* bench 4201.1.0 d7352442732d */
/* bench 4201.1.1 ca3d1287e4c0 */
/* bench 4201.1.2 dac4110ac648 */
/* bench 4201.1.3 1e013f60c18e */
/* bench 4201.1.4 cdf686d9453c */
/* bench 4201.1.5 2976788eebf1 */
/* bench 4201.1.6 bae25fb1a33d */
/* bench 4201.1.7 0433ed6f8d38 */
/* bench 4201.1.8 841029948faf */
/* bench 4201.1.9 525133977bb5 */
    description: Battery sense resistor in microohm.
    minimum: 1000

  lltc,rsnsi-micro-ohms:
    $ref: /schemas/types.yaml#/definitions/uint32
    description: Input current sense resistor in microohm.
    minimum: 1000

  lltc,cell-count:
    $ref: /schemas/types.yaml#/definitions/uint32
    description: |
      Number of battery cells. If not provided, will be obtained from the chip
      once the external power is applied. Omit this when the number of cells
      is somewhat dynamic. Without it, several measurements will return 0 until
      the charger is connected to an external supply.

required:
  - compatible
  - reg
  - lltc,rsnsb-micro-ohms
  - lltc,rsnsi-micro-ohms

additionalProperties: false

examples:
  - |
    i2c0 {
      #address-cells = <1>;
      #size-cells = <0>;
      charger: battery-charger@68 {
              compatible = "lltc,ltc4162-l";
              reg = <0x68>;
              lltc,rsnsb-micro-ohms = <10000>;
              lltc,rsnsi-micro-ohms = <16000>;
              lltc,cell-count = <2>;
      };
    };
```

## Documentation/devicetree/bindings/power/supply/max17040_battery.txt
```
FASTVC-BENCH-CORPUS:linux-main-100k-v1-e0bd41dc-8e12-4f1b-978d-a3645ae59da0
max17040_battery
~~~~~~~~~~~~~~~~

Required properties :
 - compatible : "maxim,max17040", "maxim,max17041", "maxim,max17043",
		"maxim,max17044", "maxim,max17048", "maxim,max17049",
		"maxim,max17058", "maxim,max17059" or "maxim,max77836-battery"
 - reg: i2c slave address

Optional properties :
- maxim,alert-low-soc-level :	The alert threshold that sets the state of
				charge level (%) where an interrupt is
				generated. Can be configured from 1 up to 32
				(%). If skipped the power up default value of
				4 (%) will be used.
- maxim,double-soc : 		Certain devices return double the capacity.
				Specify this boolean property to divide the
				reported value in 2 and thus normalize it.
				SOC == State of Charge == Capacity.
- maxim,rcomp :			A value to compensate readings for various
				battery chemistries and operating temperatures.
				max17040,41 have 2 byte rcomp, default to
				0x97 0x00. All other devices have one byte
				rcomp, default to 0x97.
- interrupts : 			Interrupt line see Documentation/devicetree/
				bindings/interrupt-controller/interrupts.txt
- wakeup-source :		This device has wakeup capabilities. Use this
				property to use alert low SOC level interrupt
				as wake up source.

Optional properties support interrupt functionality for alert low state of
charge level, present in some ICs in the same family, and should be used with
compatible "maxim,max77836-battery".

Example:

	battery-fuel-gauge@36 {
		compatible = "maxim,max77836-battery";
		reg = <0x36>;
		maxim,alert-low-soc-level = <10>;
/* bench 12016.0.0 ef77de6ad3fb */
/* bench 12016.0.1 e7d4d4f2b15e */
/* bench 12016.0.2 ae910d7976e8 */
/* bench 12016.0.3 322afc0d9944 */
/* bench 12016.0.4 774b60ced769 */
/* bench 12016.0.5 4a65d9ddbdff */
/* bench 12016.0.6 5b403e6b9772 */
/* bench 12016.0.7 a3ec4499033d */
/* bench 12016.0.8 1180f20cb63e */
/* bench 12016.0.9 12a8a1e3d57f */
/* bench 12016.0.10 735770f7a9fd */
/* bench 12016.0.11 1742ba410e74 */
/* bench 12016.0.12 4f0db5adfdd2 */
/* bench 12016.0.13 c06e5e3c9972 */
/* bench 12016.0.14 7a7a688a2f65 */
/* bench 12016.0.15 6cc873f42f9b */
	};

	battery-fuel-gauge@36 {
		compatible = "maxim,max17048";
		reg = <0x36>;
		maxim,rcomp = /bits/ 8 <0x56>;
		maxim,alert-low-soc-level = <10>;
		maxim,double-soc;
	};
```
