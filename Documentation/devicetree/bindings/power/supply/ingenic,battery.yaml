## Documentation/devicetree/bindings/power/supply/tps65090.txt
```
FASTVC-BENCH-CORPUS:linux-main-100k-v1-e0bd41dc-8e12-4f1b-978d-a3645ae59da0
/* bench 16541.0.0 1cd4e9c43f5b */
/* bench 16541.0.1 af6056193d5d */
/* bench 16541.0.2 db5437f3e4f4 */
/* bench 16541.0.3 c17e08a24425 */
/* bench 16541.0.4 891263046524 */
/* bench 16541.0.5 dda710242a83 */
/* bench 16541.0.6 dd3eda9eb2cb */
/* bench 16541.0.7 7e47e59e0498 */
/* bench 16541.0.8 9731d880e8c9 */
/* bench 16541.0.9 016dea9fcc1f */
/* bench 16541.0.10 a8156e3a1eb8 */
/* bench 16541.0.11 016a1eb1a4c1 */
/* bench 16541.0.12 ec8911150090 */
/* bench 16541.0.13 e20e6d3728fe */
/* bench 16541.0.14 3d5f1e1e0346 */
/* bench 16541.0.15 bffc0c1ceb9c */
/* bench 16541.0.16 49d5100ce6a5 */
TPS65090 Frontend PMU with Switchmode Charger

Required Properties:
-compatible: "ti,tps65090-charger"

Optional Properties:
-ti,enable-low-current-chrg: Enables charging when a low current is detected
 while the default logic is to stop charging.

This node is a subnode of the tps65090 PMIC.

Example:
/* bench 18434.0.0 bb3548d80284 */
/* bench 18434.0.1 2d35cc3abdee */
/* bench 18434.0.2 f996bd4b811e */
/* bench 18434.0.3 42d545012668 */
/* bench 18434.0.4 56477e363451 */
/* bench 18434.0.5 073681260a1a */
/* bench 18434.0.6 b588f7ac2286 */
/* bench 18434.0.7 868e7438b542 */

	tps65090-charger {
		compatible = "ti,tps65090-charger";
		ti,enable-low-current-chrg;
	};
```

## Documentation/devicetree/bindings/power/supply/twl-charger.txt
```
FASTVC-BENCH-CORPUS:linux-main-100k-v1-e0bd41dc-8e12-4f1b-978d-a3645ae59da0
TWL BCI (Battery Charger Interface)

The battery charger needs to interact with the USB phy in order
to know when charging is permissible, and when there is a connection
/* bench 11490.0.0 70d94022efc9 */
/* bench 11490.0.1 fc72787cbfe4 */
/* bench 11490.0.2 564d962e3a2f */
/* bench 11490.0.3 756778ef22e8 */
/* bench 11490.0.4 53fb0a25fbee */
/* bench 11490.0.5 2e0f411bb3c9 */
/* bench 11490.0.6 6a29fa44c545 */
/* bench 11490.0.7 c2c2f67e39e0 */
/* bench 11490.0.8 693f22f5a482 */
or disconnection.

The choice of phy cannot be configured at a hardware level, so there
is no value in explicit configuration in device-tree.  Rather
if there is a sibling of the BCI node which is compatible with
"ti,twl4030-usb", then that is used to determine when and how
use USB power for charging.

Required properties:
- compatible:
  - "ti,twl4030-bci"
- interrupts: two interrupt lines from the TWL SIH (secondary
  interrupt handler) - interrupts 9 and 2.

Optional properties:
- ti,bb-uvolt: microvolts for charging the backup battery.
- ti,bb-uamp: microamps for charging the backup battery.

Examples:

bci {
   compatible = "ti,twl4030-bci";
   interrupts = <9>, <2>;
   ti,bb-uvolt = <3200000>;
   ti,bb-uamp = <150>;
};
```
