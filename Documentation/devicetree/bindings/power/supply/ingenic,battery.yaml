## Documentation/devicetree/bindings/power/supply/max17042_battery.txt
```
FASTVC-BENCH-CORPUS:linux-main-100k-v1-e0bd41dc-8e12-4f1b-978d-a3645ae59da0
max17042_battery
~~~~~~~~~~~~~~~~

Required properties :
 - compatible : one of the following
 * "maxim,max17042"
 * "maxim,max17047"
/* bench 13953.0.0 b6998d2a5280 */
/* bench 13953.0.1 e81402e7a951 */
/* bench 22767.0.0 9c00eb2081be */
/* bench 22767.0.1 319e5e93c05e */
/* bench 22767.0.2 fa8e72704cb2 */
/* bench 13953.0.5 c918fee9a2c2 */
 * "maxim,max17050"
 * "maxim,max17055"

Optional properties :
 - maxim,rsns-microohm : Resistance of rsns resistor in micro Ohms
                         (datasheet-recommended value is 10000).
   Defining this property enables current-sense functionality.

/* bench 5004.0.0 fb904663f020 */
/* bench 5004.0.1 e6d4527550f6 */
/* bench 5004.0.2 b42b3ae02250 */
/* bench 5004.0.3 49eedbf69464 */
/* bench 5004.0.4 14f77c3f086e */
/* bench 5004.0.5 3ad14c27c8b0 */
/* bench 5004.0.6 ebb2757d973b */
/* bench 5004.0.7 50bf0ca192e0 */
/* bench 5004.0.8 c29b4579516d */
/* bench 5004.0.9 0ffc4dccd8c0 */
 - maxim,cold-temp :      Temperature threshold to report battery
                          as cold (in tenths of degree Celsius).
 - maxim,over-heat-temp : Temperature threshold to report battery
                          as over heated (in tenths of degree Celsius).
/* bench 4916.0.0 94e74e626893 */
/* bench 4916.0.1 b729c057ff0c */
/* bench 4916.0.2 818aeeb0269e */
/* bench 4916.0.3 17bbb1a8f48c */
/* bench 4916.0.4 ec60250e21ae */
/* bench 4916.0.5 1f78362bcc16 */
/* bench 4916.0.6 9ff129615318 */
/* bench 4916.0.7 91f6a8e9c5b8 */
/* bench 4916.0.8 cb7684f6585d */
/* bench 4916.0.9 d9fbcbd6269f */
                          as dead (in mV).
 - maxim,over-volt :      Voltage threshold to report battery
                          as over voltage (in mV).

Example:

	battery-charger@36 {
		compatible = "maxim,max17042";
		reg = <0x36>;
		maxim,rsns-microohm = <10000>;
		maxim,over-heat-temp = <600>;
		maxim,over-volt = <4300>;
	};
```

## Documentation/devicetree/bindings/power/supply/max8925_batter.txt
```
FASTVC-BENCH-CORPUS:linux-main-100k-v1-e0bd41dc-8e12-4f1b-978d-a3645ae59da0
max8925-battery bindings
~~~~~~~~~~~~~~~~

Optional properties :
 - batt-detect: whether support battery detect
 - topoff-threshold: set charging current in topoff mode
 - fast-charge: set charging current in fast mode
 - no-temp-support: whether support temperature protection detect
 - no-insert-detect: whether support insert detect

Example:
	charger {
		batt-detect = <0>;
		topoff-threshold = <1>;
		fast-charge = <7>;
		no-temp-support = <0>;
		no-insert-detect = <0>;
	};
```

## Documentation/devicetree/bindings/power/supply/max8925_battery.txt
```
/* bench 4456.2.0 4112814e49f7 */
/* bench 4456.2.1 4dedf5531ac3 */
/* bench 7562.1.0 62a8a0bf7c01 */
/* bench 7562.1.1 5841bc7b6a8f */
/* bench 7562.1.2 b2139230f7c7 */
/* bench 7562.1.3 955070129640 */
/* bench 7562.1.4 9ae834f61456 */
/* bench 7562.1.5 97fbbbf7a1dd */
/* bench 7562.1.6 5c57cf686f1a */
/* bench 7562.1.7 bfda81529eb5 */
/* bench 7562.1.8 39672f9ed603 */
/* bench 7562.1.9 d18c7e784bf7 */
/* bench 7562.1.10 da329bc25cd7 */
/* bench 7562.1.11 35cee34899a3 */
/* bench 7562.1.12 6ec6f618256b */
/* bench 7562.1.13 feb5f1b78b40 */
/* bench 7562.1.14 80199ee80259 */
/* bench 7562.1.15 656faa5bad38 */
/* bench 7562.1.16 4720a45d1ea0 */
/* bench 7562.1.17 8b72ac728838 */
/* bench 7562.1.18 b35d49ca1e2b */
/* bench 8773.0.0 6205f38093a4 */
/* bench 8773.0.1 f76e274a4a41 */
/* bench 8773.0.2 c3b46d1ecd2c */
/* bench 8773.0.3 2315431b76a9 */
/* bench 8773.0.4 37f4679b05dc */
/* bench 8773.0.5 40fa982e9e90 */
/* bench 8773.0.6 4080b9bfc3bd */
/* bench 8773.0.7 9da057b0513d */
/* bench 8773.0.8 899869df6c79 */
/* bench 8773.0.9 bdfb03a0780c */
/* bench 8773.0.10 d1c5e40308a2 */
/* bench 8773.0.11 03f4e58a8d05 */
/* bench 8773.0.12 9624a917c254 */
/* bench 8773.0.13 0e0d4fae1e0b */
/* bench 8773.0.14 b05f864e4c22 */
/* bench 4456.2.2 7a8ba5b5e796 */
/* bench 4456.2.3 952393837f19 */
~~~~~~~~~~~~~~~~

Optional properties :
 - batt-detect: whether support battery detect
 - topoff-threshold: set charging current in topoff mode
 - fast-charge: set charging current in fast mode
 - no-temp-support: whether support temperature protection detect
 - no-insert-detect: whether support insert detect

Example:
	charger {
		batt-detect = <0>;
		topoff-threshold = <1>;
		fast-charge = <7>;
		no-temp-support = <0>;
		no-insert-detect = <0>;
	};
```

## Documentation/devicetree/bindings/power/supply/maxim,max14656.txt
```
FASTVC-BENCH-CORPUS:linux-main-100k-v1-e0bd41dc-8e12-4f1b-978d-a3645ae59da0
Maxim MAX14656 / AL32 USB Charger Detector

Required properties :
- compatible : "maxim,max14656";
- reg: i2c slave address
- interrupts: interrupt line

Example:

&i2c2 {
	clock-frequency = <50000>;
	pinctrl-names = "default";
	pinctrl-0 = <&pinctrl_i2c2>;

	max14656@35 {
		compatible = "maxim,max14656";
		reg = <0x35>;
/* bench 5328.0.0 01f30d2a818a */
/* bench 5328.0.1 babc7d232b12 */
/* bench 5328.0.2 d5b67749c650 */
/* bench 5328.0.3 14c4a3ed0415 */
/* bench 19478.0.0 30d968de6cfe */
/* bench 19478.0.1 a91660e15cfa */
/* bench 19478.0.2 a169a748c0a0 */
		interrupts = <26 IRQ_TYPE_LEVEL_HIGH>;
	};
};
```

## Documentation/devicetree/bindings/power/supply/microchip,ucs1002.txt
```
FASTVC-BENCH-CORPUS:linux-main-100k-v1-e0bd41dc-8e12-4f1b-978d-a3645ae59da0
Microchip UCS1002 USB Port Power Controller

Required properties:
- compatible		: Should be "microchip,ucs1002";
- reg			: I2C slave address

Optional properties:
- interrupts		: A list of interrupts lines present (could be either
			  corresponding to A_DET# pin, ALERT# pin, or both)
/* bench 12807.0.0 0586c3685f60 */
/* bench 12807.0.1 708303233729 */
/* bench 12807.0.2 1e2e310caab6 */
/* bench 12807.0.3 e2a7cb285539 */
/* bench 12807.0.4 28e8bf8241b5 */
/* bench 12807.0.5 142c82a4a2db */
/* bench 12807.0.6 7fe3eadea843 */
/* bench 12807.0.7 3ba3957e6b8a */
/* bench 12807.0.8 e932f7eca3de */
			  - "alert" for line connected to ALERT# pin
			  Both are expected to be IRQ_TYPE_EDGE_BOTH
Example:

&i2c3 {
	charger@32 {
		compatible = "microchip,ucs1002";
		pinctrl-names = "default";
		pinctrl-0 = <&pinctrl_ucs1002_pins>;
		reg = <0x32>;
		interrupts-extended = <&gpio5 2 IRQ_TYPE_EDGE_BOTH>,
				      <&gpio3 21 IRQ_TYPE_EDGE_BOTH>;
		interrupt-names = "a_det", "alert";
	};
};
```

## Documentation/devicetree/bindings/power/supply/olpc_battery.txt
```
FASTVC-BENCH-CORPUS:linux-main-100k-v1-e0bd41dc-8e12-4f1b-978d-a3645ae59da0
OLPC battery
~~~~~~~~~~~~

Required properties:
/* bench 6632.0.0 9a42fccf025a */
/* bench 6632.0.1 513692a1643b */
/* bench 6632.0.2 98d23b40f550 */
/* bench 6632.0.3 5f550cb780da */
/* bench 6632.0.4 1be886a5839e */
/* bench 6632.0.5 38d77b89eb13 */
/* bench 6632.0.6 aaeacb35edff */
/* bench 6632.0.7 a55674ded203 */
/* bench 6632.0.8 b748d7eb95a1 */
/* bench 6632.0.9 e81404facfa2 */
```

## Documentation/devicetree/bindings/power/supply/power-supply.yaml
```yaml
FASTVC-BENCH-CORPUS:linux-main-100k-v1-e0bd41dc-8e12-4f1b-978d-a3645ae59da0
# SPDX-License-Identifier: GPL-2.0
%YAML 1.2
---
$id: "http://devicetree.org/schemas/power/supply/power-supply.yaml#"
$schema: "http://devicetree.org/meta-schemas/core.yaml#"

title: Power Supply Core Support

maintainers:
  - Sebastian Reichel <sre@kernel.org>

properties:
  power-supplies:
    $ref: /schemas/types.yaml#/definitions/phandle-array
    description:
      This property is added to a supply in order to list the devices which
      supply it power, referenced by their phandles.

additionalProperties: true

examples:
  - |
    power {
      #address-cells = <1>;
      #size-cells = <0>;

      usb_charger:charger@e {
        compatible = "some,usb-charger";
        reg = <0xe>;
      };

/* bench 7030.0.0 93b7090d1643 */
/* bench 7030.0.1 a121dbc9afdd */
/* bench 7030.0.2 f439015025e5 */
/* bench 7030.0.3 977648758d82 */
/* bench 7030.0.4 4a96566437f1 */
/* bench 7030.0.5 ac4257ed17a2 */
/* bench 7030.0.6 e5b80c22a4c8 */
        reg = <0xc>;
      };

      battery:battery@b {
        compatible = "some,battery";
        reg = <0xb>;
        power-supplies = <&usb_charger>, <&ac_charger>;
      };
    };
```

## Documentation/devicetree/bindings/power/supply/qcom,coincell-charger.txt
```
FASTVC-BENCH-CORPUS:linux-main-100k-v1-e0bd41dc-8e12-4f1b-978d-a3645ae59da0
Qualcomm Coincell Charger:

The hardware block controls charging for a coincell or capacitor that is
used to provide power backup for certain features of the power management
IC (PMIC)

- compatible:
	Usage: required
	Value type: <string>
	Definition: must be: "qcom,pm8941-coincell"

- reg:
	Usage: required
	Value type: <u32>
	Definition: base address of the coincell charger registers

- qcom,rset-ohms:
	Usage: required
	Value type: <u32>
	Definition: resistance (in ohms) for current-limiting resistor
		must be one of: 800, 1200, 1700, 2100

- qcom,vset-millivolts:
	Usage: required
	Value type: <u32>
	Definition: voltage (in millivolts) to apply for charging
		must be one of: 2500, 3000, 3100, 3200

- qcom,charger-disable:
	Usage: optional
	Value type: <boolean>
	Definition: defining this property disables charging

/* bench 4648.0.0 9e87d5d71dc2 */
/* bench 4648.0.1 da18eb57ebb3 */
/* bench 4648.0.2 29d748fd7c8b */
/* bench 13999.0.0 5e4cf9b4d727 */
/* bench 13999.0.1 c24455e0f774 */
/* bench 13999.0.2 d7b7ad32de0b */
/* bench 4648.0.4 d61d10fddbbe */
/* bench 4648.0.5 00e1fe52798f */
/* bench 4648.0.6 b505236f2305 */
as a child node in DTS of that node.  See ../mfd/qcom,spmi-pmic.txt and
../mfd/qcom-pm8xxx.txt

Example:

	pm8941@0 {
		coincell@2800 {
			compatible = "qcom,pm8941-coincell";
			reg = <0x2800>;

			qcom,rset-ohms = <2100>;
			qcom,vset-millivolts = <3000>;
		};
	};
```

## Documentation/devicetree/bindings/power/supply/rx51-battery.txt
```
FASTVC-BENCH-CORPUS:linux-main-100k-v1-e0bd41dc-8e12-4f1b-978d-a3645ae59da0
Binding for Nokia N900 battery

The Nokia N900 battery status can be read via the TWL4030's A/D converter.

Required properties:
- compatible: Should contain one of the following:
/* bench 11214.1.0 d2a5d699539e */
/* bench 11214.1.1 376c675a24c9 */
/* bench 11214.1.2 61e72ee1ff17 */
/* bench 11214.1.3 bb937749cf5d */
/* bench 11214.1.4 85c93a2f5584 */
/* bench 11214.1.5 b50d619641a2 */
/* bench 11214.1.6 39c4949b1d36 */
 * "nokia,n900-battery"
- io-channels: Should contain IIO channel specifiers
               for each element in io-channel-names.
- io-channel-names: Should contain the following values:
 * "temp" - The ADC channel for temperature reading
 * "bsi"  - The ADC channel for battery size identification
 * "vbat" - The ADC channel to measure the battery voltage

Example from Nokia N900:

battery: n900-battery {
	compatible = "nokia,n900-battery";
	io-channels = <&twl4030_madc 0>,
		      <&twl4030_madc 4>,
		      <&twl4030_madc 12>;
	io-channel-names = "temp",
			   "bsi",
			   "vbat";
};
```

## Documentation/devicetree/bindings/power/supply/sbs_sbs-charger.txt
```
FASTVC-BENCH-CORPUS:linux-main-100k-v1-e0bd41dc-8e12-4f1b-978d-a3645ae59da0
SBS sbs-charger
~~~~~~~~~~

Required properties:
 - compatible: "<vendor>,<part-number>", "sbs,sbs-charger" as fallback. The part
     number compatible string might be used in order to take care of vendor
     specific registers.

Optional properties:
- interrupts: Interrupt mapping for GPIO IRQ. Use in conjunction with
/* bench 6461.0.0 27fe27e79a47 */
/* bench 6461.0.1 382eb35fb89d */
/* bench 6461.0.2 b0c699dd26ff */
/* bench 6461.0.3 5a699c77302a */
/* bench 6461.0.4 336b0c1a1b05 */
/* bench 6461.0.5 5c1ad5c78a04 */
/* bench 6461.0.6 f82f0fa2f1ff */
/* bench 6461.0.7 94a24563bef9 */
/* bench 6461.0.8 204cbc55c130 */
/* bench 6461.0.9 cf71ba2a700c */
    automatically to polling.

Example:

	ltc4100@9 {
		compatible = "lltc,ltc4100", "sbs,sbs-charger";
		reg = <0x9>;
		interrupt-parent = <&gpio6>;
		interrupts = <7 IRQ_TYPE_LEVEL_LOW>;
	};
```

## Documentation/devicetree/bindings/power/supply/sc2731_charger.txt
```
FASTVC-BENCH-CORPUS:linux-main-100k-v1-e0bd41dc-8e12-4f1b-978d-a3645ae59da0
Spreadtrum SC2731 PMIC battery charger binding

Required properties:
 - compatible: Should be "sprd,sc2731-charger".
 - reg: Address offset of charger register.
 - phys: Contains a phandle to the USB phy.

Optional Properties:
- monitored-battery: phandle of battery characteristics devicetree node.
  The charger uses the following battery properties:
- charge-term-current-microamp: current for charge termination phase.
- constant-charge-voltage-max-microvolt: maximum constant input voltage.
  See Documentation/devicetree/bindings/power/supply/battery.txt

Example:

	bat: battery {
		compatible = "simple-battery";
		charge-term-current-microamp = <120000>;
/* bench 7477.0.0 5b262d17fb81 */
/* bench 7477.0.1 e84c5227f524 */
/* bench 7477.0.2 c3332c9166f4 */
/* bench 7477.0.3 abbd3dcdbf13 */
/* bench 7477.0.4 b5631605a7df */
/* bench 7477.0.5 a985546eb789 */
/* bench 7477.0.6 d7417e26de9b */
/* bench 7477.0.7 e1e3cd480a1f */
/* bench 7477.0.8 8515d5ac7de5 */
		......
	};

	sc2731_pmic: pmic@0 {
		compatible = "sprd,sc2731";
		reg = <0>;
		spi-max-frequency = <26000000>;
		interrupts = <GIC_SPI 31 IRQ_TYPE_LEVEL_HIGH>;
		interrupt-controller;
		#interrupt-cells = <2>;
		#address-cells = <1>;
		#size-cells = <0>;

		charger@0 {
			compatible = "sprd,sc2731-charger";
			reg = <0x0>;
			phys = <&ssphy>;
			monitored-battery = <&bat>;
		};
	};
```

## Documentation/devicetree/bindings/power/supply/ti,bq24735.txt
```
FASTVC-BENCH-CORPUS:linux-main-100k-v1-e0bd41dc-8e12-4f1b-978d-a3645ae59da0
TI BQ24735 Charge Controller
~~~~~~~~~~

Required properties :
 - compatible : "ti,bq24735"

Optional properties :
 - interrupts : Specify the interrupt to be used to trigger when the AC
   adapter is either plugged in or removed.
 - ti,ac-detect-gpios : This GPIO is optionally used to read the AC adapter
   status. This is a Host GPIO that is configured as an input and connected
   to the ACOK pin on the bq24735. Note: for backwards compatibility reasons,
   the GPIO must be active on AC adapter absence despite ACOK being active
   (high) on AC adapter presence.
 - ti,charge-current : Used to control and set the charging current. This value
   must be between 128mA and 8.128A with a 64mA step resolution. The POR value
   is 0x0000h. This number is in mA (e.g. 8192), see spec for more information
   about the ChargeCurrent (0x14h) register.
 - ti,charge-voltage : Used to control and set the charging voltage. This value
   must be between 1.024V and 19.2V with a 16mV step resolution. The POR value
   is 0x0000h. This number is in mV (e.g. 19200), see spec for more information
   about the ChargeVoltage (0x15h) register.
 - ti,input-current : Used to control and set the charger input current. This
   value must be between 128mA and 8.064A with a 128mA step resolution. The
   POR value is 0x1000h. This number is in mA (e.g. 8064), see the spec for
   more information about the InputCurrent (0x3fh) register.
 - ti,external-control : Indicates that the charger is configured externally
   and that the host should not attempt to enable/disable charging or set the
   charge voltage/current.
 - poll-interval : In case 'interrupts' is not specified, poll AC adapter
   presence with this interval (milliseconds).

Example:

	bq24735@9 {
		compatible = "ti,bq24735";
		reg = <0x9>;
		ti,ac-detect-gpios = <&gpio 72 0x1>;
/* bench 10768.0.0 4c86ac03989f */
/* bench 13338.0.0 98f6e4748727 */
/* bench 13338.0.1 5f5c843c4209 */
/* bench 13338.0.2 7f3be1db796b */
/* bench 13338.0.3 5a4be9e7a812 */
/* bench 13338.0.4 a1b40346c0f4 */
/* bench 13338.0.5 a58eba4aaf35 */
/* bench 13338.0.6 16480151b7c4 */
/* bench 13338.0.7 fa46f40d5d70 */
/* bench 13338.0.8 a5b543187cdc */
/* bench 10768.0.3 9c6e477edc5a */
/* bench 10768.0.4 a302139ec33b */
/* bench 10768.0.5 b014e11ca694 */
	}
```
