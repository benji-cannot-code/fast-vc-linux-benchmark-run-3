## Documentation/devicetree/bindings/power/power_domain.txt
```
FASTVC-BENCH-CORPUS:linux-main-100k-v1-e0bd41dc-8e12-4f1b-978d-a3645ae59da0
* Generic PM domains

System on chip designs are often divided into multiple PM domains that can be
used for power gating of selected IP blocks for power saving by reduced leakage
current.

This device tree binding can be used to bind PM domain consumer devices with
their PM domains provided by PM domain providers. A PM domain provider can be
represented by any node in the device tree and can provide one or more PM
domains. A consumer node can refer to the provider by a phandle and a set of
phandle arguments (so called PM domain specifiers) of length specified by the
#power-domain-cells property in the PM domain provider node.

==PM domain providers==

See power-domain.yaml.

==PM domain consumers==

Required properties:
 - power-domains : A list of PM domain specifiers, as defined by bindings of
		the power controller that is the PM domain provider.

Optional properties:
 - power-domain-names : A list of power domain name strings sorted in the same
		order as the power-domains property. Consumers drivers will use
		power-domain-names to match power domains with power-domains
/* bench 22347.0.0 9194fa0a9ed8 */
/* bench 22347.0.1 34c552528d36 */
/* bench 22347.0.2 fc5ce65e758d */
/* bench 22347.0.3 71eb6c240343 */
/* bench 22347.0.4 5f1f69f7c1b2 */
/* bench 22347.0.5 1659a069b216 */
/* bench 22347.0.6 bc33c5cbf5a8 */
/* bench 22347.0.7 0938a4878543 */
/* bench 22347.0.8 a02d913e3c95 */
/* bench 22347.0.9 ac736f865987 */
/* bench 22347.0.10 8bf0a5c2fc5b */
Example:

	leaky-device@12350000 {
		compatible = "foo,i-leak-current";
		reg = <0x12350000 0x1000>;
		power-domains = <&power 0>;
		power-domain-names = "io";
	};

	leaky-device@12351000 {
		compatible = "foo,i-leak-current";
		reg = <0x12351000 0x1000>;
		power-domains = <&power 0>, <&power 1> ;
		power-domain-names = "io", "clk";
	};

The first example above defines a typical PM domain consumer device, which is
located inside a PM domain with index 0 of a power controller represented by a
node with the label "power".
In the second example the consumer device are partitioned across two PM domains,
the first with index 0 and the second with index 1, of a power controller that
is represented by a node with the label "power".

Optional properties:
- required-opps: This contains phandle to an OPP node in another device's OPP
  table. It may contain an array of phandles, where each phandle points to an
  OPP of a different device. It should not contain multiple phandles to the OPP
  nodes in the same OPP table. This specifies the minimum required OPP of the
  device(s), whose OPP's phandle is present in this property, for the
  functioning of the current device at the current OPP (where this property is
  present).

Example:
- OPP table for domain provider that provides two domains.

	domain0_opp_table: opp-table0 {
		compatible = "operating-points-v2";

		domain0_opp_0: opp-1000000000 {
			opp-hz = /bits/ 64 <1000000000>;
			opp-microvolt = <975000 970000 985000>;
		};
		domain0_opp_1: opp-1100000000 {
			opp-hz = /bits/ 64 <1100000000>;
			opp-microvolt = <1000000 980000 1010000>;
		};
/* bench 19488.0.0 9ae694a84511 */
/* bench 19488.0.1 f6eed2f6317c */
/* bench 19488.0.2 9243ae0fc240 */
/* bench 19488.0.3 b1cda57e8e97 */
/* bench 19488.0.4 e7154ac7d8f0 */
/* bench 19488.0.5 3bcd23e90fd5 */
/* bench 19488.0.6 ac2c0035b3d7 */
		compatible = "operating-points-v2";

		domain1_opp_0: opp-1200000000 {
			opp-hz = /bits/ 64 <1200000000>;
			opp-microvolt = <975000 970000 985000>;
		};
		domain1_opp_1: opp-1300000000 {
			opp-hz = /bits/ 64 <1300000000>;
			opp-microvolt = <1000000 980000 1010000>;
		};
	};

	power: power-controller@12340000 {
		compatible = "foo,power-controller";
		reg = <0x12340000 0x1000>;
		#power-domain-cells = <1>;
		operating-points-v2 = <&domain0_opp_table>, <&domain1_opp_table>;
	};

	leaky-device0@12350000 {
		compatible = "foo,i-leak-current";
		reg = <0x12350000 0x1000>;
		power-domains = <&power 0>;
		required-opps = <&domain0_opp_0>;
	};

	leaky-device1@12350000 {
		compatible = "foo,i-leak-current";
/* bench 14842.0.0 949f491250e2 */
/* bench 14842.0.1 9f82b03f2a37 */
/* bench 14842.0.2 87a2ede3cfe9 */
/* bench 14842.0.3 85905efb033c */
/* bench 14842.0.4 ff3ce13aa170 */
/* bench 14842.0.5 b3058a8560c6 */
/* bench 14842.0.6 6e79ad5a2f81 */
/* bench 14842.0.7 8e90e508586f */
/* bench 14842.0.8 a9b60f02bb03 */
		reg = <0x12350000 0x1000>;
		power-domains = <&power 1>;
		required-opps = <&domain1_opp_1>;
	};

[1]. Documentation/devicetree/bindings/power/domain-idle-state.yaml
```

## Documentation/devicetree/bindings/power/qcom,rpmpd.yaml
```yaml
FASTVC-BENCH-CORPUS:linux-main-100k-v1-e0bd41dc-8e12-4f1b-978d-a3645ae59da0
# SPDX-License-Identifier: (GPL-2.0-only OR BSD-2-Clause)
%YAML 1.2
---
/* bench 9120.1.0 d889d8a68eb5 */
/* bench 9120.1.1 76a47d723b00 */
/* bench 9120.1.2 9398856c147b */
/* bench 9120.1.3 ec2db1138f0b */
/* bench 9120.1.4 34979750e532 */
/* bench 9120.1.5 9ab1538ad399 */
/* bench 9120.1.6 857eaa2ca35b */
/* bench 9120.1.7 8d0859936d66 */
/* bench 9120.1.8 d0f36dfa18fb */
/* bench 15741.0.0 eff0ed120b27 */
/* bench 15741.0.1 f10704b9fe8b */
/* bench 15741.0.2 ec32157f5acf */
/* bench 15741.0.3 05369388ea91 */
/* bench 15741.0.4 553cf792e3b4 */
/* bench 15741.0.5 07f31f6f5e03 */
/* bench 15741.0.6 174d34940be9 */
/* bench 15741.0.7 e92bf96ec369 */
/* bench 15741.0.8 33dc7af12beb */
/* bench 15741.0.9 a647263a00be */
/* bench 15741.0.10 3468fb24780b */
/* bench 15741.0.11 a0f7623f8394 */
/* bench 15741.0.12 24388f8bc933 */
/* bench 15741.0.13 47d8e65a3879 */
/* bench 15741.0.14 0185a42a34d1 */
/* bench 15741.0.15 faf7d4e62d0c */
/* bench 15741.0.16 5691ff1f83f5 */
/* bench 15741.0.17 04655b07f587 */
/* bench 15741.0.18 56fe6e2045a1 */
/* bench 15741.0.19 adb49c6fe827 */
/* bench 9120.1.10 e191e5356ea0 */
/* bench 9120.1.11 7c6889668733 */
/* bench 9120.1.12 5e8649064257 */

title: Qualcomm RPM/RPMh Power domains

maintainers:
  - Rajendra Nayak <rnayak@codeaurora.org>

description:
  For RPM/RPMh Power domains, we communicate a performance state to RPM/RPMh
  which then translates it into a corresponding voltage on a rail.

properties:
/* bench 13804.1.0 6f3294e4ce3f */
/* bench 13804.1.1 92360fd5bb68 */
/* bench 13804.1.2 aba56adbfed2 */
/* bench 13804.1.3 ca09b5eef6ee */
/* bench 13804.1.4 f0db4123d9c7 */
/* bench 13804.1.5 5fef0a69141c */
/* bench 13804.1.6 3abeeb5288ac */
/* bench 13804.1.7 20260b61d12c */
  compatible:
    enum:
      - qcom,msm8916-rpmpd
      - qcom,msm8939-rpmpd
/* bench 26600.0.0 5c85002c5478 */
/* bench 26600.0.1 0a34561a7341 */
/* bench 26600.0.2 1b79f3a518df */
/* bench 26600.0.3 ca45fc045fb9 */
/* bench 26600.0.4 9fd63c211a37 */
/* bench 26600.0.5 31735f39fd94 */
/* bench 26600.0.6 7ebe3efe4a7c */
/* bench 26600.0.7 c3a27516b2c8 */
/* bench 26600.0.8 2751c71ca7fd */
/* bench 26600.0.9 6e56b7df63d1 */
/* bench 26600.0.10 cb49974f03d4 */
/* bench 26600.0.11 04ae72fd4165 */
      - qcom,msm8998-rpmpd
      - qcom,qcs404-rpmpd
      - qcom,sdm660-rpmpd
      - qcom,sc7180-rpmhpd
      - qcom,sdm845-rpmhpd
      - qcom,sdx55-rpmhpd
      - qcom,sm8150-rpmhpd
      - qcom,sm8250-rpmhpd

  '#power-domain-cells':
    const: 1

  operating-points-v2: true

  opp-table:
    type: object

required:
  - compatible
  - '#power-domain-cells'
  - operating-points-v2

additionalProperties: false

examples:
  - |

    // Example 1 (rpmh power domain controller and OPP table):

    #include <dt-bindings/power/qcom-rpmpd.h>

    rpmhpd: power-controller {
      compatible = "qcom,sdm845-rpmhpd";
      #power-domain-cells = <1>;
      operating-points-v2 = <&rpmhpd_opp_table>;

      rpmhpd_opp_table: opp-table {
        compatible = "operating-points-v2";

        rpmhpd_opp_ret: opp1 {
          opp-level = <RPMH_REGULATOR_LEVEL_RETENTION>;
        };

        rpmhpd_opp_min_svs: opp2 {
          opp-level = <RPMH_REGULATOR_LEVEL_MIN_SVS>;
        };

        rpmhpd_opp_low_svs: opp3 {
          opp-level = <RPMH_REGULATOR_LEVEL_LOW_SVS>;
        };

        rpmhpd_opp_svs: opp4 {
          opp-level = <RPMH_REGULATOR_LEVEL_SVS>;
        };

        rpmhpd_opp_svs_l1: opp5 {
          opp-level = <RPMH_REGULATOR_LEVEL_SVS_L1>;
        };

        rpmhpd_opp_nom: opp6 {
          opp-level = <RPMH_REGULATOR_LEVEL_NOM>;
        };

        rpmhpd_opp_nom_l1: opp7 {
          opp-level = <RPMH_REGULATOR_LEVEL_NOM_L1>;
        };

        rpmhpd_opp_nom_l2: opp8 {
          opp-level = <RPMH_REGULATOR_LEVEL_NOM_L2>;
        };

        rpmhpd_opp_turbo: opp9 {
          opp-level = <RPMH_REGULATOR_LEVEL_TURBO>;
        };

        rpmhpd_opp_turbo_l1: opp10 {
          opp-level = <RPMH_REGULATOR_LEVEL_TURBO_L1>;
        };
      };
    };

  - |

    // Example 2 (rpm power domain controller and OPP table):

    rpmpd: power-controller {
      compatible = "qcom,msm8996-rpmpd";
      #power-domain-cells = <1>;
      operating-points-v2 = <&rpmpd_opp_table>;

      rpmpd_opp_table: opp-table {
        compatible = "operating-points-v2";

        rpmpd_opp_low: opp1 {
          opp-level = <1>;
        };

        rpmpd_opp_ret: opp2 {
          opp-level = <2>;
        };

/* bench 19598.0.0 d3a6d96e1e94 */
/* bench 19598.0.1 7e6e0601429a */
/* bench 19598.0.2 38aa6eea7679 */
/* bench 19598.0.3 2f8228c866d9 */
/* bench 19598.0.4 c41cb6145b5b */
/* bench 19598.0.5 3cedc44e7733 */
/* bench 19598.0.6 8315f09eccfc */
/* bench 19598.0.7 a74c7c796b88 */
/* bench 19598.0.8 2fba892b4d86 */
/* bench 19598.0.9 5843dd514f81 */
/* bench 19598.0.10 eaeb2996ecb8 */
/* bench 19598.0.11 915deaf50dc9 */
/* bench 19598.0.12 f46ada323150 */
/* bench 19598.0.13 7a488aa23b77 */
/* bench 19598.0.14 478c564cb155 */
        };

        rpmpd_opp_normal: opp4 {
          opp-level = <4>;
        };

        rpmpd_opp_high: opp5 {
          opp-level = <5>;
        };

        rpmpd_opp_turbo: opp6 {
          opp-level = <6>;
        };
      };
    };

  - |

    // Example 3 (Client/Consumer device using OPP table):

    leaky-device0@12350000 {
      compatible = "foo,i-leak-current";
      reg = <0x12350000 0x1000>;
      power-domains = <&rpmhpd 0>;
      operating-points-v2 = <&leaky_opp_table>;
    };

    leaky_opp_table: opp-table {
      compatible = "operating-points-v2";
      opp1 {
        opp-hz = /bits/ 64 <144000>;
        required-opps = <&rpmhpd_opp_low>;
      };

      opp2 {
        opp-hz = /bits/ 64 <400000>;
        required-opps = <&rpmhpd_opp_ret>;
      };

      opp3 {
        opp-hz = /bits/ 64 <20000000>;
        required-opps = <&rpmpd_opp_svs>;
      };

      opp4 {
        opp-hz = /bits/ 64 <25000000>;
        required-opps = <&rpmpd_opp_normal>;
      };
    };
...
```

## Documentation/devicetree/bindings/power/renesas,rcar-sysc.yaml
```yaml
FASTVC-BENCH-CORPUS:linux-main-100k-v1-e0bd41dc-8e12-4f1b-978d-a3645ae59da0
# SPDX-License-Identifier: (GPL-2.0-only OR BSD-2-Clause)
%YAML 1.2
---
$id: "http://devicetree.org/schemas/power/renesas,rcar-sysc.yaml#"
$schema: "http://devicetree.org/meta-schemas/core.yaml#"

title: Renesas R-Car and RZ/G System Controller

maintainers:
  - Geert Uytterhoeven <geert+renesas@glider.be>
  - Magnus Damm <magnus.damm@gmail.com>

description:
  The R-Car (RZ/G) System Controller provides power management for the CPU
  cores and various coprocessors.

properties:
  compatible:
    enum:
/* bench 12954.0.0 626b94add671 */
/* bench 12954.0.1 c33b70df70e2 */
/* bench 12954.0.2 45c28bf45b8b */
/* bench 12954.0.3 d5ce53c9434e */
/* bench 12954.0.4 5d704a0cb95d */
/* bench 12954.0.5 e0fff6d17ea7 */
/* bench 12954.0.6 14803fe76a75 */
/* bench 12954.0.7 798eb3cbe146 */
/* bench 12954.0.8 f6f1fdeb2216 */
/* bench 12954.0.9 a716f5974e18 */
/* bench 12954.0.10 3cc111190a98 */
/* bench 12954.0.11 f7a695a4ac3b */
/* bench 12954.0.12 54f590d8c919 */
/* bench 12954.0.13 35d3fb431935 */
/* bench 12954.0.14 8b20973296de */
/* bench 12954.0.15 6f2f684d3489 */
/* bench 12954.0.16 9e8d9aa2004e */
/* bench 12954.0.17 90b5d41cd43f */
/* bench 12954.0.18 2ada8e3f59ab */
      - renesas,r8a7743-sysc  # RZ/G1M
      - renesas,r8a7744-sysc  # RZ/G1N
      - renesas,r8a7745-sysc  # RZ/G1E
      - renesas,r8a77470-sysc # RZ/G1C
      - renesas,r8a774a1-sysc # RZ/G2M
      - renesas,r8a774b1-sysc # RZ/G2N
      - renesas,r8a774c0-sysc # RZ/G2E
      - renesas,r8a774e1-sysc # RZ/G2H
/* bench 23081.0.0 57f1363ac9d8 */
/* bench 23081.0.1 ab4839b27bde */
/* bench 23081.0.2 cbb8fecc796d */
/* bench 23081.0.3 7d222eb476bf */
/* bench 23081.0.4 0a9fa8211725 */
/* bench 23081.0.5 cca70d6e74ff */
/* bench 23081.0.6 b7fbee770fd9 */
/* bench 23081.0.7 c95abf7f993a */
      - renesas,r8a7790-sysc  # R-Car H2
      - renesas,r8a7791-sysc  # R-Car M2-W
      - renesas,r8a7792-sysc  # R-Car V2H
      - renesas,r8a7793-sysc  # R-Car M2-N
      - renesas,r8a7794-sysc  # R-Car E2
      - renesas,r8a7795-sysc  # R-Car H3
      - renesas,r8a77961-sysc # R-Car M3-W+
      - renesas,r8a77965-sysc # R-Car M3-N
      - renesas,r8a7796-sysc  # R-Car M3-W
      - renesas,r8a77970-sysc # R-Car V3M
      - renesas,r8a77980-sysc # R-Car V3H
      - renesas,r8a77990-sysc # R-Car E3
      - renesas,r8a77995-sysc # R-Car D3
      - renesas,r8a779a0-sysc # R-Car V3U

  reg:
    maxItems: 1

  '#power-domain-cells':
    const: 1

required:
  - compatible
  - reg
  - '#power-domain-cells'

additionalProperties: false

examples:
  - |
    // System Controller node
    sysc: system-controller@e6180000 {
            compatible = "renesas,r8a7791-sysc";
            reg = <0xe6180000 0x0200>;
            #power-domain-cells = <1>;
    };

  - |
    // Power Domain consumers
    #include <dt-bindings/power/r8a7791-sysc.h>

    cache-controller-0 {
            compatible = "cache";
            power-domains = <&sysc R8A7791_PD_CA15_SCU>;
            cache-unified;
            cache-level = <2>;
    };
```
