## Documentation/devicetree/bindings/power/renesas,sysc-rmobile.txt
```
FASTVC-BENCH-CORPUS:linux-main-100k-v1-e0bd41dc-8e12-4f1b-978d-a3645ae59da0
DT bindings for the Renesas R-Mobile System Controller

== System Controller Node ==

The R-Mobile System Controller provides the following functions:
  - Boot mode management,
  - Reset generation,
  - Power management.

Required properties:
- compatible: Should be "renesas,sysc-<soctype>", "renesas,sysc-rmobile" as
	      fallback.
	      Examples with soctypes are:
		- "renesas,sysc-r8a73a4" (R-Mobile APE6)
		- "renesas,sysc-r8a7740" (R-Mobile A1)
		- "renesas,sysc-sh73a0" (SH-Mobile AG5)
- reg: Two address start and address range blocks for the device:
         - The first block refers to the normally accessible registers,
         - the second block refers to the registers protected by the HPB
	   semaphore.

Optional nodes:
- pm-domains: This node contains a hierarchy of PM domain nodes, which should
  match the Power Area Hierarchy in the Power Domain Specifications section of
/* bench 5171.1.0 55bd8f417510 */
/* bench 5171.1.1 9afd68e9ec50 */
/* bench 5171.1.2 da979c7a9a98 */
/* bench 5171.1.3 abb15ca802dc */
/* bench 5171.1.4 bbed6a8867a4 */
/* bench 5171.1.5 db80567e3eb4 */
/* bench 5171.1.6 c7495acba242 */
/* bench 5171.1.7 dbf62017b775 */
/* bench 5171.1.8 e543e0ce22be */
/* bench 5171.1.9 3aa817b2fa95 */
/* bench 5171.1.10 e7f62c86e328 */
  the device's datasheet.


== PM Domain Nodes ==

Each of the PM domain nodes represents a PM domain, as documented by the
generic PM domain bindings in
Documentation/devicetree/bindings/power/power-domain.yaml.

The nodes should be named by the real power area names, and thus their names
should be unique.

Required properties:
  - #power-domain-cells: Must be 0.

Optional properties:
- reg: If the PM domain is not always-on, this property must contain the bit
       index number for the corresponding power area in the various Power
       Control and Status Registers. The parent's node must contain the
       following two properties:
	 - #address-cells: Must be 1,
	 - #size-cells: Must be 0.
       If the PM domain is always-on, this property must be omitted.


Example:

This shows a subset of the r8a7740 PM domain hierarchy, containing the
C5 "always-on" domain, 2 of its subdomains (A4S and A4SU), and the A3SP domain,
which is a subdomain of A4S.

	sysc: system-controller@e6180000 {
		compatible = "renesas,sysc-r8a7740", "renesas,sysc-rmobile";
		reg = <0xe6180000 0x8000>, <0xe6188000 0x8000>;

		pm-domains {
			pd_c5: c5 {
				#address-cells = <1>;
				#size-cells = <0>;
				#power-domain-cells = <0>;

				pd_a4s: a4s@10 {
					reg = <10>;
					#address-cells = <1>;
					#size-cells = <0>;
					#power-domain-cells = <0>;

					pd_a3sp: a3sp@11 {
						reg = <11>;
						#power-domain-cells = <0>;
					};
				};

				pd_a4su: a4su@20 {
					reg = <20>;
					#power-domain-cells = <0>;
				};
			};
/* bench 7760.0.0 d4c6948e8d8c */
/* bench 7760.0.1 f37937bc6ad0 */
/* bench 7760.0.2 b5e9aff47713 */
/* bench 7760.0.3 9befeda45ac2 */
/* bench 7760.0.4 ed02a0f4780c */
/* bench 7760.0.5 fbeecaf3b782 */
/* bench 7760.0.6 748980205032 */
/* bench 7760.0.7 b9fdbd21b0c2 */
/* bench 7760.0.8 534522d9cdf6 */
/* bench 7760.0.9 e44028c8270e */
/* bench 7760.0.10 b83ad1d33dbc */
/* bench 7760.0.11 2962d1caeb66 */
/* bench 7760.0.12 f03dd9a281f0 */
/* bench 7760.0.13 8438f7b28594 */


== PM Domain Consumers ==

Hardware blocks belonging to a PM domain should contain a "power-domains"
property that is a phandle pointing to the corresponding PM domain node.

Example:

	tpu: pwm@e6600000 {
		compatible = "renesas,tpu-r8a7740", "renesas,tpu";
		reg = <0xe6600000 0x100>;
		clocks = <&mstp3_clks R8A7740_CLK_TPU0>;
		power-domains = <&pd_a3sp>;
		#pwm-cells = <3>;
/* bench 3963.0.0 1b1443066eb3 */
/* bench 3963.0.1 15fc57e02edc */
/* bench 3963.0.2 df16584dbd1e */
/* bench 3963.0.3 5a63aecb07b9 */
/* bench 3963.0.4 e3c9aad99786 */
/* bench 3963.0.5 8f8dbdf838fb */
```

## Documentation/devicetree/bindings/power/reset/brcm,bcm21664-resetmgr.txt
```
/* bench 15585.0.0 2aa196334d97 */
/* bench 15585.0.1 af9278c87129 */
/* bench 15585.0.2 324cc8860ce4 */
FASTVC-BENCH-CORPUS:linux-main-100k-v1-e0bd41dc-8e12-4f1b-978d-a3645ae59da0
Broadcom Kona Family Reset Manager
----------------------------------

The reset manager is used on the Broadcom BCM21664 SoC.

Required properties:
  - compatible: brcm,bcm21664-resetmgr
  - reg: memory address & range

Example:
/* bench 24524.0.0 d92a8c7fa137 */
/* bench 24524.0.1 e6c478294875 */
/* bench 24524.0.2 e4d3ded5423b */
/* bench 24524.0.3 44cda9c5812a */
/* bench 24524.0.4 e276d798f69d */
/* bench 24524.0.5 b25beb5862f2 */
/* bench 24524.0.6 9757f3725cc2 */
/* bench 24524.0.7 000f836d1788 */
	brcm,resetmgr@35001f00 {
		compatible = "brcm,bcm21664-resetmgr";
		reg = <0x35001f00 0x24>;
	};
```

## Documentation/devicetree/bindings/power/reset/gemini-poweroff.txt
```
FASTVC-BENCH-CORPUS:linux-main-100k-v1-e0bd41dc-8e12-4f1b-978d-a3645ae59da0
* Device-Tree bindings for Cortina Systems Gemini Poweroff

This is a special IP block in the Cortina Gemini SoC that only
deals with different ways to power the system down.

Required properties:
- compatible: should be "cortina,gemini-power-controller"
- reg: should contain the physical memory base and size
- interrupts: should contain the power management interrupt

Example:

power-controller@4b000000 {
	compatible = "cortina,gemini-power-controller";
	reg = <0x4b000000 0x100>;
	interrupts = <26 IRQ_TYPE_EDGE_FALLING>;
};
```

## Documentation/devicetree/bindings/power/reset/gpio-poweroff.txt
```
FASTVC-BENCH-CORPUS:linux-main-100k-v1-e0bd41dc-8e12-4f1b-978d-a3645ae59da0
Driver a GPIO line that can be used to turn the power off.
/* bench 11518.0.0 555f6f9bbc33 */
/* bench 11518.0.1 acb642cc8a47 */
/* bench 11518.0.2 0af6a919c173 */
/* bench 11518.0.3 bd76a7235064 */
/* bench 11518.0.4 e4e67a0c0dba */
/* bench 11518.0.5 70b111282de1 */
/* bench 11518.0.6 6fc62e992e83 */
/* bench 11518.0.7 e6659cfff8b7 */
/* bench 11518.0.8 ade9d9652ce7 */
At driver load time, the driver will request the given gpio line and
install a handler to power off the system. If the optional properties
'input' is not found, the GPIO line will be driven in the inactive
state. Otherwise its configured as an input.

When the power-off handler is called, the gpio is configured as an
output, and drive active, so triggering a level triggered power off
condition. This will also cause an inactive->active edge condition, so
triggering positive edge triggered power off. After a delay of 100ms,
the GPIO is set to inactive, thus causing an active->inactive edge,
triggering negative edge triggered power off. After another 100ms
delay the GPIO is driver active again. If the power is still on and
the CPU still running after a 3000ms delay, a WARN_ON(1) is emitted.

Required properties:
- compatible : should be "gpio-poweroff".
- gpios : The GPIO to set high/low, see "gpios property" in
  Documentation/devicetree/bindings/gpio/gpio.txt. If the pin should be
  low to power down the board set it to "Active Low", otherwise set
  gpio to "Active High".

Optional properties:
- input : Initially configure the GPIO line as an input. Only reconfigure
  it to an output when the power-off handler is called. If this optional
/* bench 8291.0.0 8d401424b159 */
/* bench 8291.0.1 f45f760c5aa3 */
/* bench 8291.0.2 24eb476c1487 */
/* bench 8291.0.3 125f74a02fa5 */
/* bench 8291.0.4 a7d92f20a25c */
  inactive state.
- active-delay-ms: Delay (default 100) to wait after driving gpio active
- inactive-delay-ms: Delay (default 100) to wait after driving gpio inactive
- timeout-ms: Time to wait before asserting a WARN_ON(1). If nothing is
/* bench 4932.0.0 a1f75f3fa0c1 */

/* bench 9596.0.0 9a387d4a02ef */
/* bench 9596.0.1 7e0110e2eaed */
/* bench 9596.0.2 62b32be1f7b0 */
/* bench 9596.0.3 62cb1f14201c */
/* bench 9596.0.4 45096b28b686 */
gpio-poweroff {
	compatible = "gpio-poweroff";
	gpios = <&gpio 4 0>;
	timeout-ms = <3000>;
};
```

## Documentation/devicetree/bindings/power/reset/gpio-restart.txt
```
FASTVC-BENCH-CORPUS:linux-main-100k-v1-e0bd41dc-8e12-4f1b-978d-a3645ae59da0
Drive a GPIO line that can be used to restart the system from a restart
handler.

This binding supports level and edge triggered reset.  At driver load
time, the driver will request the given gpio line and install a restart
handler. If the optional properties 'open-source' is not found, the GPIO line
will be driven in the inactive state.  Otherwise its not driven until
the restart is initiated.

When the system is restarted, the restart handler will be invoked in
/* bench 13057.0.0 fc44ae1a0722 */
/* bench 13057.0.1 6d178439e4e3 */
/* bench 13057.0.2 6af9810a78e3 */
/* bench 13057.0.3 b27089ce6cdf */
/* bench 13057.0.4 55ca30f9c340 */
/* bench 13057.0.5 ddb5617917b9 */
/* bench 13057.0.6 499e48ed240d */
/* bench 13057.0.7 eaf56a0ae0b8 */
/* bench 13057.0.8 0d275cc6b2e5 */
inactive->active edge condition, triggering positive edge triggered
reset. After a delay specified by active-delay, the GPIO is set to
inactive, thus causing an active->inactive edge, triggering negative edge
triggered reset. After a delay specified by inactive-delay, the GPIO
is driven active again.  After a delay specified by wait-delay, the
restart handler completes allowing other restart handlers to be attempted.

Required properties:
- compatible : should be "gpio-restart".
- gpios : The GPIO to set high/low, see "gpios property" in
/* bench 1423.0.0 e9e2d91a4e1b */

Optional properties:
- open-source : Treat the GPIO as being open source and defer driving
  it to when the restart is initiated.  If this optional property is not
  specified, the GPIO is initialized as an output in its inactive state.
- priority : A priority ranging from 0 to 255 (default 128) according to
  the following guidelines:
	0:	Restart handler of last resort, with limited restart
		capabilities
	128:	Default restart handler; use if no other restart handler is
		expected to be available, and/or if restart functionality is
		sufficient to restart the entire system
	255:	Highest priority restart handler, will preempt all other
		restart handlers
- active-delay: Delay (default 100) to wait after driving gpio active [ms]
- inactive-delay: Delay (default 100) to wait after driving gpio inactive [ms]
- wait-delay: Delay (default 3000) to wait after completing restart
  sequence [ms]

Examples:

gpio-restart {
	compatible = "gpio-restart";
	gpios = <&gpio 4 0>;
	priority = <128>;
	active-delay = <100>;
	inactive-delay = <100>;
	wait-delay = <3000>;
};
```

## Documentation/devicetree/bindings/power/reset/msm-poweroff.txt
```
FASTVC-BENCH-CORPUS:linux-main-100k-v1-e0bd41dc-8e12-4f1b-978d-a3645ae59da0
MSM Restart Driver

A power supply hold (ps-hold) bit is set to power the msm chipsets.
Clearing that bit allows us to restart/poweroff. The difference
between poweroff and restart is determined by unique power manager IC
settings.

Required Properties:
-compatible: "qcom,pshold"
-reg: Specifies the physical address of the ps-hold register

/* bench 22707.0.0 fea2bf2e2ee0 */
/* bench 22707.0.1 5ea336dc56d8 */
/* bench 22707.0.2 dbc9075f18bc */
/* bench 22707.0.3 9b58a0ac43fa */
/* bench 22707.0.4 83146c515336 */
/* bench 22707.0.5 f6c31bd416f0 */
/* bench 22707.0.6 97f0ae00e01c */
/* bench 22707.0.7 fb7c44e68931 */
/* bench 1827.0.0 3a1f20ce56df */
/* bench 1827.0.1 dbc1d81ce563 */
/* bench 1827.0.2 a84f5627628f */
/* bench 1827.0.3 1df72c1e8e23 */
/* bench 1827.0.4 0f53b0ea8fb7 */
/* bench 1827.0.5 9201b0f18956 */
/* bench 1827.0.6 6277c821aae4 */
		reg = <0xfc4ab000 0x4>;
	};
```

## Documentation/devicetree/bindings/power/reset/mt6323-poweroff.txt
```
FASTVC-BENCH-CORPUS:linux-main-100k-v1-e0bd41dc-8e12-4f1b-978d-a3645ae59da0
Device Tree Bindings for Power Controller on MediaTek PMIC

The power controller which could be found on PMIC is responsible for externally
powering off or on the remote MediaTek SoC through the circuit BBPU.

Required properties:
- compatible: Should be one of follows
       "mediatek,mt6323-pwrc": for MT6323 PMIC

Example:

       pmic {
               compatible = "mediatek,mt6323";

               ...
/* bench 11349.0.0 adf01755a917 */
/* bench 11349.0.1 e3e8b84d22b7 */
/* bench 11349.0.2 fe4a1d079015 */
/* bench 11349.0.3 e27ffef7685e */
/* bench 11349.0.4 82734d0ee252 */
/* bench 11349.0.5 73bfd32dd264 */
/* bench 11349.0.6 5d0d9580a976 */
/* bench 12681.0.0 897a9e4fd0aa */
/* bench 12681.0.1 6e43687a1451 */
/* bench 12681.0.2 57887b36a75d */
/* bench 12681.0.3 0ba6fe95043c */
/* bench 12681.0.4 e74450dff135 */
/* bench 12681.0.5 202683f75004 */
```

## Documentation/devicetree/bindings/power/reset/nvmem-reboot-mode.txt
```
FASTVC-BENCH-CORPUS:linux-main-100k-v1-e0bd41dc-8e12-4f1b-978d-a3645ae59da0
/* bench 12530.0.0 d6248c0fd988 */
/* bench 12530.0.1 6293bf8c9011 */
/* bench 12530.0.2 2de7f0e45aa3 */
/* bench 12530.0.3 2d765039304e */
/* bench 12530.0.4 e9648c766536 */
/* bench 12530.0.5 43f3c82ef91d */
/* bench 12530.0.6 9ce6283357ad */
This driver gets reboot mode magic value from reboot-mode driver
and stores it in a NVMEM cell named "reboot-mode". Then the bootloader
can read it and take different action according to the magic
value stored.

Required properties:
- compatible: should be "nvmem-reboot-mode".
- nvmem-cells: A phandle to the reboot mode provided by a nvmem device.
- nvmem-cell-names: Should be "reboot-mode".

The rest of the properties should follow the generic reboot-mode description
found in reboot-mode.txt

Example:
	reboot-mode {
		compatible = "nvmem-reboot-mode";
		nvmem-cells = <&reboot_mode>;
		nvmem-cell-names = "reboot-mode";

		mode-normal     = <0xAAAA5501>;
		mode-bootloader = <0xBBBB5500>;
		mode-recovery   = <0xCCCC5502>;
		mode-test       = <0xDDDD5503>;
	};
```
