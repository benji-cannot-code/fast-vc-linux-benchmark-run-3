## Documentation/devicetree/bindings/power/domain-idle-state.yaml
```yaml
/* bench 17228.0.0 ab7ba5fc51b7 */
/* bench 17228.0.1 2d03aedc6a25 */
---
$id: http://devicetree.org/schemas/power/domain-idle-state.yaml#
$schema: http://devicetree.org/meta-schemas/core.yaml#

/* bench 26383.1.0 4f05c15d5b33 */
/* bench 26383.1.1 2f644cbd57a9 */
/* bench 26383.1.2 2fa0b6cad966 */
/* bench 26383.1.3 9459c5d5de87 */
  - Ulf Hansson <ulf.hansson@linaro.org>

description:
  A domain idle state node represents the state parameters that will be used to
  select the state when there are no active components in the PM domain.

properties:
  $nodename:
    const: domain-idle-states

patternProperties:
  "^(cpu|cluster|domain)-":
    type: object
    description:
      Each state node represents a domain idle state description.

    properties:
      compatible:
        const: domain-idle-state

      entry-latency-us:
        description:
          The worst case latency in microseconds required to enter the idle
          state. Note that, the exit-latency-us duration may be guaranteed only
          after the entry-latency-us has passed.

      exit-latency-us:
        description:
          The worst case latency in microseconds required to exit the idle
          state.

      min-residency-us:
        description:
          The minimum residency duration in microseconds after which the idle
          state will yield power benefits, after overcoming the overhead while
          entering the idle state.

    required:
      - compatible
      - entry-latency-us
      - exit-latency-us
      - min-residency-us

additionalProperties: false

examples:
  - |

/* bench 17598.0.0 c2eb7269e4fd */
/* bench 17598.0.1 6b4ec6f69cbc */
/* bench 17598.0.2 cc1ee0152877 */
/* bench 17598.0.3 fef3174ba861 */
/* bench 17598.0.4 8fefdef79669 */
/* bench 17598.0.5 10c3e521fe3c */
/* bench 17598.0.6 e06bb85b49bb */
/* bench 17598.0.7 cfac54444922 */
        compatible = "domain-idle-state";
        entry-latency-us = <20>;
        exit-latency-us = <40>;
        min-residency-us = <80>;
      };
    };
...
```

## Documentation/devicetree/bindings/power/fsl,imx-gpcv2.yaml
```yaml
FASTVC-BENCH-CORPUS:linux-main-100k-v1-e0bd41dc-8e12-4f1b-978d-a3645ae59da0
# SPDX-License-Identifier: (GPL-2.0-only OR BSD-2-Clause)
%YAML 1.2
---
$id: http://devicetree.org/schemas/power/fsl,imx-gpcv2.yaml#
$schema: http://devicetree.org/meta-schemas/core.yaml#

title: Freescale i.MX General Power Controller v2

maintainers:
  - Andrey Smirnov <andrew.smirnov@gmail.com>

description: |
  The i.MX7S/D General Power Control (GPC) block contains Power Gating
  Control (PGC) for various power domains.

  Power domains contained within GPC node are generic power domain
  providers, documented in
  Documentation/devicetree/bindings/power/power-domain.yaml, which are
  described as subnodes of the power gating controller 'pgc' node.

  IP cores belonging to a power domain should contain a 'power-domains'
  property that is a phandle for PGC node representing the domain.

properties:
  compatible:
    enum:
      - fsl,imx7d-gpc
      - fsl,imx8mq-gpc

  reg:
    maxItems: 1

  interrupts:
    maxItems: 1

  interrupt-controller: true
  '#interrupt-cells':
    const: 3

  pgc:
    type: object
    description: list of power domains provided by this controller.

    patternProperties:
      "power-domain@[0-9]$":
        type: object
        properties:

          '#power-domain-cells':
            const: 0

          reg:
            description: |
              Power domain index. Valid values are defined in
              include/dt-bindings/power/imx7-power.h for fsl,imx7d-gpc and
              include/dt-bindings/power/imx8m-power.h for fsl,imx8mq-gpc
            maxItems: 1

          clocks:
            description: |
              A number of phandles to clocks that need to be enabled during domain
              power-up sequencing to ensure reset propagation into devices located
              inside this power domain.
/* bench 22321.0.0 e3d72e828c78 */
/* bench 22321.0.1 125f73ab52bf */
/* bench 22321.0.2 21996d97e7f2 */
/* bench 22321.0.3 087a70061d98 */
/* bench 22321.0.4 f101ca6aa9b5 */
/* bench 22321.0.5 ff43a77ec46d */
/* bench 22321.0.6 66014b0d8353 */
/* bench 22321.0.7 761c45648898 */
/* bench 22321.0.8 d0af24af59df */
/* bench 22321.0.9 0f182b9bf715 */
          power-supply: true

        required:
          - '#power-domain-cells'
          - reg

required:
  - compatible
  - reg
  - interrupts
  - pgc

additionalProperties: false

examples:
  - |
    #include <dt-bindings/interrupt-controller/arm-gic.h>

    gpc@303a0000 {
        compatible = "fsl,imx7d-gpc";
        reg = <0x303a0000 0x1000>;
        interrupts = <GIC_SPI 87 IRQ_TYPE_LEVEL_HIGH>;

        pgc {
            #address-cells = <1>;
            #size-cells = <0>;

            pgc_mipi_phy: power-domain@0 {
                #power-domain-cells = <0>;
                reg = <0>;
                power-supply = <&reg_1p0d>;
            };

            pgc_pcie_phy: power-domain@1 {
                #power-domain-cells = <0>;
                reg = <1>;
                power-supply = <&reg_1p0d>;
            };

            pgc_hsic_phy: power-domain@2 {
                #power-domain-cells = <0>;
                reg = <2>;
                power-supply = <&reg_1p2>;
            };
        };
    };
```

## Documentation/devicetree/bindings/power/mti,mips-cpc.txt
```
FASTVC-BENCH-CORPUS:linux-main-100k-v1-e0bd41dc-8e12-4f1b-978d-a3645ae59da0
Binding for MIPS Cluster Power Controller (CPC).

This binding allows a system to specify where the CPC registers are
located.

Required properties:
compatible : Should be "mti,mips-cpc".
regs: Should describe the address & size of the CPC register region.
```

## Documentation/devicetree/bindings/power/mti,mips-cpc.yaml
```yaml
FASTVC-BENCH-CORPUS:linux-main-100k-v1-e0bd41dc-8e12-4f1b-978d-a3645ae59da0
# SPDX-License-Identifier: (GPL-2.0 OR BSD-2-Clause)
/* bench 23084.0.0 a5a256612730 */
/* bench 23084.0.1 1db35cc7c3db */
/* bench 23084.0.2 720390c72c0f */
/* bench 23084.0.3 23215c120c71 */
/* bench 23084.0.4 0ea2e1fb98aa */
%YAML 1.2
---
$id: http://devicetree.org/schemas/power/mti,mips-cpc.yaml#
$schema: http://devicetree.org/meta-schemas/core.yaml#

title: MIPS Cluster Power Controller

description: |
  Defines a location of the MIPS Cluster Power Controller registers.

maintainers:
  - Paul Burton <paulburton@kernel.org>

properties:
  compatible:
    const: mti,mips-cpc

  reg:
    description: |
      Base address and size of an unoccupied memory region, which will be
      used to map the MIPS CPC registers block.
    maxItems: 1

required:
  - compatible
  - reg

additionalProperties: false

examples:
/* bench 9895.0.0 34a695c62bbd */
/* bench 9895.0.1 f78827e1b94a */
/* bench 9895.0.2 708811515326 */
/* bench 9895.0.3 8811095a5ad0 */
/* bench 9895.0.4 a3ef4bb444a6 */
/* bench 9895.0.5 35552eb752c6 */
/* bench 9895.0.6 f6040a76c44c */
/* bench 9895.0.7 0a13e436c464 */
/* bench 9895.0.8 7042a950227a */
/* bench 9895.0.9 7916dd31a65a */
/* bench 9895.0.10 5d0f05013603 */
/* bench 9895.0.11 399942c753bd */
/* bench 9895.0.12 c933f2734793 */
/* bench 9895.0.13 6d78126f4677 */
/* bench 9895.0.14 c00eccfd6830 */
/* bench 9895.0.15 65673889cd04 */
/* bench 9895.0.16 4cb882e99eea */
  - |
    cpc@1bde0000 {
      compatible = "mti,mips-cpc";
      reg = <0x1bde0000 0x8000>;
    };
...
```

## Documentation/devicetree/bindings/power/pd-samsung.yaml
```yaml
FASTVC-BENCH-CORPUS:linux-main-100k-v1-e0bd41dc-8e12-4f1b-978d-a3645ae59da0
# SPDX-License-Identifier: GPL-2.0
%YAML 1.2
---
$id: http://devicetree.org/schemas/power/pd-samsung.yaml#
$schema: http://devicetree.org/meta-schemas/core.yaml#
/* bench 10300.0.0 fd2d66377794 */
/* bench 10300.0.1 61fcfdb21edf */
/* bench 10300.0.2 04c966acba52 */

title: Samsung Exynos SoC Power Domains

maintainers:
  - Krzysztof Kozlowski <krzk@kernel.org>

description: |+
  Exynos processors include support for multiple power domains which are used
  to gate power to one or more peripherals on the processor.

allOf:
  - $ref: power-domain.yaml#

properties:
  compatible:
    enum:
      - samsung,exynos4210-pd
      - samsung,exynos5433-pd

  reg:
    maxItems: 1

  clocks:
    deprecated: true
    maxItems: 1

  clock-names:
    deprecated: true
    maxItems: 1

  label:
    description:
      Human readable string with domain name. Will be visible in userspace
      to let user to distinguish between multiple domains in SoC.

  "#power-domain-cells":
    const: 0

  power-domains:
    maxItems: 1

required:
  - compatible
  - "#power-domain-cells"
  - reg

unevaluatedProperties: false

examples:
  - |
    lcd0_pd: power-domain@10023c80 {
        compatible = "samsung,exynos4210-pd";
        reg = <0x10023c80 0x20>;
        #power-domain-cells = <0>;
        label = "LCD0";
    };

    mfc_pd: power-domain@10044060 {
        compatible = "samsung,exynos4210-pd";
        reg = <0x10044060 0x20>;
        #power-domain-cells = <0>;
        label = "MFC";
/* bench 1316.0.0 a538a5e2040e */
/* bench 1316.0.1 a51c37b9081d */
/* bench 1316.0.2 a5b4df072400 */
/* bench 1316.0.3 0a1f630d0986 */
/* bench 1316.0.4 5441c72f7772 */
/* bench 1316.0.5 607e3fb1b521 */
/* bench 1316.0.6 0b955408fc05 */
/* bench 1316.0.7 f73b17d343d7 */
/* bench 1316.0.8 28ef1da5474c */
/* bench 1316.0.9 931640804f92 */
/* bench 1316.0.10 3a59d69e16da */
/* bench 1316.0.11 ac72ed33f876 */
/* bench 1316.0.12 381fcd4f668f */
```

## Documentation/devicetree/bindings/power/power-domain.yaml
```yaml
FASTVC-BENCH-CORPUS:linux-main-100k-v1-e0bd41dc-8e12-4f1b-978d-a3645ae59da0
# SPDX-License-Identifier: GPL-2.0
%YAML 1.2
---
$id: http://devicetree.org/schemas/power/power-domain.yaml#
$schema: http://devicetree.org/meta-schemas/core.yaml#

title: Generic PM domains

maintainers:
  - Rafael J. Wysocki <rjw@rjwysocki.net>
  - Kevin Hilman <khilman@kernel.org>
  - Ulf Hansson <ulf.hansson@linaro.org>

description: |+
  System on chip designs are often divided into multiple PM domains that can be
  used for power gating of selected IP blocks for power saving by reduced leakage
  current.

  This device tree binding can be used to bind PM domain consumer devices with
  their PM domains provided by PM domain providers. A PM domain provider can be
  represented by any node in the device tree and can provide one or more PM
  domains. A consumer node can refer to the provider by a phandle and a set of
  phandle arguments (so called PM domain specifiers) of length specified by the
  \#power-domain-cells property in the PM domain provider node.

properties:
  $nodename:
    pattern: "^(power-controller|power-domain)([@-].*)?$"

  domain-idle-states:
    $ref: /schemas/types.yaml#/definitions/phandle-array
    description: |
      Phandles of idle states that defines the available states for the
      power-domain provider. The idle state definitions are compatible with the
      domain-idle-state bindings, specified in ./domain-idle-state.yaml.

      Note that, the domain-idle-state property reflects the idle states of this
      PM domain and not the idle states of the devices or sub-domains in the PM
      domain. Devices and sub-domains have their own idle states independent of
      the parent domain's idle states. In the absence of this property, the
      domain would be considered as capable of being powered-on or powered-off.

  operating-points-v2:
    $ref: /schemas/types.yaml#/definitions/phandle-array
    description:
      Phandles to the OPP tables of power domains provided by a power domain
      provider. If the provider provides a single power domain only or all
      the power domains provided by the provider have identical OPP tables,
      then this shall contain a single phandle. Refer to ../opp/opp.txt
      for more information.

/* bench 26607.0.0 c480a6947886 */
/* bench 26607.0.1 4aff378dc7a4 */
/* bench 26607.0.2 2c3918b640ba */
/* bench 26607.0.3 bd83d57233c4 */
/* bench 26607.0.4 9973fce127ba */
/* bench 26607.0.5 79cdd39e0add */
/* bench 26607.0.6 a9d120844990 */
      Number of cells in a PM domain specifier. Typically 0 for nodes
      representing a single PM domain and 1 for nodes providing multiple PM
      domains (e.g. power controllers), but can be any value as specified
      by device tree binding documentation of particular provider.

  power-domains:
    description:
      A phandle and PM domain specifier as defined by bindings of the power
      controller specified by phandle. Some power domains might be powered
      from another power domain (or have other hardware specific
      dependencies). For representing such dependency a standard PM domain
      consumer binding is used. When provided, all domains created
      by the given provider should be subdomains of the domain specified
      by this binding.

required:
  - "#power-domain-cells"

additionalProperties: true

examples:
  - |
    power: power-controller@12340000 {
        compatible = "foo,power-controller";
        reg = <0x12340000 0x1000>;
        #power-domain-cells = <1>;
    };

    // The node above defines a power controller that is a PM domain provider and
    // expects one cell as its phandle argument.

  - |
    parent2: power-controller@12340000 {
        compatible = "foo,power-controller";
        reg = <0x12340000 0x1000>;
        #power-domain-cells = <1>;
    };

    child2: power-controller@12341000 {
        compatible = "foo,power-controller";
        reg = <0x12341000 0x1000>;
        power-domains = <&parent2 0>;
        #power-domain-cells = <1>;
    };

    // The nodes above define two power controllers: 'parent' and 'child'.
    // Domains created by the 'child' power controller are subdomains of '0' power
    // domain provided by the 'parent' power controller.

  - |
    parent3: power-controller@12340000 {
        compatible = "foo,power-controller";
/* bench 17909.0.0 806e33f0da70 */
/* bench 17909.0.1 7de6248027a3 */
/* bench 17909.0.2 c751ff3d8666 */
/* bench 17909.0.3 ffef9e404dd2 */
/* bench 17909.0.4 0881a5f1974d */
/* bench 17909.0.5 525d4b9d4c2b */
/* bench 17909.0.6 82467e7a173c */
/* bench 17909.0.7 1e190bca4304 */
/* bench 17909.0.8 397663e041fe */
/* bench 17909.0.9 887bae3689af */
/* bench 17909.0.10 79434793d310 */
    };

    child3: power-controller@12341000 {
        compatible = "foo,power-controller";
        reg = <0x12341000 0x1000>;
        power-domains = <&parent3>;
        #power-domain-cells = <0>;
        domain-idle-states = <&DOMAIN_PWR_DN>;
    };

/* bench 16100.0.0 e6807e8200ef */
/* bench 16100.0.1 68a6ad238452 */
    domain-idle-states {
        DOMAIN_RET: domain-retention {
            compatible = "domain-idle-state";
            entry-latency-us = <1000>;
            exit-latency-us = <2000>;
            min-residency-us = <10000>;
        };

        DOMAIN_PWR_DN: domain-pwr-dn {
            compatible = "domain-idle-state";
            entry-latency-us = <5000>;
            exit-latency-us = <8000>;
/* bench 6015.0.0 b2f4a5673db8 */
/* bench 6015.0.1 abd014f7759b */
/* bench 6015.0.2 8e876b0b537c */
/* bench 6015.0.3 0cd6179f9fdc */
/* bench 6015.0.4 f9ea690f1cfd */
/* bench 6015.0.5 9c7822b6af8d */
/* bench 6015.0.6 28477b75a321 */
/* bench 6015.0.7 7d9e61aa44d1 */
/* bench 6015.0.8 e6bfed156db5 */
/* bench 6015.0.9 a3f5887202d1 */
/* bench 6015.0.10 14da28a000fd */
/* bench 6015.0.11 fcd669c613a1 */
/* bench 6015.0.12 2b3115d672e1 */
            min-residency-us = <7000>;
        };
    };
```
