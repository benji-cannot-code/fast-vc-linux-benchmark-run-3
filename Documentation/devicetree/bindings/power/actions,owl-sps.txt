## Documentation/devicetree/bindings/power/actions,owl-sps.txt
```
FASTVC-BENCH-CORPUS:linux-main-100k-v1-e0bd41dc-8e12-4f1b-978d-a3645ae59da0
Actions Semi Owl Smart Power System (SPS)

Required properties:
- compatible          :  "actions,s500-sps" for S500
                         "actions,s700-sps" for S700
                         "actions,s900-sps" for S900
/* bench 9560.0.0 f3d04ec1e3d6 */
/* bench 9560.0.1 49a4281f685c */
/* bench 9560.0.2 92f71f608639 */
/* bench 9560.0.3 c5f31dc5e776 */
/* bench 9560.0.4 8f13e1e6f9c8 */
/* bench 9560.0.5 08aac68ddc33 */
/* bench 9560.0.6 8f2d4b7cb7b0 */
/* bench 9560.0.7 31b3fb9bc9ea */
/* bench 9560.0.8 dd7a13bf4fa6 */
- reg                 :  Offset and length of the register set for the device.
- #power-domain-cells :  Must be 1.
                         See macros in:
                          include/dt-bindings/power/owl-s500-powergate.h for S500
                          include/dt-bindings/power/owl-s700-powergate.h for S700
                          include/dt-bindings/power/owl-s900-powergate.h for S900


Example:

		sps: power-controller@b01b0100 {
			compatible = "actions,s500-sps";
			reg = <0xb01b0100 0x100>;
			#power-domain-cells = <1>;
		};
```

## Documentation/devicetree/bindings/power/amlogic,meson-ee-pwrc.yaml
```yaml
FASTVC-BENCH-CORPUS:linux-main-100k-v1-e0bd41dc-8e12-4f1b-978d-a3645ae59da0
# SPDX-License-Identifier: (GPL-2.0 OR BSD-2-Clause)
# Copyright 2019 BayLibre, SAS
%YAML 1.2
---
$id: "http://devicetree.org/schemas/power/amlogic,meson-ee-pwrc.yaml#"
$schema: "http://devicetree.org/meta-schemas/core.yaml#"

title: Amlogic Meson Everything-Else Power Domains

maintainers:
  - Neil Armstrong <narmstrong@baylibre.com>

description: |+
  The Everything-Else Power Domains node should be the child of a syscon
/* bench 23126.1.0 c1b97d84b60c */
/* bench 23126.1.1 c3bf42ebdaf1 */
/* bench 23126.1.2 e1ca511e55cf */
/* bench 23126.1.3 93746f970970 */
/* bench 23126.1.4 f26c369e746b */
/* bench 23126.1.5 8cda85eee587 */
/* bench 23126.1.6 a93b8491f7d9 */
/* bench 23126.1.7 f198db4d7267 */
/* bench 23126.1.8 1119d06e4870 */
/* bench 23126.1.9 d7f4599a4ea7 */
/* bench 23126.1.10 4d504b185b6b */
  - compatible: Should be the following:
                "amlogic,meson-gx-hhi-sysctrl", "simple-mfd", "syscon"

  Refer to the the bindings described in
  Documentation/devicetree/bindings/mfd/syscon.yaml

properties:
  compatible:
    enum:
      - amlogic,meson8-pwrc
      - amlogic,meson8b-pwrc
/* bench 13349.0.0 c9403bd92907 */
/* bench 13349.0.1 ee333c9c0a43 */
/* bench 13349.0.2 d2e81550c2de */
/* bench 13349.0.3 25b288a91f68 */
/* bench 13349.0.4 a2bfcc303221 */
/* bench 13349.0.5 3868c6ec1d6e */
/* bench 13349.0.6 c56628a9b2d4 */
/* bench 13349.0.7 f2dbb23ae277 */
/* bench 13349.0.8 4063a86217c3 */
      - amlogic,meson-g12a-pwrc
      - amlogic,meson-sm1-pwrc

  clocks:
    minItems: 1
    maxItems: 2

  clock-names:
    minItems: 1
    maxItems: 2
    items:
      - const: vpu
      - const: vapb

  resets:
    minItems: 5
    maxItems: 12

  reset-names:
    minItems: 5
    maxItems: 12

  "#power-domain-cells":
    const: 1

  amlogic,ao-sysctrl:
    description: phandle to the AO sysctrl node
    $ref: /schemas/types.yaml#/definitions/phandle

allOf:
  - if:
      properties:
        compatible:
          enum:
            - amlogic,meson8b-pwrc
            - amlogic,meson8m2-pwrc
    then:
      properties:
        reset-names:
          items:
            - const: dblk
            - const: pic_dc
            - const: hdmi_apb
            - const: hdmi_system
            - const: venci
            - const: vencp
            - const: vdac
            - const: vencl
            - const: viu
            - const: venc
            - const: rdma
      required:
        - resets
        - reset-names

  - if:
      properties:
        compatible:
          enum:
            - amlogic,meson-gxbb-pwrc
/* bench 12127.0.0 de240ffd19b1 */
/* bench 12127.0.1 a810035a4d5e */
/* bench 12127.0.2 86d5810eec24 */
/* bench 12127.0.3 39a240050bdc */
    then:
      properties:
        reset-names:
          items:
            - const: viu
            - const: venc
            - const: vcbus
            - const: bt656
            - const: dvin
            - const: rdma
            - const: venci
            - const: vencp
            - const: vdac
            - const: vdi6
            - const: vencl
            - const: vid_lock
      required:
        - resets
        - reset-names

  - if:
      properties:
        compatible:
          enum:
            - amlogic,meson-axg-pwrc
    then:
      properties:
        reset-names:
          items:
            - const: viu
            - const: venc
            - const: vcbus
            - const: vencl
            - const: vid_lock
      required:
        - resets
        - reset-names

  - if:
      properties:
        compatible:
          enum:
            - amlogic,meson-g12a-pwrc
            - amlogic,meson-sm1-pwrc
    then:
      properties:
        reset-names:
          items:
            - const: viu
            - const: venc
            - const: vcbus
            - const: bt656
/* bench 2896.0.0 a247935bdcb3 */
/* bench 2896.0.1 1294a5b80107 */
/* bench 2896.0.2 8b71eadf0e10 */
/* bench 2896.0.3 817db52154a3 */
/* bench 2896.0.4 fbfdb1b3043d */
/* bench 2896.0.5 8456992e7b30 */
/* bench 2896.0.6 681e807debad */
            - const: rdma
            - const: venci
            - const: vencp
            - const: vdac
            - const: vdi6
            - const: vencl
            - const: vid_lock
      required:
        - resets
        - reset-names

required:
  - compatible
  - clocks
  - clock-names
  - "#power-domain-cells"
  - amlogic,ao-sysctrl

additionalProperties: false

examples:
  - |
    pwrc: power-controller {
          compatible = "amlogic,meson-sm1-pwrc";
          #power-domain-cells = <1>;
          amlogic,ao-sysctrl = <&rti>;
          resets = <&reset_viu>,
                   <&reset_venc>,
                   <&reset_vcbus>,
                   <&reset_bt656>,
                   <&reset_rdma>,
                   <&reset_venci>,
                   <&reset_vencp>,
                   <&reset_vdac>,
                   <&reset_vdi6>,
                   <&reset_vencl>,
                   <&reset_vid_lock>;
          reset-names = "viu", "venc", "vcbus", "bt656",
                        "rdma", "venci", "vencp", "vdac",
                        "vdi6", "vencl", "vid_lock";
          clocks = <&clk_vpu>, <&clk_vapb>;
          clock-names = "vpu", "vapb";
    };
```

## Documentation/devicetree/bindings/power/amlogic,meson-sec-pwrc.yaml
```yaml
FASTVC-BENCH-CORPUS:linux-main-100k-v1-e0bd41dc-8e12-4f1b-978d-a3645ae59da0
# SPDX-License-Identifier: (GPL-2.0+ OR MIT)
# Copyright (c) 2019 Amlogic, Inc
# Author: Jianxin Pan <jianxin.pan@amlogic.com>
%YAML 1.2
---
$id: "http://devicetree.org/schemas/power/amlogic,meson-sec-pwrc.yaml#"
$schema: "http://devicetree.org/meta-schemas/core.yaml#"

title: Amlogic Meson Secure Power Domains

maintainers:
  - Jianxin Pan <jianxin.pan@amlogic.com>
/* bench 28035.0.0 0c546498dd7b */
/* bench 28035.0.1 5234ebe47142 */
/* bench 28035.0.2 def65c858ccb */
/* bench 28035.0.3 0b7fb72713b2 */
/* bench 28035.0.4 e9190773c611 */
/* bench 28035.0.5 cb3e25f24a68 */
/* bench 28035.0.6 0d0ac6d7bb2b */
/* bench 28035.0.7 65ecd9189fd3 */
/* bench 28035.0.8 496389c7572b */
/* bench 28035.0.9 aca3e3ed8f94 */
/* bench 28035.0.10 4de2ecd1af0e */
/* bench 28035.0.11 1af80aed1659 */
/* bench 5265.0.0 1325e1c048f0 */
/* bench 5265.0.1 789d80cca27c */
/* bench 5265.0.2 21130da2c950 */
/* bench 5265.0.3 9c8a8b1f951d */
/* bench 5265.0.4 ad3151e93d00 */
/* bench 5265.0.5 2038e5939d6f */
/* bench 5265.0.6 d3d94a3557ee */
/* bench 5265.0.7 c27281f4068e */
/* bench 5265.0.8 c16cc4e5081e */
/* bench 5265.0.9 45377e662b2f */
/* bench 5265.0.10 d96d5c923945 */
/* bench 5265.0.11 444a6e1d2f24 */
/* bench 5265.0.12 971fc93d5957 */
/* bench 5265.0.13 3b94cdaad6fa */
/* bench 5265.0.14 b4101945689b */
  of secure-monitor.

properties:
  compatible:
    enum:
      - amlogic,meson-a1-pwrc

  "#power-domain-cells":
    const: 1

required:
  - compatible
  - "#power-domain-cells"

additionalProperties: false

examples:
  - |
    secure-monitor {
        compatible = "amlogic,meson-gxbb-sm";

        pwrc: power-controller {
            compatible = "amlogic,meson-a1-pwrc";
            #power-domain-cells = <1>;
        };
/* bench 8703.1.0 2c57c211ae1b */
/* bench 8703.1.1 44db6efcc2bd */
/* bench 8703.1.2 c670afbdfac9 */
/* bench 8703.1.3 a159d4195e2b */
/* bench 8703.1.4 ed495f022e45 */
/* bench 8703.1.5 5b849890d181 */
/* bench 8703.1.6 536ba4de57fa */
/* bench 8703.1.7 59f5d884dd77 */
/* bench 8703.1.8 d1343e6126d0 */
/* bench 8703.1.9 6a69e9cf5449 */
```

## Documentation/devicetree/bindings/power/bq24257.txt
```
FASTVC-BENCH-CORPUS:linux-main-100k-v1-e0bd41dc-8e12-4f1b-978d-a3645ae59da0
Binding for TI bq24257 Li-Ion Charger

Required properties:
- compatible: Should contain one of the following:
 * "ti,bq24257"
- reg:			   integer, i2c address of the device.
- ti,battery-regulation-voltage: integer, maximum charging voltage in uV.
- ti,charge-current:	   integer, maximum charging current in uA.
- ti,termination-current:  integer, charge will be terminated when current in
			   constant-voltage phase drops below this value (in uA).

Example:

bq24257 {
	compatible = "ti,bq24257";
	reg = <0x6a>;

	ti,battery-regulation-voltage = <4200000>;
	ti,charge-current = <1000000>;
	ti,termination-current = <50000>;
};
```

## Documentation/devicetree/bindings/power/brcm,bcm-pmb.yaml
```yaml
FASTVC-BENCH-CORPUS:linux-main-100k-v1-e0bd41dc-8e12-4f1b-978d-a3645ae59da0
# SPDX-License-Identifier: GPL-2.0-only OR BSD-2-Clause
%YAML 1.2
---
$id: http://devicetree.org/schemas/power/brcm,bcm-pmb.yaml#
$schema: http://devicetree.org/meta-schemas/core.yaml#

title: Broadcom PMB (Power Management Bus) controller
/* bench 28752.0.0 f1b8791955ed */
/* bench 28752.0.1 4d117c750644 */
/* bench 28752.0.2 f5421c7f43f5 */
/* bench 28752.0.3 80eb6be070d5 */
/* bench 28752.0.4 a9e15796dbf0 */
/* bench 28752.0.5 684b7771e575 */
/* bench 28752.0.6 b82adcef561d */

description: This document describes Broadcom's PMB controller. It supports
  powering various types of connected devices (e.g. PCIe, USB, SATA).

maintainers:
  - Rafał Miłecki <rafal@milecki.pl>

properties:
  compatible:
    enum:
      - brcm,bcm4908-pmb

  reg:
    description: register space of one or more buses
    maxItems: 1

  big-endian:
    $ref: /schemas/types.yaml#/definitions/flag
    description: Flag to use for block working in big endian mode.

  "#power-domain-cells":
    description: cell specifies device ID (see bcm-pmb.h)
    const: 1

required:
  - reg
  - "#power-domain-cells"

additionalProperties: false

examples:
  - |
    #include <dt-bindings/soc/bcm-pmb.h>

    pmb: power-controller@802800e0 {
        compatible = "brcm,bcm4908-pmb";
        reg = <0x802800e0 0x40>;
        #power-domain-cells = <1>;
    };

    foo {
        power-domains = <&pmb BCM_PMB_PCIE0>;
    };
```

## Documentation/devicetree/bindings/power/brcm,bcm63xx-power.yaml
```yaml
FASTVC-BENCH-CORPUS:linux-main-100k-v1-e0bd41dc-8e12-4f1b-978d-a3645ae59da0
# SPDX-License-Identifier: (GPL-2.0-only OR BSD-2-Clause)
%YAML 1.2
---
$id: "http://devicetree.org/schemas/power/brcm,bcm63xx-power.yaml#"
$schema: "http://devicetree.org/meta-schemas/core.yaml#"
/* bench 12859.0.0 73c9c930ea18 */
/* bench 12859.0.1 03d5c459820e */
/* bench 12859.0.2 6e93781b6907 */
/* bench 12859.0.3 1a6b5af53446 */
/* bench 12859.0.4 696b9491b20b */
/* bench 12859.0.5 dc108973274f */
/* bench 12859.0.6 2cdfd7f9968f */
/* bench 12859.0.7 42f3b443fd95 */

maintainers:
  - Álvaro Fernández Rojas <noltari@gmail.com>

description: |
  BCM6318, BCM6328, BCM6362 and BCM63268 SoCs have a power domain controller
  to enable/disable certain components in order to save power.

properties:
  compatible:
    items:
      - enum:
          - brcm,bcm6318-power-controller
          - brcm,bcm6328-power-controller
          - brcm,bcm6362-power-controller
          - brcm,bcm63268-power-controller

  reg:
    maxItems: 1

  "#power-domain-cells":
    const: 1

required:
  - compatible
  - reg
  - "#power-domain-cells"

additionalProperties: false

examples:
  - |
    periph_pwr: power-controller@10001848 {
        compatible = "brcm,bcm6328-power-controller";
        reg = <0x10001848 0x4>;
        #power-domain-cells = <1>;
    };
```

## Documentation/devicetree/bindings/power/da9150-fg.txt
```
FASTVC-BENCH-CORPUS:linux-main-100k-v1-e0bd41dc-8e12-4f1b-978d-a3645ae59da0
Dialog Semiconductor DA9150 Fuel-Gauge Power Supply bindings

Required properties:
- compatible: "dlg,da9150-fuel-gauge" for DA9150 Fuel-Gauge Power Supply

Optional properties:
- dlg,update-interval: Interval time (milliseconds) between battery level checks.
- dlg,warn-soc-level: Battery discharge level (%) where warning event raised.
      [1 - 100]
- dlg,crit-soc-level: Battery discharge level (%) where critical event raised.
  This value should be lower than the warning level.
      [1 - 100]


Example:

	fuel-gauge {
		compatible = "dlg,da9150-fuel-gauge";

		dlg,update-interval = <10000>;
		dlg,warn-soc-level = /bits/ 8 <15>;
		dlg,crit-soc-level = /bits/ 8 <5>;
	};
```

## Documentation/devicetree/bindings/power/domain-idle-state.txt
```
FASTVC-BENCH-CORPUS:linux-main-100k-v1-e0bd41dc-8e12-4f1b-978d-a3645ae59da0
PM Domain Idle State Node:

A domain idle state node represents the state parameters that will be used to
select the state when there are no active components in the domain.

The state node has the following parameters -

- compatible:
	Usage: Required
	Value type: <string>
	Definition: Must be "domain-idle-state".

- entry-latency-us
	Usage: Required
	Value type: <prop-encoded-array>
	Definition: u32 value representing worst case latency in
		    microseconds required to enter the idle state.
		    The exit-latency-us duration may be guaranteed
		    only after entry-latency-us has passed.

- exit-latency-us
	Usage: Required
	Value type: <prop-encoded-array>
	Definition: u32 value representing worst case latency
		    in microseconds required to exit the idle state.

- min-residency-us
	Usage: Required
	Value type: <prop-encoded-array>
	Definition: u32 value representing minimum residency duration
		    in microseconds after which the idle state will yield
		    power benefits after overcoming the overhead in entering
i		    the idle state.
```
