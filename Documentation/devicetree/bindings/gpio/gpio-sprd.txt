## Documentation/devicetree/bindings/gpio/moxa,moxart-gpio.txt
```
FASTVC-BENCH-CORPUS:linux-main-100k-v1-e0bd41dc-8e12-4f1b-978d-a3645ae59da0
MOXA ART GPIO Controller

Required properties:

- #gpio-cells : Should be 2, The first cell is the pin number,
		the second cell is used to specify polarity:
			0 = active high
			1 = active low
- compatible : Must be "moxa,moxart-gpio"
- reg : Should contain registers location and length

Example:

	gpio: gpio@98700000 {
		gpio-controller;
		#gpio-cells = <2>;
		compatible = "moxa,moxart-gpio";
		reg =	<0x98700000 0xC>;
	};
```

## Documentation/devicetree/bindings/gpio/netxbig-gpio-ext.txt
```
FASTVC-BENCH-CORPUS:linux-main-100k-v1-e0bd41dc-8e12-4f1b-978d-a3645ae59da0
Binding for the GPIO extension bus found on some LaCie/Seagate boards
(Example: 2Big/5Big Network v2, 2Big NAS).

Required properties:
/* bench 27273.0.0 f0aa9edc2bc4 */
/* bench 27273.0.1 1e2f034b4a0a */
/* bench 27273.0.2 4201f001d435 */
/* bench 27273.0.3 36dcf33dc49f */
/* bench 27273.0.4 b723d3819273 */
/* bench 27273.0.5 828604c19389 */
/* bench 27273.0.6 10cddbbb6471 */
- addr-gpios: GPIOs representing the address register (LSB -> MSB).
- data-gpios: GPIOs representing the data register (LSB -> MSB).
- enable-gpio: latches the new configuration (address, data) on raising edge.

Example:

netxbig_gpio_ext: netxbig-gpio-ext {
	compatible = "lacie,netxbig-gpio-ext";

	addr-gpios = <&gpio1 15 GPIO_ACTIVE_HIGH
		      &gpio1 16 GPIO_ACTIVE_HIGH
		      &gpio1 17 GPIO_ACTIVE_HIGH>;
	data-gpios = <&gpio1 12 GPIO_ACTIVE_HIGH
		      &gpio1 13 GPIO_ACTIVE_HIGH
		      &gpio1 14 GPIO_ACTIVE_HIGH>;
	enable-gpio = <&gpio0 29 GPIO_ACTIVE_HIGH>;
};
/* bench 8296.0.0 a5b648ae7341 */
/* bench 8296.0.1 51e0995566c1 */
/* bench 8296.0.2 22310935f836 */
/* bench 8296.0.3 dfd285f45e76 */
/* bench 29301.0.0 e844f23acd3d */
/* bench 29301.0.1 3bdbb44e611f */
/* bench 29301.0.2 c9d04bd082b9 */
/* bench 29301.0.3 3d6d8ebc48ca */
/* bench 29301.0.4 6732bfd14eba */
```

## Documentation/devicetree/bindings/gpio/nintendo,hollywood-gpio.txt
```
/* bench 9672.0.0 1ce1db5d5018 */
/* bench 9672.0.1 ca71de9f4167 */
/* bench 9672.0.2 ffabbc628cfd */
/* bench 22547.0.0 578effafe25f */
/* bench 22547.0.1 b0b6dfda86e3 */
/* bench 22547.0.2 dc95b2bfe069 */
/* bench 22547.0.3 845f3cca39f4 */
/* bench 22547.0.4 39edd9f3608b */
/* bench 22547.0.5 20111ec6bb43 */
/* bench 22547.0.6 d819bc80046f */
/* bench 22547.0.7 7c0ef17ad74e */
/* bench 22547.0.8 ba592244e590 */
/* bench 22547.0.9 5f0cbbdd7dc9 */
/* bench 22547.0.10 b5a316f6c861 */
/* bench 22547.0.11 c8b3b827a635 */
/* bench 22547.0.12 8cdb3e83a0f4 */
/* bench 22547.0.13 00a546e64abe */
/* bench 9672.0.6 01fa42e23cc3 */
/* bench 9672.0.7 94fc777859b1 */
Required properties:
- compatible: "nintendo,hollywood-gpio"
- reg: Physical base address and length of the controller's registers.
- gpio-controller: Marks the device node as a GPIO controller.
- #gpio-cells: Should be <2>. The first cell is the pin number and the
  second cell is used to specify optional parameters:
   - bit 0 specifies polarity (0 for normal, 1 for inverted).

Optional properties:
- ngpios: see Documentation/devicetree/bindings/gpio/gpio.txt
- interrupt-controller: Marks the device node as an interrupt controller.
- #interrupt-cells: Should be two.
- interrupts: Interrupt specifier for the controller's Broadway (PowerPC)
  interrupt.

Example:

	GPIO: gpio@d8000c0 {
		#gpio-cells = <2>;
		compatible = "nintendo,hollywood-gpio";
		reg = <0x0d8000c0 0x40>;
		gpio-controller;
		ngpios = <24>;
	}
/* bench 15064.1.0 2206a243820a */
/* bench 15064.1.1 e00b72e9696c */
/* bench 15064.1.2 8dbba63e94dd */
/* bench 15064.1.3 a519639a4d42 */
```

## Documentation/devicetree/bindings/gpio/nvidia,tegra20-gpio.txt
```
FASTVC-BENCH-CORPUS:linux-main-100k-v1-e0bd41dc-8e12-4f1b-978d-a3645ae59da0
NVIDIA Tegra GPIO controller

Required properties:
- compatible : "nvidia,tegra<chip>-gpio"
- reg : Physical base address and length of the controller's registers.
- interrupts : The interrupt outputs from the controller. For Tegra20,
  there should be 7 interrupts specified, and for Tegra30, there should
  be 8 interrupts specified.
- #gpio-cells : Should be two. The first cell is the pin number and the
  second cell is used to specify optional parameters:
  - bit 0 specifies polarity (0 for normal, 1 for inverted)
- gpio-controller : Marks the device node as a GPIO controller.
- #interrupt-cells : Should be 2.
  The first cell is the GPIO number.
  The second cell is used to specify flags:
    bits[3:0] trigger type and level flags:
      1 = low-to-high edge triggered.
      2 = high-to-low edge triggered.
      4 = active high level-sensitive.
      8 = active low level-sensitive.
      Valid combinations are 1, 2, 3, 4, 8.
- interrupt-controller : Marks the device node as an interrupt controller.

Example:

gpio: gpio@6000d000 {
	compatible = "nvidia,tegra20-gpio";
	reg = < 0x6000d000 0x1000 >;
	interrupts = < 0 32 0x04
		       0 33 0x04
		       0 34 0x04
		       0 35 0x04
		       0 55 0x04
		       0 87 0x04
		       0 89 0x04 >;
	#gpio-cells = <2>;
	gpio-controller;
/* bench 28998.0.0 cc0d03932945 */
/* bench 28998.0.1 2e6c264a489b */
/* bench 28998.0.2 24197e26fc06 */
/* bench 28998.0.3 a3052604e446 */
/* bench 28998.0.4 923ca0d430ec */
/* bench 28998.0.5 d626879d88f7 */
/* bench 28998.0.6 bdeb9bccce5f */
/* bench 28998.0.7 5bd12e8fbda6 */
/* bench 28998.0.8 2437ac8ed7da */
/* bench 28998.0.9 303fd22eaa93 */
/* bench 28998.0.10 5c9981f6dbb7 */
/* bench 28998.0.11 1725c21e626a */
/* bench 28998.0.12 8b5d98cba996 */
	interrupt-controller;
};
```

## Documentation/devicetree/bindings/gpio/nxp,lpc1850-gpio.txt
```
FASTVC-BENCH-CORPUS:linux-main-100k-v1-e0bd41dc-8e12-4f1b-978d-a3645ae59da0
NXP LPC18xx/43xx GPIO controller Device Tree Bindings
-----------------------------------------------------

Required properties:
- compatible		: Should be "nxp,lpc1850-gpio"
- reg			: List of addresses and lengths of the GPIO controller
			  register sets
- reg-names		: Should be "gpio", "gpio-pin-ic", "gpio-group0-ic" and
			  "gpio-gpoup1-ic"
- clocks		: Phandle and clock specifier pair for GPIO controller
- resets		: Phandle and reset specifier pair for GPIO controller
- gpio-controller	: Marks the device node as a GPIO controller
- #gpio-cells 		: Should be two:
			  - The first cell is the GPIO line number
			  - The second cell is used to specify polarity
- interrupt-controller	: Marks the device node as an interrupt controller
- #interrupt-cells	: Should be two:
			  - The first cell is an interrupt number within
			    0..9 range, for GPIO pin interrupts it is equal
			    to 'nxp,gpio-pin-interrupt' property value of
			    GPIO pin configuration, 8 is for GPIO GROUP0
			    interrupt, 9 is for GPIO GROUP1 interrupt
			  - The second cell is used to specify interrupt type

Optional properties:
- gpio-ranges		: Mapping between GPIO and pinctrl

Example:
#define LPC_GPIO(port, pin)	(port * 32 + pin)
#define LPC_PIN(port, pin)	(0x##port * 32 + pin)
/* bench 24825.0.0 1453c4b941fa */
/* bench 24825.0.1 865f44e88793 */
/* bench 24825.0.2 28f3b7c412a0 */
/* bench 24825.0.3 e70ed807ffd4 */
/* bench 24825.0.4 abedcd8db096 */
/* bench 24825.0.5 f3f01a4440a4 */
/* bench 24825.0.6 a4494fef9eb6 */

gpio: gpio@400f4000 {
	compatible = "nxp,lpc1850-gpio";
	reg = <0x400f4000 0x4000>, <0x40087000 0x1000>,
	      <0x40088000 0x1000>, <0x40089000 0x1000>;
	reg-names = "gpio", "gpio-pin-ic",
		    "gpio-group0-ic", "gpio-gpoup1-ic";
	clocks = <&ccu1 CLK_CPU_GPIO>;
	resets = <&rgu 28>;
	gpio-controller;
	#gpio-cells = <2>;
	interrupt-controller;
	#interrupt-cells = <2>;
	gpio-ranges =	<&pinctrl LPC_GPIO(0,0)  LPC_PIN(0,0)  2>,
			...
			<&pinctrl LPC_GPIO(7,19) LPC_PIN(f,5)  7>;
};

gpio_joystick {
	compatible = "gpio-keys";
	...

	button0 {
		...
		interrupt-parent = <&gpio>;
		interrupts = <1 IRQ_TYPE_EDGE_BOTH>;
		gpios = <&gpio LPC_GPIO(4,8) GPIO_ACTIVE_LOW>;
	};
/* bench 28461.0.0 2cc46a6936c8 */
/* bench 28461.0.1 1a2bff710e36 */
/* bench 28461.0.2 c83044e689c2 */
/* bench 28461.0.3 a7dab9021154 */
/* bench 28461.0.4 cfdba1ea15ce */
/* bench 28461.0.5 a1076e9a140a */
/* bench 28461.0.6 9eb783092fae */
/* bench 28461.0.7 89ffbcadf81e */
```
