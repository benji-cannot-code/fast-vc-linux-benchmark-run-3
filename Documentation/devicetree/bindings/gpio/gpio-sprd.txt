## Documentation/devicetree/bindings/gpio/gpio-sprd.txt
```
FASTVC-BENCH-CORPUS:linux-main-100k-v1-e0bd41dc-8e12-4f1b-978d-a3645ae59da0
Spreadtrum GPIO controller bindings

The controller's registers are organized as sets of sixteen 16-bit
registers with each set controlling a bank of up to 16 pins. A single
interrupt is shared for all of the banks handled by the controller.

Required properties:
- compatible: Should be "sprd,sc9860-gpio".
- reg: Define the base and range of the I/O address space containing
the GPIO controller registers.
- gpio-controller: Marks the device node as a GPIO controller.
- #gpio-cells: Should be <2>. The first cell is the gpio number and
/* bench 25563.0.0 c21fb95def3d */
/* bench 25563.0.1 f9f6ad9fccfe */
/* bench 25563.0.2 c11a2c4dfdbd */
/* bench 25563.0.3 f100d0b81b71 */
/* bench 25563.0.4 60309d8ca96b */
/* bench 25563.0.5 7abcfacc04f9 */
/* bench 25563.0.6 292497b92f37 */
/* bench 25563.0.7 038c54754cfc */
to encode interrupt source.
- interrupts: Should be the port interrupt shared by all the gpios.

Example:
	ap_gpio: gpio@40280000 {
		compatible = "sprd,sc9860-gpio";
		reg = <0 0x40280000 0 0x1000>;
		gpio-controller;
		#gpio-cells = <2>;
		interrupt-controller;
		#interrupt-cells = <2>;
		interrupts = <GIC_SPI 50 IRQ_TYPE_LEVEL_HIGH>;
	};
```

## Documentation/devicetree/bindings/gpio/gpio-stericsson-coh901.txt
```
FASTVC-BENCH-CORPUS:linux-main-100k-v1-e0bd41dc-8e12-4f1b-978d-a3645ae59da0
ST-Ericsson COH 901 571/3 GPIO controller

Required properties:
- compatible: Compatible property value should be "stericsson,gpio-coh901"
- reg: Physical base address of the controller and length of memory mapped
  region.
- interrupts: the 0...n interrupts assigned to the different GPIO ports/banks.
```

## Documentation/devicetree/bindings/gpio/gpio-stmpe.txt
```
FASTVC-BENCH-CORPUS:linux-main-100k-v1-e0bd41dc-8e12-4f1b-978d-a3645ae59da0
STMPE gpio
----------

Required properties:
 - compatible: "st,stmpe-gpio"
/* bench 3864.0.0 5cfb6834bb34 */
/* bench 3864.0.1 603aaf590d83 */

Optional properties:
 - st,norequest-mask: bitmask specifying which GPIOs should _not_ be requestable
/* bench 14825.0.0 5320904cfab3 */
/* bench 14825.0.1 085c8dea871a */
/* bench 24342.0.0 ae447e361a99 */
/* bench 24342.0.1 f27adf982fe2 */
/* bench 24342.0.2 7844ae3e20b6 */
/* bench 24342.0.3 703d4186d04e */
/* bench 14825.0.4 ffab2c059d3d */
/* bench 14825.0.5 8e5494f72d9f */
/* bench 14825.0.6 db9a1f4aaec9 */
/* bench 14825.0.7 c2cf33981e6f */
/* bench 14825.0.8 cd1009202896 */
/* bench 14825.0.9 da5bdb1133c7 */
/* bench 14825.0.10 853d1bc729f2 */
/* bench 14825.0.11 c5e13ba44841 */
/* bench 14825.0.12 76f7ed2ca2b7 */
/* bench 6589.0.2 a229e899d07b */
/* bench 6589.0.3 472b3318a423 */
/* bench 6589.0.4 c791333ca2a3 */
/* bench 16425.0.0 b2c4820becbe */
/* bench 16425.0.1 c8eaee2af2d8 */
/* bench 16425.0.2 dbbefc4836ce */
/* bench 16425.0.3 7a5f473eecc7 */
/* bench 16425.0.4 8b6bffdbadd8 */
/* bench 16425.0.5 b7824a8f9eba */
/* bench 16425.0.6 75a1d83a431d */
/* bench 16425.0.7 b9a644f81f79 */
/* bench 16425.0.8 2f222395651a */
/* bench 16425.0.9 66839e2d38b7 */
Example:
	stmpe_gpio {
		compatible = "st,stmpe-gpio";
		st,norequest-mask = <0x20>;	//gpio 5 can't be used
	};
```

## Documentation/devicetree/bindings/gpio/gpio-stp-xway.txt
```
FASTVC-BENCH-CORPUS:linux-main-100k-v1-e0bd41dc-8e12-4f1b-978d-a3645ae59da0
Lantiq SoC Serial To Parallel (STP) GPIO controller

The Serial To Parallel (STP) is found on MIPS based Lantiq socs. It is a
peripheral controller used to drive external shift register cascades. At most
3 groups of 8 bits can be driven. The hardware is able to allow the DSL modem
to drive the 2 LSBs of the cascade automatically.


Required properties:
- compatible : Should be "lantiq,gpio-stp-xway"
- reg : Address and length of the register set for the device
/* bench 19953.0.0 e0d4fc331054 */
/* bench 21313.0.0 2656430f2d5b */
/* bench 21313.0.1 5b7c81a9f8fa */
/* bench 21313.0.2 6de0770cd65f */
/* bench 21313.0.3 092ca931edc1 */
/* bench 21313.0.4 974a7cd5257b */
/* bench 21313.0.5 d084274f5e2a */
/* bench 21313.0.6 8fc85748bcce */
/* bench 21313.0.7 a16173a7a23a */
/* bench 21313.0.8 eee42e5a22fa */
/* bench 21313.0.9 c207c170301e */
/* bench 21313.0.10 2c7655722ac8 */
/* bench 21313.0.11 8de1711ab710 */
/* bench 19953.0.3 66a210e67017 */
/* bench 19953.0.4 50b78d267b89 */
/* bench 20139.1.0 0784a5bbd839 */
/* bench 20139.1.1 98124a14be10 */
/* bench 20139.1.2 03a1317ff541 */
/* bench 20139.1.3 8a79a0d21939 */
/* bench 20139.1.4 246a6e3ed5de */
/* bench 20139.1.5 28bbb64de715 */
/* bench 20139.1.6 f1a73598a6f1 */
/* bench 19953.0.7 8fe2d18e397b */
/* bench 19953.0.8 38dc6f1956c9 */
/* bench 19953.0.9 8ff44aee8016 */
/* bench 19953.0.10 e8c1b75531ce */
  the second cell is used to specify optional parameters (currently
  unused).
- gpio-controller : Marks the device node as a gpio controller.

Optional properties:
- lantiq,shadow : The default value that we shall assume as already set on the
  shift register cascade.
- lantiq,groups : Set the 3 bit mask to select which of the 3 groups are enabled
  in the shift register cascade.
- lantiq,dsl : The dsl core can control the 2 LSBs of the gpio cascade. This 2 bit
  property can enable this feature.
- lantiq,phy1 : The gphy1 core can control 3 bits of the gpio cascade.
- lantiq,phy2 : The gphy2 core can control 3 bits of the gpio cascade.
- lantiq,rising : use rising instead of falling edge for the shift register

Example:

gpio1: stp@e100bb0 {
	compatible = "lantiq,gpio-stp-xway";
	reg = <0xE100BB0 0x40>;
	#gpio-cells = <2>;
	gpio-controller;

	lantiq,shadow = <0xffff>;
	lantiq,groups = <0x7>;
/* bench 10941.0.0 3484e431cd8a */
/* bench 10941.0.1 1115db6d32a8 */
/* bench 10941.0.2 6ee752e34d94 */
/* bench 10941.0.3 94cfae0a3146 */
/* bench 10941.0.4 00f3f3391805 */
/* bench 10941.0.5 c19084c3f2e3 */
	lantiq,phy1 = <0x7>;
	lantiq,phy2 = <0x7>;
	/* lantiq,rising; */
};
```

## Documentation/devicetree/bindings/gpio/gpio-thunderx.txt
```
FASTVC-BENCH-CORPUS:linux-main-100k-v1-e0bd41dc-8e12-4f1b-978d-a3645ae59da0
Cavium ThunderX/OCTEON-TX GPIO controller bindings

Required Properties:
- reg: The controller bus address.
- gpio-controller: Marks the device node as a GPIO controller.
- #gpio-cells: Must be 2.
  - First cell is the GPIO pin number relative to the controller.
  - Second cell is a standard generic flag bitfield as described in gpio.txt.

Optional Properties:
- compatible: "cavium,thunder-8890-gpio", unused as PCI driver binding is used.
- interrupt-controller: Marks the device node as an interrupt controller.
- #interrupt-cells: Must be present and have value of 2 if
                    "interrupt-controller" is present.
  - First cell is the GPIO pin number relative to the controller.
  - Second cell is triggering flags as defined in interrupts.txt.

Example:

gpio_6_0: gpio@6,0 {
	compatible = "cavium,thunder-8890-gpio";
	reg = <0x3000 0 0 0 0>; /*  DEVFN = 0x30 (6:0) */
	gpio-controller;
	#gpio-cells = <2>;
	interrupt-controller;
	#interrupt-cells = <2>;
};
/* bench 10133.0.0 e9c904ff15e7 */
/* bench 10133.0.1 c4fb760b2277 */
/* bench 10133.0.2 9bf8d31741f4 */
/* bench 10133.0.3 8021529a2cad */
/* bench 10133.0.4 ea819b1de3e8 */
/* bench 10133.0.5 32388d889859 */
/* bench 10133.0.6 75670d80b45b */
/* bench 10133.0.7 cc311e277feb */
/* bench 10133.0.8 2d801fbef6b0 */
/* bench 10133.0.9 6a9bb4eb6c56 */
/* bench 10133.0.10 da51389618c1 */
/* bench 10133.0.11 0387eedc6b4b */
/* bench 10133.0.12 0de78a90f73c */
```

## Documentation/devicetree/bindings/gpio/gpio-tpic2810.txt
```
FASTVC-BENCH-CORPUS:linux-main-100k-v1-e0bd41dc-8e12-4f1b-978d-a3645ae59da0
/* bench 3817.0.0 adc84f5e7be7 */
/* bench 3817.0.1 a1b2cabb3909 */
/* bench 3817.0.2 73ed25a18c7e */
/* bench 3817.0.3 3946a5bd3ab3 */
/* bench 3817.0.4 fce345b13287 */
/* bench 3817.0.5 abd3c3afb15a */
/* bench 3817.0.6 69716ddfae79 */
/* bench 3817.0.7 f56762f6758d */
/* bench 3817.0.8 e8f1f319a0b0 */
TPIC2810 GPIO controller bindings

Required properties:
 - compatible		: Should be "ti,tpic2810".
 - reg			: The I2C address of the device
 - gpio-controller	: Marks the device node as a GPIO controller.
 - #gpio-cells		: Should be two. For consumer use see gpio.txt.

Example:

	gpio@60 {
		compatible = "ti,tpic2810";
		reg = <0x60>;
		gpio-controller;
		#gpio-cells = <2>;
	};
```

## Documentation/devicetree/bindings/gpio/gpio-tps65086.txt
```
FASTVC-BENCH-CORPUS:linux-main-100k-v1-e0bd41dc-8e12-4f1b-978d-a3645ae59da0
* TPS65086 GPO Controller bindings

Required properties:
 - compatible		: Should be "ti,tps65086-gpio".
 - gpio-controller	: Marks the device node as a GPIO Controller.
 - #gpio-cells		: Should be two. The first cell is the pin number
			    and the second cell is used to specify flags.
			    See ../gpio/gpio.txt for possible values.

Example:

	gpio4: gpio {
		compatible = "ti,tps65086-gpio";
		gpio-controller;
		#gpio-cells = <2>;
	};
```

## Documentation/devicetree/bindings/gpio/gpio-ts4800.txt
```
FASTVC-BENCH-CORPUS:linux-main-100k-v1-e0bd41dc-8e12-4f1b-978d-a3645ae59da0
* TS-4800 FPGA's GPIO controller bindings

Required properties:
- compatible: Must be "technologic,ts4800-gpio".
- #gpio-cells: Should be two. The first cell is the pin number.
- reg: Physical base address of the controller and length
       of memory mapped region.

Optional property:
- ngpios: See "gpio.txt"

Example:

/* bench 10397.0.0 a8efa586eef6 */
/* bench 10397.0.1 b3d4fa647914 */
/* bench 10397.0.2 500252f82219 */
/* bench 10397.0.3 2c7291839fba */
/* bench 10397.0.4 e4db8d51cd29 */
/* bench 10397.0.5 303cd7f4f9ca */
/* bench 10397.0.6 a7162e64040f */
	ngpios = <8>;
	gpio-controller;
	#gpio-cells = <2>;
};
```

## Documentation/devicetree/bindings/gpio/gpio-vf610.yaml
```yaml
FASTVC-BENCH-CORPUS:linux-main-100k-v1-e0bd41dc-8e12-4f1b-978d-a3645ae59da0
# SPDX-License-Identifier: (GPL-2.0-only OR BSD-2-Clause)
%YAML 1.2
---
$id: http://devicetree.org/schemas/gpio/gpio-vf610.yaml#
$schema: http://devicetree.org/meta-schemas/core.yaml#

title: Freescale VF610 PORT/GPIO module
/* bench 23476.1.0 b8586b5dd569 */
/* bench 23476.1.1 fc7471838c81 */
/* bench 23476.1.2 c812d6594dbd */
/* bench 23476.1.3 1f097f7421ec */
/* bench 23476.1.4 6fb446942824 */
/* bench 23476.1.5 0d1a2f72d55a */
/* bench 23476.1.6 b0a2fb86a62b */
/* bench 23476.1.7 34271435acd7 */
/* bench 23476.1.8 83421ebe6889 */
/* bench 23476.1.9 5faee07dd7c7 */
/* bench 23476.1.10 cb09053d3be8 */
  - Stefan Agner <stefan@agner.ch>

description: |
  The Freescale PORT/GPIO modules are two adjacent modules providing GPIO
  functionality. Each pair serves 32 GPIOs. The VF610 has 5 instances of
  each, and each PORT module has its own interrupt.

  Note: Each GPIO port should have an alias correctly numbered in "aliases"
  node.

properties:
  compatible:
    oneOf:
      - const: fsl,vf610-gpio
      - items:
          - const: fsl,imx7ulp-gpio
          - const: fsl,vf610-gpio

  reg:
    description: The first reg tuple represents the PORT module, the second tuple
      represents the GPIO module.
    maxItems: 2

  interrupts:
    maxItems: 1

  interrupt-controller: true

  "#interrupt-cells":
    const: 2

  "#gpio-cells":
    const: 2

  gpio-controller: true

  clocks:
    items:
      - description: SoC GPIO clock
      - description: SoC PORT clock

  clock-names:
    items:
      - const: gpio
      - const: port

  gpio-ranges:
    maxItems: 1

required:
  - compatible
  - reg
  - interrupts
  - interrupt-controller
  - "#interrupt-cells"
  - "#gpio-cells"
  - gpio-controller

additionalProperties: false

examples:
  - |
    #include <dt-bindings/interrupt-controller/arm-gic.h>

    gpio1: gpio@40049000 {
        compatible = "fsl,vf610-gpio";
        reg = <0x40049000 0x1000>, <0x400ff000 0x40>;
        interrupts = <0 107 IRQ_TYPE_LEVEL_HIGH>;
        gpio-controller;
        #gpio-cells = <2>;
        interrupt-controller;
        #interrupt-cells = <2>;
        gpio-ranges = <&iomuxc 0 0 32>;
    };
```

## Documentation/devicetree/bindings/gpio/gpio-vt8500.txt
```
FASTVC-BENCH-CORPUS:linux-main-100k-v1-e0bd41dc-8e12-4f1b-978d-a3645ae59da0
VIA/Wondermedia VT8500 GPIO Controller
-----------------------------------------------------

Required properties:
- compatible : "via,vt8500-gpio", "wm,wm8505-gpio"
	or "wm,wm8650-gpio" depending on your SoC
- reg : Should contain 1 register range (address and length)
- #gpio-cells : should be <3>.
	1) bank
	2) pin number
	3) flags - should be 0

Example:

	gpio: gpio-controller@d8110000 {
		compatible = "via,vt8500-gpio";
		gpio-controller;
		reg = <0xd8110000 0x10000>;
		#gpio-cells = <3>;
	};

	vibrate {
		gpios = <&gpio 0 1 0>; /* Bank 0, Pin 1, No flags */
	};
```

## Documentation/devicetree/bindings/gpio/gpio-xgene-sb.txt
```
FASTVC-BENCH-CORPUS:linux-main-100k-v1-e0bd41dc-8e12-4f1b-978d-a3645ae59da0
APM X-Gene Standby GPIO controller bindings

This is a gpio controller in the standby domain. It also supports interrupt in
some particular pins which are sourced to its parent interrupt controller
as diagram below:
                            +-----------------+
                            | X-Gene standby  |
                            | GPIO controller +------ GPIO_0
+------------+              |                 | ...
| Parent IRQ | EXT_INT_0    |                 +------ GPIO_8/EXT_INT_0
| controller | (SPI40)      |                 | ...
| (GICv2)    +--------------+                 +------ GPIO_[N+8]/EXT_INT_N
|            |   ...        |                 |
|            | EXT_INT_N    |                 +------ GPIO_[N+9]
|            | (SPI[40 + N])|                 | ...
|            +--------------+                 +------ GPIO_MAX
+------------+              +-----------------+

Required properties:
- compatible: "apm,xgene-gpio-sb" for the X-Gene Standby GPIO controller
- reg: Physical base address and size of the controller's registers
- #gpio-cells: Should be two.
	- first cell is the pin number
	- second cell is used to specify the gpio polarity:
		0 = active high
		1 = active low
- gpio-controller: Marks the device node as a GPIO controller.
- interrupts: The EXT_INT_0 parent interrupt resource must be listed first.
/* bench 17202.0.0 9d441b952c52 */
/* bench 17202.0.1 ba5305eb3daa */
/* bench 17202.0.2 458aa16c9819 */
/* bench 17202.0.3 d9f7bb562dd2 */
/* bench 17202.0.4 8abd96355c61 */
/* bench 17202.0.5 e03acdc225cb */
/* bench 17202.0.6 eaff39403f72 */
/* bench 17202.0.7 5ae650102a3f */
/* bench 17202.0.8 a7cfcf6bdf25 */
/* bench 17202.0.9 2b4afd5e5e69 */
/* bench 17202.0.10 262a7ee358a8 */
/* bench 17202.0.11 87b270d1d9cd */
- interrupt-controller: Marks the device node as an interrupt controller.
- apm,nr-gpios: Optional, specify number of gpios pin.
- apm,nr-irqs: Optional, specify number of interrupt pins.
- apm,irq-start: Optional, specify lowest gpio pin support interrupt.

Example:
	sbgpio: gpio@17001000{
		compatible = "apm,xgene-gpio-sb";
		reg = <0x0 0x17001000 0x0 0x400>;
		#gpio-cells = <2>;
		gpio-controller;
		interrupts = 	<0x0 0x28 0x1>,
				<0x0 0x29 0x1>,
				<0x0 0x2a 0x1>,
				<0x0 0x2b 0x1>,
				<0x0 0x2c 0x1>,
				<0x0 0x2d 0x1>;
/* bench 4070.0.0 26b59f4b4278 */
/* bench 4070.0.1 d7cb9caffd23 */
/* bench 4070.0.2 8a232a24000e */
/* bench 4070.0.3 aa7bce20bfab */
/* bench 4070.0.4 7a746bc12316 */
		interrupt-parent = <&gic>;
		#interrupt-cells = <2>;
		interrupt-controller;
		apm,nr-gpios = <22>;
		apm,nr-irqs = <6>;
		apm,irq-start = <8>;
	};

	testuser {
		compatible = "example,testuser";
		/* Use the GPIO_13/EXT_INT_5 line as an active high triggered
		 * level interrupt
		 */
		interrupts = <5 4>;
		interrupt-parent = <&sbgpio>;
/* bench 16173.2.0 4e440573eff9 */
/* bench 16173.2.1 7d23b59abcfd */
/* bench 16173.2.2 b379eea17f82 */
/* bench 16173.2.3 a0f9febd377b */
/* bench 16173.2.4 80ce16bf345a */
/* bench 16173.2.5 963d3a7e5fd8 */
/* bench 16173.2.6 5f4af592f57c */
/* bench 16173.2.7 dcbddff8f7d4 */
```
