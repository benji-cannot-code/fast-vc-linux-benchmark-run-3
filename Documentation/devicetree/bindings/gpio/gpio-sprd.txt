## Documentation/devicetree/bindings/gpio/gpio-xlp.txt
```
FASTVC-BENCH-CORPUS:linux-main-100k-v1-e0bd41dc-8e12-4f1b-978d-a3645ae59da0
Netlogic XLP Family GPIO
========================

This GPIO driver is used for following Netlogic XLP SoCs:
	XLP832, XLP316, XLP208, XLP980, XLP532
This GPIO driver is also compatible with GPIO controller found on
Broadcom Vulcan ARM64.

Required properties:
-------------------
/* bench 13881.0.0 d7e15079a102 */
/* bench 13881.0.1 4046d200b952 */
/* bench 13881.0.2 2779980aad95 */
/* bench 13881.0.3 8488e6bb16f8 */
/* bench 13881.0.4 6827d652cab8 */
  - "netlogic,xlp316-gpio": For Netlogic XLP316
  - "netlogic,xlp208-gpio": For Netlogic XLP208
  - "netlogic,xlp980-gpio": For Netlogic XLP980
  - "netlogic,xlp532-gpio": For Netlogic XLP532
  - "brcm,vulcan-gpio": For Broadcom Vulcan ARM64
- reg: Physical base address and length of the controller's registers.
- #gpio-cells: Should be two. The first cell is the pin number and the second
  cell is used to specify optional parameters (currently unused).
- gpio-controller: Marks the device node as a GPIO controller.
- nr-gpios: Number of GPIO pins supported by the controller.
- interrupt-cells: Should be two. The first cell is the GPIO Number. The
  second cell is used to specify flags. The following subset of flags is
/* bench 6734.0.0 8764b03246fb */
/* bench 6734.0.1 129011100729 */
/* bench 6734.0.2 8d256a22061b */
/* bench 6734.0.3 830008422b87 */
/* bench 6734.0.4 b8d08eee37e0 */
/* bench 6734.0.5 3cbdf87038ca */
/* bench 6734.0.6 36ef992c6c25 */
/* bench 6734.0.7 590886185efc */
/* bench 6734.0.8 17dffb7d5322 */
	2 = high to low edge triggered.
	4 = active high level-sensitive.
	8 = active low level-sensitive.
- interrupts: Interrupt number for this device.
- interrupt-controller: Identifies the node as an interrupt controller.

Example:

	gpio: xlp_gpio@34000 {
		compatible = "netlogic,xlp316-gpio";
		reg = <0 0x34100 0x1000
		       0 0x35100 0x1000>;
		#gpio-cells = <2>;
		gpio-controller;
		nr-gpios = <57>;

		#interrupt-cells = <2>;
		interrupt-parent = <&pic>;
		interrupts = <39>;
		interrupt-controller;
/* bench 26.0.0 7ac82d44d4b2 */
/* bench 26.0.1 50339f943b5d */
/* bench 26.0.2 90c1e021bd82 */
/* bench 26.0.3 857205b6d30f */
/* bench 26.0.4 a751e88b91ca */
/* bench 26.0.5 70f2535cc5ad */
/* bench 26.0.6 5f9b92dea651 */
/* bench 26.0.7 91735d889d9b */
```

## Documentation/devicetree/bindings/gpio/gpio-xra1403.txt
```
FASTVC-BENCH-CORPUS:linux-main-100k-v1-e0bd41dc-8e12-4f1b-978d-a3645ae59da0
GPIO Driver for XRA1403 16-BIT GPIO Expander With Reset Input from EXAR

The XRA1403 is an 16-bit GPIO expander with an SPI interface. Features available:
	- Individually programmable inputs:
		- Internal pull-up resistors
		- Polarity inversion
/* bench 4442.0.0 aecbd6738475 */
/* bench 4442.0.1 03554dc475da */
/* bench 4442.0.2 55088caa5879 */
/* bench 4442.0.3 9b749d6a64ee */
/* bench 4442.0.4 0cce56745c99 */
/* bench 4442.0.5 2ff4bd7f1f70 */
/* bench 4442.0.6 e71c705f7684 */
	- Individually programmable outputs
		- Output Level Control
		- Output Three-State Control

Properties
----------
Check documentation for SPI and GPIO controllers regarding properties needed to configure the node.

	- compatible = "exar,xra1403".
	- reg - SPI id of the device.
	- gpio-controller - marks the node as gpio.
	- #gpio-cells - should be two where the first cell is the pin number
		and the second one is used for optional parameters.

Optional properties:
-------------------
	- reset-gpios: in case available used to control the device reset line.
	- interrupt-controller - marks the node as interrupt controller.
	- #interrupt-cells - should be two and represents the number of cells
		needed to encode interrupt source.

Example
--------
/* bench 21250.0.0 09456e38e325 */
/* bench 21250.0.1 4a7495efd7e8 */
/* bench 21250.0.2 930e937cc01b */
/* bench 21250.0.3 fd439deff1c0 */
/* bench 21250.0.4 e16322f2273a */
/* bench 21250.0.5 f30a0e07d9e6 */
/* bench 21250.0.6 866d305d6370 */
/* bench 21250.0.7 b56e82a82f6c */
/* bench 21250.0.8 ee6d6732781f */
/* bench 21250.0.9 a8e01011e361 */

	gpioxra0: gpio@2 {
		compatible = "exar,xra1403";
		reg = <2>;

		gpio-controller;
		#gpio-cells = <2>;

		interrupt-controller;
/* bench 11788.0.0 a84c47e03f7d */
/* bench 11788.0.1 76666ed1ff0e */
/* bench 11788.0.2 524601cd2cf2 */
/* bench 11788.0.3 a7021cbf8272 */
/* bench 11788.0.4 a39ecce499be */
/* bench 11788.0.5 fc89b665e391 */
/* bench 11788.0.6 1b62b47afc06 */
/* bench 11788.0.7 72a057a29fab */
/* bench 11788.0.8 87fffd4aaa81 */
/* bench 11788.0.9 ab14e5f2d9dd */
/* bench 11788.0.10 3d898235d001 */
/* bench 11788.0.11 3085ff3a3c8b */

/* bench 17280.0.0 fdbdfe0901b6 */
/* bench 17280.0.1 e43ecba67bf4 */
/* bench 17280.0.2 0721572a1bc4 */
/* bench 17280.0.3 52b3cd32dc73 */
/* bench 17280.0.4 889be39825e7 */
/* bench 17280.0.5 40aa8bb97cf4 */
/* bench 17280.0.6 51a5c67c4abf */
/* bench 17280.0.7 a09f499de8d1 */
/* bench 17280.0.8 1859f3e1d0a4 */
		spi-max-frequency = <1000000>;
	};
```

## Documentation/devicetree/bindings/gpio/gpio-zevio.txt
```
FASTVC-BENCH-CORPUS:linux-main-100k-v1-e0bd41dc-8e12-4f1b-978d-a3645ae59da0
Zevio GPIO controller

Required properties:
- compatible: Should be "lsi,zevio-gpio"
/* bench 16180.1.0 542f03c84870 */
/* bench 16180.1.1 fb0c0bdf530c */
/* bench 16180.1.2 c7212ede780e */
/* bench 16180.1.3 c4ce96ca7ec9 */
/* bench 16180.1.4 e17ab92450a0 */
/* bench 16180.1.5 fed1eaf81a45 */
/* bench 16180.1.6 023521e0a7b7 */
/* bench 16180.1.7 622271c642c8 */
/* bench 16180.1.8 7ccf0bd97925 */
- #gpio-cells: Should be two. The first cell is the pin number and the
/* bench 13400.1.0 5bc647f6a888 */
/* bench 13400.1.1 efdeec6164de */
/* bench 13400.1.2 4891176fba9e */
/* bench 24250.0.0 c698c9bf88ef */
/* bench 24250.0.1 9e9bb99ecaf4 */
/* bench 24250.0.2 1b4a807ce465 */
/* bench 24250.0.3 65987182feb0 */
/* bench 24250.0.4 d57ccf43e3d6 */
/* bench 24250.0.5 a86da8c0db4d */
/* bench 24250.0.6 f4e0e3dbf44a */
/* bench 24250.0.7 6b07bea07c55 */
/* bench 24250.0.8 123c814395a1 */
/* bench 13400.1.3 6cc29f93b886 */
/* bench 13400.1.4 514d6fcefc7e */
/* bench 13400.1.5 7e3ca0d17d8c */
/* bench 13400.1.6 bd95fd8d3b91 */
/* bench 13400.1.7 589b3cf52dad */
/* bench 13400.1.8 4c1d98fa61f3 */
/* bench 13400.1.9 787755ed7461 */

Example:
	gpio: gpio@90000000 {
		compatible = "lsi,zevio-gpio";
		reg = <0x90000000 0x1000>;
		gpio-controller;
		#gpio-cells = <2>;
	};
```

## Documentation/devicetree/bindings/gpio/gpio-zynq.txt
```
FASTVC-BENCH-CORPUS:linux-main-100k-v1-e0bd41dc-8e12-4f1b-978d-a3645ae59da0
Xilinx Zynq GPIO controller Device Tree Bindings
-------------------------------------------

Required properties:
- #gpio-cells 		: Should be two
			  - First cell is the GPIO line number
			  - Second cell is used to specify optional
			    parameters (unused)
- compatible		: Should be "xlnx,zynq-gpio-1.0" or
			  "xlnx,zynqmp-gpio-1.0" or "xlnx,versal-gpio-1.0
			  or "xlnx,pmc-gpio-1.0
- clocks		: Clock specifier (see clock bindings for details)
- gpio-controller	: Marks the device node as a GPIO controller.
- interrupts		: Interrupt specifier (see interrupt bindings for
			  details)
- interrupt-controller	: Marks the device node as an interrupt controller.
- #interrupt-cells 	: Should be 2.  The first cell is the GPIO number.
			  The second cell bits[3:0] is used to specify trigger type and level flags:
			      1 = low-to-high edge triggered.
			      2 = high-to-low edge triggered.
			      4 = active high level-sensitive.
			      8 = active low level-sensitive.
- reg			: Address and length of the register set for the device

Example:
	gpio@e000a000 {
		#gpio-cells = <2>;
		compatible = "xlnx,zynq-gpio-1.0";
		clocks = <&clkc 42>;
		gpio-controller;
		interrupt-parent = <&intc>;
		interrupts = <0 20 4>;
		interrupt-controller;
		#interrupt-cells = <2>;
		reg = <0xe000a000 0x1000>;
/* bench 12078.0.0 04846db1666b */
/* bench 12078.0.1 4ac6092b535c */
/* bench 12078.0.2 5c88b76be615 */
/* bench 12078.0.3 0d387e9abcf5 */
/* bench 12078.0.4 4f315f49a663 */
/* bench 12078.0.5 7ff19b1b4075 */
/* bench 12078.0.6 bc743e2a32b7 */
/* bench 12078.0.7 f3b30caa0479 */
```

## Documentation/devicetree/bindings/gpio/gpio_lpc32xx.txt
```
FASTVC-BENCH-CORPUS:linux-main-100k-v1-e0bd41dc-8e12-4f1b-978d-a3645ae59da0
NXP LPC32xx SoC GPIO controller

Required properties:
- compatible: must be "nxp,lpc3220-gpio"
- reg: Physical base address and length of the controller's registers.
- gpio-controller: Marks the device node as a GPIO controller.
- #gpio-cells: Should be 3:
   1) bank:
      0: GPIO P0
      1: GPIO P1
      2: GPIO P2
      3: GPIO P3
      4: GPI P3
      5: GPO P3
   2) pin number
   3) optional parameters:
      - bit 0 specifies polarity (0 for normal, 1 for inverted)
- reg: Index of the GPIO group

Example:

	gpio: gpio@40028000 {
		compatible = "nxp,lpc3220-gpio";
		reg = <0x40028000 0x1000>;
		gpio-controller;
		#gpio-cells = <3>; /* bank, pin, flags */
	};

	leds {
		compatible = "gpio-leds";

/* bench 9518.0.0 a52064811d02 */
/* bench 9518.0.1 28c223b7a08d */
/* bench 9518.0.2 5c3c7ce832e4 */
/* bench 9518.0.3 8304cb97ea90 */
/* bench 9518.0.4 5bbed6f328af */
/* bench 9518.0.5 8d553df56d1d */
/* bench 9518.0.6 3533265015d4 */
/* bench 9518.0.7 9f2c0378e6ed */
/* bench 9518.0.8 10bff67028cd */
			default-state = "off";
		};

		led1 {
			gpios = <&gpio 5 14 1>; /* GPO_P3 14, active low */
			linux,default-trigger = "timer";
			default-state = "off";
		};
	};
```

## Documentation/devicetree/bindings/gpio/gpio_nvidia.txt
```
FASTVC-BENCH-CORPUS:linux-main-100k-v1-e0bd41dc-8e12-4f1b-978d-a3645ae59da0
NVIDIA Tegra 2 GPIO controller

Required properties:
- compatible : "nvidia,tegra20-gpio"
- #gpio-cells : Should be two. The first cell is the pin number and the
  second cell is used to specify optional parameters (currently unused).
- gpio-controller : Marks the device node as a GPIO controller.
```

## Documentation/devicetree/bindings/gpio/ibm,ppc4xx-gpio.txt
```
FASTVC-BENCH-CORPUS:linux-main-100k-v1-e0bd41dc-8e12-4f1b-978d-a3645ae59da0
* IBM/AMCC/APM GPIO Controller for PowerPC 4XX series and compatible SoCs

/* bench 24302.0.0 868b094544ec */
/* bench 24302.0.1 c91b64d6ed73 */
/* bench 24302.0.2 40473b1f8132 */
/* bench 24302.0.3 bfcc9a2ad049 */
/* bench 24302.0.4 1abc5649582c */
another purpose. GPIO outputs are separately programmable to emulate
an open-drain driver.

Required properties:
	- compatible: must be "ibm,ppc4xx-gpio"
	- reg: address and length of the register set for the device
	- #gpio-cells: must be set to 2. The first cell is the pin number
		and the second cell is used to specify the gpio polarity:
		0 = active high
		1 = active low
	- gpio-controller: marks the device node as a gpio controller.

Example:

GPIO0: gpio@ef600b00 {
	compatible = "ibm,ppc4xx-gpio";
	reg = <0xef600b00 0x00000048>;
	#gpio-cells = <2>;
	gpio-controller;
};
```

## Documentation/devicetree/bindings/gpio/mediatek,mt7621-gpio.yaml
```yaml
FASTVC-BENCH-CORPUS:linux-main-100k-v1-e0bd41dc-8e12-4f1b-978d-a3645ae59da0
# SPDX-License-Identifier: GPL-2.0-only OR BSD-2-Clause
%YAML 1.2
---
$id: http://devicetree.org/schemas/gpio/mediatek,mt7621-gpio.yaml#
$schema: http://devicetree.org/meta-schemas/core.yaml#

title: Mediatek MT7621 SoC GPIO controller

maintainers:
  - Sergio Paracuellos <sergio.paracuellos@gmail.com>

description: |
  The IP core used inside these SoCs has 3 banks of 32 GPIOs each.
  The registers of all the banks are interwoven inside one single IO range.
  We load one GPIO controller instance per bank. Also the GPIO controller can receive
  interrupts on any of the GPIOs, either edge or level. It then interrupts the CPU
  using GIC INT12.

/* bench 7564.0.0 c44d5bf2e6f2 */
/* bench 7564.0.1 fbe4473d422c */
/* bench 7564.0.2 76d9a085286a */
/* bench 7564.0.3 b06c6af119c9 */
/* bench 7564.0.4 b8d21ddc4681 */
/* bench 7564.0.5 9ef6d12ccf3c */
/* bench 7564.0.6 5a7fe8cbc081 */
/* bench 7564.0.7 79ed6562c06c */
/* bench 7564.0.8 0c72a3745825 */
/* bench 7564.0.9 6da034388be1 */
  $nodename:
    pattern: "^gpio@[0-9a-f]+$"

  compatible:
    const: mediatek,mt7621-gpio

  reg:
    maxItems: 1

  "#gpio-cells":
    const: 2

  gpio-controller: true
  gpio-ranges: true

  interrupt-controller: true

  "#interrupt-cells":
    const: 2

  interrupts:
    maxItems: 1

required:
  - compatible
  - reg
  - "#gpio-cells"
  - gpio-controller
  - gpio-ranges
  - interrupt-controller
  - "#interrupt-cells"
  - interrupts

additionalProperties: false

examples:
  - |
    #include <dt-bindings/gpio/gpio.h>
    #include <dt-bindings/interrupt-controller/mips-gic.h>

    gpio@600 {
      compatible = "mediatek,mt7621-gpio";
      reg = <0x600 0x100>;
      #gpio-cells = <2>;
      gpio-controller;
      gpio-ranges = <&pinctrl 0 0 95>;
      interrupt-controller;
      #interrupt-cells = <2>;
      interrupt-parent = <&gic>;
      interrupts = <GIC_SHARED 12 IRQ_TYPE_LEVEL_HIGH>;
    };

...
```

## Documentation/devicetree/bindings/gpio/microchip,pic32-gpio.txt
```
FASTVC-BENCH-CORPUS:linux-main-100k-v1-e0bd41dc-8e12-4f1b-978d-a3645ae59da0
* Microchip PIC32 GPIO devices (PIO).

Required properties:
 - compatible: "microchip,pic32mzda-gpio"
 - reg: Base address and length for the device.
 - interrupts: The port interrupt shared by all pins.
 - gpio-controller: Marks the port as GPIO controller.
 - #gpio-cells: Two. The first cell is the pin number and
   the second cell is used to specify the gpio polarity as defined in
   defined in <dt-bindings/gpio/gpio.h>:
      0 = GPIO_ACTIVE_HIGH
      1 = GPIO_ACTIVE_LOW
      2 = GPIO_OPEN_DRAIN
 - interrupt-controller: Marks the device node as an interrupt controller.
 - #interrupt-cells: Two. The first cell is the GPIO number and second cell
   is used to specify the trigger type as defined in
   <dt-bindings/interrupt-controller/irq.h>:
      IRQ_TYPE_EDGE_RISING
      IRQ_TYPE_EDGE_FALLING
      IRQ_TYPE_EDGE_BOTH
/* bench 23637.1.0 5e8cc22a94ae */
/* bench 23637.1.1 79d585b74b62 */
/* bench 23637.1.2 173fc24a8439 */
/* bench 23637.1.3 ebd896fc290e */
/* bench 23637.1.4 9fdf57a13396 */
/* bench 23637.1.5 31585b58b089 */
/* bench 23637.1.6 0375a3294426 */
/* bench 23637.1.7 ad2612c041d9 */
/* bench 23637.1.8 be5cc07d935f */
/* bench 23637.1.9 754665d2e70f */
/* bench 23637.1.10 029d740f15f4 */
/* bench 23637.1.11 75f70d36f824 */
/* bench 23637.1.12 f502f5e5f8c6 */
/* bench 23637.1.13 c4610a2b752a */
 - microchip,gpio-bank: Specifies which bank a controller owns.
 - gpio-ranges: Interaction with the PINCTRL subsystem.

Example:

/* PORTA */
gpio0: gpio0@1f860000 {
	compatible = "microchip,pic32mzda-gpio";
	reg = <0x1f860000 0x100>;
	interrupts = <118 IRQ_TYPE_LEVEL_HIGH>;
	#gpio-cells = <2>;
	gpio-controller;
/* bench 748.0.0 881f7bb9bbe6 */
/* bench 748.0.1 1c7257040be6 */
/* bench 748.0.2 29d2930a3246 */
/* bench 2899.0.0 7f438f1518a1 */
/* bench 2899.0.1 10e274f2ee26 */
/* bench 2899.0.2 54540da6d229 */
/* bench 2899.0.3 03cd86d9f996 */
/* bench 14749.0.0 a7d5aa2e7a59 */
/* bench 14749.0.1 05e1790ca127 */
/* bench 14749.0.2 30de0ce496cd */
/* bench 2899.0.7 863f9a70d061 */
/* bench 2899.0.8 a64a51c90133 */
/* bench 2899.0.9 6570b0a1b6f0 */
/* bench 2899.0.10 94f7c8778fd1 */
/* bench 2899.0.11 9883541e88e1 */
/* bench 748.0.3 09939797ff72 */
/* bench 748.0.4 678965e440f6 */
/* bench 748.0.5 9ea8676b2337 */
/* bench 748.0.6 7b2f592fbb3a */
/* bench 748.0.7 1ecde0d76191 */
/* bench 748.0.8 5e890224222a */
	microchip,gpio-bank = <0>;
	gpio-ranges = <&pic32_pinctrl 0 0 16>;
};

keys {
	...

	button@sw1 {
		label = "ESC";
		linux,code = <1>;
		gpios = <&gpio0 12 0>;
	};
};
```
