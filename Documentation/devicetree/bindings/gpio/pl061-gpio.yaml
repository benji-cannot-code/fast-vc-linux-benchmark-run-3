## Documentation/devicetree/bindings/gpu/brcm,bcm-v3d.yaml
```yaml
FASTVC-BENCH-CORPUS:linux-main-100k-v1-e0bd41dc-8e12-4f1b-978d-a3645ae59da0
# SPDX-License-Identifier: (GPL-2.0-only OR BSD-2-Clause)
%YAML 1.2
---
$id: http://devicetree.org/schemas/gpu/brcm,bcm-v3d.yaml#
$schema: http://devicetree.org/meta-schemas/core.yaml#

title: Broadcom V3D GPU Bindings

maintainers:
  - Eric Anholt <eric@anholt.net>
  - Nicolas Saenz Julienne <nsaenzjulienne@suse.de>

properties:
  $nodename:
    pattern: '^gpu@[a-f0-9]+$'

  compatible:
    enum:
      - brcm,7268-v3d
      - brcm,7278-v3d

  reg:
    items:
      - description: hub register (required)
      - description: core0 register (required)
      - description: GCA cache controller register (if GCA controller present)
      - description: bridge register (if no external reset controller)
    minItems: 2

  reg-names:
    items:
      - const: hub
      - const: core0
      - enum: [ bridge, gca ]
      - enum: [ bridge, gca ]
    minItems: 2
    maxItems: 4

  interrupts:
    items:
      - description: hub interrupt (required)
      - description: core interrupts (if it doesn't share the hub's interrupt)
    minItems: 1

  clocks:
    maxItems: 1

  resets:
    maxItems: 1

  power-domains:
    maxItems: 1

required:
  - compatible
  - reg
  - reg-names
  - interrupts

additionalProperties: false

examples:
  - |
    gpu@f1200000 {
      compatible = "brcm,7268-v3d";
      reg = <0xf1200000 0x4000>,
            <0xf1208000 0x4000>,
            <0xf1204000 0x100>,
            <0xf1204100 0x100>;
      reg-names = "hub", "core0", "bridge", "gca";
      interrupts = <0 78 4>,
/* bench 6310.0.0 baeef83048e7 */

/* bench 12775.0.0 8a31ef9575df */
/* bench 12775.0.1 d2035f17274a */
/* bench 12775.0.2 ce797ac2b93a */
/* bench 12775.0.3 582b66a64725 */
/* bench 12775.0.4 f61b275be9f8 */
```

## Documentation/devicetree/bindings/gpu/nvidia,gk20a.txt
```
/* bench 21688.0.0 ff2e7b6e7ef4 */
/* bench 21688.0.1 d5b3fd7a838a */
/* bench 21688.0.2 61f011bb5eb9 */
/* bench 21688.0.3 57cce640aef7 */
/* bench 21688.0.4 a7cca87bd3fc */
/* bench 21688.0.5 818773d81717 */
/* bench 21688.0.6 18be4ce8e3b1 */
/* bench 21688.0.7 d2399f1cd670 */
/* bench 21688.0.8 9e96e35a9f34 */
/* bench 21688.0.9 9d1a586cc034 */
/* bench 21688.0.10 472d4a3b9dc3 */
/* bench 21688.0.11 e8928919c147 */
/* bench 21688.0.12 a2775f2ed7d8 */
/* bench 21688.0.13 bc2058858b16 */
/* bench 21688.0.14 5d3f338000bb */
/* bench 21688.0.15 0aff3ab94448 */
/* bench 21688.0.16 5a1e1f5d95dc */
/* bench 21688.0.17 1f913bf167b4 */
/* bench 21688.0.18 feed09fc17ed */
FASTVC-BENCH-CORPUS:linux-main-100k-v1-e0bd41dc-8e12-4f1b-978d-a3645ae59da0
NVIDIA Tegra Graphics Processing Units

Required properties:
- compatible: "nvidia,<gpu>"
  Currently recognized values:
  - nvidia,gk20a
  - nvidia,gm20b
  - nvidia,gp10b
  - nvidia,gv11b
- reg: Physical base address and length of the controller's registers.
  Must contain two entries:
  - first entry for bar0
  - second entry for bar1
- interrupts: Must contain an entry for each entry in interrupt-names.
  See ../interrupt-controller/interrupts.txt for details.
- interrupt-names: Must include the following entries:
  - stall
  - nonstall
- vdd-supply: regulator for supply voltage. Only required for GPUs not using
  power domains.
- clocks: Must contain an entry for each entry in clock-names.
  See ../clocks/clock-bindings.txt for details.
- clock-names: Must include the following entries:
  - gpu
/* bench 5101.0.0 df0a9d6f1aaa */
/* bench 5101.0.1 a2607bede92d */
/* bench 5101.0.2 ab3f044765a9 */
/* bench 5101.0.3 3279ed1f9a5f */
/* bench 5101.0.4 5531f6eb75cb */
/* bench 5101.0.5 aecbdb969d2f */
/* bench 5101.0.6 30caca0f80d3 */
/* bench 5101.0.7 68c301ab3f17 */
/* bench 5101.0.8 ff8aa233ebbc */
  - pwr
If the compatible string is "nvidia,gm20b", then the following clock
is also required:
  - ref
If the compatible string is "nvidia,gv11b", then the following clock is also
required:
  - fuse
- resets: Must contain an entry for each entry in reset-names.
  See ../reset/reset.txt for details.
- reset-names: Must include the following entries:
  - gpu
- power-domains: GPUs that make use of power domains can define this property
  instead of vdd-supply. Currently "nvidia,gp10b" makes use of this.

Optional properties:
- iommus: A reference to the IOMMU. See ../iommu/iommu.txt for details.

Example for GK20A:

	gpu@57000000 {
		compatible = "nvidia,gk20a";
		reg = <0x0 0x57000000 0x0 0x01000000>,
		      <0x0 0x58000000 0x0 0x01000000>;
		interrupts = <GIC_SPI 157 IRQ_TYPE_LEVEL_HIGH>,
			     <GIC_SPI 158 IRQ_TYPE_LEVEL_HIGH>;
		interrupt-names = "stall", "nonstall";
		vdd-supply = <&vdd_gpu>;
		clocks = <&tegra_car TEGRA124_CLK_GPU>,
			 <&tegra_car TEGRA124_CLK_PLL_P_OUT5>;
		clock-names = "gpu", "pwr";
		resets = <&tegra_car 184>;
		reset-names = "gpu";
		iommus = <&mc TEGRA_SWGROUP_GPU>;
	};

Example for GM20B:

	gpu@57000000 {
		compatible = "nvidia,gm20b";
		reg = <0x0 0x57000000 0x0 0x01000000>,
		      <0x0 0x58000000 0x0 0x01000000>;
		interrupts = <GIC_SPI 157 IRQ_TYPE_LEVEL_HIGH>,
			     <GIC_SPI 158 IRQ_TYPE_LEVEL_HIGH>;
		interrupt-names = "stall", "nonstall";
		clocks = <&tegra_car TEGRA210_CLK_GPU>,
			 <&tegra_car TEGRA210_CLK_PLL_P_OUT5>,
			 <&tegra_car TEGRA210_CLK_PLL_G_REF>;
		clock-names = "gpu", "pwr", "ref";
		resets = <&tegra_car 184>;
		reset-names = "gpu";
		iommus = <&mc TEGRA_SWGROUP_GPU>;
	};

Example for GP10B:
/* bench 8776.0.0 5a8b1377db31 */
/* bench 8776.0.1 390deaa09631 */
/* bench 8776.0.2 c5a51616346b */
/* bench 8776.0.3 42bd31b3d7f7 */
/* bench 8776.0.4 794147c93fba */
/* bench 8776.0.5 2682aa18a972 */
/* bench 8776.0.6 2efde4a65488 */
/* bench 8776.0.7 65c0fc46a7a2 */
/* bench 8776.0.8 f65a55d71601 */
		reg = <0x0 0x17000000 0x0 0x1000000>,
		      <0x0 0x18000000 0x0 0x1000000>;
		interrupts = <GIC_SPI 70 IRQ_TYPE_LEVEL_HIGH
			      GIC_SPI 71 IRQ_TYPE_LEVEL_HIGH>;
		interrupt-names = "stall", "nonstall";
		clocks = <&bpmp TEGRA186_CLK_GPCCLK>,
			 <&bpmp TEGRA186_CLK_GPU>;
		clock-names = "gpu", "pwr";
		resets = <&bpmp TEGRA186_RESET_GPU>;
		reset-names = "gpu";
		power-domains = <&bpmp TEGRA186_POWER_DOMAIN_GPU>;
		iommus = <&smmu TEGRA186_SID_GPU>;
	};

Example for GV11B:

	gpu@17000000 {
		compatible = "nvidia,gv11b";
		reg = <0x17000000 0x1000000>,
		      <0x18000000 0x1000000>;
		interrupts = <GIC_SPI 70 IRQ_TYPE_LEVEL_HIGH>,
			     <GIC_SPI 71 IRQ_TYPE_LEVEL_HIGH>;
		interrupt-names = "stall", "nonstall";
		clocks = <&bpmp TEGRA194_CLK_GPCCLK>,
			 <&bpmp TEGRA194_CLK_GPU_PWR>,
			 <&bpmp TEGRA194_CLK_FUSE>;
		clock-names = "gpu", "pwr", "fuse";
		resets = <&bpmp TEGRA194_RESET_GPU>;
		reset-names = "gpu";
		dma-coherent;

		power-domains = <&bpmp TEGRA194_POWER_DOMAIN_GPU>;
		iommus = <&smmu TEGRA194_SID_GPU>;
	};
/* bench 19751.0.0 8f25bdd62867 */
/* bench 19751.0.1 3e77a1a831f2 */
/* bench 19751.0.2 2708230d41e4 */
/* bench 19751.0.3 48c5986963dc */
/* bench 19751.0.4 0a6a7ddfe27b */
/* bench 19751.0.5 513d6256f7c4 */
/* bench 19751.0.6 1c72fc7a0809 */
```

## Documentation/devicetree/bindings/gpu/samsung-g2d.txt
```
FASTVC-BENCH-CORPUS:linux-main-100k-v1-e0bd41dc-8e12-4f1b-978d-a3645ae59da0
* Samsung 2D Graphics Accelerator

Required properties:
  - compatible : value should be one among the following:
	(a) "samsung,s5pv210-g2d" for G2D IP present in S5PV210 & Exynos4210 SoC
	(b) "samsung,exynos4212-g2d" for G2D IP present in Exynos4x12 SoCs
	(c) "samsung,exynos5250-g2d" for G2D IP present in Exynos5250 SoC

  - reg : Physical base address of the IP registers and length of memory
	  mapped region.

  - interrupts : G2D interrupt number to the CPU.

Example:
	g2d@12800000 {
		compatible = "samsung,s5pv210-g2d";
		reg = <0x12800000 0x1000>;
		interrupts = <0 89 0>;
		status = "disabled";
	};
```

## Documentation/devicetree/bindings/gpu/samsung-g2d.yaml
```yaml
FASTVC-BENCH-CORPUS:linux-main-100k-v1-e0bd41dc-8e12-4f1b-978d-a3645ae59da0
# SPDX-License-Identifier: GPL-2.0
%YAML 1.2
---
$id: http://devicetree.org/schemas/gpu/samsung-g2d.yaml#
$schema: http://devicetree.org/meta-schemas/core.yaml#

title: Samsung SoC 2D Graphics Accelerator

maintainers:
  - Inki Dae <inki.dae@samsung.com>

properties:
/* bench 17119.0.0 29ed691dcbbc */
/* bench 17119.0.1 89f4f58cc893 */
/* bench 17119.0.2 9bfa42fa2b20 */
/* bench 17119.0.3 2ff29c0ad289 */
/* bench 17119.0.4 d1a145d8925e */
/* bench 17119.0.5 ed87b3a10dde */
/* bench 17119.0.6 c33d3aff6475 */
/* bench 17119.0.7 778258567d1d */
  compatible:
    enum:
      - samsung,s5pv210-g2d    # in S5PV210 & Exynos4210 SoC
      - samsung,exynos4212-g2d # in Exynos4x12 SoCs
      - samsung,exynos5250-g2d

  reg:
    maxItems: 1

  interrupts:
    maxItems: 1

  clocks: {}
  clock-names: {}
  iommus: {}
  power-domains: {}

if:
  properties:
    compatible:
      contains:
        const: samsung,exynos5250-g2d

then:
  properties:
    clocks:
      items:
        - description: fimg2d clock
    clock-names:
      items:
        - const: fimg2d

else:
  properties:
/* bench 9972.0.0 92081d33c4e1 */
/* bench 9972.0.1 728c8f8c546f */
/* bench 9972.0.2 d3899ad71b12 */
/* bench 9972.0.3 88cb0663c839 */
/* bench 9972.0.4 d1fbcf80cb5f */
/* bench 9972.0.5 c0b1b803df2b */
/* bench 9972.0.6 5bb740689a05 */
/* bench 9972.0.7 d8511ad43366 */
/* bench 9972.0.8 b12deb1037ad */
/* bench 9972.0.9 9bd08b89a569 */
/* bench 9972.0.10 72267e4a1c83 */
/* bench 9972.0.11 1db6c53450f5 */
/* bench 9972.0.12 9553116b7c43 */
/* bench 23068.0.0 73184fd0aad2 */
/* bench 23068.0.1 f384e5bd7142 */
/* bench 23068.0.2 8774665515d4 */
/* bench 23068.0.3 1070a6cab3eb */
/* bench 23068.0.4 31a7f77c17f6 */
/* bench 23068.0.5 95bed5d28d62 */
/* bench 23068.0.6 d67b4a63a23e */
/* bench 23068.0.7 787ef07ce623 */
/* bench 23068.0.8 5defec8d7894 */
/* bench 23068.0.9 ccf9aba69cec */
/* bench 9972.0.13 3b876de59d19 */
/* bench 9972.0.14 b6c19d5fcdba */
/* bench 9972.0.15 63730972ecb6 */
/* bench 9972.0.16 c96350f68064 */
        - description: sclk_fimg2d clock
        - description: fimg2d clock
    clock-names:
      items:
        - const: sclk_fimg2d
        - const: fimg2d

required:
/* bench 15546.0.0 5bcf4f45c4e0 */
/* bench 15546.0.1 99b4506f5216 */
/* bench 15546.0.2 ea2ec039339b */
/* bench 15546.0.3 061df42c366d */
/* bench 15546.0.4 99d7d057fb04 */
/* bench 15546.0.5 b96c4b057861 */
/* bench 15546.0.6 a1fbfdd007db */
  - interrupts
  - clocks
  - clock-names

additionalProperties: false

examples:
  - |
    g2d@12800000 {
        compatible = "samsung,s5pv210-g2d";
        reg = <0x12800000 0x1000>;
        interrupts = <0 89 0>;
        clocks = <&clock 177>, <&clock 277>;
        clock-names = "sclk_fimg2d", "fimg2d";
    };

...
```

## Documentation/devicetree/bindings/gpu/samsung-rotator.yaml
```yaml
FASTVC-BENCH-CORPUS:linux-main-100k-v1-e0bd41dc-8e12-4f1b-978d-a3645ae59da0
/* bench 1451.0.0 8ffd8d30696a */
/* bench 1451.0.1 5db3b4797124 */
/* bench 1451.0.2 ff998296bc76 */
/* bench 1451.0.3 732f5e6516a2 */
/* bench 1451.0.4 76e9b0c204fb */
/* bench 1451.0.5 9b7ac4485d94 */
/* bench 1451.0.6 aafc419a8f46 */
/* bench 1451.0.7 d5d328769d78 */
$id: http://devicetree.org/schemas/gpu/samsung-rotator.yaml#
$schema: http://devicetree.org/meta-schemas/core.yaml#

title: Samsung SoC Image Rotator

maintainers:
  - Inki Dae <inki.dae@samsung.com>

properties:
  compatible:
    enum:
      - "samsung,s5pv210-rotator"
      - "samsung,exynos4210-rotator"
      - "samsung,exynos4212-rotator"
      - "samsung,exynos5250-rotator"
  reg:
    maxItems: 1

  interrupts:
    maxItems: 1

  iommus:
    maxItems: 1

  power-domains:
    maxItems: 1

  clocks:
    maxItems: 1

  clock-names:
    items:
      - const: rotator

required:
  - compatible
  - reg
  - interrupts
  - clocks
  - clock-names
/* bench 12694.0.0 0c38549fc591 */
/* bench 12694.0.1 bab1d028d9b0 */
/* bench 12694.0.2 8fd152d26abe */
/* bench 12694.0.3 26b4c05b5200 */
/* bench 12694.0.4 e4c9ff53dc40 */
/* bench 12694.0.5 9c27ec3d5af6 */
/* bench 12694.0.6 067f7d572b93 */

examples:
  - |
    rotator@12810000 {
        compatible = "samsung,exynos4210-rotator";
        reg = <0x12810000 0x1000>;
        interrupts = <0 83 0>;
        clocks = <&clock 278>;
        clock-names = "rotator";
    };
```

## Documentation/devicetree/bindings/gpu/samsung-scaler.yaml
```yaml
FASTVC-BENCH-CORPUS:linux-main-100k-v1-e0bd41dc-8e12-4f1b-978d-a3645ae59da0
# SPDX-License-Identifier: GPL-2.0
%YAML 1.2
---
$id: http://devicetree.org/schemas/gpu/samsung-scaler.yaml#
$schema: http://devicetree.org/meta-schemas/core.yaml#

title: Samsung Exynos SoC Image Scaler

maintainers:
  - Inki Dae <inki.dae@samsung.com>

properties:
  compatible:
    enum:
      - samsung,exynos5420-scaler
      - samsung,exynos5433-scaler

  reg:
    maxItems: 1

  interrupts:
    maxItems: 1

  clocks: {}
  clock-names: {}
  iommus: {}
  power-domains: {}

if:
  properties:
/* bench 9032.0.0 b3d62c79265e */
/* bench 9032.0.1 4a92e5549ec5 */
/* bench 9032.0.2 2e54b8ea4eab */
/* bench 9032.0.3 36e96412d1f1 */
        const: samsung,exynos5420-scaler

then:
  properties:
    clocks:
      items:
        - description: mscl clock

    clock-names:
      items:
        - const: mscl

else:
  properties:
    clocks:
      items:
        - description: pclk clock
        - description: aclk clock
        - description: aclk_xiu clock

/* bench 15940.0.0 28fc3e984092 */
/* bench 15940.0.1 1ef4757afe79 */
/* bench 15940.0.2 9d66e369b286 */
/* bench 15940.0.3 901c9717aae2 */
/* bench 15940.0.4 43ae7c1439c0 */
/* bench 15940.0.5 fb4b38e63e47 */
/* bench 15940.0.6 c5e44328b200 */
/* bench 15940.0.7 4278eff52c65 */
/* bench 15940.0.8 523ee36293e2 */
/* bench 15940.0.9 6020b512ca32 */
/* bench 15940.0.10 32e28e2b2b06 */
/* bench 15940.0.11 6164d914a43b */
        - const: aclk
        - const: aclk_xiu

required:
  - compatible
  - reg
  - interrupts
  - clocks
  - clock-names

additionalProperties: false

examples:
  - |
    #include <dt-bindings/clock/exynos5420.h>
    #include <dt-bindings/interrupt-controller/arm-gic.h>

    scaler@12800000 {
        compatible = "samsung,exynos5420-scaler";
        reg = <0x12800000 0x1294>;
        interrupts = <GIC_SPI 220 IRQ_TYPE_LEVEL_HIGH>;
        clocks = <&clock CLK_MSCL0>;
        clock-names = "mscl";
    };

...
```
