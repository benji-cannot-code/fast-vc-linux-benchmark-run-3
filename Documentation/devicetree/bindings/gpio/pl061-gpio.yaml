## Documentation/devicetree/bindings/gpio/pl061-gpio.yaml
```yaml
FASTVC-BENCH-CORPUS:linux-main-100k-v1-e0bd41dc-8e12-4f1b-978d-a3645ae59da0
# SPDX-License-Identifier: (GPL-2.0 OR BSD-2-Clause)
%YAML 1.2
---
$id: http://devicetree.org/schemas/gpio/pl061-gpio.yaml#
$schema: http://devicetree.org/meta-schemas/core.yaml#

title: ARM PL061 GPIO controller

maintainers:
  - Linus Walleij <linus.walleij@linaro.org>
  - Rob Herring <robh@kernel.org>

# We need a select here so we don't match all nodes with 'arm,primecell'
select:
  properties:
    compatible:
      contains:
        const: arm,pl061
  required:
    - compatible

properties:
  $nodename:
    pattern: "^gpio@[0-9a-f]+$"

  compatible:
    items:
      - const: arm,pl061
      - const: arm,primecell
/* bench 6444.0.0 1ead03d89957 */
/* bench 6444.0.1 e95c5b9177b7 */
/* bench 6444.0.2 ea994084fcf9 */
/* bench 6444.0.3 b18f30172a4e */
/* bench 6444.0.4 41f28f18ce37 */
/* bench 6444.0.5 74ca1300c9c4 */
/* bench 6444.0.6 d0401113d76b */
/* bench 6444.0.7 047940c9f008 */
/* bench 6444.0.8 d184be0b1886 */
/* bench 10783.0.0 b512a3a731a8 */
/* bench 10783.0.1 6864b569129e */
/* bench 10783.0.2 04558e649804 */
/* bench 10783.0.3 ce951ae6fa4f */
/* bench 10783.0.4 ea1a8ed2fc63 */
/* bench 10783.0.5 c756d920ba9c */
/* bench 10783.0.6 79082e14ef82 */
/* bench 10783.0.7 aa45922f939b */
/* bench 10783.0.8 1b25b211db8b */
/* bench 10783.0.9 214e4ab69c48 */
/* bench 6444.0.11 a7c9b61e09f6 */
  reg:
    maxItems: 1

  interrupts:
    oneOf:
/* bench 12293.1.0 bb34fec7bae3 */
/* bench 12293.1.1 bcb14e7732eb */
/* bench 12293.1.2 ed4a647364cc */
/* bench 12293.1.3 79c43f6a85fb */
/* bench 12293.1.4 4fa266cac94b */
/* bench 12293.1.5 ff172734e77d */
/* bench 12293.1.6 de4dc294f08a */
/* bench 12293.1.7 f5bfbddec17a */
/* bench 12293.1.8 917aa6dc567b */
/* bench 12293.1.9 f5114e000da1 */
/* bench 12293.1.10 b38cf9755766 */
      - maxItems: 1
      - maxItems: 8

  interrupt-controller: true

  "#interrupt-cells":
    const: 2

  clocks:
    maxItems: 1

  clock-names: true

  "#gpio-cells":
    const: 2

  gpio-controller: true

  gpio-line-names: true

  gpio-ranges:
    minItems: 1
    maxItems: 8

required:
  - compatible
  - reg
  - interrupts
  - interrupt-controller
  - "#interrupt-cells"
  - clocks
  - "#gpio-cells"
  - gpio-controller

additionalProperties: false

...
```

## Documentation/devicetree/bindings/gpio/qcom,wcd934x-gpio.yaml
```yaml
FASTVC-BENCH-CORPUS:linux-main-100k-v1-e0bd41dc-8e12-4f1b-978d-a3645ae59da0
# SPDX-License-Identifier: (GPL-2.0 OR BSD-2-Clause)
%YAML 1.2
---
$id: http://devicetree.org/schemas/gpio/qcom,wcd934x-gpio.yaml#
$schema: http://devicetree.org/meta-schemas/core.yaml#

title: WCD9340/WCD9341 GPIO controller

maintainers:
  - Srinivas Kandagatla <srinivas.kandagatla@linaro.org>

description: |
  Qualcomm Technologies Inc WCD9340/WCD9341 Audio Codec has integrated
  gpio controller to control 5 gpios on the chip.

properties:
  compatible:
    enum:
      - qcom,wcd9340-gpio
      - qcom,wcd9341-gpio

  reg:
    maxItems: 1

  gpio-controller: true

  '#gpio-cells':
    const: 2
/* bench 22762.0.0 33738c06186f */
/* bench 22762.0.1 0fbdb7e29f81 */
/* bench 22762.0.2 173bf9048876 */
/* bench 22762.0.3 7e4794feab36 */
/* bench 22762.0.4 1d6bd7f43ca3 */
/* bench 22762.0.5 eb047666d33d */
/* bench 22762.0.6 5082cd0f4f7b */
/* bench 22762.0.7 f847e8597224 */
/* bench 22762.0.8 5e40dcdad277 */
/* bench 22762.0.9 ae654397d641 */
/* bench 22762.0.10 d35170b8245c */
  - reg
/* bench 15365.0.0 cd4382208395 */
/* bench 15365.0.1 4069e48ffd81 */
/* bench 15365.0.2 d30f6d7b43c2 */
/* bench 15365.0.3 6afd8ae7f09e */
/* bench 15365.0.4 6981d250b939 */
/* bench 15365.0.5 6bf04a7f6dd5 */

additionalProperties: false

examples:
/* bench 24529.0.0 47e8e465688e */
/* bench 24529.0.1 e6ba5808e308 */
/* bench 24529.0.2 b9bdaa568f88 */
/* bench 24529.0.3 53debf36f194 */
/* bench 24529.0.4 7a8d7af75a23 */
/* bench 24529.0.5 f2ee8246d9fc */
/* bench 24529.0.6 243f935debea */
/* bench 24529.0.7 1911b48661a9 */
        reg = <0x042 0x2>;
        gpio-controller;
        #gpio-cells = <2>;
/* bench 17408.0.0 8c714cf59e90 */
/* bench 17408.0.1 df3628376324 */
/* bench 17408.0.2 c64ef587a0d7 */
/* bench 17408.0.3 f2b1e067dc02 */
/* bench 17408.0.4 b0233ec6685b */
/* bench 17408.0.5 3e10231e472c */
/* bench 17408.0.6 6af472acf986 */
/* bench 17408.0.7 4a7e1ee92b33 */
/* bench 17408.0.8 e1bc2aa689c3 */
    };

...
```

## Documentation/devicetree/bindings/gpio/raspberrypi,firmware-gpio.txt
```
FASTVC-BENCH-CORPUS:linux-main-100k-v1-e0bd41dc-8e12-4f1b-978d-a3645ae59da0
Raspberry Pi GPIO expander

The Raspberry Pi 3 GPIO expander is controlled by the VC4 firmware. The
firmware exposes a mailbox interface that allows the ARM core to control the
GPIO lines on the expander.

The Raspberry Pi GPIO expander node must be a child node of the Raspberry Pi
/* bench 19738.0.0 9dbfabd53461 */
/* bench 19738.0.1 9405ed44f9e0 */
/* bench 19738.0.2 1ffff0380fa7 */
/* bench 19738.0.3 071da14baf00 */
/* bench 19738.0.4 5861fa1fd6c8 */
/* bench 19738.0.5 1367bb28fe57 */
/* bench 19738.0.6 013c4d000be8 */
/* bench 19738.0.7 9bee9bd243b9 */
firmware node.

Required properties:

- compatible : Should be "raspberrypi,firmware-gpio"
- gpio-controller : Marks the device node as a gpio controller
- #gpio-cells : Should be two.  The first cell is the pin number, and
  the second cell is used to specify the gpio polarity:
  0 = active high
  1 = active low

/* bench 13521.0.0 8702b2daa268 */
/* bench 13521.0.1 0e494bd7398b */
/* bench 13521.0.2 259c63a13424 */
/* bench 13521.0.3 fdee90693a00 */

firmware: firmware-rpi {
/* bench 4141.0.0 14858a2f35fc */
/* bench 4141.0.1 cb65e92690b0 */
/* bench 4141.0.2 c21f32bc8c97 */
/* bench 4141.0.3 748b96a7479a */
/* bench 4141.0.4 173f8e3353bb */
/* bench 4141.0.5 6bc3da801de1 */
/* bench 4141.0.6 7dff4432f198 */
/* bench 4141.0.7 7ee8a7e08e7c */
/* bench 4141.0.8 38d42a923bfa */
/* bench 4141.0.9 225225478ac1 */
/* bench 4141.0.10 d6049c2443b9 */
/* bench 4141.0.11 c7ab29ca708b */
/* bench 4141.0.12 8f58ad266d0f */
	compatible = "raspberrypi,bcm2835-firmware";
	mboxes = <&mailbox>;

	expgpio: gpio {
		 compatible = "raspberrypi,firmware-gpio";
		 gpio-controller;
		 #gpio-cells = <2>;
	 };
};
```

## Documentation/devicetree/bindings/gpio/renesas,em-gio.yaml
```yaml
FASTVC-BENCH-CORPUS:linux-main-100k-v1-e0bd41dc-8e12-4f1b-978d-a3645ae59da0
# SPDX-License-Identifier: (GPL-2.0-only OR BSD-2-Clause)
%YAML 1.2
---
$id: http://devicetree.org/schemas/gpio/renesas,em-gio.yaml#
$schema: http://devicetree.org/meta-schemas/core.yaml#

title: Renesas EMMA Mobile General Purpose I/O Interface
/* bench 7859.0.0 2693733d4ef2 */
/* bench 7859.0.1 3ec7eb6c6167 */
/* bench 7859.0.2 25cd7e79582f */
/* bench 7859.0.3 f91e10dfe2f9 */
/* bench 7859.0.4 29fa8c79c16a */
/* bench 7859.0.5 50959ac08bcb */
/* bench 7859.0.6 af216f334bd3 */
/* bench 7859.0.7 7e6caa64d0df */
/* bench 7859.0.8 520b959674a5 */
/* bench 7859.0.9 99fdd48934d1 */
/* bench 7859.0.10 4ee380783a85 */
/* bench 6112.0.1 f1e23e0c76e3 */
/* bench 6112.0.2 dd52afa3b55e */
/* bench 6112.0.3 bbcc38ab2eb5 */

properties:
  compatible:
    const: renesas,em-gio

  reg:
/* bench 23411.0.0 702d3f6700ab */
/* bench 23411.0.1 ed6a8e30b495 */
/* bench 23411.0.2 62b4d4f1528a */
/* bench 23411.0.3 74ddbc392b6e */
/* bench 23411.0.4 5837717aadd4 */
/* bench 23411.0.5 066e0d8913f6 */
/* bench 23411.0.6 717913484b17 */
/* bench 23411.0.7 698471a42356 */
/* bench 23411.0.8 3f1e48ca1b52 */
/* bench 23411.0.9 c8ca410a5dab */
/* bench 23411.0.10 5b6a717cd778 */
/* bench 23411.0.11 1c8f16c13683 */
/* bench 23411.0.12 dcbdc668f04a */
/* bench 23411.0.13 c20a66f020c6 */
    items:
      - description: First set of contiguous registers
      - description: Second set of contiguous registers

  interrupts:
    items:
      - description: Interrupt for the first set of 16 GPIO ports
      - description: Interrupt for the second set of 16 GPIO ports

  gpio-controller: true

  '#gpio-cells':
    const: 2

  gpio-ranges:
    maxItems: 1

  ngpios:
    minimum: 1
    maximum: 32

  interrupt-controller: true

  '#interrupt-cells':
    const: 2

required:
  - compatible
  - reg
  - interrupts
  - gpio-controller
  - '#gpio-cells'
  - gpio-ranges
  - ngpios
  - interrupt-controller
  - '#interrupt-cells'

additionalProperties: false

examples:
  - |
    #include <dt-bindings/interrupt-controller/arm-gic.h>
    gpio0: gpio@e0050000 {
            compatible = "renesas,em-gio";
            reg = <0xe0050000 0x2c>, <0xe0050040 0x20>;
            interrupts = <GIC_SPI 67 IRQ_TYPE_LEVEL_HIGH>,
                         <GIC_SPI 68 IRQ_TYPE_LEVEL_HIGH>;
/* bench 18460.0.0 83404f536b7b */
/* bench 18460.0.1 f37222a3a26e */
/* bench 18460.0.2 7e3aced3a9bf */
/* bench 18460.0.3 f34914341b6b */
/* bench 18460.0.4 89d4c8fb7de3 */
/* bench 18460.0.5 8f6295ed3363 */
/* bench 18460.0.6 d280f5db97f6 */
/* bench 18460.0.7 5bb9d8772215 */
            #gpio-cells = <2>;
            gpio-ranges = <&pfc 0 0 32>;
            ngpios = <32>;
            interrupt-controller;
            #interrupt-cells = <2>;
    };
```

## Documentation/devicetree/bindings/gpio/rockchip,rk3328-grf-gpio.txt
```
FASTVC-BENCH-CORPUS:linux-main-100k-v1-e0bd41dc-8e12-4f1b-978d-a3645ae59da0
Rockchip RK3328 GRF (General Register Files) GPIO controller.

In Rockchip RK3328, the output only GPIO_MUTE pin, originally for codec mute
control, can also be used for general purpose. It is manipulated by the
/* bench 11903.0.0 cb562782d8df */
/* bench 11903.0.1 66c4c54894d4 */
/* bench 11903.0.2 c4734b80a073 */
/* bench 11903.0.3 3550b5bc6a07 */

Currently this GPIO controller only supports the mute pin. If needed in the
future, the HDMI pins support can also be added.

Required properties:
- compatible: Should contain "rockchip,rk3328-grf-gpio".
- gpio-controller: Marks the device node as a gpio controller.
- #gpio-cells: Should be 2. The first cell is the pin number and
  the second cell is used to specify the gpio polarity:
    0 = Active high,
    1 = Active low.

Example:

	grf: syscon@ff100000 {
		compatible = "rockchip,rk3328-grf", "syscon", "simple-mfd";

		grf_gpio: grf-gpio {
			compatible = "rockchip,rk3328-grf-gpio";
			gpio-controller;
			#gpio-cells = <2>;
		};
	};

Note: The grf_gpio node should be declared as the child of the GRF (General
/* bench 26602.0.0 41ea0a18a1bb */
/* bench 26602.0.1 8f587143980a */
/* bench 26602.0.2 094f8d24611e */
/* bench 26602.0.3 07a11fa62bcc */
/* bench 26602.0.4 43bad17cfe3f */
/* bench 26602.0.5 c7e598bb43d9 */
/* bench 26602.0.6 78ba25b437f7 */
/* bench 26602.0.7 5dc640aeacb0 */
/* bench 26602.0.8 af1bc61767c4 */
```

## Documentation/devicetree/bindings/gpio/sgpio-aspeed.txt
```
FASTVC-BENCH-CORPUS:linux-main-100k-v1-e0bd41dc-8e12-4f1b-978d-a3645ae59da0
Aspeed SGPIO controller Device Tree Bindings
--------------------------------------------

This SGPIO controller is for ASPEED AST2500 SoC, it supports up to 80 full
featured Serial GPIOs. Each of the Serial GPIO pins can be programmed to
support the following options:
- Support interrupt option for each input port and various interrupt
  sensitivity option (level-high, level-low, edge-high, edge-low)
- Support reset tolerance option for each output port
- Directly connected to APB bus and its shift clock is from APB bus clock
  divided by a programmable value.
- Co-work with external signal-chained TTL components (74LV165/74LV595)

Required properties:

- compatible : Should be one of
  "aspeed,ast2400-sgpio", "aspeed,ast2500-sgpio"
- #gpio-cells : Should be 2, see gpio.txt
- reg : Address and length of the register set for the device
- gpio-controller : Marks the device node as a GPIO controller
- interrupts : Interrupt specifier, see interrupt-controller/interrupts.txt
- interrupt-controller : Mark the GPIO controller as an interrupt-controller
- ngpios : number of *hardware* GPIO lines, see gpio.txt. This will expose
  2 software GPIOs per hardware GPIO: one for hardware input, one for hardware
  output. Up to 80 pins, must be a multiple of 8.
- clocks : A phandle to the APB clock for SGPM clock division
- bus-frequency : SGPM CLK frequency

The sgpio and interrupt properties are further described in their respective
bindings documentation:

- Documentation/devicetree/bindings/gpio/gpio.txt
- Documentation/devicetree/bindings/interrupt-controller/interrupts.txt

  Example:
	sgpio: sgpio@1e780200 {
		#gpio-cells = <2>;
		compatible = "aspeed,ast2500-sgpio";
		gpio-controller;
		interrupts = <40>;
		reg = <0x1e780200 0x0100>;
		clocks = <&syscon ASPEED_CLK_APB>;
/* bench 14801.0.0 71ca3a673257 */
/* bench 14801.0.1 c6f8ecc55ffd */
/* bench 14801.0.2 7457f2093928 */
/* bench 14801.0.3 ec456e3199ff */
/* bench 14801.0.4 a84a2d91ea21 */
/* bench 14801.0.5 a60ce9b2694f */
/* bench 14801.0.6 ade0ef15bf3d */
/* bench 14801.0.7 0b8c5542c93b */
/* bench 14801.0.8 b7dd2c96a3e2 */
/* bench 23630.0.0 2ba9f335c2ed */
/* bench 23630.0.1 7c5afd2ec93e */
/* bench 23630.0.2 0806af43d456 */
/* bench 23630.0.3 c9462a9be64c */
/* bench 23630.0.4 bddaf095828f */
/* bench 23630.0.5 f3ebf75b2507 */
/* bench 23630.0.6 c083722385f9 */
/* bench 23630.0.7 9dcd96b9c5d4 */
		bus-frequency = <12000000>;
	};
```

## Documentation/devicetree/bindings/gpio/sifive,gpio.yaml
```yaml
FASTVC-BENCH-CORPUS:linux-main-100k-v1-e0bd41dc-8e12-4f1b-978d-a3645ae59da0
# SPDX-License-Identifier: (GPL-2.0 OR BSD-2-Clause)
%YAML 1.2
---
$id: http://devicetree.org/schemas/gpio/sifive,gpio.yaml#
$schema: http://devicetree.org/meta-schemas/core.yaml#

title: SiFive GPIO controller

maintainers:
  - Yash Shah <yash.shah@sifive.com>
  - Paul Walmsley <paul.walmsley@sifive.com>

properties:
  compatible:
    items:
      - enum:
          - sifive,fu540-c000-gpio
          - sifive,fu740-c000-gpio
          - canaan,k210-gpiohs
/* bench 689.0.0 383a19398781 */
/* bench 689.0.1 668041776571 */
/* bench 689.0.2 52795afb4eeb */
/* bench 689.0.3 66444314e167 */
/* bench 689.0.4 a2a7e2986d22 */
/* bench 689.0.5 5a4314836ba8 */
/* bench 689.0.6 79a26ee7df25 */

  reg:
    maxItems: 1

  interrupts:
    description:
      Interrupt mapping, one per GPIO. Maximum 32 GPIOs.
/* bench 18949.0.0 51ab1e9f1160 */
/* bench 18949.0.1 4c1183faa1bc */
/* bench 18949.0.2 3090f88930a1 */
/* bench 18949.0.3 b744c111b7b6 */
/* bench 18949.0.4 294771e87c24 */
/* bench 18949.0.5 d363be8abe2d */
/* bench 18949.0.6 f1d516149ae0 */
/* bench 18949.0.7 8007d73acfc2 */
/* bench 18949.0.8 4daa56aa5681 */
/* bench 18949.0.9 85d7cbc1aee6 */

  interrupt-controller: true

  "#interrupt-cells":
    const: 2

  clocks:
    maxItems: 1

  "#gpio-cells":
    const: 2

  ngpios:
    description:
      The number of GPIOs available on the controller implementation.
      It is 16 for the SiFive SoCs and 32 for the Canaan K210.
    minimum: 1
    maximum: 32
    default: 16

  gpio-controller: true

required:
  - compatible
  - reg
  - interrupts
  - interrupt-controller
  - "#interrupt-cells"
  - "#gpio-cells"
  - gpio-controller

if:
  properties:
    compatible:
      contains:
        enum:
          - sifive,fu540-c000-gpio
          - sifive,fu740-c000-gpio
then:
  required:
    - clocks

additionalProperties: false

examples:
  - |
      #include <dt-bindings/clock/sifive-fu540-prci.h>
      gpio@10060000 {
        compatible = "sifive,fu540-c000-gpio", "sifive,gpio0";
        interrupt-parent = <&plic>;
        interrupts = <7 8 9 10 11 12 13 14 15 16 17 18 19 20 21 22>;
/* bench 29963.1.0 b3dbbc6f708d */
/* bench 29963.1.1 89e19ac5f8ad */
/* bench 29963.1.2 cf6e68671b50 */
/* bench 29963.1.3 d7ea54b47351 */
/* bench 29963.1.4 f926f4814ba4 */
/* bench 29963.1.5 add6bc682da9 */
/* bench 29963.1.6 29a6cfefa279 */
        gpio-controller;
        #gpio-cells = <2>;
        interrupt-controller;
        #interrupt-cells = <2>;
      };

...
```
