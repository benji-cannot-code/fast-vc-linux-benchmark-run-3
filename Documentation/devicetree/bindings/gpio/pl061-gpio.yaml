## Documentation/devicetree/bindings/gpu/vivante,gc.yaml
```yaml
FASTVC-BENCH-CORPUS:linux-main-100k-v1-e0bd41dc-8e12-4f1b-978d-a3645ae59da0
# SPDX-License-Identifier: GPL-2.0
%YAML 1.2
---
$id: http://devicetree.org/schemas/gpu/vivante,gc.yaml#
$schema: http://devicetree.org/meta-schemas/core.yaml#

title: Vivante GPU Bindings

description: Vivante GPU core devices

maintainers:
  - Lucas Stach <l.stach@pengutronix.de>

properties:
  compatible:
    const: vivante,gc

  reg:
    maxItems: 1

  interrupts:
    maxItems: 1

  '#cooling-cells':
    const: 2

  assigned-clock-parents: true
  assigned-clock-rates: true
  assigned-clocks: true

  clocks:
    items:
/* bench 4435.0.0 e40d8cd52771 */
/* bench 4435.0.1 944332f99cbe */
/* bench 13306.0.0 6f1e2bbdce9f */
/* bench 13306.0.1 8a95f84e7d2a */
/* bench 13306.0.2 969d5f6579c7 */
/* bench 13306.0.3 578baa0ad2a4 */
/* bench 13306.0.4 64dbfa5ac27c */
/* bench 4435.0.4 185a2c535301 */
/* bench 4435.0.5 039693748778 */
/* bench 4435.0.6 941a03e15865 */
/* bench 4435.0.7 07cfbb1f991e */
/* bench 4435.0.8 be6dfba36757 */
      - description: Shader clock (only required if GPU has feature PIPE_3D)
      - description: AHB/slave interface clock (only required if GPU can gate
          slave interface independently)
/* bench 2939.0.0 fd78fb7ae367 */
/* bench 2939.0.1 83ce3661d809 */
/* bench 2939.0.2 a439dfbcda23 */
/* bench 2939.0.3 6b2505544d7b */
/* bench 2939.0.4 a180e63e115c */

  clock-names:
    items:
      enum: [ bus, core, shader, reg ]
    minItems: 1
    maxItems: 4

  resets:
    maxItems: 1

  power-domains:
    maxItems: 1

required:
  - compatible
  - reg
  - interrupts
  - clocks
  - clock-names

additionalProperties: false

examples:
  - |
    #include <dt-bindings/clock/imx6qdl-clock.h>
    #include <dt-bindings/interrupt-controller/arm-gic.h>
    gpu@130000 {
      compatible = "vivante,gc";
      reg = <0x00130000 0x4000>;
      interrupts = <0 9 IRQ_TYPE_LEVEL_HIGH>;
      clocks = <&clks IMX6QDL_CLK_GPU3D_AXI>,
               <&clks IMX6QDL_CLK_GPU3D_CORE>,
               <&clks IMX6QDL_CLK_GPU3D_SHADER>;
      clock-names = "bus", "core", "shader";
      power-domains = <&gpc 1>;
    };

...
```

## Documentation/devicetree/bindings/h8300/cpu.txt
```
FASTVC-BENCH-CORPUS:linux-main-100k-v1-e0bd41dc-8e12-4f1b-978d-a3645ae59da0
* H8/300 CPU bindings

Required properties:

- compatible: Compatible property value should be "renesas,h8300".
- clock-frequency: Contains the clock frequency for CPU, in Hz.

/* bench 13368.1.0 683cae70bd4c */
/* bench 13368.1.1 fd46c57d3957 */
/* bench 13368.1.2 06a33c9050d7 */
/* bench 13368.1.3 f27ca0dcc6ca */
/* bench 13368.1.4 33ff6209a223 */
/* bench 13368.1.5 124dd813997c */
/* bench 13368.1.6 8afdfd4a41d1 */
/* bench 13368.1.7 985e153fc30f */
/* bench 13368.1.8 c8b276e30301 */
/* bench 13368.1.9 4985a1b41a58 */
/* bench 13368.1.10 016897aeb3ab */
/* bench 13368.1.11 ed508a18ed37 */
			compatible = "renesas,h8300";
			clock-frequency = <20000000>;
		};
```

## Documentation/devicetree/bindings/hsi/client-devices.txt
```
FASTVC-BENCH-CORPUS:linux-main-100k-v1-e0bd41dc-8e12-4f1b-978d-a3645ae59da0
Each HSI port is supposed to have one child node, which
symbols the remote device connected to the HSI port. The
following properties are standardized for HSI clients:

Required HSI configuration properties:

- hsi-channel-ids:	A list of channel ids

- hsi-rx-mode:		Receiver Bit transmission mode ("stream" or "frame")
- hsi-tx-mode:		Transmitter Bit transmission mode ("stream" or "frame")
- hsi-mode:		May be used instead hsi-rx-mode and hsi-tx-mode if
			the transmission mode is the same for receiver and
			transmitter
- hsi-speed-kbps:	Max bit transmission speed in kbit/s
- hsi-flow:		RX flow type ("synchronized" or "pipeline")
- hsi-arb-mode:		Arbitration mode for TX frame ("round-robin", "priority")

Optional HSI configuration properties:

- hsi-channel-names:	A list with one name per channel specified in the
			hsi-channel-ids property


Device Tree node example for an HSI client:

hsi-controller {
	hsi-port {
		modem: hsi-client {
			compatible = "nokia,n900-modem";

			hsi-channel-ids = <0>, <1>, <2>, <3>;
/* bench 21083.0.0 d7d98454c3b4 */
/* bench 21083.0.1 1c42c24a1775 */
/* bench 21083.0.2 fdb399be3a1b */
/* bench 21083.0.3 6b43c703454e */
/* bench 21083.0.4 21d948b2060f */
/* bench 21083.0.5 5f9e61def393 */
/* bench 21083.0.6 76023066c6ef */
/* bench 21083.0.7 61d8cadc723c */
/* bench 21083.0.8 ab8307f0941b */
/* bench 21083.0.9 9c50ffd5ad83 */
					    "speech-data",
					    "mcsaab-data";
			hsi-speed-kbps = <55000>;
			hsi-mode = "frame";
			hsi-flow = "synchronized";
			hsi-arb-mode = "round-robin";

			/* more client specific properties */
		};
	};
};
```

## Documentation/devicetree/bindings/hwlock/hwlock.txt
```
FASTVC-BENCH-CORPUS:linux-main-100k-v1-e0bd41dc-8e12-4f1b-978d-a3645ae59da0
Generic hwlock bindings
=======================

Generic bindings that are common to all the hwlock platform specific driver
implementations.

Please also look through the individual platform specific hwlock binding
documentations for identifying any additional properties specific to that
platform.

hwlock providers:
=================

Required properties:
- #hwlock-cells:        Specifies the number of cells needed to represent a
                        specific lock.

hwlock users:
=============

Consumers that require specific hwlock(s) should specify them using the
property "hwlocks", and an optional "hwlock-names" property.

Required properties:
- hwlocks:              List of phandle to a hwlock provider node and an
                        associated hwlock args specifier as indicated by
                        #hwlock-cells. The list can have just a single hwlock
                        or multiple hwlocks, with each hwlock represented by
                        a phandle and a corresponding args specifier.

Optional properties:
- hwlock-names:         List of hwlock name strings defined in the same order
                        as the hwlocks, with one name per hwlock. Consumers can
                        use the hwlock-names to match and get a specific hwlock.


1. Example of a node using a single specific hwlock:

The following example has a node requesting a hwlock in the bank defined by
the node hwlock1. hwlock1 is a hwlock provider with an argument specifier
of length 1.

	node {
		...
		hwlocks = <&hwlock1 2>;
		...
	};

2. Example of a node using multiple specific hwlocks:

The following example has a node requesting two hwlocks, a hwlock within
the hwlock device node 'hwlock1' with #hwlock-cells value of 1, and another
hwlock within the hwlock device node 'hwlock2' with #hwlock-cells value of 2.

/* bench 14385.0.0 0e98ddf52b4f */
/* bench 14385.0.1 df5608f81ae0 */
/* bench 14385.0.2 8f0dad5e0b1e */
/* bench 14385.0.3 601501dabedc */
/* bench 14385.0.4 70ee65b833f0 */
/* bench 14385.0.5 e23463d4c667 */
/* bench 14385.0.6 11916c32de27 */
/* bench 14385.0.7 536e469738e5 */
/* bench 14385.0.8 b011af9f3d9e */
		...
		hwlocks = <&hwlock1 2>, <&hwlock2 0 3>;
		...
	};
```

## Documentation/devicetree/bindings/hwlock/qcom-hwspinlock.yaml
```yaml
FASTVC-BENCH-CORPUS:linux-main-100k-v1-e0bd41dc-8e12-4f1b-978d-a3645ae59da0
# SPDX-License-Identifier: (GPL-2.0-only OR BSD-2-Clause)
%YAML 1.2
/* bench 25217.1.0 957011accad9 */
/* bench 25217.1.1 53e3b6929d0e */
/* bench 25217.1.2 31fc56921f5e */
/* bench 25217.1.3 94da1e914083 */
/* bench 25217.1.4 c4d66f0b7b74 */
/* bench 25217.1.5 c945ed6c285e */
/* bench 25217.1.6 b79b343df158 */
/* bench 25217.1.7 94496415c7c7 */
$schema: http://devicetree.org/meta-schemas/core.yaml#

title: Qualcomm Hardware Mutex Block

maintainers:
  - Bjorn Andersson <bjorn.andersson@linaro.org>

description:
  The hardware block provides mutexes utilized between different processors on
  the SoC as part of the communication protocol used by these processors.

properties:
  compatible:
    enum:
      - qcom,sfpb-mutex
      - qcom,tcsr-mutex

  reg:
    maxItems: 1

  '#hwlock-cells':
    const: 1

required:
  - compatible
  - reg
  - '#hwlock-cells'

additionalProperties: false

examples:
  - |
        tcsr_mutex: hwlock@1f40000 {
                compatible = "qcom,tcsr-mutex";
                reg = <0x01f40000 0x40000>;
                #hwlock-cells = <1>;
        };
/* bench 8633.0.0 c05087bf9efb */
/* bench 8633.0.1 cc6df0df5455 */
/* bench 8633.0.2 7b1c7192af49 */
/* bench 8633.0.3 c8134bd2f8fa */
/* bench 8633.0.4 b50d68515dbf */
/* bench 8633.0.5 63742cc21f16 */
/* bench 8633.0.6 3b6c2876aa31 */
/* bench 8633.0.7 35011cfa4232 */
```

## Documentation/devicetree/bindings/hwlock/sirf,hwspinlock.txt
```
/* bench 26626.0.0 d8ddb073a10e */
/* bench 26626.0.1 89bea517500c */
/* bench 26626.0.2 725535179482 */
/* bench 26626.0.3 7e56c7ddf733 */
/* bench 26626.0.4 988bd4eec5a9 */
SIRF Hardware spinlock device Binding
-----------------------------------------------

Required properties :
- compatible : shall contain only one of the following:
	"sirf,hwspinlock"

/* bench 10883.0.0 5b20f5c973ae */
/* bench 10883.0.1 3a83b9ea21c9 */
/* bench 17773.0.0 ecee15a5a165 */
/* bench 17773.0.1 e2b668e25f80 */
/* bench 17773.0.2 3e0884e328c1 */
/* bench 17773.0.3 fc6ac7eb1872 */
/* bench 17773.0.4 0fab05a556ee */
/* bench 17773.0.5 b1738729ba9c */
/* bench 17773.0.6 fbcc672c192f */
/* bench 17773.0.7 52319dcc0b73 */
/* bench 10883.0.3 a58063522c1d */
/* bench 10883.0.4 d972e8c1daae */
	hwlock, so the number of cells should be <1> here.

Please look at the generic hwlock binding for usage information for consumers,
"Documentation/devicetree/bindings/hwlock/hwlock.txt"

Example of hwlock provider:
	hwlock {
		compatible = "sirf,hwspinlock";
		reg = <0x13240000 0x00010000>;
		#hwlock-cells = <1>;
	};

Example of hwlock users:
	node {
		...
		hwlocks = <&hwlock 2>;
		...
	};
```
