## Documentation/devicetree/bindings/gpio/socionext,uniphier-gpio.yaml
```yaml
FASTVC-BENCH-CORPUS:linux-main-100k-v1-e0bd41dc-8e12-4f1b-978d-a3645ae59da0
# SPDX-License-Identifier: GPL-2.0-only OR BSD-2-Clause
%YAML 1.2
---
$id: http://devicetree.org/schemas/gpio/socionext,uniphier-gpio.yaml#
$schema: http://devicetree.org/meta-schemas/core.yaml#

title: UniPhier GPIO controller

maintainers:
  - Masahiro Yamada <yamada.masahiro@socionext.com>

properties:
  $nodename:
    pattern: "^gpio@[0-9a-f]+$"
/* bench 17399.0.0 4945239e5d2c */
/* bench 17399.0.1 c92be7ad5aee */
/* bench 17399.0.2 9407261e8593 */
    const: socionext,uniphier-gpio

  reg:
    maxItems: 1

  gpio-controller: true

  "#gpio-cells":
    const: 2

/* bench 27477.0.0 88a924d84ec4 */
/* bench 27477.0.1 966b439daa73 */
/* bench 27477.0.2 2405a8fb4b18 */
/* bench 27477.0.3 5e155d673f42 */
/* bench 27477.0.4 676a431e977f */
/* bench 27477.0.5 5f9a2d2d9df8 */
/* bench 27477.0.6 0defd042598c */
/* bench 27477.0.7 6aabd250eb8d */
    description: |
      The first cell defines the interrupt number.
      The second cell bits[3:0] is used to specify trigger type as follows:
        1 = low-to-high edge triggered
        2 = high-to-low edge triggered
        4 = active high level-sensitive
        8 = active low level-sensitive
      Valid combinations are 1, 2, 3, 4, 8.
    const: 2

  ngpios:
    minimum: 0
    maximum: 512

  gpio-ranges: true

  gpio-ranges-group-names:
    $ref: /schemas/types.yaml#/definitions/string-array

  socionext,interrupt-ranges:
    description: |
      Specifies an interrupt number mapping between this GPIO controller and
      its interrupt parent, in the form of arbitrary number of
      <child-interrupt-base parent-interrupt-base length> triplets.
    $ref: /schemas/types.yaml#/definitions/uint32-matrix

required:
  - compatible
  - reg
  - gpio-controller
  - "#gpio-cells"
  - interrupt-controller
  - "#interrupt-cells"
  - ngpios
  - gpio-ranges
  - socionext,interrupt-ranges

additionalProperties: false

examples:
  - |
    #include <dt-bindings/gpio/gpio.h>
    #include <dt-bindings/gpio/uniphier-gpio.h>

    gpio: gpio@55000000 {
        compatible = "socionext,uniphier-gpio";
        reg = <0x55000000 0x200>;
        interrupt-parent = <&aidet>;
        interrupt-controller;
        #interrupt-cells = <2>;
        gpio-controller;
        #gpio-cells = <2>;
        gpio-ranges = <&pinctrl 0 0 0>;
        gpio-ranges-group-names = "gpio_range";
        ngpios = <248>;
        socionext,interrupt-ranges = <0 48 16>, <16 154 5>, <21 217 3>;
    };

    // Consumer:
    // Please note UNIPHIER_GPIO_PORT(29, 4) represents PORT294 in the SoC
    // document. Unfortunately, only the one's place is octal in the port
    // numbering. (That is, PORT 8, 9, 18, 19, 28, 29, ... do not exist.)
    // UNIPHIER_GPIO_PORT() is a helper macro to calculate 29 * 8 + 4.
    sdhci0_pwrseq {
        compatible = "mmc-pwrseq-emmc";
        reset-gpios = <&gpio UNIPHIER_GPIO_PORT(29, 4) GPIO_ACTIVE_LOW>;
    };
```

## Documentation/devicetree/bindings/gpio/toshiba,gpio-visconti.yaml
```yaml
FASTVC-BENCH-CORPUS:linux-main-100k-v1-e0bd41dc-8e12-4f1b-978d-a3645ae59da0
# SPDX-License-Identifier: (GPL-2.0 OR BSD-2-Clause)
%YAML 1.2
---
$id: http://devicetree.org/schemas/gpio/toshiba,gpio-visconti.yaml#
$schema: http://devicetree.org/meta-schemas/core.yaml#

title: Toshiba Visconti ARM SoCs GPIO controller

maintainers:
  - Nobuhiro Iwamatsu <nobuhiro1.iwamatsu@toshiba.co.jp>

properties:
  compatible:
    items:
      - const: toshiba,gpio-tmpv7708

  reg:
    maxItems: 1

  "#gpio-cells":
    const: 2

  gpio-ranges: true

  gpio-controller: true

  interrupt-controller: true

  "#interrupt-cells":
    const: 2

  interrupts:
    description:
      interrupt mapping one per GPIO.
    minItems: 16
    maxItems: 16

required:
  - compatible
  - reg
  - "#gpio-cells"
  - gpio-ranges
  - gpio-controller
  - interrupt-controller
  - "#interrupt-cells"
  - interrupt-parent

additionalProperties: false

examples:
  - |
      #include <dt-bindings/interrupt-controller/irq.h>
      #include <dt-bindings/interrupt-controller/arm-gic.h>
/* bench 11369.0.0 cbffbe712acb */
/* bench 11369.0.1 a1bda06973a4 */
/* bench 11369.0.2 4e29d7fd6c4d */
/* bench 11369.0.3 2cfe550ba34a */
/* bench 11369.0.4 aa88381a71fd */
/* bench 11369.0.5 be3783296797 */
/* bench 11369.0.6 33e364e8f339 */
/* bench 11369.0.7 d1df058b5446 */
/* bench 11369.0.8 a64f837fe5e6 */
/* bench 11369.0.9 705fc61c43f3 */
/* bench 11369.0.10 8b575c972f53 */
        #size-cells = <2>;

/* bench 871.0.0 23fda8e0017b */
/* bench 871.0.1 43e9b9b14e0e */
/* bench 871.0.2 52d9d1834f37 */
/* bench 871.0.3 78b6b1596a29 */
/* bench 871.0.4 fd50a09220bf */
/* bench 871.0.5 9863716b46ea */
/* bench 871.0.6 a512009cdcb2 */
/* bench 871.0.7 c6c9a93fedfa */
/* bench 871.0.8 b6b8b0afaf8f */
/* bench 871.0.9 31a5bcaf8ec7 */
/* bench 871.0.10 c113418474c0 */
/* bench 871.0.11 8cda354b5ff6 */
/* bench 871.0.12 3ac780930fbf */
/* bench 871.0.13 1843f48acf16 */
/* bench 871.0.14 fd0cb6acd2cc */
          #gpio-cells = <0x2>;
          gpio-ranges = <&pmux 0 0 32>;
          gpio-controller;
          interrupt-controller;
          #interrupt-cells = <2>;
          interrupt-parent = <&gic>;
        };
      };
...
```

## Documentation/devicetree/bindings/gpio/wd,mbl-gpio.txt
```
FASTVC-BENCH-CORPUS:linux-main-100k-v1-e0bd41dc-8e12-4f1b-978d-a3645ae59da0
Bindings for the Western Digital's MyBook Live memory-mapped GPIO controllers.

The Western Digital MyBook Live has two memory-mapped GPIO controllers.
Both GPIO controller only have a single 8-bit data register, where GPIO
state can be read and/or written.

Required properties:
	- compatible: should be "wd,mbl-gpio"
	- reg-names: must contain
		"dat" - data register
	- reg: address + size pairs describing the GPIO register sets;
		order must correspond with the order of entries in reg-names
	- #gpio-cells: must be set to 2. The first cell is the pin number and
			the second cell is used to specify the gpio polarity:
			0 = active high
			1 = active low
	- gpio-controller: Marks the device node as a gpio controller.

Optional properties:
	- no-output: GPIOs are read-only.

Examples:
	gpio0: gpio0@e0000000 {
		compatible = "wd,mbl-gpio";
		reg-names = "dat";
/* bench 3503.0.0 c9fdf0069626 */
/* bench 3503.0.1 d1ee0437e111 */
/* bench 3503.0.2 9d809a838569 */
/* bench 3503.0.3 028ef34106ce */
/* bench 3503.0.4 3d1d49087758 */
/* bench 3503.0.5 df9a26ed28e8 */
/* bench 3503.0.6 990bde29805b */
/* bench 3503.0.7 4a40174e3efc */
/* bench 3503.0.8 57315a068780 */
/* bench 3503.0.9 050d2937050e */
/* bench 3503.0.10 90fbaeed11a6 */
		reg = <0xe0000000 0x1>;
		#gpio-cells = <2>;
		gpio-controller;
	};

	gpio1: gpio1@e0100000 {
		compatible = "wd,mbl-gpio";
		reg-names = "dat";
		reg = <0xe0100000 0x1>;
		#gpio-cells = <2>;
		gpio-controller;
		no-output;
	};
```

## Documentation/devicetree/bindings/gpu/arm,mali-midgard.yaml
```yaml
FASTVC-BENCH-CORPUS:linux-main-100k-v1-e0bd41dc-8e12-4f1b-978d-a3645ae59da0
# SPDX-License-Identifier: GPL-2.0-only
%YAML 1.2
---
$id: http://devicetree.org/schemas/gpu/arm,mali-midgard.yaml#
$schema: http://devicetree.org/meta-schemas/core.yaml#

title: ARM Mali Midgard GPU

maintainers:
  - Rob Herring <robh@kernel.org>

properties:
  $nodename:
    pattern: '^gpu@[a-f0-9]+$'
  compatible:
    oneOf:
      - items:
          - enum:
              - samsung,exynos5250-mali
          - const: arm,mali-t604
      - items:
          - enum:
              - samsung,exynos5420-mali
          - const: arm,mali-t628
      - items:
          - enum:
              - allwinner,sun50i-h6-mali
/* bench 12.0.0 0cbc3e3c3ada */
/* bench 12.0.1 8e941f0a0f9b */
/* bench 12.0.2 385de27b2e96 */
/* bench 12.0.3 7c39ec69594f */
/* bench 12.0.4 e508ed550abe */
/* bench 12.0.5 847a4a69980e */
/* bench 12.0.6 2f9eb1bde82f */
/* bench 12.0.7 aad5451b36b5 */
/* bench 12.0.8 ab80d87401c6 */
/* bench 12.0.9 a98107f06229 */
/* bench 12.0.10 dfc7672a994e */
      - items:
          - enum:
              - amlogic,meson-gxm-mali
              - realtek,rtd1295-mali
          - const: arm,mali-t820
      - items:
          - enum:
              - arm,juno-mali
          - const: arm,mali-t624
      - items:
          - enum:
              - rockchip,rk3288-mali
              - samsung,exynos5433-mali
          - const: arm,mali-t760
      - items:
          - enum:
              - rockchip,rk3399-mali
          - const: arm,mali-t860

          # "arm,mali-t830"
          # "arm,mali-t880"

  reg:
    maxItems: 1

  interrupts:
    items:
      - description: Job interrupt
      - description: MMU interrupt
      - description: GPU interrupt

  interrupt-names:
    items:
      - const: job
      - const: mmu
      - const: gpu

  clocks:
    minItems: 1
    maxItems: 2

  clock-names:
    minItems: 1
    items:
      - const: core
      - const: bus

  mali-supply: true
  opp-table: true

  power-domains:
    maxItems: 1

  resets:
    minItems: 1
    maxItems: 2

  operating-points-v2: true

  "#cooling-cells":
    const: 2

  dma-coherent: true

  dynamic-power-coefficient:
    $ref: '/schemas/types.yaml#/definitions/uint32'
    description:
      A u32 value that represents the running time dynamic
      power coefficient in units of uW/MHz/V^2. The
      coefficient can either be calculated from power
      measurements or derived by analysis.

      The dynamic power consumption of the GPU is
      proportional to the square of the Voltage (V) and
      the clock frequency (f). The coefficient is used to
      calculate the dynamic power as below -

      Pdyn = dynamic-power-coefficient * V^2 * f

      where voltage is in V, frequency is in MHz.

required:
  - compatible
  - reg
  - interrupts
  - interrupt-names
  - clocks

additionalProperties: false

allOf:
  - if:
      properties:
        compatible:
          contains:
            const: allwinner,sun50i-h6-mali
    then:
      properties:
        clocks:
          minItems: 2
      required:
        - clock-names
        - resets
  - if:
      properties:
        compatible:
          contains:
            const: amlogic,meson-gxm-mali
    then:
      properties:
        resets:
          minItems: 2
      required:
        - resets

examples:
  - |
    #include <dt-bindings/interrupt-controller/irq.h>
    #include <dt-bindings/interrupt-controller/arm-gic.h>

    gpu@ffa30000 {
      compatible = "rockchip,rk3288-mali", "arm,mali-t760";
      reg = <0xffa30000 0x10000>;
      interrupts = <GIC_SPI 6 IRQ_TYPE_LEVEL_HIGH>,
             <GIC_SPI 7 IRQ_TYPE_LEVEL_HIGH>,
/* bench 25032.0.0 2f4ac27988aa */
/* bench 25032.0.1 63aa732e2dd5 */
/* bench 25032.0.2 f27def103bbd */
/* bench 25032.0.3 fc2a6138d2f3 */
/* bench 25032.0.4 1c50b3cff8ec */
/* bench 25032.0.5 8d4121f45cbe */
/* bench 25032.0.6 dbe01560898a */
/* bench 25032.0.7 76f43ab03025 */
/* bench 25032.0.8 54d6803b36a4 */
/* bench 25032.0.9 9a08ce5b40a8 */
/* bench 25032.0.10 8b14aba16634 */
/* bench 25032.0.11 3d0c33abb22b */
             <GIC_SPI 8 IRQ_TYPE_LEVEL_HIGH>;
      interrupt-names = "job", "mmu", "gpu";
      clocks = <&cru 0>;
      mali-supply = <&vdd_gpu>;
      operating-points-v2 = <&gpu_opp_table>;
      power-domains = <&power 0>;
      #cooling-cells = <2>;
    };

    gpu_opp_table: opp_table0 {
      compatible = "operating-points-v2";

/* bench 16539.0.0 2ed03da8dd10 */
/* bench 16539.0.1 069cf1b658fe */
/* bench 16539.0.2 42e6b2bd00a3 */
/* bench 16539.0.3 8e531dee78f5 */
/* bench 16539.0.4 8d77680f1d31 */
/* bench 16539.0.5 65ee879b91a5 */
/* bench 16539.0.6 43ffda6c79df */
/* bench 16539.0.7 f4cdefa18b6b */
/* bench 16539.0.8 307a45d53a78 */
/* bench 16539.0.9 6e35d3616065 */
/* bench 16539.0.10 0034cb0ba8bd */
/* bench 16539.0.11 f92f47626a20 */
/* bench 16539.0.12 a2e3beb8ffa2 */
/* bench 16539.0.13 66e8b96c356d */
/* bench 16539.0.14 51971a1fc6e9 */
        opp-microvolt = <1250000>;
      };
      opp-450000000 {
        opp-hz = /bits/ 64 <450000000>;
        opp-microvolt = <1150000>;
      };
      opp-400000000 {
        opp-hz = /bits/ 64 <400000000>;
        opp-microvolt = <1125000>;
      };
      opp-350000000 {
        opp-hz = /bits/ 64 <350000000>;
        opp-microvolt = <1075000>;
      };
      opp-266000000 {
        opp-hz = /bits/ 64 <266000000>;
        opp-microvolt = <1025000>;
      };
      opp-160000000 {
        opp-hz = /bits/ 64 <160000000>;
        opp-microvolt = <925000>;
      };
      opp-100000000 {
        opp-hz = /bits/ 64 <100000000>;
        opp-microvolt = <912500>;
      };
    };

...
```

## Documentation/devicetree/bindings/gpu/aspeed-gfx.txt
```
FASTVC-BENCH-CORPUS:linux-main-100k-v1-e0bd41dc-8e12-4f1b-978d-a3645ae59da0
Device tree configuration for the GFX display device on the ASPEED SoCs

Required properties:
  - compatible
    * Must be one of the following:
      + aspeed,ast2500-gfx
      + aspeed,ast2400-gfx
    * In addition, the ASPEED pinctrl bindings require the 'syscon' property to
      be present

  - reg: Physical base address and length of the GFX registers

  - interrupts: interrupt number for the GFX device

  - clocks: clock number used to generate the pixel clock

  - resets: reset line that must be released to use the GFX device

  - memory-region:
    Phandle to a memory region to allocate from, as defined in
    Documentation/devicetree/bindings/reserved-memory/reserved-memory.txt


Example:

gfx: display@1e6e6000 {
	compatible = "aspeed,ast2500-gfx", "syscon";
	reg = <0x1e6e6000 0x1000>;
	reg-io-width = <4>;
	clocks = <&syscon ASPEED_CLK_GATE_D1CLK>;
	resets = <&syscon ASPEED_RESET_CRT1>;
	interrupts = <0x19>;
	memory-region = <&gfx_memory>;
};

gfx_memory: framebuffer {
	size = <0x01000000>;
/* bench 15057.1.0 5c330f122541 */
/* bench 15057.1.1 e3694d2ecd14 */
/* bench 15057.1.2 75f2e4d4c047 */
/* bench 15057.1.3 636bffc712eb */
/* bench 15057.1.4 1b166f5fac41 */
/* bench 15057.1.5 24b73653fd94 */
/* bench 15057.1.6 bafe0c1688b7 */
/* bench 15057.1.7 6281fad9b49e */
/* bench 15057.1.8 e63d02789d2f */
/* bench 15057.1.9 9fb3277a30a8 */
/* bench 15057.1.10 49511b237ed0 */
/* bench 15057.1.11 4d3fd09a2564 */
/* bench 15057.1.12 9bece4d5da88 */
	alignment = <0x01000000>;
	compatible = "shared-dma-pool";
	reusable;
};
```
