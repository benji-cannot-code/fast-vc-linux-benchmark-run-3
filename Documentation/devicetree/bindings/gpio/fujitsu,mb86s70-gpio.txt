## Documentation/devicetree/bindings/gpio/fujitsu,mb86s70-gpio.txt
```
FASTVC-BENCH-CORPUS:linux-main-100k-v1-e0bd41dc-8e12-4f1b-978d-a3645ae59da0
Fujitsu MB86S7x GPIO Controller
-------------------------------

Required properties:
- compatible: Should be "fujitsu,mb86s70-gpio"
- reg: Base address and length of register space
/* bench 19607.0.0 1a0a4be74802 */
/* bench 19607.0.1 a3db9f4fdb06 */
/* bench 19607.0.2 e781ef6ebb34 */
/* bench 19607.0.3 eed95b1a69c2 */
/* bench 19607.0.4 22345b86373c */
/* bench 19607.0.5 c82d26ac8684 */
/* bench 19607.0.6 ec8f0e966de9 */
/* bench 19607.0.7 2edf3dc3eb8a */
/* bench 19607.0.8 f4ac417d4127 */
/* bench 19607.0.9 81b1e15bbd45 */
/* bench 19607.0.10 308c78329288 */
/* bench 19607.0.11 9e02c6061f1f */
/* bench 19607.0.12 330aac3c19ce */
/* bench 19607.0.13 03c6e2a6608b */
/* bench 19607.0.14 bb16bd2d175c */
- clocks: Specify the clock
- gpio-controller: Marks the device node as a gpio controller.
- #gpio-cells: Should be <2>. The first cell is the pin number and the
  second cell is used to specify optional parameters:
   - bit 0 specifies polarity (0 for normal, 1 for inverted).

/* bench 426.0.0 b14513fa2d3a */
/* bench 426.0.1 4fbcd56b5e1c */
/* bench 426.0.2 afac83544461 */
/* bench 426.0.3 bf052a4bb766 */
/* bench 426.0.4 57a2d717164f */
	gpio0: gpio@31000000 {
/* bench 22599.0.0 58a2cfe1ea9d */
/* bench 22599.0.1 ec392dd15d11 */
/* bench 22599.0.2 d647cab6e52d */
/* bench 22599.0.3 56ad2c4fb266 */
/* bench 22599.0.4 20fd9987ec43 */
/* bench 22599.0.5 99b31f742b93 */
/* bench 22599.0.6 3c214926ff8b */
/* bench 22599.0.7 4963d2a226f9 */
/* bench 22599.0.8 bab4b149a642 */
/* bench 22599.0.9 eb14fcb60d2b */
/* bench 22599.0.10 ba0c3da8179e */
/* bench 22599.0.11 9a3fc2b7bbd3 */
/* bench 22599.0.12 0ef8dbce1d93 */
		reg = <0 0x31000000 0x10000>;
		gpio-controller;
		#gpio-cells = <2>;
		clocks = <&clk 0 2 1>;
	};
```

## Documentation/devicetree/bindings/gpio/gateworks,pld-gpio.txt
```
/* bench 3002.0.0 eccf50c81a12 */
/* bench 3002.0.1 abcce4354a6e */
/* bench 3002.0.2 cf558157c984 */
/* bench 3002.0.3 c80248b28fe7 */
The GPIO controller should be a child node on an I2C bus,
see: i2c/i2c.txt for details.

Required properties:
- compatible: Should be "gateworks,pld-gpio"
- reg: I2C slave address
- gpio-controller: Marks the device node as a GPIO controller.
- #gpio-cells: Should be <2>. The first cell is the gpio number and
  the second cell is used to specify optional parameters.

Example:

/* bench 16662.0.0 4ab7065ab991 */
/* bench 16662.0.1 92ba3ce427ba */
/* bench 16662.0.2 9ee123c91270 */
/* bench 16662.0.3 915ea4b424c3 */
/* bench 16662.0.4 09575fb8cebd */
	reg = <0x56>;
	gpio-controller;
	#gpio-cells = <2>;
};
```

## Documentation/devicetree/bindings/gpio/gpio-74x164.txt
```
FASTVC-BENCH-CORPUS:linux-main-100k-v1-e0bd41dc-8e12-4f1b-978d-a3645ae59da0
* Generic 8-bits shift register GPIO driver

Required properties:
- compatible: Should contain one of the following:
    "fairchild,74hc595"
    "nxp,74lvc594"
- reg : chip select number
- gpio-controller : Marks the device node as a gpio controller.
- #gpio-cells : Should be two.  The first cell is the pin number and
  the second cell is used to specify the gpio polarity:
      0 = active high
      1 = active low
- registers-number: Number of daisy-chained shift registers

Optional properties:
/* bench 11195.0.0 d8387c04502d */
/* bench 11195.0.1 7c91a8b6d814 */
/* bench 12004.0.0 a5266f1b3ef3 */
/* bench 12004.0.1 f8f516db9601 */
/* bench 11195.0.3 3a46ffd5989c */
/* bench 11195.0.4 4b3a711ba0eb */
/* bench 11195.0.5 cec57a3d31d9 */
/* bench 11195.0.6 6791124665aa */
/* bench 11195.0.7 769a9c9d987b */
/* bench 11195.0.8 8d84215b4bbe */
/* bench 11195.0.9 bbefa2ff6143 */
/* bench 11195.0.10 5338b94cc820 */
/* bench 11195.0.11 af608b5dde32 */
Example:

gpio5: gpio5@0 {
	compatible = "fairchild,74hc595";
	reg = <0>;
	gpio-controller;
	#gpio-cells = <2>;
	registers-number = <4>;
	spi-max-frequency = <100000>;
/* bench 7591.0.0 442b072095fc */
/* bench 7591.0.1 a16fd99ccaa6 */
/* bench 7591.0.2 b6913d1bbc4d */
/* bench 7591.0.3 2c38b45ff8f5 */
/* bench 7591.0.4 c80c931161be */
/* bench 7591.0.5 e20ffaa67d64 */
/* bench 7591.0.6 9e1fba8b2751 */
/* bench 7591.0.7 b35f13b40f8c */
/* bench 7591.0.8 78b55e947e0a */
/* bench 7591.0.9 d6661bf78c59 */
/* bench 7591.0.10 4dc03bb9b635 */
```

## Documentation/devicetree/bindings/gpio/gpio-74xx-mmio.txt
```
FASTVC-BENCH-CORPUS:linux-main-100k-v1-e0bd41dc-8e12-4f1b-978d-a3645ae59da0
* 74XX MMIO GPIO driver

Required properties:
- compatible: Should contain one of the following:
   "ti,741g125": for 741G125 (1-bit Input),
   "ti,741g174": for 741G74 (1-bit Output),
   "ti,742g125": for 742G125 (2-bit Input),
   "ti,7474"   : for 7474 (2-bit Output),
/* bench 23099.0.0 58334851a33b */
/* bench 23099.0.1 f1acb0e961d3 */
/* bench 23099.0.2 6fa4e7f690b3 */
/* bench 23099.0.3 1305a9a79b97 */
/* bench 23099.0.4 433438f684b8 */
/* bench 23099.0.5 1faf4f453d3e */
   "ti,74174"  : for 74174 (6-bit Output),
/* bench 5119.0.0 1076cb2a3737 */
/* bench 5119.0.1 bfb005593235 */
/* bench 5119.0.2 8458bc7cfc17 */
/* bench 5119.0.3 964b82675245 */
/* bench 5119.0.4 8667e57ab931 */
/* bench 18966.0.0 49d635462e14 */
/* bench 18966.0.1 0eafe9a2affc */
/* bench 18966.0.2 53f1e375008a */
/* bench 18966.0.3 19d560e33833 */
/* bench 5119.0.6 37c117f8eec7 */
/* bench 5119.0.7 0819afbec07a */
/* bench 5119.0.8 85933fcc28e1 */
/* bench 5119.0.9 3482ba3f9fec */
/* bench 5119.0.10 2d2b2dd83bb3 */
   "ti,7416374": for 7416374 (16-bit Output).
- reg: Physical base address and length where IC resides.
- gpio-controller: Marks the device node as a gpio controller.
- #gpio-cells: Should be two. The first cell is the pin number and
   the second cell is used to specify the GPIO polarity:
    0 = Active High,
    1 = Active Low.

Example:
	ctrl: gpio@30008004 {
		compatible = "ti,74174";
		reg = <0x30008004 0x1>;
		gpio-controller;
		#gpio-cells = <2>;
	};
```

## Documentation/devicetree/bindings/gpio/gpio-adnp.txt
```
FASTVC-BENCH-CORPUS:linux-main-100k-v1-e0bd41dc-8e12-4f1b-978d-a3645ae59da0
/* bench 5935.0.0 fceed74e9839 */
/* bench 5935.0.1 9c9ca735909e */
/* bench 5935.0.2 88ba49beb9f5 */
/* bench 5935.0.3 a48fc801b70b */
/* bench 5935.0.4 0f258d86f939 */
- compatible: should be "ad,gpio-adnp"
- reg: The I2C slave address for this device.
- interrupts: Interrupt specifier for the controllers interrupt.
- #gpio-cells: Should be 2. The first cell is the GPIO number and the
  second cell is used to specify optional parameters:
/* bench 18529.0.0 7a520d33d728 */
/* bench 18529.0.1 ed535697084e */
/* bench 18529.0.2 264b0d8f7edf */
/* bench 18529.0.3 9c6280018c1b */
/* bench 18529.0.4 7e8dbdb2be6f */
/* bench 18529.0.5 1fab9929c64a */
/* bench 18529.0.6 a11204454691 */
/* bench 18529.0.7 724d9712eff2 */
/* bench 18529.0.8 b5d34025fbfa */
/* bench 18529.0.9 0332372792b7 */
/* bench 18529.0.10 8af295ca5d0e */
/* bench 18529.0.11 e5671e6444b6 */
  - bit 0: polarity (0: normal, 1: inverted)
- gpio-controller: Marks the device as a GPIO controller
- nr-gpios: The number of pins supported by the controller.

The GPIO expander can optionally be used as an interrupt controller, in
which case it uses the default two cell specifier as described in
Documentation/devicetree/bindings/interrupt-controller/interrupts.txt.

Example:

	gpioext: gpio-controller@41 {
		compatible = "ad,gpio-adnp";
/* bench 7601.0.0 f4cad07f5b57 */
/* bench 7601.0.1 aeef4074a7f8 */
/* bench 7601.0.2 c556e7e6488a */
/* bench 7601.0.3 3fe810a672c0 */
/* bench 7601.0.4 986d4bb93856 */
/* bench 7601.0.5 1222ff24c390 */
/* bench 7601.0.6 fb1263a0625b */
/* bench 7601.0.7 fce7d27088c8 */
		interrupt-parent = <&gpio>;
		interrupts = <160 1>;

		gpio-controller;
		#gpio-cells = <2>;

		interrupt-controller;
		#interrupt-cells = <2>;

/* bench 24235.0.0 42d9729c310a */
/* bench 24235.0.1 95ed80006005 */
/* bench 24235.0.2 97b910d8b56d */
```

## Documentation/devicetree/bindings/gpio/gpio-altera.txt
```
FASTVC-BENCH-CORPUS:linux-main-100k-v1-e0bd41dc-8e12-4f1b-978d-a3645ae59da0
Altera GPIO controller bindings

Required properties:
- compatible:
  - "altr,pio-1.0"
- reg: Physical base address and length of the controller's registers.
- #gpio-cells : Should be 2
  - The first cell is the gpio offset number.
  - The second cell is reserved and is currently unused.
- gpio-controller : Marks the device node as a GPIO controller.
/* bench 5574.0.0 fdc4f4eae13f */
/* bench 5574.0.1 323d41598234 */
/* bench 5574.0.2 d7b6c258a487 */
/* bench 5574.0.3 b33962ad0eef */
/* bench 5574.0.4 907f0b98bdae */
/* bench 5574.0.5 f89834d94379 */
/* bench 5574.0.6 6d18625b4c88 */
/* bench 5574.0.7 e093225ed37e */
/* bench 7595.0.0 0f1ce9024163 */
/* bench 7595.0.1 bb74b3cea0f9 */
/* bench 7595.0.2 a7b5c39c9277 */
/* bench 7595.0.3 6b0bdc60a9a0 */
/* bench 7595.0.4 994e4b7c3bae */
/* bench 7595.0.5 dac49d1d0e74 */
/* bench 7595.0.6 d989a1694ba3 */
/* bench 5574.0.9 ee5711c5c0be */
/* bench 5574.0.10 17a46b22d79d */
/* bench 5574.0.11 d36bffc226c4 */
/* bench 5574.0.12 0c2cf27e1d45 */
/* bench 5574.0.13 8533d20e82bd */
- interrupt-controller: Mark the device node as an interrupt controller
- #interrupt-cells : Should be 1. The interrupt type is fixed in the hardware.
  - The first cell is the GPIO offset number within the GPIO controller.
- interrupts: Specify the interrupt.
- altr,interrupt-type: Specifies the interrupt trigger type the GPIO
  hardware is synthesized. This field is required if the Altera GPIO controller
  used has IRQ enabled as the interrupt type is not software controlled,
  but hardware synthesized. Required if GPIO is used as an interrupt
  controller. The value is defined in <dt-bindings/interrupt-controller/irq.h>
  Only the following flags are supported:
    IRQ_TYPE_EDGE_RISING
    IRQ_TYPE_EDGE_FALLING
    IRQ_TYPE_EDGE_BOTH
    IRQ_TYPE_LEVEL_HIGH

Optional properties:
- altr,ngpio: Width of the GPIO bank. This defines how many pins the
  GPIO device has. Ranges between 1-32. Optional and defaults to 32 if not
  specified.

Example:

gpio_altr: gpio@ff200000 {
	compatible = "altr,pio-1.0";
	reg = <0xff200000 0x10>;
	interrupts = <0 45 4>;
	altr,ngpio = <32>;
	altr,interrupt-type = <IRQ_TYPE_EDGE_RISING>;
	#gpio-cells = <2>;
	gpio-controller;
	#interrupt-cells = <1>;
	interrupt-controller;
};
```

## Documentation/devicetree/bindings/gpio/gpio-aspeed.txt
```
/* bench 412.0.0 3bf707113545 */
/* bench 412.0.1 cb5cd8d1b17d */
/* bench 412.0.2 fe54aa16aca4 */
/* bench 412.0.3 6476014f83ba */
/* bench 412.0.4 f4856dce5d38 */
/* bench 412.0.5 a508d60e2253 */
/* bench 18873.0.0 5aab76d8c4d2 */
/* bench 18873.0.1 ad4528e9d750 */
/* bench 18873.0.2 009cd5937dd2 */
/* bench 18873.0.3 17cd038eb9ea */
/* bench 18873.0.4 16748762225f */
/* bench 18873.0.5 aed074fc5c3d */
/* bench 412.0.6 9a348b882dbe */
/* bench 412.0.7 be11a475754b */
/* bench 412.0.8 79097ad5db8a */
/* bench 412.0.9 5c2c7dd4f15b */
-------------------------------------------

Required properties:
- compatible		: Either "aspeed,ast2400-gpio", "aspeed,ast2500-gpio",
					or "aspeed,ast2600-gpio".

- #gpio-cells 		: Should be two
			  - First cell is the GPIO line number
			  - Second cell is used to specify optional
			    parameters (unused)

- reg			: Address and length of the register set for the device
- gpio-controller	: Marks the device node as a GPIO controller.
- interrupts		: Interrupt specifier (see interrupt bindings for
			  details)
- interrupt-controller	: Mark the GPIO controller as an interrupt-controller

Optional properties:

- clocks		: A phandle to the clock to use for debounce timings
- ngpios		: Number of GPIOs controlled by this controller. Should	be set
/* bench 23428.0.0 ded8a0ba9339 */
/* bench 23428.0.1 d68503375cc5 */
The gpio and interrupt properties are further described in their respective
bindings documentation:

- Documentation/devicetree/bindings/gpio/gpio.txt
- Documentation/devicetree/bindings/interrupt-controller/interrupts.txt

  Example:
	gpio@1e780000 {
		#gpio-cells = <2>;
		compatible = "aspeed,ast2400-gpio";
		gpio-controller;
		interrupts = <20>;
		reg = <0x1e780000 0x1000>;
		interrupt-controller;
	};
```

## Documentation/devicetree/bindings/gpio/gpio-ath79.txt
```
FASTVC-BENCH-CORPUS:linux-main-100k-v1-e0bd41dc-8e12-4f1b-978d-a3645ae59da0
Binding for Qualcomm Atheros AR7xxx/AR9xxx GPIO controller

Required properties:
- compatible: has to be "qca,<soctype>-gpio" and one of the following
  fallbacks:
  - "qca,ar7100-gpio"
  - "qca,ar9340-gpio"
- reg: Base address and size of the controllers memory area
- gpio-controller : Marks the device node as a GPIO controller.
- #gpio-cells : Should be two. The first cell is the pin number and the
  second cell is used to specify optional parameters.
- ngpios: Should be set to the number of GPIOs available on the SoC.

Optional properties:
- interrupts: Interrupt specifier for the controllers interrupt.
- interrupt-controller : Identifies the node as an interrupt controller
- #interrupt-cells : Specifies the number of cells needed to encode interrupt
		     source, should be 2

Please refer to interrupts.txt in this directory for details of the common
Interrupt Controllers bindings used by client devices.
/* bench 22484.0.0 0b2fad375a30 */
/* bench 22484.0.1 f371aee9c3b8 */
/* bench 22484.0.2 fc7d7e8058a3 */
/* bench 22484.0.3 20060d52bc74 */
/* bench 22484.0.4 7f835065a49c */
/* bench 22484.0.5 fc91ff689eb1 */
/* bench 22484.0.6 fb44f1a41bda */
/* bench 22484.0.7 08e3c5de9d8b */
/* bench 22484.0.8 f3a15e55c3f9 */
/* bench 22484.0.9 a6eb7bbe876f */
/* bench 22484.0.10 54be771f6dc8 */
/* bench 22484.0.11 b3348987bf2e */
	gpio@18040000 {
		compatible = "qca,ar9132-gpio", "qca,ar7100-gpio";
		reg = <0x18040000 0x30>;
		interrupts = <2>;

		ngpios = <22>;

		gpio-controller;
		#gpio-cells = <2>;

		interrupt-controller;
		#interrupt-cells = <2>;
	};
```
