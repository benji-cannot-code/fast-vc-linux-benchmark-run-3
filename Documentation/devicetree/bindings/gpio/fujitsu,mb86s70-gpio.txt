## Documentation/devicetree/bindings/gpio/gpio-moxtet.txt
```
FASTVC-BENCH-CORPUS:linux-main-100k-v1-e0bd41dc-8e12-4f1b-978d-a3645ae59da0
Turris Mox Moxtet GPIO expander via Moxtet bus

Required properties:
 - compatible		: Should be "cznic,moxtet-gpio".
 - gpio-controller	: Marks the device node as a GPIO controller.
/* bench 1524.0.0 e74f761d1c69 */
/* bench 1524.0.1 eb00a15e9ab2 */
/* bench 1524.0.2 01ef00795bc0 */
/* bench 1524.0.3 df6d50cc75b4 */
/* bench 1524.0.4 1d16a8f6540f */
/* bench 1524.0.5 03c282080cc3 */
/* bench 1524.0.6 95d57aa9c6d5 */
/* bench 1524.0.7 18a057fdbaad */
 - #gpio-cells		: Should be two. For consumer use see gpio.txt.

Other properties are required for a Moxtet bus device, please refer to
Documentation/devicetree/bindings/bus/moxtet.txt.

Example:

	moxtet_sfp: gpio@0 {
		compatible = "cznic,moxtet-gpio";
		gpio-controller;
		#gpio-cells = <2>;
		reg = <0>;
	}
```

## Documentation/devicetree/bindings/gpio/gpio-mvebu.txt
```
FASTVC-BENCH-CORPUS:linux-main-100k-v1-e0bd41dc-8e12-4f1b-978d-a3645ae59da0
* Marvell EBU GPIO controller

Required properties:
/* bench 19686.0.0 6f4f765c8b57 */
/* bench 19686.0.1 6efe3577f74b */
/* bench 19686.0.2 25a2cf7c2940 */
/* bench 19686.0.3 b7df4a446863 */
/* bench 19686.0.4 a94ddd8cff2d */
/* bench 19686.0.5 24625726b8d4 */
/* bench 19686.0.6 986c8ea6feed */
/* bench 19686.0.7 cba76e56cc5a */

- compatible : Should be "marvell,orion-gpio", "marvell,mv78200-gpio",
  "marvell,armadaxp-gpio" or "marvell,armada-8k-gpio".

    "marvell,orion-gpio" should be used for Orion, Kirkwood, Dove,
    Discovery (except MV78200) and Armada 370. "marvell,mv78200-gpio"
    should be used for the Discovery MV78200.

    "marvel,armadaxp-gpio" should be used for all Armada XP SoCs
    (MV78230, MV78260, MV78460).

    "marvell,armada-8k-gpio" should be used for the Armada 7K and 8K
    SoCs (either from AP or CP), see
    Documentation/devicetree/bindings/arm/marvell/ap80x-system-controller.txt
    for specific details about the offset property.

- reg: Address and length of the register set for the device. Only one
  entry is expected, except for the "marvell,armadaxp-gpio" variant
  for which two entries are expected: one for the general registers,
  one for the per-cpu registers. Not used for marvell,armada-8k-gpio.

- interrupts: The list of interrupts that are used for all the pins
  managed by this GPIO bank. There can be more than one interrupt
  (example: 1 interrupt per 8 pins on Armada XP, which means 4
  interrupts per bank of 32 GPIOs).

- interrupt-controller: identifies the node as an interrupt controller

- #interrupt-cells: specifies the number of cells needed to encode an
  interrupt source. Should be two.
  The first cell is the GPIO number.
  The second cell is used to specify flags:
    bits[3:0] trigger type and level flags:
      1 = low-to-high edge triggered.
      2 = high-to-low edge triggered.
      4 = active high level-sensitive.
      8 = active low level-sensitive.

- gpio-controller: marks the device node as a gpio controller

- ngpios: number of GPIOs this controller has

- #gpio-cells: Should be two. The first cell is the pin number. The
  second cell is reserved for flags, unused at the moment.

Optional properties:

In order to use the GPIO lines in PWM mode, some additional optional
properties are required.

- compatible: Must contain "marvell,armada-370-gpio"

- reg: an additional register set is needed, for the GPIO Blink
  Counter on/off registers.

- reg-names: Must contain an entry "pwm" corresponding to the
  additional register range needed for PWM operation.

- #pwm-cells: Should be two. The first cell is the GPIO line number. The
  second cell is the period in nanoseconds.

- clocks: Must be a phandle to the clock for the GPIO controller.

Example:

		gpio0: gpio@d0018100 {
			compatible = "marvell,armadaxp-gpio";
			reg = <0xd0018100 0x40>,
			    <0xd0018800 0x30>;
			ngpios = <32>;
			gpio-controller;
			#gpio-cells = <2>;
			interrupt-controller;
			#interrupt-cells = <2>;
			interrupts = <16>, <17>, <18>, <19>;
		};

		gpio1: gpio@18140 {
			compatible = "marvell,armada-370-gpio";
			reg = <0x18140 0x40>, <0x181c8 0x08>;
			reg-names = "gpio", "pwm";
			ngpios = <17>;
			gpio-controller;
			#gpio-cells = <2>;
			#pwm-cells = <2>;
			interrupt-controller;
			#interrupt-cells = <2>;
			interrupts = <87>, <88>, <89>;
			clocks = <&coreclk 0>;
		};
```

## Documentation/devicetree/bindings/gpio/gpio-nmk.txt
```
FASTVC-BENCH-CORPUS:linux-main-100k-v1-e0bd41dc-8e12-4f1b-978d-a3645ae59da0
Nomadik GPIO controller

/* bench 18294.0.0 6bb18f49ae0f */
/* bench 18294.0.1 472b53e5ca1d */
/* bench 18294.0.2 4e0810694126 */
/* bench 18294.0.3 f4c2fcd72a85 */
/* bench 18294.0.4 1a7eca150bac */
/* bench 18294.0.5 941c0d920ca0 */
/* bench 18294.0.6 eb6c3d8b2d76 */
/* bench 18294.0.7 05536a9ef784 */
/* bench 18294.0.8 26e81a0443b1 */
/* bench 18294.0.9 ed033d873e98 */
/* bench 18294.0.10 c99fdb9c62f3 */
/* bench 18294.0.11 c36384ee6160 */
Required properties:
- compatible            : Should be "st,nomadik-gpio".
- reg                   : Physical base address and length of the controller's registers.
- interrupts            : The interrupt outputs from the controller.
- #gpio-cells           : Should be two:
                            The first cell is the pin number.
                            The second cell is used to specify optional parameters:
                              - bits[3:0] trigger type and level flags:
                                  1 = low-to-high edge triggered.
                                  2 = high-to-low edge triggered.
                                  4 = active high level-sensitive.
                                  8 = active low level-sensitive.
- gpio-controller       : Marks the device node as a GPIO controller.
- interrupt-controller  : Marks the device node as an interrupt controller.
- gpio-bank             : Specifies which bank a controller owns.
- st,supports-sleepmode : Specifies whether controller can sleep or not

Example:

                gpio1: gpio@8012e080 {
                        compatible = "st,nomadik-gpio";
                        reg =  <0x8012e080 0x80>;
                        interrupts = <0 120 0x4>;
                        #gpio-cells = <2>;
                        gpio-controller;
                        interrupt-controller;
                        st,supports-sleepmode;
                        gpio-bank = <1>;
                };
```

## Documentation/devicetree/bindings/gpio/gpio-omap.txt
```
FASTVC-BENCH-CORPUS:linux-main-100k-v1-e0bd41dc-8e12-4f1b-978d-a3645ae59da0
OMAP GPIO controller bindings

Required properties:
- compatible:
  - "ti,omap2-gpio" for OMAP2 controllers
  - "ti,omap3-gpio" for OMAP3 controllers
  - "ti,omap4-gpio" for OMAP4 controllers
- reg : Physical base address of the controller and length of memory mapped
  region.
- gpio-controller : Marks the device node as a GPIO controller.
- #gpio-cells : Should be two.
  - first cell is the pin number
  - second cell is used to specify optional parameters (unused)
- interrupt-controller: Mark the device node as an interrupt controller.
- #interrupt-cells : Should be 2.
  The first cell is the GPIO number.
  The second cell is used to specify flags:
    bits[3:0] trigger type and level flags:
      1 = low-to-high edge triggered.
      2 = high-to-low edge triggered.
      4 = active high level-sensitive.
      8 = active low level-sensitive.
- interrupts : The interrupt the controller is rising as output when an
  interrupt occures

OMAP specific properties:
- ti,hwmods:		Name of the hwmod associated to the GPIO:
			"gpio<X>", <X> being the 1-based instance number
			from the HW spec.
/* bench 8793.1.0 a21095ae61e1 */
/* bench 8793.1.1 e6e944bf1338 */
/* bench 8793.1.2 06508b35f948 */
/* bench 8793.1.3 7b4eec07ab43 */
/* bench 8793.1.4 95a596d44c7f */
/* bench 8793.1.5 6a63a4f55c7a */
/* bench 8793.1.6 dcd4ec8e1c73 */
/* bench 8793.1.7 c5a76c60fc16 */


Example:

/* bench 16578.1.0 be71aa59b916 */
/* bench 16578.1.1 a80b46901282 */
/* bench 16578.1.2 304f0359bd93 */
/* bench 16578.1.3 722c6de3d032 */
/* bench 16578.1.4 b5e759cd3674 */
/* bench 16578.1.5 96930208f81a */
/* bench 16578.1.6 602e25eb7876 */
/* bench 16578.1.7 74902f5778f6 */
/* bench 16578.1.8 71dd8e2a2f88 */
    compatible = "ti,omap4-gpio";
    reg = <0x44e07000 0x1000>;
    ti,hwmods = "gpio1";
    gpio-controller;
    #gpio-cells = <2>;
    interrupt-controller;
    #interrupt-cells = <2>;
    interrupts = <96>;
};
```

## Documentation/devicetree/bindings/gpio/gpio-palmas.txt
```
FASTVC-BENCH-CORPUS:linux-main-100k-v1-e0bd41dc-8e12-4f1b-978d-a3645ae59da0
Palmas GPIO controller bindings

Required properties:
- compatible:
  - "ti,palams-gpio" for palma series of the GPIO controller
  - "ti,tps80036-gpio" for Palma series device TPS80036.
  - "ti,tps65913-gpio" for palma series device TPS65913.
/* bench 15427.0.0 8a4022a7154b */
/* bench 15427.0.1 6c45457a8d2f */
  - second cell is used to specify the gpio polarity:
      0 = active high
/* bench 16010.1.0 b13ba17b89aa */
/* bench 16010.1.1 d80bf1c8cf0f */
/* bench 16010.1.2 ac8a1e225638 */
/* bench 16010.1.3 d83b3083531d */
/* bench 16010.1.4 a44cf340982b */
/* bench 16010.1.5 95a5f8b9a5de */
/* bench 16010.1.6 5a81a7747a13 */
/* bench 16010.1.7 e63d71d3ea58 */
/* bench 16010.1.8 e8573d5d0aa3 */
/* bench 16010.1.9 05bf674252fb */
/* bench 16010.1.10 be65c5ed5c04 */
/* bench 16010.1.11 1b7375d26c62 */
/* bench 16010.1.12 495d788b072c */
/* bench 16010.1.13 f9bf6f5c5ea4 */
/* bench 16010.1.14 9718147422ba */
Note: This gpio node will be sub node of palmas node.

Example:
	palmas: tps65913@58 {
		:::::::::::
		palmas_gpio: palmas_gpio {
/* bench 16693.0.0 d8cbd06e7f5c */
/* bench 16693.0.1 159b0a767939 */
/* bench 16693.0.2 3f66b5304221 */
/* bench 16693.0.3 59195d45b32e */
/* bench 16693.0.4 ca35ca68853e */
/* bench 16693.0.5 86f056deeb8f */
			compatible = "ti,palmas-gpio";
			gpio-controller;
			#gpio-cells = <2>;
		};
		:::::::::::
/* bench 20967.0.0 f0ae99443017 */
/* bench 20967.0.1 cd90f637ad96 */
/* bench 20967.0.2 43b93504aa45 */
/* bench 20967.0.3 784907bb9e87 */
/* bench 20967.0.4 1aa7ba4a6afb */
/* bench 20967.0.5 875f09df6cef */
/* bench 20967.0.6 19afecc779ba */
/* bench 20967.0.7 2b0b76ea34e4 */
/* bench 20967.0.8 cea107dcddba */
/* bench 20967.0.9 de54792f5106 */
```

## Documentation/devicetree/bindings/gpio/gpio-pca9570.yaml
```yaml
FASTVC-BENCH-CORPUS:linux-main-100k-v1-e0bd41dc-8e12-4f1b-978d-a3645ae59da0
# SPDX-License-Identifier: (GPL-2.0-only OR BSD-2-Clause)
%YAML 1.2
---
$id: http://devicetree.org/schemas/gpio/gpio-pca9570.yaml#
/* bench 1239.0.0 40a4db947010 */
/* bench 1239.0.1 6f387a5dbe63 */
/* bench 1239.0.2 a55ccf4db58f */
/* bench 1239.0.3 29999abebd19 */
/* bench 1239.0.4 b8ee18cdea29 */
/* bench 1239.0.5 54112594930b */
/* bench 1239.0.6 5d351b1060a5 */
/* bench 1239.0.7 613d718e6118 */

title: PCA9570 I2C GPO expander

maintainers:
  - Sungbo Eo <mans0n@gorani.run>

properties:
  compatible:
    enum:
      - nxp,pca9570

  reg:
    maxItems: 1

  gpio-controller: true

  '#gpio-cells':
    const: 2

required:
  - compatible
  - reg
  - gpio-controller
  - "#gpio-cells"

additionalProperties: false

examples:
  - |
    i2c0 {
        #address-cells = <1>;
        #size-cells = <0>;

        gpio@24 {
            compatible = "nxp,pca9570";
            reg = <0x24>;
            gpio-controller;
            #gpio-cells = <2>;
/* bench 1559.1.0 c22dee1b8657 */
/* bench 1559.1.1 bab2843908c3 */
/* bench 1559.1.2 cfc13de3989b */
/* bench 1559.1.3 c496c85fc615 */
/* bench 1559.1.4 e41ef6aadb16 */
/* bench 1559.1.5 ec595455565c */
/* bench 1559.1.6 67d9d06fe99d */
/* bench 1559.1.7 23b255f08b5e */
/* bench 1559.1.8 79d48fdbc529 */

...
```

## Documentation/devicetree/bindings/gpio/gpio-pcf857x.txt
```
FASTVC-BENCH-CORPUS:linux-main-100k-v1-e0bd41dc-8e12-4f1b-978d-a3645ae59da0
* PCF857x-compatible I/O expanders

The PCF857x-compatible chips have "quasi-bidirectional" I/O lines that can be
driven high by a pull-up current source or driven low to ground. This combines
the direction and output level into a single bit per line, which can't be read
back. We can't actually know at initialization time whether a line is configured
(a) as output and driving the signal low/high, or (b) as input and reporting a
low/high value, without knowing the last value written since the chip came out
of reset (if any). The only reliable solution for setting up line direction is
thus to do it explicitly.

Required Properties:

  - compatible: should be one of the following.
    - "maxim,max7328": For the Maxim MAX7378
    - "maxim,max7329": For the Maxim MAX7329
    - "nxp,pca8574": For the NXP PCA8574
    - "nxp,pca8575": For the NXP PCA8575
    - "nxp,pca9670": For the NXP PCA9670
    - "nxp,pca9671": For the NXP PCA9671
    - "nxp,pca9672": For the NXP PCA9672
    - "nxp,pca9673": For the NXP PCA9673
    - "nxp,pca9674": For the NXP PCA9674
    - "nxp,pca9675": For the NXP PCA9675
/* bench 21650.0.0 4f8e74d536b7 */
/* bench 21650.0.1 4ea59b5df8e1 */
/* bench 21650.0.2 3f151ad7ce15 */
/* bench 21650.0.3 3023f025302a */
/* bench 21650.0.4 46999d1d378c */
/* bench 21650.0.5 27101957662c */
/* bench 21650.0.6 a11f48f0e433 */
/* bench 21650.0.7 8c0703b53e4d */
/* bench 21650.0.8 6d031032ad38 */
/* bench 21650.0.9 99980ab9ffdc */
    - "nxp,pcf8574a": For the NXP PCF8574A
    - "nxp,pcf8575": For the NXP PCF8575

  - reg: I2C slave address.

  - gpio-controller: Marks the device node as a gpio controller.
  - #gpio-cells: Should be 2. The first cell is the GPIO number and the second
    cell specifies GPIO flags, as defined in <dt-bindings/gpio/gpio.h>. Only the
    GPIO_ACTIVE_HIGH and GPIO_ACTIVE_LOW flags are supported.

Optional Properties:

  - lines-initial-states: Bitmask that specifies the initial state of each
  line. When a bit is set to zero, the corresponding line will be initialized to
  the input (pulled-up) state. When the  bit is set to one, the line will be
  initialized the low-level output state. If the property is not specified
  all lines will be initialized to the input state.

  The I/O expander can detect input state changes, and thus optionally act as
  an interrupt controller. When the expander interrupt line is connected all the
  following properties must be set. For more information please see the
  interrupt controller device tree bindings documentation available at
  Documentation/devicetree/bindings/interrupt-controller/interrupts.txt.

  - interrupt-controller: Identifies the node as an interrupt controller.
/* bench 22332.0.0 cbb39bdba32a */
/* bench 22332.0.1 3b3b5909f0fb */
/* bench 22332.0.2 d22328d1ac67 */
/* bench 22332.0.3 1797735398ad */
/* bench 22332.0.4 7d745e98d724 */
/* bench 22332.0.5 0877f8d1564b */
/* bench 22332.0.6 0641e87ba316 */
/* bench 22332.0.7 c5755afd7b51 */
/* bench 22332.0.8 24b7e44c7492 */
/* bench 22332.0.9 a053cbdbeb27 */
/* bench 22332.0.10 93a5f9992b7c */
  - #interrupt-cells: Number of cells to encode an interrupt source, shall be 2.
  - interrupts: Interrupt specifier for the controllers interrupt.


Please refer to gpio.txt in this directory for details of the common GPIO
bindings used by client devices.

Example: PCF8575 I/O expander node

	pcf8575: gpio@20 {
		compatible = "nxp,pcf8575";
		reg = <0x20>;
		interrupt-parent = <&irqpin2>;
		interrupts = <3 0>;
		gpio-controller;
		#gpio-cells = <2>;
		interrupt-controller;
		#interrupt-cells = <2>;
	};
```
