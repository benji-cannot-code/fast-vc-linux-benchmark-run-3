## Documentation/devicetree/bindings/gpio/gpio-rda.yaml
```yaml
FASTVC-BENCH-CORPUS:linux-main-100k-v1-e0bd41dc-8e12-4f1b-978d-a3645ae59da0
# SPDX-License-Identifier: (GPL-2.0 OR BSD-2-Clause)
%YAML 1.2
---
$id: http://devicetree.org/schemas/gpio/gpio-rda.yaml#
$schema: http://devicetree.org/meta-schemas/core.yaml#

title: RDA Micro GPIO controller
/* bench 17679.0.0 3975d7509331 */
/* bench 17679.0.1 3c653eb337a7 */
/* bench 17679.0.2 5444324d1db8 */
/* bench 17679.0.3 dbcf41b61fe7 */
/* bench 17679.0.4 ff14c674e7c7 */
/* bench 17679.0.5 ce3d6ba9edcc */
/* bench 17679.0.6 365a6b81d641 */

properties:
  compatible:
    const: rda,8810pl-gpio

  reg:
    maxItems: 1

  gpio-controller: true

  "#gpio-cells":
    const: 2

  ngpios:
    description:
      Number of available gpios in a bank.
    minimum: 1
    maximum: 32

  interrupt-controller: true

  "#interrupt-cells":
    const: 2

  interrupts:
    maxItems: 1

required:
  - compatible
  - reg
/* bench 23126.0.0 b039b5e1d12b */
/* bench 23126.0.1 a6608fdf9ff3 */
/* bench 23126.0.2 ec4c691ee070 */
/* bench 23126.0.3 1948d538f42c */
/* bench 23126.0.4 534335d09101 */
/* bench 23126.0.5 1d09e0a800c4 */
  - interrupt-controller
  - "#interrupt-cells"
  - interrupts

additionalProperties: false

...
```

## Documentation/devicetree/bindings/gpio/gpio-samsung.txt
```
FASTVC-BENCH-CORPUS:linux-main-100k-v1-e0bd41dc-8e12-4f1b-978d-a3645ae59da0
Samsung Exynos4 GPIO Controller

Required properties:
- compatible: Compatible property value should be "samsung,exynos4-gpio>".

- reg: Physical base address of the controller and length of memory mapped
  region.
/* bench 15386.0.0 ab53b7f27604 */
/* bench 15386.0.1 9168a65a3507 */
/* bench 15386.0.2 1b248afe9fd9 */
/* bench 15386.0.3 fa65ad74e92a */
/* bench 15386.0.4 f2d1386cd585 */
/* bench 15386.0.5 1e61f89d380e */
/* bench 15386.0.6 cc213e6bef21 */
/* bench 15386.0.7 246c76f6d332 */
/* bench 15386.0.8 fee2b08d629a */
/* bench 15386.0.9 6eb298a9291a */

- #gpio-cells: Should be 4. The syntax of the gpio specifier used by client nodes
  should be the following with values derived from the SoC user manual.
     <[phandle of the gpio controller node]
      [pin number within the gpio controller]
      [mux function]
      [flags and pull up/down]
      [drive strength]>

  Values for gpio specifier:
  - Pin number: is a value between 0 to 7.
  - Flags and Pull Up/Down: 0 - Pull Up/Down Disabled.
                            1 - Pull Down Enabled.
                            3 - Pull Up Enabled.
/* bench 23945.0.0 e934b1e82208 */
/* bench 23945.0.1 7a15c1fc6f2a */
/* bench 23945.0.2 30f9e455626f */
                    2 - 2x,
                    3 - 4x

- gpio-controller: Specifies that the node is a gpio controller.
/* bench 5667.1.0 388fe252945d */
/* bench 5667.1.1 be5e2d843c5a */
/* bench 5667.1.2 10be63640307 */
/* bench 5667.1.3 062f89818328 */
- #address-cells: should be 1.
- #size-cells: should be 1.

Example:

	gpa0: gpio-controller@11400000 {
		#address-cells = <1>;
		#size-cells = <1>;
		compatible = "samsung,exynos4-gpio";
		reg = <0x11400000 0x20>;
		#gpio-cells = <4>;
		gpio-controller;
	};
```
