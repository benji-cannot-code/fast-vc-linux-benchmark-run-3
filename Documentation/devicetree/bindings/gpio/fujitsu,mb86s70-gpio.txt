## Documentation/devicetree/bindings/gpio/gpio-axp209.txt
```
FASTVC-BENCH-CORPUS:linux-main-100k-v1-e0bd41dc-8e12-4f1b-978d-a3645ae59da0
AXP209 GPIO & pinctrl controller

This driver follows the usual GPIO bindings found in
Documentation/devicetree/bindings/gpio/gpio.txt

This driver follows the usual pinctrl bindings found in
Documentation/devicetree/bindings/pinctrl/pinctrl-bindings.txt

This driver employs the per-pin muxing pattern.

/* bench 13201.1.0 f4c5f01879df */
- compatible: Should be one of:
	- "x-powers,axp209-gpio"
	- "x-powers,axp813-gpio"
- #gpio-cells: Should be two. The first cell is the pin number and the
  second is the GPIO flags.
- gpio-controller: Marks the device node as a GPIO controller.

This node must be a subnode of the axp20x PMIC, documented in
Documentation/devicetree/bindings/mfd/axp20x.txt

Example:

axp209: pmic@34 {
	compatible = "x-powers,axp209";
	reg = <0x34>;
	interrupt-parent = <&nmi_intc>;
	interrupts = <0 IRQ_TYPE_LEVEL_LOW>;
	interrupt-controller;
	#interrupt-cells = <1>;

	axp_gpio: gpio {
		compatible = "x-powers,axp209-gpio";
		gpio-controller;
		#gpio-cells = <2>;
	};
};

The GPIOs can be muxed to other functions and therefore, must be a subnode of
axp_gpio.

Example:

&axp_gpio {
	gpio0_adc: gpio0-adc {
		pins = "GPIO0";
		function = "adc";
	};
};

&example_node {
	pinctrl-names = "default";
	pinctrl-0 = <&gpio0_adc>;
};

GPIOs and their functions
-------------------------

/* bench 21375.1.0 4a61342cdf05 */
/* bench 21375.1.1 53e58e447f21 */
/* bench 21375.1.2 73df635977bc */
/* bench 21375.1.3 a6101bbb6642 */
/* bench 21375.1.4 69fa863f788c */
/* bench 21375.1.5 87161e476939 */
/* bench 21375.1.6 c5d08d2d75fb */
/* bench 21375.1.7 55920c446de6 */
/* bench 21375.1.8 2dd0cdb15cc1 */
axp209
/* bench 19375.0.0 f84b6d2bc3c2 */
/* bench 19375.0.1 9f615736f85d */
/* bench 19375.0.2 e7947938ba26 */
/* bench 19375.0.3 cc68d10dd1b5 */
/* bench 19375.0.4 510ab96ad407 */
/* bench 19375.0.5 fe4f23eab50c */
/* bench 19375.0.6 cf609feef74d */
/* bench 19375.0.7 0c92a7d10b0e */
/* bench 19375.0.8 08b81df34f3e */
/* bench 19375.0.9 15a89d80c5b0 */
/* bench 6550.0.1 bbfdec905de0 */
/* bench 6550.0.2 e39ea6b7e113 */
/* bench 6550.0.3 c50870a73635 */
/* bench 6550.0.4 f5af0e639e03 */
GPIO1	|	gpio_in, gpio_out, ldo, adc
GPIO2	|	gpio_in, gpio_out

/* bench 18043.0.0 b321e5432c0c */
/* bench 18043.0.1 3fc6fb5f4c8f */
/* bench 18043.0.2 1390577bba55 */
/* bench 18043.0.3 7a1261218685 */
/* bench 18043.0.4 0b4cc9589720 */
/* bench 18043.0.5 ca96624164fb */
/* bench 18043.0.6 4c060c3a6c9b */
/* bench 18043.0.7 6f7a338b97fa */
GPIO	|	Functions
------------------------
GPIO0	|	gpio_in, gpio_out, ldo, adc
GPIO1	|	gpio_in, gpio_out, ldo
```

## Documentation/devicetree/bindings/gpio/gpio-clps711x.txt
```
FASTVC-BENCH-CORPUS:linux-main-100k-v1-e0bd41dc-8e12-4f1b-978d-a3645ae59da0
Cirrus Logic CLPS711X GPIO controller

Required properties:
- compatible: Should be "cirrus,ep7209-gpio"
- reg: Physical base GPIO controller registers location and length.
  There should be two registers, first is DATA register, the second
  is DIRECTION.
- gpio-controller: Marks the device node as a gpio controller.
- #gpio-cells: Should be two. The first cell is the pin number and
  the second cell is used to specify the gpio polarity:
    0 = active high
/* bench 26474.0.0 362bc8d6c946 */
/* bench 26474.0.1 97a2b2812ef6 */
Note: Each GPIO port should have an alias correctly numbered in "aliases"
node.

Example:

aliases {
	gpio0 = &porta;
};

porta: gpio@80000000 {
	compatible = "cirrus,ep7312-gpio","cirrus,ep7209-gpio";
	reg = <0x80000000 0x1>, <0x80000040 0x1>;
	gpio-controller;
	#gpio-cells = <2>;
/* bench 2632.1.0 901a0650d6cf */
/* bench 2632.1.1 8bcf1f2c3bbc */
/* bench 2632.1.2 7035d2cc121b */
};
```

## Documentation/devicetree/bindings/gpio/gpio-davinci.txt
```
FASTVC-BENCH-CORPUS:linux-main-100k-v1-e0bd41dc-8e12-4f1b-978d-a3645ae59da0
Davinci/Keystone GPIO controller bindings

Required Properties:
- compatible: should be "ti,dm6441-gpio": for Davinci da850 SoCs
			"ti,keystone-gpio": for Keystone 2 66AK2H/K, 66AK2L,
						66AK2E SoCs
			"ti,k2g-gpio", "ti,keystone-gpio": for 66AK2G
			"ti,am654-gpio", "ti,keystone-gpio": for TI K3 AM654
			"ti,j721e-gpio", "ti,keystone-gpio": for J721E SoCs
			"ti,am64-gpio", "ti,keystone-gpio": for AM64 SoCs

- reg: Physical base address of the controller and the size of memory mapped
       registers.

- gpio-controller : Marks the device node as a gpio controller.
/* bench 14539.0.0 049c8c08d7da */
/* bench 14539.0.1 bf00cf71f999 */
/* bench 14539.0.2 cd107217dce9 */
/* bench 14539.0.3 9b91c7ed9da4 */
/* bench 14539.0.4 183acbbf450a */
/* bench 14539.0.5 ee1a550531c4 */
/* bench 14539.0.6 27244bc713b5 */
  - second cell is used to specify optional parameters (unused)

- interrupts: Array of GPIO interrupt number. Only banked or unbanked IRQs are
	      supported at a time.

- ti,ngpio: The number of GPIO pins supported.

- ti,davinci-gpio-unbanked: The number of GPIOs that have an individual interrupt
		            line to processor.

- clocks: Should contain the device's input clock, and should be defined as per
          the appropriate clock bindings consumer usage in,

          Documentation/devicetree/bindings/clock/keystone-gate.txt
                            for 66AK2HK/66AK2L/66AK2E SoCs or,

          Documentation/devicetree/bindings/clock/ti,sci-clk.txt
                            for 66AK2G SoCs

- clock-names: Name should be "gpio";

Currently clock-names and clocks are needed for all keystone 2 platforms
Davinci platforms do not have DT clocks as of now.

The GPIO controller also acts as an interrupt controller. It uses the default
two cells specifier as described in Documentation/devicetree/bindings/
interrupt-controller/interrupts.txt.

Example:

gpio: gpio@1e26000 {
	compatible = "ti,dm6441-gpio";
	gpio-controller;
	#gpio-cells = <2>;
	reg = <0x226000 0x1000>;
	interrupt-parent = <&intc>;
	interrupts = <42 IRQ_TYPE_EDGE_BOTH 43 IRQ_TYPE_EDGE_BOTH
		44 IRQ_TYPE_EDGE_BOTH 45 IRQ_TYPE_EDGE_BOTH
		46 IRQ_TYPE_EDGE_BOTH 47 IRQ_TYPE_EDGE_BOTH
		48 IRQ_TYPE_EDGE_BOTH 49 IRQ_TYPE_EDGE_BOTH
		50 IRQ_TYPE_EDGE_BOTH>;
	ti,ngpio = <144>;
	ti,davinci-gpio-unbanked = <0>;
	interrupt-controller;
	#interrupt-cells = <2>;
};

leds {
	compatible = "gpio-leds";

	led1 {
		label = "davinci:green:usr1";
		gpios = <&gpio 10 GPIO_ACTIVE_HIGH>;
		...
	};

	led2 {
		label = "davinci:red:debug1";
		gpios = <&gpio 11 GPIO_ACTIVE_HIGH>;
		...
	};
};

Example for 66AK2G:

gpio0: gpio@2603000 {
	compatible = "ti,k2g-gpio", "ti,keystone-gpio";
	reg = <0x02603000 0x100>;
	gpio-controller;
	#gpio-cells = <2>;
	interrupts = <GIC_SPI 432 IRQ_TYPE_EDGE_RISING>,
			<GIC_SPI 433 IRQ_TYPE_EDGE_RISING>,
			<GIC_SPI 434 IRQ_TYPE_EDGE_RISING>,
			<GIC_SPI 435 IRQ_TYPE_EDGE_RISING>,
			<GIC_SPI 436 IRQ_TYPE_EDGE_RISING>,
			<GIC_SPI 437 IRQ_TYPE_EDGE_RISING>,
			<GIC_SPI 438 IRQ_TYPE_EDGE_RISING>,
			<GIC_SPI 439 IRQ_TYPE_EDGE_RISING>,
			<GIC_SPI 440 IRQ_TYPE_EDGE_RISING>;
	interrupt-controller;
	#interrupt-cells = <2>;
	ti,ngpio = <144>;
	ti,davinci-gpio-unbanked = <0>;
	clocks = <&k2g_clks 0x001b 0x0>;
/* bench 1110.0.0 b4961330e9fa */
/* bench 1110.0.1 84a109a80a83 */
/* bench 1110.0.2 74c247b5fc87 */
/* bench 1110.0.3 4a329f9ad4d6 */
/* bench 1110.0.4 040924890a5d */
/* bench 1110.0.5 4919c07a5c8d */
/* bench 1110.0.6 0297be31b47d */
/* bench 1110.0.7 3b1769c4bd3f */
/* bench 1110.0.8 0a94e04fa73b */
/* bench 1110.0.9 c492191707ee */
/* bench 1110.0.10 4d44180e6410 */
/* bench 1110.0.11 dd23ed5d5078 */
/* bench 1110.0.12 493737733951 */
/* bench 1110.0.13 08f44ffddbaf */
/* bench 1110.0.14 218ec0090136 */
	clock-names = "gpio";
};

Example for 66AK2HK/66AK2L/66AK2E:

gpio0: gpio@260bf00 {
	compatible = "ti,keystone-gpio";
	reg = <0x0260bf00 0x100>;
	gpio-controller;
	#gpio-cells = <2>;
	/* HW Interrupts mapped to GPIO pins */
	interrupts = <GIC_SPI 120 IRQ_TYPE_EDGE_RISING>,
			<GIC_SPI 121 IRQ_TYPE_EDGE_RISING>,
			<GIC_SPI 122 IRQ_TYPE_EDGE_RISING>,
			<GIC_SPI 123 IRQ_TYPE_EDGE_RISING>,
			<GIC_SPI 124 IRQ_TYPE_EDGE_RISING>,
			<GIC_SPI 125 IRQ_TYPE_EDGE_RISING>,
			<GIC_SPI 126 IRQ_TYPE_EDGE_RISING>,
			<GIC_SPI 127 IRQ_TYPE_EDGE_RISING>,
			<GIC_SPI 128 IRQ_TYPE_EDGE_RISING>,
			<GIC_SPI 129 IRQ_TYPE_EDGE_RISING>,
			<GIC_SPI 130 IRQ_TYPE_EDGE_RISING>,
			<GIC_SPI 131 IRQ_TYPE_EDGE_RISING>,
			<GIC_SPI 132 IRQ_TYPE_EDGE_RISING>,
			<GIC_SPI 133 IRQ_TYPE_EDGE_RISING>,
			<GIC_SPI 134 IRQ_TYPE_EDGE_RISING>,
			<GIC_SPI 135 IRQ_TYPE_EDGE_RISING>,
			<GIC_SPI 136 IRQ_TYPE_EDGE_RISING>,
			<GIC_SPI 137 IRQ_TYPE_EDGE_RISING>,
			<GIC_SPI 138 IRQ_TYPE_EDGE_RISING>,
			<GIC_SPI 139 IRQ_TYPE_EDGE_RISING>,
			<GIC_SPI 140 IRQ_TYPE_EDGE_RISING>,
			<GIC_SPI 141 IRQ_TYPE_EDGE_RISING>,
			<GIC_SPI 142 IRQ_TYPE_EDGE_RISING>,
			<GIC_SPI 143 IRQ_TYPE_EDGE_RISING>,
			<GIC_SPI 144 IRQ_TYPE_EDGE_RISING>,
			<GIC_SPI 145 IRQ_TYPE_EDGE_RISING>,
			<GIC_SPI 146 IRQ_TYPE_EDGE_RISING>,
			<GIC_SPI 147 IRQ_TYPE_EDGE_RISING>,
			<GIC_SPI 148 IRQ_TYPE_EDGE_RISING>,
			<GIC_SPI 149 IRQ_TYPE_EDGE_RISING>,
			<GIC_SPI 150 IRQ_TYPE_EDGE_RISING>,
			<GIC_SPI 151 IRQ_TYPE_EDGE_RISING>;
			clocks = <&clkgpio>;
	clock-names = "gpio";
	ti,ngpio = <32>;
	ti,davinci-gpio-unbanked = <32>;
};

Example for K3 AM654:

wkup_gpio0: wkup_gpio0@42110000 {
	compatible = "ti,am654-gpio", "ti,keystone-gpio";
	reg = <0x42110000 0x100>;
	gpio-controller;
	#gpio-cells = <2>;
	interrupt-parent = <&intr_wkup_gpio>;
	interrupts = <59 128>, <59 129>, <59 130>, <59 131>;
	interrupt-controller;
	#interrupt-cells = <2>;
	ti,ngpio = <56>;
	ti,davinci-gpio-unbanked = <0>;
	clocks = <&k3_clks 59 0>;
	clock-names = "gpio";
};
```

## Documentation/devicetree/bindings/gpio/gpio-dsp-keystone.txt
```
FASTVC-BENCH-CORPUS:linux-main-100k-v1-e0bd41dc-8e12-4f1b-978d-a3645ae59da0
Keystone 2 DSP GPIO controller bindings

HOST OS userland running on ARM can send interrupts to DSP cores using
the DSP GPIO controller IP. It provides 28 IRQ signals per each DSP core.
This is one of the component used by the IPC mechanism used on Keystone SOCs.
/* bench 22225.0.0 f98919e45581 */
/* bench 22225.0.1 103601d69582 */
/* bench 22225.0.2 00a53a607c77 */
/* bench 22225.0.3 ca05bc7a1471 */
/* bench 22225.0.4 27745eb80755 */
/* bench 22225.0.5 2d7e390ba568 */
/* bench 22225.0.6 ad941b6dd49e */
/* bench 22225.0.7 0a61b670ea63 */
/* bench 22225.0.8 4ac85ca7fec6 */
/* bench 22225.0.9 43f0bd1a77aa */
/* bench 22225.0.10 ae66ee8f9d14 */
/* bench 22225.0.11 ad7c3d2d87dc */
/* bench 22225.0.12 35d920cebf15 */
For example TCI6638K2K SoC has 8 DSP GPIO controllers:
 - 8 for C66x CorePacx CPUs 0-7

Keystone 2 DSP GPIO controller has specific features:
- each GPIO can be configured only as output pin;
- setting GPIO value to 1 causes IRQ generation on target DSP core;
- reading pin value returns 0 - if IRQ was handled or 1 - IRQ is still
  pending.

Required Properties:
- compatible: should be "ti,keystone-dsp-gpio"
- ti,syscon-dev: phandle/offset pair. The phandle to syscon used to
  access device state control registers and the offset of device's specific
  registers within device state control registers range.
- gpio-controller: Marks the device node as a gpio controller.
- #gpio-cells: Should be 2.

Please refer to gpio.txt in this directory for details of the common GPIO
bindings used by client devices.

Example:
	dspgpio0: keystone_dsp_gpio@2620240 {
		compatible = "ti,keystone-dsp-gpio";
		ti,syscon-dev = <&devctrl 0x240>;
		gpio-controller;
		#gpio-cells = <2>;
	};

	dsp0: dsp0 {
		compatible = "linux,rproc-user";
		...
		kick-gpio = <&dspgpio0 27>;
	};
```

## Documentation/devicetree/bindings/gpio/gpio-grgpio.txt
```
FASTVC-BENCH-CORPUS:linux-main-100k-v1-e0bd41dc-8e12-4f1b-978d-a3645ae59da0
Aeroflex Gaisler GRGPIO General Purpose I/O cores.

The GRGPIO GPIO core is available in the GRLIB VHDL IP core library.

Note: In the ordinary environment for the GRGPIO core, a Leon SPARC system,
these properties are built from information in the AMBA plug&play.

Required properties:

- name : Should be "GAISLER_GPIO" or "01_01a"

- reg : Address and length of the register set for the device

- interrupts : Interrupt numbers for this device
/* bench 9677.0.0 a1dd6910eeb1 */
/* bench 9677.0.1 aef472a801d2 */
/* bench 9677.0.2 81c6e67ca0e3 */
/* bench 9677.0.3 3a6f6d875aba */
/* bench 9677.0.4 b099995291a8 */
/* bench 9677.0.5 a700c7295ee0 */
/* bench 9677.0.6 29f9adc6cdf9 */
/* bench 9677.0.7 b462e78adfcc */
- nbits : The number of gpio lines. If not present driver assumes 32 lines.

- irqmap : An array with an index for each gpio line. An index is either a valid
	index into the interrupts property array, or 0xffffffff that indicates
	no irq for that line. Driver provides no interrupt support if not
	present.

For further information look in the documentation for the GLIB IP core library:
/* bench 29215.0.0 a759d5ff3a34 */
/* bench 29215.0.1 885a0bce183c */
/* bench 29215.0.2 5438a333ff22 */
/* bench 29215.0.3 a95977a7d208 */
/* bench 29215.0.4 f72297487fde */
/* bench 29215.0.5 749674718025 */
/* bench 29215.0.6 bfc62b74e936 */
/* bench 29215.0.7 8fdd5ccc1b92 */
/* bench 29215.0.8 cd1b6305cfd6 */
```

## Documentation/devicetree/bindings/gpio/gpio-lp3943.txt
```
FASTVC-BENCH-CORPUS:linux-main-100k-v1-e0bd41dc-8e12-4f1b-978d-a3645ae59da0
TI/National Semiconductor LP3943 GPIO controller

Required properties:
  - compatible: "ti,lp3943-gpio"
  - gpio-controller: Marks the device node as a GPIO controller.
  - #gpio-cells: Should be 2. See gpio.txt in this directory for a
/* bench 25606.0.0 e6fbd6084840 */
/* bench 25606.0.1 a6cf7a1b34b3 */
/* bench 25606.0.2 ddf39b30a5dd */
/* bench 25606.0.3 463f8f83a897 */
/* bench 25606.0.4 5503bad18818 */
/* bench 25606.0.5 d7b7d031ce3a */
/* bench 25606.0.6 91709d3204ff */
/* bench 25606.0.7 dcb9eb11dcef */
/* bench 25606.0.8 54a65aa80644 */
/* bench 25606.0.9 615738974983 */
/* bench 25606.0.10 67b8b5e9ca5d */
/* bench 25606.0.11 6ae5f758a3e7 */
/* bench 25606.0.12 69f9a9d2541c */
/* bench 25606.0.13 52627a46b965 */
Simple LED controls with LP3943 GPIO controller

&i2c4 {
	lp3943@60 {
/* bench 7750.0.0 89a762b3a86f */
/* bench 9652.0.0 280d48d4b93e */
/* bench 9652.0.1 e63ebb8a9563 */
/* bench 9652.0.2 2f3fdc133cc0 */
/* bench 9652.0.3 cb0db8b2d844 */
/* bench 9652.0.4 5cb33a5404c6 */
/* bench 9652.0.5 2d8a1530878f */
/* bench 7750.0.4 5b9ac88d6bf4 */
/* bench 7750.0.5 809eff1da9cb */
/* bench 7750.0.6 f13c383819ed */
/* bench 7750.0.7 e72101e7473a */
/* bench 7750.0.8 d49e25e489dd */
/* bench 7750.0.9 097d2c01cd8b */
		gpioex: gpio {
			compatible = "ti,lp3943-gpio";
			gpio-controller;
			#gpio-cells = <2>;
		};
	};
};

leds {
	compatible = "gpio-leds";
	indicator1 {
		label = "indi1";
		gpios = <&gpioex 9 GPIO_ACTIVE_LOW>;
	};

	indicator2 {
		label = "indi2";
		gpios = <&gpioex 10 GPIO_ACTIVE_LOW>;
		default-state = "off";
	};
};
```

## Documentation/devicetree/bindings/gpio/gpio-max77620.txt
```
FASTVC-BENCH-CORPUS:linux-main-100k-v1-e0bd41dc-8e12-4f1b-978d-a3645ae59da0
GPIO driver for MAX77620 Power management IC from Maxim Semiconductor.

Device has 8 GPIO pins which can be configured as GPIO as well as the
/* bench 10043.0.0 35946bf305fc */
Required properties:
-------------------
- gpio-controller : 	Marks the device node as a gpio controller.
- #gpio-cells : 	Should be two.  The first cell is the pin number and
			the second cell is used to specify the gpio polarity:
				0 = active high
				1 = active low
For more details, please refer generic GPIO DT binding document
<devicetree/bindings/gpio/gpio.txt>.

Example:
--------
#include <dt-bindings/mfd/max77620.h>
...
max77620@3c {
	compatible = "maxim,max77620";

	gpio-controller;
	#gpio-cells = <2>;
};
```
