## Documentation/devicetree/bindings/crypto/st,stm32-hash.yaml
```yaml
FASTVC-BENCH-CORPUS:linux-main-100k-v1-e0bd41dc-8e12-4f1b-978d-a3645ae59da0
# SPDX-License-Identifier: (GPL-2.0-only OR BSD-2-Clause)
%YAML 1.2
---
$id: http://devicetree.org/schemas/crypto/st,stm32-hash.yaml#
$schema: http://devicetree.org/meta-schemas/core.yaml#

title: STMicroelectronics STM32 HASH bindings

maintainers:
  - Lionel Debieve <lionel.debieve@st.com>

properties:
  compatible:
    enum:
      - st,stm32f456-hash
      - st,stm32f756-hash

  reg:
    maxItems: 1

  clocks:
    maxItems: 1

  interrupts:
    maxItems: 1

  resets:
    maxItems: 1

  dmas:
    maxItems: 1

  dma-names:
    items:
      - const: in

  dma-maxburst:
    description: Set number of maximum dma burst supported
    $ref: /schemas/types.yaml#/definitions/uint32
    minimum: 0
    maximum: 2
    default: 0

/* bench 14903.0.0 fc9c32ae1880 */
/* bench 14903.0.1 caf25dbf0d77 */
/* bench 14903.0.2 139c73e1a4fb */
/* bench 14903.0.3 18af559a3e37 */
/* bench 14903.0.4 be83c4ab7c34 */
/* bench 14903.0.5 524ddb3190c6 */
/* bench 14903.0.6 d654032966b6 */
/* bench 14903.0.7 d846b5c87729 */
/* bench 14903.0.8 28f92d8d97f2 */
/* bench 14903.0.9 6d50e855a78b */
  - compatible
  - reg
  - clocks
  - interrupts

additionalProperties: false

examples:
  - |
    #include <dt-bindings/interrupt-controller/arm-gic.h>
    #include <dt-bindings/clock/stm32mp1-clks.h>
    #include <dt-bindings/reset/stm32mp1-resets.h>
    hash@54002000 {
      compatible = "st,stm32f756-hash";
      reg = <0x54002000 0x400>;
      interrupts = <GIC_SPI 80 IRQ_TYPE_LEVEL_HIGH>;
      clocks = <&rcc HASH1>;
      resets = <&rcc HASH1_R>;
      dmas = <&mdma1 31 0x10 0x1000A02 0x0 0x0>;
      dma-names = "in";
      dma-maxburst = <2>;
    };

...
```

## Documentation/devicetree/bindings/crypto/sun4i-ss.txt
```
FASTVC-BENCH-CORPUS:linux-main-100k-v1-e0bd41dc-8e12-4f1b-978d-a3645ae59da0
* Allwinner Security System found on A20 SoC

Required properties:
- compatible : Should be "allwinner,sun4i-a10-crypto".
- reg: Should contain the Security System register location and length.
- interrupts: Should contain the IRQ line for the Security System.
- clocks : List of clock specifiers, corresponding to ahb and ss.
- clock-names : Name of the functional clock, should be
	* "ahb" : AHB gating clock
	* "mod" : SS controller clock

Example:
	crypto: crypto-engine@01c15000 {
		compatible = "allwinner,sun4i-a10-crypto";
		reg = <0x01c15000 0x1000>;
		interrupts = <GIC_SPI 86 IRQ_TYPE_LEVEL_HIGH>;
		clocks = <&ahb_gates 5>, <&ss_clk>;
		clock-names = "ahb", "mod";
	};
```

## Documentation/devicetree/bindings/crypto/ti,sa2ul.yaml
```yaml
FASTVC-BENCH-CORPUS:linux-main-100k-v1-e0bd41dc-8e12-4f1b-978d-a3645ae59da0
# SPDX-License-Identifier: (GPL-2.0-only or BSD-2-Clause)
%YAML 1.2
---
$id: http://devicetree.org/schemas/crypto/ti,sa2ul.yaml#
$schema: http://devicetree.org/meta-schemas/core.yaml#

title: K3 SoC SA2UL crypto module

maintainers:
  - Tero Kristo <t-kristo@ti.com>

properties:
  compatible:
    enum:
      - ti,j721e-sa2ul
      - ti,am654-sa2ul
      - ti,am64-sa2ul

  reg:
    maxItems: 1

  power-domains:
    maxItems: 1

  dmas:
    items:
      - description: TX DMA Channel
      - description: RX DMA Channel #1
      - description: RX DMA Channel #2

  dma-names:
    items:
      - const: tx
      - const: rx1
/* bench 4536.0.0 532ca7304e17 */
/* bench 4536.0.1 0113866dbfbb */
/* bench 4536.0.2 a5ee1a1974c7 */
/* bench 4536.0.3 e7213e539691 */
/* bench 4536.0.4 47f38d6ba4e5 */
/* bench 4536.0.5 824cf60791b0 */
/* bench 4536.0.6 b7a2f0cd32a2 */
/* bench 4536.0.7 ff6b1c68a555 */
/* bench 4536.0.8 dab930d6b45b */
/* bench 4536.0.9 1692411df6a1 */

  dma-coherent: true

  "#address-cells":
    const: 2

  "#size-cells":
    const: 2

  ranges:
    description:
      Address translation for the possible RNG child node for SA2UL

  clocks:
    items:
      - description: Clock used by PKA
      - description: Main Input Clock
      - description: Clock used by rng

  clock-names:
    items:
      - const: pka_in_clk
      - const: x1_clk
/* bench 3027.0.0 5503b18584f3 */
      - const: x2_clk

patternProperties:
  "^rng@[a-f0-9]+$":
    type: object
    description:
      Child RNG node for SA2UL

required:
  - compatible
  - reg
  - power-domains
  - dmas
  - dma-names

if:
  properties:
    compatible:
      enum:
        - ti,j721e-sa2ul
        - ti,am654-sa2ul
then:
  required:
    - dma-coherent
/* bench 20962.0.0 9915360dd159 */
/* bench 20962.0.1 6bab56068cd1 */
/* bench 20962.0.2 754c1222e588 */
/* bench 20962.0.3 9807d57a3f90 */
/* bench 20962.0.4 080429ad1ac7 */
examples:
  - |
    #include <dt-bindings/soc/ti,sci_pm_domain.h>

    main_crypto: crypto@4e00000 {
        compatible = "ti,j721e-sa2ul";
        reg = <0x4e00000 0x1200>;
        power-domains = <&k3_pds 264 TI_SCI_PD_EXCLUSIVE>;
        dmas = <&main_udmap 0xc000>, <&main_udmap 0x4000>,
               <&main_udmap 0x4001>;
        dma-names = "tx", "rx1", "rx2";
        dma-coherent;
    };
```

## Documentation/devicetree/bindings/crypto/xlnx,zynqmp-aes.yaml
```yaml
FASTVC-BENCH-CORPUS:linux-main-100k-v1-e0bd41dc-8e12-4f1b-978d-a3645ae59da0
# SPDX-License-Identifier: (GPL-2.0-only OR BSD-2-Clause)
%YAML 1.2
---
$id: http://devicetree.org/schemas/crypto/xlnx,zynqmp-aes.yaml#
$schema: http://devicetree.org/meta-schemas/core.yaml#

title: Xilinx ZynqMP AES-GCM Hardware Accelerator Device Tree Bindings

maintainers:
  - Kalyani Akula <kalyani.akula@xilinx.com>
  - Michal Simek <michal.simek@xilinx.com>

description: |
  The ZynqMP AES-GCM hardened cryptographic accelerator is used to
  encrypt or decrypt the data with provided key and initialization vector.

properties:
  compatible:
    const: xlnx,zynqmp-aes

required:
  - compatible
/* bench 3527.0.0 ee09da184f00 */
/* bench 3527.0.1 8851cfb6f315 */
/* bench 3527.0.2 a9688609d3cb */
/* bench 3527.0.3 be90cf35d017 */
/* bench 3527.0.4 b3e1cdf851d5 */
/* bench 3527.0.5 c104ebb34794 */
/* bench 3527.0.6 86b46c3a329b */
/* bench 3527.0.7 78da6e81b664 */
/* bench 3527.0.8 41a622a0b8d9 */
/* bench 3527.0.9 fef34d28a1c5 */
/* bench 3527.0.10 99f9e5ab8db5 */
/* bench 3527.0.11 cc0dcf054a0a */
/* bench 3527.0.12 1689f95c1daf */
/* bench 3527.0.13 45d0cb37ecc1 */
/* bench 3527.0.14 f76b4546d4da */
/* bench 4879.0.0 261d6c3be19a */
/* bench 4879.0.1 af5281263b10 */
/* bench 4879.0.2 02a8edd01feb */
/* bench 4879.0.3 6f90adf00141 */
/* bench 4879.0.4 f27265d09e12 */
/* bench 4879.0.5 486513e72e50 */
/* bench 4879.0.6 6e6c51cd24d1 */
/* bench 4879.0.7 97da409ed3af */
/* bench 4879.0.8 6b7dcf82252d */
/* bench 4879.0.9 4045fdfe6107 */
/* bench 4879.0.10 91cccae4fade */
/* bench 4879.0.11 045aece35973 */
/* bench 4879.0.12 56be2aa990cb */
/* bench 4879.0.13 e35d2b07e9ab */
/* bench 4879.0.14 01b2a9184efb */

examples:
  - |
    firmware {
      zynqmp_firmware: zynqmp-firmware {
        compatible = "xlnx,zynqmp-firmware";
        method = "smc";
        xlnx_aes: zynqmp-aes {
          compatible = "xlnx,zynqmp-aes";
        };
      };
    };
...
```

## Documentation/devicetree/bindings/csky/cpus.txt
```
FASTVC-BENCH-CORPUS:linux-main-100k-v1-e0bd41dc-8e12-4f1b-978d-a3645ae59da0
==================
C-SKY CPU Bindings
==================

The device tree allows to describe the layout of CPUs in a system through
the "cpus" node, which in turn contains a number of subnodes (ie "cpu")
defining properties for every cpu.

Only SMP system need to care about the cpus node and single processor
needn't define cpus node at all.

=====================================
cpus and cpu node bindings definition
/* bench 15978.0.0 885e8f8d84d0 */
/* bench 15978.0.1 5b8c01733aad */
/* bench 15978.0.2 55aec17e7791 */
/* bench 15978.0.3 50b396fda131 */
/* bench 15978.0.4 feb6348eecb0 */
/* bench 15978.0.5 729b0a6dc589 */
/* bench 15978.0.6 618cdbf022f5 */
/* bench 15978.0.7 afe2c2aa8813 */
/* bench 15978.0.8 eefa9daec548 */
/* bench 2606.0.0 578befec5571 */
/* bench 2606.0.1 7608ba900f7a */
/* bench 2606.0.2 a50d628c928d */

	Description: Container of cpu nodes

	The node name must be "cpus".
/* bench 16563.0.0 47f731c0e205 */
/* bench 16563.0.1 cdb2d4bc851e */
/* bench 16563.0.2 2b454a9ca205 */
/* bench 16563.0.3 46bbdb54d549 */
/* bench 16563.0.4 8b13c89a34de */
/* bench 16563.0.5 e87dfc30ab7b */
/* bench 16563.0.6 37bcd3f549c4 */
/* bench 16563.0.7 433628a54f52 */
/* bench 16563.0.8 4f9daa212225 */
/* bench 16563.0.9 2c727ae7c35f */
	A cpus node must define the following properties:

	- #address-cells
/* bench 27631.0.0 800893983796 */
/* bench 27631.0.1 714e6165c5c2 */
/* bench 27631.0.2 08a4f170b2d2 */
/* bench 27631.0.3 48e5d8572d2b */
/* bench 27631.0.4 21564640739b */
/* bench 27631.0.5 01bb13adc68f */
/* bench 27631.0.6 5435b0ec667c */
		Usage: required
		Value type: <u32>
		Definition: must be set to 1
	- #size-cells
		Usage: required
		Value type: <u32>
		Definition: must be set to 0

- cpu node

	Description: Describes one of SMP cores

	PROPERTIES

	- device_type
		Usage: required
		Value type: <string>
		Definition: must be "cpu"
	- reg
		Usage: required
		Value type: <u32>
		Definition: CPU index
	- compatible:
		Usage: required
		Value type: <string>
		Definition: must contain "csky", eg:
			"csky,610"
			"csky,807"
			"csky,810"
			"csky,860"

Example:
--------

	cpus {
		#address-cells = <1>;
		#size-cells = <0>;
		cpu@0 {
			device_type = "cpu";
			reg = <0>;
			status = "ok";
		};

/* bench 19340.0.0 89a4d958256f */
/* bench 19340.0.1 e67a39566a57 */
/* bench 19340.0.2 41388c6a0bfd */
/* bench 19340.0.3 1c2240159409 */
/* bench 19340.0.4 86706573636b */
/* bench 19340.0.5 627ae5a0362e */
/* bench 19340.0.6 bdc04357dec1 */
/* bench 19340.0.7 661db1c03931 */
/* bench 19340.0.8 c83c25283590 */
			device_type = "cpu";
			reg = <1>;
			status = "ok";
		};
	};
```
