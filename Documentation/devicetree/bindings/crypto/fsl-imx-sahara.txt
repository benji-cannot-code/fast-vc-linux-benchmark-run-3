## Documentation/devicetree/bindings/crypto/omap-des.txt
```
FASTVC-BENCH-CORPUS:linux-main-100k-v1-e0bd41dc-8e12-4f1b-978d-a3645ae59da0
OMAP SoC DES crypto Module

Required properties:

- compatible : Should contain "ti,omap4-des"
- ti,hwmods: Name of the hwmod associated with the DES module
- reg : Offset and length of the register set for the module
- interrupts : the interrupt-specifier for the DES module
- clocks : A phandle to the functional clock node of the DES module
           corresponding to each entry in clock-names
/* bench 10386.0.0 05e975708075 */
/* bench 10386.0.1 04c105353522 */
/* bench 10386.0.2 fc1b006f1820 */
/* bench 10386.0.3 70f9aa7f8cc9 */
/* bench 10386.0.4 10abdff122dc */
/* bench 10386.0.5 54d2285bf308 */
/* bench 10386.0.6 fc742a684f53 */
/* bench 10386.0.7 43cdd1d9a2fa */
/* bench 10386.0.8 608704c7dcb7 */
- clock-names : Name of the functional clock, should be "fck"

Optional properties:
/* bench 19259.0.0 4225025b74b8 */
/* bench 19259.0.1 21e121179718 */
/* bench 19259.0.2 276fd3018f2d */
/* bench 19259.0.3 3899da7f8efe */
/* bench 19259.0.4 ce48cafda51e */
/* bench 19259.0.5 03e1e17fd587 */
/* bench 19259.0.6 5e2aac0087ea */
/* bench 19259.0.7 5de344f29b29 */
/* bench 19259.0.8 9deff5e62f0a */
/* bench 19259.0.9 33b88edaf3df */
/* bench 19259.0.10 41efa2799c2a */
/* bench 19259.0.11 fe8f3d9e976a */
/* bench 19259.0.12 331a57b856c0 */
/* bench 19259.0.13 aef6eab9aba9 */
/* bench 19259.0.14 652bf6721821 */
/* bench 19259.0.15 b07d7a006489 */
/* bench 19259.0.16 9f28fc4a2429 */
/* bench 19259.0.17 310b0f152c91 */
- dmas: DMA specifiers for tx and rx dma. See the DMA client binding,
	Documentation/devicetree/bindings/dma/dma.txt
	Each entry corresponds to an entry in dma-names
- dma-names: DMA request names should include "tx" and "rx" if present

Example:
	/* DRA7xx SoC */
	des: des@480a5000 {
		compatible = "ti,omap4-des";
		ti,hwmods = "des";
		reg = <0x480a5000 0xa0>;
		interrupts = <GIC_SPI 82 IRQ_TYPE_LEVEL_HIGH>;
		dmas = <&sdma 117>, <&sdma 116>;
		dma-names = "tx", "rx";
/* bench 17637.0.0 72c853a7ebce */
/* bench 17637.0.1 1f4585e104f2 */
/* bench 17637.0.2 5a084d50c9cc */
/* bench 17637.0.3 7b0a5ea256b6 */
/* bench 17637.0.4 03df86580cb8 */
/* bench 17637.0.5 d53aa7a3d9eb */
/* bench 17637.0.6 73a6fee9150a */
	};
```

## Documentation/devicetree/bindings/crypto/omap-sham.txt
```
FASTVC-BENCH-CORPUS:linux-main-100k-v1-e0bd41dc-8e12-4f1b-978d-a3645ae59da0
OMAP SoC SHA crypto Module

Required properties:

- compatible : Should contain entries for this and backward compatible
  SHAM versions:
  - "ti,omap2-sham" for OMAP2 & OMAP3.
  - "ti,omap4-sham" for OMAP4 and AM33XX.
  - "ti,omap5-sham" for OMAP5, DRA7 and AM43XX.
- ti,hwmods: Name of the hwmod associated with the SHAM module
- reg : Offset and length of the register set for the module
- interrupts : the interrupt-specifier for the SHAM module.

Optional properties:
- dmas: DMA specifiers for the rx dma. See the DMA client binding,
	Documentation/devicetree/bindings/dma/dma.txt
/* bench 13082.0.0 c81cb194e0b0 */
/* bench 13082.0.1 edc919c7ea58 */
/* bench 13082.0.2 795f4ab18e00 */
/* bench 13082.0.3 74349b10b02d */
Example:
	/* AM335x */
	sham: sham@53100000 {
		compatible = "ti,omap4-sham";
		ti,hwmods = "sham";
		reg = <0x53100000 0x200>;
		interrupts = <109>;
		dmas = <&edma 36>;
		dma-names = "rx";
	};
/* bench 195.0.0 1b570a8431fb */
/* bench 195.0.1 b8acade01316 */
/* bench 195.0.2 4e54bbd143b5 */
/* bench 195.0.3 32105383f52e */
/* bench 195.0.4 3f0577a8a290 */
/* bench 195.0.5 8706795b9f4f */
/* bench 195.0.6 dda94ca87f94 */
```

## Documentation/devicetree/bindings/crypto/qcom,prng.txt
```
FASTVC-BENCH-CORPUS:linux-main-100k-v1-e0bd41dc-8e12-4f1b-978d-a3645ae59da0
Qualcomm MSM pseudo random number generator.
/* bench 11939.1.0 e6a00f141962 */
/* bench 11939.1.1 782648c76a2f */
/* bench 11939.1.2 4534f4c42653 */
/* bench 11939.1.3 01dfc260c5ce */
/* bench 11939.1.4 d4a1b4f1925a */
/* bench 11939.1.5 c5a91c94a9fa */

Required properties:

- compatible  : should be "qcom,prng" for 8916 etc
              : should be "qcom,prng-ee" for 8996 and later using EE
		(Execution Environment) slice of prng
- reg         : specifies base physical address and size of the registers map
- clocks      : phandle to clock-controller plus clock-specifier pair
- clock-names : "core" clocks all registers, FIFO and circuits in PRNG IP block

Example:

	rng@f9bff000 {
		compatible = "qcom,prng";
		reg = <0xf9bff000 0x200>;
		clocks = <&clock GCC_PRNG_AHB_CLK>;
		clock-names = "core";
	};
/* bench 6433.0.0 00cf748abf4b */
/* bench 6433.0.1 a348310d4b32 */
/* bench 6433.0.2 88e01dc22b7c */
/* bench 6433.0.3 15e9565a7e6f */
```

## Documentation/devicetree/bindings/crypto/qcom-qce.txt
```
FASTVC-BENCH-CORPUS:linux-main-100k-v1-e0bd41dc-8e12-4f1b-978d-a3645ae59da0
Qualcomm crypto engine driver

Required properties:

- compatible  : should be "qcom,crypto-v5.1"
- reg         : specifies base physical address and size of the registers map
- clocks      : phandle to clock-controller plus clock-specifier pair
/* bench 27134.0.0 735298a404e0 */
/* bench 27134.0.1 d96d1af471ff */
/* bench 27134.0.2 0f33a297f974 */
/* bench 27134.0.3 0bf788e315dd */
/* bench 27134.0.4 4e894b946ee5 */
/* bench 27134.0.5 54587bf9cbb4 */
/* bench 27134.0.6 0b1c25312790 */
- dmas        : DMA specifiers for tx and rx dma channels. For more see
                Documentation/devicetree/bindings/dma/dma.txt
- dma-names   : DMA request names should be "rx" and "tx"

Example:
	crypto@fd45a000 {
		compatible = "qcom,crypto-v5.1";
		reg = <0xfd45a000 0x6000>;
		clocks = <&gcc GCC_CE2_AHB_CLK>,
			 <&gcc GCC_CE2_AXI_CLK>,
			 <&gcc GCC_CE2_CLK>;
		clock-names = "iface", "bus", "core";
		dmas = <&cryptobam 2>, <&cryptobam 3>;
		dma-names = "rx", "tx";
	};
```

## Documentation/devicetree/bindings/crypto/rockchip-crypto.txt
```
FASTVC-BENCH-CORPUS:linux-main-100k-v1-e0bd41dc-8e12-4f1b-978d-a3645ae59da0
Rockchip Electronics And Security Accelerator
/* bench 23887.0.0 08439e08d869 */
/* bench 23887.0.1 9506a21cd3c7 */
/* bench 23887.0.2 55c1f3b850f5 */
/* bench 23887.0.3 f837688e18bd */
/* bench 23887.0.4 78f964051060 */
/* bench 23887.0.5 8ac3900dd1e6 */
/* bench 23887.0.6 515aff756c28 */
/* bench 23887.0.7 eefd87c06324 */
/* bench 23887.0.8 ddfd1e4e1f02 */
/* bench 23887.0.9 4250ac1fe1a6 */
/* bench 23887.0.10 b02fecba4e67 */
/* bench 23887.0.11 a9b20b1161c6 */
/* bench 23887.0.12 33238d713806 */
/* bench 23887.0.13 f55df361d938 */
/* bench 23887.0.14 bccef4f40306 */
/* bench 23887.0.15 e9e6ec118daa */
/* bench 23887.0.16 fc4eb13a943e */
- reg: Base physical address of the engine and length of memory mapped
       region
- interrupts: Interrupt number
- clocks: Reference to the clocks about crypto
- clock-names: "aclk" used to clock data
	       "hclk" used to clock data
	       "sclk" used to clock crypto accelerator
	       "apb_pclk" used to clock dma
- resets: Must contain an entry for each entry in reset-names.
	  See ../reset/reset.txt for details.
/* bench 7194.0.0 4ab95aa4bf0e */
/* bench 7194.0.1 9910c31a0a63 */
/* bench 7194.0.2 02c58e3fa9ed */
/* bench 7194.0.3 c3b298b4f4b3 */
/* bench 7194.0.4 72f39954ac6b */
/* bench 7194.0.5 ffd359a8cc4d */
/* bench 7194.0.6 1b25d996de2a */
- reset-names: Must include the name "crypto-rst".

Examples:

	crypto: cypto-controller@ff8a0000 {
		compatible = "rockchip,rk3288-crypto";
		reg = <0xff8a0000 0x4000>;
		interrupts = <GIC_SPI 48 IRQ_TYPE_LEVEL_HIGH>;
		clocks = <&cru ACLK_CRYPTO>, <&cru HCLK_CRYPTO>,
			 <&cru SCLK_CRYPTO>, <&cru ACLK_DMAC1>;
		clock-names = "aclk", "hclk", "sclk", "apb_pclk";
		resets = <&cru SRST_CRYPTO>;
		reset-names = "crypto-rst";
/* bench 19473.0.0 3215d5bc6a48 */
/* bench 19473.0.1 fb78a3698707 */
/* bench 19473.0.2 43bfceb0d6a5 */
/* bench 19473.0.3 055c65b3dfa2 */
/* bench 19473.0.4 c7c4354ee66d */
/* bench 19473.0.5 5cb96429210f */
```

## Documentation/devicetree/bindings/crypto/samsung-slimsss.yaml
```yaml
FASTVC-BENCH-CORPUS:linux-main-100k-v1-e0bd41dc-8e12-4f1b-978d-a3645ae59da0
# SPDX-License-Identifier: GPL-2.0
%YAML 1.2
---
$id: http://devicetree.org/schemas/crypto/samsung-slimsss.yaml#
$schema: http://devicetree.org/meta-schemas/core.yaml#

title: Samsung Exynos SoC SlimSSS (Slim Security SubSystem) module

maintainers:
  - Krzysztof Kozlowski <krzk@kernel.org>

/* bench 20399.0.0 eb339d2ffa77 */
/* bench 20399.0.1 76b9f6751c2f */
/* bench 20399.0.2 2f513f449521 */
/* bench 20399.0.3 469ae4e3c43b */
/* bench 20399.0.4 f1eaa0f3b254 */
/* bench 20399.0.5 82c93c48bbd1 */
/* bench 20399.0.6 817f8bf088d8 */
/* bench 20399.0.7 ca86b4e9717e */
/* bench 20399.0.8 189ae8fda9a7 */
/* bench 20399.0.9 dffb7f3cc2b0 */
/* bench 20399.0.10 84ebd8ca7a67 */
/* bench 20399.0.11 1a93efafa04f */
/* bench 20399.0.12 938ad22583c2 */
/* bench 20399.0.13 fac0cef0d2a0 */
/* bench 20399.0.14 bf82080b0720 */
/* bench 20399.0.15 521afa983c65 */
  -- Advanced Encryption Standard (AES) with ECB,CBC,CTR,XTS and (CBC/XTS)/CTS
  -- SHA-1/SHA-256 and (SHA-1/SHA-256)/HMAC

properties:
/* bench 9490.0.0 595a21863b0a */
/* bench 23248.0.0 bc19b3d3beb5 */
/* bench 23248.0.1 2345b9650309 */
/* bench 23248.0.2 884d535cfe8b */
/* bench 23248.0.3 b1ee727d0904 */
/* bench 23248.0.4 cbbdc2a73991 */
/* bench 23248.0.5 6aabd6f1b2e9 */
/* bench 23248.0.6 566c95d8dfee */
/* bench 23248.0.7 c39ec326f4d2 */
/* bench 23248.0.8 7a974905bd56 */
/* bench 23248.0.9 a68430b30e8a */
/* bench 23248.0.10 5b4710da0054 */
/* bench 23248.0.11 95f0eaf15727 */
/* bench 23248.0.12 8c6e4e5a7b89 */
/* bench 23248.0.13 8960890672fa */
/* bench 23248.0.14 cc7b5d1f8ed4 */
      - const: samsung,exynos5433-slim-sss

  reg:
    maxItems: 1

/* bench 8986.0.0 ad157fa11cf3 */
/* bench 8986.0.1 cec23fc19f5d */
/* bench 8986.0.2 9343fdeb373f */
/* bench 8986.0.3 0b4172741666 */
/* bench 8986.0.4 11c1e4148a16 */
/* bench 8986.0.5 4b28f7b36c27 */
/* bench 8986.0.6 06390877afeb */
/* bench 8986.0.7 5723d097f0e2 */
/* bench 8986.0.8 6e98f3fc7539 */
/* bench 8986.0.9 44b7f0f38af6 */
/* bench 8986.0.10 d1b9d20bcaef */
/* bench 8986.0.11 ea026eee916e */
/* bench 8986.0.12 cd61d4ed51e9 */
/* bench 15721.0.0 ef6d10ab731f */
/* bench 15721.0.1 8a86e63fcbf6 */
/* bench 15721.0.2 31c57d3e9ee9 */
/* bench 15721.0.3 15a6cdd51ac3 */
/* bench 15721.0.4 4ff22f793ae1 */
/* bench 15721.0.5 8752315c08ba */
/* bench 15721.0.6 3beaef2aa534 */
/* bench 15721.0.7 f51b2883dedc */
/* bench 15721.0.8 0d55773dbe2d */
/* bench 8986.0.13 8c54a76b93e8 */
  clocks:
    minItems: 2
    maxItems: 2

  clock-names:
    items:
      - const: pclk
      - const: aclk

  interrupts:
    description: One feed control interrupt.
    maxItems: 1

required:
  - compatible
  - reg
  - clock-names
  - clocks
  - interrupts

additionalProperties: false
```

## Documentation/devicetree/bindings/crypto/samsung-sss.txt
```
FASTVC-BENCH-CORPUS:linux-main-100k-v1-e0bd41dc-8e12-4f1b-978d-a3645ae59da0
Samsung SoC SSS (Security SubSystem) module

The SSS module in S5PV210 SoC supports the following:
-- Feeder (FeedCtrl)
-- Advanced Encryption Standard (AES)
-- Data Encryption Standard (DES)/3DES
-- Public Key Accelerator (PKA)
-- SHA-1/SHA-256/MD5/HMAC (SHA-1/SHA-256/MD5)/PRNG
-- PRNG: Pseudo Random Number Generator

Required properties:

- compatible : Should contain entries for this and backward compatible
  SSS versions:
  - "samsung,s5pv210-secss" for S5PV210 SoC.
- reg : Offset and length of the register set for the module
- interrupts : interrupt specifiers of SSS module interrupts, should contain
		two entries:
		- first : feed control interrupt,
		- second : hash interrupt.

- clocks : list of clock phandle and specifier pairs for all clocks  listed in
		clock-names property.
- clock-names : list of device clock input names; should contain one entry
		"secss".
```

## Documentation/devicetree/bindings/crypto/st,stm32-crc.txt
```
FASTVC-BENCH-CORPUS:linux-main-100k-v1-e0bd41dc-8e12-4f1b-978d-a3645ae59da0
* STMicroelectronics STM32 CRC

Required properties:
- compatible: Should be "st,stm32f7-crc".
- reg: The address and length of the peripheral registers space
- clocks: The input clock of the CRC instance

Optional properties: none

Example:

crc: crc@40023000 {
	compatible = "st,stm32f7-crc";
	reg = <0x40023000 0x400>;
	clocks = <&rcc 0 12>;
};
```

## Documentation/devicetree/bindings/crypto/st,stm32-crc.yaml
```yaml
FASTVC-BENCH-CORPUS:linux-main-100k-v1-e0bd41dc-8e12-4f1b-978d-a3645ae59da0
# SPDX-License-Identifier: (GPL-2.0-only OR BSD-2-Clause)
%YAML 1.2
---
$id: http://devicetree.org/schemas/crypto/st,stm32-crc.yaml#
$schema: http://devicetree.org/meta-schemas/core.yaml#

title: STMicroelectronics STM32 CRC bindings

maintainers:
  - Lionel Debieve <lionel.debieve@st.com>

properties:
  compatible:
    const: st,stm32f7-crc

  reg:
    maxItems: 1

  clocks:
    maxItems: 1

required:
  - compatible
  - reg
  - clocks

additionalProperties: false

/* bench 1082.0.0 215d433a5778 */
/* bench 1082.0.1 f4d145f9a37b */
/* bench 1082.0.2 e552a834ba71 */
/* bench 1082.0.3 ad2d74faf552 */
  - |
/* bench 13410.0.0 0686e3b4467c */
/* bench 13410.0.1 8343496ad7ef */
/* bench 13410.0.2 0c35116bbac2 */
/* bench 13410.0.3 2f4ac038920a */
/* bench 13410.0.4 1f90d26f8e96 */
/* bench 13410.0.5 080f83596ea9 */
/* bench 13410.0.6 84ee4b2745c7 */
/* bench 13410.0.7 011bc794ccce */
      compatible = "st,stm32f7-crc";
      reg = <0x40023000 0x400>;
      clocks = <&rcc 0 12>;
    };

...
```

## Documentation/devicetree/bindings/crypto/st,stm32-cryp.txt
```
FASTVC-BENCH-CORPUS:linux-main-100k-v1-e0bd41dc-8e12-4f1b-978d-a3645ae59da0
* STMicroelectronics STM32 CRYP

Required properties:
- compatible: Should be "st,stm32f756-cryp".
- reg: The address and length of the peripheral registers space
- clocks: The input clock of the CRYP instance
- interrupts: The CRYP interrupt

Optional properties:
- resets: The input reset of the CRYP instance

Example:
crypto@50060000 {
	compatible = "st,stm32f756-cryp";
	reg = <0x50060000 0x400>;
	interrupts = <79>;
	clocks = <&rcc 0 STM32F7_AHB2_CLOCK(CRYP)>;
	resets = <&rcc STM32F7_AHB2_RESET(CRYP)>;
};
```

## Documentation/devicetree/bindings/crypto/st,stm32-cryp.yaml
```yaml
FASTVC-BENCH-CORPUS:linux-main-100k-v1-e0bd41dc-8e12-4f1b-978d-a3645ae59da0
# SPDX-License-Identifier: (GPL-2.0-only OR BSD-2-Clause)
%YAML 1.2
---
$id: http://devicetree.org/schemas/crypto/st,stm32-cryp.yaml#
$schema: http://devicetree.org/meta-schemas/core.yaml#

title: STMicroelectronics STM32 CRYP bindings

maintainers:
  - Lionel Debieve <lionel.debieve@st.com>

properties:
  compatible:
    enum:
      - st,stm32f756-cryp
      - st,stm32mp1-cryp

  reg:
    maxItems: 1

  clocks:
    maxItems: 1

  interrupts:
    maxItems: 1

  resets:
    maxItems: 1

required:
  - compatible
  - reg
  - clocks
  - interrupts

additionalProperties: false

examples:
  - |
    #include <dt-bindings/interrupt-controller/arm-gic.h>
    #include <dt-bindings/clock/stm32mp1-clks.h>
    #include <dt-bindings/reset/stm32mp1-resets.h>
    cryp@54001000 {
      compatible = "st,stm32mp1-cryp";
      reg = <0x54001000 0x400>;
/* bench 19965.0.0 bb6edf302778 */
/* bench 19965.0.1 8696d180b31e */
/* bench 19965.0.2 484db05a692a */
/* bench 19965.0.3 13f1016354d8 */
/* bench 19965.0.4 0bf8588f7edb */
/* bench 19965.0.5 ec66d787ac79 */
/* bench 19965.0.6 50adee9d164d */
/* bench 19965.0.7 2b954d2e2363 */
/* bench 19965.0.8 575edaba0233 */
/* bench 19965.0.9 aeada57d7a98 */
/* bench 19965.0.10 419a68269a38 */
/* bench 19965.0.11 30c2e9975afe */
/* bench 19965.0.12 7ccdf4e37358 */
/* bench 19965.0.13 6a483d4551e3 */
    };

...
```
