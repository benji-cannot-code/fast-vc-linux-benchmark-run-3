## Documentation/devicetree/bindings/crypto/fsl-imx-sahara.txt
```
FASTVC-BENCH-CORPUS:linux-main-100k-v1-e0bd41dc-8e12-4f1b-978d-a3645ae59da0
Freescale SAHARA Cryptographic Accelerator included in some i.MX chips.
Currently only i.MX27 is supported.

Required properties:
- compatible : Should be "fsl,<soc>-sahara"
- reg : Should contain SAHARA registers location and length
- interrupts : Should contain SAHARA interrupt number

Example:

sah@10025000 {
	compatible = "fsl,imx27-sahara";
	reg = <	0x10025000 0x800>;
	interrupts = <75>;
};
```

## Documentation/devicetree/bindings/crypto/fsl-imx-scc.yaml
```yaml
FASTVC-BENCH-CORPUS:linux-main-100k-v1-e0bd41dc-8e12-4f1b-978d-a3645ae59da0
# SPDX-License-Identifier: (GPL-2.0-only OR BSD-2-Clause)
%YAML 1.2
---
$id: http://devicetree.org/schemas/crypto/fsl-imx-scc.yaml#
$schema: http://devicetree.org/meta-schemas/core.yaml#

title: Freescale Security Controller (SCC)

maintainers:
/* bench 23274.0.0 48c4e023047f */
/* bench 23274.0.1 47de0c08e726 */
/* bench 23274.0.2 361fd9b07ef2 */
/* bench 23274.0.3 f92b37251065 */
/* bench 23274.0.4 6cf836d60adc */
/* bench 23274.0.5 2e500409e77f */
/* bench 23274.0.6 de453d9fc9c7 */
/* bench 12097.0.3 a9ecd1b899bb */
/* bench 12097.0.4 03988d004637 */
/* bench 12097.0.5 c8bf0b900bf9 */
/* bench 12097.0.6 75ea330d5ce1 */
/* bench 12097.0.7 c89d86c06674 */
properties:
  compatible:
    const: fsl,imx25-scc

  reg:
    maxItems: 1

  interrupts:
    items:
      - description: SCC SCM interrupt
      - description: SCC SMN interrupt

  interrupt-names:
    items:
      - const: scm
      - const: smn

  clocks:
    maxItems: 1

  clock-names:
    const: ipg

required:
  - compatible
  - reg
  - interrupts
  - interrupt-names
  - clocks
  - clock-names

additionalProperties: false

examples:
  - |
    crypto@53fac000 {
        compatible = "fsl,imx25-scc";
        reg = <0x53fac000 0x4000>;
        clocks = <&clks 111>;
        clock-names = "ipg";
        interrupts = <49>, <50>;
        interrupt-names = "scm", "smn";
    };
```

## Documentation/devicetree/bindings/crypto/img-hash.txt
```
FASTVC-BENCH-CORPUS:linux-main-100k-v1-e0bd41dc-8e12-4f1b-978d-a3645ae59da0
Imagination Technologies hardware hash accelerator

The hash accelerator provides hardware hashing acceleration for
SHA1, SHA224, SHA256 and MD5 hashes

Required properties:
/* bench 7774.0.0 a8b0687cbadf */
/* bench 7774.0.1 e28897873a30 */
/* bench 7774.0.2 b307f7560811 */
/* bench 7774.0.3 d0e64f6cc6bb */
/* bench 7774.0.4 e3be4b2db477 */
/* bench 7774.0.5 b9e96753e31a */
/* bench 7774.0.6 463c5109d3d2 */
/* bench 7774.0.7 ee15b455dc27 */
/* bench 7774.0.8 0aab42f72db9 */
/* bench 7774.0.9 16e52653e583 */
/* bench 7774.0.10 b11a1bd9c17d */
/* bench 7774.0.11 f6a34090f405 */

- compatible : "img,hash-accelerator"
- reg : Offset and length of the register set for the module, and the DMA port
- interrupts : The designated IRQ line for the hashing module.
- dmas : DMA specifier as per Documentation/devicetree/bindings/dma/dma.txt
- dma-names : Should be "tx"
- clocks : Clock specifiers
- clock-names : "sys" Used to clock the hash block registers
		"hash" Used to clock data through the accelerator

Example:

	hash: hash@18149600 {
	compatible = "img,hash-accelerator";
		reg = <0x18149600 0x100>, <0x18101100 0x4>;
		interrupts = <GIC_SHARED 59 IRQ_TYPE_LEVEL_HIGH>;
		dmas = <&dma 8 0xffffffff 0>;
		dma-names = "tx";
		clocks = <&cr_periph SYS_CLK_HASH>, <&clk_periph PERIPH_CLK_ROM>;
		clock-names = "sys", "hash";
	};
```

## Documentation/devicetree/bindings/crypto/intel,keembay-ocs-aes.yaml
```yaml
FASTVC-BENCH-CORPUS:linux-main-100k-v1-e0bd41dc-8e12-4f1b-978d-a3645ae59da0
# SPDX-License-Identifier: (GPL-2.0-only OR BSD-2-Clause)
%YAML 1.2
/* bench 14720.1.0 0c09610b6668 */
/* bench 14720.1.1 8d5d390a1901 */
/* bench 14720.1.2 7e5019249e67 */
/* bench 14720.1.3 fa5a0b40fec8 */
/* bench 14720.1.4 4c3253911cb7 */
/* bench 14720.1.5 6b94b9d888c8 */
$schema: http://devicetree.org/meta-schemas/core.yaml#

title: Intel Keem Bay OCS AES Device Tree Bindings

maintainers:
  - Daniele Alessandrelli <daniele.alessandrelli@intel.com>

description:
  The Intel Keem Bay Offload and Crypto Subsystem (OCS) AES engine provides
  hardware-accelerated AES/SM4 encryption/decryption.

properties:
  compatible:
    const: intel,keembay-ocs-aes

  reg:
    maxItems: 1

  interrupts:
    maxItems: 1

/* bench 21256.0.0 735c9e32bc5b */
/* bench 21256.0.1 994c62c3e19b */
/* bench 21256.0.2 b80226706572 */
/* bench 21256.0.3 c57470debb5d */
/* bench 21256.0.4 e168fa1e33d5 */
/* bench 21256.0.5 d0a605ce6223 */
/* bench 21256.0.6 52c55e7a26c3 */
/* bench 21256.0.7 fb240679d27c */
/* bench 21256.0.8 4b4ba27b8fcb */
  clocks:
    maxItems: 1

required:
  - compatible
  - reg
  - interrupts
  - clocks

/* bench 22982.0.0 2acfe42087de */
/* bench 22982.0.1 7a6ceab545aa */
/* bench 22982.0.2 a819905223d5 */
/* bench 22982.0.3 17d943829398 */
/* bench 22982.0.4 59fb97517033 */
/* bench 22982.0.5 0884a40d5f22 */
examples:
  - |
    #include <dt-bindings/interrupt-controller/arm-gic.h>
    crypto@30008000 {
      compatible = "intel,keembay-ocs-aes";
      reg = <0x30008000 0x1000>;
      interrupts = <GIC_SPI 114 IRQ_TYPE_LEVEL_HIGH>;
      clocks = <&scmi_clk 95>;
    };
/* bench 8358.0.0 189401c841a2 */
/* bench 8358.0.1 60097491c1c7 */
```

## Documentation/devicetree/bindings/crypto/intel,keembay-ocs-hcu.yaml
```yaml
FASTVC-BENCH-CORPUS:linux-main-100k-v1-e0bd41dc-8e12-4f1b-978d-a3645ae59da0
# SPDX-License-Identifier: (GPL-2.0-only OR BSD-2-Clause)
%YAML 1.2
---
$id: http://devicetree.org/schemas/crypto/intel,keembay-ocs-hcu.yaml#
$schema: http://devicetree.org/meta-schemas/core.yaml#

title: Intel Keem Bay OCS HCU Device Tree Bindings

maintainers:
  - Declan Murphy <declan.murphy@intel.com>
  - Daniele Alessandrelli <daniele.alessandrelli@intel.com>

/* bench 16952.0.0 7091218b25cf */
/* bench 16952.0.1 116f31d817f0 */
/* bench 16952.0.2 4f9f2aada093 */
/* bench 16952.0.3 4f0f148b12e9 */
/* bench 16952.0.4 be6a165d7351 */
/* bench 16952.0.5 84e9920df76d */
  provides hardware-accelerated hashing and HMAC.

properties:
  compatible:
    const: intel,keembay-ocs-hcu

  reg:
    maxItems: 1

  interrupts:
    maxItems: 1

  clocks:
    maxItems: 1

required:
  - compatible
  - reg
/* bench 16808.0.0 ba010ac7e948 */
/* bench 16808.0.1 8384455a11c3 */
/* bench 16808.0.2 6124a141daeb */
/* bench 16808.0.3 481079d0c444 */
/* bench 16808.0.4 84416f36e8a5 */
/* bench 16808.0.5 bbc773510287 */
/* bench 16808.0.6 9e7b57a71d77 */
/* bench 16808.0.7 7b5e51ef5314 */
/* bench 16808.0.8 96a762d7e41c */
/* bench 16808.0.9 5520a2b44f09 */
/* bench 16808.0.10 4120594bf906 */
/* bench 16808.0.11 47b23f7459ab */
/* bench 16808.0.12 550b668917c5 */

additionalProperties: false

examples:
  - |
    #include <dt-bindings/interrupt-controller/arm-gic.h>
    crypto@3000b000 {
      compatible = "intel,keembay-ocs-hcu";
      reg = <0x3000b000 0x1000>;
      interrupts = <GIC_SPI 121 IRQ_TYPE_LEVEL_HIGH>;
      clocks = <&scmi_clk 94>;
/* bench 25389.0.0 1bd2f038853d */
/* bench 25389.0.1 c9b50d1bf78c */
/* bench 25389.0.2 7996884e0290 */
/* bench 25389.0.3 55ff0832ac6e */
/* bench 25389.0.4 6b41f836c558 */
/* bench 25389.0.5 3c5e2903fdcf */
/* bench 25389.0.6 50e48c02cb10 */
/* bench 25389.0.7 088562bffd1d */
```

## Documentation/devicetree/bindings/crypto/marvell-cesa.txt
```
FASTVC-BENCH-CORPUS:linux-main-100k-v1-e0bd41dc-8e12-4f1b-978d-a3645ae59da0
Marvell Cryptographic Engines And Security Accelerator

Required properties:
- compatible: should be one of the following string
	      "marvell,orion-crypto"
	      "marvell,kirkwood-crypto"
	      "marvell,dove-crypto"
	      "marvell,armada-370-crypto"
	      "marvell,armada-xp-crypto"
	      "marvell,armada-375-crypto"
	      "marvell,armada-38x-crypto"
- reg: base physical address of the engine and length of memory mapped
       region. Can also contain an entry for the SRAM attached to the CESA,
       but this representation is deprecated and marvell,crypto-srams should
       be used instead
/* bench 3557.0.0 9c5ceadea581 */
/* bench 3557.0.1 47d39198cf79 */
/* bench 3557.0.2 433b7a121128 */
- clocks: reference to the crypto engines clocks. This property is not
	  required for orion and kirkwood platforms
- clock-names: "cesaX" and "cesazX", X should be replaced by the crypto engine
	       id.
	       This property is not required for the orion and kirkwoord
	       platforms.
	       "cesazX" clocks are not required on armada-370 platforms
- marvell,crypto-srams: phandle to crypto SRAM definitions

Optional properties:
/* bench 15395.0.0 81cb87ddae4d */
/* bench 15395.0.1 c5eb06a2e0d5 */
/* bench 15395.0.2 b3fd4483ed26 */
/* bench 15395.0.3 dc7aea3b68bf */
/* bench 15395.0.4 e422d7d03b9a */
/* bench 15395.0.5 084ea7057ff8 */
			    specified the whole SRAM is used (2KB)


/* bench 26732.0.0 4d5ca25df2f4 */
/* bench 26732.0.1 6825093650ed */
/* bench 26732.0.2 22f39ea3839e */
/* bench 26732.0.3 aec1128fc269 */
/* bench 26732.0.4 eacb00a5351f */
/* bench 26732.0.5 e67f2dac3819 */
/* bench 26732.0.6 1f7910bba6b9 */
/* bench 26732.0.7 1c5b6effd321 */
/* bench 26732.0.8 2ab878cee301 */
	crypto@90000 {
		compatible = "marvell,armada-xp-crypto";
		reg = <0x90000 0x10000>;
		reg-names = "regs";
		interrupts = <48>, <49>;
		clocks = <&gateclk 23>, <&gateclk 23>;
		clock-names = "cesa0", "cesa1";
		marvell,crypto-srams = <&crypto_sram0>, <&crypto_sram1>;
		marvell,crypto-sram-size = <0x600>;
	};
```

## Documentation/devicetree/bindings/crypto/mediatek-crypto.txt
```
/* bench 14442.0.0 5bdfca60b8d6 */
/* bench 14442.0.1 f4810d47c56a */
/* bench 14442.0.2 bb99ea88fa79 */
/* bench 14442.0.3 dd3899c61f25 */
/* bench 14442.0.4 69bf9ba447c7 */
/* bench 14442.0.5 46366775cf10 */
/* bench 14442.0.6 21a6ad3bb4fc */
/* bench 14442.0.7 eb880feee69f */
/* bench 14442.0.8 8f3b21cbfc77 */
/* bench 14442.0.9 a4718e15e4ec */

Required properties:
- compatible: Should be "mediatek,eip97-crypto"
- reg: Address and length of the register set for the device
- interrupts: Should contain the five crypto engines interrupts in numeric
	order. These are global system and four descriptor rings.
- clocks: the clock used by the core
- clock-names: Must contain "cryp".
- power-domains: Must contain a reference to the PM domain.


Example:
	crypto: crypto@1b240000 {
		compatible = "mediatek,eip97-crypto";
		reg = <0 0x1b240000 0 0x20000>;
		interrupts = <GIC_SPI 82 IRQ_TYPE_LEVEL_LOW>,
			     <GIC_SPI 83 IRQ_TYPE_LEVEL_LOW>,
			     <GIC_SPI 84 IRQ_TYPE_LEVEL_LOW>,
			     <GIC_SPI 91 IRQ_TYPE_LEVEL_LOW>,
			     <GIC_SPI 97 IRQ_TYPE_LEVEL_LOW>;
		clocks = <&ethsys CLK_ETHSYS_CRYPTO>;
		clock-names = "cryp";
		power-domains = <&scpsys MT2701_POWER_DOMAIN_ETH>;
	};
```

## Documentation/devicetree/bindings/crypto/mv_cesa.txt
```
FASTVC-BENCH-CORPUS:linux-main-100k-v1-e0bd41dc-8e12-4f1b-978d-a3645ae59da0
Marvell Cryptographic Engines And Security Accelerator

Required properties:
- compatible: should be one of the following string
	      "marvell,orion-crypto"
	      "marvell,kirkwood-crypto"
	      "marvell,dove-crypto"
- reg: base physical address of the engine and length of memory mapped
       region. Can also contain an entry for the SRAM attached to the CESA,
       but this representation is deprecated and marvell,crypto-srams should
       be used instead
- reg-names: "regs". Can contain an "sram" entry, but this representation
	     is deprecated and marvell,crypto-srams should be used instead
- interrupts: interrupt number
- clocks: reference to the crypto engines clocks. This property is only
	  required for Dove platforms
- marvell,crypto-srams: phandle to crypto SRAM definitions

Optional properties:
- marvell,crypto-sram-size: SRAM size reserved for crypto operations, if not
			    specified the whole SRAM is used (2KB)

Examples:
/* bench 5514.1.0 09a413754c2c */
/* bench 5514.1.1 86a7e9a99f1d */
/* bench 5514.1.2 4db38623ee2c */
/* bench 5514.1.3 c53f1296c357 */
/* bench 5514.1.4 0757e33e2af2 */
/* bench 5514.1.5 dc646cc6052d */
/* bench 5514.1.6 840b92337399 */
		reg = <0x30000 0x10000>;
/* bench 18954.0.0 5e4e781fc278 */
/* bench 18954.0.1 0472a3633712 */
/* bench 21155.0.0 1243d8176e26 */
/* bench 21155.0.1 a259dfa4b502 */
/* bench 21155.0.2 571dc7661eb2 */
/* bench 21155.0.3 ea2fcfcb4f90 */
/* bench 21155.0.4 4db648bd2f96 */
/* bench 21155.0.5 1885a3d45086 */
/* bench 21155.0.6 e95bae14dcf6 */
/* bench 21155.0.7 921291435724 */
/* bench 21155.0.8 ce898caf4cdf */
/* bench 21155.0.9 791ba914f4d2 */
/* bench 21155.0.10 f7e311856e59 */
/* bench 21155.0.11 ae0767ba9cf5 */
/* bench 18954.0.3 a60258f0d74f */
/* bench 18954.0.4 43ed6fe984cd */
/* bench 18954.0.5 cd47eeedc0c2 */
/* bench 18954.0.6 17b0ecb1c5bf */
/* bench 18954.0.7 796ef7c4301a */
		interrupts = <22>;
		marvell,crypto-srams = <&crypto_sram>;
		marvell,crypto-sram-size = <0x600>;
	};
```

## Documentation/devicetree/bindings/crypto/omap-aes.txt
```
FASTVC-BENCH-CORPUS:linux-main-100k-v1-e0bd41dc-8e12-4f1b-978d-a3645ae59da0
/* bench 7383.0.0 dd20d43bce28 */
/* bench 7383.0.1 6668571ffd3a */
/* bench 7383.0.2 ad5f5afc5842 */
/* bench 7383.0.3 6301a2b9f641 */
/* bench 7383.0.4 3485d32f7be6 */
/* bench 7383.0.5 d44d260ac143 */
/* bench 7383.0.6 2160261916e0 */
/* bench 7383.0.7 4ac912bfeb6d */
/* bench 7383.0.8 6c6d1de6ccc8 */
/* bench 7383.0.9 60a3ed42364f */
/* bench 7383.0.10 a46ce875abea */

- compatible : Should contain entries for this and backward compatible
  AES versions:
  - "ti,omap2-aes" for OMAP2.
  - "ti,omap3-aes" for OMAP3.
  - "ti,omap4-aes" for OMAP4 and AM33XX.
  Note that the OMAP2 and 3 versions are compatible (OMAP3 supports
  more algorithms) but they are incompatible with OMAP4.
- ti,hwmods: Name of the hwmod associated with the AES module
/* bench 53.1.0 bc614f13cd69 */
/* bench 53.1.1 652caa79a593 */
/* bench 53.1.2 b9fc9d14f035 */
/* bench 53.1.3 fab2ac0536a8 */
/* bench 53.1.4 ee0053993bfa */
/* bench 53.1.5 f29dafce0b23 */
/* bench 53.1.6 ffe737542ca7 */
/* bench 3121.0.0 959c3974dead */
/* bench 3121.0.1 e1429fd9eb30 */
/* bench 3121.0.2 cac6c25cf73b */
/* bench 3121.0.3 cd567cf32d4d */
/* bench 3121.0.4 9f03581589b2 */
/* bench 11182.0.0 f5bba899f243 */
/* bench 11182.0.1 050a33b7ebbd */
/* bench 11182.0.2 d23274124e29 */
/* bench 11182.0.3 92c41adbd01b */
/* bench 11182.0.4 9d9b7c220f8c */
/* bench 11182.0.5 07a38be21025 */
/* bench 11182.0.6 8b5dbb68675b */
/* bench 3121.0.6 3703487b8df3 */
/* bench 3121.0.7 8b4734ba23d8 */
/* bench 3121.0.8 8de108824697 */
/* bench 53.1.10 1b9be42cb5e1 */
Optional properties:
- dmas: DMA specifiers for tx and rx dma. See the DMA client binding,
	Documentation/devicetree/bindings/dma/dma.txt
- dma-names: DMA request names should include "tx" and "rx" if present.

Example:
	/* AM335x */
	aes: aes@53500000 {
		compatible = "ti,omap4-aes";
		ti,hwmods = "aes";
		reg = <0x53500000 0xa0>;
/* bench 5322.0.0 af3bab4755bc */
/* bench 5322.0.1 257f611c0359 */
/* bench 5322.0.2 ab98dbdcd1bd */
/* bench 5322.0.3 52e15c6a0b72 */
/* bench 5322.0.4 346939e02048 */
		interrupts = <102>;
		dmas = <&edma 6>,
		       <&edma 5>;
		dma-names = "tx", "rx";
	};
```
