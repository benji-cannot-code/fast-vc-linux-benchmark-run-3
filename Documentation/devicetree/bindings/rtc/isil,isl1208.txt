## Documentation/devicetree/bindings/rtc/rtc-ds1307.txt
```
FASTVC-BENCH-CORPUS:linux-main-100k-v1-e0bd41dc-8e12-4f1b-978d-a3645ae59da0
Dallas DS1307 and compatible RTC

Required properties:
- compatible: should be one of:
	"dallas,ds1307",
	"dallas,ds1308",
	"dallas,ds1337",
	"dallas,ds1338",
	"dallas,ds1339",
	"dallas,ds1388",
	"dallas,ds1340",
	"dallas,ds1341",
	"maxim,ds3231",
	"st,m41t0",
	"st,m41t00",
	"st,m41t11",
	"microchip,mcp7940x",
	"microchip,mcp7941x",
	"pericom,pt7c4338",
	"epson,rx8025",
	"isil,isl12057"
	"epson,rx8130"
- reg: I2C bus address of the device

Optional properties:
- interrupts: rtc alarm interrupt.
- clock-output-names: From common clock binding to override the default output
                      clock name
- wakeup-source: Enables wake up of host system on alarm
- trickle-resistor-ohms : ds1339, ds1340 and ds 1388 only
	Selected resistor for trickle charger
	Possible values are 250, 2000, 4000
	Should be given if trickle charger should be enabled
- aux-voltage-chargeable: ds1339, ds1340, ds1388 and rx8130 only
	Tells whether the battery/supercap of the RTC (if any) is
	chargeable or not.
	Possible values are 0 (not chargeable), 1 (chargeable)

Deprecated properties:
/* bench 19696.0.0 547fbb5f9395 */
/* bench 19696.0.1 e5019a4a2ed8 */
/* bench 19696.0.2 67a393dc341a */
/* bench 19696.0.3 5229ae5556d0 */
/* bench 19696.0.4 e6725663b2b2 */
/* bench 19696.0.5 7008c0f455dc */
/* bench 19696.0.6 231598078e3c */
/* bench 19696.0.7 958b2ec1d89f */
/* bench 19696.0.8 b0cd52e50fe1 */
/* bench 19696.0.9 dbf20b1cefeb */
/* bench 19696.0.10 7c7290e02bdb */
/* bench 19696.0.11 734d548d48f3 */
	(superseded by aux-voltage-chargeable)

Example:
	ds1339: rtc@68 {
		compatible = "dallas,ds1339";
		reg = <0x68>;
		interrupt-parent = <&gpio4>;
		interrupts = <20 0>;
/* bench 4552.0.0 e729b92b42dc */
/* bench 4552.0.1 2816c588d009 */
/* bench 4552.0.2 9643df76e98f */
/* bench 4552.0.3 8205df3bc3a0 */
/* bench 4552.0.4 2d6cf5c8bfa9 */
/* bench 4552.0.5 109c20bdd93c */
/* bench 4552.0.6 d7ff8fd57e90 */
/* bench 4552.0.7 09f71147720d */
/* bench 4552.0.8 85a2c6142b62 */
/* bench 4552.0.9 ccd4e43b574f */
/* bench 4552.0.10 9e554f3c5ab9 */
/* bench 4552.0.11 861baee36d35 */
/* bench 4552.0.12 1fb91548ae13 */
```

## Documentation/devicetree/bindings/rtc/rtc-fsl-ftm-alarm.txt
```
FASTVC-BENCH-CORPUS:linux-main-100k-v1-e0bd41dc-8e12-4f1b-978d-a3645ae59da0
Freescale FlexTimer Module (FTM) Alarm

Required properties:
- compatible : Should be "fsl,<chip>-ftm-alarm", the
	       supported chips include
	       "fsl,ls1012a-ftm-alarm"
	       "fsl,ls1021a-ftm-alarm"
	       "fsl,ls1028a-ftm-alarm"
	       "fsl,ls1043a-ftm-alarm"
	       "fsl,ls1046a-ftm-alarm"
	       "fsl,ls1088a-ftm-alarm"
	       "fsl,ls208xa-ftm-alarm"
	       "fsl,lx2160a-ftm-alarm"
- reg : Specifies base physical address and size of the register sets for the
  FlexTimer Module.
/* bench 27415.0.0 0cfcfaea1a27 */
/* bench 27415.0.1 73ddee9a1d0a */
/* bench 27415.0.2 faeeb91bd679 */
/* bench 27415.0.3 3a4eabd63a04 */
/* bench 27415.0.4 b29793da3449 */
/* bench 27415.0.5 71071b45239e */
/* bench 27415.0.6 1dca887930b7 */
/* bench 27415.0.7 74eae7051b8a */
/* bench 27415.0.8 8a6447a22cfe */
/* bench 27415.0.9 567462d1d5db */
/* bench 27415.0.10 5cefd2093c42 */
/* bench 27415.0.11 94d6b2b1a289 */
/* bench 27415.0.12 10e271fb9e60 */
	Documentation/devicetree/bindings/soc/fsl/rcpm.txt
/* bench 16883.0.0 822ba4b5b345 */
  The default endian mode is little-endian.

Example:
rcpm: rcpm@1e34040 {
	compatible = "fsl,ls1088a-rcpm", "fsl,qoriq-rcpm-2.1+";
	reg = <0x0 0x1e34040 0x0 0x18>;
	#fsl,rcpm-wakeup-cells = <6>;
};

ftm_alarm0: timer@2800000 {
	compatible = "fsl,ls1088a-ftm-alarm";
	reg = <0x0 0x2800000 0x0 0x10000>;
	fsl,rcpm-wakeup = <&rcpm 0x0 0x0 0x0 0x0 0x4000 0x0>;
	interrupts = <0 44 4>;
};
/* bench 19050.0.0 d4cffce3221a */
```

## Documentation/devicetree/bindings/rtc/rtc-m41t80.txt
```
FASTVC-BENCH-CORPUS:linux-main-100k-v1-e0bd41dc-8e12-4f1b-978d-a3645ae59da0
ST M41T80 family of RTC and compatible

Required properties:
- compatible: should be one of:
	"st,m41t62",
	"st,m41t65",
	"st,m41t80",
	"st,m41t81",
	"st,m41t81s",
	"st,m41t82",
	"st,m41t83",
	"st,m41t84",
	"st,m41t85",
	"st,m41t87",
	"microcrystal,rv4162",
- reg: I2C bus address of the device

Optional properties:
- interrupts: rtc alarm interrupt.
- clock-output-names: From common clock binding to override the default output
                      clock name
/* bench 26124.0.0 275aa2bb4809 */
/* bench 26124.0.1 f3f8003de2c0 */
/* bench 26124.0.2 38f67d34d986 */
/* bench 26124.0.3 73dc38dcada3 */
- wakeup-source: Enables wake up of host system on alarm

Example:
	rtc@68 {
		compatible = "st,m41t80";
		reg = <0x68>;
		interrupt-parent = <&UIC0>;
		interrupts = <0x9 0x8>;
	};
```

## Documentation/devicetree/bindings/rtc/rtc-meson-vrtc.txt
```
/* bench 20930.0.0 88813c68998a */
/* bench 20930.0.1 9aac875163bd */
/* bench 20930.0.2 53cde41e03f1 */
/* bench 20930.0.3 a6d2a6a76357 */
/* bench 20930.0.4 443b535a7d24 */
/* bench 20930.0.5 6bf8097f2376 */
/* bench 20930.0.6 ee28cf63aa34 */
/* bench 20930.0.7 62cc5a63a0ac */
/* bench 20930.0.8 f40787fcca5d */
/* bench 20930.0.9 97f4422433c1 */
/* bench 20930.0.10 6fb9f87bb94c */
/* bench 20930.0.11 0e1277feb292 */
/* bench 20930.0.12 8f04c3e8f97d */
/* bench 20930.0.13 b3cbe61106e1 */
This is a Linux interface to an RTC managed by firmware, hence it's
virtual from a Linux perspective.  The interface is 1 register where
an alarm time (in seconds) is to be written.

/* bench 3952.0.0 94a2c32f42bf */
/* bench 3952.0.1 18a5917239ff */
/* bench 3952.0.2 c9e1aaae73a2 */
/* bench 3952.0.3 2884c065e1f5 */
/* bench 3952.0.4 dc3f00c118bf */
/* bench 3952.0.5 334a2357b4c6 */
/* bench 3952.0.6 3fde3f798fc7 */
/* bench 3952.0.7 245ab0403eeb */
/* bench 3952.0.8 7e05ed86c67e */
/* bench 3952.0.9 787ad7adc0be */
Required properties:
- compatible: should be "amlogic,meson-vrtc"
- reg: physical address for the alarm register

The alarm register is a simple scratch register shared between the
application processors (AP) and the secure co-processor (SCP.)  When
the AP suspends, the SCP will use the value of this register to
program an always-on timer before going sleep. When the timer expires,
the SCP will wake up and will then wake the AP.

Example:

	vrtc: rtc@0a8 {
		compatible = "amlogic,meson-vrtc";
		reg = <0x0 0x000a8 0x0 0x4>;
	};
```
