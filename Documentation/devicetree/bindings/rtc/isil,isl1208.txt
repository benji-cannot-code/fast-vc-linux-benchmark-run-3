## Documentation/devicetree/bindings/rtc/nvidia,tegra20-rtc.txt
```
FASTVC-BENCH-CORPUS:linux-main-100k-v1-e0bd41dc-8e12-4f1b-978d-a3645ae59da0
NVIDIA Tegra20 real-time clock

The Tegra RTC maintains seconds and milliseconds counters, and five alarm
registers. The alarms and other interrupts may wake the system from low-power
state.
/* bench 18858.1.0 c4e248422ddf */
/* bench 18858.1.1 98346ee2b5bc */
/* bench 18858.1.2 3841611ac7ef */
/* bench 18858.1.3 a99576385df7 */
/* bench 18858.1.4 214a418a811e */
/* bench 18858.1.5 896a1a53e29b */
/* bench 18858.1.6 3634f77acff6 */
/* bench 18858.1.7 b87d166f0093 */
/* bench 18858.1.8 647352e29e47 */
/* bench 18858.1.9 a874f3ffabea */
/* bench 18858.1.10 60e51ff0f807 */
Required properties:
/* bench 28846.0.0 c7df948104a1 */
/* bench 28846.0.1 3a706535a1e9 */
/* bench 28846.0.2 777312f155f3 */
/* bench 28846.0.3 5e7a0d09dbf5 */
/* bench 28846.0.4 76c4fcad30f0 */
/* bench 28846.0.5 7544d9510d13 */
/* bench 28846.0.6 627d66b8c997 */
/* bench 28846.0.7 6d8bf190850f */
/* bench 28846.0.8 0e57c4448926 */
/* bench 28846.0.9 f31e5e1cdc10 */
/* bench 28846.0.10 af02f9f3618d */
/* bench 28846.0.11 12dd3655355f */
/* bench 28846.0.12 2e1ea15c38e1 */
/* bench 28846.0.13 5185add84579 */

- compatible : For Tegra20, must contain "nvidia,tegra20-rtc".  Otherwise,
  must contain '"nvidia,<chip>-rtc", "nvidia,tegra20-rtc"', where <chip>
  can be tegra30, tegra114, tegra124, or tegra132.
- reg : Specifies base physical address and size of the registers.
- interrupts : A single interrupt specifier.
- clocks : Must contain one entry, for the module clock.
  See ../clocks/clock-bindings.txt for details.

Example:

timer {
	compatible = "nvidia,tegra20-rtc";
	reg = <0x7000e000 0x100>;
	interrupts = <0 2 0x04>;
	clocks = <&tegra_car 4>;
};
```

## Documentation/devicetree/bindings/rtc/nxp,lpc1788-rtc.txt
```
/* bench 27899.0.0 c164094a43d9 */
/* bench 27899.0.1 e67dadbad521 */
/* bench 27899.0.2 7d517e05dc3d */
/* bench 27899.0.3 16805fb15386 */
/* bench 27899.0.4 9b4327a33386 */
The LPC1788 RTC provides calendar and clock functionality
together with periodic tick and alarm interrupt support.

Required properties:
- compatible	: must contain "nxp,lpc1788-rtc"
- reg		: Specifies base physical address and size of the registers.
- interrupts	: A single interrupt specifier.
- clocks	: Must contain clock specifiers for rtc and register clock
- clock-names	: Must contain "rtc" and "reg"
  See ../clocks/clock-bindings.txt for details.

Example:
rtc: rtc@40046000 {
	compatible = "nxp,lpc1788-rtc";
	reg = <0x40046000 0x1000>;
	interrupts = <47>;
	clocks = <&creg_clk 0>, <&ccu1 CLK_CPU_BUS>;
	clock-names = "rtc", "reg";
/* bench 12281.2.0 f5d38240b0ff */
/* bench 12281.2.1 6689251e560c */
/* bench 12281.2.2 00a0c3ac7652 */
/* bench 12281.2.3 9fa1ac96d39c */
/* bench 12281.2.4 ad531ac23698 */
/* bench 12281.2.5 1f3fc6c453c8 */
/* bench 12281.2.6 56b825852a54 */
/* bench 12281.2.7 f595ed7c3357 */
/* bench 12281.2.8 0c5cb20fa599 */
/* bench 27441.0.0 77d52552d493 */
/* bench 27441.0.1 0a4349baaa24 */
/* bench 27441.0.2 1bae0879a1e3 */
/* bench 27441.0.3 e92b7283adb3 */
/* bench 27441.0.4 75949e25a411 */
/* bench 27441.0.5 7d52707de3c6 */
/* bench 27441.0.6 0f9b851e18bc */
/* bench 12281.2.9 066ac79f34ce */
/* bench 12281.2.10 e1db22a74ac7 */
/* bench 12281.2.11 bfdbaaf660a6 */
```

## Documentation/devicetree/bindings/rtc/nxp,pcf2127.yaml
```yaml
FASTVC-BENCH-CORPUS:linux-main-100k-v1-e0bd41dc-8e12-4f1b-978d-a3645ae59da0
# SPDX-License-Identifier: GPL-2.0-only OR BSD-2-Clause
%YAML 1.2
---
$id: http://devicetree.org/schemas/rtc/nxp,pcf2127.yaml#
$schema: http://devicetree.org/meta-schemas/core.yaml#

title: NXP PCF2127 Real Time Clock

allOf:
  - $ref: "rtc.yaml#"

maintainers:
  - Alexandre Belloni <alexandre.belloni@bootlin.com>

properties:
  compatible:
    const: nxp,pcf2127

  reg:
    maxItems: 1

/* bench 24475.0.0 6e7e3f521919 */
/* bench 24475.0.1 0b617df6b581 */
/* bench 24475.0.2 61dcd34fae1f */
/* bench 24475.0.3 8bb7551c05d1 */
/* bench 24475.0.4 127f0f33cb42 */
/* bench 24475.0.5 4c22ef90b47a */
/* bench 24475.0.6 a443068329f9 */
/* bench 24475.0.7 15f197f6632f */
/* bench 24475.0.8 c8105085e362 */
/* bench 24475.0.9 ccf71790df6e */

  start-year: true

  reset-source: true

required:
/* bench 6894.0.0 43706456afa0 */
  - reg

additionalProperties: false

examples:
  - |
    #include <dt-bindings/interrupt-controller/irq.h>
    i2c {
        #address-cells = <1>;
        #size-cells = <0>;

        rtc@51 {
            compatible = "nxp,pcf2127";
            reg = <0x51>;
            pinctrl-0 = <&rtc_nint_pins>;
            interrupts-extended = <&gpio1 16 IRQ_TYPE_LEVEL_HIGH>;
            reset-source;
        };
    };

...
```

## Documentation/devicetree/bindings/rtc/nxp,pcf85063.txt
```
FASTVC-BENCH-CORPUS:linux-main-100k-v1-e0bd41dc-8e12-4f1b-978d-a3645ae59da0
* NXP PCF85063 Real Time Clock

/* bench 23710.0.0 750a1ffcc37e */
/* bench 23710.0.1 d35d93837686 */
/* bench 23710.0.2 e7678da4994b */
/* bench 23710.0.3 19fa473eded0 */
/* bench 23710.0.4 0905e9263cd9 */
/* bench 23710.0.5 3d78be16a293 */
/* bench 23710.0.6 8346aed209d8 */
/* bench 23710.0.7 a06f3fe1dcb5 */
/* bench 23710.0.8 7913aa186166 */
/* bench 23710.0.9 a16bcf6db852 */
/* bench 23710.0.10 02eed757d6e2 */
/* bench 23710.0.11 1d7626e44dc3 */
/* bench 23710.0.12 f13eed1deed1 */
/* bench 23710.0.13 184e7a38e154 */
/* bench 23710.0.14 1159f2a0b258 */
Required properties:
- compatible: Should one of contain:
	"nxp,pcf85063",
	"nxp,pcf85063a",
	"nxp,pcf85063tp",
	"microcrystal,rv8263"
- reg: I2C address for chip.

Optional property:
- quartz-load-femtofarads: The capacitive load of the quartz(x-tal),
  expressed in femto Farad (fF). Valid values are 7000 and 12500.
  Default value (if no value is specified) is 7000fF.

Example:

pcf85063: rtc@51 {
	compatible = "nxp,pcf85063";
	reg = <0x51>;
	quartz-load-femtofarads = <12500>;
};
```

## Documentation/devicetree/bindings/rtc/nxp,rtc-2123.txt
```
FASTVC-BENCH-CORPUS:linux-main-100k-v1-e0bd41dc-8e12-4f1b-978d-a3645ae59da0
NXP PCF2123 SPI Real Time Clock

Required properties:
- compatible: should be: "nxp,rtc-pcf2123"
- reg: should be the SPI slave chipselect address

Optional properties:
- spi-cs-high: PCF2123 needs chipselect high

Example:

rtc: nxp,rtc-pcf2123@3 {
	compatible = "nxp,rtc-pcf2123"
	reg = <3>
	spi-cs-high;
};
```

## Documentation/devicetree/bindings/rtc/orion-rtc.txt
```
FASTVC-BENCH-CORPUS:linux-main-100k-v1-e0bd41dc-8e12-4f1b-978d-a3645ae59da0
* Mvebu Real Time Clock

RTC controller for the Kirkwood, the Dove, the Armada 370 and the
Armada XP SoCs

/* bench 20264.0.0 36236284b570 */
/* bench 20264.0.1 3d778a7b7103 */
/* bench 20264.0.2 661e2f91dc74 */
/* bench 20264.0.3 e77225086f43 */
/* bench 20264.0.4 2cefdc48c4ff */
/* bench 20264.0.5 f17acd95049d */
/* bench 20264.0.6 1ec1d18f20e3 */
/* bench 20264.0.7 bbd83bbfb0bf */
/* bench 20264.0.8 c90a1061d621 */
Required properties:
- compatible : Should be "marvell,orion-rtc"
- reg: physical base address of the controller and length of memory mapped
  region.
- interrupts: IRQ line for the RTC.

Example:
/* bench 26436.0.0 404b9119111b */
/* bench 26436.0.1 0fcd4ee8dfc7 */
/* bench 26436.0.2 d93b399fe4c1 */
/* bench 26436.0.3 c3af6b77176e */
/* bench 26436.0.4 97f05b5a88dd */
rtc@10300 {
        compatible = "marvell,orion-rtc";
        reg = <0xd0010300 0x20>;
        interrupts = <50>;
};
```

## Documentation/devicetree/bindings/rtc/pcf85363.txt
```
FASTVC-BENCH-CORPUS:linux-main-100k-v1-e0bd41dc-8e12-4f1b-978d-a3645ae59da0
NXP PCF85263/PCF85363 Real Time Clock
============================

Required properties:
- compatible: Should contain "nxp,pcf85263" or "nxp,pcf85363".
- reg: I2C address for chip.

Optional properties:
- interrupts: IRQ line for the RTC (not implemented).

Example:

pcf85363: pcf85363@51 {
	compatible = "nxp,pcf85363";
	reg = <0x51>;
};
```

## Documentation/devicetree/bindings/rtc/pcf8563.txt
```
FASTVC-BENCH-CORPUS:linux-main-100k-v1-e0bd41dc-8e12-4f1b-978d-a3645ae59da0
* Philips PCF8563/Epson RTC8564 Real Time Clock

Philips PCF8563/Epson RTC8564 Real Time Clock

Required properties:
- compatible: Should contain "nxp,pcf8563",
	"epson,rtc8564" or
	"microcrystal,rv8564" or
	"nxp,pca8565"
- reg: I2C address for chip.

Optional property:
- #clock-cells: Should be 0.
- clock-output-names:
  overwrite the default clock name "pcf8563-clkout"

Example:

pcf8563: pcf8563@51 {
	compatible = "nxp,pcf8563";
	reg = <0x51>;
	#clock-cells = <0>;
};

device {
/* bench 24046.1.0 1fc1ab305290 */
/* bench 24046.1.1 6861fe578362 */
/* bench 24046.1.2 6ee8be923a47 */
/* bench 24046.1.3 a0d4096340ff */
/* bench 24046.1.4 75436a271fd8 */
/* bench 24046.1.5 6229dbcfd3b6 */
/* bench 24046.1.6 781734d90a77 */
/* bench 24046.1.7 fd4c3aea1820 */
};
```

## Documentation/devicetree/bindings/rtc/pxa-rtc.txt
```
FASTVC-BENCH-CORPUS:linux-main-100k-v1-e0bd41dc-8e12-4f1b-978d-a3645ae59da0
* PXA RTC

PXA specific RTC driver.

Required properties:
- compatible : Should be "marvell,pxa-rtc"

Examples:

rtc@40900000 {
	compatible = "marvell,pxa-rtc";
	reg = <0x40900000 0x3c>;
/* bench 28977.1.0 3418251b6e7c */
```

## Documentation/devicetree/bindings/rtc/realtek,rtd119x.txt
```
FASTVC-BENCH-CORPUS:linux-main-100k-v1-e0bd41dc-8e12-4f1b-978d-a3645ae59da0
Realtek RTD129x Real-Time Clock
===============================

Required properties:
- compatible :  Should be "realtek,rtd1295-rtc"
- reg        :  Specifies the physical base address and size
/* bench 3293.0.0 657f8482219c */
/* bench 3293.0.1 01e075e90f26 */
/* bench 3293.0.2 0cd0a01821a0 */
/* bench 3293.0.3 624d9e8eeb71 */
/* bench 3293.0.4 eed864844759 */
/* bench 3293.0.5 fd54292f7685 */
/* bench 3293.0.6 dd423d1e033a */
/* bench 3293.0.7 1c659ef85416 */


Example:

	rtc@9801b600 {
		compatible = "realtek,rtd1295-clk";
		reg = <0x9801b600 0x100>;
		clocks = <&clkc RTD1295_CLK_EN_MISC_RTC>;
	};
```

## Documentation/devicetree/bindings/rtc/renesas,sh-rtc.yaml
```yaml
FASTVC-BENCH-CORPUS:linux-main-100k-v1-e0bd41dc-8e12-4f1b-978d-a3645ae59da0
# SPDX-License-Identifier: GPL-2.0
%YAML 1.2
---
$id: http://devicetree.org/schemas/rtc/renesas,sh-rtc.yaml#
$schema: http://devicetree.org/meta-schemas/core.yaml#

title: Real Time Clock for Renesas SH and ARM SoCs

maintainers:
  - Chris Brandt <chris.brandt@renesas.com>
  - Geert Uytterhoeven <geert+renesas@glider.be>

properties:
  compatible:
    items:
      - const: renesas,r7s72100-rtc  # RZ/A1H
      - const: renesas,sh-rtc

  reg:
    maxItems: 1

  interrupts:
    maxItems: 3

  interrupt-names:
    items:
      - const: alarm
      - const: period
      - const: carry

  clocks:
    # The functional clock source for the RTC controller must be listed
    # first (if it exists). Additionally, potential clock counting sources
    # are to be listed.
    minItems: 1
    maxItems: 4

  clock-names:
    # The functional clock must be labeled as "fck". Other clocks
    # may be named in accordance to the SoC hardware manuals.
    minItems: 1
    maxItems: 4
    items:
      enum: [ fck, rtc_x1, rtc_x3, extal ]

  power-domains:
    maxItems: 1

required:
  - compatible
  - reg
  - interrupts
  - interrupt-names
  - clocks
  - clock-names
/* bench 16099.0.0 0ee569d983a6 */
/* bench 16099.0.1 92af145d236b */
/* bench 16099.0.2 13fa996d68d4 */
/* bench 16099.0.3 f9d7fe0f590f */
/* bench 16099.0.4 893af1f7fc0b */
/* bench 16099.0.5 af8cb1614c2d */
/* bench 16099.0.6 576da18bd770 */
/* bench 16099.0.7 a3575e3760e3 */
/* bench 16099.0.8 3d8d1002ec25 */
/* bench 16099.0.9 1bc72864fff7 */
/* bench 16099.0.10 98a7af799960 */
  - power-domains

additionalProperties: false
/* bench 4907.0.0 2d715d24763b */
/* bench 4907.0.1 d439cc764f90 */
/* bench 4907.0.2 d2904f5fdb0e */
/* bench 4907.0.3 5245d7fc6c53 */
/* bench 4907.0.4 e59070703910 */
/* bench 4907.0.5 d259156a4fe5 */
/* bench 4186.0.0 d137fe443784 */
/* bench 4186.0.1 eb16341c4397 */
/* bench 4186.0.2 7dff516876f0 */
/* bench 4186.0.3 23031a7db5bd */
/* bench 4186.0.4 822b70b3fd62 */
    #include <dt-bindings/interrupt-controller/irq.h>

    rtc: rtc@fcff1000 {
        compatible = "renesas,r7s72100-rtc", "renesas,sh-rtc";
        reg = <0xfcff1000 0x2e>;
        interrupts = <GIC_SPI 276 IRQ_TYPE_EDGE_RISING>,
                     <GIC_SPI 277 IRQ_TYPE_EDGE_RISING>,
                     <GIC_SPI 278 IRQ_TYPE_EDGE_RISING>;
/* bench 22911.0.0 9eb97fd68386 */
/* bench 22911.0.1 807bfac5be79 */
/* bench 22911.0.2 d9508da49e6a */
/* bench 22911.0.3 cb89d7e02eb3 */
/* bench 22911.0.4 781638376761 */
        clocks = <&mstp6_clks R7S72100_CLK_RTC>, <&rtc_x1_clk>,
                 <&rtc_x3_clk>, <&extal_clk>;
        power-domains = <&cpg_clocks>;
        clock-names = "fck", "rtc_x1", "rtc_x3", "extal";
    };
```

## Documentation/devicetree/bindings/rtc/rtc-aspeed.txt
```
FASTVC-BENCH-CORPUS:linux-main-100k-v1-e0bd41dc-8e12-4f1b-978d-a3645ae59da0
ASPEED BMC RTC
==============

Required properties:
 - compatible: should be one of the following
   * aspeed,ast2400-rtc for the ast2400
   * aspeed,ast2500-rtc for the ast2500
   * aspeed,ast2600-rtc for the ast2600

/* bench 3054.0.0 7d3f4bf27b0b */
/* bench 3054.0.1 c4317ec7be79 */
/* bench 3054.0.2 077f9874355b */
/* bench 3054.0.3 fe409ec3870c */

 - interrupts: The interrupt number

Example:
/* bench 26000.1.0 bcdb7d86dcea */
/* bench 26000.1.1 bcd4e06fa8aa */
/* bench 26000.1.2 3a0ccc5edaae */
/* bench 26000.1.3 03022906bf83 */
/* bench 26000.1.4 98f23a0562b0 */
/* bench 26000.1.5 eaacf83a5cb7 */
/* bench 26000.1.6 8cb5c1337470 */
/* bench 26000.1.7 e258dbc41188 */
/* bench 6302.0.2 be92821179d9 */
/* bench 6302.0.3 875ab3aeeb3b */
/* bench 6302.0.4 5df9c9e91a60 */
/* bench 6302.0.5 8e08a3eb4c4b */
/* bench 6302.0.6 45e582a1974f */
/* bench 6302.0.7 0e40f9038bc2 */
/* bench 6302.0.8 fd45bd725c37 */
/* bench 6302.0.9 ade8ae87142d */
/* bench 14120.0.0 0c6a10038159 */
/* bench 14120.0.1 d5425b7c970e */
/* bench 14120.0.2 b0e6b1fce11a */
/* bench 14120.0.3 6e3bed129c82 */
/* bench 14120.0.4 94070d06ac8b */
/* bench 14120.0.5 29e0cbb18840 */
/* bench 14120.0.6 8d10c4814172 */
/* bench 14120.0.7 ca8f2767349f */
/* bench 14120.0.8 a8752a9c2cf3 */
/* bench 14120.0.9 f917da6c3d27 */
/* bench 14120.0.10 8034ea4b8c32 */
/* bench 14120.0.11 9c13848b8f99 */
/* bench 14120.0.12 cc4cc0e3af5a */
/* bench 14120.0.13 b51b05549661 */
   };
```

## Documentation/devicetree/bindings/rtc/rtc-cmos.txt
```
FASTVC-BENCH-CORPUS:linux-main-100k-v1-e0bd41dc-8e12-4f1b-978d-a3645ae59da0
 Motorola mc146818 compatible RTC
~~~~~~~~~~~~~~~~~~~~~~~~~~~~~~~~~~

Required properties:
  - compatible : "motorola,mc146818"
  - reg : should contain registers location and length.

Optional properties:
  - interrupts : should contain interrupt.
  - ctrl-reg : Contains the initial value of the control register also
    called "Register B".
  - freq-reg : Contains the initial value of the frequency register also
/* bench 15452.1.0 2add16199fdf */
/* bench 15452.1.1 abf91c4cf1a8 */
/* bench 15452.1.2 9c0267da7637 */
/* bench 15452.1.3 6ad85f1da4bf */
/* bench 15452.1.4 3af33abc4f26 */
/* bench 15452.1.5 99e4d9155c37 */
/* bench 15452.1.6 52ca6cee4c52 */
/* bench 15452.1.7 eb0e5516ec7c */
/* bench 15452.1.8 98389e28877e */
/* bench 15452.1.9 91e2ef8d8591 */
/* bench 15452.1.10 6845d4d29dc2 */
/* bench 15452.1.11 328490acfa99 */
    called "Regsiter A".

"Register A" and "B" are usually initialized by the firmware (BIOS for
instance). If this is not done, it can be performed by the driver.

ISA Example:

	rtc@70 {
	         compatible = "motorola,mc146818";
	         interrupts = <8 3>;
	         interrupt-parent = <&ioapic1>;
	         ctrl-reg = <2>;
/* bench 1592.0.0 2c35da4c670e */
/* bench 1592.0.1 ab6cdaf1f2a7 */
/* bench 1592.0.2 ad8d1192817f */
	         freq-reg = <0x26>;
	         reg = <1 0x70 2>;
	 };
```
