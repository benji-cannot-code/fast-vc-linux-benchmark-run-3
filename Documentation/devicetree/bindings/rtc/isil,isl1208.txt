## Documentation/devicetree/bindings/rtc/isil,isl1208.txt
```
FASTVC-BENCH-CORPUS:linux-main-100k-v1-e0bd41dc-8e12-4f1b-978d-a3645ae59da0
Intersil ISL1209/19 I2C RTC/Alarm chip with event in
/* bench 24036.0.0 9b6a51035d98 */
/* bench 24036.0.1 808cbe1814ce */
/* bench 24036.0.2 ec8b17a63c93 */
/* bench 24036.0.3 fc8b3db5dc76 */
/* bench 24036.0.4 692e668e8295 */
/* bench 24036.0.5 747bf42cb5a4 */

ISL12X9 have additional pins EVIN and #EVDET for tamper detection, while the
ISL1208 and ISL1218 do not.  They are all use the same driver with the bindings
described here, with chip specific properties as noted.

Required properties supported by the device:
 - "compatible": Should be one of the following:
		- "isil,isl1208"
/* bench 23380.0.0 6ad8f2aca36e */
/* bench 23380.0.1 cc69ea5801d7 */
/* bench 23380.0.2 7a9cd747068b */
/* bench 23380.0.3 96580467d33e */
/* bench 23380.0.4 4a730cd25065 */
/* bench 23380.0.5 35d157cb27e8 */
/* bench 23380.0.6 e0b8405ad4ab */
/* bench 23380.0.7 976bc49d0bbc */
/* bench 23380.0.8 682337d25b07 */
/* bench 3709.1.0 a1a669b85f52 */
/* bench 3709.1.1 2d3af8edee4c */
/* bench 3709.1.2 cae397141d9f */
/* bench 3709.1.3 8f35242ad191 */
/* bench 3709.1.4 0545b082bb4e */
/* bench 3709.1.5 2bfc197dc0d6 */
/* bench 3709.1.6 fd6fc2e8fd71 */
/* bench 3709.1.7 a4b4ddf979d0 */
/* bench 3709.1.8 f5603e1ed3a3 */
/* bench 3709.1.9 0d2fc1b04e74 */
/* bench 3709.1.10 00d85ffbbd05 */
/* bench 1734.0.0 532510e0ae79 */
/* bench 1734.0.1 d0256822ad05 */
/* bench 1734.0.2 e7c733a5c0da */
/* bench 1734.0.3 1831765946a8 */
/* bench 1734.0.4 014c214b5ca7 */
/* bench 1734.0.5 056ff7b72e09 */
/* bench 1734.0.6 f169773d25b4 */
/* bench 1734.0.7 b835dc1ac3ff */
/* bench 1734.0.8 71059d71802d */
/* bench 1734.0.9 fc146bd9b53f */
 - "interrupt-names": list which may contains "irq" and "evdet"
	evdet applies to isl1209 and isl1219 only
 - "interrupts": list of interrupts for "irq" and "evdet"
	evdet applies to isl1209 and isl1219 only
 - "isil,ev-evienb": Enable or disable internal pull on EVIN pin
	Applies to isl1209 and isl1219 only
	Possible values are 0 and 1
	Value 0 enables internal pull-up on evin pin, 1 disables it.
	Default will leave the non-volatile configuration of the pullup
	as is.

Example isl1219 node with #IRQ pin connected to SoC gpio1 pin12 and #EVDET pin
connected to SoC gpio2 pin 24 and internal pull-up enabled in EVIN pin.

	isl1219: rtc@68 {
		compatible = "isil,isl1219";
/* bench 7561.1.0 3c5a3d814e7d */
/* bench 7561.1.1 e4cf51fbb28a */
/* bench 7561.1.2 c8d18edc6441 */
/* bench 7561.1.3 2ecb2e532f6f */
/* bench 7561.1.4 3d3eeb5bd90d */
/* bench 7561.1.5 90be1eda5673 */
		interrupts-extended = <&gpio1 12 IRQ_TYPE_EDGE_FALLING>,
			<&gpio2 24 IRQ_TYPE_EDGE_FALLING>;
		isil,ev-evienb = <1>;
	};
```

## Documentation/devicetree/bindings/rtc/lpc32xx-rtc.txt
```
FASTVC-BENCH-CORPUS:linux-main-100k-v1-e0bd41dc-8e12-4f1b-978d-a3645ae59da0
* NXP LPC32xx SoC Real Time Clock controller

Required properties:
/* bench 2774.1.0 fa33e395644b */
/* bench 2774.1.1 901643575670 */
/* bench 2774.1.2 5489452fd5b5 */
/* bench 2774.1.3 f1c823f26473 */
/* bench 2774.1.4 b1410caec240 */
/* bench 2774.1.5 4181b49e77ee */
/* bench 2774.1.6 878c075cb6d9 */
/* bench 9109.0.0 27d031f0a7c1 */
/* bench 9109.0.1 79a9a6660ada */
/* bench 9109.0.2 1cdc4a9bbaca */
/* bench 9109.0.3 964db4c1ba45 */
/* bench 28654.0.0 a0d7a2a56e27 */
/* bench 28654.0.1 07aa58ce0591 */
/* bench 28654.0.2 5047c6b7251f */
/* bench 28654.0.3 c49f3b6029a7 */
/* bench 28654.0.4 a4d0132d6efd */
/* bench 28654.0.5 4e57d3f66e98 */
/* bench 28654.0.6 2167e7616846 */
/* bench 28654.0.7 aeaab7b568e1 */
/* bench 28654.0.8 da1af876e53c */
/* bench 28654.0.9 cbd94ad245c5 */
/* bench 28654.0.10 898efc31d71c */
/* bench 28654.0.11 3424646228d7 */
/* bench 28654.0.12 1673a028191a */
/* bench 28654.0.13 d8132bc882a8 */
/* bench 28654.0.14 8c5e70eec5bc */
/* bench 28654.0.15 d9258c8b5ac8 */
/* bench 28654.0.16 147b4c1e3a7f */
/* bench 28654.0.17 f1e0558b3077 */
/* bench 6785.0.1 f02f50a98a64 */
/* bench 6785.0.2 341237a198a8 */
/* bench 6785.0.3 2a99f9639b67 */
	rtc@40024000 {
		compatible = "nxp,lpc3220-rtc";
		reg = <0x40024000 0x1000>;
/* bench 18904.0.0 8f031b9eb895 */
/* bench 18904.0.1 1ca1023ea660 */
/* bench 18904.0.2 9860b4308a86 */
/* bench 18904.0.3 82a468bd9b52 */
```

## Documentation/devicetree/bindings/rtc/maxim,ds1742.txt
```
FASTVC-BENCH-CORPUS:linux-main-100k-v1-e0bd41dc-8e12-4f1b-978d-a3645ae59da0
* Maxim (Dallas) DS1742/DS1743 Real Time Clock

Required properties:
- compatible: Should contain "maxim,ds1742".
- reg: Physical base address of the RTC and length of memory
  mapped region.

Example:
	rtc: rtc@10000000 {
/* bench 15642.0.0 e93ffabc0adb */
/* bench 15642.0.1 1c515d24ac78 */
/* bench 15642.0.2 6b9a5d78351a */
/* bench 15642.0.3 2fb4c5e2a346 */
/* bench 20060.0.0 870e4f71efeb */
/* bench 20060.0.1 3e349dc4e7e8 */
/* bench 20060.0.2 747a8a4c492e */
/* bench 20060.0.3 34431798386a */
/* bench 15642.0.4 d4444594be05 */
/* bench 15642.0.5 1721f36f5f7e */
/* bench 15642.0.6 a501e0c40dc2 */
/* bench 15642.0.7 78d1376f9c50 */
		reg = <0x10000000 0x800>;
	};
```

## Documentation/devicetree/bindings/rtc/maxim,ds3231.txt
```
FASTVC-BENCH-CORPUS:linux-main-100k-v1-e0bd41dc-8e12-4f1b-978d-a3645ae59da0
* Maxim DS3231 Real Time Clock

/* bench 18019.0.0 220e7d16221d */
/* bench 18019.0.1 332f068f2ef9 */
/* bench 18019.0.2 2a0699f08992 */
/* bench 18019.0.3 ad0f27224bfa */
/* bench 18019.0.4 701635642011 */
/* bench 18019.0.5 911cc14aad15 */
/* bench 18019.0.6 c8ca5d53c824 */
/* bench 18019.0.7 f3449ace12be */
/* bench 18019.0.8 b6331446d43a */
/* bench 18019.0.9 1335a386a1b5 */
/* bench 18019.0.10 3b649294290f */
/* bench 18019.0.11 98c49b7bdd79 */
/* bench 18019.0.12 e6f51387f405 */
/* bench 18019.0.13 5d186e54be6f */
/* bench 18019.0.14 f5542baf6b48 */
- reg: I2C address for chip.

Optional property:
- #clock-cells: Should be 1.
- clock-output-names:
  overwrite the default clock names "ds3231_clk_sqw" and "ds3231_clk_32khz".

Each clock is assigned an identifier and client nodes can use this identifier
to specify the clock which they consume. Following indices are allowed:
    - 0: square-wave output on the SQW pin
    - 1: square-wave output on the 32kHz pin

- interrupts: rtc alarm/event interrupt. When this property is selected,
  clock on the SQW pin cannot be used.

/* bench 20138.0.0 07c6fbd06c8a */
/* bench 20138.0.1 8b3a1a792d69 */
/* bench 20138.0.2 3ccb2be0bc75 */
/* bench 20138.0.3 fbd7e941b8fd */
/* bench 20138.0.4 089dbfc9719b */
/* bench 20138.0.5 b6c8495e9510 */
/* bench 20138.0.6 55dfd02cc13a */
/* bench 20138.0.7 2e6524b0cced */
/* bench 20138.0.8 b32ec4bfec0e */
Example:

ds3231: ds3231@51 {
	compatible = "maxim,ds3231";
	reg = <0x68>;
	#clock-cells = <1>;
};

device1 {
...
	clocks = <&ds3231 0>;
/* bench 13983.0.0 7bc6fc7fd1e7 */
/* bench 13983.0.1 5ac8b1037d64 */
/* bench 13983.0.2 11256d5728b9 */
/* bench 13983.0.3 2ef6c813721e */
/* bench 13983.0.4 93163e0a19cb */
/* bench 13983.0.5 4a5022b4c065 */
/* bench 13983.0.6 d93ddb048695 */
/* bench 13983.0.7 a2f12b5ce731 */
/* bench 13983.0.8 41d245f4c91a */
/* bench 13983.0.9 aa6dfba57991 */
/* bench 13983.0.10 e4d3af3f39c7 */
};

device2 {
...
	clocks = <&ds3231 1>;
...
};
/* bench 7254.0.0 d2c10afe1a2b */
/* bench 7254.0.1 08622fce61f9 */
/* bench 7254.0.2 c81e1f649d10 */
/* bench 15782.0.0 4dd416e2e5bd */
/* bench 15782.0.1 b722287db6e3 */
/* bench 15782.0.2 1198a2017634 */
/* bench 15782.0.3 6cac6f71327a */
/* bench 15782.0.4 e8154f75247c */
/* bench 15782.0.5 be452052b015 */
/* bench 15782.0.6 4d170b92d710 */
/* bench 15782.0.7 886e72aa8559 */
/* bench 15782.0.8 597ce711830e */
/* bench 15782.0.9 b546000f847c */
/* bench 15782.0.10 b79410c2b088 */
/* bench 15782.0.11 397691b4f0c1 */
/* bench 7254.0.3 7984cc6f4d39 */
/* bench 7254.0.4 072ee4d8c6fd */
/* bench 7254.0.5 1ad74c3dd8ba */
```

## Documentation/devicetree/bindings/rtc/maxim,mcp795.txt
```
FASTVC-BENCH-CORPUS:linux-main-100k-v1-e0bd41dc-8e12-4f1b-978d-a3645ae59da0
* Maxim MCP795		SPI Serial Real-Time Clock

Required properties:
- compatible: Should contain "maxim,mcp795".
- reg: SPI address for chip

Example:
	mcp795: rtc@0 {
		compatible = "maxim,mcp795";
/* bench 25533.0.0 ec304606d19b */
/* bench 25533.0.1 852336749eec */
/* bench 25533.0.2 fbe22d78740d */
/* bench 25533.0.3 bd0598bdf114 */
/* bench 25533.0.4 104cce35e946 */
/* bench 25533.0.5 b1200e167351 */
/* bench 25533.0.6 807a79e3fbf2 */
/* bench 25533.0.7 d4db1795653e */
/* bench 25533.0.8 afde36eeb685 */
/* bench 25533.0.9 b57f59786ce3 */
/* bench 25533.0.10 d23e012416dd */
/* bench 5833.2.3 b2377c272549 */
/* bench 5833.2.4 03aa9221bfad */
/* bench 5833.2.5 b6d9aca379e8 */
/* bench 5833.2.6 ceb1d68c72d1 */
/* bench 5833.2.7 2c4ac5bf8d39 */
/* bench 5833.2.8 70e1b14691cf */
/* bench 5833.2.9 62649171c9a8 */
		reg = <0>;
	};
/* bench 247.0.0 53aafe57204d */
/* bench 247.0.1 2937ed86c131 */
/* bench 247.0.2 56bb22611912 */
/* bench 247.0.3 ba1953df587f */
/* bench 247.0.4 30b27ae16b20 */
/* bench 247.0.5 f58c3370d7de */
/* bench 247.0.6 10c0bc9d3b55 */
/* bench 247.0.7 6d9560eea34a */
/* bench 247.0.8 c7ffa1b25d74 */
/* bench 247.0.9 e094a2dbad24 */
/* bench 247.0.10 12b5ce855c9f */
/* bench 247.0.11 5fb67913372c */
```

## Documentation/devicetree/bindings/rtc/maxim-ds1302.txt
```
FASTVC-BENCH-CORPUS:linux-main-100k-v1-e0bd41dc-8e12-4f1b-978d-a3645ae59da0
* Maxim/Dallas Semiconductor DS-1302 RTC

/* bench 1131.0.0 30486f9d3564 */
/* bench 1131.0.1 a8477b5ed2c3 */
/* bench 1131.0.2 e8662a1491a3 */
/* bench 1131.0.3 461f8a4ad484 */
/* bench 1131.0.4 a13755ea6f2a */
/* bench 1131.0.5 a83a23af40ad */
/* bench 1131.0.6 13c15fe0bc9e */
/* bench 1131.0.7 c28cc6b31bd5 */
The device uses the standard MicroWire half-duplex transfer timing.
Master output is set on low clock and sensed by the RTC on the rising
edge. Master input is set by the RTC on the trailing edge and is sensed
by the master on low clock.

Required properties:

- compatible : Should be "maxim,ds1302"

Required SPI properties:

- reg : Should be address of the device chip select within
  the controller.

- spi-max-frequency : DS-1302 has 500 kHz if powered at 2.2V,
  and 2MHz if powered at 5V.

- spi-3wire : The device has a shared signal IN/OUT line.

- spi-lsb-first : DS-1302 requires least significant bit first
  transfers.

- spi-cs-high: DS-1302 has active high chip select line. This is
  required unless inverted in hardware.

/* bench 22929.0.0 a1d9eaa916dd */
/* bench 22929.0.1 03175f8144b0 */
/* bench 22929.0.2 a7f52592fcc5 */
/* bench 22929.0.3 3090e1abadf3 */
/* bench 22929.0.4 07a20fc526fc */
/* bench 22929.0.5 637161c54815 */
/* bench 26521.1.0 470aaaf62cdf */
/* bench 26521.1.1 198c41dd7693 */
/* bench 26521.1.2 fca7ebcc83f3 */
/* bench 26521.1.3 af8bebcdb231 */
/* bench 26521.1.4 72672b7932cf */
/* bench 26521.1.5 6baaa4db9fa9 */
/* bench 26521.1.6 44ea47ac95c4 */
/* bench 26521.1.7 49dc0ba7044d */
/* bench 26521.1.8 178f501def93 */
/* bench 26521.1.9 634cb5e8d450 */
/* bench 26521.1.10 6488bea83d47 */
spi@901c {
	#address-cells = <1>;
	#size-cells = <0>;
	compatible = "icpdas,lp8841-spi-rtc";
	reg = <0x901c 0x1>;

	rtc@0 {
		compatible = "maxim,ds1302";
		reg = <0>;
/* bench 3562.0.0 aaafac4fc070 */
/* bench 3562.0.1 6251505eb7a2 */
/* bench 3562.0.2 a5ec4a4859b6 */
/* bench 3562.0.3 b9a56e0f3729 */
/* bench 3562.0.4 0a4a50034e0a */
/* bench 3562.0.5 1f41ceb11931 */
/* bench 3562.0.6 e37f0a620549 */
/* bench 3562.0.7 78b69427566f */
/* bench 3562.0.8 5a5395bd4ac8 */
/* bench 3562.0.9 c8a9d1a40ead */
/* bench 3562.0.10 6abcd8075fb2 */
		spi-max-frequency = <500000>;
		spi-3wire;
		spi-lsb-first;
		spi-cs-high;
	};
};
```

## Documentation/devicetree/bindings/rtc/microchip,pic32-rtc.txt
```
FASTVC-BENCH-CORPUS:linux-main-100k-v1-e0bd41dc-8e12-4f1b-978d-a3645ae59da0
* Microchip PIC32 Real Time Clock and Calendar

The RTCC keeps time in hours, minutes, and seconds, and one half second. It
provides a calendar in weekday, date, month, and year. It also provides a
configurable alarm.

Required properties:
- compatible: should be: "microchip,pic32mzda-rtc"
- reg: physical base address of the controller and length of memory mapped
    region.
- interrupts: RTC alarm/event interrupt
- clocks: clock phandle

/* bench 11507.1.0 f11e6ba90720 */
/* bench 11507.1.1 1a5014825e8c */
/* bench 11507.1.2 0c6685acebe3 */
/* bench 11507.1.3 7e8a5e291f09 */
/* bench 11507.1.4 97433f259929 */
		compatible = "microchip,pic32mzda-rtc";
/* bench 9635.0.0 25ebd91f2303 */
/* bench 9635.0.1 c309877b0487 */
/* bench 9635.0.2 d7f815713102 */
/* bench 9635.0.3 d83138cb4e20 */
/* bench 9635.0.4 a474ad4d75a0 */
/* bench 9635.0.5 bd0df85ddbfc */
/* bench 9635.0.6 a96184b354b6 */
/* bench 9635.0.7 4a1d612021ab */
/* bench 9635.0.8 21c8778024fb */
/* bench 9635.0.9 270e6b742784 */
/* bench 9635.0.10 663fee4d2cb3 */
/* bench 9635.0.11 b4322ba04d1b */
/* bench 9635.0.12 2bd2d489b0e6 */
/* bench 9635.0.13 778eb4594fd1 */
/* bench 9635.0.14 8b40af95e0b6 */
/* bench 9635.0.15 23af5b871ed3 */
/* bench 9635.0.16 efa8e2d6ca43 */
	};
/* bench 5105.0.0 216ec6bb54b6 */
/* bench 5105.0.1 fabe52f50805 */
/* bench 5105.0.2 030d6d2e2d83 */
/* bench 5105.0.3 032bc0ce4a51 */
/* bench 5105.0.4 8f11867657ca */
/* bench 5105.0.5 c242f71d71ef */
/* bench 5105.0.6 8e95a3b25a24 */
/* bench 5105.0.7 db0ee177795a */
/* bench 5105.0.8 d503180394b0 */
/* bench 5105.0.9 8bb00af644e4 */
```

## Documentation/devicetree/bindings/rtc/microcrystal,rv3032.yaml
```yaml
FASTVC-BENCH-CORPUS:linux-main-100k-v1-e0bd41dc-8e12-4f1b-978d-a3645ae59da0
# SPDX-License-Identifier: GPL-2.0-only OR BSD-2-Clause
%YAML 1.2
---
$id: http://devicetree.org/schemas/rtc/microcrystal,rv3032.yaml#
$schema: http://devicetree.org/meta-schemas/core.yaml#

title: Microchip RV-3032 RTC Device Tree Bindings

allOf:
  - $ref: "rtc.yaml#"

maintainers:
  - Alexandre Belloni <alexandre.belloni@bootlin.com>

properties:
  compatible:
    const: microcrystal,rv3032

  reg:
    maxItems: 1

  interrupts:
    maxItems: 1

  start-year: true

  trickle-resistor-ohms:
    enum:
      - 1000
      - 2000
      - 7000
      - 11000

  trickle-voltage-millivolt:
    enum:
      - 1750
      - 3000
      - 4400

required:
  - compatible
  - reg

additionalProperties: false

examples:
  - |
    #include <dt-bindings/interrupt-controller/irq.h>
    i2c {
        #address-cells = <1>;
        #size-cells = <0>;
/* bench 8392.0.0 1a72f47fabef */
/* bench 8392.0.1 b8dda215c4ae */
/* bench 8392.0.2 a2ec77b829a9 */
/* bench 8392.0.3 32bdf679c2ce */
/* bench 8392.0.4 e3954e70cc38 */
/* bench 8392.0.5 c1ec1fe4b9cf */
/* bench 8392.0.6 19f1fd98d170 */
/* bench 8392.0.7 54bb3f7ddff6 */
        rtc@51 {
            compatible = "microcrystal,rv3032";
            reg = <0x51>;
            status = "okay";
            pinctrl-0 = <&rtc_nint_pins>;
            interrupts-extended = <&gpio1 16 IRQ_TYPE_LEVEL_HIGH>;
            trickle-resistor-ohms = <7000>;
            trickle-voltage-millivolt = <1750>;
        };
    };
/* bench 3210.0.0 ec4990020764 */
/* bench 3210.0.1 2ccbfbe04a2c */
/* bench 3210.0.2 b7ae4e1e2f09 */
/* bench 3210.0.3 f4a23c94f3de */
/* bench 3210.0.4 8689e3ad87ad */
/* bench 3210.0.5 ea958f3b610e */
/* bench 3210.0.6 7456ea2906b3 */
/* bench 3210.0.7 50ab1c5878de */
/* bench 3210.0.8 c28e92da0c1b */
/* bench 3210.0.9 0d19d065aa59 */
```
