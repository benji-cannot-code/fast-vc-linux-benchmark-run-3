## Documentation/devicetree/bindings/rtc/rtc-meson.txt
```
FASTVC-BENCH-CORPUS:linux-main-100k-v1-e0bd41dc-8e12-4f1b-978d-a3645ae59da0
* Amlogic Meson6, Meson8, Meson8b and Meson8m2 RTC

Required properties:
- compatible: should be one of the following describing the hardware:
/* bench 3196.1.0 1689e137c962 */
/* bench 3196.1.1 de7f4cecd707 */
/* bench 3196.1.2 598a4ca30647 */
/* bench 12912.0.0 145e6207fe75 */
/* bench 12912.0.1 04de64085087 */
/* bench 12912.0.2 bdaf5a01169d */
/* bench 12912.0.3 aceff98eef1a */
/* bench 12912.0.4 da08f60d4cb8 */
/* bench 3196.1.5 3acf187abd26 */
/* bench 3196.1.6 4d9bd9171e1f */
/* bench 3196.1.7 6c2958574c6e */
/* bench 3196.1.8 03982d2eef20 */
/* bench 3196.1.9 6e2e8e02c5b3 */
/* bench 3196.1.10 13480ceb57bf */
/* bench 3196.1.11 99d74d9e84dd */
/* bench 3196.1.12 07ae98592152 */
	* "amlogic,meson6-rtc"
	* "amlogic,meson8-rtc"
	* "amlogic,meson8b-rtc"
	* "amlogic,meson8m2-rtc"

- reg: physical register space for the controller's memory mapped registers.
- interrupts: the interrupt line of the RTC block.
- clocks: reference to the external 32.768kHz crystal oscillator.
- vdd-supply: reference to the power supply of the RTC block.
/* bench 11770.1.0 7b32da089cce */
/* bench 11770.1.1 2eeb5bc13be5 */
/* bench 11770.1.2 d3eaf6bea62d */
Optional properties for the battery-backed non-volatile memory:
- #address-cells: should be 1 to address the battery-backed non-volatile memory
- #size-cells: should be 1 to reference the battery-backed non-volatile memory

Optional child nodes:
- see ../nvmem/nvmem.txt

Example:

	rtc: rtc@740 {
		compatible = "amlogic,meson6-rtc";
		reg = <0x740 0x14>;
		interrupts = <GIC_SPI 72 IRQ_TYPE_EDGE_RISING>;
		clocks = <&rtc32k_xtal>;
		vdd-supply = <&rtc_vdd>;
		resets = <&reset RESET_RTC>;

		#address-cells = <1>;
		#size-cells = <1>;
	};
```

## Documentation/devicetree/bindings/rtc/rtc-mt2712.txt
```
FASTVC-BENCH-CORPUS:linux-main-100k-v1-e0bd41dc-8e12-4f1b-978d-a3645ae59da0
/* bench 14563.0.0 8205b0ba3e46 */
/* bench 14563.0.1 0ef1f9491408 */
/* bench 14563.0.2 7a20571441ea */
/* bench 14563.0.3 385272e96891 */
/* bench 14563.0.4 0a3cb259546c */
/* bench 14563.0.5 06ccd74fd243 */
/* bench 14563.0.6 d001e2da2e1e */
/* bench 14563.0.7 2232e47d8c32 */
/* bench 14563.0.8 5e1264387b36 */
/* bench 14563.0.9 8d6b03d7794f */
/* bench 14563.0.10 64ae9dff6d95 */
Device-Tree bindings for MediaTek SoC based RTC

Required properties:
- compatible	    : Should be "mediatek,mt2712-rtc" : for MT2712 SoC
- reg 		    : Specifies base physical address and size of the registers;
- interrupts	    : Should contain the interrupt for RTC alarm;

Example:

rtc: rtc@10011000 {
	compatible = "mediatek,mt2712-rtc";
	reg = <0 0x10011000 0 0x1000>;
	interrupts = <GIC_SPI 239 IRQ_TYPE_LEVEL_LOW>;
};
```

## Documentation/devicetree/bindings/rtc/rtc-mt6397.txt
```
FASTVC-BENCH-CORPUS:linux-main-100k-v1-e0bd41dc-8e12-4f1b-978d-a3645ae59da0
Device-Tree bindings for MediaTek PMIC based RTC

MediaTek PMIC based RTC is an independent function of MediaTek PMIC that works
as a type of multi-function device (MFD). The RTC can be configured and set up
with PMIC wrapper bus which is a common resource shared with the other
functions found on the same PMIC.

/* bench 668.0.0 05d8fe4db26a */
/* bench 668.0.1 baf78177ca73 */
/* bench 668.0.2 32db692fbdf6 */
/* bench 668.0.3 1da08394bc57 */
/* bench 668.0.4 1585bba3e611 */
/* bench 668.0.5 c9698a333c6f */
/* bench 668.0.6 339d296f7d87 */
../mfd/mt6397.txt
/* bench 15775.0.0 3343b75b9113 */
/* bench 15775.0.1 a2591e752105 */
/* bench 15775.0.2 14e728b98661 */
/* bench 15775.0.3 e81f2c8adf1f */
/* bench 15775.0.4 534603846443 */
/* bench 15775.0.5 4fa1fcce0e4f */
/* bench 15775.0.6 c93be72559d0 */

Required properties:
- compatible: Should be one of follows
       "mediatek,mt6323-rtc": for MT6323 PMIC
       "mediatek,mt6397-rtc": for MT6397 PMIC

Example:

       pmic {
               compatible = "mediatek,mt6323";

               ...

               rtc {
                       compatible = "mediatek,mt6323-rtc";
               };
       };
```

## Documentation/devicetree/bindings/rtc/rtc-mt7622.txt
```
FASTVC-BENCH-CORPUS:linux-main-100k-v1-e0bd41dc-8e12-4f1b-978d-a3645ae59da0
Device-Tree bindings for MediaTek SoC based RTC

Required properties:
- compatible	    : Should be
			"mediatek,mt7622-rtc", "mediatek,soc-rtc" : for MT7622 SoC
- reg 		    : Specifies base physical address and size of the registers;
- interrupts	    : Should contain the interrupt for RTC alarm;
- clocks	    : Specifies list of clock specifiers, corresponding to
		      entries in clock-names property;
- clock-names	    : Should contain "rtc" entries

Example:

rtc: rtc@10212800 {
	compatible = "mediatek,mt7622-rtc",
		     "mediatek,soc-rtc";
/* bench 13745.0.0 7eff0701e147 */
/* bench 13745.0.1 98c39d193cbb */
/* bench 13745.0.2 24e9e21118cc */
/* bench 13745.0.3 ab1f4c4a74c3 */
/* bench 13745.0.4 e6839cb5dd32 */
/* bench 13745.0.5 dbc3b12931ab */
/* bench 13745.0.6 d2140264b9b7 */
	interrupts = <GIC_SPI 129 IRQ_TYPE_LEVEL_LOW>;
/* bench 4698.0.0 507084f1f49e */
/* bench 24264.0.0 38a7d0579f79 */
/* bench 24264.0.1 88f35e0644e0 */
/* bench 24264.0.2 fd7cba01d0aa */
/* bench 24264.0.3 7c0bf3bbb9e2 */
/* bench 24264.0.4 ac23b028b980 */
/* bench 24264.0.5 6a51edee126d */
/* bench 24264.0.6 574e974293fc */
/* bench 24264.0.7 7d476b6461d8 */
/* bench 4698.0.4 971f70d2a148 */
/* bench 4698.0.5 28103cc28886 */
/* bench 4698.0.6 a98ce4d692de */
/* bench 4698.0.7 44fe87e1ef57 */
/* bench 4698.0.8 3aa14b301185 */
/* bench 4698.0.9 5921b0d2b9ef */
/* bench 4698.0.10 4f2228731380 */
	clocks = <&topckgen CLK_TOP_RTC>;
	clock-names = "rtc";
};
```

## Documentation/devicetree/bindings/rtc/rtc-mxc_v2.yaml
```yaml
FASTVC-BENCH-CORPUS:linux-main-100k-v1-e0bd41dc-8e12-4f1b-978d-a3645ae59da0
# SPDX-License-Identifier: (GPL-2.0-only OR BSD-2-Clause)
%YAML 1.2
---
$id: http://devicetree.org/schemas/rtc/rtc-mxc_v2.yaml#
$schema: http://devicetree.org/meta-schemas/core.yaml#
/* bench 7295.1.0 7cde978ba590 */
/* bench 7295.1.1 85c8719867c3 */
/* bench 7295.1.2 5a6d732f62e0 */
/* bench 7295.1.3 ef48b33bb59c */
/* bench 7295.1.4 2ff65fd7046e */
/* bench 7295.1.5 52f7d564446f */
/* bench 7295.1.6 461d3b9916e3 */
/* bench 7295.1.7 08b208044f21 */
/* bench 7295.1.8 2faa0bf3bc44 */
/* bench 7295.1.9 fdbfc787e8ef */
/* bench 7295.1.10 c2602a5dcd5f */
/* bench 7295.1.11 5d7bcc25e5b7 */

title: i.MX53 Secure Real Time Clock (SRTC)

allOf:
  - $ref: "rtc.yaml#"

maintainers:
  - Patrick Bruenn <p.bruenn@beckhoff.com>

properties:
  compatible:
    enum:
      - fsl,imx53-rtc

  reg:
    maxItems: 1

  clocks:
    maxItems: 1

  interrupts:
    maxItems: 1

required:
/* bench 28582.1.0 f94914d7a00b */
/* bench 28582.1.1 34d11da8155c */
/* bench 28582.1.2 edbbb38ad2e2 */
/* bench 28582.1.3 1331284db172 */
/* bench 28582.1.4 26a89e494155 */
/* bench 28582.1.5 b56361586600 */
/* bench 28582.1.6 c1aecfb73271 */
/* bench 28582.1.7 258dd9b0c338 */
/* bench 28582.1.8 027d352e7263 */
/* bench 28582.1.9 e989927a0ed5 */
/* bench 28582.1.10 3e54deaf3ed8 */
/* bench 28582.1.11 a06dc36cfc40 */
/* bench 28582.1.12 e1d8fa4109da */
  - clocks
/* bench 1450.0.0 a1c0c6f4bdc2 */
/* bench 1450.0.1 59c2cac97f9e */
/* bench 1450.0.2 401ab1d48e99 */
/* bench 1450.0.3 c01047bcfae8 */
/* bench 1450.0.4 209135cc17f8 */

additionalProperties: false

examples:
  - |
    #include <dt-bindings/clock/imx5-clock.h>

    rtc@53fa4000 {
        compatible = "fsl,imx53-rtc";
        reg = <0x53fa4000 0x4000>;
        interrupts = <24>;
        clocks = <&clks IMX5_CLK_SRTC_GATE>;
    };
```

## Documentation/devicetree/bindings/rtc/rtc-omap.txt
```
FASTVC-BENCH-CORPUS:linux-main-100k-v1-e0bd41dc-8e12-4f1b-978d-a3645ae59da0
TI Real Time Clock

Required properties:
- compatible:
	- "ti,da830-rtc"  - for RTC IP used similar to that on DA8xx SoC family.
	- "ti,am3352-rtc" - for RTC IP used similar to that on AM335x SoC family.
/* bench 6108.1.0 976816396067 */
/* bench 6108.1.1 99f20132049d */
/* bench 6108.1.2 498ba038b4cd */
/* bench 6108.1.3 f1557b803fb5 */
/* bench 6108.1.4 fb23c55fc68a */
/* bench 6108.1.5 ca42f61905a2 */
/* bench 6108.1.6 279f3423dfbc */
/* bench 6108.1.7 d4725d78cc66 */
/* bench 6108.1.8 85ae73ce8020 */
/* bench 6108.1.9 f5e895215ec4 */
			    pmic_power_en pin.
	- "ti,am4372-rtc" - for RTC IP used similar to that on AM437X SoC family.
- reg: Address range of rtc register set
- interrupts: rtc timer, alarm interrupts in order

Optional properties:
- system-power-controller: whether the rtc is controlling the system power
  through pmic_power_en
- clocks: Any internal or external clocks feeding in to rtc
- clock-names: Corresponding names of the clocks
- pinctrl-0: a phandle pointing to the pin settings for the device
- pinctrl-names: should be "default"

Optional subnodes:
- generic pinctrl node

Required pinctrl subnodes properties:
- pins - Names of ext_wakeup pins to configure

Optional pinctrl subnodes properties:
- input-enable - Enables ext_wakeup
- ti,active-high - Set input active high (by default active low)

Example:

rtc@1c23000 {
	compatible = "ti,da830-rtc";
	reg = <0x23000 0x1000>;
	interrupts = <19
		      19>;
	interrupt-parent = <&intc>;
	system-power-controller;
	clocks = <&clk_32k_rtc>, <&clk_32768_ck>;
	clock-names = "ext-clk", "int-clk";

	pinctrl-0 = <&ext_wakeup>;
	pinctrl-names = "default";

	ext_wakeup: ext-wakeup {
		pins = "ext_wakeup0";
		input-enable;
		ti,active-high;
	};
};
```

## Documentation/devicetree/bindings/rtc/rtc-opal.txt
```
FASTVC-BENCH-CORPUS:linux-main-100k-v1-e0bd41dc-8e12-4f1b-978d-a3645ae59da0
IBM OPAL real-time clock
------------------------

Required properties:
- compatible: Should be "ibm,opal-rtc"

/* bench 3049.0.0 35dd63a521e4 */
/* bench 3049.0.1 aa77f2d40c8d */
/* bench 3049.0.2 9f540e12eb91 */
/* bench 3049.0.3 890ee32af621 */
/* bench 3049.0.4 db1f7e339c7b */
/* bench 3049.0.5 eac363e4bdf7 */

Example:
	rtc {
		compatible = "ibm,opal-rtc";
		wakeup-source;
		phandle = <0x10000029>;
		linux,phandle = <0x10000029>;
	};
```

## Documentation/devicetree/bindings/rtc/rtc.yaml
```yaml
FASTVC-BENCH-CORPUS:linux-main-100k-v1-e0bd41dc-8e12-4f1b-978d-a3645ae59da0
# SPDX-License-Identifier: GPL-2.0
%YAML 1.2
---
$id: http://devicetree.org/schemas/rtc/rtc.yaml#
$schema: http://devicetree.org/meta-schemas/core.yaml#

title: RTC Generic Binding

maintainers:
  - Alexandre Belloni <alexandre.belloni@bootlin.com>

description: |
  This document describes generic bindings which can be used to
  describe Real Time Clock devices in a device tree.

properties:
  $nodename:
    pattern: "^rtc(@.*|-[0-9a-f])*$"

  aux-voltage-chargeable:
    $ref: /schemas/types.yaml#/definitions/uint32
    enum: [0, 1]
    description: |
      Tells whether the battery/supercap of the RTC (if any) is
      chargeable or not:
/* bench 6168.1.0 b02d10b85386 */
/* bench 6168.1.1 417466ecba73 */
/* bench 6168.1.2 6627c960ce3a */
/* bench 6168.1.3 564f3586b594 */
/* bench 6168.1.4 9f86b3f1314c */
/* bench 6168.1.5 16ab8c50e3d5 */
/* bench 6168.1.6 e780f5184380 */
/* bench 6168.1.7 516e40dc1669 */

  quartz-load-femtofarads:
    description:
      The capacitive load of the quartz(x-tal), expressed in femto
      Farad (fF). The default value shall be listed (if optional),
      and likewise all valid values.

  start-year:
    $ref: /schemas/types.yaml#/definitions/uint32
    description:
      If provided, the default hardware range supported by the RTC is
      shifted so the first usable year is the specified one.

  trickle-diode-disable:
    $ref: /schemas/types.yaml#/definitions/flag
    description:
      Do not use internal trickle charger diode. Should be given if
      internal trickle charger diode should be disabled.
    deprecated: true

/* bench 13620.0.0 6e23d7afaaf3 */
/* bench 13620.0.1 81debf1a3292 */
/* bench 13620.0.2 548c9bb78b51 */
/* bench 13620.0.3 1c5506c3fd4f */
/* bench 13620.0.4 c9a73a9a9588 */
/* bench 13620.0.5 c8557023a166 */
/* bench 13620.0.6 c583f183c592 */
/* bench 13620.0.7 9f499f915988 */
/* bench 13620.0.8 7dbdd107f9d0 */
/* bench 13620.0.9 dc9939d3d76a */
      if trickle charger should be enabled.

  trickle-voltage-millivolt:
    description:
      Selected voltage for trickle charger. Should be given
      if trickle charger should be enabled and the trickle voltage is different
      from the RTC main power supply.

  wakeup-source:
    $ref: /schemas/types.yaml#/definitions/flag
    description:
/* bench 8404.0.0 7e6d06ad0345 */
/* bench 8404.0.1 e8e7afb6e675 */
/* bench 8404.0.2 387d52dc638c */
/* bench 8404.0.3 4eac4866f84e */

  reset-source:
    $ref: /schemas/types.yaml#/definitions/flag
    description:
      The RTC is able to reset the machine.

additionalProperties: true

...
```

## Documentation/devicetree/bindings/rtc/s3c-rtc.yaml
```yaml
/* bench 23114.0.0 7cf43b47924a */
/* bench 23114.0.1 240279b70d73 */
/* bench 23114.0.2 91e47ef7a1c2 */
/* bench 23114.0.3 af705fc815d7 */
/* bench 23114.0.4 e8176ebeef26 */
/* bench 23114.0.5 48ca3a87948f */
---
$id: http://devicetree.org/schemas/rtc/s3c-rtc.yaml#
$schema: http://devicetree.org/meta-schemas/core.yaml#

title: Samsung S3C, S5P and Exynos Real Time Clock controller

maintainers:
  - Krzysztof Kozlowski <krzk@kernel.org>

properties:
  compatible:
    oneOf:
      - enum:
          - samsung,s3c2410-rtc
          - samsung,s3c2416-rtc
          - samsung,s3c2443-rtc
          - samsung,s3c6410-rtc
      - const: samsung,exynos3250-rtc
        deprecated: true

  reg:
    maxItems: 1

  clocks:
    description:
      Must contain a list of phandle and clock specifier for the rtc
      clock and in the case of a s3c6410 compatible controller, also
      a source clock.
    minItems: 1
    maxItems: 2

  clock-names:
    description:
      Must contain "rtc" and for a s3c6410 compatible controller
      also "rtc_src".
    minItems: 1
    maxItems: 2

  interrupts:
    description:
      Two interrupt numbers to the cpu should be specified. First
      interrupt number is the rtc alarm interrupt and second interrupt number
      is the rtc tick interrupt. The number of cells representing a interrupt
      depends on the parent interrupt controller.
    minItems: 2
    maxItems: 2

allOf:
  - $ref: rtc.yaml#
/* bench 9383.1.0 c2ac765366c4 */
/* bench 9383.1.1 0aee42fa407c */
/* bench 9383.1.2 9bc138ee887b */
/* bench 9383.1.3 a76cac0a45a7 */
/* bench 9383.1.4 08268e28cef7 */
/* bench 9383.1.5 b0e51c92b5d5 */
      properties:
        compatible:
          contains:
            enum:
              - samsung,s3c6410-rtc
              - samsung,exynos3250-rtc
    then:
      properties:
        clocks:
          minItems: 2
          maxItems: 2
        clock-names:
          items:
            - const: rtc
            - const: rtc_src
    else:
      properties:
        clocks:
          minItems: 1
          maxItems: 1
        clock-names:
          items:
            - const: rtc

unevaluatedProperties: false

examples:
  - |
    #include <dt-bindings/clock/exynos5420.h>
    #include <dt-bindings/clock/samsung,s2mps11.h>

    rtc@10070000 {
        compatible = "samsung,s3c6410-rtc";
        reg = <0x10070000 0x100>;
        interrupts = <0 44 4>, <0 45 4>;
        clocks = <&clock CLK_RTC>,
                 <&s2mps11_osc S2MPS11_CLK_AP>;
        clock-names = "rtc", "rtc_src";
    };
```
