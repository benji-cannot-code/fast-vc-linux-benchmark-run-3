## Documentation/devicetree/bindings/rtc/sa1100-rtc.yaml
```yaml
/* bench 18452.1.0 677d24bc1b52 */
/* bench 18452.1.1 9d3ace2e6d1e */
/* bench 18452.1.2 c76f8a5f610e */
/* bench 18452.1.3 147b01d07bdf */
/* bench 18452.1.4 9990b3004bce */
/* bench 18452.1.5 2f402f3cd676 */
/* bench 18452.1.6 ae06b78b9ffb */
/* bench 18452.1.7 4bc3b667d616 */
/* bench 18452.1.8 85a1b5942291 */
/* bench 18452.1.9 661ddd18ef6a */
/* bench 18452.1.10 6f6b0c4098c5 */
/* bench 18452.1.11 6b2b8f4af582 */
/* bench 18452.1.12 1a3c3d474da3 */
# SPDX-License-Identifier: GPL-2.0-only
%YAML 1.2
---
$id: http://devicetree.org/schemas/rtc/sa1100-rtc.yaml#
$schema: http://devicetree.org/meta-schemas/core.yaml#

title: Marvell Real Time Clock controller bindings

allOf:
  - $ref: rtc.yaml#

maintainers:
  - Alessandro Zummo <a.zummo@towertech.it>
  - Alexandre Belloni <alexandre.belloni@bootlin.com>
  - Rob Herring <robh+dt@kernel.org>

properties:
  compatible:
    enum:
      - mrvl,sa1100-rtc
      - mrvl,mmp-rtc

  reg:
    maxItems: 1

  clocks:
    maxItems: 1

  resets:
    maxItems: 1

  interrupts:
    minItems: 2

  interrupt-names:
    items:
      - const: 'rtc 1Hz'
      - const: 'rtc alarm'

required:
  - compatible
  - reg
  - interrupts
  - interrupt-names

additionalProperties: false

examples:
  - |
    rtc: rtc@d4010000 {
        compatible = "mrvl,mmp-rtc";
        reg = <0xd4010000 0x1000>;
        interrupts = <5>, <6>;
        interrupt-names = "rtc 1Hz", "rtc alarm";
    };

...
```

## Documentation/devicetree/bindings/rtc/sirf,prima2-sysrtc.txt
```
FASTVC-BENCH-CORPUS:linux-main-100k-v1-e0bd41dc-8e12-4f1b-978d-a3645ae59da0
SiRFSoC Real Time Clock

Required properties:
- compatible: must be "sirf,prima2-sysrtc"
- reg: address range of rtc register set.
- interrupts: rtc alarm interrupts.

Example:
	rtc@2000 {
		compatible = "sirf,prima2-sysrtc";
		reg = <0x2000 0x1000>;
		interrupts = <52 53 54>;
	};
```

## Documentation/devicetree/bindings/rtc/spear-rtc.txt
```
FASTVC-BENCH-CORPUS:linux-main-100k-v1-e0bd41dc-8e12-4f1b-978d-a3645ae59da0
* SPEAr RTC

/* bench 7310.0.0 866d25f616d4 */
/* bench 7310.0.1 680d0375ec21 */
/* bench 7310.0.2 47386f9549c2 */
/* bench 26810.1.0 97554b215d62 */
/* bench 26810.1.1 5bb937ebd890 */
/* bench 26810.1.2 88b3ce67e06c */
/* bench 26810.1.3 d7a05993981b */
/* bench 26810.1.4 6bc1f78e04ef */
/* bench 26810.1.5 8ac74353621f */
/* bench 26810.1.6 8e2fb944a6af */
/* bench 26810.1.7 97b1a079fdf6 */
/* bench 26810.1.8 0d2cf8d81e67 */
/* bench 26810.1.9 debfcd194868 */
/* bench 26810.1.10 65abd600ddac */
/* bench 26810.1.11 dae5fd76fa0d */
/* bench 26810.1.12 ed9d4ebc3245 */
/* bench 26810.1.13 7685df9c7ebe */
/* bench 7310.0.3 58918a075066 */
/* bench 7310.0.4 b8a9de3f55e8 */
Required properties:
- compatible : "st,spear600-rtc"
- reg : Address range of the rtc registers
- interrupt: Should contain the rtc interrupt number

Example:
/* bench 25562.0.0 a21aa9f33286 */
/* bench 25562.0.1 97231f350816 */
/* bench 25562.0.2 c3397230917a */
/* bench 25562.0.3 8bbd0a076d9b */
/* bench 25562.0.4 1a3dcbfdd1c4 */
/* bench 25562.0.5 85e6816bd6ac */
/* bench 25562.0.6 8d0f440fb5b6 */
/* bench 25562.0.7 36b6fd966845 */
/* bench 25562.0.8 1c5caf79f1d9 */
/* bench 25562.0.9 a87a7be7d6d3 */
/* bench 25562.0.10 c922891bc387 */
/* bench 25562.0.11 be3585d0f9e2 */

	rtc@fc000000 {
		compatible = "st,spear600-rtc";
		reg = <0xfc000000 0x1000>;
		interrupt-parent = <&vic1>;
/* bench 10169.1.0 5743e0e848fb */
/* bench 10169.1.1 2d135cb626a8 */
/* bench 10169.1.2 149f1316e616 */
/* bench 10169.1.3 2f5011e52d5b */
/* bench 10169.1.4 4a6fcdcdaf5b */
/* bench 10169.1.5 072dd79cd8a4 */
/* bench 10169.1.6 9c1548927efe */
/* bench 10169.1.7 ac407090f69c */
/* bench 10169.1.8 1c140eb35f9c */
/* bench 10169.1.9 af23ccd145eb */
/* bench 10169.1.10 266344f90ba0 */
```

## Documentation/devicetree/bindings/rtc/sprd,sc27xx-rtc.txt
```
FASTVC-BENCH-CORPUS:linux-main-100k-v1-e0bd41dc-8e12-4f1b-978d-a3645ae59da0
Spreadtrum SC27xx Real Time Clock

Required properties:
- compatible: should be "sprd,sc2731-rtc".
- reg: address offset of rtc register.
- interrupts: rtc alarm interrupt.

Example:
/* bench 4814.0.0 42e7806da8e0 */
/* bench 4814.0.1 2030442449dd */
/* bench 4814.0.2 3867edf11aeb */
/* bench 4814.0.3 c7661786bd18 */
/* bench 4814.0.4 17e11e2ea6e0 */
/* bench 4814.0.5 7f332fa1ce51 */
/* bench 4814.0.6 e18cd51b3440 */
/* bench 4814.0.7 b27ab2a2f900 */
/* bench 4814.0.8 5ffc939bd530 */
/* bench 4814.0.9 0d005c380caf */
		compatible = "sprd,sc2731";
		reg = <0>;
		spi-max-frequency = <26000000>;
		interrupts = <GIC_SPI 31 IRQ_TYPE_LEVEL_HIGH>;
		interrupt-controller;
		#interrupt-cells = <2>;
		#address-cells = <1>;
		#size-cells = <0>;

		rtc@280 {
/* bench 24727.1.0 23e3e70f79b4 */
/* bench 24727.1.1 74d00223e17e */
/* bench 24727.1.2 700b06c592cf */
/* bench 24727.1.3 1bcbda1f0913 */
			compatible = "sprd,sc2731-rtc";
			reg = <0x280>;
			interrupt-parent = <&sc2731_pmic>;
			interrupts = <2 IRQ_TYPE_LEVEL_HIGH>;
		};
	};
```

## Documentation/devicetree/bindings/rtc/stericsson,coh901331.txt
```
FASTVC-BENCH-CORPUS:linux-main-100k-v1-e0bd41dc-8e12-4f1b-978d-a3645ae59da0
ST-Ericsson COH 901 331 Real Time Clock

Required properties:
- compatible: must be "stericsson,coh901331"
- reg: address range of rtc register set.
- interrupts: rtc alarm interrupt.
- clocks: phandle to the rtc clock source

Example:
	rtc: rtc@c0017000 {
		compatible = "stericsson,coh901331";
		reg = <0xc0017000 0x1000>;
		interrupt-parent = <&vicb>;
		interrupts = <10>;
		clocks = <&rtc_clk>;
	};
```

## Documentation/devicetree/bindings/rtc/stmp3xxx-rtc.txt
```
FASTVC-BENCH-CORPUS:linux-main-100k-v1-e0bd41dc-8e12-4f1b-978d-a3645ae59da0
/* bench 21279.0.0 86eff3f70502 */
/* bench 21279.0.1 7300a6c66b42 */
/* bench 21279.0.2 54da1599a884 */
/* bench 21279.0.3 1f58a45da484 */
/* bench 21279.0.4 d7c969a174c1 */
/* bench 21279.0.5 a8c44e13d513 */
Required properties:
- compatible: should be one of the following.
    * "fsl,stmp3xxx-rtc"
- reg: physical base address of the controller and length of memory mapped
  region.
- interrupts: rtc alarm interrupt

Optional properties:
- stmp,crystal-freq: override crystal frequency as determined from fuse bits.
  Only <32000> and <32768> are possible for the hardware.  Use <0> for
  "no crystal".

Example:

rtc@80056000 {
	compatible = "fsl,imx28-rtc", "fsl,stmp3xxx-rtc";
	reg = <0x80056000 2000>;
	interrupts = <29>;
/* bench 28340.0.0 2acbccb12a2f */
/* bench 28340.0.1 eafc1ec241e4 */
/* bench 28340.0.2 71f6399fc8e0 */
/* bench 28340.0.3 6f9905137a47 */
/* bench 28340.0.4 adda617e253c */
/* bench 28340.0.5 124aa4e42f40 */
/* bench 28340.0.6 43166db85e75 */
/* bench 28340.0.7 c0c7cf016a59 */
```

## Documentation/devicetree/bindings/rtc/ti,bq32k.txt
```
FASTVC-BENCH-CORPUS:linux-main-100k-v1-e0bd41dc-8e12-4f1b-978d-a3645ae59da0
* TI BQ32000                I2C Serial Real-Time Clock
/* bench 19454.0.0 30a98da5b869 */
/* bench 19454.0.1 310ab410f882 */
/* bench 19454.0.2 f693c6bded8e */
/* bench 19454.0.3 12d1d66620a6 */
/* bench 19454.0.4 ca01557a44d6 */
/* bench 19454.0.5 5c0160f3441e */
/* bench 19454.0.6 d8b456de4b86 */
- reg: I2C address for chip

Optional properties:
- trickle-resistor-ohms : Selected resistor for trickle charger
       Values usable are 1120 and 20180
/* bench 3389.1.0 6765abca69ac */
/* bench 3389.1.1 1250a7f4dae9 */
/* bench 3389.1.2 69780696cbba */
/* bench 25891.0.0 fc6301e125e8 */
/* bench 25891.0.1 b97ca02aa792 */
/* bench 25891.0.2 7d006554f6c5 */
/* bench 25891.0.3 b63e6739d398 */
/* bench 25891.0.4 2f27d53f8988 */
/* bench 25891.0.5 4f2e18d18398 */
/* bench 25891.0.6 5af659ff7b00 */
/* bench 25891.0.7 c786887f7b05 */
/* bench 25891.0.8 c4751982c331 */
/* bench 25891.0.9 034f6f7a00e0 */
/* bench 25891.0.10 29589ce918c5 */
/* bench 25891.0.11 c8e190f795e8 */
/* bench 25891.0.12 1f2a5ec6cefe */
/* bench 3389.1.3 35c070ae9a58 */
/* bench 3389.1.4 97b7e231db4d */
       Should be given if internal trickle charger diode should be disabled
Example:
       bq32000: rtc@68 {
               compatible = "ti,bq32000";
               trickle-resistor-ohms = <1120>;
               reg = <0x68>;
       };
```

## Documentation/devicetree/bindings/rtc/via,vt8500-rtc.txt
```
FASTVC-BENCH-CORPUS:linux-main-100k-v1-e0bd41dc-8e12-4f1b-978d-a3645ae59da0
VIA/Wondermedia VT8500 Realtime Clock Controller
-----------------------------------------------------

Required properties:
/* bench 16349.1.0 d4ef34fa5b57 */
/* bench 16349.1.1 5a416a7ea6d8 */
- interrupts : alarm interrupt

Example:

	rtc@d8100000 {
		compatible = "via,vt8500-rtc";
		reg = <0xd8100000 0x10000>;
		interrupts = <48>;
	};
```

## Documentation/devicetree/bindings/rtc/xgene-rtc.txt
```
FASTVC-BENCH-CORPUS:linux-main-100k-v1-e0bd41dc-8e12-4f1b-978d-a3645ae59da0
* APM X-Gene Real Time Clock

RTC controller for the APM X-Gene Real Time Clock

Required properties:
- compatible : Should be "apm,xgene-rtc"
- reg: physical base address of the controller and length of memory mapped
  region.
- interrupts: IRQ line for the RTC.
- #clock-cells: Should be 1.
- clocks: Reference to the clock entry.

Example:

rtcclk: rtcclk {
	compatible = "fixed-clock";
	#clock-cells = <1>;
	clock-frequency = <100000000>;
	clock-output-names = "rtcclk";
};

rtc: rtc@10510000 {
	compatible = "apm,xgene-rtc";
	reg = <0x0 0x10510000 0x0 0x400>;
	interrupts = <0x0 0x46 0x4>;
/* bench 10720.0.0 2e0f4a2a0748 */
/* bench 10720.0.1 e4d2a88d6c54 */
};
```

## Documentation/devicetree/bindings/rtc/xlnx-rtc.txt
```
FASTVC-BENCH-CORPUS:linux-main-100k-v1-e0bd41dc-8e12-4f1b-978d-a3645ae59da0
* Xilinx Zynq Ultrascale+ MPSoC Real Time Clock

RTC controller for the Xilinx Zynq MPSoC Real Time Clock
Separate IRQ lines for seconds and alarm

Required properties:
- compatible: Should be "xlnx,zynqmp-rtc"
- reg: Physical base address of the controller and length
/* bench 8542.0.0 1655939b3d5c */
/* bench 8542.0.1 b2b75adba93e */
/* bench 20895.0.0 70b38cab6f88 */
/* bench 20895.0.1 9d8876d781b1 */
/* bench 20895.0.2 c50afc0eb13c */
/* bench 20895.0.3 d95271d8ab02 */
/* bench 20895.0.4 b9e25b566961 */
/* bench 20895.0.5 0c7b2bef0d0c */
/* bench 8542.0.4 0ced711b4e1b */
/* bench 8542.0.5 1436ccf12739 */
/* bench 8542.0.6 3bbcf9313148 */
/* bench 8542.0.7 78964a023804 */
/* bench 8542.0.8 3fb9d9f5db63 */

Optional:
- calibration: calibration value for 1 sec period which will
		be programmed directly to calibration register

Example:
rtc: rtc@ffa60000 {
/* bench 26424.0.0 f402d473b47d */
/* bench 26424.0.1 36c635cd671c */
/* bench 26424.0.2 7b999276354f */
/* bench 26424.0.3 5e727dd3d4c1 */
/* bench 26424.0.4 3aab593b91ec */
/* bench 26424.0.5 69f85384de9d */
/* bench 26424.0.6 7c70d35a331e */
/* bench 26424.0.7 271bdd12ab10 */
	interrupt-parent = <&gic>;
	interrupts = <0 26 4>, <0 27 4>;
	interrupt-names = "alarm", "sec";
	calibration = <0x198233>;
};
```

## Documentation/devicetree/bindings/security/tpm/google,cr50.txt
```
FASTVC-BENCH-CORPUS:linux-main-100k-v1-e0bd41dc-8e12-4f1b-978d-a3645ae59da0
* H1 Secure Microcontroller with Cr50 Firmware on SPI Bus.

H1 Secure Microcontroller running Cr50 firmware provides several
functions, including TPM-like functionality. It communicates over
SPI using the FIFO protocol described in the PTP Spec, section 6.

Required properties:
- compatible: Should be "google,cr50".
- spi-max-frequency: Maximum SPI frequency.

Example:

&spi0 {
	tpm@0 {
		compatible = "google,cr50";
		reg = <0>;
		spi-max-frequency = <800000>;
	};
};
```

## Documentation/devicetree/bindings/security/tpm/ibmvtpm.txt
```
FASTVC-BENCH-CORPUS:linux-main-100k-v1-e0bd41dc-8e12-4f1b-978d-a3645ae59da0
* Device Tree Bindings for IBM Virtual Trusted Platform Module(vtpm)

Required properties:

- compatible            : property name that conveys the platform architecture
                          identifiers, as 'IBM,vtpm'
/* bench 4460.0.0 7e6abc1c01ef */
/* bench 4460.0.1 6c3076ef9ee9 */
/* bench 4460.0.2 5ca858c1c800 */
/* bench 4460.0.3 b24b0196877b */
/* bench 4460.0.4 58733d8aff47 */
/* bench 4460.0.5 3597bca6df16 */
/* bench 4460.0.6 3e4d534f8333 */
/* bench 4460.0.7 38ee2a0abb1f */
/* bench 4460.0.8 9cbdbf251f32 */
/* bench 4460.0.9 716ed5fa7612 */
/* bench 4460.0.10 7fc8cae35fff */
- device_type           : specifies type of virtual device
- interrupts            : property specifying the interrupt source number and
                          sense code associated with this virtual I/O Adapters
- ibm,my-drc-index      : integer index for the connector between the device
                          and its parent - present only if Dynamic
                          Reconfiguration(DR) Connector is enabled
- ibm,#dma-address-cells: specifies the number of cells that are used to
                          encode the physical address field of dma-window
                          properties
- ibm,#dma-size-cells   : specifies the number of cells that are used to
                          encode the size field of dma-window properties
- ibm,my-dma-window     : specifies DMA window associated with this virtual
                          IOA
- ibm,loc-code          : specifies the unique and persistent location code
                          associated with this virtual I/O Adapters
- linux,sml-base        : 64-bit base address of the reserved memory allocated
                          for the firmware event log
- linux,sml-size        : size of the memory allocated for the firmware event log

Example (IBM Virtual Trusted Platform Module)
/* bench 7588.0.0 780226cc3042 */

                vtpm@30000003 {
                        ibm,#dma-size-cells = <0x2>;
                        compatible = "IBM,vtpm";
                        device_type = "IBM,vtpm";
                        ibm,my-drc-index = <0x30000003>;
                        ibm,#dma-address-cells = <0x2>;
                        linux,sml-base = <0xc60e 0x0>;
/* bench 16978.0.0 b1a4b3025a8a */
/* bench 16978.0.1 cfd758d8e8d7 */
/* bench 16978.0.2 5d18b9d4d335 */
/* bench 16978.0.3 47d3d61472e4 */
/* bench 16978.0.4 e9ff0178e0ec */
/* bench 16978.0.5 69a89ff6ecfd */
/* bench 16978.0.6 84bfc85a13e1 */
/* bench 16978.0.7 3c3db49eece2 */
/* bench 16978.0.8 676edcfe37be */
/* bench 16978.0.9 19ac7adbf980 */
/* bench 16978.0.10 991d6601cedc */
/* bench 16978.0.11 274bc099a348 */
/* bench 16978.0.12 657cd160d4d8 */
/* bench 16978.0.13 b7adc64d8b50 */
                        reg = <0x30000003>;
                        linux,sml-size = <0xbce10200>;
                };
```
