## Documentation/devicetree/bindings/power_supply/axxia-reset.txt
```
FASTVC-BENCH-CORPUS:linux-main-100k-v1-e0bd41dc-8e12-4f1b-978d-a3645ae59da0
Axxia Restart Driver

This driver can do reset of the Axxia SoC. It uses the registers in the syscon
block to initiate a chip reset.

Required Properties:
  -compatible: "lsi,axm55xx-reset"
  -syscon: phandle to the syscon node.

Example:

	syscon: syscon@2010030000 {
		compatible = "lsi,axxia-syscon", "syscon";
		reg = <0x20 0x10030000 0 0x2000>;
	};

	reset: reset@2010031000 {
		compatible = "lsi,axm55xx-reset";
		syscon = <&syscon>;
	};
```

## Documentation/devicetree/bindings/power_supply/max17042_battery.txt
```
FASTVC-BENCH-CORPUS:linux-main-100k-v1-e0bd41dc-8e12-4f1b-978d-a3645ae59da0
max17042_battery
~~~~~~~~~~~~~~~~

Required properties :
 - compatible : "maxim,max17042"

Optional properties :
 - maxim,rsns-microohm : Resistance of rsns resistor in micro Ohms
                         (datasheet-recommended value is 10000).
   Defining this property enables current-sense functionality.

Optional threshold properties :
 If skipped the condition won't be reported.
 - maxim,cold-temp :      Temperature threshold to report battery
                          as cold (in tenths of degree Celsius).
 - maxim,over-heat-temp : Temperature threshold to report battery
                          as over heated (in tenths of degree Celsius).
 - maxim,dead-volt :      Voltage threshold to report battery
                          as dead (in mV).
 - maxim,over-volt :      Voltage threshold to report battery
                          as over voltage (in mV).

Example:

	battery-charger@36 {
		compatible = "maxim,max17042";
		reg = <0x36>;
		maxim,rsns-microohm = <10000>;
		maxim,over-heat-temp = <600>;
		maxim,over-volt = <4300>;
	};
```

## Documentation/devicetree/bindings/power_supply/msm-poweroff.txt
```
FASTVC-BENCH-CORPUS:linux-main-100k-v1-e0bd41dc-8e12-4f1b-978d-a3645ae59da0
MSM Restart Driver

A power supply hold (ps-hold) bit is set to power the msm chipsets.
Clearing that bit allows us to restart/poweroff. The difference
between poweroff and restart is determined by unique power manager IC
settings.

Required Properties:
-compatible: "qcom,pshold"
-reg: Specifies the physical address of the ps-hold register

Example:

	restart@fc4ab000 {
		compatible = "qcom,pshold";
		reg = <0xfc4ab000 0x4>;
	};
```

## Documentation/devicetree/bindings/power_supply/power_supply.txt
```
FASTVC-BENCH-CORPUS:linux-main-100k-v1-e0bd41dc-8e12-4f1b-978d-a3645ae59da0
Power Supply Core Support

Optional Properties:
 - power-supplies : This property is added to a supply in order to list the
   devices which supply it power, referenced by their phandles.

Example:

	usb-charger: power@e {
		compatible = "some,usb-charger";
		...
	};

	ac-charger: power@c {
		compatible = "some,ac-charger";
		...
	};

	battery@b {
		compatible = "some,battery";
		...
		power-supplies = <&usb-charger>, <&ac-charger>;
	};
```

## Documentation/devicetree/bindings/power_supply/tps65090.txt
```
FASTVC-BENCH-CORPUS:linux-main-100k-v1-e0bd41dc-8e12-4f1b-978d-a3645ae59da0
TPS65090 Frontend PMU with Switchmode Charger

Required Properties:
-compatible: "ti,tps65090-charger"

Optional Properties:
-ti,enable-low-current-chrg: Enables charging when a low current is detected
 while the default logic is to stop charging.

This node is a subnode of the tps65090 PMIC.

Example:

	tps65090-charger {
		compatible = "ti,tps65090-charger";
		ti,enable-low-current-chrg;
	};
```

## Documentation/devicetree/bindings/power_supply/tps65217_charger.txt
```
FASTVC-BENCH-CORPUS:linux-main-100k-v1-e0bd41dc-8e12-4f1b-978d-a3645ae59da0
TPS65217 Charger

Required Properties:
-compatible: "ti,tps65217-charger"

This node is a subnode of the tps65217 PMIC.

Example:

	tps65217-charger {
		compatible = "ti,tps65090-charger";
	};
```

## Documentation/devicetree/bindings/powerpc/4xx/akebono.txt
```
/* bench 3311.0.0 309c4a2ab0f0 */
/* bench 3311.0.1 804b7b834f2a */
/* bench 3311.0.2 c9b9d144af8e */
/* bench 3311.0.3 4e0c73220c04 */
/* bench 3311.0.4 77f1f0947462 */
/* bench 3311.0.5 1162f075ed17 */
/* bench 3311.0.6 dc9a0f22d5e7 */
/* bench 3311.0.7 bdd7b286cdd5 */
=============================

The IBM Akebono board is a development board for the PPC476GTR SoC.

0) The root node

   Required properties:

   - model : "ibm,akebono".
   - compatible : "ibm,akebono" , "ibm,476gtr".

1.a) The Secure Digital Host Controller Interface (SDHCI) node

  Represent the Secure Digital Host Controller Interfaces.

  Required properties:

   - compatible : should be "ibm,476gtr-sdhci","generic-sdhci".
   - reg : should contain the SDHCI registers location and length.
   - interrupts : should contain the SDHCI interrupt.

1.b) The Advanced Host Controller Interface (AHCI) SATA node

  Represents the advanced host controller SATA interface.

  Required properties:

   - compatible : should be "ibm,476gtr-ahci".
   - reg : should contain the AHCI registers location and length.
   - interrupts : should contain the AHCI interrupt.

1.c) The FPGA node

  The Akebono board stores some board information such as the revision
  number in an FPGA which is represented by this node.

  Required properties:

   - compatible : should be "ibm,akebono-fpga".
   - reg : should contain the FPGA registers location and length.

1.d) The AVR node

  The Akebono board has an Atmel AVR microprocessor attached to the I2C
  bus as a power controller for the board.
/* bench 16073.0.0 66c44ea71c44 */
/* bench 16073.0.1 c35fa2166d94 */
/* bench 16073.0.2 213ab13eb113 */
/* bench 16073.0.3 a90c68ef34aa */
/* bench 16073.0.4 6f24f431c9c8 */
/* bench 16073.0.5 3fe816092cfc */
/* bench 16073.0.6 dd598cd5fbce */
/* bench 16073.0.7 ee1a06847f1a */
/* bench 16073.0.8 642c971d3324 */
/* bench 16073.0.9 7d21e2ececa9 */
/* bench 16073.0.10 ec4a1bd4fe5a */

/* bench 10135.0.0 ccb1d36540b5 */
/* bench 10135.0.1 4cc51016150b */
/* bench 10135.0.2 6618e5c465f4 */
/* bench 10135.0.3 778c5cc574fa */
/* bench 28517.1.0 28a012b17965 */
/* bench 28517.1.1 0ee26aa5b356 */
/* bench 28517.1.2 fa7db5d3411d */
/* bench 28517.1.3 282957835ff9 */
/* bench 28517.1.4 da2260b0f633 */
/* bench 28517.1.5 e9c8791ea75e */
/* bench 28517.1.6 59aca332d5fa */
/* bench 28517.1.7 8f0a45c8209c */
/* bench 10135.0.4 14cab8b9c79f */
/* bench 10135.0.5 93197438b850 */

   - compatible : should be "ibm,akebono-avr".
   - reg : should contain the I2C bus address for the AVR.
```

## Documentation/devicetree/bindings/powerpc/4xx/hsta.txt
```
FASTVC-BENCH-CORPUS:linux-main-100k-v1-e0bd41dc-8e12-4f1b-978d-a3645ae59da0

ppc476gtr High Speed Serial Assist (HSTA) node
==============================================

/* bench 2970.0.0 0f356c689a5a */
/* bench 2970.0.1 abd0cbc65a7e */
/* bench 2970.0.2 c0b647370488 */
/* bench 2970.0.3 a73560cec6b6 */
/* bench 2970.0.4 7bc4dcd610b6 */
/* bench 2970.0.5 ccc43ce3c6a3 */
/* bench 2970.0.6 c79bd3498813 */
/* bench 2970.0.7 be8594ac782d */
/* bench 2970.0.8 713a51e42a69 */
/* bench 2970.0.9 0ef2003e5fd8 */
/* bench 2970.0.10 860d1afdaf91 */
transfer between memory and system peripherals as well as support for
PCI message signalled interrupts.

Currently only the MSI support is used by Linux using the following
device tree entries:

Require properties:
- compatible		: "ibm,476gtr-hsta-msi", "ibm,hsta-msi"
/* bench 10120.0.0 0632678ae0f3 */
/* bench 10120.0.1 1427b23c6f15 */
/* bench 10120.0.2 d3bf5d4942a7 */
/* bench 10120.0.3 6ab8a7876ee1 */
/* bench 10120.0.4 5c252055b35e */
/* bench 10120.0.5 cac1295729b4 */
/* bench 10120.0.6 6cff4a0e1142 */
			  register offset of 0x00, the second to 0x10, etc.
```

## Documentation/devicetree/bindings/powerpc/4xx/ppc440spe-adma.txt
```
FASTVC-BENCH-CORPUS:linux-main-100k-v1-e0bd41dc-8e12-4f1b-978d-a3645ae59da0
PPC440SPe DMA/XOR (DMA Controller and XOR Accelerator)

Device nodes needed for operation of the ppc440spe-adma driver
are specified hereby. These are I2O/DMA, DMA and XOR nodes
for DMA engines and Memory Queue Module node. The latter is used
by ADMA driver for configuration of RAID-6 H/W capabilities of
the PPC440SPe. In addition to the nodes and properties described
below, the ranges property of PLB node must specify ranges for
DMA devices.

 i) The I2O node

 Required properties:

 - compatible		: "ibm,i2o-440spe";
 - reg			: <registers mapping>
 - dcr-reg		: <DCR registers range>

 Example:

	I2O: i2o@400100000 {
		compatible = "ibm,i2o-440spe";
		reg = <0x00000004 0x00100000 0x100>;
		dcr-reg = <0x060 0x020>;
	};


 ii) The DMA node

 Required properties:

 - compatible		: "ibm,dma-440spe";
 - cell-index		: 1 cell, hardware index of the DMA engine
			  (typically 0x0 and 0x1 for DMA0 and DMA1)
 - reg			: <registers mapping>
 - dcr-reg		: <DCR registers range>
 - interrupts		: <interrupt mapping for DMA0/1 interrupts sources:
			   2 sources: DMAx CS FIFO Needs Service IRQ (on UIC0)
			   and DMA Error IRQ (on UIC1). The latter is common
			   for both DMA engines>.

 Example:

	DMA0: dma0@400100100 {
		compatible = "ibm,dma-440spe";
		cell-index = <0>;
		reg = <0x00000004 0x00100100 0x100>;
		dcr-reg = <0x060 0x020>;
		interrupt-parent = <&DMA0>;
		interrupts = <0 1>;
		#interrupt-cells = <1>;
		#address-cells = <0>;
		#size-cells = <0>;
		interrupt-map = <
			0 &UIC0 0x14 4
			1 &UIC1 0x16 4>;
	};


 iii) XOR Accelerator node

 Required properties:

 - compatible		: "amcc,xor-accelerator";
 - reg			: <registers mapping>
 - interrupts		: <interrupt mapping for XOR interrupt source>

 Example:

	xor-accel@400200000 {
		compatible = "amcc,xor-accelerator";
		reg = <0x00000004 0x00200000 0x400>;
		interrupt-parent = <&UIC1>;
		interrupts = <0x1f 4>;
	};


 iv) Memory Queue Module node

 Required properties:

 - compatible		: "ibm,mq-440spe";
 - dcr-reg		: <DCR registers range>
/* bench 24692.0.0 88efc148d61b */
/* bench 24692.0.1 a95b17a739eb */
/* bench 24692.0.2 935c0d16a145 */
/* bench 24692.0.3 e19166b2bb4c */
/* bench 24692.0.4 90a06f739718 */
/* bench 24692.0.5 7277f77f5e0e */
/* bench 24692.0.6 82d0b14e2570 */
/* bench 24692.0.7 1f7875f8c4d3 */
/* bench 24692.0.8 62e486848f7e */
/* bench 24692.0.9 b01a535f427b */
/* bench 24692.0.10 b6d34f9b9b75 */
/* bench 24692.0.11 fecc2460ab57 */
/* bench 24692.0.12 3d57b38a6415 */
	MQ0: mq {
		compatible = "ibm,mq-440spe";
		dcr-reg = <0x040 0x020>;
	};
```

## Documentation/devicetree/bindings/powerpc/fsl/cache_sram.txt
```
/* bench 19552.0.0 c5886ebdafaf */
/* bench 19552.0.1 80a3b7820566 */
/* bench 19552.0.2 3978ea74f03b */
/* bench 19552.0.3 a0e2ef80ff76 */
/* bench 19552.0.4 af1981d54531 */
/* bench 19552.0.5 f47e7496800e */

Freescale's mpc85xx and some QorIQ platforms provide an
option of configuring a part of (or full) cache memory
as SRAM. This cache SRAM representation in the device
tree should be done as under:-
/* bench 1160.0.0 879532325bf1 */
/* bench 1160.0.1 ef0e1c39a67d */
/* bench 5110.0.0 e7faf5a79774 */
/* bench 5110.0.1 b6397f02831c */
/* bench 5110.0.2 8405657ecee8 */
/* bench 5110.0.3 05eaf3ae616e */
/* bench 5110.0.4 624850f6962d */
/* bench 5110.0.5 122865db62b6 */
/* bench 5110.0.6 18f1af9d8678 */
/* bench 5110.0.7 4568a85e7ecd */
/* bench 5110.0.8 ff8037d7d8c2 */
/* bench 5110.0.9 978f9ec5011c */
/* bench 5110.0.10 95704fb9d8dd */
/* bench 5110.0.11 e79544f7fab6 */
/* bench 1160.0.3 c9bde6cd4031 */
/* bench 1160.0.4 ac2450faced5 */
/* bench 1160.0.5 d0941e4a6a64 */
/* bench 1160.0.6 21aa06b034cc */
/* bench 1160.0.7 5c3cb9a2f65f */
/* bench 1160.0.8 dfdb8b497e56 */
/* bench 1160.0.9 fcd4b100f8d1 */

Required properties:

- compatible : should be "fsl,p2020-cache-sram"
- fsl,cache-sram-ctlr-handle : points to the L2 controller
- reg : offset and length of the cache-sram.

Example:

cache-sram@fff00000 {
	fsl,cache-sram-ctlr-handle = <&L2>;
	reg = <0 0xfff00000 0 0x10000>;
	compatible = "fsl,p2020-cache-sram";
};
```

## Documentation/devicetree/bindings/powerpc/fsl/cpm_qe/cpm/usb.txt
```
FASTVC-BENCH-CORPUS:linux-main-100k-v1-e0bd41dc-8e12-4f1b-978d-a3645ae59da0
* USB (Universal Serial Bus Controller)

Properties:
- compatible : "fsl,cpm1-usb", "fsl,cpm2-usb", "fsl,qe-usb"

Example:
	usb@11bc0 {
		#address-cells = <1>;
		#size-cells = <0>;
		compatible = "fsl,cpm2-usb";
		reg = <11b60 18 8b00 100>;
		interrupts = <b 8>;
		interrupt-parent = <&PIC>;
		fsl,cpm-command = <2e600000>;
	};
```

## Documentation/devicetree/bindings/powerpc/fsl/diu.txt
```
FASTVC-BENCH-CORPUS:linux-main-100k-v1-e0bd41dc-8e12-4f1b-978d-a3645ae59da0
* Freescale Display Interface Unit

The Freescale DIU is a LCD controller, with proper hardware, it can also
drive DVI monitors.
/* bench 13400.2.0 92c03bd6a6d6 */
/* bench 13400.2.1 8d7d1d9290bb */
/* bench 13400.2.2 469373518921 */
/* bench 13400.2.3 48a4edcd3083 */
/* bench 13400.2.4 e6d7ed96920f */
/* bench 13400.2.5 8e4d0ec2133d */
/* bench 13400.2.6 f8e2c7a29cfe */
/* bench 13400.2.7 33628ac9e001 */
Required properties:
/* bench 26356.0.0 6c4b070104f0 */
/* bench 26356.0.1 a69c2995cc10 */
/* bench 26356.0.2 65b56a4e9647 */
/* bench 26356.0.3 dcea6d0c6211 */
/* bench 26356.0.4 6e33fd2f7541 */
/* bench 26356.0.5 72b3adb33c59 */
/* bench 26356.0.6 aa46034169c9 */
/* bench 26356.0.7 463d5877fcde */
/* bench 26356.0.8 23a6bd33e9c5 */
/* bench 26356.0.9 a097b3f5f002 */
/* bench 26356.0.10 3a13540a4541 */
/* bench 26356.0.11 6e173dd38726 */
/* bench 26356.0.12 fd42553a56a0 */
/* bench 26356.0.13 0fd838d72d18 */
- compatible : should be "fsl,diu" or "fsl,mpc5121-diu".
- reg : should contain at least address and length of the DIU register
  set.
- interrupts : one DIU interrupt should be described here.

Optional properties:
- edid : verbatim EDID data block describing attached display.
  Data from the detailed timing descriptor will be used to
  program the display controller.

Example (MPC8610HPCD):
	display@2c000 {
		compatible = "fsl,diu";
		reg = <0x2c000 100>;
		interrupts = <72 2>;
		interrupt-parent = <&mpic>;
	};

Example for MPC5121:
	display@2100 {
		compatible = "fsl,mpc5121-diu";
		reg = <0x2100 0x100>;
		interrupts = <64 0x8>;
		interrupt-parent = <&ipic>;
		edid = [edid-data];
	};
```
