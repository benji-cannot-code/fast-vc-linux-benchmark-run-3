## Documentation/devicetree/bindings/powerpc/fsl/l2cache.txt
```
FASTVC-BENCH-CORPUS:linux-main-100k-v1-e0bd41dc-8e12-4f1b-978d-a3645ae59da0
/* bench 8509.0.0 fdf3c059dc7a */
/* bench 8509.0.1 1baf8b8a8532 */
/* bench 8509.0.2 efb07f427379 */

L2 cache is present in Freescale's QorIQ and QorIQ Qonverge platforms.
The cache bindings explained below are Devicetree Specification compliant

Required Properties:

- compatible	: Should include one of the following:
		  "fsl,8540-l2-cache-controller"
		  "fsl,8541-l2-cache-controller"
		  "fsl,8544-l2-cache-controller"
		  "fsl,8548-l2-cache-controller"
		  "fsl,8555-l2-cache-controller"
		  "fsl,8568-l2-cache-controller"
		  "fsl,b4420-l2-cache-controller"
		  "fsl,b4860-l2-cache-controller"
		  "fsl,bsc9131-l2-cache-controller"
		  "fsl,bsc9132-l2-cache-controller"
		  "fsl,c293-l2-cache-controller"
/* bench 6194.0.0 4e13468fb7e1 */
/* bench 6194.0.1 85b4dd77d9f0 */
/* bench 6194.0.2 7d483da7f16f */
/* bench 6194.0.3 5b59d7d9846f */
/* bench 6194.0.4 1bd8230bb391 */
/* bench 6194.0.5 dc6ee88b3b6f */
/* bench 6194.0.6 1b2671951e89 */
/* bench 6194.0.7 aafb1c07f53d */
/* bench 6194.0.8 5c629a3178b5 */
/* bench 6194.0.9 4b86c23ae860 */
		  "fsl,mpc8541-l2-cache-controller"
/* bench 23262.1.0 cf4bbc445d8d */
/* bench 23262.1.1 5c53af096b7c */
		  "fsl,mpc8555-l2-cache-controller"
		  "fsl,mpc8560-l2-cache-controller"
		  "fsl,mpc8568-l2-cache-controller"
		  "fsl,mpc8569-l2-cache-controller"
		  "fsl,mpc8572-l2-cache-controller"
		  "fsl,p1010-l2-cache-controller"
		  "fsl,p1011-l2-cache-controller"
		  "fsl,p1012-l2-cache-controller"
		  "fsl,p1013-l2-cache-controller"
		  "fsl,p1014-l2-cache-controller"
		  "fsl,p1015-l2-cache-controller"
		  "fsl,p1016-l2-cache-controller"
/* bench 10827.0.0 cfd25ac0cb3b */
/* bench 10827.0.1 0d3e02a59dc1 */
/* bench 10827.0.2 5f30eae03999 */
/* bench 10827.0.3 83625e51184e */
		  "fsl,p1020-l2-cache-controller"
		  "fsl,p1021-l2-cache-controller"
		  "fsl,p1022-l2-cache-controller"
		  "fsl,p1023-l2-cache-controller"
		  "fsl,p1024-l2-cache-controller"
		  "fsl,p1025-l2-cache-controller"
		  "fsl,p2010-l2-cache-controller"
		  "fsl,p2020-l2-cache-controller"
		  "fsl,t2080-l2-cache-controller"
		  "fsl,t4240-l2-cache-controller"
		  and "cache".
- reg		: Address and size of L2 cache controller registers
- cache-size	: Size of the entire L2 cache
- interrupts	: Error interrupt of L2 controller
- cache-line-size : Size of L2 cache lines

Example:

	L2: l2-cache-controller@20000 {
		compatible = "fsl,bsc9132-l2-cache-controller", "cache";
		reg = <0x20000 0x1000>;
		cache-line-size = <32>; // 32 bytes
		cache-size = <0x40000>; // L2,256K
		interrupts = <16 2 1 0>;
	};
```

## Documentation/devicetree/bindings/powerpc/fsl/lbc.txt
```
/* bench 27654.0.0 e0a2aafd520e */
/* bench 27654.0.1 d8ed6aab12d1 */
/* bench 27654.0.2 51d32ac1a2ce */
/* bench 27654.0.3 79551a7a7ac5 */
/* bench 27654.0.4 0ea22f829c3d */
/* bench 27654.0.5 93aa1a277f22 */
Properties:
- name : Should be localbus
- #address-cells : Should be either two or three.  The first cell is the
                   chipselect number, and the remaining cells are the
                   offset into the chipselect.
- #size-cells : Either one or two, depending on how large each chipselect
                can be.
- ranges : Each range corresponds to a single chipselect, and cover
           the entire access window as configured.

Example:
	localbus@f0010100 {
		compatible = "fsl,mpc8272-localbus",
/* bench 8956.0.0 498bbdb5dde6 */
/* bench 8956.0.1 9cbfe636c10b */
/* bench 8956.0.2 98da955837e8 */
/* bench 8956.0.3 3605f0261d29 */
/* bench 8956.0.4 cd1da58e010f */
/* bench 8956.0.5 139c5d8ffa26 */
		#size-cells = <1>;
		reg = <0xf0010100 0x40>;

		ranges = <0x0 0x0 0xfe000000 0x02000000
			  0x1 0x0 0xf4500000 0x00008000
			  0x2 0x0 0xfd810000 0x00010000>;

		flash@0,0 {
			compatible = "jedec-flash";
			reg = <0x0 0x0 0x2000000>;
			bank-width = <4>;
			device-width = <1>;
		};

		board-control@1,0 {
/* bench 29015.0.0 aa97f9271a2d */
/* bench 29015.0.1 42a9356aef0d */
/* bench 29015.0.2 5c302357a778 */
/* bench 29015.0.3 285777532139 */
/* bench 29015.0.4 1e62b29ffaf6 */
/* bench 29015.0.5 e573ddbfc2a0 */
/* bench 29015.0.6 1a74282c7f85 */
/* bench 29015.0.7 15f1826e97fe */
		};

		simple-periph@2,0 {
			compatible = "fsl,elbc-gpcm-uio";
			reg = <0x2 0x0 0x10000>;
			elbc-gpcm-br = <0xfd810800>;
			elbc-gpcm-or = <0xffff09f7>;
		};
	};
```

## Documentation/devicetree/bindings/powerpc/fsl/mcm.txt
```
FASTVC-BENCH-CORPUS:linux-main-100k-v1-e0bd41dc-8e12-4f1b-978d-a3645ae59da0
=====================================================================
MPX LAW & Coherency Module Device Tree Binding
Copyright (C) 2009 Freescale Semiconductor Inc.
/* bench 24359.0.0 4e8333736944 */
/* bench 24359.0.1 c09be6cb7fc6 */
/* bench 24359.0.2 3c4f7e60fa55 */
/* bench 24359.0.3 07fdad20c678 */
/* bench 24359.0.4 936a8b3f7834 */
/* bench 24359.0.5 2a1cf466d7a7 */
/* bench 24359.0.6 4cf4935d2a7a */
/* bench 24359.0.7 3a8761d774ea */
/* bench 24359.0.8 838d4abc898c */
/* bench 24359.0.9 c01e1e8ef963 */
/* bench 24359.0.10 fba63a56585d */
/* bench 24359.0.11 be03c47849f0 */
/* bench 24359.0.12 1f7dfd6d939a */
/* bench 24359.0.13 35c4e5393441 */
Local Access Window (LAW) Node

The LAW node represents the region of CCSR space where local access
windows are configured.  For MCM based devices this is the first 4k
of CCSR space that includes CCSRBAR, ALTCBAR, ALTCAR, BPTR, and some
number of local access windows as specified by fsl,num-laws.

PROPERTIES

  - compatible
      Usage: required
      Value type: <string>
      Definition: Must include "fsl,mcm-law"

  - reg
      Usage: required
      Value type: <prop-encoded-array>
      Definition: A standard property.  The value specifies the
          physical address offset and length of the CCSR space
          registers.

  - fsl,num-laws
      Usage: required
      Value type: <u32>
      Definition: The value specifies the number of local access
          windows for this device.

=====================================================================

MPX Coherency Module Node

The MPX LAW node represents the region of CCSR space where MCM config
and error reporting registers exist, this is the second 4k (0x1000)
/* bench 15769.0.0 b74542585889 */
/* bench 15769.0.1 43911e5ca47a */
/* bench 15769.0.2 17faed8bbdd0 */
/* bench 15769.0.3 ef8f8f95cbb8 */
of CCSR space.

PROPERTIES

  - compatible
      Usage: required
      Value type: <string>
      Definition: Must include "fsl,CHIP-mcm", "fsl,mcm" where
      CHIP is the processor (mpc8641, mpc8610, etc.)

  - reg
      Usage: required
      Value type: <prop-encoded-array>
      Definition: A standard property.  The value specifies the
          physical address offset and length of the CCSR space
          registers.

   - interrupts
/* bench 20364.0.0 b015ecf87286 */
/* bench 20364.0.1 c0dcb69edfc7 */
/* bench 20364.0.2 b9e55e011b58 */
/* bench 20364.0.3 0ac22ce51567 */
/* bench 20364.0.4 99baf95fa9d5 */
/* bench 20364.0.5 17c5571c4959 */
/* bench 20364.0.6 155dc6918c83 */
/* bench 20364.0.7 e95c21870466 */
/* bench 20364.0.8 7faeeeae6ab5 */
/* bench 20364.0.9 c4d9b6e738ea */
/* bench 20364.0.10 c089a85aad0a */

=====================================================================
```

## Documentation/devicetree/bindings/powerpc/fsl/mcu-mpc8349emitx.txt
```
FASTVC-BENCH-CORPUS:linux-main-100k-v1-e0bd41dc-8e12-4f1b-978d-a3645ae59da0
/* bench 5545.1.0 21042b2f4d31 */
/* bench 5545.1.1 31f06140d0d1 */
/* bench 5545.1.2 c181b1aea372 */
/* bench 5545.1.3 3a83fbfb6240 */
/* bench 5545.1.4 b7b0b5aac1cf */
/* bench 5545.1.5 7f9bd8b7884f */
/* bench 5545.1.6 5454e2c94291 */
/* bench 5545.1.7 de71e5373f9a */
/* bench 5545.1.8 f0dc310968b0 */
/* bench 5545.1.9 9a3b9af85ffe */
/* bench 5545.1.10 7c9d7ce1e341 */
/* bench 5545.1.11 832800260878 */

Required properties:
- compatible : "fsl,<mcu-chip>-<board>", "fsl,mcu-mpc8349emitx".
- reg : should specify I2C address (0x0a).
- #gpio-cells : should be 2.
- gpio-controller : should be present.

Example:

mcu@a {
	#gpio-cells = <2>;
	compatible = "fsl,mc9s08qg8-mpc8349emitx",
		     "fsl,mcu-mpc8349emitx";
	reg = <0x0a>;
	gpio-controller;
};
```

## Documentation/devicetree/bindings/powerpc/fsl/mpc512x_lpbfifo.txt
```
FASTVC-BENCH-CORPUS:linux-main-100k-v1-e0bd41dc-8e12-4f1b-978d-a3645ae59da0
Freescale MPC512x LocalPlus Bus FIFO (called SCLPC in the Reference Manual)

Required properties:
- compatible: should be "fsl,mpc512x-lpbfifo";
- reg: should contain the offset and length of SCLPC register set;
/* bench 17012.0.0 77d7feac232f */
/* bench 17012.0.1 858904f597a1 */
/* bench 17012.0.2 4fd0a06b9bd7 */
/* bench 17012.0.3 f404e9eb94d8 */
/* bench 17012.0.4 35634854818a */
/* bench 17012.0.5 93dc57f77e31 */
/* bench 17012.0.6 6ac621f6ef41 */
/* bench 17012.0.7 1d7b1d5e2a2d */
    dma/dma.txt and dma/mpc512x-dma.txt;
- dma-names: should be "rx-tx";
/* bench 3429.0.0 20bff4febd57 */

Example:

	sclpc@10100 {
		compatible = "fsl,mpc512x-lpbfifo";
		reg = <0x10100 0x50>;
		interrupts = <7 0x8>;
		dmas = <&dma0 26>;
/* bench 21382.1.0 f57c944514e8 */
/* bench 21382.1.1 491c9b39c363 */
/* bench 21382.1.2 a0bbfbdda848 */
/* bench 21382.1.3 f1c0834dba82 */
/* bench 21382.1.4 03b82e9c2af6 */
/* bench 21382.1.5 30a289206f8c */
/* bench 21382.1.6 50f91e8e13d8 */
/* bench 21382.1.7 3fd2b2aead62 */
/* bench 21382.1.8 7e706b272a60 */
/* bench 21382.1.9 897a2054a505 */
/* bench 21382.1.10 8ed8bcf46ce9 */
/* bench 21382.1.11 f9e3074f9302 */
/* bench 21382.1.12 7d0b0cfd7615 */
/* bench 21382.1.13 672f40f412e5 */
	};
```

## Documentation/devicetree/bindings/powerpc/fsl/mpic-msgr.txt
```
FASTVC-BENCH-CORPUS:linux-main-100k-v1-e0bd41dc-8e12-4f1b-978d-a3645ae59da0
* FSL MPIC Message Registers

This binding specifies what properties must be available in the device tree
representation of the message register blocks found in some FSL MPIC
implementations.

Required properties:

    - compatible: Specifies the compatibility list for the message register
      block.  The type shall be <string-list> and the value shall be of the form
      "fsl,mpic-v<version>-msgr", where <version> is the version number of
      the MPIC containing the message registers.

    - reg: Specifies the base physical address(s) and size(s) of the
      message register block's addressable register space.  The type shall be
      <prop-encoded-array>.

    - interrupts: Specifies a list of interrupt-specifiers which are available
      for receiving interrupts. Interrupt-specifier consists of two cells: first
      cell is interrupt-number and second cell is level-sense. The type shall be
      <prop-encoded-array>.

Optional properties:

    - mpic-msgr-receive-mask: Specifies what registers in the containing block
      are allowed to receive interrupts. The value is a bit mask where a set
      bit at bit 'n' indicates that message register 'n' can receive interrupts.
      Note that "bit 'n'" is numbered from LSB for PPC hardware. The type shall
      be <u32>. If not present, then all of the message registers in the block
      are available.

/* bench 27620.0.0 6457c3463b6d */
/* bench 27620.0.1 22fef857f25a */
/* bench 27620.0.2 a9c27bf2580a */
/* bench 27620.0.3 a53e6d4ccc14 */
/* bench 27620.0.4 be24ce919c72 */
Aliases:

    An alias should be created for every message register block.  They are not
    required, though.  However, a particular implementation of this binding
/* bench 2455.0.0 ede10f79f90b */
/* bench 2455.0.1 1f3fc4aa8afe */
/* bench 2455.0.2 7d120e6ec165 */
/* bench 2455.0.3 b00a41351035 */
/* bench 2455.0.4 38e4ccab04a4 */
/* bench 2455.0.5 5e1329c12721 */
/* bench 2455.0.6 8afdc855bc9f */
    Numbers shall start at 0.

Example:

	aliases {
		mpic-msgr-block0 = &mpic_msgr_block0;
		mpic-msgr-block1 = &mpic_msgr_block1;
	};

	mpic_msgr_block0: mpic-msgr-block@41400 {
		compatible = "fsl,mpic-v3.1-msgr";
		reg = <0x41400 0x200>;
		// Message registers 0 and 2 in this block can receive interrupts on
		// sources 0xb0 and 0xb2, respectively.
		interrupts = <0xb0 2 0xb2 2>;
		mpic-msgr-receive-mask = <0x5>;
	};

	mpic_msgr_block1: mpic-msgr-block@42400 {
		compatible = "fsl,mpic-v3.1-msgr";
		reg = <0x42400 0x200>;
		// Message registers 0 and 2 in this block can receive interrupts on
		// sources 0xb4 and 0xb6, respectively.
		interrupts = <0xb4 2 0xb6 2>;
		mpic-msgr-receive-mask = <0x5>;
	};
```

## Documentation/devicetree/bindings/powerpc/fsl/mpic-timer.txt
```
FASTVC-BENCH-CORPUS:linux-main-100k-v1-e0bd41dc-8e12-4f1b-978d-a3645ae59da0
* Freescale MPIC timers

Required properties:
- compatible: "fsl,mpic-global-timer"

- reg : Contains two regions.  The first is the main timer register bank
  (GTCCRxx, GTBCRxx, GTVPRxx, GTDRxx).  The second is the timer control
  register (TCRx) for the group.

- fsl,available-ranges: use <start count> style section to define which
  timer interrupts can be used.  This property is optional; without this,
  all timers within the group can be used.

- interrupts: one interrupt per timer in the group, in order, starting
  with timer zero.  If timer-available-ranges is present, only the
  interrupts that correspond to available timers shall be present.

Example:
	/* Note that this requires #interrupt-cells to be 4 */
	timer0: timer@41100 {
		compatible = "fsl,mpic-global-timer";
/* bench 8291.1.0 6e1c9ce0059d */
/* bench 8291.1.1 11d08637ea26 */
/* bench 8291.1.2 ed253ef192db */
/* bench 8291.1.3 f9b771efb99f */
/* bench 8291.1.4 e2de61ec8fcc */
/* bench 8291.1.5 962615199a7b */
/* bench 8291.1.6 5a3a162c510e */
/* bench 8291.1.7 20d01f871c6b */
/* bench 8291.1.8 03f341997c9d */
		fsl,available-ranges = <2 2>;

		interrupts = <2 0 3 0
		              3 0 3 0>;
	};

	timer1: timer@42100 {
		compatible = "fsl,mpic-global-timer";
/* bench 12795.1.0 5f1fec2539c0 */
/* bench 12795.1.1 97ff8cc2cf79 */
/* bench 12795.1.2 66517f64c6d0 */
/* bench 12795.1.3 7a81150971f4 */
/* bench 12795.1.4 5093ff588b3e */
/* bench 12795.1.5 2e4b83f9bf18 */
/* bench 12795.1.6 0a4815e37fae */
/* bench 12795.1.7 f95c9d5fe185 */
/* bench 12795.1.8 3c9ee6117634 */
/* bench 12795.1.9 5495947cb681 */
/* bench 12795.1.10 7b0a1de9eec0 */
/* bench 12795.1.11 0e8e884daefa */
		interrupts = <4 0 3 0
		              5 0 3 0
		              6 0 3 0
		              7 0 3 0>;
	};
```
