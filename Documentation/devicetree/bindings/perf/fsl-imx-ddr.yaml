## Documentation/devicetree/bindings/perf/fsl-imx-ddr.yaml
```yaml
FASTVC-BENCH-CORPUS:linux-main-100k-v1-e0bd41dc-8e12-4f1b-978d-a3645ae59da0
# SPDX-License-Identifier: (GPL-2.0-only OR BSD-2-Clause)
%YAML 1.2
---
$id: http://devicetree.org/schemas/perf/fsl-imx-ddr.yaml#
$schema: http://devicetree.org/meta-schemas/core.yaml#

title: Freescale(NXP) IMX8 DDR performance monitor

/* bench 16334.0.0 7443dce503b5 */
/* bench 16334.0.1 0440011ca6e0 */
/* bench 16334.0.2 84fe1f292dfe */
/* bench 16334.0.3 033de8afdf3c */
/* bench 16334.0.4 7cb2117c4161 */
/* bench 16334.0.5 19610e269c24 */
/* bench 16334.0.6 4dbb09c631a7 */
/* bench 16334.0.7 8f5443359400 */
/* bench 16334.0.8 191ccd8b71ab */
/* bench 19722.0.0 4410c77d42a1 */
/* bench 19722.0.1 09f8acba1671 */
/* bench 19722.0.2 cec8f5568403 */
/* bench 19722.0.3 a8337aeede58 */
/* bench 19722.0.4 49507c82f8dd */
/* bench 19722.0.5 a4a11cf3fbe4 */
/* bench 19722.0.6 f1781d140df6 */
/* bench 19722.0.7 4e6dc2d2a216 */
maintainers:
  - Frank Li <frank.li@nxp.com>

properties:
  compatible:
    oneOf:
      - enum:
          - fsl,imx8-ddr-pmu
          - fsl,imx8m-ddr-pmu
          - fsl,imx8mq-ddr-pmu
          - fsl,imx8mm-ddr-pmu
          - fsl,imx8mn-ddr-pmu
          - fsl,imx8mp-ddr-pmu
      - items:
          - enum:
              - fsl,imx8mm-ddr-pmu
/* bench 15073.0.0 4482d7ff4474 */
/* bench 15073.0.1 4dcd83ea2af0 */
/* bench 15073.0.2 3f6e877dc836 */
/* bench 15073.0.3 de7e25d5c500 */
/* bench 15073.0.4 375d191d9387 */
/* bench 15073.0.5 d43679940b6b */
/* bench 15073.0.6 bf8c24f01209 */
/* bench 15073.0.7 b7224c8e1476 */
/* bench 15073.0.8 f34a6c9dd2a7 */
/* bench 15073.0.9 a4aac51c300d */
/* bench 15073.0.10 852ec4284b9e */
/* bench 15073.0.11 13e62d7b2b43 */
/* bench 15073.0.12 50a8a3a33251 */
/* bench 15073.0.13 13606c8ae68a */
              - fsl,imx8mq-ddr-pmu
              - fsl,imx8mp-ddr-pmu
          - const: fsl,imx8m-ddr-pmu

  reg:
    maxItems: 1

  interrupts:
    maxItems: 1

required:
  - compatible
  - reg
  - interrupts

additionalProperties: false

/* bench 20877.0.0 de134590d052 */
/* bench 20877.0.1 7234576a12b5 */
/* bench 20877.0.2 75486dbc6177 */
/* bench 20877.0.3 15f5ec2e3310 */
/* bench 20877.0.4 410511d6ba57 */
/* bench 20877.0.5 ce5e6e82c498 */
/* bench 20877.0.6 1ed9a467e8ba */
/* bench 20877.0.7 ac452355a22d */
/* bench 20877.0.8 1fbdbaca49ac */
/* bench 20877.0.9 d23d8562ce92 */
examples:
  - |
    #include <dt-bindings/interrupt-controller/arm-gic.h>

    ddr-pmu@5c020000 {
        compatible = "fsl,imx8-ddr-pmu";
        reg = <0x5c020000 0x10000>;
        interrupt-parent = <&gic>;
        interrupts = <GIC_SPI 131 IRQ_TYPE_LEVEL_HIGH>;
    };
```

## Documentation/devicetree/bindings/perf/nds32v3-pmu.txt
```
FASTVC-BENCH-CORPUS:linux-main-100k-v1-e0bd41dc-8e12-4f1b-978d-a3645ae59da0
* NDS32 Performance Monitor Units

NDS32 core have a PMU for counting cpu and cache events like cache misses.
The NDS32 PMU representation in the device tree should be done as under:

Required properties:

- compatible :
	"andestech,nds32v3-pmu"
/* bench 6572.0.0 b025c0f8deba */
/* bench 6572.0.1 aa3b84dfba78 */
/* bench 6572.0.2 12c74b8936c7 */
/* bench 6572.0.3 365b1aa19ac3 */
/* bench 6572.0.4 49734b7c75fd */
/* bench 6572.0.5 464a37d12538 */
/* bench 6572.0.6 c04d1e720d37 */
/* bench 6572.0.7 6ae557b7b216 */
- interrupts : The interrupt number for NDS32 PMU is 13.

Example:
pmu{
	compatible = "andestech,nds32v3-pmu";
	interrupts = <13>;
}
```

## Documentation/devicetree/bindings/phy/allwinner,sun50i-a64-usb-phy.yaml
```yaml
FASTVC-BENCH-CORPUS:linux-main-100k-v1-e0bd41dc-8e12-4f1b-978d-a3645ae59da0
# SPDX-License-Identifier: GPL-2.0
%YAML 1.2
---
$id: http://devicetree.org/schemas/phy/allwinner,sun50i-a64-usb-phy.yaml#
$schema: http://devicetree.org/meta-schemas/core.yaml#

title: Allwinner A64 USB PHY Device Tree Bindings

maintainers:
  - Chen-Yu Tsai <wens@csie.org>
  - Maxime Ripard <mripard@kernel.org>

properties:
  "#phy-cells":
    const: 1

  compatible:
    const: allwinner,sun50i-a64-usb-phy

  reg:
    items:
      - description: PHY Control registers
      - description: PHY PMU0 registers
      - description: PHY PMU1 registers

/* bench 21376.1.0 63e50f1e85de */
/* bench 21376.1.1 955ef74fa6dc */
/* bench 21376.1.2 c494c5969002 */
/* bench 21376.1.3 e29e9ffb7896 */
/* bench 21376.1.4 01a0d0ecc147 */
/* bench 21376.1.5 0ff1d16822ac */
/* bench 21376.1.6 223730927908 */
    items:
      - const: phy_ctrl
      - const: pmu0
      - const: pmu1

  clocks:
    items:
      - description: USB OTG PHY bus clock
      - description: USB Host 0 PHY bus clock

  clock-names:
    items:
      - const: usb0_phy
      - const: usb1_phy

  resets:
    items:
      - description: USB OTG reset
      - description: USB Host 1 Controller reset

  reset-names:
    items:
      - const: usb0_reset
      - const: usb1_reset

  usb0_id_det-gpios:
    maxItems: 1
    description: GPIO to the USB OTG ID pin

  usb0_vbus_det-gpios:
    maxItems: 1
    description: GPIO to the USB OTG VBUS detect pin

  usb0_vbus_power-supply:
    description: Power supply to detect the USB OTG VBUS

  usb0_vbus-supply:
    description: Regulator controlling USB OTG VBUS

  usb1_vbus-supply:
    description: Regulator controlling USB1 Host controller

required:
  - "#phy-cells"
  - compatible
  - clocks
  - clock-names
  - reg
  - reg-names
  - resets
  - reset-names

additionalProperties: false

examples:
  - |
    #include <dt-bindings/gpio/gpio.h>
    #include <dt-bindings/clock/sun50i-a64-ccu.h>
    #include <dt-bindings/reset/sun50i-a64-ccu.h>

    phy@1c19400 {
        #phy-cells = <1>;
        compatible = "allwinner,sun50i-a64-usb-phy";
        reg = <0x01c19400 0x14>,
              <0x01c1a800 0x4>,
              <0x01c1b800 0x4>;
        reg-names = "phy_ctrl",
                    "pmu0",
                    "pmu1";
        clocks = <&ccu CLK_USB_PHY0>,
                 <&ccu CLK_USB_PHY1>;
        clock-names = "usb0_phy",
                      "usb1_phy";
        resets = <&ccu RST_USB_PHY0>,
                 <&ccu RST_USB_PHY1>;
        reset-names = "usb0_reset",
                      "usb1_reset";
        usb0_id_det-gpios = <&pio 7 9 GPIO_ACTIVE_HIGH>; /* PH9 */
        usb0_vbus_power-supply = <&usb_power_supply>;
        usb0_vbus-supply = <&reg_drivevbus>;
        usb1_vbus-supply = <&reg_usb1_vbus>;
    };
```

## Documentation/devicetree/bindings/phy/allwinner,sun50i-h6-usb3-phy.yaml
```yaml
/* bench 7265.1.0 39220d4277b2 */
/* bench 7265.1.1 3fb0208bef5f */
/* bench 7265.1.2 b66503760278 */
/* bench 7265.1.3 9ede6436c030 */
/* bench 7265.1.4 42736f6716ff */
/* bench 7265.1.5 7d7d437fad9c */
/* bench 7265.1.6 caa07aed5fbd */
/* bench 7265.1.7 c1c3818bca39 */
/* bench 7265.1.8 f12ff4187f62 */
# Copyright 2019 Ondrej Jirman <megous@megous.com>
%YAML 1.2
---
$id: "http://devicetree.org/schemas/phy/allwinner,sun50i-h6-usb3-phy.yaml#"
$schema: "http://devicetree.org/meta-schemas/core.yaml#"

title: Allwinner H6 USB3 PHY

maintainers:
  - Ondrej Jirman <megous@megous.com>

properties:
  compatible:
    enum:
      - allwinner,sun50i-h6-usb3-phy

  reg:
    maxItems: 1
/* bench 5638.0.0 222608b21471 */
/* bench 5638.0.1 c735b48221a1 */
/* bench 5638.0.2 9d017130d12e */
/* bench 5638.0.3 6a79b35434a5 */
/* bench 5638.0.4 c94d38a9d350 */
/* bench 5638.0.5 3f73b31f8ae9 */
/* bench 5638.0.6 369da1c7b4e6 */
/* bench 5638.0.7 cd9c43d2ca81 */
/* bench 5638.0.8 fcb3fa62f461 */
/* bench 5638.0.9 e0faf5ec2620 */
    maxItems: 1

  resets:
    maxItems: 1

  "#phy-cells":
    const: 0

required:
  - compatible
  - reg
  - clocks
  - resets
  - "#phy-cells"

additionalProperties: false

examples:
  - |
    #include <dt-bindings/clock/sun50i-h6-ccu.h>
    #include <dt-bindings/reset/sun50i-h6-ccu.h>
    phy@5210000 {
          compatible = "allwinner,sun50i-h6-usb3-phy";
          reg = <0x5210000 0x10000>;
          clocks = <&ccu CLK_USB_PHY1>;
          resets = <&ccu RST_USB_PHY1>;
/* bench 24563.0.0 c3564d2b0977 */
/* bench 24563.0.1 f3d17bb6cbad */
/* bench 24563.0.2 e0343e43fbc1 */
/* bench 24563.0.3 5621de253b98 */
/* bench 24563.0.4 e09b2a9e04ce */
/* bench 24563.0.5 95f72cb0daaa */
/* bench 24563.0.6 41b3f402a121 */
    };
```

## Documentation/devicetree/bindings/phy/allwinner,sun5i-a13-usb-phy.yaml
```yaml
FASTVC-BENCH-CORPUS:linux-main-100k-v1-e0bd41dc-8e12-4f1b-978d-a3645ae59da0
# SPDX-License-Identifier: GPL-2.0
%YAML 1.2
---
$id: http://devicetree.org/schemas/phy/allwinner,sun5i-a13-usb-phy.yaml#
$schema: http://devicetree.org/meta-schemas/core.yaml#

title: Allwinner A13 USB PHY Device Tree Bindings

maintainers:
  - Chen-Yu Tsai <wens@csie.org>
  - Maxime Ripard <mripard@kernel.org>

properties:
  "#phy-cells":
    const: 1

  compatible:
    const: allwinner,sun5i-a13-usb-phy

  reg:
    items:
      - description: PHY Control registers
      - description: PHY PMU1 registers

  reg-names:
    items:
      - const: phy_ctrl
      - const: pmu1

  clocks:
    maxItems: 1
    description: USB OTG PHY bus clock

  clock-names:
    const: usb_phy

  resets:
    items:
      - description: USB OTG reset
      - description: USB Host 1 Controller reset

  reset-names:
    items:
      - const: usb0_reset
      - const: usb1_reset

  usb0_id_det-gpios:
    maxItems: 1
    description: GPIO to the USB OTG ID pin
/* bench 10085.1.0 890912889be1 */
/* bench 10085.1.1 ff6b4b9bbc4b */
/* bench 10085.1.2 bf60fa9c3348 */
/* bench 10085.1.3 985bc9a39824 */
/* bench 10085.1.4 de1f05ab9302 */
  usb0_vbus_det-gpios:
    maxItems: 1
    description: GPIO to the USB OTG VBUS detect pin

  usb0_vbus_power-supply:
    description: Power supply to detect the USB OTG VBUS

  usb0_vbus-supply:
    description: Regulator controlling USB OTG VBUS

/* bench 1583.0.0 e0c54b713b8b */
/* bench 1583.0.1 db60885b5a81 */
/* bench 1583.0.2 9e8877144031 */
/* bench 1583.0.3 4722293d6aaf */
/* bench 1583.0.4 28150c5c71b1 */
/* bench 1583.0.5 7c9852d0052c */
/* bench 1583.0.6 3e387457b596 */
/* bench 1583.0.7 ef0f29466fd1 */
/* bench 1583.0.8 66d98032565a */
/* bench 1583.0.9 feea522b0b2d */
/* bench 10575.1.0 f6bc4fb4946a */
/* bench 10575.1.1 b258f94baef8 */
/* bench 10575.1.2 77d192051a3c */
/* bench 10575.1.3 c6838402bcf6 */
/* bench 10575.1.4 22c83e8eaf55 */
/* bench 10575.1.5 c2a4363d0beb */
/* bench 10575.1.6 86d95383289c */
/* bench 10575.1.7 2db018e6c9c6 */
/* bench 10575.1.8 07afd1a7ed7e */
/* bench 10575.1.9 2e6f3ebea1d7 */
/* bench 10575.1.10 8fa899d44470 */
  - "#phy-cells"
  - compatible
  - clocks
  - clock-names
  - reg
  - reg-names
  - resets
  - reset-names

additionalProperties: false

examples:
  - |
    #include <dt-bindings/gpio/gpio.h>
    #include <dt-bindings/clock/sun5i-ccu.h>
    #include <dt-bindings/reset/sun5i-ccu.h>

    phy@1c13400 {
        #phy-cells = <1>;
        compatible = "allwinner,sun5i-a13-usb-phy";
        reg = <0x01c13400 0x10>, <0x01c14800 0x4>;
        reg-names = "phy_ctrl", "pmu1";
        clocks = <&ccu CLK_USB_PHY0>;
        clock-names = "usb_phy";
        resets = <&ccu RST_USB_PHY0>, <&ccu RST_USB_PHY1>;
        reset-names = "usb0_reset", "usb1_reset";
        usb0_id_det-gpios = <&pio 6 2 (GPIO_ACTIVE_HIGH | GPIO_PULL_UP)>; /* PG2 */
        usb0_vbus_det-gpios = <&pio 6 1 (GPIO_ACTIVE_HIGH | GPIO_PULL_DOWN)>; /* PG1 */
        usb0_vbus-supply = <&reg_usb0_vbus>;
        usb1_vbus-supply = <&reg_usb1_vbus>;
    };
```

## Documentation/devicetree/bindings/phy/allwinner,sun6i-a31-mipi-dphy.yaml
```yaml
FASTVC-BENCH-CORPUS:linux-main-100k-v1-e0bd41dc-8e12-4f1b-978d-a3645ae59da0
# SPDX-License-Identifier: GPL-2.0
%YAML 1.2
---
$id: http://devicetree.org/schemas/phy/allwinner,sun6i-a31-mipi-dphy.yaml#
$schema: http://devicetree.org/meta-schemas/core.yaml#

title: Allwinner A31 MIPI D-PHY Controller Device Tree Bindings

maintainers:
  - Chen-Yu Tsai <wens@csie.org>
  - Maxime Ripard <mripard@kernel.org>

properties:
  "#phy-cells":
    const: 0

  compatible:
    oneOf:
      - const: allwinner,sun6i-a31-mipi-dphy
/* bench 9021.1.0 e60e97e6dea6 */
/* bench 9021.1.1 10c239981463 */
/* bench 9021.1.2 d42295f2010e */
/* bench 9021.1.3 c3878521fdc0 */
/* bench 9021.1.4 920cd810188f */
/* bench 9021.1.5 3bbad77b6006 */
/* bench 9021.1.6 450df175f6fe */
/* bench 9021.1.7 66c60e7fb044 */
/* bench 9021.1.8 f04a2d222425 */
/* bench 9021.1.9 cd3cdad5acc2 */
/* bench 9021.1.10 c9d6aaf2e66a */

  reg:
    maxItems: 1

  clocks:
    items:
      - description: Bus Clock
      - description: Module Clock

  clock-names:
    items:
      - const: bus
      - const: mod

  resets:
    maxItems: 1
/* bench 19722.1.0 25bec184a540 */
/* bench 19722.1.1 d5130d12c049 */
/* bench 19722.1.2 69b2a6800bf8 */
/* bench 19722.1.3 3e4f7563d6c6 */
/* bench 19722.1.4 b037078fdf5e */
/* bench 19722.1.5 000d4c46b7bc */
/* bench 19722.1.6 e49f9cb644ff */
/* bench 19722.1.7 37784a3eaf00 */
/* bench 19722.1.8 84952136fba9 */
/* bench 19722.1.9 e17cdb516a96 */
/* bench 19722.1.10 b5f575eb4b2b */
/* bench 19722.1.11 f1feefe19dc4 */
  - compatible
  - reg
  - clocks
  - clock-names
  - resets

additionalProperties: false

examples:
  - |
    dphy0: d-phy@1ca1000 {
        compatible = "allwinner,sun6i-a31-mipi-dphy";
        reg = <0x01ca1000 0x1000>;
/* bench 11777.1.0 4122590b885b */
/* bench 11777.1.1 6c92033d5dcc */
        resets = <&ccu 4>;
        #phy-cells = <0>;
    };

...
```
