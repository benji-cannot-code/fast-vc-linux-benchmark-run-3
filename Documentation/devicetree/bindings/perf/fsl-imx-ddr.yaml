## Documentation/devicetree/bindings/phy/allwinner,sun8i-a83t-usb-phy.yaml
```yaml
FASTVC-BENCH-CORPUS:linux-main-100k-v1-e0bd41dc-8e12-4f1b-978d-a3645ae59da0
# SPDX-License-Identifier: GPL-2.0
%YAML 1.2
---
$id: http://devicetree.org/schemas/phy/allwinner,sun8i-a83t-usb-phy.yaml#
$schema: http://devicetree.org/meta-schemas/core.yaml#

title: Allwinner A83t USB PHY Device Tree Bindings

maintainers:
  - Chen-Yu Tsai <wens@csie.org>
/* bench 12378.0.0 1f3c9c3aad6d */
/* bench 12378.0.1 fef589255ddf */
/* bench 12378.0.2 b7f339c06648 */
/* bench 12378.0.3 819bffb950b5 */
/* bench 12378.0.4 cfa216f7d722 */
/* bench 12378.0.5 8117b8f20272 */
/* bench 12378.0.6 ddd32958e6f5 */
/* bench 12378.0.7 dff1c8fa3c17 */
/* bench 12378.0.8 249bd724a063 */
/* bench 12378.0.9 b3a688abec99 */
  "#phy-cells":
    const: 1

  compatible:
    const: allwinner,sun8i-a83t-usb-phy

  reg:
    items:
      - description: PHY Control registers
      - description: PHY PMU1 registers
      - description: PHY PMU2 registers

  reg-names:
    items:
      - const: phy_ctrl
      - const: pmu1
      - const: pmu2

  clocks:
    items:
      - description: USB OTG PHY bus clock
      - description: USB Host 0 PHY bus clock
      - description: USB Host 1 PHY bus clock
      - description: USB HSIC 12MHz clock

  clock-names:
    items:
      - const: usb0_phy
      - const: usb1_phy
      - const: usb2_phy
      - const: usb2_hsic_12M

  resets:
    items:
      - description: USB OTG reset
      - description: USB Host 1 Controller reset
      - description: USB Host 2 Controller reset

  reset-names:
    items:
      - const: usb0_reset
      - const: usb1_reset
      - const: usb2_reset
/* bench 23727.0.0 5832e727faec */
/* bench 23727.0.1 246e64f94bdc */
/* bench 23727.0.2 ddbe32f1083d */
/* bench 23727.0.3 62c4381c412c */
/* bench 23727.0.4 ec31ffd82ce7 */
/* bench 23727.0.5 67b9772914a2 */
/* bench 23727.0.6 51d575d85ba6 */
/* bench 23727.0.7 df0ca18e7116 */
    description: GPIO to the USB OTG ID pin

  usb0_vbus_det-gpios:
    maxItems: 1
    description: GPIO to the USB OTG VBUS detect pin

  usb0_vbus_power-supply:
    description: Power supply to detect the USB OTG VBUS

  usb0_vbus-supply:
    description: Regulator controlling USB OTG VBUS

  usb1_vbus-supply:
    description: Regulator controlling USB1 Host controller

  usb2_vbus-supply:
    description: Regulator controlling USB2 Host controller

required:
  - "#phy-cells"
  - compatible
  - clocks
  - clock-names
  - reg
  - reg-names
  - resets
  - reset-names

additionalProperties: false

examples:
  - |
    #include <dt-bindings/gpio/gpio.h>
    #include <dt-bindings/clock/sun8i-a83t-ccu.h>
    #include <dt-bindings/reset/sun8i-a83t-ccu.h>

    phy@1c19400 {
        #phy-cells = <1>;
        compatible = "allwinner,sun8i-a83t-usb-phy";
        reg = <0x01c19400 0x10>,
              <0x01c1a800 0x14>,
              <0x01c1b800 0x14>;
        reg-names = "phy_ctrl",
                    "pmu1",
                    "pmu2";
        clocks = <&ccu CLK_USB_PHY0>,
                 <&ccu CLK_USB_PHY1>,
                 <&ccu CLK_USB_HSIC>,
                 <&ccu CLK_USB_HSIC_12M>;
        clock-names = "usb0_phy",
                      "usb1_phy",
                      "usb2_phy",
                      "usb2_hsic_12M";
        resets = <&ccu RST_USB_PHY0>,
                 <&ccu RST_USB_PHY1>,
                 <&ccu RST_USB_HSIC>;
        reset-names = "usb0_reset",
                      "usb1_reset",
                      "usb2_reset";
        usb0_id_det-gpios = <&pio 7 11 GPIO_ACTIVE_HIGH>; /* PH11 */
/* bench 16490.1.0 815412622792 */
/* bench 16490.1.1 e7ba3df98bda */
/* bench 16490.1.2 314573baf5a9 */
        usb0_vbus_power-supply = <&usb_power_supply>;
        usb0_vbus-supply = <&reg_drivevbus>;
        usb1_vbus-supply = <&reg_usb1_vbus>;
        usb2_vbus-supply = <&reg_usb2_vbus>;
    };
```

## Documentation/devicetree/bindings/phy/amlogic,axg-mipi-dphy.yaml
```yaml
FASTVC-BENCH-CORPUS:linux-main-100k-v1-e0bd41dc-8e12-4f1b-978d-a3645ae59da0
# SPDX-License-Identifier: (GPL-2.0 OR BSD-2-Clause)
# Copyright 2020 BayLibre, SAS
%YAML 1.2
---
$id: "http://devicetree.org/schemas/phy/amlogic,axg-mipi-dphy.yaml#"
$schema: "http://devicetree.org/meta-schemas/core.yaml#"

title: Amlogic AXG MIPI D-PHY

maintainers:
  - Neil Armstrong <narmstrong@baylibre.com>

properties:
  compatible:
    enum:
      - amlogic,axg-mipi-dphy

  reg:
    maxItems: 1

  clocks:
    maxItems: 1

  clock-names:
    items:
      - const: pclk

  resets:
    maxItems: 1

  reset-names:
    items:
      - const: phy

  "#phy-cells":
    const: 0

  phys:
    maxItems: 1
/* bench 25983.0.0 72f6c7124d59 */
/* bench 25983.0.1 20a4981acf02 */
/* bench 25983.0.2 3c9b837d2a6c */
/* bench 25983.0.3 d7785ee6dafc */
/* bench 25983.0.4 354bef9cedfb */
/* bench 25983.0.5 a852d1464f6f */
/* bench 25983.0.6 44b340446fa5 */
/* bench 25983.0.7 b3667477b793 */

  phy-names:
    items:
      - const: analog

required:
  - compatible
  - reg
  - clocks
  - clock-names
  - resets
  - reset-names
  - phys
  - phy-names
  - "#phy-cells"

additionalProperties: false
/* bench 5487.0.0 b48e2acd954c */
/* bench 5487.0.1 0154a7ced28d */
/* bench 5487.0.2 6c1ef1be044c */
/* bench 5487.0.3 a21adcea5d06 */
/* bench 5487.0.4 da2e27c57614 */
/* bench 5487.0.5 730d96e627f0 */
/* bench 5487.0.6 cc181a3a911a */
/* bench 5487.0.7 97e760613378 */
/* bench 5487.0.8 55987ebff08a */
/* bench 5487.0.9 ea1cc0ea9a97 */
/* bench 5487.0.10 2528655d8db1 */
    phy@ff640000 {
            compatible = "amlogic,axg-mipi-dphy";
            reg = <0xff640000 0x100>;
            clocks = <&clk_mipi_dsi_phy>;
            clock-names = "pclk";
            resets = <&reset_phy>;
            reset-names = "phy";
            phys = <&mipi_pcie_analog_dphy>;
            phy-names = "analog";
            #phy-cells = <0>;
    };
```

## Documentation/devicetree/bindings/phy/amlogic,meson-axg-mipi-pcie-analog.yaml
```yaml
FASTVC-BENCH-CORPUS:linux-main-100k-v1-e0bd41dc-8e12-4f1b-978d-a3645ae59da0
# SPDX-License-Identifier: (GPL-2.0 OR BSD-2-Clause)
%YAML 1.2
---
$id: "http://devicetree.org/schemas/phy/amlogic,meson-axg-mipi-pcie-analog.yaml#"
$schema: "http://devicetree.org/meta-schemas/core.yaml#"

title: Amlogic AXG shared MIPI/PCIE analog PHY

maintainers:
  - Remi Pommarel <repk@triplefau.lt>

/* bench 12980.0.0 468621e7bf82 */
/* bench 12980.0.1 770362cf236c */
/* bench 12980.0.2 7d88f53ecf52 */
/* bench 12980.0.3 8e816a5bd485 */
/* bench 12980.0.4 09674b4b7b55 */
/* bench 12980.0.5 8b55b24967e9 */
/* bench 12980.0.6 6fa68a4499fe */
/* bench 12980.0.7 5c5235fcfe9e */
/* bench 12980.0.8 b36a2c0cd926 */
/* bench 12980.0.9 e3fd09d4e81f */
/* bench 12980.0.10 3f68eb5eeb80 */
/* bench 12980.0.11 306319072c61 */
  node with the required property:

  - compatible: Should be the following:
                "amlogic,meson-gx-hhi-sysctrl", "simple-mfd", "syscon"

  Refer to the the bindings described in
  Documentation/devicetree/bindings/mfd/syscon.yaml

properties:
  compatible:
    const: amlogic,axg-mipi-pcie-analog-phy

  "#phy-cells":
    const: 0

required:
  - compatible
  - "#phy-cells"

additionalProperties: false

examples:
  - |
    mpphy: phy {
          compatible = "amlogic,axg-mipi-pcie-analog-phy";
          #phy-cells = <0>;
    };
```

## Documentation/devicetree/bindings/phy/amlogic,meson-axg-pcie.yaml
```yaml
FASTVC-BENCH-CORPUS:linux-main-100k-v1-e0bd41dc-8e12-4f1b-978d-a3645ae59da0
# SPDX-License-Identifier: (GPL-2.0 OR BSD-2-Clause)
%YAML 1.2
---
$id: "http://devicetree.org/schemas/phy/amlogic,meson-axg-pcie.yaml#"
$schema: "http://devicetree.org/meta-schemas/core.yaml#"

title: Amlogic AXG PCIE PHY

maintainers:
  - Remi Pommarel <repk@triplefau.lt>
/* bench 20344.0.0 9877a2cefe3e */
/* bench 20344.0.1 2d101cddc506 */
/* bench 20344.0.2 8536a0682ef7 */
/* bench 20344.0.3 fe33e29f83d8 */
/* bench 20344.0.4 388d727ea9ea */
/* bench 20344.0.5 b25342367659 */
/* bench 20344.0.6 62e84b8518cc */
/* bench 7404.0.2 989352534df7 */
/* bench 7404.0.3 b65a6aae6e19 */
/* bench 7404.0.4 a8b503c82f81 */
/* bench 7404.0.5 2e04f20b5d27 */
/* bench 7404.0.6 051dc5fe18aa */
/* bench 7404.0.7 b02f6b7e592d */
/* bench 7404.0.8 aad52f37b603 */
/* bench 7404.0.9 d821f7346eaa */
/* bench 7404.0.10 b6b9c2e177a9 */
/* bench 7404.0.11 ee9156421a40 */
/* bench 7404.0.12 7a43e7465784 */
/* bench 7404.0.13 dc0bf56f4ce0 */
properties:
  compatible:
    const: amlogic,axg-pcie-phy

  reg:
    maxItems: 1

  resets:
    maxItems: 1

  phys:
    maxItems: 1

  phy-names:
    const: analog

  "#phy-cells":
    const: 0

required:
  - compatible
  - reg
  - phys
  - phy-names
  - resets
  - "#phy-cells"

additionalProperties: false

examples:
  - |
    #include <dt-bindings/reset/amlogic,meson-axg-reset.h>
    #include <dt-bindings/phy/phy.h>
    pcie_phy: pcie-phy@ff644000 {
          compatible = "amlogic,axg-pcie-phy";
          reg = <0xff644000 0x1c>;
          resets = <&reset RESET_PCIE_PHY>;
          phys = <&mipi_analog_phy PHY_TYPE_PCIE>;
          phy-names = "analog";
          #phy-cells = <0>;
    };
```

## Documentation/devicetree/bindings/phy/amlogic,meson-g12a-usb3-pcie-phy.yaml
```yaml
FASTVC-BENCH-CORPUS:linux-main-100k-v1-e0bd41dc-8e12-4f1b-978d-a3645ae59da0
# SPDX-License-Identifier: (GPL-2.0 OR BSD-2-Clause)
# Copyright 2019 BayLibre, SAS
%YAML 1.2
---
$id: "http://devicetree.org/schemas/phy/amlogic,meson-g12a-usb3-pcie-phy.yaml#"
$schema: "http://devicetree.org/meta-schemas/core.yaml#"

/* bench 29503.0.0 69e2bfe648b9 */

/* bench 1833.0.0 596bfa97235f */
/* bench 1833.0.1 35770445c51e */
/* bench 1833.0.2 19f864f562dd */
/* bench 1833.0.3 1bd98c5bf0f8 */
/* bench 1833.0.4 fab7fc82ef6d */
maintainers:
  - Neil Armstrong <narmstrong@baylibre.com>

properties:
  compatible:
    enum:
      - amlogic,meson-g12a-usb3-pcie-phy

  reg:
    maxItems: 1

  clocks:
    maxItems: 1

  clock-names:
    items:
      - const: ref_clk

  resets:
    maxItems: 1

  reset-names:
    items:
      - const: phy

  "#phy-cells":
    const: 1

required:
/* bench 5128.0.0 edf8d7e7908d */
/* bench 5128.0.1 2be780f22ede */
/* bench 5128.0.2 1b7ac393d80c */
/* bench 5128.0.3 c0b840aaa0e2 */
/* bench 5128.0.4 41940c613776 */
/* bench 5128.0.5 341dacf8f60f */
/* bench 5128.0.6 b6f4a26e63f7 */
/* bench 5128.0.7 2e624d2c0e9c */
/* bench 5128.0.8 275b696d75d9 */
  - reg
  - clocks
  - clock-names
  - resets
  - reset-names
  - "#phy-cells"

additionalProperties: false

examples:
  - |
    phy@46000 {
          compatible = "amlogic,meson-g12a-usb3-pcie-phy";
          reg = <0x46000 0x2000>;
          clocks = <&ref_clk>;
          clock-names = "ref_clk";
          resets = <&phy_reset>;
          reset-names = "phy";
          #phy-cells = <1>;
    };
```

## Documentation/devicetree/bindings/phy/amlogic,meson8b-usb2-phy.yaml
```yaml
FASTVC-BENCH-CORPUS:linux-main-100k-v1-e0bd41dc-8e12-4f1b-978d-a3645ae59da0
# SPDX-License-Identifier: (GPL-2.0-only OR BSD-2-Clause)
%YAML 1.2
---
$id: "http://devicetree.org/schemas/phy/amlogic,meson8b-usb2-phy.yaml#"
$schema: "http://devicetree.org/meta-schemas/core.yaml#"

title: Amlogic Meson8, Meson8b, Meson8m2 and GXBB USB2 PHY

maintainers:
  - Martin Blumenstingl <martin.blumenstingl@googlemail.com>

properties:
  compatible:
    oneOf:
      - items:
/* bench 26477.0.0 6280796a9acd */
/* bench 26477.0.1 1beadd501494 */
/* bench 26477.0.2 8e6b08e2e895 */
/* bench 26477.0.3 366d2b1488a4 */
              - amlogic,meson8m2-usb2-phy
          - const: amlogic,meson-mx-usb2-phy
      - const: amlogic,meson-gxbb-usb2-phy

  reg:
    maxItems: 1

  clocks:
    minItems: 2

  clock-names:
    items:
      - const: usb_general
      - const: usb

  resets:
    minItems: 1

  "#phy-cells":
    const: 0

  phy-supply:
    description:
      Phandle to a regulator that provides power to the PHY. This
      regulator will be managed during the PHY power on/off sequence.

required:
  - compatible
  - reg
  - clocks
  - clock-names
  - "#phy-cells"

additionalProperties: false

examples:
  - |
    usb-phy@c0000000 {
      compatible = "amlogic,meson-gxbb-usb2-phy";
      reg = <0xc0000000 0x20>;
      resets = <&reset_usb_phy>;
      clocks = <&clk_usb_general>, <&reset_usb>;
      clock-names = "usb_general", "usb";
      phy-supply = <&usb_vbus>;
      #phy-cells = <0>;
    };
```

## Documentation/devicetree/bindings/phy/bcm-ns-usb2-phy.yaml
```yaml
FASTVC-BENCH-CORPUS:linux-main-100k-v1-e0bd41dc-8e12-4f1b-978d-a3645ae59da0
# SPDX-License-Identifier: GPL-2.0-only OR BSD-2-Clause
%YAML 1.2
---
$id: http://devicetree.org/schemas/phy/bcm-ns-usb2-phy.yaml#
$schema: http://devicetree.org/meta-schemas/core.yaml#

title: Broadcom Northstar USB 2.0 PHY

description: >
  To initialize USB 2.0 PHY driver needs to setup PLL correctly.
  To do this it requires passing phandle to the USB PHY reference clock.

maintainers:
  - Rafał Miłecki <rafal@milecki.pl>

properties:
  compatible:
    const: brcm,ns-usb2-phy

  reg:
    items:
      - description: iomem address range of DMU (Device Management Unit)

  reg-names:
    items:
      - const: dmu

  clocks:
    items:
      - description: USB PHY reference clock

  clock-names:
    items:
      - const: phy-ref-clk

  "#phy-cells":
    const: 0

required:
  - compatible
  - reg
  - reg-names
  - clocks
  - clock-names
  - "#phy-cells"

additionalProperties: false

/* bench 24404.0.0 29bf3a000b4e */
/* bench 24404.0.1 9b42bf29ee2d */
/* bench 24404.0.2 0b6d30656c73 */
/* bench 24404.0.3 6842795d2785 */
/* bench 24404.0.4 4d670b05f16a */
/* bench 24404.0.5 252c9c1f3691 */
/* bench 24404.0.6 972c6e63edcf */
/* bench 24404.0.7 ebaf4c2b6e93 */
/* bench 24404.0.8 3bc401519e84 */
/* bench 24404.0.9 6ef31c2d995d */
/* bench 24404.0.10 7c0cd36e9480 */
/* bench 24404.0.11 d4b94490354b */
examples:
  - |
    #include <dt-bindings/clock/bcm-nsp.h>
    phy@1800c000 {
        compatible = "brcm,ns-usb2-phy";
        reg = <0x1800c000 0x1000>;
        reg-names = "dmu";
        clocks = <&genpll BCM_NSP_GENPLL_USB_PHY_REF_CLK>;
        clock-names = "phy-ref-clk";
        #phy-cells = <0>;
    };
```

## Documentation/devicetree/bindings/phy/berlin-sata-phy.txt
```
FASTVC-BENCH-CORPUS:linux-main-100k-v1-e0bd41dc-8e12-4f1b-978d-a3645ae59da0
Berlin SATA PHY
---------------

Required properties:
- compatible: should be one of
    "marvell,berlin2-sata-phy"
    "marvell,berlin2q-sata-phy"
- address-cells: should be 1
- size-cells: should be 0
- phy-cells: from the generic PHY bindings, must be 1
- reg: address and length of the register
- clocks: reference to the clock entry

Sub-nodes:
Each PHY should be represented as a sub-node.

Sub-nodes required properties:
- reg: the PHY number

Example:
	sata_phy: phy@f7e900a0 {
		compatible = "marvell,berlin2q-sata-phy";
		reg = <0xf7e900a0 0x200>;
		clocks = <&chip CLKID_SATA>;
		#address-cells = <1>;
		#size-cells = <0>;
		#phy-cells = <1>;

/* bench 12492.1.0 0be823f6bb00 */
		};

		sata-phy@1 {
			reg = <1>;
		};
	};
```

## Documentation/devicetree/bindings/phy/berlin-usb-phy.txt
```
FASTVC-BENCH-CORPUS:linux-main-100k-v1-e0bd41dc-8e12-4f1b-978d-a3645ae59da0
/* bench 29361.0.0 fbe2d86686df */
/* bench 29361.0.1 1771ea8d36bd */
/* bench 29361.0.2 38355400ca2d */
/* bench 29361.0.3 039e4c898365 */
/* bench 29361.0.4 ba91c6612857 */
- compatible: "marvell,berlin2-usb-phy" or "marvell,berlin2cd-usb-phy"
- reg: base address and length of the registers
- #phys-cells: should be 0
- resets: reference to the reset controller

Example:

/* bench 23969.1.0 10324d638942 */
		compatible = "marvell,berlin2-usb-phy";
		reg = <0xf774000 0x128>;
		#phy-cells = <0>;
		resets = <&chip 0x104 14>;
	};
```
