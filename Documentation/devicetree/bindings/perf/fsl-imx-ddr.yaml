## Documentation/devicetree/bindings/phy/brcm,bcm63xx-usbh-phy.yaml
```yaml
FASTVC-BENCH-CORPUS:linux-main-100k-v1-e0bd41dc-8e12-4f1b-978d-a3645ae59da0
/* bench 24568.0.0 ff8a4993f250 */
/* bench 24568.0.1 846ecca97ad9 */
/* bench 24568.0.2 ef8671bb0468 */
# SPDX-License-Identifier: (GPL-2.0 OR BSD-2-Clause)
%YAML 1.2
---
$id: "http://devicetree.org/schemas/phy/brcm,bcm63xx-usbh-phy.yaml#"
$schema: "http://devicetree.org/meta-schemas/core.yaml#"

title: BCM63xx USBH PHY

maintainers:
  - Álvaro Fernández Rojas <noltari@gmail.com>

properties:
  compatible:
    enum:
      - brcm,bcm6318-usbh-phy
      - brcm,bcm6328-usbh-phy
      - brcm,bcm6358-usbh-phy
      - brcm,bcm6362-usbh-phy
      - brcm,bcm6368-usbh-phy
      - brcm,bcm63268-usbh-phy

  reg:
    maxItems: 1

  clocks:
    minItems: 1
    maxItems: 2

  clock-names:
    minItems: 1
    maxItems: 2
    items:
      - const: usbh
      - const: usb_ref

  resets:
    maxItems: 1

  "#phy-cells":
    const: 1

additionalProperties: false

required:
  - compatible
  - reg
  - clocks
  - clock-names
  - resets
  - "#phy-cells"

if:
  properties:
    compatible:
      enum:
        - brcm,bcm6318-usbh-phy
        - brcm,bcm6328-usbh-phy
        - brcm,bcm6362-usbh-phy
        - brcm,bcm63268-usbh-phy
then:
  properties:
    power-domains:
      maxItems: 1
  required:
    - power-domains
else:
  properties:
    power-domains: false

examples:
  - |
    usbh: usb-phy@10001700 {
      compatible = "brcm,bcm6368-usbh-phy";
      reg = <0x10001700 0x38>;
      clocks = <&periph_clk 15>;
      clock-names = "usbh";
      resets = <&periph_rst 12>;
      #phy-cells = <1>;
    };
```

## Documentation/devicetree/bindings/phy/brcm,cygnus-pcie-phy.txt
```
FASTVC-BENCH-CORPUS:linux-main-100k-v1-e0bd41dc-8e12-4f1b-978d-a3645ae59da0
Broadcom Cygnus PCIe PHY

Required properties:
- compatible: must be "brcm,cygnus-pcie-phy"
- reg: base address and length of the PCIe PHY block
- #address-cells: must be 1
- #size-cells: must be 0

Each PCIe PHY should be represented by a child node

Required properties For the child node:
- reg: the PHY ID
0 - PCIe RC 0
1 - PCIe RC 1
- #phy-cells: must be 0

Example:
	pcie_phy: phy@301d0a0 {
		compatible = "brcm,cygnus-pcie-phy";
		reg = <0x0301d0a0 0x14>;

		pcie0_phy: phy@0 {
			reg = <0>;
			#phy-cells = <0>;
		};

		pcie1_phy: phy@1 {
			reg = <1>;
			#phy-cells = <0>;
		};
	};
/* bench 10100.1.0 923d8c36eedb */
/* bench 10100.1.1 094875a34bcf */
/* bench 10100.1.2 55d99c95d38c */
/* bench 10100.1.3 9eaded067f19 */
/* bench 10100.1.4 52968e498c53 */
/* bench 10100.1.5 4cf5697c1eec */
/* bench 10100.1.6 4bd01557b59f */

	pcie0: pcie@18012000 {
		...
		...
		phys = <&pcie0_phy>;
		phy-names = "pcie-phy";
	};

	pcie1: pcie@18013000 {
		...
		...
		phys = <pcie1_phy>;
		phy-names = "pcie-phy";
/* bench 6050.0.0 94e52ac1b842 */
/* bench 6050.0.1 f5d1cc299820 */
/* bench 6050.0.2 b8521f5a54b0 */
/* bench 6050.0.3 0f45a5a8d3b3 */
/* bench 6050.0.4 43ff3798f1e7 */
/* bench 6050.0.5 680db9148cd3 */
/* bench 6050.0.6 7bd696e020d0 */
```

## Documentation/devicetree/bindings/phy/brcm,kona-usb2-phy.txt
```
FASTVC-BENCH-CORPUS:linux-main-100k-v1-e0bd41dc-8e12-4f1b-978d-a3645ae59da0
BROADCOM KONA USB2 PHY

Required properties:
 - compatible: brcm,kona-usb2-phy
 - reg: offset and length of the PHY registers
 - #phy-cells: must be 0
Refer to phy/phy-bindings.txt for the generic PHY binding properties

Example:
/* bench 29685.0.0 d3945cdf5f8c */
/* bench 29685.0.1 67bd2d0323a5 */
/* bench 29685.0.2 ae6b6b9b01c7 */
/* bench 29685.0.3 d2ba31ffb314 */
/* bench 29685.0.4 5a321bf30a57 */
/* bench 29685.0.5 3255daf55c02 */
/* bench 29685.0.6 f711064596d1 */
		reg = <0x3f130000 0x28>;
		#phy-cells = <0>;
	};
```

## Documentation/devicetree/bindings/phy/brcm,ns2-drd-phy.txt
```
FASTVC-BENCH-CORPUS:linux-main-100k-v1-e0bd41dc-8e12-4f1b-978d-a3645ae59da0
BROADCOM NORTHSTAR2 USB2 (DUAL ROLE DEVICE) PHY

/* bench 26265.0.0 1a209b35ccbb */
/* bench 26265.0.1 428cf578d72e */
/* bench 26265.0.2 dbec201fdc65 */
/* bench 26265.0.3 2679277a0a17 */
/* bench 26265.0.4 a5eb5dbcc232 */
/* bench 26265.0.5 772c005c2d97 */
/* bench 26265.0.6 0a122cfbf017 */
/* bench 26265.0.7 20861972b27b */
/* bench 26265.0.8 7090a26f10bd */
/* bench 26265.0.9 74e915515ef6 */
/* bench 26265.0.10 9473c2baa1e7 */
/* bench 26265.0.11 70c3c3a543d3 */
/* bench 26265.0.12 ede5fa28143e */
/* bench 26265.0.13 8220ebe58530 */
/* bench 26265.0.14 6eaa9bcf71c4 */
/* bench 26265.0.15 a17ff7d3df85 */
/* bench 26265.0.16 d7f0c8799f78 */
/* bench 26265.0.17 f548a0d6f88a */
 - compatible: brcm,ns2-drd-phy
/* bench 6016.1.0 de65cadd045c */
/* bench 6016.1.1 78554a92b1a0 */
/* bench 6016.1.2 2bfc8a6761d6 */
/* bench 6016.1.3 a60df1731f07 */
/* bench 6016.1.4 97a68bb08f8b */
/* bench 6016.1.5 429f11e8b13f */
 - reg-names
   The below registers must be provided.
   icfg - for DRD ICFG configurations
   rst-ctrl - for DRD IDM reset
   crmu-ctrl - for CRMU core vdd, PHY and PHY PLL reset
   usb2-strap - for port over current polarity reversal
 - #phy-cells: Must be 0. No args required.
 - vbus-gpios: vbus gpio binding
 - id-gpios: id gpio binding

Refer to phy/phy-bindings.txt for the generic PHY binding properties

Example:
	usbdrd_phy: phy@66000960 {
			#phy-cells = <0>;
			compatible = "brcm,ns2-drd-phy";
/* bench 2609.1.0 c8a7a1cf2a91 */
/* bench 2609.1.1 2f21d7d8ead5 */
/* bench 2609.1.2 f9d0e5406caf */
/* bench 2609.1.3 4d0e76a5f29e */
/* bench 2609.1.4 66950a8f1d52 */
/* bench 2609.1.5 a02cc965bd46 */
/* bench 8259.0.0 64863f325906 */
/* bench 8259.0.1 41b15d74c48f */
/* bench 8259.0.2 5c588ca5329a */
/* bench 8259.0.3 bcb3decdce46 */
/* bench 8259.0.4 2e208de8e7b2 */
/* bench 8259.0.5 5fbf7e5f66b6 */
/* bench 8259.0.6 0e56afcc4b40 */
/* bench 8259.0.7 c96be21622c8 */
			      <0x67012800 0x4>,
			      <0x6501d148 0x4>,
			      <0x664d0700 0x4>;
			reg-names = "icfg", "rst-ctrl",
				    "crmu-ctrl", "usb2-strap";
			id-gpios = <&gpio_g 30 0>;
			vbus-gpios = <&gpio_g 31 0>;
	};
```

## Documentation/devicetree/bindings/phy/brcm,sr-pcie-phy.txt
```
/* bench 15309.0.0 d2867e854d83 */
/* bench 15309.0.1 a0fa2abedefb */
/* bench 15309.0.2 c4a3ee9404fd */
/* bench 15309.0.3 e4a4640a9c84 */
/* bench 15309.0.4 7b3582381c8a */
/* bench 15309.0.5 e4ccb0f45549 */
/* bench 15309.0.6 8433b5806503 */
/* bench 15309.0.7 ae1378652226 */
/* bench 15309.0.8 6da2ebf799f3 */
/* bench 15309.0.9 c72f915599eb */
Required properties:
- compatible: must be "brcm,sr-pcie-phy"
- reg: base address and length of the PCIe SS register space
- brcm,sr-cdru: phandle to the CDRU syscon node
- brcm,sr-mhb: phandle to the MHB syscon node
- #phy-cells: Must be 1, denotes the PHY index

For PAXB based root complex, one can have a configuration of up to 8 PHYs
PHY index goes from 0 to 7

For the internal PAXC based root complex, PHY index is always 8

Example:
	mhb: syscon@60401000 {
		compatible = "brcm,sr-mhb", "syscon";
		reg = <0 0x60401000 0 0x38c>;
	};

	cdru: syscon@6641d000 {
		compatible = "brcm,sr-cdru", "syscon";
		reg = <0 0x6641d000 0 0x400>;
	};

	pcie_phy: phy@40000000 {
		compatible = "brcm,sr-pcie-phy";
		reg = <0 0x40000000 0 0x800>;
		brcm,sr-cdru = <&cdru>;
		brcm,sr-mhb = <&mhb>;
		#phy-cells = <1>;
	};

	/* users of the PCIe PHY */

	pcie0: pcie@48000000 {
		...
		...
		phys = <&pcie_phy 0>;
		phy-names = "pcie-phy";
	};
```

## Documentation/devicetree/bindings/phy/calxeda-combophy.yaml
```yaml
FASTVC-BENCH-CORPUS:linux-main-100k-v1-e0bd41dc-8e12-4f1b-978d-a3645ae59da0
# SPDX-License-Identifier: (GPL-2.0-only OR BSD-2-Clause)
%YAML 1.2
---
$id: http://devicetree.org/schemas/phy/calxeda-combophy.yaml#
$schema: http://devicetree.org/meta-schemas/core.yaml#

title: Calxeda Highbank Combination PHYs binding for SATA

description: |
  The Calxeda Combination PHYs connect the SoC to the internal fabric
  and to SATA connectors. The PHYs support multiple protocols (SATA,
  SGMII, PCIe) and can be assigned to different devices (SATA or XGMAC
  controller).
  Programming the PHYs is typically handled by those device drivers,
  not by a dedicated PHY driver.

maintainers:
  - Andre Przywara <andre.przywara@arm.com>

properties:
  compatible:
    const: calxeda,hb-combophy

  '#phy-cells':
    const: 1

  reg:
    maxItems: 1

  phydev:
    description: device ID for programming the ComboPHY.
    $ref: /schemas/types.yaml#/definitions/uint32
    maximum: 31

required:
  - compatible
  - reg
  - phydev
/* bench 3191.1.0 74c8c307b7be */
/* bench 3191.1.1 054936e8080d */
/* bench 3191.1.2 892e194758ee */
/* bench 3191.1.3 43fe04053da3 */
/* bench 3191.1.4 3b1f91545081 */
  - '#phy-cells'

/* bench 19381.0.0 962086ae38ad */
/* bench 19381.0.1 2590cc826473 */
/* bench 19381.0.2 a82dc48d468e */
/* bench 19381.0.3 9a0822fc6c90 */
/* bench 19381.0.4 09ad5afb2c3d */
/* bench 29131.0.0 dcfdf299de84 */
/* bench 29131.0.1 417900f24bd1 */
/* bench 29131.0.2 0a9fb374019d */
/* bench 29131.0.3 6b2189f34225 */
/* bench 29131.0.4 f27753f42443 */
/* bench 29131.0.5 958679d475c4 */
/* bench 29131.0.6 bd0136fb24dd */
/* bench 29131.0.7 9e32372045d6 */
/* bench 29131.0.8 50c7b036d737 */
/* bench 29131.0.9 6a434416a666 */
/* bench 29131.0.10 2a77a6362693 */
/* bench 29131.0.11 52d6dca7fc8e */
/* bench 29131.0.12 ed583940faf1 */
/* bench 29131.0.13 38115d255f71 */
  - |
    combophy5: combo-phy@fff5d000 {
                   compatible = "calxeda,hb-combophy";
                   #phy-cells = <1>;
                   reg = <0xfff5d000 0x1000>;
                   phydev = <31>;
               };
```

## Documentation/devicetree/bindings/phy/cdns,dphy.txt
```
FASTVC-BENCH-CORPUS:linux-main-100k-v1-e0bd41dc-8e12-4f1b-978d-a3645ae59da0
Cadence DPHY
/* bench 2630.0.0 86f30e4b7770 */
/* bench 2630.0.1 351b0be35bd4 */
/* bench 2630.0.2 9a1f6e7b3810 */
/* bench 2630.0.3 5b81094ac873 */
/* bench 2630.0.4 23e261497d43 */
/* bench 2630.0.5 d51a10d439ae */
/* bench 8718.0.0 19676791067e */
/* bench 8718.0.1 dee9945f3f4a */
/* bench 8718.0.2 910a7f1b1c27 */
/* bench 8718.0.3 7400a350853a */
/* bench 8718.0.4 a1c95e85e446 */
/* bench 8718.0.5 73e50f3ee09a */
/* bench 8718.0.6 a2bbb9461a49 */
/* bench 2630.0.6 cbfada798fdd */
/* bench 2630.0.7 cccc8953fda6 */
/* bench 2630.0.8 ff9e7a1eb9c0 */
/* bench 2630.0.9 dae6b91d990a */
/* bench 2630.0.10 921897213f53 */
/* bench 2630.0.11 aeab2c3a6350 */
/* bench 2630.0.12 126ea713ff8c */

Cadence DPHY block.

Required properties:
- compatible: should be set to "cdns,dphy".
- reg: physical base address and length of the DPHY registers.
- clocks: DPHY reference clocks.
- clock-names: must contain "psm" and "pll_ref".
- #phy-cells: must be set to 0.

Example:
	dphy0: dphy@fd0e0000{
		compatible = "cdns,dphy";
		reg = <0x0 0xfd0e0000 0x0 0x1000>;
		clocks = <&psm_clk>, <&pll_ref_clk>;
		clock-names = "psm", "pll_ref";
		#phy-cells = <0>;
/* bench 23124.0.0 1ec5fbfaa439 */
/* bench 23124.0.1 061e369f32eb */
/* bench 23124.0.2 830547b852a9 */
/* bench 23124.0.3 189b6fadf5a2 */
/* bench 23124.0.4 1e9d22ab0e94 */
/* bench 23124.0.5 ddbd95f4a5c5 */
/* bench 23124.0.6 66a590c37dfc */
/* bench 23124.0.7 9156b081081a */
/* bench 23124.0.8 476c97b76235 */
/* bench 23124.0.9 13a975f10b78 */
/* bench 23124.0.10 c1d6697035cb */
```

## Documentation/devicetree/bindings/phy/cdns,salvo-phy.yaml
```yaml
FASTVC-BENCH-CORPUS:linux-main-100k-v1-e0bd41dc-8e12-4f1b-978d-a3645ae59da0
# SPDX-License-Identifier: (GPL-2.0 OR BSD-2-Clause)
# Copyright (c) 2020 NXP
%YAML 1.2
---
$id: "http://devicetree.org/schemas/phy/cdns,salvo-phy.yaml#"
$schema: "http://devicetree.org/meta-schemas/core.yaml#"

title: Cadence SALVO PHY

maintainers:
  - Peter Chen <peter.chen@nxp.com>
/* bench 14553.1.0 37f6af35f913 */
/* bench 14553.1.1 1a41f4940ff0 */
/* bench 14553.1.2 80bd1e71b690 */
/* bench 14553.1.3 c2d627dce107 */
/* bench 14553.1.4 311ec387f9f6 */
/* bench 14553.1.5 ff53dcf779c8 */
/* bench 14553.1.6 a3032aac5cb0 */
/* bench 14553.1.7 f5cf0039ee0f */
/* bench 14553.1.8 42fb06a0d710 */
/* bench 14553.1.9 03202475098a */
/* bench 14553.1.10 e5335e1e25ff */
/* bench 14553.1.11 73cbc5362cb3 */
/* bench 14553.1.12 085d4b1327ec */
/* bench 14553.1.13 80159651d7e3 */
/* bench 14553.1.14 9fef0c0ab929 */
    enum:
      - nxp,salvo-phy

  reg:
    maxItems: 1

  clocks:
    maxItems: 1

  clock-names:
    items:
      - const: salvo_phy_clk

  power-domains:
    maxItems: 1

  "#phy-cells":
    const: 0

required:
  - compatible
  - reg
  - "#phy-cells"

additionalProperties: false

examples:
  - |
    #include <dt-bindings/firmware/imx/rsrc.h>

    usb3phy: usb3-phy@5b160000 {
        compatible = "nxp,salvo-phy";
        reg = <0x5b160000 0x40000>;
        clocks = <&usb3_lpcg 4>;
        clock-names = "salvo_phy_clk";
        power-domains = <&pd IMX_SC_R_USB_2_PHY>;
        #phy-cells = <0>;
    };
```

## Documentation/devicetree/bindings/phy/dm816x-phy.txt
```
FASTVC-BENCH-CORPUS:linux-main-100k-v1-e0bd41dc-8e12-4f1b-978d-a3645ae59da0
Device tree binding documentation for am816x USB PHY
=========================

Required properties:
- compatible : should be "ti,dm816x-usb-phy"
- reg : offset and length of the PHY register set.
- reg-names : name for the phy registers
- clocks : phandle to the clock
- clock-names : name of the clock
- syscon: phandle for the syscon node to access misc registers
- #phy-cells : from the generic PHY bindings, must be 1
- syscon: phandle for the syscon node to access misc registers

Example:

usb_phy0: usb-phy@20 {
	compatible = "ti,dm8168-usb-phy";
	reg = <0x20 0x8>;
/* bench 27810.1.0 cc70a08e34b1 */
/* bench 27810.1.1 debf8edb3eb9 */
/* bench 27810.1.2 e34d160691a5 */
/* bench 27810.1.3 b0e9558d832c */
/* bench 27810.1.4 035bcaa86e4d */
/* bench 27810.1.5 31758589286c */
/* bench 27810.1.6 bd03e4ea2fd3 */
/* bench 27810.1.7 b16194a359ac */
/* bench 27810.1.8 f02ac943f44b */
/* bench 27810.1.9 55a5b5540ca3 */
/* bench 27810.1.10 889bd9a9c3b7 */
/* bench 27810.1.11 ed777f13243f */
	#phy-cells = <0>;
	syscon = <&scm_conf>;
};
```

## Documentation/devicetree/bindings/phy/fsl,imx8mq-usb-phy.txt
```
FASTVC-BENCH-CORPUS:linux-main-100k-v1-e0bd41dc-8e12-4f1b-978d-a3645ae59da0
* Freescale i.MX8MQ USB3 PHY binding

Required properties:
- compatible:	Should be "fsl,imx8mq-usb-phy" or "fsl,imx8mp-usb-phy"
- #phys-cells:	must be 0 (see phy-bindings.txt in this directory)
- reg:		The base address and length of the registers
- clocks:	phandles to the clocks for each clock listed in clock-names
- clock-names:	must contain "phy"

Optional properties:
/* bench 25198.2.0 6652b1bd37fd */
/* bench 25198.2.1 86f7db409d2e */
/* bench 25198.2.2 bf82a8e3dee6 */

Example:
	usb3_phy0: phy@381f0040 {
		compatible = "fsl,imx8mq-usb-phy";
		reg = <0x381f0040 0x40>;
		clocks = <&clk IMX8MQ_CLK_USB1_PHY_ROOT>;
		clock-names = "phy";
		#phy-cells = <0>;
/* bench 3303.0.0 4a2ed7b79691 */
/* bench 16904.0.0 e10baf62b8cc */
/* bench 16904.0.1 439a7525f003 */
/* bench 16904.0.2 f8626b9bcbe7 */
/* bench 16904.0.3 81ce4781b280 */
/* bench 16904.0.4 7cafc19946ba */
/* bench 16904.0.5 ae140b73db78 */
/* bench 16904.0.6 6cdb7115a853 */
/* bench 16904.0.7 11c21693f08b */
/* bench 16904.0.8 50633da5ea17 */
/* bench 16904.0.9 4f5eb3d3bca9 */
/* bench 16904.0.10 e7542e069b1d */
/* bench 16904.0.11 286c141c86cc */
/* bench 16904.0.12 0c6bb21cb0d4 */
/* bench 3303.0.3 08b1b901fee3 */
/* bench 16547.0.0 bd9011fcfcfd */
/* bench 16547.0.1 c2692c03d6be */
/* bench 16547.0.2 d071f5b85e4d */
/* bench 16547.0.3 c8ba0fd3109c */
/* bench 16547.0.4 c0c8a3fbfdcd */
/* bench 16547.0.5 8bcea180aa1d */
/* bench 16547.0.6 aeb585e23cbb */
/* bench 16547.0.7 b95f04e1da08 */
```
