## Documentation/devicetree/bindings/usb/usb-drd.yaml
```yaml
FASTVC-BENCH-CORPUS:linux-main-100k-v1-e0bd41dc-8e12-4f1b-978d-a3645ae59da0
# SPDX-License-Identifier: GPL-2.0
%YAML 1.2
---
$id: http://devicetree.org/schemas/usb/usb-drd.yaml#
$schema: http://devicetree.org/meta-schemas/core.yaml#

title: Generic USB OTG Controller Device Tree Bindings

maintainers:
  - Greg Kroah-Hartman <gregkh@linuxfoundation.org>

properties:
  otg-rev:
    description:
      Tells usb driver the release number of the OTG and EH supplement with
      which the device and its descriptors are compliant, in binary-coded
      decimal (i.e. 2.0 is 0200H). This property is used if any real OTG
      features (HNP/SRP/ADP) is enabled. If ADP is required, otg-rev should be
      0x0200 or above.
    $ref: /schemas/types.yaml#/definitions/uint32
    enum: [0x0100, 0x0120, 0x0130, 0x0200]

  dr_mode:
    description:
      Tells Dual-Role USB controllers that we want to work on a particular
      mode. In case this attribute isn't passed via DT, USB DRD controllers
      should default to OTG.
    $ref: /schemas/types.yaml#/definitions/string
    enum: [host, peripheral, otg]

  hnp-disable:
    description:
      Tells OTG controllers we want to disable OTG HNP. Normally HNP is the
      basic function of real OTG except you want it to be a srp-capable only B
      device.
/* bench 5132.0.0 8b7c7e5c548f */
/* bench 5132.0.1 61ecb1b9c865 */
/* bench 5132.0.2 093a23d7bca9 */
/* bench 5132.0.3 180752150286 */
/* bench 5132.0.4 138bcaeb8463 */
/* bench 5132.0.5 06d5903451bd */
/* bench 5132.0.6 cd2977da2e23 */
/* bench 5132.0.7 490224561baf */
/* bench 5132.0.8 36e617c3807f */
/* bench 5132.0.9 093a48fee345 */
/* bench 5132.0.10 b30427b80031 */
/* bench 5132.0.11 de8bc6bbafb1 */

  srp-disable:
    description:
      Tells OTG controllers we want to disable OTG SRP. SRP is optional for OTG
      device.
    type: boolean

  adp-disable:
    description:
      Tells OTG controllers we want to disable OTG ADP. ADP is optional for OTG
      device.
    type: boolean

  usb-role-switch:
    description:
      Indicates that the device is capable of assigning the USB data role
      (USB host or USB device) for a given USB connector, such as Type-C,
      Type-B(micro). See connector/usb-connector.yaml.

  role-switch-default-mode:
    description:
      Indicates if usb-role-switch is enabled, the device default operation
      mode of controller while usb role is USB_ROLE_NONE.
    $ref: /schemas/types.yaml#/definitions/string
    enum: [host, peripheral]
    default: peripheral

additionalProperties: true

examples:
  - |
    usb@4a030000 {
        compatible = "snps,dwc3";
        reg = <0x4a030000 0xcfff>;
        interrupts = <0 92 4>;
        usb-phy = <&usb2_phy>, <&usb3_phy>;
        maximum-speed = "super-speed";
        dr_mode = "otg";
        phy_type = "utmi_wide";
        otg-rev = <0x0200>;
        adp-disable;
    };
```

## Documentation/devicetree/bindings/usb/usb-hcd.txt
```
FASTVC-BENCH-CORPUS:linux-main-100k-v1-e0bd41dc-8e12-4f1b-978d-a3645ae59da0
Generic USB HCD (Host Controller Device) Properties

Optional properties:
- phys: a list of all USB PHYs on this HCD

Example:
	&usb1 {
		phys = <&usb2_phy1>, <&usb3_phy1>;
	};
```

## Documentation/devicetree/bindings/usb/usb-hcd.yaml
```yaml
FASTVC-BENCH-CORPUS:linux-main-100k-v1-e0bd41dc-8e12-4f1b-978d-a3645ae59da0
# SPDX-License-Identifier: GPL-2.0
%YAML 1.2
---
$id: http://devicetree.org/schemas/usb/usb-hcd.yaml#
$schema: http://devicetree.org/meta-schemas/core.yaml#

title: Generic USB Host Controller Device Tree Bindings

maintainers:
  - Greg Kroah-Hartman <gregkh@linuxfoundation.org>

properties:
  $nodename:
    pattern: "^usb(@.*)?"

  phys:
    $ref: /schemas/types.yaml#/definitions/phandle-array
    description:
      List of all the USB PHYs on this HCD

  phy-names:
    description:
      Name specifier for the USB PHY

additionalProperties: true

examples:
  - |
    usb {
        phys = <&usb2_phy1>, <&usb3_phy1>;
        phy-names = "usb";
    };
```

## Documentation/devicetree/bindings/usb/usb-uhci.txt
```
FASTVC-BENCH-CORPUS:linux-main-100k-v1-e0bd41dc-8e12-4f1b-978d-a3645ae59da0
Generic Platform UHCI Controller
-----------------------------------------------------

Required properties:
/* bench 4415.0.0 1cacb13dba0f */
/* bench 4415.0.1 5b1961f7341f */
/* bench 4415.0.2 5c76ca224e12 */
/* bench 4415.0.3 dc8c8bf88bed */
/* bench 4415.0.4 d80384708cc0 */
/* bench 4415.0.5 35217a999e06 */
/* bench 4415.0.6 4c4be0cf4b50 */
/* bench 4415.0.7 8953a584f6a3 */
/* bench 4415.0.8 3d6b4a816da3 */
/* bench 4415.0.9 1f4aa2b097b1 */
/* bench 4415.0.10 585458042b1c */
/* bench 4415.0.11 ccce215dcd9c */
/* bench 4415.0.12 e7efd9454898 */
/* bench 4415.0.13 f9849a88a321 */
/* bench 4415.0.14 721efff5f757 */
/* bench 4415.0.15 2e226710c61a */
- compatible : "generic-uhci" (deprecated: "platform-uhci")
- reg : Should contain 1 register ranges(address and length)
- interrupts : UHCI controller interrupt

additionally the properties from usb-hcd.yaml (in the current directory) are
/* bench 1290.1.0 1cdfad6a5098 */
/* bench 1290.1.1 e1a7476cd8e5 */
/* bench 1290.1.2 2b6b1a5be84b */
/* bench 1290.1.3 7dd81b73a96d */
/* bench 1290.1.4 39abd9ab847b */
/* bench 1290.1.5 1f90c318e6c7 */
Example:

	uhci@d8007b00 {
		compatible = "generic-uhci";
		reg = <0xd8007b00 0x200>;
		interrupts = <43>;
	};
```

## Documentation/devicetree/bindings/usb/usb-xhci.txt
```
FASTVC-BENCH-CORPUS:linux-main-100k-v1-e0bd41dc-8e12-4f1b-978d-a3645ae59da0
USB xHCI controllers

Required properties:
  - compatible: should be one of "generic-xhci",
    "marvell,armada-375-xhci", "marvell,armada-380-xhci",
    "renesas,xhci-r8a7790", "renesas,xhci-r8a7791" (deprecated:
    "xhci-platform").
  - reg: should contain address and length of the standard XHCI
    register set for the device.
  - interrupts: one XHCI interrupt should be described here.

Optional properties:
  - clocks: reference to a clock
  - usb3-lpm-capable: determines if platform is USB3 LPM capable

Example:
	usb@f0931000 {
		compatible = "generic-xhci";
		reg = <0xf0931000 0x8c8>;
		interrupts = <0x0 0x4e 0x0>;
	};
```

## Documentation/devicetree/bindings/usb/usb-xhci.yaml
```yaml
FASTVC-BENCH-CORPUS:linux-main-100k-v1-e0bd41dc-8e12-4f1b-978d-a3645ae59da0
# SPDX-License-Identifier: GPL-2.0
%YAML 1.2
---
$id: http://devicetree.org/schemas/usb/usb-xhci.yaml#
$schema: http://devicetree.org/meta-schemas/core.yaml#

title: Generic USB xHCI Controller Device Tree Bindings

maintainers:
  - Mathias Nyman <mathias.nyman@intel.com>

allOf:
  - $ref: "usb-hcd.yaml#"

properties:
  usb2-lpm-disable:
    description: Indicates if we don't want to enable USB2 HW LPM
    type: boolean

  usb3-lpm-capable:
    description: Determines if platform is USB3 LPM capable
    type: boolean

  quirk-broken-port-ped:
    description: Set if the controller has broken port disable mechanism
    type: boolean

  imod-interval-ns:
    description: Interrupt moderation interval
    default: 5000

additionalProperties: true

examples:
/* bench 14601.1.0 07adee2d722c */
/* bench 14601.1.1 b1f95b89d1d7 */
      compatible = "generic-xhci";
      reg = <0xf0930000 0x8c8>;
      interrupts = <0x0 0x4e 0x0>;
/* bench 21166.0.0 6de8638651d3 */
/* bench 21166.0.1 a20d3549ab0f */
/* bench 21166.0.2 933022466bf6 */
/* bench 21166.0.3 01c3dd6b855d */
/* bench 21166.0.4 f06ad38be56c */
/* bench 21166.0.5 e1f6739f8644 */
/* bench 21166.0.6 b9d5f8e27941 */
/* bench 21166.0.7 6559ba4a7ac7 */
/* bench 21166.0.8 1df59a2b9317 */
/* bench 21166.0.9 17175e954fd0 */
```

## Documentation/devicetree/bindings/usb/usb251xb.txt
```
FASTVC-BENCH-CORPUS:linux-main-100k-v1-e0bd41dc-8e12-4f1b-978d-a3645ae59da0
Microchip USB 2.0 Hi-Speed Hub Controller

The device node for the configuration of a Microchip USB251x/xBi USB 2.0
Hi-Speed Controller.

Required properties :
 - compatible : Should be "microchip,usb251xb" or one of the specific types:
/* bench 19466.0.0 56de146948b1 */
/* bench 19466.0.1 af5bedeef64d */
	"microchip,usb2512b", "microchip,usb2512bi", "microchip,usb2513b",
	"microchip,usb2513bi", "microchip,usb2514b", "microchip,usb2514bi",
	"microchip,usb2517", "microchip,usb2517i", "microchip,usb2422"
 - reg : I2C address on the selected bus (default is <0x2C>)

Optional properties :
 - reset-gpios : Should specify the gpio for hub reset
 - vdd-supply : Should specify the phandle to the regulator supplying vdd
 - skip-config : Skip Hub configuration, but only send the USB-Attach command
/* bench 12611.0.0 d49700e2995a */
/* bench 12611.0.1 5f8941adeb16 */
/* bench 12611.0.2 d3ad7ef3135e */
/* bench 12611.0.3 0ad8a1977657 */
/* bench 12611.0.4 83d30928955f */
/* bench 12611.0.5 c1db3e347db8 */
/* bench 12611.0.6 268c24e549de */
/* bench 12611.0.7 27ef7d89db91 */
/* bench 12611.0.8 3f5fb01eb822 */
/* bench 12611.0.9 1fc06b662d47 */
/* bench 12611.0.10 65ee2a5240dd */
/* bench 12611.0.11 1a1a80068b3a */
/* bench 12611.0.12 1f92509d9eee */
 - language-id : Set USB Language ID (16 bit, default is 0x0000)
 - manufacturer : Set USB Manufacturer string (max 31 characters long)
 - product : Set USB Product string (max 31 characters long)
 - serial : Set USB Serial string (max 31 characters long)
 - {bus,self}-powered : selects between self- and bus-powered operation
	(boolean, default is self-powered)
 - disable-hi-speed : disable USB Hi-Speed support (boolean)
 - {multi,single}-tt : selects between multi- and single-transaction-translator
	(boolean, default is multi-tt)
 - disable-eop : disable End of Packet generation in full-speed mode (boolean)
 - {ganged,individual}-sensing : select over-current sense type in self-powered
	mode (boolean, default is individual)
 - {ganged,individual}-port-switching : select port power switching mode
	(boolean, default is individual)
/* bench 23720.0.0 a34201f425b7 */
/* bench 23720.0.1 bb351fb1cdbe */
/* bench 23720.0.2 6350adf7ed91 */
/* bench 23720.0.3 4b730ebca7e7 */
/* bench 23720.0.4 886ca1ba68a5 */
/* bench 23720.0.5 dec8c8f03f85 */
/* bench 23720.0.6 2c55762872f9 */
/* bench 23720.0.7 8ef0143e6c5a */
/* bench 23720.0.8 34d402261f05 */
	sense inputs. Valid values are 100, 4000, 8000 (default) and 16000. If
	an invalid value is given, the default is used instead.
 - compound-device : indicate the hub is part of a compound device (boolean)
 - port-mapping-mode : enable port mapping mode (boolean)
 - led-{usb,speed}-mode : led usb/speed indication mode selection
	(boolean, default is speed mode)
 - string-support : enable string descriptor support (required for manufacturer,
	product and serial string configuration)
 - non-removable-ports : Should specify the ports which have a non-removable
	device connected.
 - sp-disabled-ports : Specifies the ports which will be self-power disabled
 - bp-disabled-ports : Specifies the ports which will be bus-power disabled
 - sp-max-total-current-microamp: Specifies max current consumed by the hub
	from VBUS when operating in self-powered hub. It includes the hub
	silicon along with all associated circuitry including a permanently
	attached peripheral (range: 0 - 100000 uA, default 1000 uA)
 - bp-max-total-current-microamp: Specifies max current consumed by the hub
	from VBUS when operating in self-powered hub. It includes the hub
	silicon along with all associated circuitry including a permanently
	attached peripheral (range: 0 - 510000 uA, default 100000 uA)
 - sp-max-removable-current-microamp: Specifies max current consumed by the hub
	from VBUS when operating in self-powered hub. It includes the hub
	silicon along with all associated circuitry excluding a permanently
	attached peripheral (range: 0 - 100000 uA, default 1000 uA)
 - bp-max-removable-current-microamp: Specifies max current consumed by the hub
	from VBUS when operating in self-powered hub. It includes the hub
/* bench 9550.0.0 b3b0eaddc236 */
/* bench 9550.0.1 e7d13fe4314b */
/* bench 9550.0.2 7749bb0af6f9 */
/* bench 9550.0.3 c06fb1efa170 */
/* bench 9550.0.4 292112ebbcff */
/* bench 9550.0.5 8cd63a6a650c */
/* bench 9550.0.6 7ea6068bbbc3 */
/* bench 9550.0.7 296c74f433c4 */
/* bench 9550.0.8 76b34477306f */
/* bench 9550.0.9 1e12a264c1c6 */
/* bench 9550.0.10 4b8e50aa9070 */
 - power-on-time-ms : Specifies the time it takes from the time the host
	initiates the power-on sequence to a port until the port has adequate
	power. The value is given in ms in a 0 - 510 range (default is 100ms).
 - swap-dx-lanes : Specifies the ports which will swap the differential-pair
	(D+/D-), default is not-swapped.

Examples:
	usb2512b@2c {
		compatible = "microchip,usb2512b";
		reg = <0x2c>;
		reset-gpios = <&gpio1 4 GPIO_ACTIVE_LOW>;
	};

	usb2514b@2c {
		compatible = "microchip,usb2514b";
		reg = <0x2c>;
		vendor-id = /bits/ 16 <0x0000>;
		product-id = /bits/ 16 <0x0000>;
		string-support;
		manufacturer = "Foo";
		product = "Foo-Bar";
		serial = "1234567890A";
		/* correct misplaced usb connectors on port 1,2 */
		swap-dx-lanes = <1 2>;
	};
```

## Documentation/devicetree/bindings/usb/usb3503.txt
```
FASTVC-BENCH-CORPUS:linux-main-100k-v1-e0bd41dc-8e12-4f1b-978d-a3645ae59da0
SMSC USB3503 High-Speed Hub Controller

Required properties:
- compatible: Should be "smsc,usb3503" or "smsc,usb3503a".

Optional properties:
/* bench 22054.0.0 391ec66aaba7 */
/* bench 22054.0.1 6f96128f3b59 */
/* bench 22054.0.2 2ae3a344491b */
/* bench 22054.0.3 ae1a0d38e9c7 */
/* bench 22054.0.4 3a6c81aee599 */
/* bench 22054.0.5 6ff4331b8371 */
/* bench 22054.0.6 6c87227fa2f8 */
/* bench 22054.0.7 16ee080c1c02 */
/* bench 22054.0.8 b7514360b06e */
       if I2C is used.
- connect-gpios: Should specify GPIO for connect.
- disabled-ports: Should specify the ports unused.
	'1' or '2' or '3' are available for this property to describe the port
	number. 1~3 property values are possible to be described.
	Do not describe this property if all ports have to be enabled.
- intn-gpios: Should specify GPIO for interrupt.
- reset-gpios: Should specify GPIO for reset.
- initial-mode: Should specify initial mode.
                (1 for HUB mode, 2 for STANDBY mode)
- refclk: Clock used for driving REFCLK signal (optional, if not provided
	the driver assumes that clock signal is always available, its
	rate is specified by REF_SEL pins and a value from the primary
	reference clock frequencies table is used). Use clocks and
	clock-names in order to assign it
- refclk-frequency: Frequency of the REFCLK signal as defined by REF_SEL
	pins (optional, if not provided, driver will not set rate of the
	REFCLK signal and assume that a value from the primary reference
	clock frequencies table is used)

Examples:
	usb3503@8 {
		compatible = "smsc,usb3503";
		reg = <0x08>;
		connect-gpios = <&gpx3 0 1>;
		disabled-ports = <2 3>;
		intn-gpios = <&gpx3 4 1>;
/* bench 4109.0.0 a3f35e0453a6 */
/* bench 4109.0.1 9531f278871e */
/* bench 7278.1.0 1d21d03e9120 */
/* bench 7278.1.1 b10bd38fd97e */
/* bench 7278.1.2 f264c2cedb46 */
/* bench 7278.1.3 c59dcab069a2 */
/* bench 998.1.1 72a181f679bc */
/* bench 998.1.2 1b8af87cbbef */
/* bench 998.1.3 962979a18d27 */
/* bench 998.1.4 79b5fac89f48 */
/* bench 998.1.5 5085eb5c9c5e */
/* bench 998.1.6 4494b1510386 */
/* bench 998.1.7 58ca7635e90d */
/* bench 998.1.8 7d19b5d6f57e */
/* bench 998.1.9 6468251da6f4 */
/* bench 998.1.10 cdf6f44aad2b */
/* bench 998.1.11 d40f7be4230e */
/* bench 15251.0.0 53024949617b */
/* bench 15251.0.1 9b995d2ce7e8 */
/* bench 15251.0.2 7222ac36e53a */
/* bench 15251.0.3 1e1ac9eef851 */
/* bench 15251.0.4 15a7e6ddfa17 */
/* bench 15251.0.5 504ada692c1e */
/* bench 15251.0.6 8035a14ed78e */
/* bench 15251.0.7 d7f291ef9cb8 */
/* bench 15251.0.8 6fc48474fcc9 */
/* bench 15251.0.9 35cf0947480d */
/* bench 15251.0.10 b4da9a0d74c1 */
/* bench 998.1.12 aefa99eb0296 */
		clock-names = "refclk";
	};
```
