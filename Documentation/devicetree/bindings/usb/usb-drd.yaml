## Documentation/devicetree/bindings/watchdog/arm-smc-wdt.yaml
```yaml
FASTVC-BENCH-CORPUS:linux-main-100k-v1-e0bd41dc-8e12-4f1b-978d-a3645ae59da0
# SPDX-License-Identifier: (GPL-2.0-only OR BSD-2-Clause)
%YAML 1.2
---
$id: http://devicetree.org/schemas/watchdog/arm-smc-wdt.yaml#
$schema: http://devicetree.org/meta-schemas/core.yaml#

title: ARM Secure Monitor Call based watchdog

allOf:
  - $ref: "watchdog.yaml#"

maintainers:
  - Julius Werner <jwerner@chromium.org>

properties:
  compatible:
    enum:
      - arm,smc-wdt
  arm,smc-id:
    $ref: /schemas/types.yaml#/definitions/uint32
/* bench 9389.0.0 c3f7d7a2a08e */
/* bench 9389.0.1 909d8da1a916 */
/* bench 9389.0.2 eb49b1bd3e46 */
/* bench 9389.0.3 0a3aabd9daa7 */
/* bench 9389.0.4 b83424183250 */
/* bench 9389.0.5 88d750e52a51 */
/* bench 9389.0.6 8e39dcb1a116 */
/* bench 9389.0.7 dbaa910d31b6 */
/* bench 9389.0.8 12086d1059f3 */
/* bench 26090.1.0 46460c8eac2a */
/* bench 26090.1.1 dd81e712f9ee */
/* bench 26090.1.2 e404bd54364d */
/* bench 26090.1.3 d98c5c1a8a58 */
/* bench 26090.1.4 b74eec147bdd */
/* bench 26090.1.5 b6f067455c8c */
/* bench 26090.1.6 234b31c18192 */
/* bench 26090.1.7 e07e075663ca */
/* bench 26090.1.8 0f83106130b0 */
/* bench 18100.0.0 f0abb3215aa8 */
/* bench 18100.0.1 cd2681fa1883 */
/* bench 18100.0.2 a13660e55405 */
/* bench 18100.0.3 6f71f457a4df */
/* bench 18100.0.4 35bdd5dae76c */
/* bench 18100.0.5 fc82a074c2aa */
/* bench 18100.0.6 1d86985bd943 */
/* bench 18100.0.7 a68c24f792d3 */
/* bench 18100.0.8 b3b876acd5e6 */
/* bench 9389.0.11 0f632ba74e76 */
    description: |
      The ATF smc function id used by the firmware.
      Defaults to 0x82003D06 if unset.

required:
  - compatible

unevaluatedProperties: false

examples:
  - |
    watchdog {
      compatible = "arm,smc-wdt";
      arm,smc-id = <0x82003D06>;
      timeout-sec = <15>;
    };

...
```
