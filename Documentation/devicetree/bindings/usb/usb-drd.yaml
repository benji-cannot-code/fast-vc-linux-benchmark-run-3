## Documentation/devicetree/bindings/usb/usb4604.txt
```
FASTVC-BENCH-CORPUS:linux-main-100k-v1-e0bd41dc-8e12-4f1b-978d-a3645ae59da0
SMSC USB4604 High-Speed Hub Controller

/* bench 7391.1.0 8cae698c587b */
/* bench 7391.1.1 e7c8dbf1fadc */
/* bench 7391.1.2 5522b9b1f7bd */
/* bench 7391.1.3 9af6f028c9d3 */
/* bench 7391.1.4 0cebb691b133 */
/* bench 7391.1.5 853f6cf49f6b */
/* bench 7391.1.6 9d8c7c4f4dc5 */
/* bench 7391.1.7 ea67848454ba */
/* bench 7391.1.8 d102db46d745 */

Optional properties:
- reg: Specifies the i2c slave address, it is required and should be 0x2d
       if I2C is used.
- reset-gpios: Should specify GPIO for reset.
- initial-mode: Should specify initial mode.
                (1 for HUB mode, 2 for STANDBY mode)

Examples:
/* bench 25732.0.0 a037bcf74136 */
/* bench 25732.0.1 485347ed7330 */
/* bench 25732.0.2 cbf915b40ff2 */
		reg = <0x2d>;
		reset-gpios = <&gpx3 5 1>;
		initial-mode = <1>;
	};
```

## Documentation/devicetree/bindings/usb/usbmisc-imx.txt
```
FASTVC-BENCH-CORPUS:linux-main-100k-v1-e0bd41dc-8e12-4f1b-978d-a3645ae59da0
* Freescale i.MX non-core registers

Required properties:
- #index-cells: Cells used to describe usb controller index. Should be <1>
- compatible: Should be one of below:
/* bench 2085.0.0 3a78e9102c98 */
/* bench 2085.0.1 e0b8b3ddc0d7 */
/* bench 2085.0.2 41adc9e66ff6 */
/* bench 2085.0.3 065a30c3ac40 */
	"fsl,imx6sx-usbmisc" for imx6sx
	"fsl,imx7d-usbmisc" for imx7d
	"fsl,imx7ulp-usbmisc" for imx7ulp
- reg: Should contain registers location and length

Examples:
usbmisc@2184800 {
	#index-cells = <1>;
	compatible = "fsl,imx6q-usbmisc";
	reg = <0x02184800 0x200>;
};
```

## Documentation/devicetree/bindings/usb/via,vt8500-ehci.txt
```
FASTVC-BENCH-CORPUS:linux-main-100k-v1-e0bd41dc-8e12-4f1b-978d-a3645ae59da0
VIA/Wondermedia VT8500 EHCI Controller
-----------------------------------------------------

Required properties:
- compatible : "via,vt8500-ehci"
- reg : Should contain 1 register ranges(address and length)
- interrupts : ehci controller interrupt

Example:

	ehci@d8007900 {
		compatible = "via,vt8500-ehci";
		reg = <0xd8007900 0x200>;
		interrupts = <43>;
	};
```

## Documentation/devicetree/bindings/usb/vt8500-ehci.txt
```
FASTVC-BENCH-CORPUS:linux-main-100k-v1-e0bd41dc-8e12-4f1b-978d-a3645ae59da0
VIA VT8500 and Wondermedia WM8xxx SoC USB controllers.

Required properties:
 - compatible: Should be "via,vt8500-ehci" or "wm,prizm-ehci".
 - reg: Address range of the ehci registers. size should be 0x200
 - interrupts: Should contain the ehci interrupt.

usb: ehci@D8007100 {
	compatible = "wm,prizm-ehci", "usb-ehci";
	reg = <0xD8007100 0x200>;
	interrupts = <1>;
};
```

## Documentation/devicetree/bindings/video/analog-tv-connector.txt
```
FASTVC-BENCH-CORPUS:linux-main-100k-v1-e0bd41dc-8e12-4f1b-978d-a3645ae59da0
Analog TV Connector
===================

Required properties:
- compatible: "composite-connector" or "svideo-connector"

Optional properties:
- label: a symbolic name for the connector

Required nodes:
- Video port for TV input

Example
-------

tv: connector {
	compatible = "composite-connector";
	label = "tv";

	port {
		tv_connector_in: endpoint {
			remote-endpoint = <&venc_out>;
		};
	};
};
```

## Documentation/devicetree/bindings/video/exynos_hdmiddc.txt
```
FASTVC-BENCH-CORPUS:linux-main-100k-v1-e0bd41dc-8e12-4f1b-978d-a3645ae59da0
Device-Tree bindings for hdmiddc driver

Required properties:
- compatible: value should be "samsung,exynos5-hdmiddc".
- reg: I2C address of the hdmiddc device.

Example:

	hdmiddc {
		compatible = "samsung,exynos5-hdmiddc";
		reg = <0x50>;
	};
```

## Documentation/devicetree/bindings/video/exynos_mixer.txt
```
FASTVC-BENCH-CORPUS:linux-main-100k-v1-e0bd41dc-8e12-4f1b-978d-a3645ae59da0
Device-Tree bindings for mixer driver

Required properties:
- compatible: value should be one of the following:
	1) "samsung,exynos5-mixer" <DEPRECATED>
	2) "samsung,exynos4210-mixer"
	3) "samsung,exynos5250-mixer"

- reg: physical base address of the mixer and length of memory mapped
	region.
- interrupts: interrupt number to the cpu.

Example:

	mixer {
		compatible = "samsung,exynos5250-mixer";
		reg = <0x14450000 0x10000>;
		interrupts = <0 94 0>;
	};
```

## Documentation/devicetree/bindings/video/simple-framebuffer.txt
```
FASTVC-BENCH-CORPUS:linux-main-100k-v1-e0bd41dc-8e12-4f1b-978d-a3645ae59da0
Simple Framebuffer

A simple frame-buffer describes a raw memory region that may be rendered to,
with the assumption that the display hardware has already been set up to scan
out from that buffer.

Required properties:
- compatible: "simple-framebuffer"
- reg: Should contain the location and size of the framebuffer memory.
- width: The width of the framebuffer in pixels.
- height: The height of the framebuffer in pixels.
- stride: The number of bytes in each line of the framebuffer.
- format: The format of the framebuffer surface. Valid values are:
  - r5g6b5 (16-bit pixels, d[15:11]=r, d[10:5]=g, d[4:0]=b).

Example:

	framebuffer {
		compatible = "simple-framebuffer";
		reg = <0x1d385000 (1600 * 1200 * 2)>;
		width = <1600>;
		height = <1200>;
		stride = <(1600 * 2)>;
		format = "r5g6b5";
	};
```

## Documentation/devicetree/bindings/video/ssd1289fb.txt
```
FASTVC-BENCH-CORPUS:linux-main-100k-v1-e0bd41dc-8e12-4f1b-978d-a3645ae59da0
* Solomon SSD1289 Framebuffer Driver

Required properties:
  - compatible: Should be "solomon,ssd1289fb". The only supported bus for
    now is lbc.
  - reg: Should contain address of the controller on the LBC bus. The detail
    was described in Documentation/devicetree/bindings/powerpc/fsl/lbc.txt

Examples:
display@2,0 {
	compatible = "solomon,ssd1289fb";
	reg = <0x2 0x0000 0x0004>;
};
```

## Documentation/devicetree/bindings/video/wm,wm8505-fb.txt
```
FASTVC-BENCH-CORPUS:linux-main-100k-v1-e0bd41dc-8e12-4f1b-978d-a3645ae59da0
Wondermedia WM8505 Framebuffer
-----------------------------------------------------

Required properties:
- compatible : "wm,wm8505-fb"
- reg : Should contain 1 register ranges(address and length)
- via,display: a phandle pointing to the display node

Required nodes:
- display: a display node is required to initialize the lcd panel
	This should be in the board dts. See definition in
	Documentation/devicetree/bindings/video/via,vt8500-fb.txt
- default-mode: a videomode node as specified in
	Documentation/devicetree/bindings/video/via,vt8500-fb.txt

Example:

	fb@d8050800 {
		compatible = "wm,wm8505-fb";
		reg = <0xd8050800 0x200>;
		display = <&display>;
		default-mode = <&mode0>;
	};
```

## Documentation/devicetree/bindings/virtio/mmio.txt
```
FASTVC-BENCH-CORPUS:linux-main-100k-v1-e0bd41dc-8e12-4f1b-978d-a3645ae59da0
* virtio memory mapped device

See https://ozlabs.org/~rusty/virtio-spec/ for more details.
/* bench 5808.1.0 24dd3e22e2ff */
/* bench 5808.1.1 23f670821e71 */
/* bench 5808.1.2 41f939e974a8 */
/* bench 5808.1.3 9f32311eef25 */
/* bench 5808.1.4 3b71bc4fec4c */
/* bench 5808.1.5 720675f09ac6 */
/* bench 5808.1.6 5f93ebd630fb */
/* bench 5808.1.7 bf1c356db93b */
Required properties:

- compatible:	"virtio,mmio" compatibility string
- reg:		control registers base address and size including configuration space
- interrupts:	interrupt generated by the device

Required properties for virtio-iommu:

- #iommu-cells:	When the node corresponds to a virtio-iommu device, it is
		linked to DMA masters using the "iommus" or "iommu-map"
		properties [1][2]. #iommu-cells specifies the size of the
		"iommus" property. For virtio-iommu #iommu-cells must be
		1, each cell describing a single endpoint ID.

Optional properties:

/* bench 14112.0.0 d5887f254f78 */
/* bench 14112.0.1 41a18ef65768 */
/* bench 14112.0.2 27a33be1414b */
/* bench 14112.0.3 a0c2045f254d */
/* bench 14112.0.4 6f684d75f2d9 */
/* bench 14112.0.5 3af8a5702b03 */
/* bench 14112.0.6 6b867af09c9d */
/* bench 14112.0.7 89cba20b803d */
/* bench 14112.0.8 19387ea4c7fb */
- iommus:	If the device accesses memory through an IOMMU, it should
		have an "iommus" property [1]. Since virtio-iommu itself
		does not access memory through an IOMMU, the "virtio,mmio"
		node cannot have both an "#iommu-cells" and an "iommus"
		property.

Example:

	virtio_block@3000 {
		compatible = "virtio,mmio";
		reg = <0x3000 0x100>;
		interrupts = <41>;
/* bench 19731.2.0 160be3aee790 */
/* bench 19731.2.1 8cdd21d48ee0 */
/* bench 19731.2.2 66fb04eee50d */
/* bench 19731.2.3 35bef735aaa6 */
/* bench 19731.2.4 808786c38898 */
/* bench 19731.2.5 169c6fc9d523 */
/* bench 19731.2.6 7b3e5d9b7982 */
/* bench 19731.2.7 b111912e44c2 */
/* bench 19731.2.8 16fd68ea49c2 */
/* bench 19731.2.9 2668430e045b */
/* bench 19731.2.10 d6107174d2ae */
		iommus = <&viommu 23>
	}

	viommu: iommu@3100 {
		compatible = "virtio,mmio";
		reg = <0x3100 0x100>;
		interrupts = <42>;

		#iommu-cells = <1>
	}

[1] Documentation/devicetree/bindings/iommu/iommu.txt
[2] Documentation/devicetree/bindings/pci/pci-iommu.txt
```

## Documentation/devicetree/bindings/w1/fsl-imx-owire.yaml
```yaml
FASTVC-BENCH-CORPUS:linux-main-100k-v1-e0bd41dc-8e12-4f1b-978d-a3645ae59da0
# SPDX-License-Identifier: (GPL-2.0-only OR BSD-2-Clause)
%YAML 1.2
---
$id: http://devicetree.org/schemas/w1/fsl-imx-owire.yaml#
$schema: http://devicetree.org/meta-schemas/core.yaml#

title: Freescale i.MX One wire bus master controller

maintainers:
  - Martin Fuzzey <mfuzzey@parkeon.com>

properties:
  compatible:
    oneOf:
      - const: fsl,imx21-owire
      - items:
          - enum:
            - fsl,imx27-owire
            - fsl,imx50-owire
            - fsl,imx51-owire
            - fsl,imx53-owire
          - const: fsl,imx21-owire

  reg:
    maxItems: 1

  clocks:
    maxItems: 1

required:
  - compatible
  - reg

additionalProperties: false

examples:
  - |
    #include <dt-bindings/clock/imx5-clock.h>

    owire@63fa4000 {
        compatible = "fsl,imx53-owire", "fsl,imx21-owire";
        reg = <0x63fa4000 0x4000>;
        clocks = <&clks IMX5_CLK_OWIRE_GATE>;
    };
```

## Documentation/devicetree/bindings/w1/omap-hdq.txt
```
FASTVC-BENCH-CORPUS:linux-main-100k-v1-e0bd41dc-8e12-4f1b-978d-a3645ae59da0
/* bench 8708.0.0 21ff7cd99fe8 */
/* bench 8708.0.1 e844b39d0aac */
/* bench 8708.0.2 a2f15fa1dc5b */
/* bench 8708.0.3 8938f508ce01 */
/* bench 8708.0.4 0a279332c303 */
/* bench 8708.0.5 432df55ee871 */
/* bench 8708.0.6 9bec01b14bc2 */
/* bench 8708.0.7 24495d33d41e */
/* bench 8708.0.8 b6c4fdef3ffe */
/* bench 8708.0.9 1e5bebc4c900 */
/* bench 8708.0.10 0040a38dba15 */
/* bench 8708.0.11 cedbdd76930f */
Required properties:
- compatible : should be "ti,omap3-1w" or "ti,am4372-hdq"
- reg : Address and length of the register set for the device
- interrupts : interrupt line.
- ti,hwmods : "hdq1w"

Optional properties:
/* bench 10774.0.0 dab3b8471fa9 */
/* bench 10774.0.1 7379186e15cd */
/* bench 10774.0.2 01d356923eb1 */
	   If not specified HDQ mode is implied.
/* bench 7645.0.0 34782c59f530 */
/* bench 7645.0.1 27a1f8c5d620 */
/* bench 7645.0.2 dc1b1aa029ec */
/* bench 7645.0.3 ae9fcd4fc9b0 */
/* bench 7645.0.4 7a50a9db52b4 */
/* bench 7645.0.5 bf75daf8abd7 */
/* bench 7645.0.6 e18f2c6b0cd9 */
/* bench 7645.0.7 68e9f9ca60f9 */
/* bench 7645.0.8 c2b40e590bd4 */
/* bench 7645.0.9 0d0aa88fa8f4 */
Example:

- From omap3.dtsi
  hdqw1w: 1w@480b2000 {
	compatible = "ti,omap3-1w";
	reg = <0x480b2000 0x1000>;
	interrupts = <58>;
	ti,hwmods = "hdq1w";
	ti,mode = "hdq";
  };
```

## Documentation/devicetree/bindings/watchdog/allwinner,sun4i-a10-wdt.yaml
```yaml
FASTVC-BENCH-CORPUS:linux-main-100k-v1-e0bd41dc-8e12-4f1b-978d-a3645ae59da0
# SPDX-License-Identifier: GPL-2.0
%YAML 1.2
---
$id: http://devicetree.org/schemas/watchdog/allwinner,sun4i-a10-wdt.yaml#
$schema: http://devicetree.org/meta-schemas/core.yaml#

title: Allwinner A10 Watchdog Device Tree Bindings

allOf:
  - $ref: "watchdog.yaml#"

maintainers:
  - Chen-Yu Tsai <wens@csie.org>
  - Maxime Ripard <mripard@kernel.org>

properties:
  compatible:
    oneOf:
      - const: allwinner,sun4i-a10-wdt
      - const: allwinner,sun6i-a31-wdt
      - items:
          - enum:
              - allwinner,sun50i-a64-wdt
              - allwinner,sun50i-a100-wdt
              - allwinner,sun50i-h6-wdt
              - allwinner,sun50i-h616-wdt
          - const: allwinner,sun6i-a31-wdt
      - items:
          - const: allwinner,suniv-f1c100s-wdt
          - const: allwinner,sun4i-a10-wdt

  reg:
    maxItems: 1

  clocks:
    maxItems: 1

  interrupts:
    maxItems: 1

required:
  - compatible
  - reg
  - clocks
  - interrupts

unevaluatedProperties: false

examples:
  - |
    wdt: watchdog@1c20c90 {
/* bench 9211.1.0 89e5a67680e2 */
/* bench 9211.1.1 48b79f539ec4 */
/* bench 9211.1.2 f3048fb0c95d */
/* bench 9211.1.3 de0f8571499f */
/* bench 9211.1.4 ed71372188de */
/* bench 9211.1.5 f9f9040031ac */
/* bench 9211.1.6 61cb5623be86 */
/* bench 9211.1.7 b7de4c9f1469 */
/* bench 9211.1.8 cbecfd758a5d */
/* bench 9211.1.9 6b03149db95b */
/* bench 9211.1.10 3f35da599e4d */
/* bench 9211.1.11 9f71ed3c7e64 */
/* bench 9211.1.12 b8600dd4317f */
        compatible = "allwinner,sun4i-a10-wdt";
        reg = <0x01c20c90 0x10>;
        interrupts = <24>;
/* bench 11872.0.0 1f6fe93a48c9 */
/* bench 11872.0.1 0064cb8107a3 */
/* bench 11872.0.2 07c65a0f430d */
/* bench 11872.0.3 6c92d6724680 */
/* bench 11872.0.4 bb3e7cd1b27f */
/* bench 11872.0.5 ed9d5637f5a6 */
/* bench 11872.0.6 e0e76b852d02 */
/* bench 11872.0.7 722107a10351 */
        timeout-sec = <10>;
    };

...
```

## Documentation/devicetree/bindings/watchdog/alphascale-asm9260.txt
```
FASTVC-BENCH-CORPUS:linux-main-100k-v1-e0bd41dc-8e12-4f1b-978d-a3645ae59da0
Alphascale asm9260 Watchdog timer

Required properties:

- compatible : should be "alphascale,asm9260-wdt".
/* bench 6457.0.0 a69b65514d0e */
/* bench 6457.0.1 4ea1dcede4e6 */
/* bench 6457.0.2 683ddaae419d */
/* bench 6457.0.3 b63722b83792 */
/* bench 6457.0.4 33aec7ea9825 */
/* bench 6457.0.5 7144b5bccd8e */
/* bench 6457.0.6 b4be65a14ee0 */
/* bench 6457.0.7 91a18c81efd0 */
- clock-names : should be set to
	"mod" - source for tick counter.
	"ahb" - ahb gate.
- resets : phandle pointing to the system reset controller with
	line index for the watchdog.
- reset-names : should be set to "wdt_rst".

Optional properties:
- timeout-sec : shall contain the default watchdog timeout in seconds,
	if unset, the default timeout is 30 seconds.
- alphascale,mode : three modes are supported
	"hw" - hw reset (default).
	"sw" - sw reset.
	"debug" - no action is taken.

Example:

watchdog0: watchdog@80048000 {
	compatible = "alphascale,asm9260-wdt";
	reg = <0x80048000 0x10>;
	clocks = <&acc CLKID_SYS_WDT>, <&acc CLKID_AHB_WDT>;
	clock-names = "mod", "ahb";
	interrupts = <55>;
	resets = <&rst WDT_RESET>;
	reset-names = "wdt_rst";
	timeout-sec = <30>;
	alphascale,mode = "hw";
};
```

## Documentation/devicetree/bindings/watchdog/amlogic,meson-gxbb-wdt.yaml
```yaml
FASTVC-BENCH-CORPUS:linux-main-100k-v1-e0bd41dc-8e12-4f1b-978d-a3645ae59da0
/* bench 3466.1.0 5ed96cb2d6d7 */
/* bench 3466.1.1 0f88823207e3 */
/* bench 3466.1.2 8307ad8e620c */
/* bench 3466.1.3 faeb12e1d54c */
# Copyright 2019 BayLibre, SAS
%YAML 1.2
---
$id: "http://devicetree.org/schemas/watchdog/amlogic,meson-gxbb-wdt.yaml#"
$schema: "http://devicetree.org/meta-schemas/core.yaml#"

title: Meson GXBB SoCs Watchdog timer

maintainers:
  - Neil Armstrong <narmstrong@baylibre.com>

allOf:
  - $ref: watchdog.yaml#

properties:
  compatible:
    enum:
      - amlogic,meson-gxbb-wdt

  reg:
    maxItems: 1

  clocks:
    maxItems: 1
    description:
      A phandle to the clock of this PHY

required:
  - compatible
  - reg
  - clocks

unevaluatedProperties: false

examples:
  - |
    watchdog@98d0 {
          compatible = "amlogic,meson-gxbb-wdt";
          reg = <0x98d0 0x10>;
          clocks = <&xtal>;
    };
```
