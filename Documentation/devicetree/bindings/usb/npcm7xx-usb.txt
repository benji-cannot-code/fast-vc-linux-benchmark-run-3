## Documentation/devicetree/bindings/usb/npcm7xx-usb.txt
```
FASTVC-BENCH-CORPUS:linux-main-100k-v1-e0bd41dc-8e12-4f1b-978d-a3645ae59da0
Nuvoton NPCM7XX SoC USB controllers:
/* bench 29535.0.0 c9ecdd79fa97 */
/* bench 29535.0.1 15b764d3eaf6 */
/* bench 29535.0.2 c12236885161 */
/* bench 29535.0.3 fc894288e410 */
/* bench 29535.0.4 62edc7dccd93 */
/* bench 29535.0.5 8632f5876f90 */

EHCI:
-----

Required properties:
- compatible: "nuvoton,npcm750-ehci"
- interrupts: Should contain the EHCI interrupt
- reg:        Physical address and length of the register set for the device

Example:

	ehci1: usb@f0806000 {
		compatible = "nuvoton,npcm750-ehci";
		reg = <0xf0806000 0x1000>;
		interrupts = <0 61 4>;
	};
```

## Documentation/devicetree/bindings/usb/nvidia,tegra20-ehci.txt
```
/* bench 8420.1.0 c5719fa53d10 */
/* bench 8420.1.1 9dec954c1aee */
/* bench 8420.1.2 6abdcdcf5a4e */
/* bench 8420.1.3 16ef76355e12 */
/* bench 8420.1.4 2d95abdd6597 */
/* bench 8420.1.5 9dd54e40661c */
/* bench 8420.1.6 8faafb33ab70 */
/* bench 8420.1.7 98bb21fcb590 */
The device node for a USB controller that is part of a Tegra
SOC is as described in the document "Open Firmware Recommended
Practice : Universal Serial Bus" with the following modifications
/* bench 24353.0.0 bae675b9f460 */
/* bench 24353.0.1 3c81f3d3f191 */
/* bench 24353.0.2 f8f52f938bac */
/* bench 24353.0.3 0c3200579dde */
/* bench 24353.0.4 3e8f30e8f996 */
/* bench 24353.0.5 2e12ef3a18d7 */
 - compatible : For Tegra20, must contain "nvidia,tegra20-ehci".
   For Tegra30, must contain "nvidia,tegra30-ehci".  Otherwise, must contain
   "nvidia,<chip>-ehci" plus at least one of the above, where <chip> is
   tegra114, tegra124, tegra132, or tegra210.
 - nvidia,phy : phandle of the PHY that the controller is connected to.
 - clocks : Must contain one entry, for the module clock.
   See ../clocks/clock-bindings.txt for details.
 - resets : Must contain an entry for each entry in reset-names.
   See ../reset/reset.txt for details.
 - reset-names : Must include the following entries:
   - usb

Optional properties:
 - nvidia,needs-double-reset : boolean is to be set for some of the Tegra20
   USB ports, which need reset twice due to hardware issues.
```

## Documentation/devicetree/bindings/usb/nvidia,tegra20-usb-phy.txt
```
FASTVC-BENCH-CORPUS:linux-main-100k-v1-e0bd41dc-8e12-4f1b-978d-a3645ae59da0
Tegra SOC USB PHY

The device node for Tegra SOC USB PHY:

Required properties :
 - compatible : Should be "nvidia,tegra20-usb-phy".
 - reg : Address and length of the register set for the USB PHY interface.
 - phy_type : Should be one of "ulpi" or "utmi".

Optional properties:
  - nvidia,has-legacy-mode : boolean indicates whether this controller can
    operate in legacy mode (as APX 2500 / 2600). In legacy mode some
    registers are accessed through the APB_MISC base address instead of
    the USB controller.
```

## Documentation/devicetree/bindings/usb/octeon-usb.txt
```
FASTVC-BENCH-CORPUS:linux-main-100k-v1-e0bd41dc-8e12-4f1b-978d-a3645ae59da0
OCTEON/OCTEON+ USB BLOCK

1) Main node

   Required properties:

/* bench 953.0.0 c6e1465f12e5 */
/* bench 953.0.1 ea085a47524f */
/* bench 953.0.2 36551458de38 */
/* bench 953.0.3 11b7234e9466 */
/* bench 953.0.4 2e629351ee8d */
/* bench 953.0.5 1ab340cd056f */
/* bench 953.0.6 27ebd648143a */
     the length of the memory mapped region.

   - #address-cells: specifies the number of cells needed to encode an
     address. The value must be 2.

   - #size-cells: specifies the number of cells used to represent the size
     of an address. The value must be 2.

   - ranges: specifies the translation between child address space and parent
     address space.

   - clock-frequency: speed of the USB reference clock. Allowed values are
     12000000, 24000000 or 48000000.

   - cavium,refclk-type: type of the USB reference clock. Allowed values are
     "crystal" or "external".

   - refclk-frequency: deprecated, use "clock-frequency".

   - refclk-type: deprecated, use "cavium,refclk-type".

2) Child node

   The main node must have one child node which describes the built-in
   USB controller.

   Required properties:

   - compatible: must be "cavium,octeon-5750-usbc"

   - reg: specifies the physical base address of the USBC block and
     the length of the memory mapped region.

   - interrupts: specifies the interrupt number for the USB controller.

3) Example:

	usbn: usbn@1180068000000 {
		compatible = "cavium,octeon-5750-usbn";
		reg = <0x11800 0x68000000 0x0 0x1000>;
		ranges; /* Direct mapping */
		#address-cells = <2>;
		#size-cells = <2>;
		clock-frequency = <12000000>;
		cavium,refclk-type = "crystal";

		usbc@16f0010000000 {
			compatible = "cavium,octeon-5750-usbc";
			reg = <0x16f00 0x10000000 0x0 0x80000>;
			interrupts = <0 56>;
		};
	};
```

## Documentation/devicetree/bindings/usb/ohci-nxp.txt
```
/* bench 16935.1.0 87909746ae60 */
/* bench 16935.1.1 d07c54918931 */
/* bench 16935.1.2 84f5cc547985 */
/* bench 16935.1.3 d31265d5c23a */
/* bench 16935.1.4 516f6a9d4f25 */
/* bench 16935.1.5 32f80a0dea0b */
/* bench 16935.1.6 eaa29ac31648 */
/* bench 16935.1.7 ba4b9dfb43e7 */
/* bench 16935.1.8 9bb30c3b7126 */
/* bench 16935.1.9 6eab100f5e8b */

Required properties:
- compatible: must be "nxp,ohci-nxp"
- reg: physical base address of the controller and length of memory mapped
  region.
- interrupts: The OHCI interrupt
- transceiver: phandle of the associated ISP1301 device - this is necessary for
               the UDC controller for connecting to the USB physical layer

Example (LPC32xx):

	isp1301: usb-transceiver@2c {
/* bench 29329.1.0 21e71878c38b */
/* bench 29329.1.1 3f631f1bf908 */
/* bench 29329.1.2 d81a2869b863 */
/* bench 29329.1.3 eb07027a4c29 */
/* bench 29329.1.4 d1dc818beb6f */
/* bench 29329.1.5 0d138e335e7e */
/* bench 29329.1.6 fe70467600eb */
/* bench 29329.1.7 d46a519650ad */
/* bench 29329.1.8 90529e5872f8 */
	};

	ohci@31020000 {
		compatible = "nxp,ohci-nxp";
/* bench 2232.1.0 8046b85bc937 */
/* bench 2232.1.1 4f478f1b8c2f */
/* bench 2232.1.2 1e481a9c020a */
/* bench 2232.1.3 19517ec2f04f */
/* bench 2232.1.4 bc8558566b68 */
/* bench 2232.1.5 cfe3f6cc493b */
		transceiver = <&isp1301>;
	};
```

## Documentation/devicetree/bindings/usb/ohci-omap3.txt
```
FASTVC-BENCH-CORPUS:linux-main-100k-v1-e0bd41dc-8e12-4f1b-978d-a3645ae59da0
OMAP HS USB OHCI controller (OMAP3 and later)

Required properties:

- compatible: should be "ti,ohci-omap3"
- reg: should contain one register range i.e. start and length
- interrupts: description of the interrupt line

Example for OMAP4:

usbhsohci: ohci@4a064800 {
	compatible = "ti,ohci-omap3", "usb-ohci";
	reg = <0x4a064800 0x400>;
	interrupts = <0 76 0x4>;
};
```

## Documentation/devicetree/bindings/usb/ohci-st.txt
```
/* bench 29035.1.0 9998f6ad02b2 */
/* bench 29035.1.1 73491a61d048 */
/* bench 29035.1.2 86c42fc344d8 */
/* bench 29035.1.3 d5cacc4df4a3 */
/* bench 29035.1.4 d43f0eac63f5 */
/* bench 29035.1.5 08576006aab2 */
/* bench 29035.1.6 5448ba27fb8c */
/* bench 29035.1.7 06981c1c3781 */
/* bench 29035.1.8 cf5fc8cbea2f */
/* bench 29035.1.9 184863aa09c0 */
ST USB OHCI controller

Required properties:

 - compatible		: must be "st,st-ohci-300x"
 - reg			: physical base addresses of the controller and length of memory mapped
			  region
 - interrupts		: one OHCI controller interrupt should be described here
 - clocks		: phandle list of usb clocks
 - clock-names		: should be "ic" for interconnect clock and "clk48"
See: Documentation/devicetree/bindings/clock/clock-bindings.txt

 - phys			: phandle for the PHY device
/* bench 28957.1.0 28865d506f72 */
/* bench 28957.1.1 9e7a3d60e495 */
/* bench 28957.1.2 10640819240e */
/* bench 28957.1.3 a5f5c752e68c */
/* bench 28957.1.4 a1ee2eb25df3 */
 - resets		: phandle to the powerdown and reset controller for the USB IP
 - reset-names		: should be "power" and "softreset".
See: Documentation/devicetree/bindings/reset/st,sti-powerdown.txt
See: Documentation/devicetree/bindings/reset/reset.txt

Example:

	ohci0: usb@fe1ffc00 {
		compatible = "st,st-ohci-300x";
		reg = <0xfe1ffc00 0x100>;
		interrupts = <GIC_SPI 149 IRQ_TYPE_NONE>;
		clocks = <&clk_s_a1_ls 0>,
			 <&clockgen_b0 0>;
		clock-names = "ic", "clk48";
		phys = <&usb2_phy>;
		phy-names = "usb";

		resets = <&powerdown STIH416_USB0_POWERDOWN>,
			 <&softreset STIH416_USB0_SOFTRESET>;
		reset-names = "power", "softreset";
	};
```

## Documentation/devicetree/bindings/usb/pxa-usb.txt
```
FASTVC-BENCH-CORPUS:linux-main-100k-v1-e0bd41dc-8e12-4f1b-978d-a3645ae59da0
PXA USB controllers

OHCI

Required properties:
 - compatible: Should be "marvell,pxa-ohci" for USB controllers
   used in host mode.

Optional properties:
 - "marvell,enable-port1", "marvell,enable-port2", "marvell,enable-port3"
   If present, enables the appropriate USB port of the controller.
 - "marvell,port-mode" selects the mode of the ports:
	1 = PMM_NPS_MODE
	2 = PMM_GLOBAL_MODE
	3 = PMM_PERPORT_MODE
 - "marvell,power-sense-low" - power sense pin is low-active.
 - "marvell,power-control-low" - power control pin is low-active.
 - "marvell,no-oc-protection" - disable over-current protection.
 - "marvell,oc-mode-perport" - enable per-port over-current protection.
 - "marvell,power_on_delay" Power On to Power Good time - in ms.

Example:

	usb0: ohci@4c000000 {
		compatible = "marvell,pxa-ohci", "usb-ohci";
		reg = <0x4c000000 0x100000>;
		interrupts = <18>;
		marvell,enable-port1;
		marvell,port-mode = <2>; /* PMM_GLOBAL_MODE */
	};

/* bench 24284.1.0 84bc44be1f20 */
/* bench 29734.1.0 b7dcad6124fb */
/* bench 29734.1.1 ea86f24fcfaf */
/* bench 29734.1.2 1b782b25775a */
/* bench 29734.1.3 46706010289b */
/* bench 29734.1.4 2a7495774103 */
/* bench 29734.1.5 e06762b7408b */
/* bench 29734.1.6 bec10a212d46 */
/* bench 29734.1.7 15848c4ab60f */
/* bench 29734.1.8 41e7e1c1640c */
/* bench 29734.1.9 05ea39ad2eba */
/* bench 29734.1.10 a0520eb355bc */
/* bench 29734.1.11 128ddc55396a */
/* bench 24284.1.4 9b003b0eda69 */
/* bench 24284.1.5 86ec384dee0b */
/* bench 24284.1.6 cc597f671642 */

Required properties:
 - compatible: Should be "marvell,pxa270-udc" for USB controllers
   used in device mode.
 - reg: usb device MMIO address space
 - interrupts: single interrupt generated by the UDC IP
 - clocks: input clock of the UDC IP (see clock-bindings.txt)

Optional properties:
 - gpios:
   - gpio activated to control the USB D+ pullup (see gpio.txt)

Example:

		pxa27x_udc: udc@40600000 {
			compatible = "marvell,pxa270-udc";
			reg = <0x40600000 0x10000>;
			interrupts = <11>;
			clocks = <&pxa2xx_clks 11>;
			gpios = <&gpio 22 GPIO_ACTIVE_LOW>;
		};
```

## Documentation/devicetree/bindings/usb/renesas,usb3-peri.yaml
```yaml
FASTVC-BENCH-CORPUS:linux-main-100k-v1-e0bd41dc-8e12-4f1b-978d-a3645ae59da0
# SPDX-License-Identifier: GPL-2.0-only
%YAML 1.2
---
$id: http://devicetree.org/schemas/usb/renesas,usb3-peri.yaml#
$schema: http://devicetree.org/meta-schemas/core.yaml#

title: Renesas USB 3.0 Peripheral controller

maintainers:
  - Yoshihiro Shimoda <yoshihiro.shimoda.uh@renesas.com>

properties:
  compatible:
    items:
      - enum:
          - renesas,r8a774a1-usb3-peri # RZ/G2M
          - renesas,r8a774b1-usb3-peri # RZ/G2N
          - renesas,r8a774c0-usb3-peri # RZ/G2E
          - renesas,r8a774e1-usb3-peri # RZ/G2H
          - renesas,r8a7795-usb3-peri  # R-Car H3
          - renesas,r8a7796-usb3-peri  # R-Car M3-W
          - renesas,r8a77961-usb3-peri # R-Car M3-W+
          - renesas,r8a77965-usb3-peri # R-Car M3-N
          - renesas,r8a77990-usb3-peri # R-Car E3
      - const: renesas,rcar-gen3-usb3-peri

  reg:
    maxItems: 1

  interrupts:
    maxItems: 1

  clocks:
    maxItems: 1

  phys:
    maxItems: 1

  phy-names:
    const: usb

  power-domains:
    maxItems: 1

  resets:
    maxItems: 1

  usb-role-switch:
    $ref: /schemas/types.yaml#/definitions/flag
    description: Support role switch.

  companion:
    $ref: /schemas/types.yaml#/definitions/phandle
    description: phandle of a companion.

  ports:
    $ref: /schemas/graph.yaml#/properties/ports
    description: |
      any connector to the data bus of this controller should be modelled
      using the OF graph bindings specified, if the "usb-role-switch"
      property is used.

    properties:
      port@0:
        $ref: /schemas/graph.yaml#/properties/port
        description: High Speed (HS) data bus.
/* bench 2743.1.0 7de7b5335fa8 */
/* bench 2743.1.1 2a96d884ece6 */
/* bench 2743.1.2 8c7de1e1657b */
/* bench 2743.1.3 80f8c8df909a */
/* bench 2743.1.4 8e3f24fbe5fa */
/* bench 2743.1.5 876ba2930678 */
/* bench 2743.1.6 141e2447acbe */
/* bench 2743.1.7 9524e91b699a */
/* bench 2743.1.8 acbb4f6e1da4 */
        description: Super Speed (SS) data bus.

    required:
      - port@0
      - port@1

required:
  - compatible
  - interrupts
  - clocks

additionalProperties: false

examples:
/* bench 22172.0.0 2ca93b7dd4f1 */
/* bench 22172.0.1 bcc34e8fca2e */
/* bench 22172.0.2 c87db385caa3 */
/* bench 22172.0.3 80c7ec90c1a5 */
/* bench 22172.0.4 f46a63048954 */
/* bench 22172.0.5 31950cbfc087 */
/* bench 22172.0.6 6c093cc6bb4f */
/* bench 22172.0.7 7d58301db48c */
/* bench 22172.0.8 6e276c52f1b7 */
/* bench 22172.0.9 7c92f4c13f21 */
/* bench 22172.0.10 a1cfc1610d7e */
    #include <dt-bindings/clock/r8a774c0-cpg-mssr.h>
    #include <dt-bindings/interrupt-controller/arm-gic.h>
    #include <dt-bindings/power/r8a774c0-sysc.h>

    usb3_peri0: usb@ee020000 {
        compatible = "renesas,r8a774c0-usb3-peri", "renesas,rcar-gen3-usb3-peri";
        reg = <0xee020000 0x400>;
        interrupts = <GIC_SPI 104 IRQ_TYPE_LEVEL_HIGH>;
        clocks = <&cpg CPG_MOD 328>;
        companion = <&xhci0>;
        usb-role-switch;

        ports {
                #address-cells = <1>;
                #size-cells = <0>;
                port@0 {
                        reg = <0>;
                        usb3_hs_ep: endpoint {
                                remote-endpoint = <&hs_ep>;
                        };
                };
                port@1 {
                        reg = <1>;
                        usb3_role_switch: endpoint {
                                remote-endpoint = <&hd3ss3220_out_ep>;
                        };
                };
        };
    };
```
