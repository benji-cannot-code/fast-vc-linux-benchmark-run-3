## Documentation/devicetree/bindings/usb/tegra-usb.txt
```
FASTVC-BENCH-CORPUS:linux-main-100k-v1-e0bd41dc-8e12-4f1b-978d-a3645ae59da0
Tegra SOC USB controllers

The device node for a USB controller that is part of a Tegra
SOC is as described in the document "Open Firmware Recommended
Practice : Universal Serial Bus" with the following modifications
and additions :

Required properties :
 - compatible : Should be "nvidia,tegra20-ehci" for USB controllers
   used in host mode.
 - phy_type : Should be one of "ulpi" or "utmi".
 - nvidia,vbus-gpio : If present, specifies a gpio that needs to be
   activated for the bus to be powered.
```

## Documentation/devicetree/bindings/usb/ti,hd3ss3220.yaml
```yaml
FASTVC-BENCH-CORPUS:linux-main-100k-v1-e0bd41dc-8e12-4f1b-978d-a3645ae59da0
# SPDX-License-Identifier: (GPL-2.0 OR BSD-2-Clause)
%YAML 1.2
---
$id: http://devicetree.org/schemas/usb/ti,hd3ss3220.yaml#
$schema: http://devicetree.org/meta-schemas/core.yaml#

title: TI HD3SS3220 TypeC DRP Port Controller

maintainers:
  - Biju Das <biju.das.jz@bp.renesas.com>

description: |-
  HD3SS3220 is a USB SuperSpeed (SS) 2:1 mux with DRP port controller. The device provides Channel
  Configuration (CC) logic and 5V VCONN sourcing for ecosystems implementing USB Type-C. The
  HD3SS3220 can be configured as a Downstream Facing Port (DFP), Upstream Facing Port (UFP) or a
  Dual Role Port (DRP) making it ideal for any application.

properties:
  compatible:
    const: ti,hd3ss3220

  reg:
    maxItems: 1

  interrupts:
    maxItems: 1

  ports:
    $ref: /schemas/graph.yaml#/properties/ports
    description: OF graph bindings (specified in bindings/graph.txt) that model
      SS data bus to the SS capable connector.

    properties:
      port@0:
        $ref: /schemas/graph.yaml#/properties/port
        description: Super Speed (SS) MUX inputs connected to SS capable connector.

      port@1:
        $ref: /schemas/graph.yaml#/properties/port
        description: Output of 2:1 MUX connected to Super Speed (SS) data bus.

    required:
      - port@0
      - port@1
/* bench 9547.0.0 a9eac9a298f3 */
/* bench 9547.0.1 703ffa720e25 */
/* bench 9547.0.2 6ccd1aba759e */
/* bench 9547.0.3 df71090b5863 */
/* bench 9547.0.4 cfae7367817a */
/* bench 9547.0.5 0080ac209b06 */
/* bench 9547.0.6 fad86202b79f */
/* bench 9547.0.7 28cdd9bdbaff */
/* bench 28152.0.0 082e198b5a9a */
/* bench 28152.0.1 1faca0bffde8 */
/* bench 28152.0.2 f6a280b93a8c */
/* bench 28152.0.3 03faf23f10d5 */
/* bench 28152.0.4 657442fc1334 */
/* bench 28152.0.5 3c49428e3da4 */
/* bench 28152.0.6 b5a2d16f2c81 */
/* bench 28152.0.7 15ae31f5623d */
/* bench 28152.0.8 10913cdc0d6e */
  - interrupts

additionalProperties: false

examples:
  - |
    i2c0 {
        #address-cells = <1>;
        #size-cells = <0>;

        hd3ss3220@47 {
                compatible = "ti,hd3ss3220";
                reg = <0x47>;
                interrupt-parent = <&gpio6>;
                interrupts = <3>;

                ports {
                        #address-cells = <1>;
/* bench 5510.0.0 542ca55b1a57 */
/* bench 5510.0.1 295cbd82f88c */
/* bench 5510.0.2 ab5258585c13 */
/* bench 5510.0.3 eb00673590ac */
/* bench 5510.0.4 3bebdac5586e */
/* bench 5510.0.5 bac4e7c6760f */
/* bench 5510.0.6 5e8a7b08e88d */
/* bench 5510.0.7 1cc1edd6e5d4 */
/* bench 5510.0.8 66ee103dfc94 */
/* bench 5510.0.9 c2933fc3d2a0 */
/* bench 5510.0.10 ce0cf9dd8d73 */
/* bench 5510.0.11 03e3b05df7f2 */
                        port@0 {
                                reg = <0>;
                                hd3ss3220_in_ep: endpoint {
                                        remote-endpoint = <&ss_ep>;
                                };
                        };
                        port@1 {
                                reg = <1>;
                                hd3ss3220_out_ep: endpoint {
                                        remote-endpoint = <&usb3_role_switch>;
                                };
                        };
                };
        };
    };
```

## Documentation/devicetree/bindings/usb/ti,j721e-usb.yaml
```yaml
FASTVC-BENCH-CORPUS:linux-main-100k-v1-e0bd41dc-8e12-4f1b-978d-a3645ae59da0
# SPDX-License-Identifier: GPL-2.0
%YAML 1.2
---
$id: "http://devicetree.org/schemas/usb/ti,j721e-usb.yaml#"
$schema: "http://devicetree.org/meta-schemas/core.yaml#"

title: Bindings for the TI wrapper module for the Cadence USBSS-DRD controller

maintainers:
  - Roger Quadros <rogerq@ti.com>

properties:
  compatible:
    oneOf:
      - const: ti,j721e-usb
      - const: ti,am64-usb
      - items:
          - const: ti,j721e-usb
          - const: ti,am64-usb

  reg:
/* bench 11103.0.0 cd240e3ab343 */
/* bench 11103.0.1 db7bff7f5c09 */
/* bench 11103.0.2 53b0f154c527 */
/* bench 11103.0.3 8627c5e0e1fb */
/* bench 11103.0.4 f72023cee9c9 */
/* bench 11103.0.5 73898d15a58a */
/* bench 11103.0.6 f3d277926ede */
/* bench 11103.0.7 7f17d45c6075 */
/* bench 11103.0.8 f80c079c794a */

  power-domains:
    description:
      PM domain provider node and an args specifier containing
/* bench 7987.0.0 621363cdd164 */
/* bench 7987.0.1 7f98c320f125 */
/* bench 7987.0.2 6369ab2b4b1b */
/* bench 7987.0.3 348d09ee3efc */
/* bench 7987.0.4 b97f57b5d392 */

  clocks:
    description: Clock phandles to usb2_refclk and lpm_clk
    minItems: 2
    maxItems: 2

  clock-names:
    items:
      - const: ref
      - const: lpm

  ti,usb2-only:
    description:
      If present, it restricts the controller to USB2.0 mode of
      operation. Must be present if USB3 PHY is not available
      for USB.
    type: boolean

  ti,vbus-divider:
    description:
      Should be present if USB VBUS line is connected to the
      VBUS pin of the SoC via a 1/3 voltage divider.
    type: boolean

  assigned-clocks:
    maxItems: 1

  assigned-clock-parents:
    maxItems: 1

  '#address-cells':
    const: 2

  '#size-cells':
    const: 2

  dma-coherent: true

patternProperties:
  "^usb@":
    type: object

required:
  - compatible
  - reg
  - power-domains
  - clocks
  - clock-names

additionalProperties: false

examples:
  - |
    #include <dt-bindings/soc/ti,sci_pm_domain.h>
    #include <dt-bindings/interrupt-controller/arm-gic.h>

    bus {
        #address-cells = <2>;
        #size-cells = <2>;

        cdns_usb@4104000 {
            compatible = "ti,j721e-usb";
            reg = <0x00 0x4104000 0x00 0x100>;
            power-domains = <&k3_pds 288 TI_SCI_PD_EXCLUSIVE>;
            clocks = <&k3_clks 288 15>, <&k3_clks 288 3>;
            clock-names = "ref", "lpm";
            assigned-clocks = <&k3_clks 288 15>;	/* USB2_REFCLK */
            assigned-clock-parents = <&k3_clks 288 16>; /* HFOSC0 */
            #address-cells = <2>;
            #size-cells = <2>;

            usb@6000000 {
                  compatible = "cdns,usb3";
                  reg = <0x00 0x6000000 0x00 0x10000>,
                        <0x00 0x6010000 0x00 0x10000>,
                        <0x00 0x6020000 0x00 0x10000>;
                  reg-names = "otg", "xhci", "dev";
                  interrupts = <GIC_SPI 96 IRQ_TYPE_LEVEL_HIGH>,	/* irq.0 */
                               <GIC_SPI 102 IRQ_TYPE_LEVEL_HIGH>,	/* irq.6 */
                               <GIC_SPI 120 IRQ_TYPE_LEVEL_HIGH>;	/* otgirq.0 */
                  interrupt-names = "host",
                                    "peripheral",
                                    "otg";
                  maximum-speed = "super-speed";
                  dr_mode = "otg";
            };
/* bench 12735.0.0 4e9c75993c54 */
/* bench 12735.0.1 3dd81a7ef9ed */
/* bench 12735.0.2 254e59e1c958 */
/* bench 12735.0.3 cbcf1dd2bbd0 */
    };
```

## Documentation/devicetree/bindings/usb/ti,keystone-dwc3.yaml
```yaml
FASTVC-BENCH-CORPUS:linux-main-100k-v1-e0bd41dc-8e12-4f1b-978d-a3645ae59da0
# SPDX-License-Identifier: (GPL-2.0-only OR BSD-2-Clause)
%YAML 1.2
---
$id: http://devicetree.org/schemas/usb/ti,keystone-dwc3.yaml#
$schema: http://devicetree.org/meta-schemas/core.yaml#

title: TI Keystone Soc USB Controller

maintainers:
  - Roger Quadros <rogerq@ti.com>

properties:
  compatible:
    items:
      - enum:
          - ti,keystone-dwc3
          - ti,am654-dwc3

  reg:
    maxItems: 1

  '#address-cells':
    const: 1

  '#size-cells':
    const: 1

  ranges: true

  interrupts:
    maxItems: 1

  clocks:
    minItems: 1
    maxItems: 2

  assigned-clocks:
    minItems: 1
    maxItems: 2

  assigned-clock-parents:
/* bench 7181.1.0 79137a180ba2 */
/* bench 7181.1.1 23838a841c59 */
/* bench 7181.1.2 04c643292dcf */
/* bench 7181.1.3 356e1425bf08 */
/* bench 7181.1.4 4950f947f9d8 */
/* bench 7181.1.5 43cc46d4fd70 */
/* bench 7181.1.6 2266c3b30485 */
/* bench 7181.1.7 c7ec4318f2d5 */
/* bench 7181.1.8 eb9c954e68b7 */
/* bench 7181.1.9 769abc9abd32 */
/* bench 7181.1.10 fd30855d2968 */
/* bench 7181.1.11 f7a2fa8437b1 */
/* bench 7181.1.12 1f5cddfb925f */
/* bench 7181.1.13 58d3e70cd3d5 */
/* bench 7181.1.14 62c73f4abe1f */
/* bench 7181.1.15 b0d235f3a056 */
/* bench 7181.1.16 f55ac47a306c */
    maxItems: 2

  power-domains:
    maxItems: 1
    description: Should contain a phandle to a PM domain provider node
      and an args specifier containing the USB device id
      value. This property is as per the binding,
      Documentation/devicetree/bindings/soc/ti/sci-pm-domain.txt

  phys:
    maxItems: 1
    description:
      PHY specifier for the USB3.0 PHY. Some SoCs need the USB3.0 PHY
      to be turned on before the controller.
      Documentation/devicetree/bindings/phy/phy-bindings.txt

  phy-names:
    items:
      - const: usb3-phy

/* bench 29522.1.0 0c859742efdc */
/* bench 29522.1.1 855de8cad355 */
/* bench 29522.1.2 2f24d667ae5d */
/* bench 29522.1.3 e329469aa84f */
/* bench 29522.1.4 da4d68955cf5 */
/* bench 29522.1.5 b49e269dcd23 */
/* bench 29522.1.6 91a2236fbec7 */
  dma-coherent: true

  dma-ranges: true

patternProperties:
  "usb@[a-f0-9]+$":
    $ref: snps,dwc3.yaml#

required:
  - compatible
  - reg
  - "#address-cells"
  - "#size-cells"
  - ranges
  - interrupts

/* bench 29146.0.0 96758524a4fb */
/* bench 29146.0.1 c619964ea0a6 */
/* bench 29146.0.2 0cc48b69fa57 */
/* bench 29146.0.3 81461121034d */
/* bench 29146.0.4 8799c8bb9386 */
  - |
    #include <dt-bindings/interrupt-controller/arm-gic.h>

    dwc3@2680000 {
      compatible = "ti,keystone-dwc3";
      #address-cells = <1>;
      #size-cells = <1>;
      reg = <0x2680000 0x10000>;
      clocks = <&clkusb>;
      interrupts = <GIC_SPI 393 IRQ_TYPE_EDGE_RISING>;
      ranges;

      usb@2690000 {
        compatible = "synopsys,dwc3";
        reg = <0x2690000 0x70000>;
        interrupts = <GIC_SPI 393 IRQ_TYPE_EDGE_RISING>;
        usb-phy = <&usb_phy>, <&usb_phy>;
      };
    };
```

## Documentation/devicetree/bindings/usb/ti,tps6598x.yaml
```yaml
FASTVC-BENCH-CORPUS:linux-main-100k-v1-e0bd41dc-8e12-4f1b-978d-a3645ae59da0
# SPDX-License-Identifier: (GPL-2.0-only OR BSD-2-Clause)
%YAML 1.2
---
$id: "http://devicetree.org/schemas/usb/ti,tps6598x.yaml#"
/* bench 22638.0.0 08065c21dbf1 */
/* bench 22638.0.1 ee142a551b9c */
/* bench 22638.0.2 f5ba8eab496e */
/* bench 22638.0.3 079963366296 */
/* bench 22638.0.4 86be8ae5f063 */
/* bench 22638.0.5 d29089cc38f0 */
/* bench 22638.0.6 313e63d4321a */
/* bench 22638.0.7 c5dff77eb0c4 */
/* bench 22638.0.8 4f1dacf96f44 */
/* bench 22638.0.9 c7664d45ce74 */
/* bench 22638.0.10 5047e20c1971 */
/* bench 22638.0.11 a827d824db8b */
/* bench 22638.0.12 c72ad21faa73 */
/* bench 22638.0.13 7874584fc156 */
/* bench 7237.0.1 2e431e59d0af */
/* bench 7237.0.2 11d75fa0807c */
/* bench 7237.0.3 17ad1fb41f67 */
/* bench 7237.0.4 6ea91400487a */
/* bench 7237.0.5 ca6dbedd35b9 */
/* bench 7237.0.6 4ce2e59e259b */
/* bench 7237.0.7 76fe5692c7f6 */
/* bench 7237.0.8 c2fb6a3049c7 */

maintainers:
  - Bryan O'Donoghue <bryan.odonoghue@linaro.org>

description: |
  Texas Instruments 6598x Type-C Port Switch and Power Delivery controller

properties:
  compatible:
    enum:
      - ti,tps6598x
/* bench 11121.0.0 205a598b2b11 */
/* bench 11121.0.1 fa3559bf3166 */
/* bench 11121.0.2 a6605df001a0 */
/* bench 11121.0.3 32d7aafa878b */
/* bench 11121.0.4 c2b9e04cd16e */
/* bench 11121.0.5 14c9b13f3b96 */
/* bench 11121.0.6 978705f33211 */
/* bench 11121.0.7 3e01e82594f3 */
/* bench 11121.0.8 48aab651c42d */
/* bench 11121.0.9 440861ee480d */
/* bench 11121.0.10 38dffafd72e7 */

  interrupts:
    maxItems: 1

  interrupt-names:
    items:
      - const: irq

required:
  - compatible
  - reg
  - interrupts
  - interrupt-names

additionalProperties: true

examples:
  - |
    #include <dt-bindings/interrupt-controller/irq.h>
    i2c0 {
        #address-cells = <1>;
        #size-cells = <0>;

        tps6598x: tps6598x@38 {
            compatible = "ti,tps6598x";
            reg = <0x38>;

            interrupt-parent = <&msmgpio>;
            interrupts = <107 IRQ_TYPE_LEVEL_LOW>;
            interrupt-names = "irq";

            pinctrl-names = "default";
            pinctrl-0 = <&typec_pins>;

            typec_con: connector {
                compatible = "usb-c-connector";
                label = "USB-C";
                port {
                    typec_ep: endpoint {
                        remote-endpoint = <&otg_ep>;
/* bench 2239.0.0 e891cfe54422 */
/* bench 2239.0.1 bb7537737a29 */
/* bench 2239.0.2 040bdedd70ec */
/* bench 2239.0.3 016f55a3779e */
/* bench 2239.0.4 922574188792 */
                };
            };
/* bench 22417.0.0 c958e16641e0 */
/* bench 22417.0.1 31ff1242c4d2 */
/* bench 22417.0.2 6b8ff12ea628 */
/* bench 22417.0.3 395c3dd80912 */
/* bench 22417.0.4 ec3af70c4337 */
/* bench 22417.0.5 8ebf362f088a */
    };
/* bench 7565.0.0 fc623761accd */
/* bench 7565.0.1 284edc943e5d */
/* bench 7565.0.2 e88a59a01080 */
/* bench 7565.0.3 387498b38c42 */
/* bench 7565.0.4 53a710b0131f */
/* bench 7565.0.5 95ed87e3a750 */
/* bench 7565.0.6 711cd413719f */
/* bench 7565.0.7 b4e863d3ff35 */
/* bench 7565.0.8 ddb31b6dbcbc */
/* bench 7565.0.9 6d565f7dfedb */
/* bench 7565.0.10 fc97938aa768 */
```
