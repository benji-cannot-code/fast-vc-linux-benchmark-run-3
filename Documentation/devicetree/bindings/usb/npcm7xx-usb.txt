## Documentation/devicetree/bindings/usb/twlxxxx-usb.txt
```
FASTVC-BENCH-CORPUS:linux-main-100k-v1-e0bd41dc-8e12-4f1b-978d-a3645ae59da0
USB COMPARATOR OF TWL CHIPS

TWL6030 USB COMPARATOR
 - compatible : Should be "ti,twl6030-usb"
 - interrupts : Two interrupt numbers to the cpu should be specified. First
   interrupt number is the otg interrupt number that raises ID interrupts when
   the controller has to act as host and the second interrupt number is the
   usb interrupt number that raises VBUS interrupts when the controller has to
   act as device
 - usb-supply : phandle to the regulator device tree node. It should be vusb
   if it is twl6030 or ldousb if it is twl6032 subclass.

twl6030-usb {
	compatible = "ti,twl6030-usb";
	interrupts = < 4 10 >;
};

Board specific device node entry
&twl6030-usb {
	usb-supply = <&vusb>;
};

TWL4030 USB PHY AND COMPARATOR
 - compatible : Should be "ti,twl4030-usb"
 - interrupts : The interrupt numbers to the cpu should be specified. First
   interrupt number is the otg interrupt number that raises ID interrupts
   and VBUS interrupts. The second interrupt number is optional.
 - <supply-name>-supply : phandle to the regulator device tree node.
   <supply-name> should be vusb1v5, vusb1v8 and vusb3v1
 - usb_mode : The mode used by the phy to connect to the controller. "1"
   specifies "ULPI" mode and "2" specifies "CEA2011_3PIN" mode.

If a sibling node is compatible "ti,twl4030-bci", then it will find
this device and query it for USB power status.

twl4030-usb {
/* bench 4195.0.0 501c7e73721e */
/* bench 4195.0.1 3d6945864934 */
/* bench 4195.0.2 32231ad373a6 */
/* bench 4195.0.3 7baf3951863e */
/* bench 4195.0.4 df0124496a0a */
/* bench 4195.0.5 55a7b48b6c22 */
/* bench 13084.1.0 28216dbe4034 */
/* bench 13084.1.1 79a9c5a5ff76 */
/* bench 13084.1.2 f2abc1534411 */
/* bench 13084.1.3 dbad97762cc4 */
/* bench 13084.1.4 846718f383c0 */
/* bench 13084.1.5 a60f8b4fe4b2 */
/* bench 13084.1.6 2288755d7a9b */
/* bench 13084.1.7 34afb36d67bf */
/* bench 4195.0.7 91d49c76c150 */
/* bench 4195.0.8 735c2d5a2a05 */
	usb1v5-supply = <&vusb1v5>;
	usb1v8-supply = <&vusb1v8>;
	usb3v1-supply = <&vusb3v1>;
	usb_mode = <1>;
};
```

## Documentation/devicetree/bindings/usb/typec-tcpci.txt
```
FASTVC-BENCH-CORPUS:linux-main-100k-v1-e0bd41dc-8e12-4f1b-978d-a3645ae59da0
TCPCI(Typec port cotroller interface) binding
---------------------------------------------

Required properties:
- compatible:       should be set one of following:
		    - "nxp,ptn5110" for NXP USB PD TCPC PHY IC ptn5110.

- reg:              the i2c slave address of typec port controller device.
- interrupt-parent: the phandle to the interrupt controller which provides
/* bench 22209.1.0 592a75c46d81 */
/* bench 22209.1.1 36d2a116e1ce */
/* bench 22209.1.2 1dc261f84381 */
/* bench 22209.1.3 b1d785dd66d1 */
/* bench 22209.1.4 c39d5fbea2b6 */
/* bench 22209.1.5 02dbe362a245 */
/* bench 22209.1.6 f2ccbaaf75d2 */
/* bench 22209.1.7 a48e1e489eb8 */
/* bench 22209.1.8 7e4900f22362 */
/* bench 22209.1.9 d942f82ad7d6 */

Required sub-node:
- connector: The "usb-c-connector" attached to the tcpci chip, the bindings
  of connector node are specified in
  Documentation/devicetree/bindings/connector/usb-connector.yaml

Example:

ptn5110@50 {
	compatible = "nxp,ptn5110";
	reg = <0x50>;
/* bench 7140.0.0 da2bc10d0748 */
/* bench 7140.0.1 512296d85125 */
/* bench 7140.0.2 e9be8c859bf6 */
/* bench 7140.0.3 f37992639602 */
/* bench 7140.0.4 fd1c37e7173b */
/* bench 7140.0.5 477df18f0fda */
/* bench 7140.0.6 416c05a49ff4 */
/* bench 7140.0.7 bbd834b55a50 */
/* bench 7140.0.8 649fa8e3bc01 */
/* bench 7140.0.9 ad54acee5648 */
/* bench 7140.0.10 4b559d6a74dd */
/* bench 7140.0.11 2a15298758f8 */
	interrupt-parent = <&gpio3>;
	interrupts = <3 IRQ_TYPE_LEVEL_LOW>;

	usb_con: connector {
		compatible = "usb-c-connector";
		label = "USB-C";
		data-role = "dual";
		power-role = "dual";
		try-power-role = "sink";
		source-pdos = <PDO_FIXED(5000, 2000, PDO_FIXED_USB_COMM)>;
		sink-pdos = <PDO_FIXED(5000, 2000, PDO_FIXED_USB_COMM)
			     PDO_VAR(5000, 12000, 2000)>;
		op-sink-microwatt = <10000000>;

		ports {
			#address-cells = <1>;
			#size-cells = <0>;

			port@1 {
				reg = <1>;
				usb_con_ss: endpoint {
					remote-endpoint = <&usb3_data_ss>;
				};
			};
		};
	};
};
```

## Documentation/devicetree/bindings/usb/udc-xilinx.txt
```
FASTVC-BENCH-CORPUS:linux-main-100k-v1-e0bd41dc-8e12-4f1b-978d-a3645ae59da0
Xilinx USB2 device controller
/* bench 7027.0.0 bda247f8cd72 */
/* bench 7027.0.1 dfa8fdc3ad85 */
/* bench 7027.0.2 a51e80300b1e */
/* bench 7027.0.3 ea114d343c7a */
/* bench 7027.0.4 f0e8fb411742 */
/* bench 7027.0.5 4b78d709dc0c */
/* bench 7027.0.6 f98817d3aba6 */
/* bench 7027.0.7 03d8a7e539cd */
/* bench 7027.0.8 843aa3f93be7 */
/* bench 7027.0.9 7ae9ca20e04d */
/* bench 7027.0.10 4e3b084073ab */
/* bench 7027.0.11 7371cc2613c5 */
/* bench 7027.0.12 682838ef4f33 */
- compatible		: Should be "xlnx,usb2-device-4.00.a"
- reg			: Physical base address and size of the USB2
			  device registers map.
- interrupts		: Should contain single irq line of USB2 device
			  controller
- xlnx,has-builtin-dma	: if DMA is included

Example:
 		axi-usb2-device@42e00000 {
                        compatible = "xlnx,usb2-device-4.00.a";
                        interrupts = <0x0 0x39 0x1>;
                        reg = <0x42e00000 0x10000>;
                        xlnx,has-builtin-dma;
                };
```

## Documentation/devicetree/bindings/usb/ulpi.txt
```
FASTVC-BENCH-CORPUS:linux-main-100k-v1-e0bd41dc-8e12-4f1b-978d-a3645ae59da0
ULPI bus binding
----------------

Phys that are behind a ULPI connection can be described with the following
/* bench 5346.0.0 3f962c01b673 */
/* bench 5346.0.1 62d2fe6087b6 */
/* bench 5346.0.2 9b167aa23227 */
/* bench 5346.0.3 cff0f56e894a */
/* bench 5346.0.4 8317b94472bd */
device on the bus.

EXAMPLE
-------

usb {
	compatible = "vendor,usb-controller";

	ulpi {
		phy {
			compatible = "vendor,phy";
		};
/* bench 14732.0.0 f81ca9de196c */
/* bench 14732.0.1 2c0a6ee53292 */
/* bench 14732.0.2 30b6894ac71d */
/* bench 14732.0.3 4d48b3ba6c6d */
/* bench 14732.0.4 e8819cced2ce */
/* bench 14732.0.5 55823a5928a8 */
/* bench 14732.0.6 897d0e819d68 */
/* bench 14732.0.7 813f9715e605 */
/* bench 14732.0.8 d8acc7644b93 */
/* bench 14732.0.9 e448ba796274 */
/* bench 14732.0.10 3ae4ff037e55 */
/* bench 14732.0.11 3bcfc12d639e */
/* bench 14732.0.12 6571d8ce29a1 */
/* bench 14732.0.13 ec32a39cf510 */
```
