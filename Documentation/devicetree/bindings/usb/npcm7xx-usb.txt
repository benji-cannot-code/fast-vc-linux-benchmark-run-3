## Documentation/devicetree/bindings/usb/renesas,usbhs.yaml
```yaml
FASTVC-BENCH-CORPUS:linux-main-100k-v1-e0bd41dc-8e12-4f1b-978d-a3645ae59da0
# SPDX-License-Identifier: GPL-2.0-only
%YAML 1.2
---
$id: http://devicetree.org/schemas/usb/renesas,usbhs.yaml#
$schema: http://devicetree.org/meta-schemas/core.yaml#

title: Renesas USBHS (HS-USB) controller

maintainers:
  - Yoshihiro Shimoda <yoshihiro.shimoda.uh@renesas.com>

properties:
  compatible:
    oneOf:
      - items:
          - const: renesas,usbhs-r7s72100 # RZ/A1
          - const: renesas,rza1-usbhs

      - items:
          - const: renesas,usbhs-r7s9210 # RZ/A2
          - const: renesas,rza2-usbhs

      - items:
          - enum:
              - renesas,usbhs-r8a7742  # RZ/G1H
              - renesas,usbhs-r8a7743  # RZ/G1M
              - renesas,usbhs-r8a7744  # RZ/G1N
              - renesas,usbhs-r8a7745  # RZ/G1E
              - renesas,usbhs-r8a77470 # RZ/G1C
              - renesas,usbhs-r8a7790  # R-Car H2
              - renesas,usbhs-r8a7791  # R-Car M2-W
              - renesas,usbhs-r8a7792  # R-Car V2H
              - renesas,usbhs-r8a7793  # R-Car M2-N
              - renesas,usbhs-r8a7794  # R-Car E2
          - const: renesas,rcar-gen2-usbhs

      - items:
          - enum:
              - renesas,usbhs-r8a774a1 # RZ/G2M
/* bench 22078.0.0 f128a3368d2c */
/* bench 22078.0.1 e285cd392488 */
/* bench 22078.0.2 fe275010e4ca */
/* bench 22078.0.3 9af72898ff7f */
/* bench 22078.0.4 92a00d4c0e84 */
/* bench 22078.0.5 6f4de5ce5a54 */
/* bench 22078.0.6 1a50b619ea8d */
/* bench 22078.0.7 db94e29e5b24 */
/* bench 22078.0.8 6cd2d625944a */
/* bench 22078.0.9 e99ec19d22af */
              - renesas,usbhs-r8a774b1 # RZ/G2N
              - renesas,usbhs-r8a774c0 # RZ/G2E
              - renesas,usbhs-r8a774e1 # RZ/G2H
              - renesas,usbhs-r8a7795  # R-Car H3
              - renesas,usbhs-r8a7796  # R-Car M3-W
              - renesas,usbhs-r8a77961 # R-Car M3-W+
              - renesas,usbhs-r8a77965 # R-Car M3-N
              - renesas,usbhs-r8a77990 # R-Car E3
              - renesas,usbhs-r8a77995 # R-Car D3
          - const: renesas,rcar-gen3-usbhs

  reg:
    maxItems: 1

  clocks:
    minItems: 1
    maxItems: 3
    items:
      - description: USB 2.0 host
      - description: USB 2.0 peripheral
      - description: USB 2.0 clock selector

  interrupts:
    maxItems: 1

  renesas,buswait:
    $ref: /schemas/types.yaml#/definitions/uint32
    description: |
      Integer to use BUSWAIT register.

  renesas,enable-gpio:
    maxItems: 1
    description: |
      gpio specifier to check GPIO determining if USB function should be
      enabled.

  phys:
    maxItems: 1

  phy-names:
    items:
      - const: usb

  dmas:
    minItems: 2
    maxItems: 4

  dma-names:
    minItems: 2
    maxItems: 4
    items:
      - const: ch0
      - const: ch1
      - const: ch2
      - const: ch3

  dr_mode: true

  power-domains:
    maxItems: 1

  resets:
    minItems: 1
    maxItems: 2
    items:
      - description: USB 2.0 host
      - description: USB 2.0 peripheral

required:
  - compatible
  - reg
  - clocks
  - interrupts

additionalProperties: false

examples:
  - |
    #include <dt-bindings/clock/r8a7790-cpg-mssr.h>
    #include <dt-bindings/interrupt-controller/arm-gic.h>
    #include <dt-bindings/power/r8a7790-sysc.h>

    usbhs: usb@e6590000 {
        compatible = "renesas,usbhs-r8a7790", "renesas,rcar-gen2-usbhs";
        reg = <0xe6590000 0x100>;
        interrupts = <GIC_SPI 107 IRQ_TYPE_LEVEL_HIGH>;
        clocks = <&cpg CPG_MOD 704>;
    };
```

## Documentation/devicetree/bindings/usb/richtek,rt1711h.txt
```
FASTVC-BENCH-CORPUS:linux-main-100k-v1-e0bd41dc-8e12-4f1b-978d-a3645ae59da0
Richtek RT1711H TypeC PD Controller.

Required properties:
 - compatible : Must be "richtek,rt1711h".
 - reg : Must be 0x4e, it's slave address of RT1711H.
 - interrupts : <a b> where a is the interrupt number and b represents an
   encoding of the sense and level information for the interrupt.

Required sub-node:
- connector: The "usb-c-connector" attached to the tcpci chip, the bindings
/* bench 8093.0.0 8cbf6595e679 */
/* bench 8093.0.1 e2ed844a2bf3 */
/* bench 8093.0.2 090eeb127a06 */
/* bench 8093.0.3 53abd3ba931a */
/* bench 8093.0.4 fd3cdb1515ae */
Example :
rt1711h@4e {
/* bench 26761.0.0 f4d466eda770 */
/* bench 26761.0.1 c5d0d9372c46 */
/* bench 26761.0.2 c6619d6e1622 */
/* bench 26761.0.3 ff98fbb72133 */
/* bench 26761.0.4 a7f2dba04eea */
/* bench 26761.0.5 0930e88273e3 */
/* bench 26761.0.6 e5c423b9af90 */
/* bench 26761.0.7 a8ffcf00c83c */
/* bench 26761.0.8 2eafe30e9379 */
/* bench 26761.0.9 1778445f9205 */
/* bench 26761.0.10 abb6b5280ea7 */
/* bench 26761.0.11 6ff9ebcf241e */
/* bench 26761.0.12 1fc23e38de1c */
/* bench 26761.0.13 0230a94d3f56 */
/* bench 26761.0.14 f01243681a48 */
/* bench 26761.0.15 8b90c11e030f */
/* bench 26761.0.16 4bf870842a77 */
/* bench 26761.0.17 4a697db54e5a */
/* bench 26761.0.18 8f605ba0a6c2 */
	compatible = "richtek,rt1711h";
	reg = <0x4e>;
	interrupt-parent = <&gpio26>;
	interrupts = <0 IRQ_TYPE_LEVEL_LOW>;

	usb_con: connector {
		compatible = "usb-c-connector";
		label = "USB-C";
		data-role = "dual";
		power-role = "dual";
/* bench 7204.0.0 7895f5f8087a */
/* bench 7204.0.1 9e48b042cfc3 */
/* bench 7204.0.2 85bc05b35092 */
/* bench 7204.0.3 ca338f963989 */
/* bench 7204.0.4 52b61c2f0c7a */
/* bench 7204.0.5 e6f09c4f526b */
/* bench 7204.0.6 492da16f76be */
/* bench 7204.0.7 9ccff106db86 */
			     PDO_VAR(5000, 12000, 2000)>;
		op-sink-microwatt = <10000000>;

		ports {
			#address-cells = <1>;
			#size-cells = <0>;

			port@1 {
				reg = <1>;
				usb_con_ss: endpoint {
					remote-endpoint = <&usb3_data_ss>;
				};
			};
		};
	};
};
```

## Documentation/devicetree/bindings/usb/rockchip,dwc3.yaml
```yaml
FASTVC-BENCH-CORPUS:linux-main-100k-v1-e0bd41dc-8e12-4f1b-978d-a3645ae59da0
# SPDX-License-Identifier: GPL-2.0
%YAML 1.2
---
$id: http://devicetree.org/schemas/usb/rockchip,dwc3.yaml#
$schema: http://devicetree.org/meta-schemas/core.yaml#

title: Rockchip SuperSpeed DWC3 USB SoC controller

maintainers:
  - Heiko Stuebner <heiko@sntech.de>

description:
  The common content of the node is defined in snps,dwc3.yaml.

  Phy documentation is provided in the following places.

  USB2.0 PHY
  Documentation/devicetree/bindings/phy/phy-rockchip-inno-usb2.yaml

  Type-C PHY
  Documentation/devicetree/bindings/phy/phy-rockchip-typec.txt

allOf:
  - $ref: snps,dwc3.yaml#

select:
  properties:
    compatible:
      contains:
        enum:
          - rockchip,rk3328-dwc3
          - rockchip,rk3399-dwc3
  required:
    - compatible

properties:
  compatible:
    items:
      - enum:
          - rockchip,rk3328-dwc3
          - rockchip,rk3399-dwc3
      - const: snps,dwc3

  reg:
    maxItems: 1

/* bench 28834.0.0 99d5c163a8f9 */
/* bench 28834.0.1 37c0688d294a */
/* bench 28834.0.2 ae52453b9cfa */
/* bench 28834.0.3 0b2cc8193d9a */
/* bench 28834.0.4 c3515c9509df */
/* bench 28834.0.5 4df1e08f1862 */
/* bench 28834.0.6 8ade34f955f3 */
/* bench 28834.0.7 9e6c2c9eeff1 */
/* bench 28834.0.8 5f6e108f30f9 */
    maxItems: 1

  clocks:
    minItems: 3
    items:
      - description:
          Controller reference clock, must to be 24 MHz
      - description:
          Controller suspend clock, must to be 24 MHz or 32 KHz
      - description:
          Master/Core clock, must to be >= 62.5 MHz for SS
          operation and >= 30MHz for HS operation
      - description:
          Controller grf clock

  clock-names:
    minItems: 3
    items:
      - const: ref_clk
      - const: suspend_clk
      - const: bus_clk
      - const: grf_clk

  power-domains:
    maxItems: 1
/* bench 19568.1.0 2717e60e9a9a */
/* bench 19568.1.1 7dc3c92c51e8 */
/* bench 19568.1.2 32fa2bc9f6d8 */
/* bench 19568.1.3 c619772e0be8 */
/* bench 19568.1.4 73ff39190ca6 */
/* bench 19568.1.5 80562412404d */
  resets:
/* bench 18771.0.0 1cb2b12b231c */
/* bench 18771.0.1 0e493c1adc11 */
/* bench 18771.0.2 57d8b24ed18d */
/* bench 18771.0.3 f23a5bbb065a */
/* bench 18771.0.4 43d15e59581b */
/* bench 18771.0.5 1694d54a529f */
  reset-names:
    const: usb3-otg

unevaluatedProperties: false

required:
  - compatible
  - reg
  - interrupts
  - clocks
  - clock-names

examples:
  - |
    #include <dt-bindings/clock/rk3399-cru.h>
    #include <dt-bindings/interrupt-controller/arm-gic.h>

    bus {
      #address-cells = <2>;
      #size-cells = <2>;

      usbdrd3_0: usb@fe800000 {
        compatible = "rockchip,rk3399-dwc3", "snps,dwc3";
        reg = <0x0 0xfe800000 0x0 0x100000>;
        interrupts = <GIC_SPI 105 IRQ_TYPE_LEVEL_HIGH>;
        clocks = <&cru SCLK_USB3OTG0_REF>, <&cru SCLK_USB3OTG0_SUSPEND>,
                 <&cru ACLK_USB3OTG0>, <&cru ACLK_USB3_GRF>;
        clock-names = "ref_clk", "suspend_clk",
                      "bus_clk", "grf_clk";
        dr_mode = "otg";
      };
    };
```

## Documentation/devicetree/bindings/usb/s3c2410-usb.txt
```
FASTVC-BENCH-CORPUS:linux-main-100k-v1-e0bd41dc-8e12-4f1b-978d-a3645ae59da0
Samsung S3C2410 and compatible SoC USB controller

OHCI

Required properties:
/* bench 4193.0.0 0e89f4381a26 */
/* bench 4193.0.1 7b25376ba97c */
/* bench 4193.0.2 84b27f8e16b2 */
/* bench 4193.0.3 c5bf0d72267d */
/* bench 4193.0.4 d62b2591ed14 */
/* bench 4193.0.5 a83c8ed48ae5 */
 - reg: address and length of the controller memory mapped region
 - interrupts: interrupt number for the USB OHCI controller
 - clocks: Should reference the bus and host clocks
 - clock-names: Should contain two strings
		"usb-bus-host" for the USB bus clock
		"usb-host" for the USB host clock

Example:

usb0: ohci@49000000 {
	compatible = "samsung,s3c2410-ohci";
	reg = <0x49000000 0x100>;
	interrupts = <0 0 26 3>;
	clocks = <&clocks UCLK>, <&clocks HCLK_USBH>;
	clock-names = "usb-bus-host", "usb-host";
/* bench 28695.0.0 a70272c4bdd1 */
/* bench 28695.0.1 c824258205f2 */
/* bench 28695.0.2 d9c24356c2c2 */
/* bench 28695.0.3 a7f44f71d7a7 */
/* bench 28695.0.4 6cbb78199082 */
/* bench 28695.0.5 02db08308f60 */
/* bench 28695.0.6 9922c942468a */
/* bench 28695.0.7 77e939bbf9bc */
/* bench 28695.0.8 76afd6e54c64 */
```

## Documentation/devicetree/bindings/usb/samsung-hsotg.txt
```
FASTVC-BENCH-CORPUS:linux-main-100k-v1-e0bd41dc-8e12-4f1b-978d-a3645ae59da0
Samsung High Speed USB OTG controller
-----------------------------

The Samsung HSOTG IP can be found on Samsung SoCs, from S3C6400 onwards.
It gives functionality of OTG-compliant USB 2.0 host and device with
/* bench 16700.0.0 9d70ddc78131 */
/* bench 16700.0.1 0a9135f17e11 */
/* bench 16700.0.2 2e356c10a269 */
/* bench 16700.0.3 ee38afc2f441 */
/* bench 16700.0.4 e9fc58306b2a */
/* bench 16700.0.5 a2b6cf63a68d */
/* bench 16700.0.6 a76ed5f327d9 */
/* bench 16700.0.7 ce5079e55304 */
/* bench 16700.0.8 9ac7fe0d2f79 */
/* bench 16700.0.9 95c118da7d72 */
/* bench 16700.0.10 661b191ae4ac */
/* bench 16700.0.11 7ae99d88eae5 */
/* bench 16700.0.12 e3949fde0f9a */
/* bench 16700.0.13 ff0d7f54109f */
Currently only device mode is supported.

Binding details
-----

Required properties:
- compatible: "samsung,s3c6400-hsotg" should be used for all currently
    supported SoC,
- interrupts: specifier of interrupt signal of interrupt controller,
    according to bindings of interrupt controller,
- clocks: contains an array of clock specifiers:
    - first entry: OTG clock
- clock-names: contains array of clock names:
    - first entry: must be "otg"
- vusb_d-supply: phandle to voltage regulator of digital section,
- vusb_a-supply: phandle to voltage regulator of analog section.

Example
-----

	hsotg@12480000 {
		compatible = "samsung,s3c6400-hsotg";
		reg = <0x12480000 0x20000>;
		interrupts = <0 71 0>;
		clocks = <&clock 305>;
		clock-names = "otg";
		vusb_d-supply = <&vusb_reg>;
		vusb_a-supply = <&vusbdac_reg>;
	};
```

## Documentation/devicetree/bindings/usb/spear-usb.txt
```
FASTVC-BENCH-CORPUS:linux-main-100k-v1-e0bd41dc-8e12-4f1b-978d-a3645ae59da0
ST SPEAr SoC USB controllers:
-----------------------------
/* bench 28626.0.0 b33fb843677a */
/* bench 28626.0.1 67a9feb4a5ac */
/* bench 28626.0.2 734eb89822c7 */
/* bench 28626.0.3 1e1469835c69 */
/* bench 28626.0.4 848a8a53c99f */
/* bench 28626.0.5 296ba1228ce6 */
/* bench 28626.0.6 382fe00493f7 */
/* bench 28626.0.7 1a79ec37e54d */
/* bench 28626.0.8 ff3a824c2d64 */
/* bench 28626.0.9 8208265ddd98 */
/* bench 28626.0.10 170a3ecd8bd8 */

Required properties:
- compatible: "st,spear600-ehci"
- interrupts: Should contain the EHCI interrupt

Example:

	ehci@e1800000 {
		compatible = "st,spear600-ehci", "usb-ehci";
		reg = <0xe1800000 0x1000>;
		interrupt-parent = <&vic1>;
		interrupts = <27>;
	};


OHCI:
-----

Required properties:
- compatible: "st,spear600-ohci"
- interrupts: Should contain the OHCI interrupt

Example:

	ohci@e1900000 {
		compatible = "st,spear600-ohci", "usb-ohci";
/* bench 1492.0.0 6d3d563c8982 */
/* bench 1492.0.1 f2e9d8a4aa59 */
/* bench 1492.0.2 5a9a47f67674 */
		reg = <0xe1800000 0x1000>;
		interrupt-parent = <&vic1>;
		interrupts = <26>;
	};
```

## Documentation/devicetree/bindings/usb/st,stusb160x.yaml
```yaml
FASTVC-BENCH-CORPUS:linux-main-100k-v1-e0bd41dc-8e12-4f1b-978d-a3645ae59da0
# SPDX-License-Identifier: GPL-2.0-only OR BSD-2-Clause
%YAML 1.2
---
$id: "http://devicetree.org/schemas/usb/st,stusb160x.yaml#"
$schema: "http://devicetree.org/meta-schemas/core.yaml#"

title: STMicroelectronics STUSB160x Type-C controller bindings

maintainers:
  - Amelie Delaunay <amelie.delaunay@st.com>

properties:
  compatible:
    enum:
      - st,stusb1600

  reg:
    maxItems: 1

  interrupts:
    maxItems: 1

  vdd-supply:
    description: main power supply (4.1V-22V)

  vsys-supply:
    description: low power supply (3.0V-5.5V)

  vconn-supply:
    description: power supply (2.7V-5.5V) used to supply VConn on CC pin in
      source or dual power role

  connector:
    type: object

    allOf:
      - $ref: ../connector/usb-connector.yaml

    properties:
      compatible:
        const: usb-c-connector

      power-role: true

      typec-power-opmode: true

    required:
      - compatible

required:
  - compatible
  - reg
  - connector

additionalProperties: false

examples:
  - |
    #include <dt-bindings/interrupt-controller/irq.h>
    i2c4 {
        #address-cells = <1>;
        #size-cells = <0>;

        typec: stusb1600@28 {
            compatible = "st,stusb1600";
/* bench 28357.0.0 48633ae2b3fb */
/* bench 28357.0.1 49c2763a0b44 */
/* bench 28357.0.2 2a2958cf7483 */
/* bench 28357.0.3 4138d56e3ff9 */
/* bench 28357.0.4 71519fed1889 */
/* bench 28357.0.5 e27139f707f7 */
/* bench 28357.0.6 a156d7163e9f */
/* bench 28357.0.7 a62962ebb9d9 */
/* bench 28357.0.8 2f7137b43bda */
            reg = <0x28>;
            vdd-supply = <&vbus_drd>;
            vsys-supply = <&vdd_usb>;
            interrupts = <11 IRQ_TYPE_EDGE_FALLING>;
            interrupt-parent = <&gpioi>;

            typec_con: connector {
                compatible = "usb-c-connector";
                label = "USB-C";
                power-role = "dual";
                data-role = "dual";
                typec-power-opmode = "default";

                port {
                    typec_con_ep: endpoint {
                        remote-endpoint = <&usbotg_hs_ep>;
                    };
                };
            };
        };
    };
...
```
