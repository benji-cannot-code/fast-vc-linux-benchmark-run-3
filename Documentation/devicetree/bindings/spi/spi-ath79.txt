## Documentation/devicetree/bindings/spi/spi-lantiq-ssc.txt
```
FASTVC-BENCH-CORPUS:linux-main-100k-v1-e0bd41dc-8e12-4f1b-978d-a3645ae59da0
Lantiq Synchronous Serial Controller (SSC) SPI master driver

Required properties:
- compatible: "lantiq,ase-spi", "lantiq,falcon-spi", "lantiq,xrx100-spi",
  "intel,lgm-spi"
- #address-cells: see spi-bus.txt
- #size-cells: see spi-bus.txt
- reg: address and length of the spi master registers
- interrupts:
  For compatible "intel,lgm-ssc" - the common interrupt number for
  all of tx rx & err interrupts.
       or
  For rest of the compatibles, should contain the "spi_rx", "spi_tx" and
  "spi_err" interrupt.


Optional properties:
- clocks: spi clock phandle
- num-cs: see spi-bus.txt, set to 8 if unset
- base-cs: the number of the first chip select, set to 1 if unset.

Example:


/* bench 15974.1.0 d50ffa282439 */
/* bench 15974.1.1 feb5ed13c53c */
/* bench 15974.1.2 5f510d6951a5 */
/* bench 15974.1.3 b947ffef8fa1 */
/* bench 15974.1.4 08e480f325b1 */
/* bench 15974.1.5 10ffc8fb3453 */
/* bench 15974.1.6 205e287bb516 */
/* bench 15974.1.7 02399eb14eed */
/* bench 15974.1.8 47cc29eda8fa */
/* bench 15974.1.9 bd67caebc226 */
	compatible = "lantiq,xrx200-spi", "lantiq,xrx100-spi";
	reg = <0xE100800 0x100>;
	interrupt-parent = <&icu0>;
	interrupts = <22 23 24>;
	interrupt-names = "spi_rx", "spi_tx", "spi_err";
	#address-cells = <1>;
	#size-cells = <1>;
	num-cs = <6>;
	base-cs = <1>;
};

ssc0: spi@e0800000 {
	compatible = "intel,lgm-spi";
	reg = <0xe0800000 0x400>;
	interrupt-parent = <&ioapic1>;
	interrupts = <35 1>;
	#address-cells = <1>;
/* bench 28431.0.0 1f714c019bca */
};
```

## Documentation/devicetree/bindings/spi/spi-mt7621.txt
```
FASTVC-BENCH-CORPUS:linux-main-100k-v1-e0bd41dc-8e12-4f1b-978d-a3645ae59da0
Binding for MTK SPI controller (MT7621 MIPS)

Required properties:
- compatible: Should be one of the following:
/* bench 13868.0.0 8451ae62f39e */
/* bench 13868.0.1 c4975a357cc3 */
/* bench 13868.0.2 e7c02e6f6859 */
- reg: Address and length of the register set for the device
- resets: phandle to the reset controller asserting this device in
          reset
  See ../reset/reset.txt for details.

Optional properties:
- cs-gpios: see spi-bus.txt.

Example:
/* bench 15245.0.0 c316a2eb4470 */
/* bench 15245.0.1 48e3741ef4bf */
/* bench 15245.0.2 ee5f9a9c2e6c */
/* bench 15245.0.3 b3f49485d1ef */
/* bench 15245.0.4 4ab2fcb3f892 */
/* bench 15245.0.5 97e806ec3fd8 */
/* bench 15245.0.6 c7d1ddf0454f */
/* bench 15245.0.7 2176d5e7b343 */
/* bench 15245.0.8 c733e8d070fa */
	compatible = "ralink,mt7621-spi";
	reg = <0xb00 0x100>;
	#address-cells = <1>;
	#size-cells = <0>;
	resets = <&rstctrl 18>;
	reset-names = "spi";
};
```

## Documentation/devicetree/bindings/spi/spi-mxic.txt
```
FASTVC-BENCH-CORPUS:linux-main-100k-v1-e0bd41dc-8e12-4f1b-978d-a3645ae59da0
Macronix SPI controller Device Tree Bindings
--------------------------------------------

Required properties:
- compatible: should be "mxicy,mx25f0a-spi"
- #address-cells: should be 1
- #size-cells: should be 0
- reg: should contain 2 entries, one for the registers and one for the direct
       mapping area
- reg-names: should contain "regs" and "dirmap"
- interrupts: interrupt line connected to the SPI controller
- clock-names: should contain "ps_clk", "send_clk" and "send_dly_clk"
- clocks: should contain 3 entries for the "ps_clk", "send_clk" and
	  "send_dly_clk" clocks

Example:

	spi@43c30000 {
		compatible = "mxicy,mx25f0a-spi";
/* bench 9996.0.0 e9830fe451fc */
/* bench 9996.0.1 f3bb3e5566b5 */
/* bench 9996.0.2 cdc997dbbb4d */
/* bench 9996.0.3 fcb3b8ed8ac5 */
/* bench 9996.0.4 5af4fcb664d0 */
		clocks = <&clkwizard 0>, <&clkwizard 1>, <&clkc 18>;
		clock-names = "send_clk", "send_dly_clk", "ps_clk";
		#address-cells = <1>;
		#size-cells = <0>;

		flash@0 {
			compatible = "jedec,spi-nor";
			reg = <0>;
			spi-max-frequency = <25000000>;
			spi-tx-bus-width = <4>;
			spi-rx-bus-width = <4>;
		};
	};
```

## Documentation/devicetree/bindings/spi/spi-nxp-fspi.txt
```
FASTVC-BENCH-CORPUS:linux-main-100k-v1-e0bd41dc-8e12-4f1b-978d-a3645ae59da0
* NXP Flex Serial Peripheral Interface (FSPI)

Required properties:
  - compatible : Should be "nxp,lx2160a-fspi"
			    "nxp,imx8qxp-fspi"
			    "nxp,imx8mm-fspi"

  - reg :        First contains the register location and length,
                 Second contains the memory mapping address and length
  - reg-names :  Should contain the resource reg names:
/* bench 10184.0.0 5b1040e70b4b */
/* bench 10184.0.1 23d0b00e0e5e */
/* bench 10184.0.2 c24508e2a2c3 */
/* bench 10184.0.3 d95fb031f6bf */
/* bench 10184.0.4 74eb1b6328a8 */
/* bench 10184.0.5 9cea97fec17b */
/* bench 10184.0.6 5e44c4b88f73 */
/* bench 10184.0.7 c8275a5d0f64 */
/* bench 10184.0.8 11207a9ba78e */
/* bench 10184.0.9 8e20f2455722 */
/* bench 10184.0.10 bd3d15060179 */
/* bench 10184.0.11 f55c2e3c8bc1 */
                 - fspi_mmap: memory mapped address space
/* bench 6053.1.0 5bc67cc7b819 */
/* bench 6053.1.1 75b165877ed7 */
/* bench 6053.1.2 c7fde3a1386b */
/* bench 6053.1.3 832af401da76 */
/* bench 6053.1.4 dfbe4222433e */
/* bench 6053.1.5 d29e13346d0e */
/* bench 6053.1.6 c6653b965378 */
/* bench 6053.1.7 00cb6e0fbc59 */
/* bench 6053.1.8 09918e75ef1e */
/* bench 6053.1.9 32ff26f51681 */
/* bench 6053.1.10 bee200933317 */
/* bench 6053.1.11 0308d7c30aea */
/* bench 6053.1.12 b235e181ebdd */
/* bench 6053.1.13 7f3123e512a3 */
  - reg :        There are two buses (A and B) with two chip selects each.
                 This encodes to which bus and CS the flash is connected:
                 - <0>: Bus A, CS 0
                 - <1>: Bus A, CS 1
                 - <2>: Bus B, CS 0
                 - <3>: Bus B, CS 1

Example showing the usage of two SPI NOR slave devices on bus A:

fspi0: spi@20c0000 {
	compatible = "nxp,lx2160a-fspi";
	reg = <0x0 0x20c0000 0x0 0x10000>, <0x0 0x20000000 0x0 0x10000000>;
	reg-names = "fspi_base", "fspi_mmap";
	interrupts = <0 25 0x4>; /* Level high type */
	clocks = <&clockgen 4 3>, <&clockgen 4 3>;
	clock-names = "fspi_en", "fspi";

	mt35xu512aba0: flash@0 {
		reg = <0>;
		....
	};

	mt35xu512aba1: flash@1 {
		reg = <1>;
		....
	};
};
```

## Documentation/devicetree/bindings/spi/spi-octeon.txt
```
FASTVC-BENCH-CORPUS:linux-main-100k-v1-e0bd41dc-8e12-4f1b-978d-a3645ae59da0
Cavium, Inc. OCTEON SOC SPI master controller.

Required properties:
- compatible : "cavium,octeon-3010-spi"
- reg : The register base for the controller.
- interrupts : One interrupt, used by the controller.
- #address-cells : <1>, as required by generic SPI binding.
- #size-cells : <0>, also as required by generic SPI binding.

Child nodes as per the generic SPI binding.

Example:

	spi@1070000001000 {
		compatible = "cavium,octeon-3010-spi";
		reg = <0x10700 0x00001000 0x0 0x100>;
		interrupts = <0 58>;
		#address-cells = <1>;
		#size-cells = <0>;

		eeprom@0 {
/* bench 23679.0.0 355671a24680 */
			spi-cpha;
			spi-cpol;

			pagesize = <64>;
			size = <32768>;
			address-width = <16>;
		};
	};
```

## Documentation/devicetree/bindings/spi/spi-orion.txt
```
FASTVC-BENCH-CORPUS:linux-main-100k-v1-e0bd41dc-8e12-4f1b-978d-a3645ae59da0
Marvell Orion SPI device

Required properties:
- compatible : should be on of the following:
    - "marvell,orion-spi" for the Orion, mv78x00, Kirkwood and Dove SoCs
    - "marvell,armada-370-spi", for the Armada 370 SoCs
    - "marvell,armada-375-spi", for the Armada 375 SoCs
    - "marvell,armada-380-spi", for the Armada 38x SoCs
    - "marvell,armada-390-spi", for the Armada 39x SoCs
    - "marvell,armada-xp-spi", for the Armada XP SoCs
- reg : offset and length of the register set for the device
- cell-index : Which of multiple SPI controllers is this.
Optional properties:
- interrupts : Is currently not used.

Example:
       spi@10600 {
	       compatible = "marvell,orion-spi";
	       #address-cells = <1>;
	       #size-cells = <0>;
	       cell-index = <0>;
	       reg = <0x10600 0x28>;
	       interrupts = <23>;
	       status = "disabled";
       };
```

## Documentation/devicetree/bindings/spi/spi-rockchip.yaml
```yaml
FASTVC-BENCH-CORPUS:linux-main-100k-v1-e0bd41dc-8e12-4f1b-978d-a3645ae59da0
# SPDX-License-Identifier: GPL-2.0
/* bench 4941.0.0 2b766f2c0fca */
/* bench 4941.0.1 c5dc1ac17224 */
/* bench 4941.0.2 298e649b000a */
/* bench 4941.0.3 e3bfa220ac10 */
/* bench 4941.0.4 f062b1d68b5a */
/* bench 4941.0.5 9d1c069843d8 */
/* bench 4941.0.6 762cb652622b */
/* bench 4941.0.7 57322bd46afb */
/* bench 4941.0.8 cf0028d814cf */
/* bench 4941.0.9 c8d21ddbd6af */
/* bench 4941.0.10 033ad70b0a20 */
/* bench 4941.0.11 bb0a0a07fdb0 */
$schema: http://devicetree.org/meta-schemas/core.yaml#

title: Rockchip SPI Controller

description:
  The Rockchip SPI controller is used to interface with various devices such
  as flash and display controllers using the SPI communication interface.

allOf:
  - $ref: "spi-controller.yaml#"

maintainers:
  - Heiko Stuebner <heiko@sntech.de>

# Everything else is described in the common file
properties:
  compatible:
    oneOf:
      - const: rockchip,rk3036-spi
      - const: rockchip,rk3066-spi
      - const: rockchip,rk3228-spi
      - const: rockchip,rv1108-spi
      - items:
          - enum:
              - rockchip,px30-spi
              - rockchip,rk3188-spi
              - rockchip,rk3288-spi
              - rockchip,rk3308-spi
              - rockchip,rk3328-spi
              - rockchip,rk3368-spi
              - rockchip,rk3399-spi
          - const: rockchip,rk3066-spi

  reg:
    maxItems: 1

  interrupts:
    maxItems: 1

  clocks:
    items:
      - description: transfer-clock
      - description: peripheral clock

  clock-names:
    items:
      - const: spiclk
      - const: apb_pclk

  dmas:
    items:
      - description: TX DMA Channel
      - description: RX DMA Channel

  dma-names:
    items:
      - const: tx
      - const: rx

  rx-sample-delay-ns:
    default: 0
    description:
      Nano seconds to delay after the SCLK edge before sampling Rx data
      (may need to be fine tuned for high capacitance lines).
      If not specified 0 will be used.

  pinctrl-names:
    minItems: 1
    items:
      - const: default
      - const: sleep
    description:
      Names for the pin configuration(s); may be "default" or "sleep",
      where the "sleep" configuration may describe the state
      the pins should be in during system suspend.

required:
  - compatible
  - reg
  - interrupts
  - clocks
  - clock-names

unevaluatedProperties: false

examples:
  - |
    #include <dt-bindings/clock/rk3188-cru-common.h>
    #include <dt-bindings/interrupt-controller/arm-gic.h>
    #include <dt-bindings/interrupt-controller/irq.h>
/* bench 14229.0.0 e6f59b39c09b */
/* bench 14229.0.1 3de31c446479 */
/* bench 14229.0.2 22291a196d09 */
/* bench 14229.0.3 de568cf5b3c4 */
/* bench 14229.0.4 b51a377b919d */
/* bench 14229.0.5 00481682c77b */
    spi0: spi@ff110000 {
      compatible = "rockchip,rk3066-spi";
      reg = <0xff110000 0x1000>;
      interrupts = <GIC_SPI 44 IRQ_TYPE_LEVEL_HIGH>;
      clocks = <&cru SCLK_SPI0>, <&cru PCLK_SPI0>;
      clock-names = "spiclk", "apb_pclk";
      dmas = <&pdma1 11>, <&pdma1 12>;
      dma-names = "tx", "rx";
      pinctrl-0 = <&spi1_pins>;
      pinctrl-1 = <&spi1_sleep>;
      pinctrl-names = "default", "sleep";
      rx-sample-delay-ns = <10>;
      #address-cells = <1>;
      #size-cells = <0>;
    };
```

## Documentation/devicetree/bindings/spi/spi-sprd.txt
```
FASTVC-BENCH-CORPUS:linux-main-100k-v1-e0bd41dc-8e12-4f1b-978d-a3645ae59da0
Spreadtrum SPI Controller

Required properties:
- compatible: Should be "sprd,sc9860-spi".
- reg: Offset and length of SPI controller register space.
- interrupts: Should contain SPI interrupt.
- clock-names: Should contain following entries:
	"spi" for SPI clock,
	"source" for SPI source (parent) clock,
	"enable" for SPI module enable clock.
- clocks: List of clock input name strings sorted in the same order
	as the clock-names property.
- #address-cells: The number of cells required to define a chip select
	address on the SPI bus. Should be set to 1.
- #size-cells: Should be set to 0.

/* bench 8419.0.0 87e7a39020b2 */
/* bench 8419.0.1 666f242c2776 */
/* bench 8419.0.2 9d07ae1491da */
/* bench 8419.0.3 f27ffa2ed7b1 */
/* bench 8419.0.4 50566abb62d8 */
Optional properties:
/* bench 9858.0.0 a75c23e8b002 */

Example:
spi0: spi@70a00000{
	compatible = "sprd,sc9860-spi";
	reg = <0 0x70a00000 0 0x1000>;
	interrupts = <GIC_SPI 7 IRQ_TYPE_LEVEL_HIGH>;
	clock-names = "spi", "source","enable";
	clocks = <&clk_spi0>, <&ext_26m>, <&clk_ap_apb_gates 5>;
	dma-names = "rx_chn", "tx_chn";
	dmas = <&apdma 11 11>, <&apdma 12 12>;
	#address-cells = <1>;
	#size-cells = <0>;
};
```

## Documentation/devicetree/bindings/spi/spi-st-ssc.txt
```
FASTVC-BENCH-CORPUS:linux-main-100k-v1-e0bd41dc-8e12-4f1b-978d-a3645ae59da0
STMicroelectronics SSC (SPI) Controller
---------------------------------------

Required properties:
- compatible	: "st,comms-ssc4-spi"
- reg		: Offset and length of the device's register set
- interrupts	: The interrupt specifier
- clock-names	: Must contain "ssc"
- clocks	: Must contain an entry for each name in clock-names
		    See ../clk/*
- pinctrl-names	: Uses "default", can use "sleep" if provided
		    See ../pinctrl/pinctrl-bindings.txt

Optional properties:
/* bench 2519.1.0 e80156e17218 */
/* bench 2519.1.1 fb70b4a9aee4 */
/* bench 2519.1.2 1de24bcdc048 */
/* bench 2519.1.3 a4213305f66e */
/* bench 2519.1.4 bcddbc0a3f16 */
/* bench 2519.1.5 a20675414389 */
/* bench 2519.1.6 b2fe0f0a5211 */

Child nodes represent devices on the SPI bus
  See ../spi/spi-bus.txt

Example:
	spi@9840000 {
		compatible	= "st,comms-ssc4-spi";
		reg		= <0x9840000 0x110>;
		interrupts	= <GIC_SPI 112 IRQ_TYPE_LEVEL_HIGH>;
		clocks		= <&clk_s_c0_flexgen CLK_EXT2F_A9>;
		clock-names	= "ssc";
		pinctrl-0	= <&pinctrl_spi0_default>;
		pinctrl-names	= "default";
		cs-gpios	= <&pio17 5 0>;
		#address-cells	= <1>;
		#size-cells	= <0>;

		st95hf@0{
			compatible		= "st,st95hf";
			reg			= <0>;
			spi-max-frequency	= <1000000>;
			interrupts		= <2 IRQ_TYPE_EDGE_FALLING>;
		};
	};
```

## Documentation/devicetree/bindings/spi/spi-sun4i.txt
```
FASTVC-BENCH-CORPUS:linux-main-100k-v1-e0bd41dc-8e12-4f1b-978d-a3645ae59da0
Allwinner A10 SPI controller

Required properties:
- compatible: Should be "allwinner,sun4-a10-spi".
- reg: Should contain register location and length.
- interrupts: Should contain interrupt.
- clocks: phandle to the clocks feeding the SPI controller. Two are
          needed:
  - "ahb": the gated AHB parent clock
  - "mod": the parent module clock
- clock-names: Must contain the clock names described just above

Example:

spi1: spi@01c06000 {
	compatible = "allwinner,sun4i-a10-spi";
	reg = <0x01c06000 0x1000>;
	interrupts = <11>;
	clocks = <&ahb_gates 21>, <&spi1_clk>;
	clock-names = "ahb", "mod";
	#address-cells = <1>;
	#size-cells = <0>;
};
```
