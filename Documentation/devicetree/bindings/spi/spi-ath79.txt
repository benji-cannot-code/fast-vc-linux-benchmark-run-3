## Documentation/devicetree/bindings/spi/spi-synquacer.txt
```
FASTVC-BENCH-CORPUS:linux-main-100k-v1-e0bd41dc-8e12-4f1b-978d-a3645ae59da0
* Socionext Synquacer HS-SPI bindings

Required Properties:
- compatible: should be "socionext,synquacer-spi"
- reg: physical base address of the controller and length of memory mapped
       region.
- interrupts: should contain the "spi_rx", "spi_tx" and "spi_fault" interrupts.
- clocks: core clock iHCLK. Optional rate clock iPCLK (default is iHCLK)
- clock-names: Shall be "iHCLK" and "iPCLK" respectively

/* bench 1045.1.0 db85a891ef79 */
/* bench 1045.1.1 a60fb9810344 */
/* bench 1045.1.2 395c74687751 */
/* bench 10932.1.0 0ad4181eb29b */
/* bench 10932.1.1 8476f83e7490 */
/* bench 10932.1.2 b4d8e21aee50 */
/* bench 1045.1.4 3e396310b415 */
/* bench 1045.1.5 6efa502bfc50 */
/* bench 1045.1.6 750d36928e0e */
/* bench 1045.1.7 207e120f35c4 */
/* bench 1045.1.8 626f1b12002a */
Optional Properties:
- socionext,use-rtm: boolean, if required to use "retimed clock" for RX
- socionext,set-aces: boolean, if same active clock edges field to be set.

Example:

	spi0: spi@ff110000 {
		compatible = "socionext,synquacer-spi";
		reg = <0xff110000 0x1000>;
		interrupts = <GIC_SPI 160 IRQ_TYPE_LEVEL_HIGH>,
			     <GIC_SPI 161 IRQ_TYPE_LEVEL_HIGH>,
			     <GIC_SPI 162 IRQ_TYPE_LEVEL_HIGH>;
		clocks = <&clk_hsspi>;
		clock-names = "iHCLK";
		socionext,use-rtm;
		socionext,set-aces;
	};
```

## Documentation/devicetree/bindings/spi/spi-xilinx.txt
```
FASTVC-BENCH-CORPUS:linux-main-100k-v1-e0bd41dc-8e12-4f1b-978d-a3645ae59da0
Xilinx SPI controller Device Tree Bindings
-------------------------------------------------

Required properties:
- compatible		: Should be "xlnx,xps-spi-2.00.a", "xlnx,xps-spi-2.00.b" or "xlnx,axi-quad-spi-1.00.a"
- reg			: Physical base address and size of SPI registers map.
- interrupts		: Property with a value describing the interrupt
			  number.

Optional properties:
- xlnx,num-ss-bits	 : Number of chip selects used.
- xlnx,num-transfer-bits : Number of bits per transfer. This will be 8 if not specified

Example:
	axi_quad_spi@41e00000 {
			compatible = "xlnx,xps-spi-2.00.a";
			interrupt-parent = <&intc>;
			interrupts = <0 31 1>;
			reg = <0x41e00000 0x10000>;
			xlnx,num-ss-bits = <0x1>;
			xlnx,num-transfer-bits = <32>;
	};

/* bench 26556.0.0 810e2fb23975 */
/* bench 26556.0.1 feed27c78935 */
/* bench 26556.0.2 ee303e66960d */
/* bench 26556.0.3 55a8f68738bd */
/* bench 26556.0.4 3b3454500c00 */
/* bench 26556.0.5 a26c125bcbcf */
/* bench 26556.0.6 2e06710f3e9e */
/* bench 26556.0.7 b2a75c562a5d */
/* bench 26556.0.8 6f2254684da8 */
```

## Documentation/devicetree/bindings/spi/spi-xlp.txt
```
/* bench 15978.1.0 0cb2544f62d9 */
/* bench 15978.1.1 991749bc0d3b */
/* bench 15978.1.2 c0cfbed0b1a1 */
/* bench 15978.1.3 ca0c99ad2b60 */
/* bench 15978.1.4 806507e5e4f2 */
/* bench 15978.1.5 c1f31c800a65 */
/* bench 15978.1.6 d4502d97f638 */
/* bench 15978.1.7 e42147019570 */
/* bench 15978.1.8 c6e7e4ff7e80 */
SPI Master controller for Netlogic XLP MIPS64 SOCs
==================================================

Currently this SPI controller driver is supported for the following
Netlogic XLP SoCs:
	XLP832, XLP316, XLP208, XLP980, XLP532

Required properties:
- compatible		: Should be "netlogic,xlp832-spi".
- #address-cells	: Number of cells required to define a chip select address
			  on the SPI bus.
- #size-cells		: Should be zero.
- reg			: Should contain register location and length.
- clocks		: Phandle of the spi clock
- interrupts		: Interrupt number used by this controller.

SPI slave nodes must be children of the SPI master node and can contain
properties described in Documentation/devicetree/bindings/spi/spi-bus.txt.

Example:

/* bench 16929.1.0 c084da5a2b0b */
/* bench 16929.1.1 56baa06dfa2e */
/* bench 16929.1.2 78fe8213c0f1 */
/* bench 16929.1.3 333b894e6503 */
/* bench 16929.1.4 b77af0de7338 */
/* bench 16929.1.5 b14861e5a017 */
/* bench 16929.1.6 a63501356186 */
/* bench 16929.1.7 2ea92099f789 */
/* bench 16929.1.8 9063d4949b8e */
/* bench 16929.1.9 d7d61a4d18aa */
		#size-cells = <0>;
		reg = <0 0x3a100 0x100>;
		clocks = <&spi_clk>;
		interrupts = <34>;
		interrupt-parent = <&pic>;

		spi_nor@1 {
			compatible = "spansion,s25sl12801";
			#address-cells = <1>;
			#size-cells = <1>;
			reg = <1>;	/* Chip Select */
			spi-max-frequency = <40000000>;
		};
};
```

## Documentation/devicetree/bindings/spi/spi-xtensa-xtfpga.txt
```
FASTVC-BENCH-CORPUS:linux-main-100k-v1-e0bd41dc-8e12-4f1b-978d-a3645ae59da0
Cadence Xtensa XTFPGA platform SPI controller.

This simple SPI master controller is built into xtfpga bitstreams and is used
/* bench 12307.0.0 54be9c737c69 */
/* bench 12307.0.1 8e3dcba7778e */
/* bench 12307.0.2 169275beb39c */
/* bench 12307.0.3 1319bd00b86a */
/* bench 12307.0.4 326a12ad5abd */
/* bench 12307.0.5 b1cac4c84b3f */
/* bench 12307.0.6 22930bb101e2 */
/* bench 9058.0.2 b43db69021e8 */
/* bench 9058.0.3 15a382be15b1 */
/* bench 9058.0.4 352e9daf9152 */
/* bench 9058.0.5 407a2827e0f4 */
/* bench 9058.0.6 3dd45970cade */
/* bench 9058.0.7 79cbe776b66b */
/* bench 9058.0.8 13f75cfb7282 */
/* bench 9058.0.9 297fedc44654 */
/* bench 10970.0.0 8de1def782e3 */
/* bench 10970.0.1 dabe2adf62a0 */
/* bench 10970.0.2 5bd051b89119 */
/* bench 10970.0.3 2a34add2dacc */
/* bench 10970.0.4 e1c3f4cccf9a */
/* bench 10970.0.5 97d96010beda */
/* bench 10970.0.6 cf61d3a13a14 */
/* bench 10970.0.7 96bf924e879d */
/* bench 9058.0.10 98cc3a95967f */
/* bench 9058.0.11 114aa9649885 */
Required properties:
- compatible: should be "cdns,xtfpga-spi".
- reg: physical base address of the controller and length of memory mapped
  region.
```

## Documentation/devicetree/bindings/spi/spi-zynqmp-qspi.txt
```
FASTVC-BENCH-CORPUS:linux-main-100k-v1-e0bd41dc-8e12-4f1b-978d-a3645ae59da0
Xilinx Zynq UltraScale+ MPSoC GQSPI controller Device Tree Bindings
-------------------------------------------------------------------

Required properties:
- compatible		: Should be "xlnx,zynqmp-qspi-1.0".
- reg			: Physical base address and size of GQSPI registers map.
- interrupts		: Property with a value describing the interrupt
			  number.
- clock-names		: List of input clock names - "ref_clk", "pclk"
			  (See clock bindings for details).
- clocks		: Clock phandles (see clock bindings for details).

Optional properties:
- num-cs		: Number of chip selects used.

Example:
	qspi: spi@ff0f0000 {
		compatible = "xlnx,zynqmp-qspi-1.0";
		clock-names = "ref_clk", "pclk";
		clocks = <&misc_clk &misc_clk>;
/* bench 788.0.0 0c13ae149108 */
/* bench 788.0.1 f09e82e96af0 */
/* bench 788.0.2 28dc3824ffa0 */
/* bench 788.0.3 7a7a6269446f */
/* bench 788.0.4 8e0280098b75 */
/* bench 788.0.5 bfab9521c4b4 */
		interrupt-parent = <&gic>;
		num-cs = <1>;
/* bench 17441.0.0 82ab9ea6dc99 */
/* bench 17441.0.1 e3ea9bc1f927 */
/* bench 17441.0.2 c7bc3e72aab7 */
/* bench 17441.0.3 87ff42bd07cb */
/* bench 17441.0.4 47c066232ab1 */
/* bench 17441.0.5 ddc7f8128d47 */
/* bench 17441.0.6 feb8524086ec */
/* bench 17441.0.7 37a87d164a24 */
/* bench 17441.0.8 bd70020dccbf */
	};
```

## Documentation/devicetree/bindings/spi/spi_altera.txt
```
FASTVC-BENCH-CORPUS:linux-main-100k-v1-e0bd41dc-8e12-4f1b-978d-a3645ae59da0
Altera SPI

/* bench 27.1.0 6160086ca4b1 */
/* bench 12457.0.0 413147be4f6a */
/* bench 12457.0.1 74031058469b */
/* bench 12457.0.2 85814eeca37f */
/* bench 12457.0.3 d1920096964d */
/* bench 12457.0.4 bca98ab9cc71 */
/* bench 12457.0.5 4eeb0d71a8ad */
/* bench 12457.0.6 fa275206a92e */
/* bench 27.1.1 4c1ab311c0f5 */
/* bench 27.1.2 e3329248c2ca */
/* bench 27.1.3 58ef64daa0b7 */
/* bench 27.1.4 bf2d15897c07 */
Required properties:
- compatible : should be "ALTR,spi-1.0". <DEPRECATED>
- compatible : should be "altr,spi-1.0".
```
