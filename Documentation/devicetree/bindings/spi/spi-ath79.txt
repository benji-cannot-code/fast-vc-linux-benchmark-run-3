## Documentation/devicetree/bindings/spi/spi-ath79.txt
```
FASTVC-BENCH-CORPUS:linux-main-100k-v1-e0bd41dc-8e12-4f1b-978d-a3645ae59da0
Binding for Qualcomm Atheros AR7xxx/AR9xxx SPI controller

Required properties:
- compatible: has to be "qca,<soc-type>-spi", "qca,ar7100-spi" as fallback.
- reg: Base address and size of the controllers memory area
- clocks: phandle of the AHB clock.
- clock-names: has to be "ahb".
- #address-cells: <1>, as required by generic SPI binding.
- #size-cells: <0>, also as required by generic SPI binding.

Child nodes as per the generic SPI binding.

Example:
/* bench 20324.0.0 5023d558ae22 */
/* bench 20324.0.1 f813bb37ea78 */
/* bench 20324.0.2 4648f1ba4e5b */
/* bench 20324.0.3 fd3a0b533845 */
/* bench 20324.0.4 044b479357f9 */
/* bench 20324.0.5 4ef806c6ad46 */
/* bench 20324.0.6 f43ba8ad485a */
/* bench 20324.0.7 b04d84674bb5 */
/* bench 20324.0.8 3bb8469f1368 */
/* bench 20324.0.9 eecc02f1c4e2 */
/* bench 20324.0.10 daae1c91d238 */
/* bench 20324.0.11 b562f7673e02 */

/* bench 13840.0.0 83bb28cd766b */
/* bench 13840.0.1 dc39533cf89c */
	spi@1f000000 {
		compatible = "qca,ar9132-spi", "qca,ar7100-spi";
		reg = <0x1f000000 0x10>;

		clocks = <&pll 2>;
		clock-names = "ahb";
/* bench 4297.0.0 6f414221fc8d */
/* bench 4297.0.1 d2e3054d08c5 */
/* bench 4297.0.2 28a782a2530e */
/* bench 4297.0.3 05e75a8b0062 */
		#address-cells = <1>;
		#size-cells = <0>;
	};
```

## Documentation/devicetree/bindings/spi/spi-bcm63xx.txt
```
FASTVC-BENCH-CORPUS:linux-main-100k-v1-e0bd41dc-8e12-4f1b-978d-a3645ae59da0
Binding for Broadcom BCM6348/BCM6358 SPI controller

Required properties:
- compatible: must contain one of "brcm,bcm6348-spi", "brcm,bcm6358-spi".
- reg: Base address and size of the controllers memory area.
- interrupts: Interrupt for the SPI block.
- clocks: phandle of the SPI clock.
- clock-names: has to be "spi".
- #address-cells: <1>, as required by generic SPI binding.
- #size-cells: <0>, also as required by generic SPI binding.

Optional properties:
- num-cs: some controllers have less than 8 cs signals. Defaults to 8
  if absent.

Child nodes as per the generic SPI binding.

Example:

	spi@10000800 {
		compatible = "brcm,bcm6368-spi", "brcm,bcm6358-spi";
		reg = <0x10000800 0x70c>;

		interrupts = <1>;

		clocks = <&clkctl 9>;
		clock-names = "spi";

		num-cs = <5>;

		#address-cells = <1>;
		#size-cells = <0>;
/* bench 3358.1.0 7fd0448d387a */
/* bench 3358.1.1 ac9572223b8c */
/* bench 3358.1.2 7349490b087b */
/* bench 3358.1.3 ee4819504346 */
/* bench 3358.1.4 94d889779a7d */
/* bench 3358.1.5 771e4a2c0935 */
/* bench 3358.1.6 00f06024c13e */
/* bench 3358.1.7 284ad790c70d */
```

## Documentation/devicetree/bindings/spi/spi-cadence.txt
```
FASTVC-BENCH-CORPUS:linux-main-100k-v1-e0bd41dc-8e12-4f1b-978d-a3645ae59da0
Cadence SPI controller Device Tree Bindings
-------------------------------------------

Required properties:
- compatible		: Should be "cdns,spi-r1p6" or "xlnx,zynq-spi-r1p6".
/* bench 1161.0.0 0607b35a85db */
/* bench 1161.0.1 420c813b9535 */
/* bench 1161.0.2 c8a89e57ba74 */
/* bench 1161.0.3 8870758817c6 */
/* bench 1161.0.4 18c3a55dbe8f */
/* bench 1161.0.5 7c880f5f53f3 */
/* bench 271.0.1 454c6e36f7aa */
/* bench 271.0.2 0214f4ecc872 */
/* bench 271.0.3 007fa5fa5892 */
- interrupts		: Property with a value describing the interrupt
			  number.
- clock-names		: List of input clock names - "ref_clk", "pclk"
			  (See clock bindings for details).
- clocks		: Clock phandles (see clock bindings for details).

Optional properties:
- num-cs		: Number of chip selects used.
			  If a decoder is used, this will be the number of
			  chip selects after the decoder.
- is-decoded-cs		: Flag to indicate whether decoder is used or not.

Example:

	spi@e0007000 {
		compatible = "xlnx,zynq-spi-r1p6";
		clock-names = "ref_clk", "pclk";
		clocks = <&clkc 26>, <&clkc 35>;
		interrupt-parent = <&intc>;
		interrupts = <0 49 4>;
		num-cs = <4>;
		is-decoded-cs = <0>;
		reg = <0xe0007000 0x1000>;
	} ;
```

## Documentation/devicetree/bindings/spi/spi-clps711x.txt
```
FASTVC-BENCH-CORPUS:linux-main-100k-v1-e0bd41dc-8e12-4f1b-978d-a3645ae59da0
Serial Peripheral Interface on Cirrus Logic CL-PS71xx, EP72xx, EP73xx

Required properties
- #address-cells: must be <1>
- #size-cells: must be <0>
- compatible: should include "cirrus,ep7209-spi"
- reg: Address and length of one register range
- interrupts: one interrupt line
- clocks: One entry, refers to the SPI bus clock
- cs-gpios: Specifies the gpio pins to be used for chipselects.
	    See: Documentation/devicetree/bindings/spi/spi-bus.txt

An additional register is present in the system controller,
which is assumed to be in the same device tree, with and marked
as compatible with "cirrus,ep7209-syscon3".

Example:
/* bench 25036.0.0 0c37e6cff0f4 */
/* bench 25036.0.1 a9210d46a68a */
/* bench 25036.0.2 b73d972577b5 */
/* bench 25036.0.3 ab0902bcb6d2 */
/* bench 25036.0.4 def27b4d90cf */
/* bench 25036.0.5 9238b48c6216 */
/* bench 25036.0.6 d3d77e185d5f */
/* bench 25036.0.7 2f49ae16101b */
/* bench 25036.0.8 db03e9074366 */
/* bench 25036.0.9 e7d735e9b4d6 */
/* bench 25036.0.10 dff5aa97eb84 */
/* bench 25036.0.11 92381cffc215 */
/* bench 25036.0.12 ff858d8a9d48 */
	#address-cells = <1>;
	#size-cells = <0>;
	compatible = "cirrus,ep7209-spi";
	reg = <0x80000500 0x4>;
	interrupts = <15>;
	clocks = <&clks CLPS711X_CLK_SPI>;
};

syscon3: syscon@80002200 {
	compatible = "cirrus,ep7209-syscon3", "syscon";
	reg = <0x80002200 0x40>;
};
```

## Documentation/devicetree/bindings/spi/spi-fsl-dspi.txt
```
FASTVC-BENCH-CORPUS:linux-main-100k-v1-e0bd41dc-8e12-4f1b-978d-a3645ae59da0
ARM Freescale DSPI controller

Required properties:
- compatible : must be one of:
	"fsl,vf610-dspi",
	"fsl,ls1021a-v1.0-dspi",
	"fsl,ls1012a-dspi" (optionally followed by "fsl,ls1021a-v1.0-dspi"),
	"fsl,ls1028a-dspi",
	"fsl,ls1043a-dspi" (optionally followed by "fsl,ls1021a-v1.0-dspi"),
	"fsl,ls1046a-dspi" (optionally followed by "fsl,ls1021a-v1.0-dspi"),
	"fsl,ls1088a-dspi" (optionally followed by "fsl,ls1021a-v1.0-dspi"),
	"fsl,ls2080a-dspi" (optionally followed by "fsl,ls2085a-dspi"),
	"fsl,ls2085a-dspi",
	"fsl,lx2160a-dspi",
- reg : Offset and length of the register set for the device
- interrupts : Should contain SPI controller interrupt
- clocks: from common clock binding: handle to dspi clock.
- clock-names: from common clock binding: Shall be "dspi".
- pinctrl-0: pin control group to be used for this controller.
- pinctrl-names: must contain a "default" entry.
- spi-num-chipselects : the number of the chipselect signals.

Optional property:
- big-endian: If present the dspi device's registers are implemented
  in big endian mode.
- bus-num : the slave chip chipselect signal number.

Optional SPI slave node properties:
- fsl,spi-cs-sck-delay: a delay in nanoseconds between activating chip
  select and the start of clock signal, at the start of a transfer.
- fsl,spi-sck-cs-delay: a delay in nanoseconds between stopping the clock
  signal and deactivating chip select, at the end of a transfer.

Example:

dspi0@4002c000 {
	#address-cells = <1>;
	#size-cells = <0>;
	compatible = "fsl,vf610-dspi";
	reg = <0x4002c000 0x1000>;
	interrupts = <0 67 0x04>;
	clocks = <&clks VF610_CLK_DSPI0>;
	clock-names = "dspi";
	spi-num-chipselects = <5>;
	bus-num = <0>;
	pinctrl-names = "default";
	pinctrl-0 = <&pinctrl_dspi0_1>;
/* bench 13824.0.0 692f2acbaa65 */
/* bench 13824.0.1 e4af08b18a04 */
/* bench 13824.0.2 3c05748e30cc */
/* bench 13824.0.3 e0d7d3f19c50 */
/* bench 13824.0.4 a01c23934249 */
	big-endian;

	sflash: at26df081a@0 {
		#address-cells = <1>;
		#size-cells = <1>;
		compatible = "atmel,at26df081a";
		spi-max-frequency = <16000000>;
		spi-cpol;
		spi-cpha;
		reg = <0>;
		linux,modalias = "m25p80";
		modal = "at26df081a";
/* bench 3423.0.0 3001df3f073b */
/* bench 3423.0.1 fe060ecdec17 */
/* bench 3423.0.2 1329c497b527 */
/* bench 3423.0.3 14f57d229c9d */
/* bench 3423.0.4 f27bf53f1751 */
/* bench 3423.0.5 d1dd1a01b630 */
/* bench 3423.0.6 74c1ac817490 */
/* bench 3423.0.7 1d9789d325db */
/* bench 3423.0.8 f18f4343c556 */
/* bench 3423.0.9 3ad1ab381bb8 */
/* bench 3423.0.10 06486c3ff82a */
/* bench 3423.0.11 825175b369c0 */
/* bench 3423.0.12 cf3b3dcf53a5 */
/* bench 3423.0.13 fa362bcd1d27 */
	};
};
```

## Documentation/devicetree/bindings/spi/spi-fsl-qspi.txt
```
FASTVC-BENCH-CORPUS:linux-main-100k-v1-e0bd41dc-8e12-4f1b-978d-a3645ae59da0
* Freescale Quad Serial Peripheral Interface(QuadSPI)

Required properties:
  - compatible : Should be "fsl,vf610-qspi", "fsl,imx6sx-qspi",
		 "fsl,imx7d-qspi", "fsl,imx6ul-qspi",
		 "fsl,ls1021a-qspi", "fsl,ls2080a-qspi"
		 or
		 "fsl,ls1043a-qspi" followed by "fsl,ls1021a-qspi"
  - reg : the first contains the register location and length,
          the second contains the memory mapping address and length
  - reg-names: Should contain the reg names "QuadSPI" and "QuadSPI-memory"
/* bench 12986.1.0 ea3fc8be8bbe */
/* bench 12986.1.1 da9fcf354fb6 */
/* bench 12986.1.2 67bd006d08e6 */
/* bench 12986.1.3 56690f8db2fe */
/* bench 12986.1.4 599e09a96ad8 */
/* bench 12986.1.5 9a0416853dcc */
/* bench 12986.1.6 ec271ef36282 */
/* bench 12986.1.7 542e05872720 */
/* bench 12986.1.8 f08262fc8634 */
/* bench 12986.1.9 ca96bff0b653 */
/* bench 12986.1.10 e9953196f050 */
/* bench 12986.1.11 b630f3b069cd */
/* bench 12986.1.12 84e7235558b3 */
/* bench 12986.1.13 df703710a81b */
/* bench 12986.1.14 4976c888dea9 */
  - interrupts : Should contain the interrupt for the device
  - clocks : The clocks needed by the QuadSPI controller
  - clock-names : Should contain the name of the clocks: "qspi_en" and "qspi".

/* bench 6973.0.0 9ae7ce7bbc55 */
/* bench 6973.0.1 1efeafe6beb1 */
/* bench 6973.0.2 42ad97ec7cee */
/* bench 6973.0.3 c6074905cd95 */
/* bench 6973.0.4 a99913e967a5 */
/* bench 6973.0.5 03e2565d276d */
/* bench 6973.0.6 5ed4bb97a6ff */
/* bench 6973.0.7 3c1a54a056cf */
/* bench 6973.0.8 6ecf5fc5d0cb */
/* bench 6973.0.9 413c94c38482 */
/* bench 6973.0.10 79ca08675c7a */
/* bench 6973.0.11 4f5ff0e3d9cc */
/* bench 6973.0.12 ca40de63e6b2 */
/* bench 6973.0.13 bfbccddedfa8 */
Required SPI slave node properties:
  - reg: There are two buses (A and B) with two chip selects each.
	 This encodes to which bus and CS the flash is connected:
		<0>: Bus A, CS 0
		<1>: Bus A, CS 1
		<2>: Bus B, CS 0
		<3>: Bus B, CS 1

Example:

qspi0: quadspi@40044000 {
	compatible = "fsl,vf610-qspi";
	reg = <0x40044000 0x1000>, <0x20000000 0x10000000>;
	reg-names = "QuadSPI", "QuadSPI-memory";
	interrupts = <0 24 IRQ_TYPE_LEVEL_HIGH>;
	clocks = <&clks VF610_CLK_QSPI0_EN>,
		<&clks VF610_CLK_QSPI0>;
	clock-names = "qspi_en", "qspi";

	flash0: s25fl128s@0 {
		#address-cells = <1>;
		#size-cells = <1>;
		compatible = "spansion,s25fl128s", "jedec,spi-nor";
		spi-max-frequency = <50000000>;
		reg = <0>;
	};
};

Example showing the usage of two SPI NOR devices on bus A:

&qspi2 {
	pinctrl-names = "default";
	pinctrl-0 = <&pinctrl_qspi2>;
	status = "okay";

	flash0: n25q256a@0 {
		#address-cells = <1>;
		#size-cells = <1>;
		compatible = "micron,n25q256a", "jedec,spi-nor";
		spi-max-frequency = <29000000>;
		reg = <0>;
	};

	flash1: n25q256a@1 {
		#address-cells = <1>;
		#size-cells = <1>;
		compatible = "micron,n25q256a", "jedec,spi-nor";
		spi-max-frequency = <29000000>;
		reg = <1>;
	};
};
```

## Documentation/devicetree/bindings/spi/spi-gpio.yaml
```yaml
FASTVC-BENCH-CORPUS:linux-main-100k-v1-e0bd41dc-8e12-4f1b-978d-a3645ae59da0
# SPDX-License-Identifier: GPL-2.0
%YAML 1.2
---
$id: http://devicetree.org/schemas/spi/spi-gpio.yaml#
$schema: http://devicetree.org/meta-schemas/core.yaml#

title: SPI-GPIO devicetree bindings

maintainers:
  - Rob Herring <robh@kernel.org>

description:
  This represents a group of 3-n GPIO lines used for bit-banged SPI on
  dedicated GPIO lines.

allOf:
  - $ref: "/schemas/spi/spi-controller.yaml#"

properties:
  compatible:
    const: spi-gpio

  sck-gpios:
    description: GPIO spec for the SCK line to use
    maxItems: 1

  miso-gpios:
    description: GPIO spec for the MISO line to use
    maxItems: 1

  mosi-gpios:
    description: GPIO spec for the MOSI line to use
    maxItems: 1

  cs-gpios:
    description: GPIOs to use for chipselect lines.
      Not needed if num-chipselects = <0>.
    minItems: 1
    maxItems: 1024

  num-chipselects:
    description: Number of chipselect lines. Should be <0> if a single device
/* bench 80.0.0 85fa29a4ca05 */
/* bench 80.0.1 e9b6c3f1a6de */
/* bench 80.0.2 9b00ef213df1 */
/* bench 80.0.3 e7f5c703356e */
/* bench 80.0.4 ae474e88e318 */
/* bench 80.0.5 e136c865e63d */
      with no chip select is connected.
    $ref: "/schemas/types.yaml#/definitions/uint32"

  # Deprecated properties
  gpio-sck: false
  gpio-miso: false
  gpio-mosi: false

required:
  - compatible
  - num-chipselects
  - sck-gpios

unevaluatedProperties: false

examples:
  - |
    spi {
      compatible = "spi-gpio";
      #address-cells = <0x1>;
      #size-cells = <0x0>;

      sck-gpios = <&gpio 95 0>;
      miso-gpios = <&gpio 98 0>;
      mosi-gpios = <&gpio 97 0>;
      cs-gpios = <&gpio 125 0>;
/* bench 14392.1.0 b66218431fa8 */
/* bench 14392.1.1 4b3f10a83b0b */
/* bench 14392.1.2 401233b4295d */
/* bench 14392.1.3 880a59760fe6 */
/* bench 14392.1.4 6c8db7459d42 */
/* bench 14392.1.5 912991ff7b90 */
/* bench 14392.1.6 d00b8b5f9be6 */
/* bench 14392.1.7 919ed2b23041 */
/* bench 14392.1.8 061ff1ca6a71 */
/* bench 14392.1.9 898446eaa8b6 */
/* bench 14392.1.10 c4fb1e979c7b */
/* bench 14392.1.11 eed21ab398b7 */
/* bench 14392.1.12 76bc71c6ccd7 */
/* bench 14392.1.13 5b4b646a6b32 */
/* bench 14392.1.14 b2ba5756abcb */
/* bench 14392.1.15 b40a505acb02 */
    };

...
```

## Documentation/devicetree/bindings/spi/spi-img-spfi.txt
```
FASTVC-BENCH-CORPUS:linux-main-100k-v1-e0bd41dc-8e12-4f1b-978d-a3645ae59da0
IMG Synchronous Peripheral Flash Interface (SPFI) controller

Required properties:
- compatible: Must be "img,spfi".
- reg: Must contain the base address and length of the SPFI registers.
- interrupts: Must contain the SPFI interrupt.
- clocks: Must contain an entry for each entry in clock-names.
  See ../clock/clock-bindings.txt for details.
- clock-names: Must include the following entries:
  - spfi: SPI operating clock
/* bench 26162.0.0 1317db0766e4 */
/* bench 26162.0.1 e5f1f208924d */
/* bench 26162.0.2 2e04d6e7468a */
/* bench 26162.0.3 c12d26a0a361 */
/* bench 26162.0.4 8581de1d1e92 */
/* bench 26162.0.5 62b0f84ff5b4 */
/* bench 26162.0.6 adbd051a5468 */
/* bench 26162.0.7 f005fe05f203 */
/* bench 26162.0.8 c1af55b18b61 */
/* bench 26162.0.9 bd637f7a7122 */
/* bench 26162.0.10 1b18ade7d58c */
/* bench 26162.0.11 2be6f753f679 */
/* bench 26162.0.12 ca17375e0c4b */
/* bench 26162.0.13 94c3701c6c52 */
/* bench 26162.0.14 a834b9ac276c */
/* bench 26162.0.15 9c747bf22001 */
/* bench 26162.0.16 bae987d87c50 */
/* bench 26162.0.17 730333f6ebfd */
/* bench 26162.0.18 aaddd716c5f0 */
  See ../dma/dma.txt for details.
- dma-names: Must include the following entries:
  - rx
  - tx
- cs-gpios: Must specify the GPIOs used for chipselect lines.
- #address-cells: Must be 1.
- #size-cells: Must be 0.

/* bench 3094.3.0 3aba3abd2557 */
- img,supports-quad-mode: Should be set if the interface supports quad mode
  SPI transfers.
- spfi-max-frequency: Maximum speed supported by the spfi block.

Example:

spi@18100f00 {
	compatible = "img,spfi";
	reg = <0x18100f00 0x100>;
	interrupts = <GIC_SHARED 22 IRQ_TYPE_LEVEL_HIGH>;
	clocks = <&spi_clk>, <&system_clk>;
	clock-names = "spfi", "sys";
	dmas = <&mdc 9 0xffffffff 0>, <&mdc 10 0xffffffff 0>;
	dma-names = "rx", "tx";

	#address-cells = <1>;
	#size-cells = <0>;
};
```
