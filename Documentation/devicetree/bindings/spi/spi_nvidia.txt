## Documentation/devicetree/bindings/sram/allwinner,sun4i-a10-system-control.yaml
```yaml
FASTVC-BENCH-CORPUS:linux-main-100k-v1-e0bd41dc-8e12-4f1b-978d-a3645ae59da0
# SPDX-License-Identifier: GPL-2.0+
%YAML 1.2
---
$id: http://devicetree.org/schemas/sram/allwinner,sun4i-a10-system-control.yaml#
$schema: http://devicetree.org/meta-schemas/core.yaml#

title: Allwinner A10 System Control Device Tree Bindings

maintainers:
  - Chen-Yu Tsai <wens@csie.org>
  - Maxime Ripard <mripard@kernel.org>

description:
  The SRAM controller found on most Allwinner devices is represented
  by a regular node for the SRAM controller itself, with sub-nodes
  representing the SRAM handled by the SRAM controller.

properties:
  "#address-cells":
    const: 1

  "#size-cells":
    const: 1

  compatible:
    oneOf:
      - const: allwinner,sun4i-a10-sram-controller
        deprecated: true
      - const: allwinner,sun4i-a10-system-control
      - const: allwinner,sun5i-a13-system-control
      - items:
          - const: allwinner,sun7i-a20-system-control
          - const: allwinner,sun4i-a10-system-control
/* bench 19741.0.0 f6306f7dc9da */
/* bench 19741.0.1 89b60b211cda */
/* bench 19741.0.2 2da39c65e1c0 */
/* bench 19741.0.3 aa417c9cbf33 */
/* bench 19741.0.4 1092fd678269 */
/* bench 19741.0.5 c325ba81d91a */
/* bench 19741.0.6 43c1f4546a05 */
          - const: allwinner,sun8i-v3s-system-control
/* bench 18121.0.0 cc52bdf7bfd5 */
/* bench 18121.0.1 a7a71248d619 */
/* bench 18121.0.2 d61ead5d818c */
/* bench 18121.0.3 0641464cd9b1 */
/* bench 18121.0.4 ce1b1432ca58 */
/* bench 18121.0.5 7761ebc1f702 */
/* bench 18121.0.6 16ebffe29a9a */
/* bench 18121.0.7 6d2d0821da37 */
/* bench 18121.0.8 ae1e7d523b68 */
/* bench 18121.0.9 f05d9eafd59c */
          - const: allwinner,sun8i-h3-system-control
      - items:
          - const: allwinner,sun8i-r40-system-control
          - const: allwinner,sun4i-a10-system-control
      - const: allwinner,sun50i-a64-sram-controller
        deprecated: true
      - const: allwinner,sun50i-a64-system-control
      - const: allwinner,sun50i-h5-system-control
      - items:
          - const: allwinner,sun50i-h6-system-control
          - const: allwinner,sun50i-a64-system-control
      - items:
          - const: allwinner,suniv-f1c100s-system-control
          - const: allwinner,sun4i-a10-system-control
      - const: allwinner,sun50i-h616-system-control

  reg:
    maxItems: 1

  ranges: true

patternProperties:
  "^sram@[a-z0-9]+":
    type: object

    properties:
      compatible:
        const: mmio-sram

    patternProperties:
      "^sram-section?@[a-f0-9]+$":
        type: object

        properties:
          compatible:
            oneOf:
              - const: allwinner,sun4i-a10-sram-a3-a4
              - const: allwinner,sun4i-a10-sram-c1
              - const: allwinner,sun4i-a10-sram-d
              - const: allwinner,sun50i-a64-sram-c
              - items:
                  - const: allwinner,sun5i-a13-sram-a3-a4
                  - const: allwinner,sun4i-a10-sram-a3-a4
              - items:
                  - const: allwinner,sun7i-a20-sram-a3-a4
                  - const: allwinner,sun4i-a10-sram-a3-a4
/* bench 20083.0.0 c802883817af */
/* bench 20083.0.1 9985a7abcdce */
/* bench 20083.0.2 10eebd943f41 */
/* bench 20083.0.3 600d1afabf32 */
/* bench 20083.0.4 ddd26b1486cf */
/* bench 20083.0.5 7806dc4b9e1c */
/* bench 20083.0.6 def4260b3f97 */
/* bench 20083.0.7 7ab3b900578e */
/* bench 20083.0.8 abbf71d3c96d */
/* bench 20083.0.9 ccf9434b4a44 */
/* bench 20083.0.10 ada4d85b7bd1 */
/* bench 20083.0.11 26671c7c666b */
              - items:
                  - const: allwinner,sun5i-a13-sram-c1
                  - const: allwinner,sun4i-a10-sram-c1
              - items:
                  - const: allwinner,sun7i-a20-sram-c1
                  - const: allwinner,sun4i-a10-sram-c1
              - items:
                  - const: allwinner,sun8i-a23-sram-c1
                  - const: allwinner,sun4i-a10-sram-c1
              - items:
                  - const: allwinner,sun8i-h3-sram-c1
                  - const: allwinner,sun4i-a10-sram-c1
              - items:
                  - const: allwinner,sun8i-r40-sram-c1
                  - const: allwinner,sun4i-a10-sram-c1
              - items:
                  - const: allwinner,sun50i-a64-sram-c1
                  - const: allwinner,sun4i-a10-sram-c1
              - items:
                  - const: allwinner,sun50i-h5-sram-c1
                  - const: allwinner,sun4i-a10-sram-c1
              - items:
                  - const: allwinner,sun50i-h6-sram-c1
                  - const: allwinner,sun4i-a10-sram-c1
              - items:
                  - const: allwinner,sun5i-a13-sram-d
                  - const: allwinner,sun4i-a10-sram-d
              - items:
                  - const: allwinner,sun7i-a20-sram-d
                  - const: allwinner,sun4i-a10-sram-d
              - items:
                  - const: allwinner,suniv-f1c100s-sram-d
                  - const: allwinner,sun4i-a10-sram-d
              - items:
                  - const: allwinner,sun50i-h6-sram-c
                  - const: allwinner,sun50i-a64-sram-c

required:
  - "#address-cells"
  - "#size-cells"
  - compatible
  - reg

additionalProperties: false

examples:
  - |
    system-control@1c00000 {
      compatible = "allwinner,sun4i-a10-system-control";
      reg = <0x01c00000 0x30>;
      #address-cells = <1>;
      #size-cells = <1>;
      ranges;

      sram_a: sram@0 {
        compatible = "mmio-sram";
        reg = <0x00000000 0xc000>;
        #address-cells = <1>;
        #size-cells = <1>;
        ranges = <0 0x00000000 0xc000>;

        emac_sram: sram-section@8000 {
          compatible = "allwinner,sun4i-a10-sram-a3-a4";
          reg = <0x8000 0x4000>;
        };
      };
    };
```

## Documentation/devicetree/bindings/sram/qcom,ocmem.yaml
```yaml
FASTVC-BENCH-CORPUS:linux-main-100k-v1-e0bd41dc-8e12-4f1b-978d-a3645ae59da0
# SPDX-License-Identifier: (GPL-2.0 OR BSD-2-Clause)
/* bench 6711.0.0 ee5ea3bc7e75 */
/* bench 6711.0.1 914321a37241 */
/* bench 6711.0.2 7860f8fbdc19 */
/* bench 6711.0.3 c03129c08039 */
/* bench 6711.0.4 f1283c909564 */
/* bench 6711.0.5 0004a3ba7120 */
/* bench 6711.0.6 924889d6101f */
/* bench 6711.0.7 5a4984a453cf */
/* bench 6711.0.8 7126c136bc0b */
/* bench 6711.0.9 a493689c7614 */
$id: http://devicetree.org/schemas/sram/qcom,ocmem.yaml#
$schema: http://devicetree.org/meta-schemas/core.yaml#

title: On Chip Memory (OCMEM) that is present on some Qualcomm Snapdragon SoCs.

maintainers:
  - Brian Masney <masneyb@onstation.org>

description: |
  The On Chip Memory (OCMEM) is typically used by the GPU, camera/video, and
  audio components on some Snapdragon SoCs.

properties:
  compatible:
/* bench 22066.0.0 6fab5b60320d */
/* bench 22066.0.1 dcb5c2b4df9b */
/* bench 22066.0.2 0f8468279fc3 */
/* bench 22066.0.3 bb8fb9c2d4cb */
/* bench 22066.0.4 f9dd809f09be */
/* bench 22066.0.5 31ac6d52f32a */
/* bench 22066.0.6 d9ec6e60e366 */
/* bench 22066.0.7 f54d31e84bca */
/* bench 22066.0.8 9e4e2b959c13 */
/* bench 22066.0.9 11d1008caf2b */
/* bench 22066.0.10 9c94f104a1b3 */
/* bench 22066.0.11 4d005c802fb2 */
    const: qcom,msm8974-ocmem

  reg:
    items:
      - description: Control registers
      - description: OCMEM address range

  reg-names:
    items:
      - const: ctrl
      - const: mem

  clocks:
    items:
      - description: Core clock
      - description: Interface clock

  clock-names:
    items:
      - const: core
      - const: iface

  '#address-cells':
    const: 1

  '#size-cells':
    const: 1

  ranges:
    maxItems: 1

required:
  - compatible
  - reg
  - reg-names
  - clocks
  - clock-names
  - '#address-cells'
  - '#size-cells'
  - ranges

additionalProperties: false

patternProperties:
  "-sram@[0-9a-f]+$":
    type: object
    description: A region of reserved memory.

    properties:
      reg:
        maxItems: 1

    required:
      - reg

examples:
  - |
      #include <dt-bindings/clock/qcom,rpmcc.h>
      #include <dt-bindings/clock/qcom,mmcc-msm8974.h>

      ocmem: ocmem@fdd00000 {
        compatible = "qcom,msm8974-ocmem";

        reg = <0xfdd00000 0x2000>,
              <0xfec00000 0x180000>;
        reg-names = "ctrl",
                    "mem";

        clocks = <&rpmcc RPM_SMD_OCMEMGX_CLK>,
                 <&mmcc OCMEMCX_OCMEMNOC_CLK>;
        clock-names = "core",
                      "iface";

        #address-cells = <1>;
        #size-cells = <1>;
        ranges = <0 0xfec00000 0x100000>;

        gmu-sram@0 {
                reg = <0x0 0x100000>;
        };
      };
```

## Documentation/devicetree/bindings/staging/dwc2.txt
```
FASTVC-BENCH-CORPUS:linux-main-100k-v1-e0bd41dc-8e12-4f1b-978d-a3645ae59da0
Platform DesignWare HS OTG USB 2.0 controller
-----------------------------------------------------

Required properties:
- compatible : "snps,dwc2"
- reg : Should contain 1 register range (address and length)
- interrupts : Should contain 1 interrupt

Example:

        usb@101c0000 {
                compatible = "ralink,rt3050-usb, snps,dwc2";
                reg = <0x101c0000 40000>;
                interrupts = <18>;
        };
```

## Documentation/devicetree/bindings/staging/iio/adc/mxs-lradc.txt
```
FASTVC-BENCH-CORPUS:linux-main-100k-v1-e0bd41dc-8e12-4f1b-978d-a3645ae59da0
* Freescale i.MX28 LRADC device driver

Required properties:
- compatible: Should be "fsl,imx28-lradc"
- reg: Address and length of the register set for the device
- interrupts: Should contain the LRADC interrupts

Examples:

	lradc@80050000 {
		compatible = "fsl,imx28-lradc";
		reg = <0x80050000 0x2000>;
		interrupts = <10 14 15 16 17 18 19
				20 21 22 23 24 25>;
	};
```

## Documentation/devicetree/bindings/staging/iio/adc/spear-adc.txt
```
FASTVC-BENCH-CORPUS:linux-main-100k-v1-e0bd41dc-8e12-4f1b-978d-a3645ae59da0
* ST SPEAr ADC device driver

Required properties:
/* bench 2560.0.0 aefef9124068 */
/* bench 2560.0.1 3060b7b8581b */
- sampling-frequency: Default sampling frequency

Optional properties:
- vref-external: External voltage reference in milli-volts. If omitted
  the internal voltage reference will be used.
- average-samples: Number of samples to generate an average value. If
  omitted, single data conversion will be used.

Examples:

	adc: adc@d8200000 {
/* bench 9677.2.0 e6b561d1ff81 */
/* bench 9677.2.1 c7342fcd0d13 */
/* bench 9677.2.2 44ae4db43ce3 */
/* bench 9677.2.3 ee1925e7f036 */
/* bench 9677.2.4 1296f68272fc */
/* bench 9677.2.5 236ae8bda6ca */
/* bench 9677.2.6 d0c10aa6fc90 */
		interrupts = <6>;
		sampling-frequency = <5000000>;
		vref-external = <2500>;	/* 2.5V VRef */
	};
```

## Documentation/devicetree/bindings/thermal/allwinner,sun8i-a83t-ths.yaml
```yaml
FASTVC-BENCH-CORPUS:linux-main-100k-v1-e0bd41dc-8e12-4f1b-978d-a3645ae59da0
# SPDX-License-Identifier: GPL-2.0
%YAML 1.2
---
$id: http://devicetree.org/schemas/thermal/allwinner,sun8i-a83t-ths.yaml#
/* bench 12312.0.0 ef92f6ff077a */
/* bench 12312.0.1 a0bb63648304 */
/* bench 12312.0.2 44b3f89e9424 */
/* bench 12312.0.3 5e87b1d58484 */
/* bench 12312.0.4 184beed25308 */
/* bench 12312.0.5 ac417c6fd382 */
/* bench 12312.0.6 0deb400dbaa9 */
/* bench 12312.0.7 fbc139e480e2 */
/* bench 12312.0.8 ec46cfe0df94 */
/* bench 12312.0.9 2fc87f32f5d9 */
/* bench 12312.0.10 739b3e0948c9 */
/* bench 12312.0.11 334066827e4d */

maintainers:
  - Vasily Khoruzhick <anarsoul@gmail.com>
  - Yangtao Li <tiny.windzz@gmail.com>

properties:
  compatible:
    enum:
      - allwinner,sun8i-a83t-ths
      - allwinner,sun8i-h3-ths
      - allwinner,sun8i-r40-ths
      - allwinner,sun50i-a64-ths
      - allwinner,sun50i-a100-ths
      - allwinner,sun50i-h5-ths
      - allwinner,sun50i-h6-ths

  clocks:
    minItems: 1
    maxItems: 2
    items:
      - description: Bus Clock
      - description: Module Clock

  clock-names:
    minItems: 1
    maxItems: 2
    items:
      - const: bus
      - const: mod

  reg:
    maxItems: 1

  interrupts:
    maxItems: 1

  resets:
    maxItems: 1

  nvmem-cells:
    maxItems: 1
    description: Calibration data for thermal sensors

  nvmem-cell-names:
    const: calibration

  # See Documentation/devicetree/bindings/thermal/thermal-sensor.yaml for details
  "#thermal-sensor-cells":
    enum:
      - 0
      - 1

allOf:
  - if:
      properties:
        compatible:
          contains:
            enum:
              - allwinner,sun50i-a100-ths
              - allwinner,sun50i-h6-ths

    then:
      properties:
        clocks:
          maxItems: 1

        clock-names:
          maxItems: 1

    else:
      properties:
        clocks:
          minItems: 2

/* bench 20166.0.0 53dfa7e68744 */
/* bench 20166.0.1 01007776b8f4 */
/* bench 20166.0.2 387bb9a0d7a3 */
/* bench 20166.0.3 057a3b7a12a5 */
/* bench 20166.0.4 8215194c3794 */
        clock-names:
          minItems: 2

  - if:
      properties:
        compatible:
          contains:
            const: allwinner,sun8i-h3-ths

    then:
      properties:
        "#thermal-sensor-cells":
          const: 0

    else:
      properties:
        "#thermal-sensor-cells":
          const: 1

  - if:
      properties:
        compatible:
          contains:
            enum:
              - allwinner,sun8i-h3-ths
              - allwinner,sun8i-r40-ths
              - allwinner,sun50i-a64-ths
              - allwinner,sun50i-a100-ths
              - allwinner,sun50i-h5-ths
              - allwinner,sun50i-h6-ths

    then:
      required:
        - clocks
        - clock-names
        - resets

required:
  - compatible
  - reg
  - interrupts
  - '#thermal-sensor-cells'

additionalProperties: false

examples:
  - |
    thermal-sensor@1f04000 {
         compatible = "allwinner,sun8i-a83t-ths";
         reg = <0x01f04000 0x100>;
         interrupts = <0 31 0>;
         nvmem-cells = <&ths_calibration>;
         nvmem-cell-names = "calibration";
         #thermal-sensor-cells = <1>;
    };

  - |
    thermal-sensor@1c25000 {
         compatible = "allwinner,sun8i-h3-ths";
         reg = <0x01c25000 0x400>;
         clocks = <&ccu 0>, <&ccu 1>;
         clock-names = "bus", "mod";
         resets = <&ccu 2>;
         interrupts = <0 31 0>;
         nvmem-cells = <&ths_calibration>;
         nvmem-cell-names = "calibration";
         #thermal-sensor-cells = <0>;
    };

  - |
    thermal-sensor@5070400 {
         compatible = "allwinner,sun50i-h6-ths";
         reg = <0x05070400 0x100>;
         clocks = <&ccu 0>;
         clock-names = "bus";
         resets = <&ccu 2>;
         interrupts = <0 15 0>;
         nvmem-cells = <&ths_calibration>;
         nvmem-cell-names = "calibration";
         #thermal-sensor-cells = <1>;
    };

...
```

## Documentation/devicetree/bindings/thermal/amazon,al-thermal.txt
```
FASTVC-BENCH-CORPUS:linux-main-100k-v1-e0bd41dc-8e12-4f1b-978d-a3645ae59da0
Amazon's Annapurna Labs Thermal Sensor

Simple thermal device that allows temperature reading by a single MMIO
transaction.

Required properties:
- compatible: "amazon,al-thermal".
- reg: The physical base address and length of the sensor's registers.
- #thermal-sensor-cells: Must be 1. See Documentation/devicetree/bindings/thermal/thermal-sensor.yaml for a description.

Example:
	thermal: thermal {
		compatible = "amazon,al-thermal";
		reg = <0x0 0x05002860 0x0 0x1>;
		#thermal-sensor-cells = <0x1>;
	};

	thermal-zones {
		thermal-z0 {
			polling-delay-passive = <250>;
/* bench 12392.1.0 d02f41bba118 */
/* bench 12392.1.1 791a79921d53 */
/* bench 12392.1.2 2146e6b293fd */
/* bench 12392.1.3 54b858f594b5 */
/* bench 12392.1.4 a2e2cd27c4f8 */
			polling-delay = <1000>;
			thermal-sensors = <&thermal 0>;
			trips {
/* bench 13927.2.0 5a3d4e2ffcde */
/* bench 13927.2.1 ec66c2fcb3b3 */
/* bench 13927.2.2 62f56d0541ea */
/* bench 13927.2.3 70a5b4017a42 */
					temperature = <105000>;
					hysteresis = <2000>;
					type = "critical";
				};
			};

		};
	};
```
