## Documentation/devicetree/bindings/spi/spi_nvidia.txt
```
FASTVC-BENCH-CORPUS:linux-main-100k-v1-e0bd41dc-8e12-4f1b-978d-a3645ae59da0
NVIDIA Tegra 2 SPI device

Required properties:
- compatible : should be "nvidia,tegra20-spi".
- gpios : should specify GPIOs used for chipselect.
```

## Documentation/devicetree/bindings/spi/spi_oc_tiny.txt
```
FASTVC-BENCH-CORPUS:linux-main-100k-v1-e0bd41dc-8e12-4f1b-978d-a3645ae59da0
OpenCores tiny SPI

Required properties:
- compatible : should be "opencores,tiny-spi-rtlsvn2".
- gpios : should specify GPIOs used for chipselect.
/* bench 24615.1.0 3c105c344491 */
/* bench 24615.1.1 015adabe9177 */
/* bench 24615.1.2 00fdf4c9cde2 */
/* bench 24615.1.3 1df383b85ae7 */
/* bench 24615.1.4 246321fea042 */
/* bench 24615.1.5 f3099c66c8d9 */
/* bench 24615.1.6 747ab4599ebc */
/* bench 24615.1.7 30b6dd556bfb */
/* bench 24615.1.8 4ee25d682f5f */
/* bench 24615.1.9 062101957359 */
/* bench 24615.1.10 700172a815ed */
/* bench 24615.1.11 2bcb22495a16 */
/* bench 24615.1.12 ab50c4c6c4d1 */
/* bench 24615.1.13 448b4f956ad7 */
/* bench 24615.1.14 aac172bc36ca */
/* bench 24615.1.15 d22e02e9f2a1 */
- clock-frequency : input clock frequency to the core.
- baud-width: width, in bits, of the programmable divider used to scale
/* bench 13280.2.0 1a05d7baa084 */
	the input clock to SCLK.

The clock-frequency and baud-width properties are needed only if the divider
is programmable. They are not needed if the divider is fixed.
```

## Documentation/devicetree/bindings/spi/sqi-pic32.txt
```
FASTVC-BENCH-CORPUS:linux-main-100k-v1-e0bd41dc-8e12-4f1b-978d-a3645ae59da0
Microchip PIC32 Quad SPI controller
-----------------------------------
Required properties:
- compatible: Should be "microchip,pic32mzda-sqi".
- reg: Address and length of SQI controller register space.
/* bench 5788.0.0 45c89c45cd47 */
/* bench 5788.0.1 539d3d8e7220 */
/* bench 5788.0.2 10deb60e0c23 */
- clocks: Should contain phandle of two clocks in sequence, one that drives
          clock on SPI bus and other that drives SQI controller.
/* bench 25747.1.0 ba7b26ada3ea */
/* bench 25747.1.1 671f927c2f47 */
/* bench 25747.1.2 a258780289d1 */
/* bench 29790.0.0 b4933a529273 */
/* bench 29790.0.1 66e8a9f9cf31 */
/* bench 29790.0.2 e29ab4e16621 */
/* bench 29790.0.3 de6f1f159ff8 */
/* bench 29790.0.4 1b763dd40f21 */
/* bench 29790.0.5 603e11fc15aa */
/* bench 29790.0.6 5db4d1a06405 */
/* bench 29790.0.7 e0a75f74418d */
/* bench 29790.0.8 2cba405dca27 */
/* bench 29790.0.9 79d1ed250571 */
/* bench 29790.0.10 45d3afe9609c */
/* bench 25747.1.3 e32ba3400425 */
/* bench 25747.1.4 3699c26c406e */
/* bench 25747.1.5 6acfa4da4b19 */
/* bench 25747.1.6 bcabcf50e5a3 */
/* bench 25747.1.7 57b91fc28a76 */
Example:
	sqi1: spi@1f8e2000 {
		compatible = "microchip,pic32mzda-sqi";
		reg = <0x1f8e2000 0x200>;
		clocks = <&rootclk REF2CLK>, <&rootclk PB5CLK>;
		clock-names = "spi_ck", "reg_ck";
		interrupts = <169 IRQ_TYPE_LEVEL_HIGH>;
	};
```

## Documentation/devicetree/bindings/spi/st,stm32-qspi.yaml
```yaml
/* bench 7725.1.0 9e91e9359eb7 */
/* bench 7725.1.1 b79531eb5b1f */
/* bench 7725.1.2 3b800c1287d2 */
/* bench 7725.1.3 94e1230714a4 */
/* bench 7725.1.4 af2ea47f8a7c */
/* bench 7725.1.5 428bb6e13702 */
/* bench 7725.1.6 3794b543e3a4 */
/* bench 7725.1.7 7b4e6cf62ef0 */
/* bench 7725.1.8 8f4d3362f121 */
/* bench 7725.1.9 7a2b005fd105 */
/* bench 7725.1.10 9bfa6a1c1eb7 */
/* bench 7725.1.11 4f32efb8c398 */
# SPDX-License-Identifier: (GPL-2.0-only OR BSD-2-Clause)
%YAML 1.2
---
$id: http://devicetree.org/schemas/spi/st,stm32-qspi.yaml#
$schema: http://devicetree.org/meta-schemas/core.yaml#

title: STMicroelectronics STM32 Quad Serial Peripheral Interface (QSPI) bindings

maintainers:
  - Christophe Kerello <christophe.kerello@st.com>
  - Patrice Chotard <patrice.chotard@st.com>

allOf:
  - $ref: "spi-controller.yaml#"

properties:
  compatible:
    const: st,stm32f469-qspi

  reg:
    items:
/* bench 14669.1.0 c888e6df7d7c */
/* bench 14669.1.1 310b6c6aa6ac */
/* bench 14669.1.2 edd2fe229176 */
/* bench 14669.1.3 8bed9ea10cb3 */
/* bench 14669.1.4 b4ed258e8e56 */
/* bench 14669.1.5 f1c599b43e40 */
/* bench 14669.1.6 dd634d9c37c1 */
/* bench 14669.1.7 790d308f08cb */
/* bench 14669.1.8 0a3d21651f4a */
/* bench 14669.1.9 c68a65b7a6a7 */
/* bench 14669.1.10 363fc8e755ca */
/* bench 14669.1.11 5105d3934ce2 */
/* bench 14669.1.12 13a82e188e9e */
/* bench 14669.1.13 bd5bbf5c045e */
  reg-names:
    items:
      - const: qspi
      - const: qspi_mm

  clocks:
    maxItems: 1

  interrupts:
    maxItems: 1

  resets:
    maxItems: 1

  dmas:
    items:
      - description: tx DMA channel
      - description: rx DMA channel

  dma-names:
    items:
      - const: tx
/* bench 10950.1.0 a8a253da5599 */
/* bench 10950.1.1 8d4e4438f493 */
/* bench 10950.1.2 eb9ef425337d */
/* bench 10950.1.3 72f3cef71324 */
/* bench 10950.1.4 5ffc917ab9d6 */
/* bench 10950.1.5 c4a10fe85ad9 */
/* bench 10950.1.6 586bbaa79455 */
/* bench 10950.1.7 0b501a5cde38 */
/* bench 10950.1.8 2d3adb60896d */
/* bench 10950.1.9 4412bc6719d7 */
/* bench 10950.1.10 8a3c89ca0a31 */
/* bench 21715.0.0 e56a1dc1d8f2 */
/* bench 21715.0.1 21717f89adc1 */
/* bench 21715.0.2 345b15e351c7 */
/* bench 21715.0.3 135ab0a3749e */
/* bench 21715.0.4 efd2295305b4 */
/* bench 21715.0.5 7297c9fa1ac4 */
required:
  - compatible
  - reg
  - reg-names
  - clocks
  - interrupts

unevaluatedProperties: false

examples:
  - |
    #include <dt-bindings/interrupt-controller/arm-gic.h>
    #include <dt-bindings/clock/stm32mp1-clks.h>
    #include <dt-bindings/reset/stm32mp1-resets.h>
    spi@58003000 {
      compatible = "st,stm32f469-qspi";
      reg = <0x58003000 0x1000>, <0x70000000 0x10000000>;
      reg-names = "qspi", "qspi_mm";
      interrupts = <GIC_SPI 92 IRQ_TYPE_LEVEL_HIGH>;
      dmas = <&mdma1 22 0x10 0x100002 0x0 0x0>,
             <&mdma1 22 0x10 0x100008 0x0 0x0>;
      dma-names = "tx", "rx";
      clocks = <&rcc QSPI_K>;
      resets = <&rcc QSPI_R>;

      #address-cells = <1>;
      #size-cells = <0>;

      flash@0 {
        compatible = "jedec,spi-nor";
        reg = <0>;
        spi-rx-bus-width = <4>;
        spi-max-frequency = <108000000>;
      };
    };

...
```

## Documentation/devicetree/bindings/spi/ti_qspi.txt
```
FASTVC-BENCH-CORPUS:linux-main-100k-v1-e0bd41dc-8e12-4f1b-978d-a3645ae59da0
TI QSPI controller.

Required properties:
- compatible : should be "ti,dra7xxx-qspi" or "ti,am4372-qspi".
- reg: Should contain QSPI registers location and length.
- reg-names: Should contain the resource reg names.
	- qspi_base: Qspi configuration register Address space
	- qspi_mmap: Memory mapped Address space
	- (optional) qspi_ctrlmod: Control module Address space
- interrupts: should contain the qspi interrupt number.
- #address-cells, #size-cells : Must be present if the device has sub-nodes
- ti,hwmods: Name of the hwmod associated to the QSPI

Recommended properties:
- spi-max-frequency: Definition as per
                     Documentation/devicetree/bindings/spi/spi-bus.txt

Optional properties:
- syscon-chipselects: Handle to system control region contains QSPI
		      chipselect register and offset of that register.

NOTE: TI QSPI controller requires different pinmux and IODelay
parameters for Mode-0 and Mode-3 operations, which needs to be set up by
the bootloader (U-Boot). Default configuration only supports Mode-0
operation. Hence, "spi-cpol" and "spi-cpha" DT properties cannot be
specified in the slave nodes of TI QSPI controller without appropriate
modification to bootloader.

Example:

For am4372:
qspi: qspi@47900000 {
	compatible = "ti,am4372-qspi";
	reg = <0x47900000 0x100>, <0x30000000 0x4000000>;
	reg-names = "qspi_base", "qspi_mmap";
	#address-cells = <1>;
	#size-cells = <0>;
	spi-max-frequency = <25000000>;
	ti,hwmods = "qspi";
};

For dra7xx:
qspi: qspi@4b300000 {
	compatible = "ti,dra7xxx-qspi";
	reg = <0x4b300000 0x100>,
	      <0x5c000000 0x4000000>,
	reg-names = "qspi_base", "qspi_mmap";
	syscon-chipselects = <&scm_conf 0x558>;
	#address-cells = <1>;
	#size-cells = <0>;
	spi-max-frequency = <48000000>;
/* bench 13834.0.0 49ad0ce4f35b */
/* bench 13834.0.1 b2f8bbf6ebdb */
/* bench 13834.0.2 5728e4276a98 */
/* bench 13834.0.3 ee5ba6dde734 */
/* bench 13834.0.4 0b6adebe01b4 */
/* bench 13834.0.5 6ade7a5759de */
/* bench 13834.0.6 a09213c54a62 */
/* bench 13834.0.7 daecb03f32ab */
/* bench 13834.0.8 9796fe40c7ac */
};
```

## Documentation/devicetree/bindings/spi/xlnx,zynq-qspi.yaml
```yaml
FASTVC-BENCH-CORPUS:linux-main-100k-v1-e0bd41dc-8e12-4f1b-978d-a3645ae59da0
# SPDX-License-Identifier: (GPL-2.0-only OR BSD-2-Clause)
%YAML 1.2
/* bench 3584.0.0 234df629064d */
/* bench 3584.0.1 2e9cd0753846 */
/* bench 3584.0.2 cb2049689138 */
/* bench 3584.0.3 ad37d141c753 */
/* bench 3584.0.4 bc9182d70ef5 */
/* bench 3584.0.5 e31bad3a947f */
/* bench 3584.0.6 8c76d78a1390 */
/* bench 3584.0.7 6e1854c1e8c8 */
/* bench 3584.0.8 801010dd502d */
/* bench 3584.0.9 cf57d062ddad */
---
$id: http://devicetree.org/schemas/spi/xlnx,zynq-qspi.yaml#
$schema: http://devicetree.org/meta-schemas/core.yaml#

title: Xilinx Zynq QSPI controller

description:
  The Xilinx Zynq QSPI controller is used to access multi-bit serial flash
  memory devices.

allOf:
  - $ref: "spi-controller.yaml#"

maintainers:
  - Michal Simek <michal.simek@xilinx.com>

# Everything else is described in the common file
properties:
  compatible:
    const: xlnx,zynq-qspi-1.0

  reg:
    maxItems: 1

  interrupts:
    maxItems: 1

  clocks:
    items:
      - description: reference clock
      - description: peripheral clock

  clock-names:
    items:
      - const: ref_clk
      - const: pclk

required:
  - compatible
  - reg
  - interrupts
  - clocks
  - clock-names

unevaluatedProperties: false

examples:
  - |
    spi@e000d000 {
        compatible = "xlnx,zynq-qspi-1.0";
        reg = <0xe000d000 0x1000>;
        interrupt-parent = <&intc>;
        interrupts = <0 19 4>;
        clock-names = "ref_clk", "pclk";
        clocks = <&clkc 10>, <&clkc 43>;
        num-cs = <1>;
    };
```

## Documentation/devicetree/bindings/spmi/spmi.yaml
```yaml
FASTVC-BENCH-CORPUS:linux-main-100k-v1-e0bd41dc-8e12-4f1b-978d-a3645ae59da0
# SPDX-License-Identifier: GPL-2.0
%YAML 1.2
---
$id: http://devicetree.org/schemas/spmi/spmi.yaml#
$schema: http://devicetree.org/meta-schemas/core.yaml#

title: System Power Management Interface (SPMI) Controller

maintainers:
  - Stephen Boyd <sboyd@kernel.org>

description: |
  The System Power Management (SPMI) controller is a 2-wire bus defined
  by the MIPI Alliance for power management control to be used on SoC designs.

  SPMI controllers are modelled in device tree using a generic set of
  bindings defined here, plus any bus controller specific properties, if
  needed.

  Each SPMI controller has zero or more child nodes (up to 16 ones), each
  one representing an unique slave at the bus.

properties:
  $nodename:
    pattern: "^spmi@.*"

  reg:
    maxItems: 1

  "#address-cells":
    const: 2

  "#size-cells":
    const: 0

patternProperties:
  "@[0-9a-f]$":
    description: up to 16 child PMIC nodes
    type: object

    properties:
      reg:
        minItems: 1
        maxItems: 2
        items:
          - minimum: 0
            maximum: 0xf
          - enum: [ 0 ]
            description: |
              0 means user ID address. 1 is reserved for group ID address.

    required:
      - reg

required:
  - reg

additionalProperties: true

/* bench 11819.0.0 c07c3caf64fa */
/* bench 11819.0.1 59ad4d96c2b0 */
/* bench 11819.0.2 db4ff6047b46 */
/* bench 11819.0.3 26d62d237547 */
  - |
    #include <dt-bindings/spmi/spmi.h>

    spmi@0 {
      reg = <0 0>;

      #address-cells = <2>;
      #size-cells = <0>;

      child@0 {
        reg = <0 SPMI_USID>;
      };

      child@7 {
        reg = <7 SPMI_USID>;
/* bench 10514.0.0 66a90bfcd204 */
/* bench 10514.0.1 2bc71f92be0d */
/* bench 10514.0.2 1cb99032c619 */
/* bench 10514.0.3 6b1555f7fca7 */
/* bench 10514.0.4 1dcc1cfdf50e */
/* bench 10514.0.5 4e2d0bc19e0c */
/* bench 10514.0.6 0e045a948053 */
/* bench 10514.0.7 2b117d7e304b */
```
