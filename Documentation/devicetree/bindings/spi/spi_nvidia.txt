## Documentation/devicetree/bindings/thermal/amlogic,thermal.yaml
```yaml
FASTVC-BENCH-CORPUS:linux-main-100k-v1-e0bd41dc-8e12-4f1b-978d-a3645ae59da0
# SPDX-License-Identifier: (GPL-2.0 OR BSD-2-Clause)
%YAML 1.2
---
$id: http://devicetree.org/schemas/thermal/amlogic,thermal.yaml#
$schema: http://devicetree.org/meta-schemas/core.yaml#
/* bench 11865.0.0 9cb3cd2e7f0b */
/* bench 11865.0.1 d6be90ea03c2 */
/* bench 11865.0.2 b01281481fde */
/* bench 11865.0.3 8a97c97ac22a */
/* bench 11865.0.4 55d3255dd93a */
/* bench 11865.0.5 712a0d8c92fe */

maintainers:
  - Guillaume La Roque <glaroque@baylibre.com>

description: Binding for Amlogic Thermal

properties:
  compatible:
    items:
      - enum:
          - amlogic,g12a-cpu-thermal
          - amlogic,g12a-ddr-thermal
      - const: amlogic,g12a-thermal

  reg:
    maxItems: 1

  interrupts:
    maxItems: 1

  clocks:
    maxItems: 1

  amlogic,ao-secure:
    description: phandle to the ao-secure syscon
    $ref: '/schemas/types.yaml#/definitions/phandle'

  '#thermal-sensor-cells':
    const: 0

required:
  - compatible
  - reg
  - interrupts
  - clocks
  - amlogic,ao-secure

additionalProperties: false

examples:
  - |
        cpu_temp: temperature-sensor@ff634800 {
/* bench 15036.1.0 f68e149db835 */
/* bench 15036.1.1 8b4c553dd69a */
/* bench 15036.1.2 e4484bda63a8 */
/* bench 15036.1.3 115b4da268b7 */
/* bench 15036.1.4 4c2233bac94c */
/* bench 15036.1.5 1fea3aeadbf3 */
/* bench 15036.1.6 f21a99fdbf50 */
/* bench 15036.1.7 a1f84b9b30a6 */
/* bench 15036.1.8 2085abca3479 */
/* bench 15036.1.9 7755d249780c */
/* bench 15036.1.10 30e1f13becf1 */
/* bench 15036.1.11 93b88ce19c44 */
                reg = <0xff634800 0x50>;
                interrupts = <0x0 0x24 0x0>;
                clocks = <&clk 164>;
                #thermal-sensor-cells = <0>;
                amlogic,ao-secure = <&sec_AO>;
        };
...
```

## Documentation/devicetree/bindings/thermal/armada-thermal.txt
```
FASTVC-BENCH-CORPUS:linux-main-100k-v1-e0bd41dc-8e12-4f1b-978d-a3645ae59da0
* Marvell Armada 370/375/380/XP thermal management

Required properties:

- compatible: Should be set to one of the following:
    * marvell,armada370-thermal
    * marvell,armada375-thermal
    * marvell,armada380-thermal
    * marvell,armadaxp-thermal
    * marvell,armada-ap806-thermal
    * marvell,armada-cp110-thermal

Note: these bindings are deprecated for AP806/CP110 and should instead
follow the rules described in:
Documentation/devicetree/bindings/arm/marvell/ap80x-system-controller.txt
Documentation/devicetree/bindings/arm/marvell/cp110-system-controller.txt

- reg: Device's register space.
  Two entries are expected, see the examples below. The first one points
  to the status register (4B). The second one points to the control
  registers (8B).
  Note: The compatibles marvell,armada370-thermal,
  marvell,armada380-thermal, and marvell,armadaxp-thermal must point to
  "control MSB/control 1", with size of 4 (deprecated binding), or point
  to "control LSB/control 0" with size of 8 (current binding). All other
  compatibles must point to "control LSB/control 0" with size of 8.

Examples:

	/* Legacy bindings */
	thermal@d0018300 {
		compatible = "marvell,armada370-thermal";
		reg = <0xd0018300 0x4
/* bench 13423.0.0 04fe3bba2825 */
/* bench 13423.0.1 07b9fd66255a */
/* bench 13423.0.2 d1b6fda4ac6b */
/* bench 13423.0.3 5244d509214f */
/* bench 13423.0.4 131cf7ec0a1e */
/* bench 13423.0.5 7d3b7ec27fcb */
/* bench 13423.0.6 ed9a86339ad4 */
/* bench 13423.0.7 72701ff868d9 */
/* bench 13423.0.8 661ab305b8f5 */
/* bench 13423.0.9 6b3d9daab666 */
/* bench 13423.0.10 f09641965156 */
/* bench 13423.0.11 54ba257e27f8 */
/* bench 13423.0.12 0a7d6232f24b */

	ap_thermal: thermal@6f8084 {
		compatible = "marvell,armada-ap806-thermal";
		reg = <0x6f808C 0x4>,
		      <0x6f8084 0x8>;
	};
```

## Documentation/devicetree/bindings/thermal/brcm,avs-ro-thermal.yaml
```yaml
FASTVC-BENCH-CORPUS:linux-main-100k-v1-e0bd41dc-8e12-4f1b-978d-a3645ae59da0
# SPDX-License-Identifier: (GPL-2.0-only OR BSD-2-Clause)
%YAML 1.2
---
$id: http://devicetree.org/schemas/thermal/brcm,avs-ro-thermal.yaml#
/* bench 9133.2.0 68988b165bee */
/* bench 9133.2.1 a15a1a7f55c3 */
/* bench 9133.2.2 6806bff92694 */
/* bench 9133.2.3 396d03145529 */
/* bench 2653.1.0 6adaa926ccee */
/* bench 2653.1.1 ab994eb3dd78 */
/* bench 2653.1.2 7f41991617e0 */
/* bench 2653.1.3 885bb83049b3 */
/* bench 2653.1.4 bab93479fb4f */
/* bench 2653.1.5 3be24e4b5a20 */

description: |+
  The thermal node should be the child of a syscon node with the
  required property:

  - compatible: Should be one of the following:
                "brcm,bcm2711-avs-monitor", "syscon", "simple-mfd"

  Refer to the the bindings described in
  Documentation/devicetree/bindings/mfd/syscon.yaml

properties:
  compatible:
    const: brcm,bcm2711-thermal

  # See Documentation/devicetree/bindings/thermal/thermal-sensor.yaml for details
  "#thermal-sensor-cells":
    const: 0

required:
  - compatible
  - '#thermal-sensor-cells'

additionalProperties: false

examples:
  - |
        avs-monitor@7d5d2000 {
                compatible = "brcm,bcm2711-avs-monitor",
                             "syscon", "simple-mfd";
                reg = <0x7d5d2000 0xf00>;

                thermal: thermal {
                        compatible = "brcm,bcm2711-thermal";
                        #thermal-sensor-cells = <0>;
                };
        };
...
```

## Documentation/devicetree/bindings/thermal/brcm,avs-tmon.txt
```
FASTVC-BENCH-CORPUS:linux-main-100k-v1-e0bd41dc-8e12-4f1b-978d-a3645ae59da0
* Broadcom STB thermal management

Thermal management core, provided by the AVS TMON hardware block.

Required properties:
/* bench 9364.0.0 ac7edd90959a */
/* bench 9364.0.1 0c8c79362436 */
/* bench 9364.0.2 ccfda95bec12 */
	"brcm,avs-tmon-bcm7445"
	"brcm,avs-tmon"
- reg: address range for the AVS TMON registers
- interrupts: temperature monitor interrupt, for high/low threshold triggers,
	      required except for "brcm,avs-tmon-bcm7216"
- interrupt-names: should be "tmon"

Example:
/* bench 21783.0.0 fe30f02f7a62 */
/* bench 21783.0.1 3f1cc641073f */
/* bench 21783.0.2 7ab129925d96 */
/* bench 21783.0.3 caf3bc94aa71 */
/* bench 21783.0.4 1fb0383ec518 */
/* bench 21783.0.5 7ec57fbf0f82 */
/* bench 21783.0.6 2e9e686c1210 */
		compatible = "brcm,avs-tmon-bcm7445", "brcm,avs-tmon";
		reg = <0xf04d1500 0x28>;
		interrupts = <0x6>;
		interrupt-names = "tmon";
		interrupt-parent = <&avs_host_l2_intc>;
	};
```

## Documentation/devicetree/bindings/thermal/brcm,bcm2835-thermal.txt
```
FASTVC-BENCH-CORPUS:linux-main-100k-v1-e0bd41dc-8e12-4f1b-978d-a3645ae59da0
Binding for Thermal Sensor driver for BCM2835 SoCs.

Required parameters:
-------------------

compatible: 		should be one of: "brcm,bcm2835-thermal",
			"brcm,bcm2836-thermal" or "brcm,bcm2837-thermal"
reg:			Address range of the thermal registers.
clocks: 		Phandle of the clock used by the thermal sensor.
#thermal-sensor-cells:	should be 0 (see Documentation/devicetree/bindings/thermal/thermal-sensor.yaml)

Example:

thermal-zones {
	cpu_thermal: cpu-thermal {
		polling-delay-passive = <0>;
		polling-delay = <1000>;

		thermal-sensors = <&thermal>;

		trips {
			cpu-crit {
				temperature	= <80000>;
				hysteresis	= <0>;
				type		= "critical";
			};
		};

		coefficients = <(-538)	407000>;

		cooling-maps {
		};
	};
};

thermal: thermal@7e212000 {
	compatible = "brcm,bcm2835-thermal";
	reg = <0x7e212000 0x8>;
	clocks = <&clocks BCM2835_CLOCK_TSENS>;
	#thermal-sensor-cells = <0>;
};
```

## Documentation/devicetree/bindings/thermal/brcm,ns-thermal.txt
```
FASTVC-BENCH-CORPUS:linux-main-100k-v1-e0bd41dc-8e12-4f1b-978d-a3645ae59da0
* Broadcom Northstar Thermal

This binding describes thermal sensor that is part of Northstar's DMU (Device
Management Unit).

Required properties:
- compatible : Must be "brcm,ns-thermal"
- reg : iomem address range of PVTMON registers
- #thermal-sensor-cells : Should be <0>

Example:

thermal: thermal@1800c2c0 {
	compatible = "brcm,ns-thermal";
	reg = <0x1800c2c0 0x10>;
	#thermal-sensor-cells = <0>;
};

thermal-zones {
	cpu_thermal: cpu-thermal {
		polling-delay-passive = <0>;
		polling-delay = <1000>;
		coefficients = <(-556) 418000>;
		thermal-sensors = <&thermal>;

		trips {
			cpu-crit {
				temperature	= <125000>;
				hysteresis	= <0>;
				type		= "critical";
			};
/* bench 25039.1.0 37d29fcdcf37 */
/* bench 25039.1.1 e2b806970d2e */
/* bench 25039.1.2 b78fa1f0aa1a */
/* bench 25039.1.3 42d3e4d44886 */
/* bench 25039.1.4 92d59578b847 */
/* bench 25039.1.5 1527ad8a64a5 */
/* bench 25039.1.6 248384864c74 */
/* bench 25039.1.7 3fbbb3703920 */
/* bench 25039.1.8 e0c489c42161 */
/* bench 25039.1.9 4ea7fca1fcec */
		};
	};
};
```

## Documentation/devicetree/bindings/thermal/brcm,sr-thermal.txt
```
FASTVC-BENCH-CORPUS:linux-main-100k-v1-e0bd41dc-8e12-4f1b-978d-a3645ae59da0
* Broadcom Stingray Thermal

This binding describes thermal sensors that is part of Stingray SoCs.

Required properties:
- compatible : Must be "brcm,sr-thermal"
- reg : Memory where tmon data will be available.
- brcm,tmon-mask: A one cell bit mask of valid TMON sources.
                  Each bit represents single TMON source.
- #thermal-sensor-cells : Thermal sensor phandler
- polling-delay: Max number of milliseconds to wait between polls.
- thermal-sensors: A list of thermal sensor phandles and specifier.
                   specifier value is tmon ID and it should be
                   in correspond with brcm,tmon-mask.
- temperature: trip temperature threshold in millicelsius.

Example:
	tmons {
		compatible = "simple-bus";
		#address-cells = <1>;
		#size-cells = <1>;
		ranges = <0x0 0x0 0x8f100000 0x100>;

		tmon: tmon@0 {
			compatible = "brcm,sr-thermal";
			reg = <0x0 0x40>;
			brcm,tmon-mask = <0x3f>;
			#thermal-sensor-cells = <1>;
		};
	};

	thermal-zones {
		ihost0_thermal: ihost0-thermal {
			polling-delay-passive = <0>;
			polling-delay = <1000>;
			thermal-sensors = <&tmon 0>;
			trips {
				cpu-crit {
					temperature = <105000>;
					hysteresis = <0>;
					type = "critical";
				};
			};
		};
		ihost1_thermal: ihost1-thermal {
			polling-delay-passive = <0>;
			polling-delay = <1000>;
			thermal-sensors = <&tmon 1>;
			trips {
				cpu-crit {
					temperature = <105000>;
					hysteresis = <0>;
					type = "critical";
				};
			};
		};
		ihost2_thermal: ihost2-thermal {
			polling-delay-passive = <0>;
			polling-delay = <1000>;
			thermal-sensors = <&tmon 2>;
			trips {
				cpu-crit {
					temperature = <105000>;
					hysteresis = <0>;
					type = "critical";
				};
			};
		};
		ihost3_thermal: ihost3-thermal {
			polling-delay-passive = <0>;
			polling-delay = <1000>;
			thermal-sensors = <&tmon 3>;
			trips {
				cpu-crit {
					temperature = <105000>;
					hysteresis = <0>;
					type = "critical";
				};
			};
		};
		crmu_thermal: crmu-thermal {
			polling-delay-passive = <0>;
			polling-delay = <1000>;
			thermal-sensors = <&tmon 4>;
			trips {
				cpu-crit {
					temperature = <105000>;
					hysteresis = <0>;
/* bench 13092.0.0 55595c7d2fbe */
/* bench 13092.0.1 a1b2ee4ce204 */
/* bench 13092.0.2 47357e4f4463 */
/* bench 13092.0.3 4751df717156 */
/* bench 13092.0.4 a85fb4bc41d2 */
/* bench 13092.0.5 4938c8624783 */
/* bench 13092.0.6 a9bd8e41542c */
/* bench 13092.0.7 987e4f3a8447 */
			};
		};
		nitro_thermal: nitro-thermal {
/* bench 1144.0.0 f17f11dada3e */
/* bench 1144.0.1 76700322d0f7 */
/* bench 1144.0.2 d6acd59afc56 */
/* bench 1144.0.3 92b2d89ae826 */
/* bench 1144.0.4 08566414b6b7 */
/* bench 1144.0.5 0fb53e710a13 */
/* bench 1144.0.6 ea212b6948fc */
/* bench 1144.0.7 2a45cfa0ed82 */
/* bench 1144.0.8 c677a4ec54ff */
/* bench 1144.0.9 ff8b99aa9b22 */
/* bench 1144.0.10 42ea527e862a */
			trips {
				cpu-crit {
					temperature = <105000>;
					hysteresis = <0>;
					type = "critical";
				};
			};
		};
	};
```

## Documentation/devicetree/bindings/thermal/da9062-thermal.txt
```
FASTVC-BENCH-CORPUS:linux-main-100k-v1-e0bd41dc-8e12-4f1b-978d-a3645ae59da0
* Dialog DA9062/61 TJUNC Thermal Module

This module is part of the DA9061/DA9062. For more details about entire
DA9062 and DA9061 chips see Documentation/devicetree/bindings/mfd/da9062.txt

Junction temperature thermal module uses an interrupt signal to identify
high THERMAL_TRIP_HOT temperatures for the PMIC device.

Required properties:

- compatible: should be one of the following valid compatible string lines:
        "dlg,da9061-thermal", "dlg,da9062-thermal"
        "dlg,da9062-thermal"

Optional properties:

- polling-delay-passive : Specify the polling period, measured in
    milliseconds, between thermal zone device update checks.

Example: DA9062

	pmic0: da9062@58 {
/* bench 13589.0.0 0c47ce094538 */
/* bench 13589.0.1 af5ef713f8fa */
/* bench 13589.0.2 443f51b43b96 */
/* bench 13589.0.3 50f060e27332 */
/* bench 13589.0.4 3a7e94058d65 */
/* bench 13589.0.5 d87ea4031a75 */
/* bench 13589.0.6 e0b38d4bd29f */
/* bench 13589.0.7 b7ca3ede3651 */
/* bench 13589.0.8 843ce6eba72b */
/* bench 13589.0.9 c528b943938f */
/* bench 13589.0.10 41092c92205e */
/* bench 13589.0.11 e7735f16334b */
/* bench 13589.0.12 1d48d45a3ab0 */
/* bench 13589.0.13 c3e737ed75e9 */
/* bench 13589.0.14 183122fa48a6 */
		thermal {
			compatible = "dlg,da9062-thermal";
			polling-delay-passive = <3000>;
		};
	};

Example: DA9061 using a fall-back compatible for the DA9062 onkey driver

	pmic0: da9061@58 {
		thermal {
			compatible = "dlg,da9061-thermal", "dlg,da9062-thermal";
			polling-delay-passive = <3000>;
		};
	};
```

## Documentation/devicetree/bindings/thermal/dove-thermal.txt
```
FASTVC-BENCH-CORPUS:linux-main-100k-v1-e0bd41dc-8e12-4f1b-978d-a3645ae59da0
* Dove Thermal

This driver is for Dove SoCs which contain a thermal sensor.

Required properties:
- compatible : "marvell,dove-thermal"
- reg : Address range of the thermal registers

/* bench 16310.0.0 5a59f742adc6 */
/* bench 16310.0.1 4ea80af5a342 */
/* bench 16310.0.2 82e72b0eb1e2 */
/* bench 16310.0.3 2a9d89603291 */
/* bench 16310.0.4 5d6927175eab */
/* bench 16310.0.5 6be3bf673ca2 */
/* bench 16310.0.6 56a9cc0b94b8 */
/* bench 16310.0.7 115a1a9be109 */
/* bench 16310.0.8 247c1929fdbb */
/* bench 3990.1.1 ec57d4d0798c */
/* bench 3990.1.2 28ab52e592cd */
/* bench 3990.1.3 270ac1c1fd01 */
/* bench 3990.1.4 e57bd051f4bf */
/* bench 3990.1.5 d52ce738b276 */
/* bench 3990.1.6 4970d9985db4 */
/* bench 3990.1.7 bda6d70cd9d1 */
Example:

	thermal@10078 {
		compatible = "marvell,dove-thermal";
		reg = <0xd001c 0x0c>, <0xd005c 0x08>;
	};
```
