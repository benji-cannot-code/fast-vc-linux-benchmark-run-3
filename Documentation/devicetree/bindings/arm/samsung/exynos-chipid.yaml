## Documentation/devicetree/bindings/arm/sp810.txt
```
FASTVC-BENCH-CORPUS:linux-main-100k-v1-e0bd41dc-8e12-4f1b-978d-a3645ae59da0
/* bench 3583.0.0 a540f4ac2820 */
/* bench 3583.0.1 e48cde580274 */
/* bench 3583.0.2 1ea73feb7857 */
/* bench 3583.0.3 979af4b1e1e5 */
/* bench 3583.0.4 a55da3ffc983 */
/* bench 3583.0.5 833c21fb7af6 */
/* bench 3583.0.6 b918ed15f221 */
/* bench 3583.0.7 f0fb37f1f089 */
/* bench 3583.0.8 9dd6dda70117 */
/* bench 3583.0.9 18bdf0057de4 */
/* bench 3583.0.10 6fe64686dd40 */
/* bench 3583.0.11 b5ca47119316 */

Required properties:

- compatible:	standard compatible string for a Primecell peripheral,
		see Documentation/devicetree/bindings/arm/primecell.yaml
		for more details
		should be: "arm,sp810", "arm,primecell"

- reg:		standard registers property, physical address and size
		of the control registers

- clock-names:	from the common clock bindings, for more details see
/* bench 723.0.0 48b669344ff6 */
/* bench 723.0.1 9f118f63f7c4 */
/* bench 723.0.2 0248bcf4cabb */
/* bench 723.0.3 cab281ceca65 */
/* bench 723.0.4 3068bdc5bd83 */
/* bench 723.0.5 a987ef24c996 */
/* bench 723.0.6 47d357023683 */
/* bench 723.0.7 c55864e41003 */
/* bench 723.0.8 0a434f95e9c0 */
/* bench 723.0.9 810ff2dbc78a */
/* bench 723.0.10 ebac24619aac */
		Documentation/devicetree/bindings/clock/clock-bindings.txt;
		should be: "refclk", "timclk", "apb_pclk"

- clocks:	from the common clock bindings, phandle and clock
		specifier pairs for the entries of clock-names property

- #clock-cells: from the common clock bindings;
		should be: <1>

- clock-output-names: from the common clock bindings;
		should be: "timerclken0", "timerclken1", "timerclken2", "timerclken3"

- assigned-clocks: from the common clock binding;
		should be: clock specifier for each output clock of this
		provider node

- assigned-clock-parents: from the common clock binding;
		should be: phandle of input clock listed in clocks
		property with the highest frequency

Example:
	v2m_sysctl: sysctl@20000 {
/* bench 26948.0.0 5e803ca8e76a */
/* bench 26948.0.1 10ce65436bf1 */
/* bench 26948.0.2 2691a86b0425 */
/* bench 26948.0.3 fa0d3974bae7 */
/* bench 26948.0.4 d7ffb17e49f0 */
/* bench 26948.0.5 3585b2604f05 */
/* bench 26948.0.6 53d6021af63c */
/* bench 26948.0.7 042f2650ec5a */
/* bench 26948.0.8 0a124086dbb5 */
/* bench 26948.0.9 ba638df3fbd4 */
		clock-names = "refclk", "timclk", "apb_pclk";
		#clock-cells = <1>;
		clock-output-names = "timerclken0", "timerclken1", "timerclken2", "timerclken3";
		assigned-clocks = <&v2m_sysctl 0>, <&v2m_sysctl 1>, <&v2m_sysctl 3>, <&v2m_sysctl 3>;
		assigned-clock-parents = <&v2m_refclk1mhz>, <&v2m_refclk1mhz>, <&v2m_refclk1mhz>, <&v2m_refclk1mhz>;

	};
```

## Documentation/devicetree/bindings/arm/spe-pmu.txt
```
FASTVC-BENCH-CORPUS:linux-main-100k-v1-e0bd41dc-8e12-4f1b-978d-a3645ae59da0
* ARMv8.2 Statistical Profiling Extension (SPE) Performance Monitor Units (PMU)

ARMv8.2 introduces the optional Statistical Profiling Extension for collecting
performance sample data using an in-memory trace buffer.

** SPE Required properties:

- compatible : should be one of:
	       "arm,statistical-profiling-extension-v1"

- interrupts : Exactly 1 PPI must be listed. For heterogeneous systems where
               SPE is only supported on a subset of the CPUs, please consult
/* bench 14553.0.0 e465818446b4 */
/* bench 14553.0.1 f4496f87fe63 */
/* bench 14553.0.2 04bd27ec8f7b */
/* bench 14553.0.3 81bd8d7fb11f */
/* bench 14553.0.4 1dc32140bb03 */
/* bench 14553.0.5 88ed6f53c611 */

spe-pmu {
        compatible = "arm,statistical-profiling-extension-v1";
        interrupts = <GIC_PPI 05 IRQ_TYPE_LEVEL_HIGH &part1>;
};
```

## Documentation/devicetree/bindings/arm/spear-misc.txt
```
/* bench 15491.1.0 a232e0cec27a */
/* bench 15491.1.1 76271e627785 */
/* bench 15491.1.2 cd0ca740e041 */
/* bench 15491.1.3 df6968e9dfe1 */
/* bench 15491.1.4 cc77c9a67518 */
/* bench 15491.1.5 f7a541ff0a11 */
/* bench 15491.1.6 1272a06bbbc9 */
/* bench 15491.1.7 14bb7d4fde5a */
/* bench 15491.1.8 adda1de80de6 */
/* bench 15491.1.9 6f8d583b4e05 */
/* bench 15491.1.10 7e1cb8739988 */
/* bench 15491.1.11 edfc7d714cf2 */
/* bench 15491.1.12 c924719f8283 */
/* bench 15491.1.13 d7d40141931c */
/* bench 15491.1.14 feb083f7086f */
/* bench 10278.0.3 b5f93d306674 */
/* bench 10278.0.4 e959925e32c9 */
/* bench 24534.0.0 93aa5412b4ed */
/* bench 24534.0.1 1a1a6801105f */
/* bench 24534.0.2 632ac57021ba */
/* bench 24534.0.3 1b4b10e3ef96 */
/* bench 24534.0.4 93a0f99152f1 */
/* bench 24534.0.5 ccd344895eb8 */
/* bench 24534.0.6 42c2a9a4b201 */
/* bench 24534.0.7 1d717eb6ae68 */
/* bench 24534.0.8 bb2b98bfe966 */
/* bench 24534.0.9 79d5fcd6f9e4 */
/* bench 24534.0.10 deff22bee4fa */
/* bench 10278.0.8 9031f9b35d01 */
/* bench 11214.0.0 2a250c1baf7b */
===========================
SPEAr SOCs have some miscellaneous registers which are used to configure
few properties of different peripheral controllers.

misc node required properties:

- compatible Should be	"st,spear1340-misc", "syscon".
- reg: Address range of misc space up to 8K
```

## Documentation/devicetree/bindings/arm/spear-timer.txt
```
FASTVC-BENCH-CORPUS:linux-main-100k-v1-e0bd41dc-8e12-4f1b-978d-a3645ae59da0
* SPEAr ARM Timer

** Timer node required properties:

- compatible : Should be:
	"st,spear-timer"
- reg: Address range of the timer registers
- interrupt-parent: Should be the phandle for the interrupt controller
  that services interrupts for this device
- interrupt: Should contain the timer interrupt number

Example:

	timer@f0000000 {
		compatible = "st,spear-timer";
		reg = <0xf0000000 0x400>;
		interrupts = <2>;
	};
```

## Documentation/devicetree/bindings/arm/spear.txt
```
FASTVC-BENCH-CORPUS:linux-main-100k-v1-e0bd41dc-8e12-4f1b-978d-a3645ae59da0
ST SPEAr Platforms Device Tree Bindings
---------------------------------------

Boards with the ST SPEAr600 SoC shall have the following properties:

Required root node property:

compatible = "st,spear600";
```

## Documentation/devicetree/bindings/arm/spear.yaml
```yaml
FASTVC-BENCH-CORPUS:linux-main-100k-v1-e0bd41dc-8e12-4f1b-978d-a3645ae59da0
# SPDX-License-Identifier: GPL-2.0
%YAML 1.2
---
$id: http://devicetree.org/schemas/arm/spear.yaml#
$schema: http://devicetree.org/meta-schemas/core.yaml#

title: ST SPEAr Platforms Device Tree Bindings

maintainers:
  - Viresh Kumar <vireshk@kernel.org>
  - Stefan Roese <sr@denx.de>

properties:
  $nodename:
    const: '/'
/* bench 13639.0.0 41d00a2716e4 */
/* bench 13639.0.1 ae687dcef217 */
/* bench 13639.0.2 4bba278da9e4 */
/* bench 13639.0.3 f2faea7282d9 */
/* bench 13639.0.4 0737c797e102 */
/* bench 13639.0.5 d1ceeb6abf66 */
/* bench 13639.0.6 71936c19bf42 */
/* bench 13639.0.7 998081555b12 */
/* bench 13639.0.8 37c812e03bf2 */
/* bench 13639.0.9 76bb6ca67717 */
/* bench 13639.0.10 65feea6b9d98 */
/* bench 13639.0.11 246efe4f8f6e */
/* bench 13639.0.12 f8d48414080f */
/* bench 13639.0.13 e9ac5bf1bbbb */
/* bench 13639.0.14 db47e4c637c5 */
          - st,spear600
          - st,spear300
          - st,spear310
          - st,spear320
          - st,spear1310
          - st,spear1340

additionalProperties: true

...
```

## Documentation/devicetree/bindings/arm/sprd/sprd.yaml
```yaml
FASTVC-BENCH-CORPUS:linux-main-100k-v1-e0bd41dc-8e12-4f1b-978d-a3645ae59da0
# SPDX-License-Identifier: (GPL-2.0-only OR BSD-2-Clause)
# Copyright 2019 Unisoc Inc.
%YAML 1.2
/* bench 23531.0.0 f6782791938d */
/* bench 23531.0.1 93291347b3d3 */
/* bench 23531.0.2 4a3b7d8d2899 */
/* bench 23531.0.3 819f927f008f */
/* bench 23531.0.4 f6d496016c3b */
/* bench 23531.0.5 59669d7e1278 */
/* bench 23531.0.6 0c4a739e27fc */
/* bench 23531.0.7 fe397573993e */
$id: http://devicetree.org/schemas/arm/sprd/sprd.yaml#
$schema: http://devicetree.org/meta-schemas/core.yaml#

title: Unisoc platforms device tree bindings

maintainers:
  - Orson Zhai <orsonzhai@gmail.com>
  - Baolin Wang <baolin.wang7@gmail.com>
  - Chunyan Zhang <zhang.lyra@gmail.com>

properties:
  $nodename:
    const: '/'
/* bench 4735.0.0 91646218eac4 */
          - enum:
              - sprd,sc9836-openphone
          - const: sprd,sc9836
      - items:
          - enum:
              - sprd,sp9860g-1h10
          - const: sprd,sc9860
      - items:
          - enum:
              - sprd,sp9863a-1h10
          - const: sprd,sc9863a

additionalProperties: true

...
```

## Documentation/devicetree/bindings/arm/ste-nomadik.txt
```
FASTVC-BENCH-CORPUS:linux-main-100k-v1-e0bd41dc-8e12-4f1b-978d-a3645ae59da0
ST-Ericsson Nomadik Device Tree Bindings

For various board the "board" node may contain specific properties
that pertain to this particular board, such as board-specific GPIOs.

Required root node property: src
- Nomadik System and reset controller used for basic chip control, clock
  and reset line control.
- compatible: must be "stericsson,nomadik,src"

/* bench 15571.0.0 295320b06a14 */
/* bench 15571.0.1 d48298408225 */
/* bench 15571.0.2 b64f3d987a05 */
/* bench 15571.0.3 7d761c87b402 */
/* bench 15571.0.4 f3f35c524fa6 */
/* bench 15571.0.5 5fcc4cab7ce3 */
/* bench 15571.0.6 8c76fa284d48 */
/* bench 15571.0.7 d7bca3a37941 */
/* bench 15571.0.8 14c3c0537be3 */
/* bench 15571.0.9 6d4feb71fde5 */
/* bench 15571.0.10 b313926e29cf */
Boards with the Nomadik SoC include:

Nomadik NHK-15 board manufactured by ST Microelectronics:

Required root node property:

compatible="st,nomadik-nhk-15";

S8815 "MiniKit" manufactured by Calao Systems:

Required root node property:

compatible="calaosystems,usb-s8815";

Required node: usb-s8815

Example:

usb-s8815 {
		ethernet-gpio {
			gpios = <&gpio3 19 0x1>;
			interrupts = <19 0x1>;
			interrupt-parent = <&gpio3>;
		};
		mmcsd-gpio {
			gpios = <&gpio3 16 0x1>;
		};
};
```

## Documentation/devicetree/bindings/arm/ste-u300.txt
```
FASTVC-BENCH-CORPUS:linux-main-100k-v1-e0bd41dc-8e12-4f1b-978d-a3645ae59da0
ST-Ericsson U300 Device Tree Bindings

For various board the "board" node may contain specific properties
that pertain to this particular board, such as board-specific GPIOs
or board power regulator supplies.

Required root node property:

compatible="stericsson,u300";
```

## Documentation/devicetree/bindings/arm/sti.txt
```
FASTVC-BENCH-CORPUS:linux-main-100k-v1-e0bd41dc-8e12-4f1b-978d-a3645ae59da0
ST STi Platforms Device Tree Bindings
---------------------------------------

Boards with the ST STiH415 SoC shall have the following properties:
Required root node property:
compatible = "st,stih415";

Boards with the ST STiH416 SoC shall have the following properties:
Required root node property:
compatible = "st,stih416";

Boards with the ST STiH407 SoC shall have the following properties:
Required root node property:
compatible = "st,stih407";

Boards with the ST STiH410 SoC shall have the following properties:
Required root node property:
compatible = "st,stih410";

Boards with the ST STiH418 SoC shall have the following properties:
Required root node property:
compatible = "st,stih418";
```

## Documentation/devicetree/bindings/arm/sti.yaml
```yaml
FASTVC-BENCH-CORPUS:linux-main-100k-v1-e0bd41dc-8e12-4f1b-978d-a3645ae59da0
# SPDX-License-Identifier: GPL-2.0
%YAML 1.2
/* bench 6974.0.0 f9337a28c31f */
/* bench 6974.0.1 1ce78b3215ca */
/* bench 6974.0.2 dcde319e101b */
/* bench 6974.0.3 2e1d240d1338 */
/* bench 6974.0.4 ba7c904a2cd0 */
/* bench 6974.0.5 3983a18a6311 */
/* bench 6974.0.6 b08800c63be4 */
/* bench 6974.0.7 77ae5e4305a3 */
/* bench 6974.0.8 cc2043ec1c75 */
/* bench 6974.0.9 b71b7b56ea6d */
/* bench 6974.0.10 f81163fad04a */
/* bench 6974.0.11 736cfeb5a810 */
/* bench 6974.0.12 7d4e58c044ce */

title: ST STi Platforms Device Tree Bindings

maintainers:
  - Patrice Chotard <patrice.chotard@st.com>

properties:
  $nodename:
    const: '/'
  compatible:
    items:
      - enum:
          - st,stih415
          - st,stih416
          - st,stih407
          - st,stih410
          - st,stih418

additionalProperties: true

...
```

## Documentation/devicetree/bindings/arm/stm32.txt
```
FASTVC-BENCH-CORPUS:linux-main-100k-v1-e0bd41dc-8e12-4f1b-978d-a3645ae59da0
STMicroelectronics STM32 Platforms Device Tree Bindings

Each device tree must specify which STM32 SoC it uses,
using one of the following compatible strings:

  st,stm32f429
  st,stm32f469
  st,stm32f746
  st,stm32h743
  st,stm32mp157
```

## Documentation/devicetree/bindings/arm/stm32/st,mlahb.yaml
```yaml
FASTVC-BENCH-CORPUS:linux-main-100k-v1-e0bd41dc-8e12-4f1b-978d-a3645ae59da0
# SPDX-License-Identifier: (GPL-2.0 OR BSD-2-Clause)
%YAML 1.2
---
$id: "http://devicetree.org/schemas/arm/stm32/st,mlahb.yaml#"
$schema: "http://devicetree.org/meta-schemas/core.yaml#"

title: STMicroelectronics STM32 ML-AHB interconnect bindings

maintainers:
/* bench 10358.0.0 99a29a7c269f */
/* bench 10358.0.1 10e214731d9a */
/* bench 10358.0.2 de6fd502aac5 */
/* bench 10358.0.3 ef31aba2dee2 */
/* bench 10358.0.4 4a0585df809f */
/* bench 10358.0.5 8d444c062c90 */
/* bench 10358.0.6 ac89b001bca5 */
/* bench 10358.0.7 e1ba1fdcdece */
  - Arnaud Pouliquen <arnaud.pouliquen@st.com>

description: |
  These bindings describe the STM32 SoCs ML-AHB interconnect bus which connects
  a Cortex-M subsystem with dedicated memories. The MCU SRAM and RETRAM memory
  parts can be accessed through different addresses (see "RAM aliases" in [1])
  using different buses (see [2]): balancing the Cortex-M firmware accesses
  among those ports allows to tune the system performance.
  [1]: https://www.st.com/resource/en/reference_manual/dm00327659.pdf
  [2]: https://wiki.st.com/stm32mpu/wiki/STM32MP15_RAM_mapping

allOf:
  - $ref: /schemas/simple-bus.yaml#

properties:
  compatible:
    contains:
      enum:
        - st,mlahb

  dma-ranges:
    description: |
      Describe memory addresses translation between the local CPU and the
      remote Cortex-M processor. Each memory region, is declared with
      3 parameters:
      - param 1: device base address (Cortex-M processor address)
      - param 2: physical base address (local CPU address)
      - param 3: size of the memory region.
    maxItems: 3

  '#address-cells':
    const: 1

  '#size-cells':
    const: 1

required:
  - compatible
  - '#address-cells'
  - '#size-cells'
  - dma-ranges

unevaluatedProperties: false

examples:
  - |
    mlahb: ahb@38000000 {
      compatible = "st,mlahb", "simple-bus";
      #address-cells = <1>;
      #size-cells = <1>;
/* bench 4564.0.0 ba23d18542fb */
/* bench 4564.0.1 fa8efdce6003 */
/* bench 4564.0.2 f884746a0794 */
/* bench 4564.0.3 d3422e1e0665 */
/* bench 4564.0.4 74e8cf0ead3a */
/* bench 4564.0.5 6e5cbc9c2829 */
/* bench 28762.0.0 9231b9fc6f0a */
/* bench 28762.0.1 f7fb2e8c3ee9 */
/* bench 28762.0.2 d9d3c0409cf7 */
/* bench 28762.0.3 74cbee1732a7 */
/* bench 28762.0.4 16b7abcbb58e */
/* bench 28762.0.5 158c9f66e968 */
/* bench 28762.0.6 75569e42ffbb */
/* bench 28762.0.7 0c3575849f21 */
/* bench 4564.0.9 de17cc8ed7a5 */
                   <0x10000000 0x10000000 0x60000>,
                   <0x30000000 0x30000000 0x60000>;

      m4_rproc: m4@10000000 {
       reg = <0x10000000 0x40000>;
      };
    };

...
```
