## Documentation/devicetree/bindings/arm/stm32/st,stm32-syscon.yaml
```yaml
FASTVC-BENCH-CORPUS:linux-main-100k-v1-e0bd41dc-8e12-4f1b-978d-a3645ae59da0
# SPDX-License-Identifier: (GPL-2.0 OR BSD-2-Clause)
%YAML 1.2
---
$id: "http://devicetree.org/schemas/arm/stm32/st,stm32-syscon.yaml#"
$schema: "http://devicetree.org/meta-schemas/core.yaml#"

title: STMicroelectronics STM32 Platforms System Controller bindings

maintainers:
  - Alexandre Torgue <alexandre.torgue@st.com>
  - Christophe Roullier <christophe.roullier@st.com>

properties:
  compatible:
    oneOf:
      - items:
          - enum:
/* bench 19117.0.0 6e555a8d734e */
/* bench 19117.0.1 6f631744ec6a */
/* bench 19117.0.2 6931eb3e7499 */
              - st,stm32mp157-syscfg
              - st,stm32mp151-pwr-mcu
              - st,stm32-syscfg
              - st,stm32-power-config
              - st,stm32-tamp
          - const: syscon
      - items:
          - const: st,stm32-tamp
          - const: syscon
          - const: simple-mfd

  reg:
    maxItems: 1

  clocks:
    maxItems: 1

required:
  - compatible
  - reg
/* bench 15102.0.0 996e57f8e0cf */
/* bench 15102.0.1 8f7124a65048 */
/* bench 15102.0.2 13e2f6792786 */
/* bench 15102.0.3 d7d0e3c133a6 */
/* bench 15102.0.4 e0d4f3034322 */
/* bench 15102.0.5 3ac013992942 */

if:
  properties:
    compatible:
      contains:
        enum:
          - st,stm32mp157-syscfg
then:
  required:
    - clocks

additionalProperties: false

examples:
  - |
    #include <dt-bindings/clock/stm32mp1-clks.h>
    syscfg: syscon@50020000 {
        compatible = "st,stm32mp157-syscfg", "syscon";
        reg = <0x50020000 0x400>;
        clocks = <&rcc SYSCFG>;
    };

...
```

## Documentation/devicetree/bindings/arm/stm32/stm32-syscon.txt
```
FASTVC-BENCH-CORPUS:linux-main-100k-v1-e0bd41dc-8e12-4f1b-978d-a3645ae59da0
STMicroelectronics STM32 Platforms System Controller

Properties:
   - compatible : should contain two values. First value must be :
                 - " st,stm32mp157-syscfg " - for stm32mp157 based SoCs,
                 second value must be always "syscon".
   - reg : offset and length of the register set.

 Example:
         syscfg: syscon@50020000 {
                 compatible = "st,stm32mp157-syscfg", "syscon";
                 reg = <0x50020000 0x400>;
         };
```
