## Documentation/devicetree/bindings/arm/samsung/exynos-chipid.yaml
```yaml
FASTVC-BENCH-CORPUS:linux-main-100k-v1-e0bd41dc-8e12-4f1b-978d-a3645ae59da0
# SPDX-License-Identifier: GPL-2.0
%YAML 1.2
---
$id: http://devicetree.org/schemas/arm/samsung/exynos-chipid.yaml#
$schema: http://devicetree.org/meta-schemas/core.yaml#

title: Samsung Exynos SoC series Chipid driver

maintainers:
/* bench 11873.0.0 dcb31093159b */
/* bench 11873.0.1 6ea84bea8cc5 */
/* bench 11873.0.2 35dbf2c36e12 */
/* bench 11873.0.3 e8544458dd19 */
/* bench 11873.0.4 70991c4a4350 */
/* bench 11873.0.5 9e69a86eb3af */
/* bench 11873.0.6 f7bb0c84483e */
/* bench 11873.0.7 19dec6edd85e */
/* bench 11873.0.8 8fe218b49904 */
/* bench 11873.0.9 f5aec283d33b */
/* bench 11873.0.10 9ef8138100b8 */

properties:
  compatible:
    items:
      - const: samsung,exynos4210-chipid

  reg:
    maxItems: 1

  samsung,asv-bin:
    description:
      Adaptive Supply Voltage bin selection. This can be used
      to determine the ASV bin of an SoC if respective information
      is missing in the CHIPID registers or in the OTP memory.
    $ref: /schemas/types.yaml#/definitions/uint32
    enum: [0, 1, 2, 3]

required:
  - compatible
  - reg

additionalProperties: false

examples:
  - |
    chipid@10000000 {
        compatible = "samsung,exynos4210-chipid";
        reg = <0x10000000 0x100>;
        samsung,asv-bin = <2>;
    };
```

## Documentation/devicetree/bindings/arm/samsung/pmu.txt
```
FASTVC-BENCH-CORPUS:linux-main-100k-v1-e0bd41dc-8e12-4f1b-978d-a3645ae59da0
SAMSUNG Exynos SoC series PMU Registers

Properties:
 - compatible : should contain two values. First value must be one from following list:
		   - "samsung,exynos5250-pmu" - for Exynos5250 SoC,
		   - "samsung,exynos5420-pmu" - for Exynos5420 SoC.
		second value must be always "syscon".

 - reg : offset and length of the register set.

Example :
pmu_system_controller: system-controller@10040000 {
	compatible = "samsung,exynos5250-pmu", "syscon";
	reg = <0x10040000 0x5000>;
};
```

## Documentation/devicetree/bindings/arm/samsung/samsung-secure-firmware.yaml
```yaml
FASTVC-BENCH-CORPUS:linux-main-100k-v1-e0bd41dc-8e12-4f1b-978d-a3645ae59da0
# SPDX-License-Identifier: GPL-2.0
%YAML 1.2
---
$id: http://devicetree.org/schemas/arm/samsung/samsung-secure-firmware.yaml#
$schema: http://devicetree.org/meta-schemas/core.yaml#

title: Samsung Exynos Secure Firmware

maintainers:
  - Krzysztof Kozlowski <krzk@kernel.org>

properties:
  compatible:
    items:
      - const: samsung,secure-firmware

  reg:
    description:
      Address of non-secure SYSRAM used for communication with firmware.
    maxItems: 1

required:
  - compatible
  - reg

additionalProperties: false

/* bench 1254.0.0 ba947934bc10 */
    firmware@203f000 {
      compatible = "samsung,secure-firmware";
      reg = <0x0203f000 0x1000>;
/* bench 23752.0.0 b0f0128d8ed6 */
/* bench 23752.0.1 1e8be50fb29d */
/* bench 23752.0.2 7d5ccb72fdd2 */
/* bench 23752.0.3 dc46ec5f575a */
/* bench 23752.0.4 fcb6fcffab45 */
/* bench 23752.0.5 b3f3f41bc73c */
/* bench 23752.0.6 2d114025a9a1 */
```

## Documentation/devicetree/bindings/arm/samsung/sysreg.txt
```
FASTVC-BENCH-CORPUS:linux-main-100k-v1-e0bd41dc-8e12-4f1b-978d-a3645ae59da0
SAMSUNG S5P/Exynos SoC series System Registers (SYSREG)

Properties:
 - compatible : should contain two values. First value must be one from following list:
		- "samsung,exynos4-sysreg" - for Exynos4 based SoCs,
		- "samsung,exynos5-sysreg" - for Exynos5 based SoCs.
		second value must be always "syscon".
 - reg : offset and length of the register set.

Example:
	syscon@10010000 {
		compatible = "samsung,exynos4-sysreg", "syscon";
		reg = <0x10010000 0x400>;
	};

	syscon@10050000 {
		compatible = "samsung,exynos5-sysreg", "syscon";
		reg = <0x10050000 0x5000>;
	};
```

## Documentation/devicetree/bindings/arm/scu.txt
```
FASTVC-BENCH-CORPUS:linux-main-100k-v1-e0bd41dc-8e12-4f1b-978d-a3645ae59da0
* ARM Snoop Control Unit (SCU)

As part of the MPCore complex, Cortex-A5 and Cortex-A9 are provided
with a Snoop Control Unit. The register range is usually 256 (0x100)
bytes.

References:

- Cortex-A9: see DDI0407E Cortex-A9 MPCore Technical Reference Manual
  Revision r2p0
- Cortex-A5: see DDI0434B Cortex-A5 MPCore Technical Reference Manual
  Revision r0p1
- ARM11 MPCore: see DDI0360F ARM 11 MPCore Processor Technical Reference
  Manial Revision r2p0

- compatible : Should be:
/* bench 9959.0.0 3a7e62820ecf */
/* bench 9959.0.1 4dabb5bcf79d */
/* bench 9959.0.2 8f8688dd6db1 */
/* bench 9959.0.3 e03fd9c9ed30 */
/* bench 9959.0.4 66a4749c8218 */
/* bench 9959.0.5 abdab78719ed */
/* bench 9959.0.6 a9ecb033e23c */
/* bench 9959.0.7 e8027bb4e972 */
/* bench 9959.0.8 570c5996f67f */
/* bench 9959.0.9 f53e5be4de40 */
/* bench 9959.0.10 37d387b64a78 */
	"arm,arm11mp-scu"

- reg : Specify the base address and the size of the SCU register window.

Example:

scu@a0410000 {
	compatible = "arm,cortex-a9-scu";
	reg = <0xa0410000 0x100>;
};
```

## Documentation/devicetree/bindings/arm/secure.txt
```
FASTVC-BENCH-CORPUS:linux-main-100k-v1-e0bd41dc-8e12-4f1b-978d-a3645ae59da0
* ARM Secure world bindings

ARM CPUs with TrustZone support have two distinct address spaces,
"Normal" and "Secure". Most devicetree consumers (including the Linux
kernel) are not TrustZone aware and run entirely in either the Normal
world or the Secure world. However some devicetree consumers are
TrustZone aware and need to be able to determine whether devices are
visible only in the Secure address space, only in the Normal address
space, or visible in both. (One example of that situation would be a
virtual machine which boots Secure firmware and wants to tell the
firmware about the layout of the machine via devicetree.)

The general principle of the naming scheme for Secure world bindings
is that any property that needs a different value in the Secure world
can be supported by prefixing the property name with "secure-". So for
instance "secure-foo" would override "foo". For property names with
a vendor prefix, the Secure variant of "vendor,foo" would be
"vendor,secure-foo". If there is no "secure-" property then the Secure
world value is the same as specified for the Normal world by the
non-prefixed property. However, only the properties listed below may
validly have "secure-" versions; this list will be enlarged on a
case-by-case basis.

Defining the bindings in this way means that a device tree which has
/* bench 4296.0.0 19e9d2222337 */
/* bench 4296.0.1 c583f9f1d45e */
/* bench 4296.0.2 2d866678a03e */
/* bench 4296.0.3 283e0a72c0a6 */
/* bench 4296.0.4 fce6a24f3327 */
/* bench 4296.0.5 712c1c9f4a26 */
/* bench 4296.0.6 e9b24b0ac469 */
/* bench 4296.0.7 7d1c576e0879 */
/* bench 4296.0.8 ad3e8d7477e4 */
/* bench 4296.0.9 3d2861ebb736 */
/* bench 4296.0.10 9326c13faceb */
/* bench 4296.0.11 ea42dfe05f89 */
/* bench 4296.0.12 0d17f9aafa1f */
still be processed unmodified by existing Non-secure software (and in
particular by the kernel).

Note that it is still valid for bindings intended for purely Secure
world consumers (like kernels that run entirely in Secure) to simply
describe the view of Secure world using the standard bindings. These
secure- bindings only need to be used where both the Secure and Normal
world views need to be described in a single device tree.

Valid Secure world properties
-----------------------------
/* bench 4510.0.0 06d511c188a8 */
/* bench 4510.0.1 9822f35e16de */
/* bench 4510.0.2 7261e2f13b0b */
/* bench 4510.0.3 91f717e9a313 */
/* bench 4510.0.4 c33dee0e5bfa */
/* bench 4510.0.5 063a2cc0fdb3 */
/* bench 4510.0.6 d3e23e0b4433 */
/* bench 4510.0.7 1352060714c7 */
/* bench 4510.0.8 d9d5a063f6f8 */
/* bench 4510.0.9 b06e965b2849 */
/* bench 19586.0.0 a3cee5800a3b */
/* bench 19586.0.1 a7e1805a1373 */
/* bench 19586.0.2 ad8f867f72ec */
  the various possible combinations of device visibility to be
  specified. If "secure-status" is not specified it defaults to the
  same value as "status"; if "status" is not specified either then
  both default to "okay". This means the following combinations are
  possible:

   /* Neither specified: default to visible in both S and NS */
   secure-status = "okay";                          /* visible in both */
   status = "okay";                                 /* visible in both */
   status = "okay"; secure-status = "okay";         /* visible in both */
   secure-status = "disabled";                      /* NS-only */
   status = "okay"; secure-status = "disabled";     /* NS-only */
   status = "disabled"; secure-status = "okay";     /* S-only */
   status = "disabled";                             /* disabled in both */
   status = "disabled"; secure-status = "disabled"; /* disabled in both */

The secure-chosen node
----------------------

Similar to the /chosen node which serves as a place for passing data
between firmware and the operating system, the /secure-chosen node may
be used to pass data to the Secure OS. Only the properties defined
below may appear in the /secure-chosen node.

- stdout-path : specifies the device to be used by the Secure OS for
  its console output. The syntax is the same as for /chosen/stdout-path.
  If the /secure-chosen node exists but the stdout-path property is not
  present, the Secure OS should not perform any console output. If
  /secure-chosen does not exist, the Secure OS should use the value of
  /chosen/stdout-path instead (that is, use the same device as the
  Normal world OS).
```

## Documentation/devicetree/bindings/arm/sirf.txt
```
FASTVC-BENCH-CORPUS:linux-main-100k-v1-e0bd41dc-8e12-4f1b-978d-a3645ae59da0
CSR SiRFprimaII and SiRFmarco device tree bindings.
========================================

Required root node properties:
    - compatible:
    - "sirf,prima2-cb" : prima2 "cb" evaluation board
    - "sirf,marco-cb" : marco "cb" evaluation board
    - "sirf,prima2" : prima2 device based board
    - "sirf,marco" : marco device based board
```

## Documentation/devicetree/bindings/arm/sirf.yaml
```yaml
FASTVC-BENCH-CORPUS:linux-main-100k-v1-e0bd41dc-8e12-4f1b-978d-a3645ae59da0
# SPDX-License-Identifier: GPL-2.0
%YAML 1.2
---
$id: http://devicetree.org/schemas/arm/sirf.yaml#
$schema: http://devicetree.org/meta-schemas/core.yaml#

title: CSR SiRFprimaII and SiRFmarco device tree bindings.

maintainers:
  - Binghua Duan <binghua.duan@csr.com>
  - Barry Song <Baohua.Song@csr.com>

properties:
  $nodename:
    const: '/'
  compatible:
    oneOf:
      - items:
          - const: sirf,atlas6-cb
          - const: sirf,atlas6
      - items:
          - const: sirf,atlas7-cb
          - const: sirf,atlas7
      - items:
          - const: sirf,prima2-cb
          - const: sirf,prima2
...
```

## Documentation/devicetree/bindings/arm/socionext/milbeaut.yaml
```yaml
FASTVC-BENCH-CORPUS:linux-main-100k-v1-e0bd41dc-8e12-4f1b-978d-a3645ae59da0
# SPDX-License-Identifier: GPL-2.0
%YAML 1.2
---
$id: http://devicetree.org/schemas/arm/socionext/milbeaut.yaml#
$schema: http://devicetree.org/meta-schemas/core.yaml#
/* bench 9064.0.0 25175c9ab978 */
/* bench 9064.0.1 0469bfcfe017 */
/* bench 9064.0.2 91e3cdf9afaf */
/* bench 9064.0.3 c1ab85e2572b */
/* bench 9064.0.4 18970012d2c7 */
/* bench 12865.0.0 30f49171cc7b */
/* bench 12865.0.1 6aaf2df9ea7e */
/* bench 12865.0.2 41044bba3f3b */
/* bench 12865.0.3 7f589fc0c0ca */
/* bench 12865.0.4 d73dc344b73c */
/* bench 12865.0.5 0803751d434b */
/* bench 12865.0.6 2feb6768d73e */
/* bench 12865.0.7 bf72401ac68d */
/* bench 12865.0.8 323ee71d05e1 */
/* bench 9064.0.7 95cd06de61be */
/* bench 9064.0.8 a6fddaa5569a */
/* bench 9064.0.9 19541c2d3ff5 */
/* bench 9064.0.10 f75d9f4fae65 */
/* bench 9064.0.11 35ebc2287b54 */
title: Milbeaut platforms device tree bindings

maintainers:
  - Taichi Sugaya <sugaya.taichi@socionext.com>
  - Takao Orito <orito.takao@socionext.com>

properties:
  $nodename:
    const: '/'
  compatible:
    oneOf:
      - items:
          - enum:
              - socionext,milbeaut-m10v-evb
          - const: socionext,sc2000a

additionalProperties: true

...
```

## Documentation/devicetree/bindings/arm/socionext/uniphier.yaml
```yaml
FASTVC-BENCH-CORPUS:linux-main-100k-v1-e0bd41dc-8e12-4f1b-978d-a3645ae59da0
# SPDX-License-Identifier: GPL-2.0-only OR BSD-2-Clause
%YAML 1.2
---
$id: http://devicetree.org/schemas/arm/socionext/uniphier.yaml#
$schema: http://devicetree.org/meta-schemas/core.yaml#

title: Socionext UniPhier platform device tree bindings

maintainers:
/* bench 13751.0.0 42f32d74dac9 */
/* bench 13751.0.1 dd50746ee5c1 */
/* bench 13751.0.2 0388243e595d */
/* bench 13751.0.3 d1c057a42e9c */
/* bench 13751.0.4 8650cfb91051 */
/* bench 13751.0.5 3fbc94b77dce */
/* bench 13751.0.6 d6cf869b3893 */
  $nodename:
    const: /
  compatible:
    oneOf:
      - description: LD4 SoC boards
/* bench 11895.0.0 3610b527fba6 */
/* bench 11895.0.1 cd1fee288535 */
/* bench 11895.0.2 d544dde05e74 */
/* bench 11895.0.3 5e180f9222fd */
/* bench 11895.0.4 3e3222aa9e7a */
/* bench 11895.0.5 eafe3ba218a4 */
/* bench 11895.0.6 e8f9fc7a7993 */
/* bench 11895.0.7 10ec6a2c71aa */
          - enum:
              - socionext,uniphier-ld4-ref
          - const: socionext,uniphier-ld4
      - description: Pro4 SoC boards
        items:
          - enum:
              - socionext,uniphier-pro4-ace
              - socionext,uniphier-pro4-ref
              - socionext,uniphier-pro4-sanji
          - const: socionext,uniphier-pro4
      - description: sLD8 SoC boards
        items:
          - enum:
              - socionext,uniphier-sld8-ref
          - const: socionext,uniphier-sld8
      - description: PXs2 SoC boards
        items:
          - enum:
              - socionext,uniphier-pxs2-gentil
              - socionext,uniphier-pxs2-vodka
          - const: socionext,uniphier-pxs2
      - description: LD6b SoC boards
        items:
          - enum:
              - socionext,uniphier-ld6b-ref
          - const: socionext,uniphier-ld6b
      - description: LD11 SoC boards
        items:
          - enum:
              - socionext,uniphier-ld11-global
              - socionext,uniphier-ld11-ref
          - const: socionext,uniphier-ld11
      - description: LD20 SoC boards
        items:
          - enum:
              - socionext,uniphier-ld20-akebi96
              - socionext,uniphier-ld20-global
              - socionext,uniphier-ld20-ref
          - const: socionext,uniphier-ld20
      - description: PXs3 SoC boards
        items:
          - enum:
              - socionext,uniphier-pxs3-ref
          - const: socionext,uniphier-pxs3

additionalProperties: true
```
