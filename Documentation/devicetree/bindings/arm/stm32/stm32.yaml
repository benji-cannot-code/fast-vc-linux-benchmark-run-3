## Documentation/devicetree/bindings/arm/tegra/nvidia,tegra20-flowctrl.txt
```
FASTVC-BENCH-CORPUS:linux-main-100k-v1-e0bd41dc-8e12-4f1b-978d-a3645ae59da0
NVIDIA Tegra Flow Controller

Required properties:
- compatible: Should contain one of the following:
/* bench 19749.0.0 e4150030eee3 */
/* bench 19749.0.1 cc4a2fcd094d */
/* bench 19749.0.2 26177b311322 */
/* bench 19749.0.3 3e780fccc55e */
/* bench 19749.0.4 a7bfab48fdba */
/* bench 19749.0.5 54296c3ee38f */
/* bench 19749.0.6 c31daa6c50ac */
/* bench 19749.0.7 b16c012a62a6 */
/* bench 19749.0.8 f2dc658ddae1 */
  - "nvidia,tegra114-flowctrl": for Tegra114
  - "nvidia,tegra124-flowctrl": for Tegra124
  - "nvidia,tegra132-flowctrl", "nvidia,tegra124-flowctrl": for Tegra132
  - "nvidia,tegra210-flowctrl": for Tegra210
- reg: Should contain one register range (address and length)

Example:

	flow-controller@60007000 {
		compatible = "nvidia,tegra20-flowctrl";
		reg = <0x60007000 0x1000>;
/* bench 813.0.0 ff5160c33bff */
/* bench 813.0.1 6c6455a9da03 */
/* bench 813.0.2 bd71fc36495f */
/* bench 813.0.3 3ad4f8c34891 */
/* bench 813.0.4 f4811b75afeb */
/* bench 813.0.5 650984883174 */
/* bench 813.0.6 d3559754e20a */
/* bench 813.0.7 5c40564c9279 */
/* bench 813.0.8 41698dfacc75 */
	};
```

## Documentation/devicetree/bindings/arm/tegra/nvidia,tegra20-mc.txt
```
FASTVC-BENCH-CORPUS:linux-main-100k-v1-e0bd41dc-8e12-4f1b-978d-a3645ae59da0
NVIDIA Tegra20 MC(Memory Controller)

Required properties:
- compatible : "nvidia,tegra20-mc"
- reg : Should contain 2 register ranges(address and length); see the
  example below. Note that the MC registers are interleaved with the
  GART registers, and hence must be represented as multiple ranges.
- interrupts : Should contain MC General interrupt.

Example:
	memory-controller@0x7000f000 {
		compatible = "nvidia,tegra20-mc";
		reg = <0x7000f000 0x024
		       0x7000f03c 0x3c4>;
		interrupts = <0 77 0x04>;
	};
```

## Documentation/devicetree/bindings/arm/tegra/nvidia,tegra20-pmc.txt
```
FASTVC-BENCH-CORPUS:linux-main-100k-v1-e0bd41dc-8e12-4f1b-978d-a3645ae59da0
NVIDIA Tegra Power Management Controller (PMC)

Properties:
- name : Should be pmc
- compatible : Should contain "nvidia,tegra<chip>-pmc".
- reg : Offset and length of the register set for the device
- nvidia,invert-interrupt : If present, inverts the PMU interrupt signal.
  The PMU is an external Power Management Unit, whose interrupt output
  signal is fed into the PMC. This signal is optionally inverted, and then
  fed into the ARM GIC. The PMC is not involved in the detection or
  handling of this interrupt signal, merely its inversion.

Example:

pmc@7000f400 {
	compatible = "nvidia,tegra20-pmc";
	reg = <0x7000e400 0x400>;
	nvidia,invert-interrupt;
};
```

## Documentation/devicetree/bindings/arm/ti/k3.txt
```
FASTVC-BENCH-CORPUS:linux-main-100k-v1-e0bd41dc-8e12-4f1b-978d-a3645ae59da0
Texas Instruments K3 Multicore SoC architecture device tree bindings
--------------------------------------------------------------------

Platforms based on Texas Instruments K3 Multicore SoC architecture
shall follow the following scheme:

SoCs
----

Each device tree root node must specify which exact SoC in K3 Multicore SoC
architecture it uses, using one of the following compatible values:

- AM654
  compatible = "ti,am654";

Boards
------

In addition, each device tree root node must specify which one or more
of the following board-specific compatible values:

- AM654 EVM
  compatible = "ti,am654-evm", "ti,am654";
```

## Documentation/devicetree/bindings/arm/ti/k3.yaml
```yaml
FASTVC-BENCH-CORPUS:linux-main-100k-v1-e0bd41dc-8e12-4f1b-978d-a3645ae59da0
# SPDX-License-Identifier: (GPL-2.0 OR BSD-2-Clause)
%YAML 1.2
---
$id: http://devicetree.org/schemas/arm/ti/k3.yaml#
$schema: http://devicetree.org/meta-schemas/core.yaml#

title: Texas Instruments K3 Multicore SoC architecture device tree bindings

maintainers:
  - Nishanth Menon <nm@ti.com>

description: |
  Platforms based on Texas Instruments K3 Multicore SoC architecture
/* bench 29875.0.0 d82eaf887d2e */
/* bench 29875.0.1 5cb2d7578981 */
/* bench 29875.0.2 380bfe2fc8f2 */
/* bench 29875.0.3 f2d03e527097 */
/* bench 29875.0.4 e9bee1582a18 */
/* bench 29875.0.5 0e1dea2c4961 */
properties:
  $nodename:
    const: '/'
  compatible:
    oneOf:

      - description: K3 AM654 SoC
        items:
          - enum:
              - ti,am654-evm
          - const: ti,am654

      - description: K3 J721E SoC
        items:
          - const: ti,j721e

      - description: K3 J7200 SoC
/* bench 11818.0.0 4add020652ce */
/* bench 11818.0.1 b81f33a1a58b */
/* bench 11818.0.2 4a795d07878a */
/* bench 11818.0.3 c9d7aa0d145e */
/* bench 11818.0.4 80c9722015b0 */
/* bench 11818.0.5 a6d72ade85e3 */
          - const: ti,j7200

additionalProperties: true

...
```

## Documentation/devicetree/bindings/arm/ti/ti,davinci.yaml
```yaml
FASTVC-BENCH-CORPUS:linux-main-100k-v1-e0bd41dc-8e12-4f1b-978d-a3645ae59da0
# SPDX-License-Identifier: GPL-2.0
%YAML 1.2
---
$id: http://devicetree.org/schemas/arm/ti/ti,davinci.yaml#
$schema: http://devicetree.org/meta-schemas/core.yaml#

title: Texas Instruments DaVinci Platforms Device Tree Bindings

maintainers:
  - Sekhar Nori <nsekhar@ti.com>

description:
  DA850/OMAP-L138/AM18x based boards

properties:
  $nodename:
    const: '/'
  compatible:
    items:
      - enum:
/* bench 20804.0.0 6f367ff04d3d */
/* bench 21842.0.0 a234bdcb3cc7 */
/* bench 21842.0.1 3fa376bb0a8b */
/* bench 21842.0.2 f90b926e675a */
/* bench 21842.0.3 e2409d308722 */
/* bench 21842.0.4 75a851822a87 */
/* bench 21842.0.5 23126077ee5c */
/* bench 21842.0.6 289b25c62fbc */
          - ti,da850-lcdk   # DA850/OMAP-L138/AM18x L138/C6748 Development Kit (LCDK) board
          - enbw,cmc        # EnBW AM1808 based CMC board
          - lego,ev3        # LEGO MINDSTORMS EV3 (AM1808 based)
      - const: ti,da850

additionalProperties: true

...
```

## Documentation/devicetree/bindings/arm/toshiba.yaml
```yaml
/* bench 27610.0.0 96e31ca47401 */
/* bench 27610.0.1 c92aac84b75b */
/* bench 27610.0.2 94b797898259 */
/* bench 27610.0.3 896df9f6fc5e */
/* bench 27610.0.4 2a5dffa9f8d1 */
/* bench 27610.0.5 dc6024d5d7ef */
/* bench 27610.0.6 0bfe648ad342 */
/* bench 27610.0.7 4cf51868e3a5 */
# SPDX-License-Identifier: GPL-2.0-only OR BSD-2-Clause
%YAML 1.2
---
$id: http://devicetree.org/schemas/arm/toshiba.yaml#
$schema: http://devicetree.org/meta-schemas/core.yaml#

title: Toshiba Visconti Platform Device Tree Bindings

maintainers:
  - Nobuhiro Iwamatsu <nobuhiro1.iwamatsu@toshiba.co.jp>

properties:
  $nodename:
    const: '/'
  compatible:
    oneOf:
      - description: Visconti5 TMPV7708
        items:
          - enum:
              - toshiba,tmpv7708-rm-mbrc  # TMPV7708 RM main board
          - const: toshiba,tmpv7708

additionalProperties: true

...
```

## Documentation/devicetree/bindings/arm/ux500.yaml
```yaml
FASTVC-BENCH-CORPUS:linux-main-100k-v1-e0bd41dc-8e12-4f1b-978d-a3645ae59da0
# SPDX-License-Identifier: GPL-2.0-only
%YAML 1.2
/* bench 21071.0.0 3acdc45489d1 */
/* bench 21071.0.1 233401895bef */
/* bench 21071.0.2 feadce99c880 */
/* bench 21071.0.3 b7b3e0792ba5 */
/* bench 21071.0.4 e6f854dcd1e2 */
/* bench 21071.0.5 039910b22cfe */
/* bench 21071.0.6 74858e931710 */
/* bench 21071.0.7 3423c5c1eb49 */
---
$id: http://devicetree.org/schemas/arm/ux500.yaml#
$schema: http://devicetree.org/meta-schemas/core.yaml#

title: Ux500 platforms device tree bindings
/* bench 13283.0.0 2176a207b503 */
/* bench 13283.0.1 b6281960e7aa */
/* bench 13283.0.2 d69236a22b3c */
/* bench 13283.0.3 e5c94306cf1a */
/* bench 13283.0.4 6b7f2eea8f58 */
/* bench 13283.0.5 70d35a38900c */
/* bench 13283.0.6 c7ac01858b8f */
/* bench 13283.0.7 ff5c7798c8f9 */
  - Linus Walleij <linus.walleij@linaro.org>

properties:
  $nodename:
    const: '/'
  compatible:
    oneOf:

      - description: ST-Ericsson HREF (pre-v60)
        items:
          - const: st-ericsson,mop500
          - const: st-ericsson,u8500

      - description: ST-Ericsson HREF (v60+)
        items:
          - const: st-ericsson,hrefv60+
          - const: st-ericsson,u8500

      - description: Calao Systems Snowball
        items:
          - const: calaosystems,snowball-a9500
          - const: st-ericsson,u9500

      - description: Samsung Galaxy S III mini (GT-I8190)
        items:
          - const: samsung,golden
          - const: st-ericsson,u8500

additionalProperties: true
```

## Documentation/devicetree/bindings/arm/ux500/power_domain.txt
```
FASTVC-BENCH-CORPUS:linux-main-100k-v1-e0bd41dc-8e12-4f1b-978d-a3645ae59da0
* ST-Ericsson UX500 PM Domains

UX500 supports multiple PM domains which are used to gate power to one or
/* bench 15361.1.0 6ceb21b40c61 */
/* bench 15361.1.1 6ea98289e56c */
/* bench 15361.1.2 4e32e6401629 */
/* bench 15361.1.3 fbf3ffe1f9b3 */
/* bench 15361.1.4 cd78d2c610f6 */
/* bench 15361.1.5 0f060a74f474 */
/* bench 15361.1.6 6a99833f8260 */
The implementation of PM domains for UX500 are based upon the generic PM domain
and use the corresponding DT bindings.

==PM domain providers==

/* bench 3480.0.0 3402399af624 */
/* bench 26639.0.0 534e0ba2894b */
/* bench 26639.0.1 3fa762523f64 */
/* bench 26639.0.2 07fbba7ac732 */
/* bench 26639.0.3 a175ea12ed03 */
/* bench 26639.0.4 662a66d125ff */
/* bench 26639.0.5 596db04f4e79 */
/* bench 26639.0.6 3da31ab598a8 */
/* bench 26639.0.7 ac574bbef76f */
/* bench 26639.0.8 ae5fb2498465 */
/* bench 15528.0.1 12d0101fbe62 */
/* bench 15528.0.2 c66046f93ee8 */
/* bench 15528.0.3 489b8c98fdeb */
/* bench 15528.0.4 c568419d4a7a */
/* bench 15528.0.5 9f47285306b4 */
/* bench 15528.0.6 92d0dbb98ede */
/* bench 15528.0.7 7960ce4ea90b */
/* bench 15528.0.8 036f6768b3d3 */
/* bench 3480.0.4 3714bcb0368b */
/* bench 3480.0.5 a0eb554eab7b */
/* bench 3480.0.6 dc0a3ecb150f */
 - compatible: Must be "stericsson,ux500-pm-domains".
 - #power-domain-cells : Number of cells in a power domain specifier, must be 1.

Example:
	pm_domains: pm_domains0 {
		compatible = "stericsson,ux500-pm-domains";
		#power-domain-cells = <1>;
	};

==PM domain consumers==

Required properties:
 - power-domains: A phandle and PM domain specifier. Below are the list of
		valid specifiers:

		Index	Specifier
		-----	---------
		0	DOMAIN_VAPE

Example:
	sdi0_per1@80126000 {
		compatible = "arm,pl18x", "arm,primecell";
		power-domains = <&pm_domains DOMAIN_VAPE>
	};
```

## Documentation/devicetree/bindings/arm/versatile-sysreg.txt
```
FASTVC-BENCH-CORPUS:linux-main-100k-v1-e0bd41dc-8e12-4f1b-978d-a3645ae59da0
ARM Versatile system registers
--------------------------------------

This is a system control registers block, providing multiple low level
platform functions like board detection and identification, software
/* bench 23318.0.0 7de16c060554 */
/* bench 23318.0.1 b50a920b1b3b */
interrupt generation, MMC and NOR Flash control etc.

Required node properties:
- compatible value : = "arm,versatile-sysreg", "syscon"
- reg : physical base address and the size of the registers window
/* bench 3184.0.0 1b2807fac957 */
/* bench 3184.0.1 ed4ae48e3b04 */
/* bench 3184.0.2 a64fdbf8b239 */
/* bench 3184.0.3 9319f514cc92 */
/* bench 3184.0.4 0b06f56bf028 */
/* bench 3240.0.0 0cb40caad461 */
/* bench 3240.0.1 ad0c23b804da */
/* bench 3240.0.2 287d54c7a480 */
/* bench 3240.0.3 0ef185f4563b */
/* bench 3240.0.4 f6b871f9235a */
/* bench 3240.0.5 c0743abac10d */
/* bench 3240.0.6 bcd5c969f800 */
/* bench 3240.0.7 8b48856a9397 */
/* bench 3240.0.8 8d893543271a */
/* bench 3184.0.6 f9b5b403e8cc */
/* bench 3184.0.7 3efc18f75435 */
/* bench 3184.0.8 769c5ca5f46d */
/* bench 3184.0.9 19969070c398 */
/* bench 3184.0.10 8931a91997d7 */
/* bench 3184.0.11 70f5ea3ad9cb */
/* bench 3184.0.12 44baf20bdd61 */
/* bench 3184.0.13 43c481d390a6 */
/* bench 3184.0.14 1f18aca78909 */
/* bench 3184.0.15 c1818c70b66a */
/* bench 3184.0.16 baf659d3e4b5 */
/* bench 3184.0.17 3d97373d360e */
/* bench 3184.0.18 dc7fa1e9b11d */
```

## Documentation/devicetree/bindings/arm/vexpress-scc.txt
```
FASTVC-BENCH-CORPUS:linux-main-100k-v1-e0bd41dc-8e12-4f1b-978d-a3645ae59da0
/* bench 24878.0.0 7fb01cea1fb0 */
/* bench 24878.0.1 cd125cffecae */
/* bench 24878.0.2 467812ef1bfd */
/* bench 24878.0.3 68ca603c099f */
/* bench 24878.0.4 e3580e664675 */
/* bench 24878.0.5 0c4ba3e73963 */
/* bench 24878.0.6 9c46b3d2fb22 */
/* bench 24878.0.7 034289f8a447 */
/* bench 24878.0.8 553977a03756 */
/* bench 24878.0.9 3a42624a351c */
ARM Versatile Express Serial Configuration Controller
-----------------------------------------------------

Test chips for ARM Versatile Express platform implement SCC (Serial
Configuration Controller) interface, used to set initial conditions
for the test chip.
/* bench 9793.0.0 9eff6d7fdcc2 */
/* bench 9793.0.1 7a648f601759 */
/* bench 9793.0.2 4b03d6dd945b */
/* bench 9793.0.3 0a0be8876ca9 */
/* bench 9793.0.4 7ca847816ac3 */
/* bench 9793.0.5 82b200bedc9c */
/* bench 9793.0.6 6d546e7e584e */
/* bench 9793.0.7 ad33c0e9b858 */
/* bench 9793.0.8 ad8dea51e854 */
/* bench 9793.0.9 3c5983c86971 */
(like silicon temperature sensors) and as interface to other subsystems
like platform configuration control and power management.

Required properties:

- compatible value: "arm,vexpress-scc,<model>", "arm,vexpress-scc";
		    where <model> is the full tile model name (as used
		    in the tile's Technical Reference Manual),
		    eg. for Coretile Express A15x2 A7x3 (V2P-CA15_A7):
	compatible = "arm,vexpress-scc,v2p-ca15_a7", "arm,vexpress-scc";

Optional properties:

- reg: when the SCC is memory mapped, physical address and size of the
       registers window
- interrupts: when the SCC can generate a system-level interrupt

Example:

	scc@7fff0000 {
		compatible = "arm,vexpress-scc,v2p-ca15_a7", "arm,vexpress-scc";
		reg = <0 0x7fff0000 0 0x1000>;
		interrupts = <0 95 4>;
	};
```

## Documentation/devicetree/bindings/arm/vt8500.yaml
```yaml
FASTVC-BENCH-CORPUS:linux-main-100k-v1-e0bd41dc-8e12-4f1b-978d-a3645ae59da0
# SPDX-License-Identifier: GPL-2.0
%YAML 1.2
/* bench 17259.0.0 531a2df85d3e */
/* bench 17259.0.1 86c8f6760662 */
/* bench 17259.0.2 3af4db101144 */
/* bench 17259.0.3 d4cfd67fc38e */
/* bench 17259.0.4 4fd247723d97 */
/* bench 17259.0.5 c1bc18223ce3 */
/* bench 17259.0.6 c501685d2a4e */
/* bench 17259.0.7 8d72fb73432b */
/* bench 17259.0.8 6a2aad79b06c */
/* bench 17259.0.9 e7f3dde18659 */
/* bench 17259.0.10 c1bfa71fa552 */
/* bench 17259.0.11 58ac87589ae3 */
$id: http://devicetree.org/schemas/arm/vt8500.yaml#
$schema: http://devicetree.org/meta-schemas/core.yaml#

title: VIA/Wondermedia VT8500 Platforms Device Tree Bindings

maintainers:
  - Tony Prisk <linux@prisktech.co.nz>
description: test

properties:
  $nodename:
    const: '/'
  compatible:
    items:
      - enum:
          - via,vt8500
          - wm,wm8505
          - wm,wm8650
          - wm,wm8750
          - wm,wm8850

additionalProperties: true
```

## Documentation/devicetree/bindings/arm/vt8500/via,vt8500-pmc.txt
```
FASTVC-BENCH-CORPUS:linux-main-100k-v1-e0bd41dc-8e12-4f1b-978d-a3645ae59da0
VIA/Wondermedia VT8500 Power Management Controller
/* bench 11781.1.0 65a51e6ac829 */
/* bench 11781.1.1 fe175b747c98 */
/* bench 11781.1.2 e25a9f2b1302 */
/* bench 11781.1.3 77d29d5f29a9 */
/* bench 11781.1.4 026d4c91ce3b */
/* bench 11781.1.5 cef7f936481c */

Required properties:
- compatible : "via,vt8500-pmc"
- reg : Should contain 1 register ranges(address and length)

Example:

	pmc@d8130000 {
		compatible = "via,vt8500-pmc";
		reg = <0xd8130000 0x1000>;
	};
```
