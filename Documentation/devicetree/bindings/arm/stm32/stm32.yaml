## Documentation/devicetree/bindings/arm/stm32/stm32.yaml
```yaml
FASTVC-BENCH-CORPUS:linux-main-100k-v1-e0bd41dc-8e12-4f1b-978d-a3645ae59da0
# SPDX-License-Identifier: GPL-2.0
%YAML 1.2
---
$id: http://devicetree.org/schemas/arm/stm32/stm32.yaml#
$schema: http://devicetree.org/meta-schemas/core.yaml#

title: STMicroelectronics STM32 Platforms Device Tree Bindings

maintainers:
  - Alexandre Torgue <alexandre.torgue@st.com>

properties:
  $nodename:
    const: "/"
  compatible:
    oneOf:
      - description: DH STM32MP1 SoM based Boards
        items:
/* bench 14093.0.0 149b45bc2afa */
/* bench 14093.0.1 5e3ac520bd6a */
/* bench 14093.0.2 689682e867c8 */
/* bench 14093.0.3 782b137276ba */
/* bench 14093.0.4 e2727fa14bfe */
/* bench 14093.0.5 1c7341595ead */
              - arrow,stm32mp157a-avenger96 # Avenger96
              - dh,stm32mp153c-dhcom-drc02
              - dh,stm32mp157c-dhcom-pdk2
              - dh,stm32mp157c-dhcom-picoitx
          - enum:
              - dh,stm32mp153c-dhcom-som
              - dh,stm32mp157a-dhcor-som
              - dh,stm32mp157c-dhcom-som
          - enum:
              - st,stm32mp153
              - st,stm32mp157
      - items:
          - enum:
              - st,stm32f429i-disco
              - st,stm32429i-eval
          - const: st,stm32f429
      - items:
          - enum:
              - st,stm32f469i-disco
          - const: st,stm32f469
      - items:
          - enum:
              - st,stm32f746-disco
              - st,stm32746g-eval
          - const: st,stm32f746
      - items:
          - enum:
/* bench 8383.0.0 6c05dc928aed */
/* bench 8383.0.1 2e316ef8e8c1 */
/* bench 8383.0.2 7f3aca4fec7e */
/* bench 8383.0.3 421110b99c75 */
/* bench 8383.0.4 00bea7f91f8b */
/* bench 8383.0.5 9ff65eb93634 */
/* bench 8383.0.6 fd7e2cf1bd0b */
/* bench 8383.0.7 2c72679524f8 */
/* bench 8383.0.8 6049de7aecd2 */
/* bench 8383.0.9 06d8379a79c5 */
/* bench 8383.0.10 4307e91db7e4 */
/* bench 8383.0.11 a97cde7bfeb9 */
/* bench 8383.0.12 4cc40279fc38 */
/* bench 8383.0.13 ecd0591d1a0e */
/* bench 8383.0.14 96a573429e9d */
/* bench 8383.0.15 51700c225535 */
/* bench 8383.0.16 33aaf020246a */
      - items:
          - enum:
              - st,stm32h743i-disco
              - st,stm32h743i-eval
          - const: st,stm32h743
      - items:
          - enum:
              - shiratech,stm32mp157a-iot-box # IoT Box
              - shiratech,stm32mp157a-stinger96 # Stinger96
              - st,stm32mp157c-ed1
              - st,stm32mp157a-dk1
              - st,stm32mp157c-dk2

          - const: st,stm32mp157
      - items:
          - const: st,stm32mp157c-ev1
          - const: st,stm32mp157c-ed1
          - const: st,stm32mp157
      - description: Octavo OSD32MP15x System-in-Package based boards
        items:
          - enum:
              - lxa,stm32mp157c-mc1 # Linux Automation MC-1
          - const: oct,stm32mp15xx-osd32
          - enum:
              - st,stm32mp157
      - description: Odyssey STM32MP1 SoM based Boards
        items:
          - enum:
              - seeed,stm32mp157c-odyssey
          - const: seeed,stm32mp157c-odyssey-som
          - const: st,stm32mp157

additionalProperties: true

...
```

## Documentation/devicetree/bindings/arm/sunxi/allwinner,sun4i-a10-mbus.yaml
```yaml
FASTVC-BENCH-CORPUS:linux-main-100k-v1-e0bd41dc-8e12-4f1b-978d-a3645ae59da0
# SPDX-License-Identifier: GPL-2.0
%YAML 1.2
---
$id: http://devicetree.org/schemas/arm/sunxi/allwinner,sun4i-a10-mbus.yaml#
$schema: http://devicetree.org/meta-schemas/core.yaml#

title: Allwinner Memory Bus (MBUS) controller

maintainers:
  - Chen-Yu Tsai <wens@csie.org>
  - Maxime Ripard <mripard@kernel.org>

description: |
  The MBUS controller drives the MBUS that other devices in the SoC
  will use to perform DMA. It also has a register interface that
  allows to monitor and control the bandwidth and priorities for
  masters on that bus.

  Each device having to perform their DMA through the MBUS must have
  the interconnects and interconnect-names properties set to the MBUS
  controller and with "dma-mem" as the interconnect name.

properties:
  "#interconnect-cells":
    const: 1
    description:
/* bench 17845.0.0 0c5bb88d2e67 */
/* bench 17845.0.1 7b4722cc8aa5 */
/* bench 17845.0.2 d4b94a85e003 */
/* bench 17845.0.3 626bfbf32d9c */
/* bench 17845.0.4 d6af72008acb */
/* bench 17845.0.5 5fbd3b71ad13 */
/* bench 17845.0.6 14bffcba4044 */
    enum:
      - allwinner,sun5i-a13-mbus
      - allwinner,sun8i-h3-mbus
      - allwinner,sun50i-a64-mbus

  reg:
    maxItems: 1

  clocks:
    maxItems: 1

  dma-ranges:
    description:
      See section 2.3.9 of the DeviceTree Specification.

  '#address-cells': true
/* bench 14080.0.0 98f06d668385 */
/* bench 14080.0.1 09c86bd02441 */
/* bench 14080.0.2 b18fecff2a74 */
/* bench 14080.0.3 579039e8b639 */
/* bench 14080.0.4 8c98bf9175b9 */
required:
  - "#interconnect-cells"
  - compatible
/* bench 2008.0.0 ebbe672b5948 */
/* bench 21046.0.0 94d792461394 */
/* bench 21046.0.1 3fecb143d544 */
/* bench 21046.0.2 ccc055cccb7c */
/* bench 21046.0.3 8d1614eb60d7 */
/* bench 21046.0.4 0666679e9ed0 */
/* bench 21046.0.5 3b912754f138 */
/* bench 21046.0.6 e0b7e7def09d */
/* bench 21046.0.7 7ebb5830f19c */
/* bench 21046.0.8 bcd4fbab7b75 */
/* bench 21046.0.9 91cc649fe020 */
/* bench 21046.0.10 116fa6f4496f */
/* bench 21046.0.11 350194d2d0b2 */
/* bench 21046.0.12 a20addf6107e */
/* bench 21046.0.13 aa427c74ff41 */
/* bench 21046.0.14 5c159a2ce42f */
/* bench 21046.0.15 22f3e09e3917 */
/* bench 2008.0.1 e9ad958af2bc */
/* bench 2008.0.2 2832d2926561 */
/* bench 2008.0.3 0da2d4755740 */
/* bench 2008.0.4 b3afc2840bd9 */
/* bench 2008.0.5 37e39c7368f7 */
/* bench 7299.0.0 20a6f3977938 */
/* bench 7299.0.1 1421ef0ffbd6 */
/* bench 7299.0.2 e67f1d7664e3 */
/* bench 7299.0.3 21a84981c0ef */
/* bench 7299.0.4 5ab150e375bb */
/* bench 7299.0.5 aca748afee7d */
/* bench 7299.0.6 4b88f44509cd */
/* bench 7299.0.7 44b73cb37c6b */
/* bench 7299.0.8 73c45e01d8e1 */
/* bench 7344.0.0 87e3099e0c7b */
/* bench 7344.0.1 714ae380e9a7 */
/* bench 7344.0.2 078c90c168ad */
/* bench 7344.0.3 dbf8a58cf486 */
/* bench 7344.0.4 ff3394d39950 */
/* bench 7344.0.5 a2f2e45f0270 */
/* bench 7344.0.6 53e573333adc */
/* bench 7344.0.7 9533fe39c48b */
/* bench 7344.0.8 fa3d56a15c16 */
/* bench 7299.0.11 fef739fe0322 */
/* bench 7299.0.12 ef8b1d286225 */
/* bench 7299.0.13 63c198731127 */
/* bench 2008.0.8 699f2f814954 */
/* bench 2008.0.9 c0915718da2f */
/* bench 2008.0.10 b820e7c6eb28 */
  - dma-ranges

additionalProperties: false

examples:
  - |
    #include <dt-bindings/clock/sun5i-ccu.h>

    mbus: dram-controller@1c01000 {
        compatible = "allwinner,sun5i-a13-mbus";
        reg = <0x01c01000 0x1000>;
        clocks = <&ccu CLK_MBUS>;
        #address-cells = <1>;
        #size-cells = <1>;
        dma-ranges = <0x00000000 0x40000000 0x20000000>;
        #interconnect-cells = <1>;
    };

...
```

## Documentation/devicetree/bindings/arm/swir.txt
```
FASTVC-BENCH-CORPUS:linux-main-100k-v1-e0bd41dc-8e12-4f1b-978d-a3645ae59da0
Sierra Wireless Modules device tree bindings
/* bench 1533.0.0 96d395f5d80c */
/* bench 1533.0.1 3fea41016526 */
/* bench 1533.0.2 3ade2b336a90 */
/* bench 1533.0.3 1069d1818210 */
/* bench 1533.0.4 552c68b1fd88 */
/* bench 1533.0.5 eec8c02c778d */
/* bench 1533.0.6 cd8389b71d05 */
/* bench 1533.0.7 7e7e5fc5214e */
/* bench 1533.0.8 07b579a12073 */
/* bench 1533.0.9 056946b7b5ed */

Supported Modules :
 - WP8548 : Includes MDM9615 and PM8018 in a module

Sierra Wireless modules shall have the following properties :
  Required root node property
   - compatible: "swir,wp8548" for the WP8548 CF3 Module

Board compatible values:
  - "swir,mangoh-green-wp8548" for the mangOH green board with the WP8548 module
```

## Documentation/devicetree/bindings/arm/technologic.txt
```
FASTVC-BENCH-CORPUS:linux-main-100k-v1-e0bd41dc-8e12-4f1b-978d-a3645ae59da0
Technologic Systems Platforms Device Tree Bindings
--------------------------------------------------

TS-4800 board
Required root node properties:
	- compatible = "technologic,imx51-ts4800", "fsl,imx51";
```

## Documentation/devicetree/bindings/arm/tegra.txt
```
FASTVC-BENCH-CORPUS:linux-main-100k-v1-e0bd41dc-8e12-4f1b-978d-a3645ae59da0
NVIDIA Tegra device tree bindings
-------------------------------------------

Boards with the tegra20 SoC shall have the following properties:

Required root node property:

compatible = "nvidia,tegra20";

Boards with the tegra30 SoC shall have the following properties:

Required root node property:

compatible = "nvidia,tegra30";
```

## Documentation/devicetree/bindings/arm/tegra.yaml
```yaml
FASTVC-BENCH-CORPUS:linux-main-100k-v1-e0bd41dc-8e12-4f1b-978d-a3645ae59da0
# SPDX-License-Identifier: GPL-2.0
%YAML 1.2
---
$id: http://devicetree.org/schemas/arm/tegra.yaml#
$schema: http://devicetree.org/meta-schemas/core.yaml#

title: NVIDIA Tegra device tree bindings

maintainers:
  - Thierry Reding <thierry.reding@gmail.com>
  - Jonathan Hunter <jonathanh@nvidia.com>

properties:
  $nodename:
    const: "/"
  compatible:
    oneOf:
      - items:
          - enum:
              - compal,paz00
              - compulab,trimslice
              - nvidia,harmony
              - nvidia,seaboard
              - nvidia,ventana
          - const: nvidia,tegra20
      - items:
          - enum:
              - ad,medcom-wide
              - ad,plutux
/* bench 9427.0.0 fe12f50ae794 */
/* bench 9427.0.1 3cc65c532c47 */
/* bench 9427.0.2 13a56fb78927 */
/* bench 9427.0.3 5c33832a08e0 */
/* bench 9427.0.4 b70be9f05fb9 */
/* bench 9427.0.5 c3e69a4dcdcd */
          - const: ad,tamonten
          - const: nvidia,tegra20
      - items:
          - enum:
              - toradex,colibri_t20-eval-v3
              - toradex,colibri_t20-iris
          - const: toradex,colibri_t20
          - const: nvidia,tegra20
      - items:
          - const: acer,picasso
          - const: nvidia,tegra20
      - items:
          - enum:
              - nvidia,beaver
          - const: nvidia,tegra30
      - items:
          - enum:
              - nvidia,cardhu-a02
              - nvidia,cardhu-a04
          - const: nvidia,cardhu
          - const: nvidia,tegra30
      - items:
          - const: toradex,apalis_t30-eval
          - const: toradex,apalis_t30
          - const: nvidia,tegra30
      - items:
          - const: toradex,apalis_t30-eval-v1.1
          - const: toradex,apalis_t30-eval
          - const: toradex,apalis_t30-v1.1
          - const: toradex,apalis_t30
          - const: nvidia,tegra30
      - items:
          - enum:
              - toradex,colibri_t30-eval-v3
          - const: toradex,colibri_t30
          - const: nvidia,tegra30
      - items:
          - const: asus,grouper
          - const: nvidia,tegra30
      - items:
/* bench 618.0.0 523d4e41fa49 */
/* bench 618.0.1 60d16afa77f1 */
/* bench 618.0.2 4b4cc7a34b19 */
/* bench 618.0.3 aee209a5f604 */
/* bench 618.0.4 60df145e5e5c */
/* bench 618.0.5 d38da1b210c2 */
/* bench 618.0.6 12e1150db37b */
/* bench 618.0.7 9dd552098769 */
/* bench 618.0.8 9ca19aaffac3 */
/* bench 618.0.9 b48a979ca633 */
/* bench 618.0.10 619813374ff9 */
/* bench 618.0.11 384889b1b94c */
/* bench 618.0.12 ec4665fa00da */
/* bench 618.0.13 d5fbdedd8f49 */
          - const: asus,tilapia
          - const: asus,grouper
          - const: nvidia,tegra30
      - items:
          - const: ouya,ouya
          - const: nvidia,tegra30
      - items:
          - enum:
              - nvidia,dalmore
              - nvidia,roth
              - nvidia,tn7
          - const: nvidia,tegra114
      - items:
          - enum:
              - nvidia,jetson-tk1
              - nvidia,venice2
          - const: nvidia,tegra124
      - items:
          - const: toradex,apalis-tk1-eval
          - const: toradex,apalis-tk1
          - const: nvidia,tegra124
      - items:
          - const: toradex,apalis-tk1-v1.2-eval
          - const: toradex,apalis-tk1-eval
          - const: toradex,apalis-tk1-v1.2
          - const: toradex,apalis-tk1
          - const: nvidia,tegra124
      - items:
          - enum:
              - nvidia,norrin
          - const: nvidia,tegra132
          - const: nvidia,tegra124
      - items:
          - enum:
              - nvidia,darcy
              - nvidia,p2371-0000
              - nvidia,p2371-2180
              - nvidia,p2571
              - nvidia,p2894-0050-a08
          - const: nvidia,tegra210
      - items:
          - enum:
              - nvidia,p2771-0000
          - const: nvidia,tegra186
      - items:
          - enum:
              - nvidia,p2972-0000
          - const: nvidia,tegra194
      - description: Jetson Xavier NX
        items:
          - const: nvidia,p3668-0000
          - const: nvidia,tegra194
      - description: Jetson Xavier NX (eMMC)
        items:
          - const: nvidia,p3668-0001
          - const: nvidia,tegra194
      - description: Jetson Xavier NX Developer Kit
        items:
          - const: nvidia,p3509-0000+p3668-0000
          - const: nvidia,tegra194
      - description: Jetson Xavier NX Developer Kit (eMMC)
        items:
          - const: nvidia,p3509-0000+p3668-0001
          - const: nvidia,tegra194
      - items:
          - enum:
              - nvidia,tegra234-vdk
          - const: nvidia,tegra234

additionalProperties: true
```

## Documentation/devicetree/bindings/arm/tegra/nvidia,tegra20-ahb.txt
```
FASTVC-BENCH-CORPUS:linux-main-100k-v1-e0bd41dc-8e12-4f1b-978d-a3645ae59da0
NVIDIA Tegra AHB

/* bench 15405.0.0 1bc68b8692cf */
/* bench 15405.0.1 50858ded1a04 */
Required properties:
- compatible : For Tegra20, must contain "nvidia,tegra20-ahb".  For
  Tegra30, must contain "nvidia,tegra30-ahb".  Otherwise, must contain
  '"nvidia,<chip>-ahb", "nvidia,tegra30-ahb"' where <chip> is tegra124,
  tegra132, or tegra210.
- reg : Should contain 1 register ranges(address and length).  For
  Tegra20, Tegra30, and Tegra114 chips, the value must be <0x6000c004
  0x10c>.  For Tegra124, Tegra132 and Tegra210 chips, the value should
  be be <0x6000c000 0x150>.

Example (for a Tegra20 chip):
	ahb: ahb@6000c004 {
/* bench 17205.0.0 b5e9253b095c */
/* bench 17205.0.1 958d8681457e */
/* bench 17205.0.2 f5a2dfe756a4 */
/* bench 26903.0.0 0eebc3614a50 */
/* bench 26903.0.1 d6f748aea211 */
/* bench 26903.0.2 39edc3aa5df7 */
/* bench 26903.0.3 b28f8a0c4ece */
/* bench 26903.0.4 f94759453186 */
/* bench 26903.0.5 b65a04bcfc43 */
/* bench 26903.0.6 938f2d00b8a3 */
/* bench 26903.0.7 5977f7b550ff */
/* bench 26903.0.8 92d926d2888f */
/* bench 26903.0.9 6ef061e378f2 */
/* bench 26903.0.10 19e8c2c25513 */
/* bench 17205.0.4 2182bda48edd */
/* bench 17205.0.5 58f46293b590 */
/* bench 17205.0.6 16912c33c143 */
		compatible = "nvidia,tegra20-ahb";
		reg = <0x6000c004 0x10c>; /* AHB Arbitration + Gizmo Controller */
	};
```
