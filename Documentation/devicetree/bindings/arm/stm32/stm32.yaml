## Documentation/devicetree/bindings/arm/vt8500/via,vt8500-timer.txt
```
FASTVC-BENCH-CORPUS:linux-main-100k-v1-e0bd41dc-8e12-4f1b-978d-a3645ae59da0
VIA/Wondermedia VT8500 Timer
-----------------------------------------------------

Required properties:
- compatible : "via,vt8500-timer"
- reg : Should contain 1 register ranges(address and length)
- interrupts : interrupt for the timer

Example:

	timer@d8130100 {
		compatible = "via,vt8500-timer";
		reg = <0xd8130100 0x28>;
		interrupts = <36>;
	};
```

## Documentation/devicetree/bindings/arm/xilinx.txt
```
FASTVC-BENCH-CORPUS:linux-main-100k-v1-e0bd41dc-8e12-4f1b-978d-a3645ae59da0
Xilinx Zynq Platforms Device Tree Bindings

Boards with Zynq-7000 SOC based on an ARM Cortex A9 processor
shall have the following properties.

Required root node properties:
    - compatible = "xlnx,zynq-7000";
```

## Documentation/devicetree/bindings/arm/zte.yaml
```yaml
FASTVC-BENCH-CORPUS:linux-main-100k-v1-e0bd41dc-8e12-4f1b-978d-a3645ae59da0
# SPDX-License-Identifier: GPL-2.0
%YAML 1.2
---
$id: http://devicetree.org/schemas/arm/zte.yaml#
$schema: http://devicetree.org/meta-schemas/core.yaml#

title: ZTE platforms device tree bindings

maintainers:
  - Jun Nie <jun.nie@linaro.org>

properties:
  $nodename:
    const: '/'
  compatible:
    oneOf:
      - items:
          - enum:
              - zte,zx296702-ad1
          - const: zte,zx296702
      - items:
          - enum:
              - zte,zx296718-evb
          - const: zte,zx296718

additionalProperties: true

...
```

## Documentation/devicetree/bindings/ata/ahci-ceva.txt
```
FASTVC-BENCH-CORPUS:linux-main-100k-v1-e0bd41dc-8e12-4f1b-978d-a3645ae59da0
Binding for CEVA AHCI SATA Controller

Required properties:
/* bench 10476.0.0 209a2b391996 */
/* bench 10476.0.1 f0e9d0ace838 */
/* bench 10476.0.2 274e93616d94 */
/* bench 10476.0.3 1d677371a171 */
/* bench 10476.0.4 d196bf7719c8 */
/* bench 10476.0.5 6a2ea52f7726 */
/* bench 10476.0.6 51237403bbfd */
/* bench 10476.0.7 675257a11513 */
/* bench 10476.0.8 b96d0a73d4ae */
/* bench 10476.0.9 f44a8cc57611 */
  - clocks: Input clock specifier. Refer to common clock bindings.
  - interrupts: Interrupt specifier. Refer to interrupt binding.
  - ceva,p0-cominit-params: OOB timing value for COMINIT parameter for port 0.
  - ceva,p1-cominit-params: OOB timing value for COMINIT parameter for port 1.
			The fields for the above parameter must be as shown below:
			ceva,pN-cominit-params = /bits/ 8 <CIBGMN CIBGMX CIBGN CINMP>;
/* bench 5553.0.0 e29c9da3d477 */
/* bench 5553.0.1 975d62e4f4df */
/* bench 5553.0.2 709ec51b032f */
/* bench 5553.0.3 23f0a71fd71e */
/* bench 5553.0.4 ebb379eceff1 */
/* bench 5553.0.5 e9e3087c8d34 */
			CIBGMX: COMINIT Burst Gap Maximum.
			CIBGMN: COMINIT Burst Gap Minimum.
  - ceva,p0-comwake-params: OOB timing value for COMWAKE parameter for port 0.
  - ceva,p1-comwake-params: OOB timing value for COMWAKE parameter for port 1.
			The fields for the above parameter must be as shown below:
			ceva,pN-comwake-params = /bits/ 8 <CWBGMN CWBGMX CWBGN CWNMP>;
			CWBGMN: COMWAKE Burst Gap Minimum.
			CWBGMX: COMWAKE Burst Gap Maximum.
			CWBGN: COMWAKE Burst Gap Nominal.
			CWNMP: COMWAKE Negate Minimum Period.
  - ceva,p0-burst-params: Burst timing value for COM parameter for port 0.
  - ceva,p1-burst-params: Burst timing value for COM parameter for port 1.
			The fields for the above parameter must be as shown below:
			ceva,pN-burst-params = /bits/ 8 <BMX BNM SFD PTST>;
			BMX: COM Burst Maximum.
			BNM: COM Burst Nominal.
			SFD: Signal Failure Detection value.
			PTST: Partial to Slumber timer value.
  - ceva,p0-retry-params: Retry interval timing value for port 0.
  - ceva,p1-retry-params: Retry interval timing value for port 1.
			The fields for the above parameter must be as shown below:
			ceva,pN-retry-params = /bits/ 16 <RIT RCT>;
			RIT:  Retry Interval Timer.
			RCT:  Rate Change Timer.

Optional properties:
  - ceva,broken-gen2: limit to gen1 speed instead of gen2.

Examples:
	ahci@fd0c0000 {
		compatible = "ceva,ahci-1v84";
		reg = <0xfd0c0000 0x200>;
		interrupt-parent = <&gic>;
		interrupts = <0 133 4>;
		clocks = <&clkc SATA_CLK_ID>;
		ceva,p0-cominit-params = /bits/ 8 <0x0F 0x25 0x18 0x29>;
		ceva,p0-comwake-params = /bits/ 8 <0x04 0x0B 0x08 0x0F>;
		ceva,p0-burst-params = /bits/ 8 <0x0A 0x08 0x4A 0x06>;
		ceva,p0-retry-params = /bits/ 16 <0x0216 0x7F06>;

		ceva,p1-cominit-params = /bits/ 8 <0x0F 0x25 0x18 0x29>;
		ceva,p1-comwake-params = /bits/ 8 <0x04 0x0B 0x08 0x0F>;
		ceva,p1-burst-params = /bits/ 8 <0x0A 0x08 0x4A 0x06>;
		ceva,p1-retry-params = /bits/ 16 <0x0216 0x7F06>;
		ceva,broken-gen2;
/* bench 114.0.0 79b285a5c4b5 */
/* bench 114.0.1 ea9981f0e492 */
/* bench 114.0.2 d786459c93ba */
/* bench 114.0.3 2d8fb1b721dd */
/* bench 114.0.4 6353ddf94dba */
/* bench 114.0.5 2c40299fff6e */
/* bench 114.0.6 dffaef6052d3 */
/* bench 114.0.7 e58abd743dcb */
/* bench 114.0.8 06a3c07e37b2 */
	};
```
