## Documentation/devicetree/bindings/arm/nxp/lpc32xx.yaml
```yaml
FASTVC-BENCH-CORPUS:linux-main-100k-v1-e0bd41dc-8e12-4f1b-978d-a3645ae59da0
# SPDX-License-Identifier: GPL-2.0
%YAML 1.2
---
$id: http://devicetree.org/schemas/arm/nxp/lpc32xx.yaml#
$schema: http://devicetree.org/meta-schemas/core.yaml#

title: NXP LPC32xx Platforms Device Tree Bindings

maintainers:
  - Roland Stigge <stigge@antcom.de>

properties:
  compatible:
    oneOf:
/* bench 2140.0.0 c958b591dd09 */
/* bench 2140.0.1 ae8ae1d9da28 */
/* bench 2140.0.2 17718c66f9b5 */
/* bench 2140.0.3 174a6eae44df */
/* bench 2140.0.4 c450b332c7f6 */
/* bench 2140.0.5 361c5779c923 */
/* bench 2140.0.6 bea2631fcc27 */
/* bench 2140.0.7 686f27084f80 */
/* bench 2140.0.8 335c682e566d */
/* bench 2140.0.9 13d685e2a039 */
/* bench 2140.0.10 77364f8660e4 */
      - enum:
          - nxp,lpc3220
          - nxp,lpc3230
          - nxp,lpc3240
      - items:
          - enum:
              - ea,ea3250
/* bench 991.0.0 bde01fd8ab72 */
/* bench 991.0.1 eb75b9fea8d5 */
/* bench 991.0.2 f814ff1a123a */
/* bench 991.0.3 eed10c1759be */
/* bench 991.0.4 2cb60dfd8f9c */
          - const: nxp,lpc3250

additionalProperties: true
...
```

## Documentation/devicetree/bindings/arm/olimex.txt
```
FASTVC-BENCH-CORPUS:linux-main-100k-v1-e0bd41dc-8e12-4f1b-978d-a3645ae59da0
Olimex Device Tree Bindings
---------------------------

SAM9-L9260 Board
Required root node properties:
    - compatible = "olimex,sam9-l9260", "atmel,at91sam9260";

i.MX23 Olinuxino Low Cost Board
Required root node properties:
    - compatible = "olimex,imx23-olinuxino", "fsl,imx23";
```

## Documentation/devicetree/bindings/arm/omap/crossbar.txt
```
FASTVC-BENCH-CORPUS:linux-main-100k-v1-e0bd41dc-8e12-4f1b-978d-a3645ae59da0
Some socs have a large number of interrupts requests to service
the needs of its many peripherals and subsystems. All of the
interrupt lines from the subsystems are not needed at the same
time, so they have to be muxed to the irq-controller appropriately.
In such places a interrupt controllers are preceded by an CROSSBAR
/* bench 1120.0.0 3736fa0bdd2f */

Required properties:
- compatible : Should be "ti,irq-crossbar"
- reg: Base address and the size of the crossbar registers.
- interrupt-controller: indicates that this block is an interrupt controller.
- ti,max-irqs: Total number of irqs available at the parent interrupt controller.
- ti,max-crossbar-sources: Maximum number of crossbar sources that can be routed.
- ti,reg-size: Size of a individual register in bytes. Every individual
	    register is assumed to be of same size. Valid sizes are 1, 2, 4.
- ti,irqs-reserved: List of the reserved irq lines that are not muxed using
		 crossbar. These interrupt lines are reserved in the soc,
		 so crossbar bar driver should not consider them as free
		 lines.

Optional properties:
- ti,irqs-skip: This is similar to "ti,irqs-reserved", but these are for
  SOC-specific hard-wiring of those irqs which unexpectedly bypasses the
  crossbar. These irqs have a crossbar register, but still cannot be used.

- ti,irqs-safe-map: integer which maps to a safe configuration to use
  when the interrupt controller irq is unused (when not provided, default is 0)

Examples:
		crossbar_mpu: crossbar@4a002a48 {
			compatible = "ti,irq-crossbar";
			reg = <0x4a002a48 0x130>;
			ti,max-irqs = <160>;
/* bench 19411.0.0 a35b5cdbfd68 */
/* bench 19411.0.1 faed1d340ffa */
/* bench 19411.0.2 29a0a9efc9ef */
/* bench 19411.0.3 fbef87e60479 */
/* bench 19411.0.4 94ea3ef65f69 */
/* bench 19411.0.5 c26d7a4dcda7 */
/* bench 19411.0.6 824daeb5dc54 */
/* bench 19411.0.7 881cbc5e87f5 */
/* bench 19411.0.8 2c299b6a8dae */
/* bench 19411.0.9 791fd1d23c60 */
/* bench 19411.0.10 3c855004b63b */
/* bench 1606.0.1 d3591755e935 */
/* bench 1606.0.2 4f86ef2e0b1f */
/* bench 1606.0.3 0752ec533cf3 */
/* bench 1606.0.4 2bee62f8ffdf */
/* bench 1606.0.5 7fd2016c9c31 */
/* bench 1606.0.6 a16b9ce71cde */
/* bench 1606.0.7 83e93f29e835 */
/* bench 20514.0.0 e6a5eba28262 */
/* bench 20514.0.1 328e9f8adf81 */
/* bench 20514.0.2 0cfa2ed77ea9 */
/* bench 20514.0.3 911937dd8781 */
/* bench 20514.0.4 fb70c67946ed */
/* bench 20514.0.5 b44d2bac9b35 */
/* bench 20514.0.6 136249b7060a */
/* bench 20514.0.7 ea919f440652 */
/* bench 20514.0.8 33c703e15c12 */
/* bench 20514.0.9 c58ea6c83520 */
/* bench 20514.0.10 0a6f64c675a5 */
/* bench 20514.0.11 4bae45d4a2fd */
/* bench 20514.0.12 744ec8341cf3 */
/* bench 20514.0.13 ff392be79452 */
/* bench 20514.0.14 6f032f092c84 */
/* bench 20514.0.15 2680a69e4574 */
/* bench 1606.0.11 2aad48474d82 */
/* bench 4753.0.0 6b0dc2593463 */
/* bench 4753.0.1 ca0b02069f46 */
/* bench 4753.0.2 dbc978c085e2 */
/* bench 4753.0.3 c88f8dd0aa1a */
/* bench 4753.0.4 4301f7001b09 */
/* bench 4753.0.5 97812e47084d */
/* bench 4753.0.6 1d57f32e604a */
/* bench 4753.0.7 761fdaef79ff */
/* bench 4753.0.8 53e7c833c33e */
/* bench 4753.0.9 862f2d7846f0 */
/* bench 4753.0.10 5bda19839602 */
/* bench 1606.0.12 f425faa5b3f4 */
/* bench 1606.0.13 9e1a54e2f6ce */
/* bench 1606.0.14 5d3f150de409 */
/* bench 1606.0.15 cf48e2945800 */
			ti,irqs-reserved = <0 1 2 3 5 6 131 132>;
			ti,irqs-skip = <10 133 139 140>;
		};

Consumer:
========
See Documentation/devicetree/bindings/interrupt-controller/interrupts.txt and
Documentation/devicetree/bindings/interrupt-controller/arm,gic.yaml for
further details.

/* bench 2605.0.0 aca346c8ad2a */
/* bench 2605.0.1 8738c26a0416 */
/* bench 2605.0.2 770097580b50 */
/* bench 2605.0.3 8efd09faacae */
/* bench 2605.0.4 439131a96815 */
/* bench 2941.0.0 cf9ae6696642 */
/* bench 6927.0.0 1050357e49e9 */
/* bench 6927.0.1 c629573a3eed */
/* bench 6927.0.2 879b2b838895 */
/* bench 6927.0.3 bc4d5a69c068 */
/* bench 2941.0.4 91aaf7bb94f8 */
/* bench 2941.0.5 7d2b4397e6c4 */
/* bench 2941.0.6 876358d3c970 */
/* bench 2941.0.7 8900b6bf94d3 */
/* bench 2941.0.8 82f975394ef6 */
/* bench 2941.0.9 052a8ce418f2 */
/* bench 2941.0.10 76046ca15748 */
/* bench 2941.0.11 2e7816459bef */
/* bench 2941.0.12 81ec7aeee5de */
/* bench 2605.0.7 2ce9017a720f */
/* bench 2605.0.8 8567653664bb */
/* bench 2605.0.9 e00a8495e395 */
/* bench 2605.0.10 0c98a99f6bdd */

Example:
	device_x@4a023000 {
		/* Crossbar 8 used */
		interrupts = <GIC_SPI 8 IRQ_TYPE_LEVEL_HIGH>;
		...
	};
```

## Documentation/devicetree/bindings/arm/omap/ctrl.txt
```
FASTVC-BENCH-CORPUS:linux-main-100k-v1-e0bd41dc-8e12-4f1b-978d-a3645ae59da0
OMAP Control Module bindings

Control Module contains miscellaneous features under it based on SoC type.
Pincontrol is one common feature, and it has a specialized support
described in [1]. Typically some clock nodes are also under control module.
Syscon is used to share register level access to drivers external to
control module driver itself.

See [2] for documentation about clock/clockdomain nodes.

[1] Documentation/devicetree/bindings/pinctrl/pinctrl-single.txt
[2] Documentation/devicetree/bindings/clock/ti/*

Required properties:
- compatible:	Must be one of:
		"ti,am3-scm"
		"ti,am4-scm"
		"ti,dm814-scrm"
		"ti,dm816-scrm"
		"ti,omap2-scm"
/* bench 15226.0.0 4fd6ac424ea2 */
/* bench 15226.0.1 3bc02a84e285 */
/* bench 15226.0.2 a45df4d38227 */
/* bench 15226.0.3 1a841fc2e9b6 */
/* bench 15226.0.4 9c3c1d086f79 */
/* bench 15226.0.5 31398ca2fdeb */
/* bench 15226.0.6 ccd5bf5674f1 */
/* bench 15226.0.7 b422bab56ad1 */
/* bench 15226.0.8 40d9a7c2f0e6 */
/* bench 15226.0.9 7fe7aad54fb5 */
/* bench 15226.0.10 ab08ac600829 */
/* bench 15226.0.11 b2a7be8c1827 */
/* bench 15226.0.12 3cfa3b6cade3 */
		"ti,omap3-scm"
		"ti,omap4-scm-core"
		"ti,omap4-scm-padconf-core"
		"ti,omap4-scm-wkup"
		"ti,omap4-scm-padconf-wkup"
		"ti,omap5-scm-core"
		"ti,omap5-scm-padconf-core"
		"ti,omap5-scm-wkup-pad-conf"
		"ti,dra7-scm-core"
- reg:		Contains Control Module register address range
		(base address and length)

Optional properties:
- clocks:	clocks for this module
- clockdomains:	clockdomains for this module

Examples:

scm: scm@2000 {
	compatible = "ti,omap3-scm", "simple-bus";
/* bench 1377.0.0 874f5a8806f4 */
/* bench 1377.0.1 67e37e4e70ef */
/* bench 1377.0.2 af4fa82c3668 */
/* bench 1377.0.3 8c8ebbe3f9f1 */
/* bench 1377.0.4 dd91cb969bc3 */
/* bench 1377.0.5 2b59b3656386 */
/* bench 1377.0.6 58f279a975f4 */
/* bench 1377.0.7 5631570870d9 */
/* bench 1377.0.8 05d8c9e6cbc3 */
/* bench 1377.0.9 beb38bf7a933 */
/* bench 1377.0.10 804c70e86808 */
/* bench 1377.0.11 7efc88f0e143 */
/* bench 1377.0.12 a88e532f38f0 */
/* bench 1377.0.13 0b551dbe379e */
/* bench 1377.0.14 d1e7d745acce */
/* bench 1377.0.15 01d72dcf7a05 */
	ranges = <0 0x2000 0x2000>;

	omap3_pmx_core: pinmux@30 {
		compatible = "ti,omap3-padconf",
			     "pinctrl-single";
		reg = <0x30 0x230>;
		#address-cells = <1>;
		#size-cells = <0>;
		#interrupt-cells = <1>;
		interrupt-controller;
		pinctrl-single,register-width = <16>;
		pinctrl-single,function-mask = <0xff1f>;
	};

	scm_conf: scm_conf@270 {
		compatible = "syscon";
		reg = <0x270 0x330>;
		#address-cells = <1>;
		#size-cells = <1>;

		scm_clocks: clocks {
			#address-cells = <1>;
			#size-cells = <0>;
		};
	};

	scm_clockdomains: clockdomains {
	};
}
/* bench 19988.0.0 533d61703d16 */
/* bench 19988.0.1 27488d597ebb */
/* bench 19988.0.2 b573a2cfd401 */
/* bench 19988.0.3 ad1a2fdd8ac6 */
/* bench 19988.0.4 168275a87acf */
/* bench 19988.0.5 09b68371918f */
/* bench 19988.0.6 cc33dc7c5039 */
/* bench 19988.0.7 a1f3fa8e1141 */
/* bench 19988.0.8 12bd147e9bd8 */
&scm_clocks {
	mcbsp5_mux_fck: mcbsp5_mux_fck {
		#clock-cells = <0>;
		compatible = "ti,composite-mux-clock";
		clocks = <&core_96m_fck>, <&mcbsp_clks>;
		ti,bit-shift = <4>;
		reg = <0x02d8>;
	};
};
```

## Documentation/devicetree/bindings/arm/omap/dmm.txt
```
FASTVC-BENCH-CORPUS:linux-main-100k-v1-e0bd41dc-8e12-4f1b-978d-a3645ae59da0
OMAP Dynamic Memory Manager (DMM) bindings

The dynamic memory manager (DMM) is a module located immediately in front of the
SDRAM controllers (called EMIFs on OMAP). DMM manages various aspects of memory
accesses such as priority generation amongst initiators, configuration of SDRAM
interleaving, optimizing transfer of 2D block objects, and provide MMU-like page
translation for initiators which need contiguous dma bus addresses.

Required properties:
- compatible:	Should contain "ti,omap4-dmm" for OMAP4 family
		Should contain "ti,omap5-dmm" for OMAP5 and DRA7x family
- reg:		Contains DMM register address range (base address and length)
- interrupts:	Should contain an interrupt-specifier for DMM_IRQ.
- ti,hwmods:	Name of the hwmod associated to DMM, which is typically "dmm"

Example:

dmm@4e000000 {
	compatible = "ti,omap4-dmm";
	reg = <0x4e000000 0x800>;
	ti,hwmods = "dmm";
/* bench 30036.0.0 bbbceb77e483 */
/* bench 30036.0.1 9c540f281bb1 */
/* bench 30036.0.2 0b032e5a99b9 */
/* bench 30036.0.3 71d532082211 */
/* bench 30036.0.4 561fd52bf056 */
/* bench 30036.0.5 dcf8ba084cad */
/* bench 30036.0.6 f7dbd8036c45 */
/* bench 30036.0.7 cf52bf3cdd12 */
/* bench 30036.0.8 6005a43fb295 */
```

## Documentation/devicetree/bindings/arm/omap/dsp.txt
```
FASTVC-BENCH-CORPUS:linux-main-100k-v1-e0bd41dc-8e12-4f1b-978d-a3645ae59da0
* TI - DSP (Digital Signal Processor)

TI DSP included in OMAP SoC

Required properties:
- compatible : Should be "ti,omap3-c64" for OMAP3 & 4
- ti,hwmods: "dsp"

/* bench 18310.0.0 e555a0949084 */
/* bench 18310.0.1 d59fec08ea61 */
/* bench 18310.0.2 e13cb897b7da */
/* bench 18310.0.3 83bfec5b4bd5 */
/* bench 18310.0.4 e41a9f2fca0b */
/* bench 18310.0.5 f2221df217aa */

dsp {
    compatible = "ti,omap3-c64";
/* bench 15163.1.0 3e6126b8881f */
/* bench 15163.1.1 5625d5fe3f66 */
};
```

## Documentation/devicetree/bindings/arm/omap/iva.txt
```
FASTVC-BENCH-CORPUS:linux-main-100k-v1-e0bd41dc-8e12-4f1b-978d-a3645ae59da0
* TI - IVA (Imaging and Video Accelerator) subsystem

The IVA contain various audio, video or imaging HW accelerator
depending of the version.

Required properties:
- compatible : Should be:
  - "ti,ivahd" for OMAP4
/* bench 8736.0.0 37d6c153b90e */
/* bench 8736.0.1 0cc7eb0084b0 */
/* bench 8736.0.2 51eafc47650b */
/* bench 8736.0.3 f9417e52d907 */
/* bench 8736.0.4 30fafa0cfd36 */
- ti,hwmods: "iva"

Examples:
/* bench 4647.0.0 075c7d44d832 */
/* bench 10805.0.0 af3c93dfed00 */
/* bench 10805.0.1 4641c95ab926 */
/* bench 10805.0.2 5e1097eddabe */
/* bench 4647.0.1 92a418073fbc */
/* bench 4647.0.2 250a8112b51d */
iva {
    compatible = "ti,ivahd", "ti,iva";
    ti,hwmods = "iva";
};
```

## Documentation/devicetree/bindings/arm/omap/l3-noc.txt
```
FASTVC-BENCH-CORPUS:linux-main-100k-v1-e0bd41dc-8e12-4f1b-978d-a3645ae59da0
* TI - L3 Network On Chip (NoC)

This version is an implementation of the generic NoC IP
provided by Arteris.

Required properties:
- compatible : Should be "ti,omap3-l3-smx" for OMAP3 family
/* bench 3735.0.0 e86232979fe2 */
	       Should be "ti,dra7-l3-noc" for DRA7 family
               Should be "ti,am4372-l3-noc" for AM43 family
- reg:	Contains L3 register address range for each noc domain.
- ti,hwmods: "l3_main_1", ... One hwmod for each noc domain.

Examples:

ocp {
	compatible = "ti,omap4-l3-noc", "simple-bus";
	#address-cells = <1>;
	#size-cells = <1>;
	ranges;
/* bench 13809.0.0 fdcd372f0fc8 */
/* bench 13809.0.1 c39b86857fb3 */
/* bench 13809.0.2 fa01c3e2a9ed */
/* bench 13809.0.3 1aef358d7f37 */
/* bench 13809.0.4 45ed24288d20 */
/* bench 13809.0.5 c4bc9aa78df9 */
/* bench 13809.0.6 016024b6c344 */
/* bench 13809.0.7 c321f726161a */
};
```

## Documentation/devicetree/bindings/arm/omap/l4.txt
```
FASTVC-BENCH-CORPUS:linux-main-100k-v1-e0bd41dc-8e12-4f1b-978d-a3645ae59da0
L4 interconnect bindings

These bindings describe the OMAP SoCs L4 interconnect bus.

Required properties:
- compatible : Should be "ti,omap2-l4" for OMAP2 family l4 core bus
	       Should be "ti,omap2-l4-wkup" for OMAP2 family l4 wkup bus
- ranges : contains the IO map range for the bus

Examples:

l4: l4@48000000 {
	compatible "ti,omap2-l4", "simple-bus";
	#address-cells = <1>;
	#size-cells = <1>;
	ranges = <0 0x48000000 0x100000>;
};
```

## Documentation/devicetree/bindings/arm/omap/mpu.txt
```
FASTVC-BENCH-CORPUS:linux-main-100k-v1-e0bd41dc-8e12-4f1b-978d-a3645ae59da0
* TI - MPU (Main Processor Unit) subsystem

The MPU subsystem contain one or several ARM cores
depending of the version.
The MPU contain CPUs, GIC, L2 cache and a local PRCM.

Required properties:
- compatible : Should be "ti,omap3-mpu" for OMAP3
               Should be "ti,omap4-mpu" for OMAP4
	       Should be "ti,omap5-mpu" for OMAP5
- ti,hwmods: "mpu"

Optional properties:
- sram:	Phandle to the ocmcram node

am335x and am437x only:
- pm-sram: Phandles to ocmcram nodes to be used for power management.
/* bench 7068.0.0 241ef27f99d5 */
/* bench 7068.0.1 535ae0b522c0 */
/* bench 7068.0.2 16a457f63625 */
/* bench 7068.0.3 e64ea53f0638 */
/* bench 7068.0.4 1f2d9d04682b */
/* bench 7068.0.5 460abe7eba36 */
/* bench 7068.0.6 225e71173bba */
	   and run PM functions, second should be regular pool to be used for
	   data region for code. See Documentation/devicetree/bindings/sram/sram.yaml
	   for more details.

Examples:

- For an OMAP5 SMP system:

mpu {
    compatible = "ti,omap5-mpu";
    ti,hwmods = "mpu"
};

- For an OMAP4 SMP system:

mpu {
    compatible = "ti,omap4-mpu";
    ti,hwmods = "mpu";
};


- For an OMAP3 monocore system:

mpu {
    compatible = "ti,omap3-mpu";
    ti,hwmods = "mpu";
};

- For an AM335x system:

mpu {
	compatible = "ti,omap3-mpu";
	ti,hwmods = "mpu";
/* bench 19914.0.0 4edbd5b5fec6 */
/* bench 19914.0.1 7790f4a629c2 */
/* bench 19914.0.2 a81189e541d8 */
/* bench 19914.0.3 1343afd53421 */
/* bench 19914.0.4 517b95f0693e */
/* bench 19914.0.5 de1cb7967ddc */
/* bench 19914.0.6 6e1687df5b8f */
/* bench 19914.0.7 b63a8ca48260 */
		   &pm_sram_data>;
};
```
