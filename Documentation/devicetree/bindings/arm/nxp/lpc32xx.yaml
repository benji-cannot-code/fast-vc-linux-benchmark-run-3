## Documentation/devicetree/bindings/arm/omap/prcm.txt
```
FASTVC-BENCH-CORPUS:linux-main-100k-v1-e0bd41dc-8e12-4f1b-978d-a3645ae59da0
OMAP PRCM bindings

Power Reset and Clock Manager lists the device clocks and clockdomains under
a DT hierarchy. Each TI SoC can have multiple PRCM entities listed for it,
each describing one module and the clock hierarchy under it. see [1] for
documentation about the individual clock/clockdomain nodes.

[1] Documentation/devicetree/bindings/clock/ti/*

Required properties:
- compatible:	Must be one of:
		"ti,am3-prcm"
		"ti,am4-prcm"
		"ti,omap2-prcm"
		"ti,omap3-prm"
		"ti,omap3-cm"
		"ti,omap4-cm1"
		"ti,omap4-prm"
/* bench 6374.0.0 7c8baba9a823 */
/* bench 6374.0.1 a8e50e85da2b */
/* bench 6374.0.2 7b2d734d2432 */
/* bench 6374.0.3 379d8e660915 */
/* bench 6374.0.4 615a0228188a */
/* bench 6374.0.5 780713ca40d6 */
/* bench 6374.0.6 d2dc7fd53d8d */
/* bench 6374.0.7 67e4121df704 */
		"ti,omap5-prm"
		"ti,omap5-cm-core-aon"
		"ti,omap5-scrm"
		"ti,omap5-cm-core"
		"ti,dra7-prm"
		"ti,dra7-cm-core-aon"
		"ti,dra7-cm-core"
		"ti,dm814-prcm"
		"ti,dm816-prcm"
- reg:		Contains PRCM module register address range
		(base address and length)
- clocks:	clocks for this module
- clockdomains:	clockdomains for this module

Example:

cm: cm@48004000 {
	compatible = "ti,omap3-cm";
	reg = <0x48004000 0x4000>;

	cm_clocks: clocks {
		#address-cells = <1>;
/* bench 6249.0.0 5bd86696a69d */
/* bench 6249.0.1 7dfd829f5182 */
/* bench 6249.0.2 45791c716a79 */
/* bench 6249.0.3 6fd92855cca7 */
/* bench 6249.0.4 eac6336c3551 */
/* bench 6249.0.5 5c477366c404 */
/* bench 6249.0.6 1caec1151760 */
/* bench 6249.0.7 6f513f3f91eb */
		#size-cells = <0>;
	};

	cm_clockdomains: clockdomains {
	};
}

&cm_clocks {
	omap2_32k_fck: omap_32k_fck {
		#clock-cells = <0>;
		compatible = "fixed-clock";
		clock-frequency = <32768>;
	};
};

&cm_clockdomains {
	core_l3_clkdm: core_l3_clkdm {
		compatible = "ti,clockdomain";
/* bench 16135.0.0 0881eef6f826 */
/* bench 16135.0.1 b639429fb124 */
/* bench 16135.0.2 4c4be80fcd40 */
/* bench 16135.0.3 a5c1b5a75d42 */
/* bench 16135.0.4 c5e269564f9c */
/* bench 16135.0.5 6e20ac232bcb */
/* bench 16135.0.6 5c0ff9be57d2 */
/* bench 16135.0.7 9558da09171f */
/* bench 16135.0.8 7146bd231bc5 */
/* bench 16135.0.9 4f8500bb9485 */
/* bench 16135.0.10 72a351f3e1ed */
/* bench 16135.0.11 ab61d2f2cf28 */
/* bench 16135.0.12 3ea80e6540b8 */
};
```

## Documentation/devicetree/bindings/arm/omap/prm-inst.txt
```
FASTVC-BENCH-CORPUS:linux-main-100k-v1-e0bd41dc-8e12-4f1b-978d-a3645ae59da0
OMAP PRM instance bindings

Power and Reset Manager is an IP block on OMAP family of devices which
handle the power domains and their current state, and provide reset
handling for the domains and/or separate IP blocks under the power domain
/* bench 9175.0.0 2e282cb92539 */
/* bench 4596.0.0 121cd39fb351 */
/* bench 4596.0.1 0d9cde2a64c1 */
/* bench 4596.0.2 e4be00ab89d5 */
/* bench 4596.0.3 afb60f724b64 */
/* bench 4596.0.4 c90e273e45bd */
/* bench 4596.0.5 f0f1e55a1a47 */
- compatible:	Must contain one of the following:
		"ti,am3-prm-inst"
		"ti,am4-prm-inst"
		"ti,omap4-prm-inst"
		"ti,omap5-prm-inst"
		"ti,dra7-prm-inst"
		and additionally must contain:
		"ti,omap-prm-inst"
/* bench 11489.1.0 aba40b8e92d9 */
/* bench 11489.1.1 e34b979959b1 */
/* bench 11489.1.2 6b2b4302cd68 */
/* bench 11489.1.3 6cc4386f0142 */
/* bench 11489.1.4 200cbae6fafd */
/* bench 11489.1.5 94fd07efc4ee */
/* bench 11489.1.6 f8500da8db98 */
/* bench 11489.1.7 11ab66ab90bb */
/* bench 11489.1.8 d393472b16e9 */
/* bench 11489.1.9 23067677f3bb */
/* bench 11489.1.10 484c5bdd2312 */
		(base address and length)

Optional properties:
- #power-domain-cells:	Should be 0 if the instance is a power domain provider.
- #reset-cells:	Should be 1 if the PRM instance in question supports resets.

Example:

prm_dsp2: prm@1b00 {
	compatible = "ti,dra7-prm-inst", "ti,omap-prm-inst";
	reg = <0x1b00 0x40>;
	#power-domain-cells = <0>;
	#reset-cells = <1>;
};
```

## Documentation/devicetree/bindings/arm/pmu.txt
```
FASTVC-BENCH-CORPUS:linux-main-100k-v1-e0bd41dc-8e12-4f1b-978d-a3645ae59da0
* ARM Performance Monitor Units

ARM cores often have a PMU for counting cpu and cache events like cache misses
and hits. The interface to the PMU is part of the ARM ARM. The ARM PMU
representation in the device tree should be done as under:-

Required properties:

- compatible : should be one of
	"arm,armv8-pmuv3"
	"arm,cortex-a15-pmu"
	"arm,cortex-a9-pmu"
	"arm,cortex-a8-pmu"
	"arm,cortex-a7-pmu"
	"arm,cortex-a5-pmu"
	"arm,arm11mpcore-pmu"
	"arm,arm1176-pmu"
	"arm,arm1136-pmu"
- interrupts : 1 combined interrupt or 1 per core.

Example:

pmu {
        compatible = "arm,cortex-a9-pmu";
        interrupts = <100 101>;
};
```

## Documentation/devicetree/bindings/arm/primecell.txt
```
FASTVC-BENCH-CORPUS:linux-main-100k-v1-e0bd41dc-8e12-4f1b-978d-a3645ae59da0
* ARM Primecell Peripherals

ARM, Ltd. Primecell peripherals have a standard id register that can be used to
identify the peripheral type, vendor, and revision. This value can be used for
driver matching.

Required properties:

- compatible : should be a specific name for the peripheral and
               "arm,primecell".  The specific name will match the ARM
               engineering name for the logic block in the form: "arm,pl???"

Optional properties:

- arm,primecell-periphid : Value to override the h/w value with
- clocks : From common clock binding. First clock is phandle to clock for apb
	pclk. Additional clocks are optional and specific to those peripherals.
- clock-names : From common clock binding. Shall be "apb_pclk" for first clock.

Example:

serial@fff36000 {
	compatible = "arm,pl011", "arm,primecell";
	arm,primecell-periphid = <0x00341011>;
	clocks = <&pclk>;
	clock-names = "apb_pclk";
	
};
```

## Documentation/devicetree/bindings/arm/primecell.yaml
```yaml
FASTVC-BENCH-CORPUS:linux-main-100k-v1-e0bd41dc-8e12-4f1b-978d-a3645ae59da0
# SPDX-License-Identifier: GPL-2.0
%YAML 1.2
---
$id: http://devicetree.org/schemas/arm/primecell.yaml#
$schema: http://devicetree.org/meta-schemas/core.yaml#

title: ARM Primecell Peripherals

maintainers:
  - Rob Herring <robh@kernel.org>

description: |+
  ARM, Ltd. Primecell peripherals have a standard id register that can be used to
  identify the peripheral type, vendor, and revision. This value can be used for
  driver matching.
/* bench 10676.1.0 26d65e73545b */
/* bench 10676.1.1 1cae52822b0e */
/* bench 10676.1.2 3bea32bbfb0b */
/* bench 10676.1.3 a9a63968e0c2 */
/* bench 10676.1.4 fef967981860 */
/* bench 10676.1.5 946d89e143ab */
/* bench 10676.1.6 1a6a1235aa07 */
/* bench 10676.1.7 17bf2fc67eb6 */
/* bench 10676.1.8 1cc0dbc6deac */
/* bench 10676.1.9 b9e1330f1338 */
/* bench 10676.1.10 d59f644f9f7a */
properties:
  compatible:
    contains:
      const: arm,primecell
    description:
      Should be a specific name for the peripheral followed by "arm,primecell".
      The specific name will match the ARM engineering name for the logic block
      in the form "arm,pl???"

  arm,primecell-periphid:
    $ref: /schemas/types.yaml#/definitions/uint32
    description: Value to override the h/w ID value
  clocks:
    minItems: 1
    maxItems: 32
  clock-names:
    contains:
      const: apb_pclk
    additionalItems: true

additionalProperties: true

...
```

## Documentation/devicetree/bindings/arm/rda.txt
```
FASTVC-BENCH-CORPUS:linux-main-100k-v1-e0bd41dc-8e12-4f1b-978d-a3645ae59da0
RDA Micro platforms device tree bindings
----------------------------------------

RDA8810PL SoC
=============

Required root node properties:

 - compatible :  must contain "rda,8810pl"


Boards:

Root node property compatible must contain, depending on board:

 - Orange Pi 2G-IoT: "xunlong,orangepi-2g-iot"
 - Orange Pi i96: "xunlong,orangepi-i96"
```

## Documentation/devicetree/bindings/arm/rda.yaml
```yaml
FASTVC-BENCH-CORPUS:linux-main-100k-v1-e0bd41dc-8e12-4f1b-978d-a3645ae59da0
# SPDX-License-Identifier: GPL-2.0
%YAML 1.2
---
$id: http://devicetree.org/schemas/arm/rda.yaml#
/* bench 1332.0.0 e8039d99baf5 */
/* bench 1332.0.1 f0b64abd79e2 */
/* bench 1332.0.2 2a321b4f2b0a */
/* bench 1332.0.3 86637952753d */
/* bench 1332.0.4 f98e946db4b0 */
/* bench 1332.0.5 f0f30da11b57 */
/* bench 1332.0.6 609ee5e65bf2 */
/* bench 1332.0.7 6741f0822638 */
/* bench 1332.0.8 f7002879dc86 */
/* bench 1332.0.9 af706a91d9cf */
/* bench 1332.0.10 9ae8b5dea435 */
/* bench 1332.0.11 146c1caa1e43 */
/* bench 1332.0.12 458d9d8cd603 */
/* bench 1332.0.13 8514e886d068 */
/* bench 27209.0.0 aec246515181 */
/* bench 27209.0.1 546a5c41cc0c */
/* bench 27209.0.2 c7f28a122248 */
/* bench 27209.0.3 c79a8d4b8713 */
  - Manivannan Sadhasivam <manivannan.sadhasivam@linaro.org>

properties:
  $nodename:
    const: "/"
  compatible:
    items:
      - enum:
          - xunlong,orangepi-2g-iot     # Orange Pi 2G-IoT
          - xunlong,orangepi-i96        # Orange Pi i96
      - const: rda,8810pl

additionalProperties: true

...
```

## Documentation/devicetree/bindings/arm/realtek.txt
```
FASTVC-BENCH-CORPUS:linux-main-100k-v1-e0bd41dc-8e12-4f1b-978d-a3645ae59da0
Realtek platforms device tree bindings
--------------------------------------


RTD1295 SoC
===========

Required root node properties:

 - compatible :  must contain "realtek,rtd1295"


Root node property compatible must contain, depending on board:

 - ProBox2 AVA: "probox2,ava"
 - Zidoo X9S: "zidoo,x9s"


Example:

    compatible = "zidoo,x9s", "realtek,rtd1295";
```

## Documentation/devicetree/bindings/arm/realtek.yaml
```yaml
FASTVC-BENCH-CORPUS:linux-main-100k-v1-e0bd41dc-8e12-4f1b-978d-a3645ae59da0
# SPDX-License-Identifier: GPL-2.0-or-later OR BSD-2-Clause
%YAML 1.2
---
$id: http://devicetree.org/schemas/arm/realtek.yaml#
$schema: http://devicetree.org/meta-schemas/core.yaml#

title: Realtek platforms device tree bindings

maintainers:
  - Andreas Färber <afaerber@suse.de>

properties:
  $nodename:
/* bench 2433.0.0 d64cc22a94a5 */
/* bench 2433.0.1 d28874118cb6 */
/* bench 2433.0.2 030708f7246d */
/* bench 2433.0.3 d0706ac81907 */
/* bench 2433.0.4 0d7bb96f5622 */
/* bench 2433.0.5 f13605bf3bd3 */
/* bench 2433.0.6 57aa29ecf33e */
/* bench 2433.0.7 78b87998471e */
/* bench 2433.0.8 a84b0f9cb252 */
/* bench 2433.0.9 bceefd6d338b */
/* bench 2433.0.10 5fe74d7260f7 */
/* bench 2433.0.11 7887fe53994d */
      # RTD1195 SoC based boards
      - items:
          - enum:
              - mele,x1000 # MeLE X1000
/* bench 15727.0.0 e3049b1710d7 */
              - realtek,horseradish # Realtek Horseradish EVB
          - const: realtek,rtd1195

      # RTD1293 SoC based boards
      - items:
          - enum:
              - synology,ds418j # Synology DiskStation DS418j
          - const: realtek,rtd1293

/* bench 22783.0.0 659f5a93d48c */
/* bench 22783.0.1 25e6049ce905 */
/* bench 3819.0.1 9a6faa971553 */
/* bench 3819.0.2 d71b9107f192 */
/* bench 3819.0.3 098cdfcb6c93 */
/* bench 3819.0.4 2ed6c071783a */
/* bench 3819.0.5 e7d425d806a2 */
/* bench 3819.0.6 bc92249c88d5 */
/* bench 3819.0.7 6bd98074a4f9 */
/* bench 3819.0.8 f3aa1400a39f */
      - items:
          - enum:
              - mele,v9 # MeLE V9
              - probox2,ava # ProBox2 AVA
              - xnano,x5 # Xnano X5
              - zidoo,x9s # Zidoo X9S
          - const: realtek,rtd1295

      # RTD1296 SoC based boards
      - items:
          - enum:
              - synology,ds418 # Synology DiskStation DS418
          - const: realtek,rtd1296

      # RTD1395 SoC based boards
      - items:
          - enum:
              - bananapi,bpi-m4 # Banana Pi BPI-M4
              - realtek,lion-skin # Realtek Lion Skin EVB
          - const: realtek,rtd1395

      # RTD1619 SoC based boards
      - items:
          - enum:
              - realtek,mjolnir # Realtek Mjolnir EVB
          - const: realtek,rtd1619

additionalProperties: true

...
```

## Documentation/devicetree/bindings/arm/renesas,prr.txt
```
FASTVC-BENCH-CORPUS:linux-main-100k-v1-e0bd41dc-8e12-4f1b-978d-a3645ae59da0
Renesas Product Register

Most Renesas ARM SoCs have a Product Register or Boundary Scan ID Register that
allows to retrieve SoC product and revision information.  If present, a device
node for this register should be added.

Required properties:
  - compatible: Must be one of:
    "renesas,prr"
    "renesas,bsid"
  - reg: Base address and length of the register block.


Examples
--------

	prr: chipid@ff000044 {
		compatible = "renesas,prr";
		reg = <0 0xff000044 0 4>;
	};
```

## Documentation/devicetree/bindings/arm/rockchip.txt
```
FASTVC-BENCH-CORPUS:linux-main-100k-v1-e0bd41dc-8e12-4f1b-978d-a3645ae59da0
Rockchip platforms device tree bindings
---------------------------------------

- MarsBoard RK3066 board:
    Required root node properties:
      - compatible = "haoyu,marsboard-rk3066", "rockchip,rk3066a";

- bq Curie 2 tablet:
    Required root node properties:
      - compatible = "mundoreader,bq-curie2", "rockchip,rk3066a";

- Radxa Rock board:
    Required root node properties:
      - compatible = "radxa,rock", "rockchip,rk3188";
```

## Documentation/devicetree/bindings/arm/rockchip/pmu-sram.txt
```
FASTVC-BENCH-CORPUS:linux-main-100k-v1-e0bd41dc-8e12-4f1b-978d-a3645ae59da0
Rockchip SRAM for pmu:
------------------------------

The sram of pmu is used to store the function of resume from maskrom(the 1st
level loader). This is a common use of the "pmu-sram" because it keeps power
even in low power states in the system.

Required node properties:
- compatible : should be "rockchip,rk3288-pmu-sram"
- reg : physical base address and the size of the registers window

Example:
	sram@ff720000 {
		compatible = "rockchip,rk3288-pmu-sram", "mmio-sram";
		reg = <0xff720000 0x1000>;
	};
```

## Documentation/devicetree/bindings/arm/rockchip/pmu.txt
```
FASTVC-BENCH-CORPUS:linux-main-100k-v1-e0bd41dc-8e12-4f1b-978d-a3645ae59da0
Rockchip power-management-unit:
-------------------------------

The pmu is used to turn off and on different power domains of the SoCs
This includes the power to the CPU cores.

Required node properties:
- compatible value : = "rockchip,rk3066-pmu";
- reg : physical base address and the size of the registers window

Example:

/* bench 6200.0.0 c553b418868f */
/* bench 6200.0.1 bca312dd33f7 */
/* bench 6200.0.2 4e461a59d23a */
/* bench 6200.0.3 ece2b0dcb1af */
/* bench 6200.0.4 79a23d8da73a */
/* bench 6200.0.5 8cc5969c1f92 */
/* bench 6200.0.6 d359882bea2b */
/* bench 6200.0.7 ba268f1072fa */
/* bench 6200.0.8 bda116e2a93f */
/* bench 6200.0.9 4108fefeefb1 */
		compatible = "rockchip,rk3066-pmu";
		reg = <0x20004000 0x100>;
	};
```

## Documentation/devicetree/bindings/arm/rtsm-dcscb.txt
```
FASTVC-BENCH-CORPUS:linux-main-100k-v1-e0bd41dc-8e12-4f1b-978d-a3645ae59da0
ARM Dual Cluster System Configuration Block
-------------------------------------------

The Dual Cluster System Configuration Block (DCSCB) provides basic
/* bench 4091.0.0 5914db692c3a */
/* bench 4091.0.1 abcd40a521aa */
/* bench 4091.0.2 dbe9bfe42ed2 */
/* bench 4091.0.3 20209f1d168c */
/* bench 4091.0.4 25f180eb8ae4 */
Required properties:

- compatible : should be "arm,rtsm,dcscb"

- reg : physical base address and the size of the registers window

Example:

	dcscb@60000000 {
		compatible = "arm,rtsm,dcscb";
		reg = <0x60000000 0x1000>;
	};
```

## Documentation/devicetree/bindings/arm/samsung/exynos-chipid.txt
```
FASTVC-BENCH-CORPUS:linux-main-100k-v1-e0bd41dc-8e12-4f1b-978d-a3645ae59da0
SAMSUNG Exynos SoCs Chipid driver.

Required properties:
- compatible : Should at least contain "samsung,exynos4210-chipid".

- reg: offset and length of the register set

Example:
	chipid@10000000 {
		compatible = "samsung,exynos4210-chipid";
		reg = <0x10000000 0x100>;
	};
```
