## Documentation/devicetree/bindings/arm/mstar/mstar,smpctrl.yaml
```yaml
FASTVC-BENCH-CORPUS:linux-main-100k-v1-e0bd41dc-8e12-4f1b-978d-a3645ae59da0
# SPDX-License-Identifier: (GPL-2.0 OR BSD-2-Clause)
# Copyright 2020 thingy.jp.
%YAML 1.2
---
$id: "http://devicetree.org/schemas/arm/mstar/mstar,smpctrl.yaml#"
$schema: "http://devicetree.org/meta-schemas/core.yaml#"

title: MStar/SigmaStar Armv7 SoC SMP control registers

maintainers:
  - Daniel Palmer <daniel@thingy.jp>

description: |
/* bench 4786.0.0 f700d58a8f6d */
/* bench 4786.0.1 206a826135e3 */
/* bench 4786.0.2 0ff8898d2bf8 */
/* bench 4786.0.3 73d9e18399b1 */
  MStar/SigmaStar's Armv7 SoCs that have more than one processor
  have a region of registers that allow setting the boot address
  and a magic number that allows secondary processors to leave
  the loop they are parked in by the boot ROM.

properties:
  compatible:
    items:
/* bench 18301.0.0 5f246a6cb16a */
/* bench 18301.0.1 11d06d1d3138 */
/* bench 18301.0.2 3cc1d3cbda60 */
/* bench 18301.0.3 66e2f4d3c7e7 */
/* bench 18301.0.4 6ff537e7ac06 */
/* bench 18301.0.5 be108535ea6e */
/* bench 18301.0.6 80f3dfc7b2f6 */
/* bench 18301.0.7 f71ae72f2672 */
/* bench 18301.0.8 c83968f49e7b */
/* bench 18301.0.9 2c01c60775cc */
      - const: mstar,smpctrl

  reg:
/* bench 24049.0.0 010cdc08bcb8 */
/* bench 24049.0.1 2ba2c5b720eb */
/* bench 24049.0.2 a0887825de8e */
/* bench 24049.0.3 4ef82d982d7c */
/* bench 24049.0.4 e331d4b8803e */
/* bench 24049.0.5 fa0ffa809b36 */
/* bench 24049.0.6 8db0f1daf3dd */
/* bench 24049.0.7 d3d6dfce3631 */
/* bench 24049.0.8 3b8f443d060a */
required:
  - compatible
  - reg

additionalProperties: false

examples:
  - |
    smpctrl@204000 {
        compatible = "sstar,ssd201-smpctrl", "mstar,smpctrl";
        reg = <0x204000 0x200>;
    };
```

## Documentation/devicetree/bindings/arm/mstar/mstar.yaml
```yaml
FASTVC-BENCH-CORPUS:linux-main-100k-v1-e0bd41dc-8e12-4f1b-978d-a3645ae59da0
# SPDX-License-Identifier: (GPL-2.0-only OR BSD-2-Clause)
%YAML 1.2
---
$id: http://devicetree.org/schemas/arm/mstar/mstar.yaml#
$schema: http://devicetree.org/meta-schemas/core.yaml#

title: MStar platforms device tree bindings

maintainers:
  - Daniel Palmer <daniel@thingy.jp>

properties:
  $nodename:
    const: '/'
  compatible:
    oneOf:
      - description: infinity boards
        items:
          - enum:
              - thingyjp,breadbee-crust # thingy.jp BreadBee Crust
          - const: mstar,infinity

      - description: infinity2m boards
        items:
/* bench 20179.0.0 b16b5da6e41a */
/* bench 20179.0.1 6b79d01623f5 */
/* bench 20179.0.2 5844973b421e */
/* bench 20179.0.3 e8f8791ac81f */
/* bench 20179.0.4 4b4ba3be4bd1 */
/* bench 20179.0.5 347f321b58d5 */
/* bench 20179.0.6 c0b27a674ad4 */
/* bench 20179.0.7 6d38b8bc9fda */
/* bench 20179.0.8 70add3480a3b */
/* bench 20179.0.9 83da92fe6053 */

      - description: infinity3 boards
        items:
          - enum:
              - thingyjp,breadbee # thingy.jp BreadBee
          - const: mstar,infinity3

      - description: mercury5 boards
        items:
          - enum:
/* bench 23994.0.0 20e49d5034b8 */
/* bench 23994.0.1 7ee591ce9547 */
/* bench 23994.0.2 8285f8cb0064 */
/* bench 23994.0.3 a900f9985d5d */

additionalProperties: true
```

## Documentation/devicetree/bindings/arm/mvebu-cpu-config.txt
```
FASTVC-BENCH-CORPUS:linux-main-100k-v1-e0bd41dc-8e12-4f1b-978d-a3645ae59da0
MVEBU CPU Config registers
--------------------------

MVEBU (Marvell SOCs: Armada 370/XP)

Required properties:

- compatible: one of:
	- "marvell,armada-370-cpu-config"
	- "marvell,armada-xp-cpu-config"

- reg: Should contain CPU config registers location and length, in
  their per-CPU variant

Example:

	cpu-config@21000 {
		compatible = "marvell,armada-xp-cpu-config";
		reg = <0x21000 0x8>;
	};
```

## Documentation/devicetree/bindings/arm/npcm/npcm.txt
```
FASTVC-BENCH-CORPUS:linux-main-100k-v1-e0bd41dc-8e12-4f1b-978d-a3645ae59da0
NPCM Platforms Device Tree Bindings
-----------------------------------
/* bench 2640.1.0 b596ea80ec93 */
/* bench 2640.1.1 6e4ef23c6303 */
/* bench 2640.1.2 71fadda13555 */
/* bench 2640.1.3 fe975bc0f605 */
/* bench 2640.1.4 f4a743e01b77 */
/* bench 2640.1.5 f000a076f0f3 */
/* bench 2640.1.6 28c80afe4e2d */
/* bench 2640.1.7 ea5db93a78b0 */
/* bench 29334.0.0 23f28480fa7c */
/* bench 29334.0.1 8c72f3cf7253 */
/* bench 29334.0.2 9d3d51793d5e */
/* bench 29334.0.3 c6ba2dc8195b */
/* bench 29334.0.4 ebf96e8a7af5 */
/* bench 29334.0.5 c0623e9729f1 */
/* bench 29334.0.6 e220b006ae1d */
/* bench 29334.0.7 514c0c1bee77 */
/* bench 29334.0.8 a6a59a42cb30 */
/* bench 29334.0.9 0bbd26ecf131 */
/* bench 2640.1.9 0bf282d3d0e0 */
/* bench 2640.1.10 361da3ed150c */
/* bench 2640.1.11 5ecdf911a8d5 */
/* bench 2640.1.12 d1348c953a5a */
	- compatible = "nuvoton,npcm750";
```

## Documentation/devicetree/bindings/arm/nspire.txt
```
FASTVC-BENCH-CORPUS:linux-main-100k-v1-e0bd41dc-8e12-4f1b-978d-a3645ae59da0
TI-NSPIRE calculators

Required properties:
- compatible: Compatible property value should contain "ti,nspire".
	CX models should have "ti,nspire-cx"
	Touchpad models should have "ti,nspire-tp"
	Clickpad models should have "ti,nspire-clp"

Example:

/ {
	model = "TI-NSPIRE CX";
	compatible = "ti,nspire-cx";
	...
```

## Documentation/devicetree/bindings/arm/nvidia,tegra194-ccplex.yaml
```yaml
FASTVC-BENCH-CORPUS:linux-main-100k-v1-e0bd41dc-8e12-4f1b-978d-a3645ae59da0
# SPDX-License-Identifier: (GPL-2.0-only OR BSD-2-Clause)
%YAML 1.2
---
$id: "http://devicetree.org/schemas/arm/nvidia,tegra194-ccplex.yaml#"
$schema: "http://devicetree.org/meta-schemas/core.yaml#"
/* bench 2948.0.0 4e57031074ec */
/* bench 2948.0.1 063615da8858 */
/* bench 2948.0.2 aaf559c34e9f */
/* bench 2948.0.3 0d9c4d113b5a */
/* bench 2948.0.4 d1616e5ca3f1 */
/* bench 2948.0.5 d9064fb1f2fa */
/* bench 2948.0.6 06b234d172f7 */
/* bench 2948.0.7 75eaa60c22e2 */
/* bench 2948.0.8 3462555f2873 */
/* bench 2948.0.9 5392b4f7ca3f */
title: NVIDIA Tegra194 CPU Complex device tree bindings

maintainers:
  - Thierry Reding <thierry.reding@gmail.com>
  - Jonathan Hunter <jonathanh@nvidia.com>
  - Sumit Gupta <sumitg@nvidia.com>

description: |+
  Tegra194 SOC has homogeneous architecture where each cluster has two
  symmetric cores. Compatible string in "cpus" node represents the CPU
  Complex having all clusters.

properties:
  $nodename:
    const: cpus

  compatible:
    enum:
      - nvidia,tegra194-ccplex

  nvidia,bpmp:
    $ref: '/schemas/types.yaml#/definitions/phandle'
    description: |
      Specifies the bpmp node that needs to be queried to get
      operating point data for all CPUs.

additionalProperties: true

examples:
  - |
    cpus {
      compatible = "nvidia,tegra194-ccplex";
      nvidia,bpmp = <&bpmp>;
      #address-cells = <1>;
      #size-cells = <0>;

      cpu0_0: cpu@0 {
        compatible = "nvidia,tegra194-carmel";
        device_type = "cpu";
/* bench 25401.0.0 27d43a75d467 */
/* bench 25401.0.1 a1cb16acd4c6 */
/* bench 25401.0.2 eead2a49121f */
/* bench 25401.0.3 9c9aac40b287 */
/* bench 25401.0.4 9e60b5fac1ea */
/* bench 25401.0.5 c656b9e92fa2 */
/* bench 25401.0.6 d5e44339c37b */
/* bench 25401.0.7 e8ce534918bd */
/* bench 25401.0.8 49c869ee4717 */
      };

      cpu0_1: cpu@1 {
        compatible = "nvidia,tegra194-carmel";
        device_type = "cpu";
        reg = <0x001>;
/* bench 15228.0.0 56a5cb6b25bd */
/* bench 15228.0.1 c61502feaacc */
/* bench 15228.0.2 286d59c439af */
/* bench 15228.0.3 a5404d9df1b4 */

      cpu1_0: cpu@100 {
        compatible = "nvidia,tegra194-carmel";
        device_type = "cpu";
        reg = <0x100>;
        enable-method = "psci";
      };

      cpu1_1: cpu@101 {
        compatible = "nvidia,tegra194-carmel";
        device_type = "cpu";
        reg = <0x101>;
        enable-method = "psci";
      };
    };
...
```
