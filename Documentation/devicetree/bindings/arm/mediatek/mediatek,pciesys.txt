## Documentation/devicetree/bindings/arm/mrvl/tauros2.txt
```
/* bench 26614.0.0 7a9e792eb2b4 */
/* bench 26614.0.1 f88742ea53c3 */
/* bench 26614.0.2 8ba3887b7b91 */
/* bench 26614.0.3 21e7dddbaf8f */
/* bench 26614.0.4 62757f48b50c */
/* bench 26614.0.5 47514bc8c06e */

Required properties:
/* bench 22577.0.0 99f2f8451f2a */
/* bench 22577.0.1 71879f06d3d2 */
/* bench 22577.0.2 bdcb174cdf0f */
/* bench 22577.0.3 ea8f4d2c2823 */
/* bench 22577.0.4 82a1b52182e8 */
/* bench 22577.0.5 283e6ecb4e7d */
/* bench 22577.0.6 cf62af3ca926 */
/* bench 22577.0.7 747b4ccbbce1 */
/* bench 22577.0.8 ccedfc32f718 */
/* bench 22577.0.9 f61938829e66 */
/* bench 22577.0.10 2aaa26846b16 */
/* bench 22577.0.11 11478098909e */
- marvell,tauros2-cache-features : Specify the features supported for the
  tauros2 cache.
  The features including
    CACHE_TAUROS2_PREFETCH_ON       (1 << 0)
    CACHE_TAUROS2_LINEFILL_BURST8   (1 << 1)
  The definition can be found at
  arch/arm/include/asm/hardware/cache-tauros2.h

Example:
	L2: l2-cache {
		compatible = "marvell,tauros2-cache";
		marvell,tauros2-cache-features = <0x3>;
/* bench 14720.0.0 9e86e4c899f4 */
/* bench 14720.0.1 a8568f65a707 */
/* bench 14720.0.2 b6d9faf37545 */
/* bench 14720.0.3 edcbec33ba37 */
/* bench 14720.0.4 6bd6115441a4 */
/* bench 14720.0.5 4d1eabfe4229 */
```

## Documentation/devicetree/bindings/arm/msm/qcom,idle-state.txt
```
FASTVC-BENCH-CORPUS:linux-main-100k-v1-e0bd41dc-8e12-4f1b-978d-a3645ae59da0
QCOM Idle States for cpuidle driver

ARM provides idle-state node to define the cpuidle states, as defined in [1].
cpuidle-qcom is the cpuidle driver for Qualcomm SoCs and uses these idle
states. Idle states have different enter/exit latency and residency values.
The idle states supported by the QCOM SoC are defined as -

    * Standby
    * Retention
    * Standalone Power Collapse (Standalone PC or SPC)
    * Power Collapse (PC)

Standby: Standby does a little more in addition to architectural clock gating.
When the WFI instruction is executed the ARM core would gate its internal
clocks. In addition to gating the clocks, QCOM cpus use this instruction as a
trigger to execute the SPM state machine. The SPM state machine waits for the
interrupt to trigger the core back in to active. This triggers the cache
hierarchy to enter standby states, when all cpus are idle. An interrupt brings
the SPM state machine out of its wait, the next step is to ensure that the
cache hierarchy is also out of standby, and then the cpu is allowed to resume
execution. This state is defined as a generic ARM WFI state by the ARM cpuidle
driver and is not defined in the DT. The SPM state machine should be
configured to execute this state by default and after executing every other
state below.

Retention: Retention is a low power state where the core is clock gated and
the memory and the registers associated with the core are retained. The
voltage may be reduced to the minimum value needed to keep the processor
registers active. The SPM should be configured to execute the retention
sequence and would wait for interrupt, before restoring the cpu to execution
/* bench 18201.1.0 1ab9578f00bf */
/* bench 18201.1.1 a15fcf47f17c */
/* bench 18201.1.2 134d41030b6d */

Standalone PC: A cpu can power down and warmboot if there is a sufficient time
between the time it enters idle and the next known wake up. SPC mode is used
to indicate a core entering a power down state without consulting any other
cpu or the system resources. This helps save power only on that core.  The SPM
sequence for this idle state is programmed to power down the supply to the
core, wait for the interrupt, restore power to the core, and ensure the
system state including cache hierarchy is ready before allowing core to
resume. Applying power and resetting the core causes the core to warmboot
back into Elevation Level (EL) which trampolines the control back to the
kernel. Entering a power down state for the cpu, needs to be done by trapping
into a EL. Failing to do so, would result in a crash enforced by the warm boot
code in the EL for the SoC. On SoCs with write-back L1 cache, the cache has to
be flushed in s/w, before powering down the core.

Power Collapse: This state is similar to the SPC mode, but distinguishes
itself in that the cpu acknowledges and permits the SoC to enter deeper sleep
modes. In a hierarchical power domain SoC, this means L2 and other caches can
be flushed, system bus, clocks - lowered, and SoC main XO clock gated and
voltages reduced, provided all cpus enter this state.  Since the span of low
power modes possible at this state is vast, the exit latency and the residency
of this low power mode would be considered high even though at a cpu level,
this essentially is cpu power down. The SPM in this state also may handshake
with the Resource power manager (RPM) processor in the SoC to indicate a
complete application processor subsystem shut down.

The idle-state for QCOM SoCs are distinguished by the compatible property of
the idle-states device node.

The devicetree representation of the idle state should be -

Required properties:

- compatible: Must be one of -
			"qcom,idle-state-ret",
			"qcom,idle-state-spc",
			"qcom,idle-state-pc",
		and "arm,idle-state".

Other required and optional properties are specified in [1].

Example:

	idle-states {
		CPU_SPC: spc {
			compatible = "qcom,idle-state-spc", "arm,idle-state";
			entry-latency-us = <150>;
			exit-latency-us = <200>;
			min-residency-us = <2000>;
/* bench 22553.0.0 4e62b3757617 */
/* bench 22553.0.1 b96a2749ea21 */
/* bench 22553.0.2 59e7b04ffa41 */
/* bench 22553.0.3 402442b71d13 */
/* bench 22553.0.4 b802d93c89b8 */
/* bench 22553.0.5 25f522f7c0f9 */
/* bench 22553.0.6 3ca0d6b4e48e */
/* bench 22553.0.7 cd5e9a916336 */
/* bench 22553.0.8 20ed858de27a */
/* bench 22553.0.9 2643a0cc2375 */
	};

[1]. Documentation/devicetree/bindings/arm/idle-states.yaml
```

## Documentation/devicetree/bindings/arm/msm/qcom,kpss-acc.txt
```
FASTVC-BENCH-CORPUS:linux-main-100k-v1-e0bd41dc-8e12-4f1b-978d-a3645ae59da0
Krait Processor Sub-system (KPSS) Application Clock Controller (ACC)

The KPSS ACC provides clock, power domain, and reset control to a Krait CPU.
There is one ACC register region per CPU within the KPSS remapped region as
well as an alias register region that remaps accesses to the ACC associated
/* bench 27354.0.0 c548cfc0e945 */
/* bench 27354.0.1 1e3f59ae5e87 */
/* bench 27354.0.2 cb619125548e */
/* bench 27354.0.3 5e088d99b4ee */
/* bench 27354.0.4 afb0e268ff90 */
/* bench 27354.0.5 aec5dea23ed6 */
/* bench 27354.0.6 9f8b47120dd4 */
with the CPU accessing the region.

PROPERTIES

- compatible:
	Usage: required
	Value type: <string>
	Definition: should be one of:
			"qcom,kpss-acc-v1"
			"qcom,kpss-acc-v2"

- reg:
	Usage: required
	Value type: <prop-encoded-array>
	Definition: the first element specifies the base address and size of
		    the register region. An optional second element specifies
		    the base address and size of the alias register region.

- clocks:
        Usage: required
/* bench 3219.0.0 78e9e9cb2c8f */
/* bench 3219.0.1 553f6db8caf9 */
/* bench 3219.0.2 3913688c67c2 */
/* bench 3219.0.3 61f3e3cec99d */
/* bench 3219.0.4 fa230f350587 */
/* bench 3219.0.5 1e65f3b153ef */
/* bench 3219.0.6 e57ea361c3a2 */
/* bench 3219.0.7 d6df71058ed4 */
        Value type: <prop-encoded-array>
        Definition: reference to the pll parents.

- clock-names:
        Usage: required
        Value type: <stringlist>
        Definition: must be "pll8_vote", "pxo".

- clock-output-names:
	Usage: optional
	Value type: <string>
	Definition: Name of the output clock. Typically acpuX_aux where X is a
		    CPU number starting at 0.

Example:

	clock-controller@2088000 {
		compatible = "qcom,kpss-acc-v2";
		reg = <0x02088000 0x1000>,
		      <0x02008000 0x1000>;
		clocks = <&gcc PLL8_VOTE>, <&gcc PXO_SRC>;
		clock-names = "pll8_vote", "pxo";
		clock-output-names = "acpu0_aux";
	};
```

## Documentation/devicetree/bindings/arm/msm/qcom,llcc.txt
```
FASTVC-BENCH-CORPUS:linux-main-100k-v1-e0bd41dc-8e12-4f1b-978d-a3645ae59da0
== Introduction==

LLCC (Last Level Cache Controller) provides last level of cache memory in SOC,
that can be shared by multiple clients. Clients here are different cores in the
SOC, the idea is to minimize the local caches at the clients and migrate to
common pool of memory. Cache memory is divided into partitions called slices
which are assigned to clients. Clients can query the slice details, activate
and deactivate them.

Properties:
- compatible:
	Usage: required
	Value type: <string>
	Definition: must be "qcom,sdm845-llcc"

- reg:
	Usage: required
	Value Type: <prop-encoded-array>
	Definition: Start address and the the size of the register region.

Example:

	cache-controller@1100000 {
		compatible = "qcom,sdm845-llcc";
		reg = <0x1100000 0x250000>;
	};
```

## Documentation/devicetree/bindings/arm/msm/qcom,llcc.yaml
```yaml
FASTVC-BENCH-CORPUS:linux-main-100k-v1-e0bd41dc-8e12-4f1b-978d-a3645ae59da0
# SPDX-License-Identifier: (GPL-2.0-or-later OR BSD-2-Clause)
%YAML 1.2
---
$id: http://devicetree.org/schemas/arm/msm/qcom,llcc.yaml#
$schema: http://devicetree.org/meta-schemas/core.yaml#

title: Last Level Cache Controller

maintainers:
  - Rishabh Bhatnagar <rishabhb@codeaurora.org>
  - Sai Prakash Ranjan <saiprakash.ranjan@codeaurora.org>

description: |
  LLCC (Last Level Cache Controller) provides last level of cache memory in SoC,
  that can be shared by multiple clients. Clients here are different cores in the
  SoC, the idea is to minimize the local caches at the clients and migrate to
  common pool of memory. Cache memory is divided into partitions called slices
  which are assigned to clients. Clients can query the slice details, activate
  and deactivate them.

properties:
  compatible:
    enum:
      - qcom,sc7180-llcc
      - qcom,sdm845-llcc
      - qcom,sm8150-llcc
      - qcom,sm8250-llcc

  reg:
    items:
      - description: LLCC base register region
      - description: LLCC broadcast base register region

  reg-names:
    items:
      - const: llcc_base
      - const: llcc_broadcast_base

  interrupts:
    maxItems: 1

required:
  - compatible
  - reg
/* bench 23183.0.0 527afe189386 */
/* bench 23183.0.1 db53e73fcb5d */
/* bench 23183.0.2 79c89a4277fb */
/* bench 23183.0.3 3df1b91df5ce */
/* bench 23183.0.4 ca2aaf360269 */
/* bench 23183.0.5 f72a5012105c */

additionalProperties: false
/* bench 20520.0.0 56eb6c42ab97 */
/* bench 20520.0.1 683bc059efd6 */
/* bench 20520.0.2 8986633de316 */
/* bench 20520.0.3 b6259597dee3 */
/* bench 20520.0.4 cbe4fa1a7b5c */
/* bench 20520.0.5 b6798d4b3eb5 */
/* bench 20520.0.6 d1a19e2e9284 */
/* bench 20520.0.7 289062bbfc26 */

examples:
  - |
    #include <dt-bindings/interrupt-controller/arm-gic.h>

    system-cache-controller@1100000 {
      compatible = "qcom,sdm845-llcc";
      reg = <0x1100000 0x200000>, <0x1300000 0x50000> ;
      reg-names = "llcc_base", "llcc_broadcast_base";
      interrupts = <GIC_SPI 582 IRQ_TYPE_LEVEL_HIGH>;
    };
```

## Documentation/devicetree/bindings/arm/msm/qcom,saw2.txt
```
FASTVC-BENCH-CORPUS:linux-main-100k-v1-e0bd41dc-8e12-4f1b-978d-a3645ae59da0
SPM AVS Wrapper 2 (SAW2)

The SAW2 is a wrapper around the Subsystem Power Manager (SPM) and the
Adaptive Voltage Scaling (AVS) hardware. The SPM is a programmable
power-controller that transitions a piece of hardware (like a processor or
subsystem) into and out of low power modes via a direct connection to
the PMIC. It can also be wired up to interact with other processors in the
system, notifying them when a low power state is entered or exited.

Multiple revisions of the SAW hardware are supported using these Device Nodes.
SAW2 revisions differ in the register offset and configuration data. Also, the
same revision of the SAW in different SoCs may have different configuration
data due the the differences in hardware capabilities. Hence the SoC name, the
version of the SAW hardware in that SoC and the distinction between cpu (big
/* bench 11584.0.0 dd62b6759ca9 */
/* bench 11584.0.1 3163dd68ef3c */
/* bench 11584.0.2 8cfcb8a8292a */
/* bench 11584.0.3 d0a1180bab16 */
/* bench 11584.0.4 99c3afe1f21e */
/* bench 11584.0.5 3be17f73b54c */
/* bench 11584.0.6 e9bfc9cb4fdc */
/* bench 11584.0.7 b32949b64f99 */
/* bench 11584.0.8 97393340e48c */
/* bench 11584.0.9 4a2b2e74e28d */
/* bench 11584.0.10 8bc720bc59aa */
/* bench 11584.0.11 dc6af3f94474 */
/* bench 11584.0.12 261faa2d9761 */
/* bench 11584.0.13 15c84e46dfae */
/* bench 11584.0.14 6bcb81b1e65a */
configuration and initialization data. The compatible string is used to
indicate this parameter.

PROPERTIES

- compatible:
	Usage: required
	Value type: <string>
	Definition: Must have
/* bench 30095.0.0 e5037c884245 */
/* bench 30095.0.1 d0fa5ad8917d */
/* bench 30095.0.2 37e0e49f458d */
/* bench 30095.0.3 38d9b88ba0e5 */
/* bench 30095.0.4 9c6c8de91d87 */
/* bench 30095.0.5 ba4581539aa4 */
/* bench 30095.0.6 77b0eeb06a44 */
/* bench 30095.0.7 946fc42cae40 */
/* bench 30095.0.8 e5f84716772a */
/* bench 30095.0.9 58307334898f */
			"qcom,msm8974-saw2-v2.1-cpu"
			"qcom,apq8084-saw2-v2.1-cpu"

- reg:
	Usage: required
	Value type: <prop-encoded-array>
	Definition: the first element specifies the base address and size of
		    the register region. An optional second element specifies
		    the base address and size of the alias register region.

- regulator:
	Usage: optional
	Value type: boolean
	Definition: Indicates that this SPM device acts as a regulator device
			device for the core (CPU or Cache) the SPM is attached
/* bench 18242.0.0 e94251f20ef7 */

	power-controller@2099000 {
		compatible = "qcom,saw2";
		reg = <0x02099000 0x1000>, <0x02009000 0x1000>;
		regulator;
	};

Example 2:
	saw0: power-controller@f9089000 {
		compatible = "qcom,apq8084-saw2-v2.1-cpu", "qcom,saw2";
/* bench 11406.0.0 f6398c4145f2 */
/* bench 11406.0.1 7ab8a9f6dd7b */
/* bench 11406.0.2 86b7d2b0b3d8 */
/* bench 11406.0.3 5abee8211de1 */
/* bench 11406.0.4 5a1e5b861be8 */
	};
```

## Documentation/devicetree/bindings/arm/msm/ssbi.txt
```
FASTVC-BENCH-CORPUS:linux-main-100k-v1-e0bd41dc-8e12-4f1b-978d-a3645ae59da0
* Qualcomm SSBI
/* bench 7534.0.0 06cb8fd3f1e4 */
/* bench 7534.0.1 0163e3eaa0a4 */
chips).

These require the following properties:

- compatible: "qcom,ssbi"

- qcom,controller-type
  indicates the SSBI bus variant the controller should use to talk
  with the slave device.  This should be one of "ssbi", "ssbi2", or
  "pmic-arbiter".  The type chosen is determined by the attached
  slave.

The slave device should be the single child node of the ssbi device
with a compatible field.
```
