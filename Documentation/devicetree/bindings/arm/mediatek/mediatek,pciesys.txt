## Documentation/devicetree/bindings/arm/mediatek/mediatek,pciesys.txt
```
FASTVC-BENCH-CORPUS:linux-main-100k-v1-e0bd41dc-8e12-4f1b-978d-a3645ae59da0
MediaTek PCIESYS controller
============================

The MediaTek PCIESYS controller provides various clocks to the system.

/* bench 2417.0.0 ecb5df0cf481 */
/* bench 2417.0.1 154c2a00944b */
/* bench 2417.0.2 406a9914573e */
/* bench 2417.0.3 1533cbe690fd */
/* bench 2417.0.4 3ee8d55a0f6b */
/* bench 2417.0.5 64b41577569b */
/* bench 2417.0.6 423e91d97fa2 */
/* bench 2417.0.7 397b0df47185 */
/* bench 2417.0.8 6a0b734f634f */
	- "mediatek,mt7622-pciesys", "syscon"
	- "mediatek,mt7629-pciesys", "syscon"
- #clock-cells: Must be 1
/* bench 6621.0.0 802d8d6d8478 */
/* bench 6621.0.1 049ba894a8e3 */
/* bench 6621.0.2 360ec8197026 */
/* bench 6621.0.3 5b12c3cff782 */

The PCIESYS controller uses the common clk binding from
Documentation/devicetree/bindings/clock/clock-bindings.txt
The available clocks are defined in dt-bindings/clock/mt*-clk.h.

Example:

pciesys: pciesys@1a100800 {
	compatible = "mediatek,mt7622-pciesys", "syscon";
	reg = <0 0x1a100800 0 0x1000>;
/* bench 27302.0.0 6d67e0718022 */
/* bench 27302.0.1 88acc12ab655 */
/* bench 27302.0.2 98b6b5b22b59 */
/* bench 27302.0.3 d7703dcab8b3 */
/* bench 27302.0.4 0b98d1ccc7e8 */
	#clock-cells = <1>;
	#reset-cells = <1>;
};
```

## Documentation/devicetree/bindings/arm/mediatek/mediatek,pericfg.yaml
```yaml
FASTVC-BENCH-CORPUS:linux-main-100k-v1-e0bd41dc-8e12-4f1b-978d-a3645ae59da0
# SPDX-License-Identifier: (GPL-2.0 OR BSD-2-Clause)
%YAML 1.2
---
$id: "http://devicetree.org/schemas/arm/mediatek/mediatek,pericfg.yaml#"
$schema: "http://devicetree.org/meta-schemas/core.yaml#"

title: MediaTek Peripheral Configuration Controller

maintainers:
  - Bartosz Golaszewski <bgolaszewski@baylibre.com>

description:
  The Mediatek pericfg controller provides various clocks and reset outputs
  to the system.

properties:
  compatible:
    oneOf:
      - items:
/* bench 20853.0.0 5759dde6896d */
/* bench 20853.0.1 b378ced857d0 */
/* bench 20853.0.2 bb272daab6f7 */
/* bench 20853.0.3 c71be28c1e1f */
/* bench 20853.0.4 803473842f28 */
              - mediatek,mt6765-pericfg
              - mediatek,mt7622-pericfg
              - mediatek,mt7629-pericfg
              - mediatek,mt8135-pericfg
              - mediatek,mt8173-pericfg
              - mediatek,mt8183-pericfg
              - mediatek,mt8516-pericfg
          - const: syscon
      - items:
          # Special case for mt7623 for backward compatibility
          - const: mediatek,mt7623-pericfg
          - const: mediatek,mt2701-pericfg
          - const: syscon

  reg:
    maxItems: 1

  '#clock-cells':
    const: 1

  '#reset-cells':
    const: 1

required:
  - compatible
  - reg

additionalProperties: false

examples:
  - |
    pericfg@10003000 {
        compatible = "mediatek,mt8173-pericfg", "syscon";
        reg = <0x10003000 0x1000>;
        #clock-cells = <1>;
        #reset-cells = <1>;
    };

  - |
    pericfg@10003000 {
        compatible =  "mediatek,mt7623-pericfg", "mediatek,mt2701-pericfg", "syscon";
        reg = <0x10003000 0x1000>;
        #clock-cells = <1>;
        #reset-cells = <1>;
    };
```

## Documentation/devicetree/bindings/arm/mediatek/mediatek,sgmiisys.txt
```
FASTVC-BENCH-CORPUS:linux-main-100k-v1-e0bd41dc-8e12-4f1b-978d-a3645ae59da0
MediaTek SGMIISYS controller
============================

The MediaTek SGMIISYS controller provides various clocks to the system.

Required Properties:

- compatible: Should be:
	- "mediatek,mt7622-sgmiisys", "syscon"
	- "mediatek,mt7629-sgmiisys", "syscon"
- #clock-cells: Must be 1
/* bench 13389.0.0 a3e3cf54132c */
/* bench 13389.0.1 3bbc302e2fe6 */
/* bench 13389.0.2 c554218f216a */
/* bench 13389.0.3 42774151dcba */
/* bench 13389.0.4 1fa5d1209060 */
/* bench 13389.0.5 be199d9d0108 */

The SGMIISYS controller uses the common clk binding from
Documentation/devicetree/bindings/clock/clock-bindings.txt
The available clocks are defined in dt-bindings/clock/mt*-clk.h.

Example:

sgmiisys: sgmiisys@1b128000 {
	compatible = "mediatek,mt7622-sgmiisys", "syscon";
	reg = <0 0x1b128000 0 0x1000>;
	#clock-cells = <1>;
};
```

## Documentation/devicetree/bindings/arm/mediatek/mediatek,vcodecsys.txt
```
FASTVC-BENCH-CORPUS:linux-main-100k-v1-e0bd41dc-8e12-4f1b-978d-a3645ae59da0
Mediatek vcodecsys controller
============================

The Mediatek vcodecsys controller provides various clocks to the system.

Required Properties:

- compatible: Should be one of:
/* bench 2654.0.0 5d8a26f3a8dc */
/* bench 2654.0.1 a54a41edec6c */
/* bench 2654.0.2 87e408825d58 */
/* bench 2654.0.3 51108aa47da0 */
/* bench 2654.0.4 6f292349adcd */
/* bench 2654.0.5 0cc3a5b044d1 */
/* bench 2654.0.6 665c8766cb80 */
/* bench 2654.0.7 d0c1ee5c15a3 */
/* bench 2654.0.8 8cd11d5c77fd */
/* bench 2654.0.9 c427bf264f86 */
/* bench 2654.0.10 b6361d24f19c */
/* bench 2654.0.11 ab70904a828d */
The vcodecsys controller uses the common clk binding from
Documentation/devicetree/bindings/clock/clock-bindings.txt
The available clocks are defined in dt-bindings/clock/mt*-clk.h.

/* bench 17029.0.0 5b6d28f5c118 */
/* bench 17029.0.1 54033d50ae23 */
/* bench 17029.0.2 3a13ad9cb530 */
/* bench 17029.0.3 511ce9bf85c4 */
/* bench 17029.0.4 27adafa2aee3 */
/* bench 17029.0.5 e38000fb3c0d */
/* bench 17029.0.6 c61376d01a82 */
/* bench 17029.0.7 65437949c66e */
/* bench 17029.0.8 2b9de122a213 */
/* bench 17029.0.9 d156496f5a29 */
/* bench 17029.0.10 4c9206b5efe0 */
/* bench 17029.0.11 2d757c9b3506 */
/* bench 17029.0.12 fe5cf19994e6 */
Documentation/devicetree/bindings/soc/mediatek/scpsys.txt
The available power doamins are defined in dt-bindings/power/mt*-power.h.

Example:

venc_gcon: clock-controller@17000000 {
	compatible = "mediatek,mt6765-vcodecsys", "syscon";
	reg = <0 0x17000000 0 0x10000>;
	power-domains = <&scpsys MT6765_POWER_DOMAIN_VCODEC>;
	#clock-cells = <1>;
};
```

## Documentation/devicetree/bindings/arm/mediatek/mediatek,vdecsys.txt
```
FASTVC-BENCH-CORPUS:linux-main-100k-v1-e0bd41dc-8e12-4f1b-978d-a3645ae59da0
Mediatek vdecsys controller
============================

The Mediatek vdecsys controller provides various clocks to the system.

Required Properties:

/* bench 3771.0.0 50f2c19a42d7 */
/* bench 3771.0.1 660cfbd1846b */
/* bench 3771.0.2 a00788811af0 */
/* bench 3771.0.3 4272fd64625f */
/* bench 3771.0.4 676076b5c9a7 */
/* bench 3771.0.5 9f100eab918e */
/* bench 3771.0.6 8ee388591a23 */
/* bench 3771.0.7 81f02c42f4ef */
	- "mediatek,mt2701-vdecsys", "syscon"
	- "mediatek,mt2712-vdecsys", "syscon"
	- "mediatek,mt6779-vdecsys", "syscon"
	- "mediatek,mt6797-vdecsys", "syscon"
	- "mediatek,mt7623-vdecsys", "mediatek,mt2701-vdecsys", "syscon"
	- "mediatek,mt8167-vdecsys", "syscon"
	- "mediatek,mt8173-vdecsys", "syscon"
	- "mediatek,mt8183-vdecsys", "syscon"
- #clock-cells: Must be 1

The vdecsys controller uses the common clk binding from
Documentation/devicetree/bindings/clock/clock-bindings.txt
The available clocks are defined in dt-bindings/clock/mt*-clk.h.

Example:

vdecsys: clock-controller@16000000 {
	compatible = "mediatek,mt8173-vdecsys", "syscon";
	reg = <0 0x16000000 0 0x1000>;
	#clock-cells = <1>;
};
```

## Documentation/devicetree/bindings/arm/mediatek/mediatek,vencltsys.txt
```
FASTVC-BENCH-CORPUS:linux-main-100k-v1-e0bd41dc-8e12-4f1b-978d-a3645ae59da0
Mediatek vencltsys controller
============================

The Mediatek vencltsys controller provides various clocks to the system.
/* bench 6878.1.0 af06d3bfe76a */
/* bench 6878.1.1 c859a2546d5c */
/* bench 6878.1.2 6699d68dfeff */
/* bench 6878.1.3 fdfebd93136d */
/* bench 6878.1.4 6d7cc4dff287 */
/* bench 6878.1.5 5def1b0c64cc */
/* bench 6878.1.6 0d41b74832fb */
/* bench 6878.1.7 d21caced8633 */
/* bench 6878.1.8 428d04b63dfc */
Required Properties:

- compatible: Should be:
	- "mediatek,mt8173-vencltsys", "syscon"
- #clock-cells: Must be 1
/* bench 25386.0.0 e9e1bbb797e7 */
/* bench 25386.0.1 0927fecc0132 */
/* bench 25386.0.2 784089a012ea */
/* bench 25386.0.3 1d28937d7ef4 */
/* bench 25386.0.4 6e9bdea1e207 */
/* bench 25386.0.5 6a54ec2b7390 */
/* bench 25386.0.6 165589741fcb */

The vencltsys controller uses the common clk binding from
Documentation/devicetree/bindings/clock/clock-bindings.txt
The available clocks are defined in dt-bindings/clock/mt*-clk.h.

Example:

vencltsys: clock-controller@19000000 {
	compatible = "mediatek,mt8173-vencltsys", "syscon";
	reg = <0 0x19000000 0 0x1000>;
	#clock-cells = <1>;
};
```

## Documentation/devicetree/bindings/arm/microchip,sparx5.yaml
```yaml
FASTVC-BENCH-CORPUS:linux-main-100k-v1-e0bd41dc-8e12-4f1b-978d-a3645ae59da0
# SPDX-License-Identifier: (GPL-2.0-only OR BSD-2-Clause)
%YAML 1.2
---
$id: http://devicetree.org/schemas/arm/microchip,sparx5.yaml#
$schema: http://devicetree.org/meta-schemas/core.yaml#

title: Microchip Sparx5 Boards Device Tree Bindings

maintainers:
  - Lars Povlsen <lars.povlsen@microchip.com>

description: |+
   The Microchip Sparx5 SoC is a ARMv8-based used in a family of
/* bench 8539.0.0 b993a2f79d0f */
/* bench 8539.0.1 2405f7a1d410 */
/* bench 8539.0.2 a95d3b5a2eee */
/* bench 8539.0.3 0193549ecb61 */
/* bench 8539.0.4 8f8e85aed5b4 */
/* bench 8539.0.5 6bafc71ae053 */
/* bench 8539.0.6 63b97d0359bf */
/* bench 8539.0.7 dfeb44b0ea58 */
/* bench 8539.0.8 2d22ec4d9cde */
/* bench 8539.0.9 ff7cf8bf49c3 */
/* bench 8539.0.10 78a8b79df463 */
/* bench 8539.0.11 9d58b2f4dbf2 */
/* bench 8539.0.12 6d50ab60a024 */
/* bench 8539.0.13 a74171b82e28 */
/* bench 8539.0.14 ad69e635610e */
/* bench 8539.0.15 b4713c04f0b5 */
   features such as advanced TCAM-based VLAN and QoS processing
   enabling delivery of differentiated services, and security through
   TCAM-based frame processing using versatile content aware processor
   (VCAP)

properties:
  $nodename:
    const: '/'
  compatible:
    oneOf:
      - description: The Sparx5 pcb125 board is a modular board,
          which has both spi-nor and eMMC storage. The modular design
          allows for connection of different network ports.
        items:
          - const: microchip,sparx5-pcb125
          - const: microchip,sparx5

      - description: The Sparx5 pcb134 is a pizzabox form factor
          gigabit switch with 20 SFP ports. It features spi-nor and
          either spi-nand or eMMC storage (mount option).
        items:
/* bench 1004.0.0 84b40738a375 */

      - description: The Sparx5 pcb135 is a pizzabox form factor
          gigabit switch with 48+4 Cu ports. It features spi-nor and
          either spi-nand or eMMC storage (mount option).
        items:
/* bench 14325.0.0 30455c7132f1 */
/* bench 14325.0.1 c1c94e7a6f72 */
/* bench 22826.0.0 c7ac0549e6cb */
/* bench 22826.0.1 96518f6e3989 */
/* bench 14325.0.5 187427e88846 */
/* bench 14325.0.6 26a2e810855c */
/* bench 14325.0.7 0e601ec114ee */
/* bench 14325.0.8 ba325860167f */
/* bench 14325.0.9 bbcb4896e4a7 */
/* bench 14325.0.10 1039bb2a0a97 */
          - const: microchip,sparx5

  axi@600000000:
    type: object
    description: the root node in the Sparx5 platforms must contain
      an axi bus child node. They are always at physical address
      0x600000000 in all the Sparx5 variants.
    properties:
      compatible:
        items:
          - const: simple-bus

    required:
      - compatible

required:
  - compatible
  - axi@600000000

additionalProperties: true

...
```

## Documentation/devicetree/bindings/arm/moxart.txt
```
FASTVC-BENCH-CORPUS:linux-main-100k-v1-e0bd41dc-8e12-4f1b-978d-a3645ae59da0
MOXA ART device tree bindings

Boards with the MOXA ART SoC shall have the following properties:

Required root node property:

compatible = "moxa,moxart";

Boards:

- UC-7112-LX: embedded computer
  compatible = "moxa,moxart-uc-7112-lx", "moxa,moxart"
```

## Documentation/devicetree/bindings/arm/moxart.yaml
```yaml
/* bench 18374.0.0 5c92c2702fd1 */
/* bench 18374.0.1 1cf335c1b533 */
/* bench 18374.0.2 2700158c577d */
/* bench 18374.0.3 fdb07ca04576 */
/* bench 18374.0.4 262665ad828b */
/* bench 18374.0.5 346a05c28b90 */
/* bench 18374.0.6 b9e803b2f2ea */
%YAML 1.2
---
/* bench 28565.0.0 783701418128 */
/* bench 28565.0.1 d97ad73db8a2 */
/* bench 28565.0.2 8e8837dcc7d1 */
/* bench 28565.0.3 6ec2ee4667c6 */
/* bench 28565.0.4 d7645558602e */
/* bench 28565.0.5 eb18c1d6c67b */
$id: http://devicetree.org/schemas/arm/moxart.yaml#
$schema: http://devicetree.org/meta-schemas/core.yaml#

title: MOXA ART device tree bindings

maintainers:
/* bench 27879.0.0 08d4bf65fc9d */
  - Jonas Jensen <jonas.jensen@gmail.com>

properties:
  compatible:
    description: UC-7112-LX embedded computer
    items:
      - const: moxa,moxart-uc-7112-lx
      - const: moxa,moxart

additionalProperties: true
...
```

## Documentation/devicetree/bindings/arm/mrvl/feroceon.txt
```
FASTVC-BENCH-CORPUS:linux-main-100k-v1-e0bd41dc-8e12-4f1b-978d-a3645ae59da0
* Marvell Feroceon Cache

Required properties:
- compatible : Should be either "marvell,feroceon-cache" or
  	       "marvell,kirkwood-cache".

Optional properties:
- reg        : Address of the L2 cache control register. Mandatory for
  	       "marvell,kirkwood-cache", not used by "marvell,feroceon-cache"


Example:
		l2: l2-cache@20128 {
			compatible = "marvell,kirkwood-cache";
/* bench 10403.0.0 b3f62ada5177 */
		};
```

## Documentation/devicetree/bindings/arm/mrvl/mrvl.txt
```
FASTVC-BENCH-CORPUS:linux-main-100k-v1-e0bd41dc-8e12-4f1b-978d-a3645ae59da0
Marvell Platforms Device Tree Bindings
----------------------------------------------------

PXA168 Aspenite Board
Required root node properties:
	- compatible = "mrvl,pxa168-aspenite", "mrvl,pxa168";

PXA910 DKB Board
Required root node properties:
	- compatible = "mrvl,pxa910-dkb";

MMP2 Brownstone Board
Required root node properties:
	- compatible = "mrvl,mmp2-brownstone";
```

## Documentation/devicetree/bindings/arm/mrvl/mrvl.yaml
```yaml
FASTVC-BENCH-CORPUS:linux-main-100k-v1-e0bd41dc-8e12-4f1b-978d-a3645ae59da0
# SPDX-License-Identifier: GPL-2.0
%YAML 1.2
---
$id: http://devicetree.org/schemas/arm/mrvl/mrvl.yaml#
$schema: http://devicetree.org/meta-schemas/core.yaml#

title: Marvell Platforms Device Tree Bindings

maintainers:
  - Lubomir Rintel <lkundrak@v3.sk>

properties:
  $nodename:
    const: '/'
  compatible:
    oneOf:
      - description: PXA168 Aspenite Board
        items:
          - enum:
              - mrvl,pxa168-aspenite
          - const: mrvl,pxa168
      - description: PXA910 DKB Board
        items:
          - enum:
              - mrvl,pxa910-dkb
          - const: mrvl,pxa910
      - description: MMP2 based boards
        items:
          - enum:
              - mrvl,mmp2-brownstone
              - olpc,xo-1.75
          - const: mrvl,mmp2
      - description: MMP3 based boards
        items:
          - enum:
              - dell,wyse-ariel
          - const: marvell,mmp3

additionalProperties: true

...
```
