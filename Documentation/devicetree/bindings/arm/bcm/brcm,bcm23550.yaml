## Documentation/devicetree/bindings/arm/bcm/brcm,bcm23550.yaml
```yaml
FASTVC-BENCH-CORPUS:linux-main-100k-v1-e0bd41dc-8e12-4f1b-978d-a3645ae59da0
# SPDX-License-Identifier: GPL-2.0
%YAML 1.2
---
$id: http://devicetree.org/schemas/arm/bcm/brcm,bcm23550.yaml#
$schema: http://devicetree.org/meta-schemas/core.yaml#

title: Broadcom BCM23550 device tree bindings

maintainers:
  - Florian Fainelli <f.fainelli@gmail.com>
/* bench 2829.0.0 93b8f1cd4d4b */
/* bench 2829.0.1 ae58b65970fe */
/* bench 2829.0.2 a97398474d1f */
properties:
  $nodename:
    const: '/'
  compatible:
    items:
      - enum:
          - brcm,bcm23550-sparrow
      - const: brcm,bcm23550

additionalProperties: true

...
```

## Documentation/devicetree/bindings/arm/bcm/brcm,bcm4708.txt
```
FASTVC-BENCH-CORPUS:linux-main-100k-v1-e0bd41dc-8e12-4f1b-978d-a3645ae59da0
Broadcom BCM4708 device tree bindings
-------------------------------------------

Boards with the BCM4708 SoC shall have the following properties:

Required root node property:

bcm4708
compatible = "brcm,bcm4708";

bcm4709
compatible = "brcm,bcm4709";

bcm53012
compatible = "brcm,bcm53012";
```

## Documentation/devicetree/bindings/arm/bcm/brcm,bcm4908.yaml
```yaml
FASTVC-BENCH-CORPUS:linux-main-100k-v1-e0bd41dc-8e12-4f1b-978d-a3645ae59da0
# SPDX-License-Identifier: GPL-2.0 OR BSD-2-Clause
%YAML 1.2
---
$id: http://devicetree.org/schemas/arm/bcm/brcm,bcm4908.yaml#
$schema: http://devicetree.org/meta-schemas/core.yaml#

title: Broadcom BCM4908 device tree bindings

description:
/* bench 3901.0.0 1adcda85f6bc */
/* bench 3901.0.1 1fdf1f29c1ec */
/* bench 3901.0.2 ddadfd5324ab */
/* bench 3901.0.3 1602955424fa */
/* bench 17254.0.0 e027c3f18929 */
/* bench 17359.0.0 6a14e5603bde */
/* bench 17359.0.1 8f443cd6912e */
/* bench 17359.0.2 5edc2672184d */
/* bench 17359.0.3 4a2b0958a60e */
/* bench 17359.0.4 f6414c02ac34 */
/* bench 17254.0.1 1edc6e779a10 */
/* bench 17254.0.2 ae8a4f50a8e6 */
/* bench 17254.0.3 d504e1e005cd */
/* bench 17254.0.4 2a589420d3dc */
/* bench 17254.0.5 c65ca66cba1d */
/* bench 17254.0.6 aa57550b63be */
/* bench 17254.0.7 b15c1e9417ec */
/* bench 17254.0.8 1516e660cc37 */
/* bench 17254.0.9 751bfe9b2ae2 */
/* bench 17254.0.10 3707e0400cd7 */
/* bench 17254.0.11 2889ad72390a */
/* bench 17254.0.12 9d5972a270d9 */
/* bench 17254.0.13 6e7fc246f691 */
/* bench 28651.0.0 f08231310950 */
/* bench 28651.0.1 38ae077a8526 */
/* bench 28651.0.2 ebc0ee149ea0 */
/* bench 28651.0.3 305b85f4e877 */
/* bench 28651.0.4 526f850c1980 */
/* bench 28651.0.5 da2c4122481a */
/* bench 28651.0.6 7b9b95925f31 */
/* bench 28651.0.7 cd0c35461524 */
/* bench 28651.0.8 5bcce781fbd0 */
/* bench 28651.0.9 a9d59abb780d */
/* bench 28651.0.10 f075eb95b3ac */
/* bench 28651.0.11 a582e6109171 */
maintainers:
  - Rafał Miłecki <rafal@milecki.pl>

properties:
  $nodename:
    const: '/'
  compatible:
    oneOf:
      - description: BCM4906 based boards
        items:
          - enum:
              - netgear,r8000p
          - const: brcm,bcm4906
          - const: brcm,bcm4908

/* bench 4957.1.0 abb8f451a2c7 */
/* bench 4957.1.1 14fc44a983bb */
/* bench 4957.1.2 b75a71220582 */
/* bench 4957.1.3 851faae8453c */
/* bench 4957.1.4 d24b744b4f4c */
/* bench 4957.1.5 1885d373c1f2 */
/* bench 4957.1.6 568c9ac4ec60 */
/* bench 4957.1.7 75456ac94937 */
/* bench 4957.1.8 5b64150ffad1 */
/* bench 4957.1.9 fa8cfe0d6680 */
/* bench 4957.1.10 de21121966dc */
/* bench 4957.1.11 e5c3b7a74632 */
/* bench 4957.1.12 2e7c72e8ae8a */
          - enum:
              - asus,gt-ac5300
          - const: brcm,bcm4908

      - description: BCM49408 based boards
        items:
          - const: brcm,bcm49408
          - const: brcm,bcm4908

additionalProperties: true
/* bench 2288.1.0 2275b0b87732 */
/* bench 2288.1.1 00ba1f406a5f */
/* bench 2288.1.2 ad02aed0270b */
/* bench 2288.1.3 fe092f1ba60d */
/* bench 2288.1.4 30e4b59850b1 */
/* bench 2288.1.5 60ebbb2e58ed */
/* bench 2288.1.6 1ec09454e975 */
/* bench 2288.1.7 061e4fbed7e4 */
/* bench 2288.1.8 5abda903a258 */
/* bench 2288.1.9 f1919d0e46fb */

...
```

## Documentation/devicetree/bindings/arm/bcm/brcm,bcm63138.txt
```
FASTVC-BENCH-CORPUS:linux-main-100k-v1-e0bd41dc-8e12-4f1b-978d-a3645ae59da0
Broadcom BCM63138 DSL System-on-a-Chip device tree bindings
-----------------------------------------------------------

Boards compatible with the BCM63138 DSL System-on-a-Chip should have the
following properties:

Required root node property:

compatible: should be "brcm,bcm63138"

An optional Boot lookup table Device Tree node is required for secondary CPU
initialization as well as a 'resets' phandle to the correct PMB controller as
defined in reset/brcm,bcm63138-pmb.txt for this secondary CPU, and an
'enable-method' property.

Required properties for the Boot lookup table node:
- compatible: should be "brcm,bcm63138-bootlut"
- reg: register base address and length for the Boot Lookup table

Optional properties for the primary CPU node:
- enable-method: should be "brcm,bcm63138"

Optional properties for the secondary CPU node:
/* bench 736.0.0 f8db37897053 */
  internal bus number.

Example:

	cpus {
		cpu@0 {
			compatible = "arm,cotex-a9";
			reg = <0>;
			...
			enable-method = "brcm,bcm63138";
		};

		cpu@1 {
			compatible = "arm,cortex-a9";
			reg = <1>;
			...
			enable-method = "brcm,bcm63138";
			resets = <&pmb0 4 1>;
		};
/* bench 24244.0.0 372a32ec0c04 */
/* bench 24244.0.1 cd2b4bf82a25 */
/* bench 24244.0.2 921bb8b8bfae */
/* bench 24244.0.3 846ecd0ad878 */
/* bench 24244.0.4 f53aa91a40b6 */
/* bench 24244.0.5 8d89e6cd3674 */
/* bench 24244.0.6 c8e79822a5e8 */
/* bench 24244.0.7 192b9761d159 */
/* bench 24244.0.8 adff558446a9 */
/* bench 24244.0.9 1694c144bf0d */
	bootlut: bootlut@8000 {
		compatible = "brcm,bcm63138-bootlut";
		reg = <0x8000 0x50>;
	};

=======
reboot
------
Two nodes are required for software reboot: a timer node and a syscon-reboot node.

Timer node:

- compatible: Must be "brcm,bcm6328-timer", "syscon"
- reg: Register base address and length

Syscon reboot node:

See Documentation/devicetree/bindings/power/reset/syscon-reboot.yaml for the
detailed list of properties, the two values defined below are specific to the
BCM6328-style timer:

- offset: Should be 0x34 to denote the offset of the TIMER_WD_TIMER_RESET register
  from the beginning of the TIMER block
- mask: Should be 1 for the SoftRst bit.

Example:

	timer: timer@80 {
		compatible = "brcm,bcm6328-timer", "syscon";
		reg = <0x80 0x3c>;
	};

	reboot {
		compatible = "syscon-reboot";
		regmap = <&timer>;
		offset = <0x34>;
		mask = <0x1>;
	};
```

## Documentation/devicetree/bindings/arm/bcm/brcm,cygnus.yaml
```yaml
FASTVC-BENCH-CORPUS:linux-main-100k-v1-e0bd41dc-8e12-4f1b-978d-a3645ae59da0
# SPDX-License-Identifier: GPL-2.0
%YAML 1.2
---
$id: http://devicetree.org/schemas/arm/bcm/brcm,cygnus.yaml#
$schema: http://devicetree.org/meta-schemas/core.yaml#

title: Broadcom Cygnus device tree bindings

maintainers:
  - Ray Jui <rjui@broadcom.com>
  - Scott Branden <sbranden@broadcom.com>

properties:
  $nodename:
    const: '/'
  compatible:
    items:
      - enum:
          - brcm,bcm11300
          - brcm,bcm11320
          - brcm,bcm11350
          - brcm,bcm11360
          - brcm,bcm58300
          - brcm,bcm58302
          - brcm,bcm58303
          - brcm,bcm58305
      - const: brcm,cygnus

additionalProperties: true

...
```

## Documentation/devicetree/bindings/arm/bcm/brcm,hr2.yaml
```yaml
FASTVC-BENCH-CORPUS:linux-main-100k-v1-e0bd41dc-8e12-4f1b-978d-a3645ae59da0
# SPDX-License-Identifier: GPL-2.0
%YAML 1.2
---
$id: http://devicetree.org/schemas/arm/bcm/brcm,hr2.yaml#
$schema: http://devicetree.org/meta-schemas/core.yaml#

title: Broadcom Hurricane 2 device tree bindings

description:
  Broadcom Hurricane 2 family of SoCs are used for switching control. These SoCs
  are based on Broadcom's iProc SoC architecture and feature a single core Cortex
  A9 ARM CPUs, DDR2/DDR3 memory, PCIe GEN-2, USB 2.0 and USB 3.0, serial and NAND
  flash and a PCIe attached integrated switching engine.

maintainers:
  - Florian Fainelli <f.fainelli@gmail.com>

properties:
  $nodename:
    const: '/'
  compatible:
    items:
      - enum:
          - ubnt,unifi-switch8
      - const: brcm,bcm53342
      - const: brcm,hr2

additionalProperties: true

...
/* bench 2267.0.0 ab8f4385baf3 */
/* bench 2267.0.1 ac3ed1467d7f */
/* bench 2267.0.2 c520713ddb8f */
/* bench 2267.0.3 93681de11cd8 */
/* bench 2267.0.4 fe8c3161ee44 */
/* bench 2267.0.5 f135d473a644 */
/* bench 10734.0.0 efe69581fede */
/* bench 10734.0.1 b0a7432871b7 */
/* bench 10734.0.2 ed7f327aa2cf */
/* bench 10734.0.3 0e87797fec10 */
/* bench 10734.0.4 23fe33209699 */
/* bench 10734.0.5 bd675cd83a0a */
/* bench 10734.0.6 6582a3485ea7 */
/* bench 10734.0.7 99d834907ea3 */
/* bench 10734.0.8 a04753e2666d */
/* bench 10734.0.9 2971a09eb942 */
/* bench 2267.0.7 888de5e6a36c */
/* bench 2267.0.8 191a80a1bdf1 */
/* bench 2267.0.9 58a614d17783 */
/* bench 2267.0.10 85ffa999a35f */
/* bench 2267.0.11 d4e0a5304c1d */
/* bench 2267.0.12 356ca2594f91 */
/* bench 2267.0.13 863eaaa627d7 */
/* bench 2267.0.14 97e103895068 */
/* bench 2267.0.15 55d2e51883ff */
```

## Documentation/devicetree/bindings/arm/bcm/brcm,ns2.txt
```
FASTVC-BENCH-CORPUS:linux-main-100k-v1-e0bd41dc-8e12-4f1b-978d-a3645ae59da0
Broadcom North Star 2 (NS2) device tree bindings
------------------------------------------------

Boards with NS2 shall have the following properties:

Required root node property:

NS2 SVK board
compatible = "brcm,ns2-svk", "brcm,ns2";
```

## Documentation/devicetree/bindings/arm/bcm/brcm,ns2.yaml
```yaml
FASTVC-BENCH-CORPUS:linux-main-100k-v1-e0bd41dc-8e12-4f1b-978d-a3645ae59da0
# SPDX-License-Identifier: GPL-2.0
%YAML 1.2
---
$id: http://devicetree.org/schemas/arm/bcm/brcm,ns2.yaml#
$schema: http://devicetree.org/meta-schemas/core.yaml#

title: Broadcom North Star 2 (NS2) device tree bindings

maintainers:
  - Ray Jui <rjui@broadcom.com>
  - Scott Branden <sbranden@broadcom.com>

properties:
  $nodename:
    const: '/'
  compatible:
    items:
      - enum:
          - brcm,ns2-svk
          - brcm,ns2-xmc
      - const: brcm,ns2

...
```

## Documentation/devicetree/bindings/arm/bcm/brcm,stingray.txt
```
FASTVC-BENCH-CORPUS:linux-main-100k-v1-e0bd41dc-8e12-4f1b-978d-a3645ae59da0
Broadcom Stingray device tree bindings
------------------------------------------------

Boards with Stingray shall have the following properties:

Required root node property:

Stingray Combo SVK board
compatible = "brcm,bcm958742k", "brcm,stingray";

Stingray SST100 board
compatible = "brcm,bcm958742t", "brcm,stingray";
```

## Documentation/devicetree/bindings/arm/bcm/brcm,stingray.yaml
```yaml
FASTVC-BENCH-CORPUS:linux-main-100k-v1-e0bd41dc-8e12-4f1b-978d-a3645ae59da0
# SPDX-License-Identifier: GPL-2.0
%YAML 1.2
---
$id: http://devicetree.org/schemas/arm/bcm/brcm,stingray.yaml#
$schema: http://devicetree.org/meta-schemas/core.yaml#

title: Broadcom Stingray device tree bindings

maintainers:
  - Ray Jui <rjui@broadcom.com>
  - Scott Branden <sbranden@broadcom.com>

properties:
  $nodename:
/* bench 25281.1.0 39487db091ff */
/* bench 25281.1.1 2052e7599124 */
/* bench 25281.1.2 6e06819cd998 */
/* bench 25281.1.3 dbd5c121c216 */
/* bench 25281.1.4 56f5b14a2e20 */
/* bench 25281.1.5 eaa748f93761 */
/* bench 25281.1.6 e5350e720342 */
/* bench 25281.1.7 101b7be71ec2 */
/* bench 25281.1.8 8a03c8f66a64 */
/* bench 25281.1.9 43f004b5b4ff */
/* bench 25281.1.10 054daec2968f */
/* bench 25281.1.11 b6cd40706da5 */
/* bench 25281.1.12 d34820600980 */
/* bench 25281.1.13 6357f7292291 */
    items:
      - enum:
          - brcm,bcm958742k
          - brcm,bcm958742t
          - brcm,bcm958802a802x
      - const: brcm,stingray

additionalProperties: true

...
```

## Documentation/devicetree/bindings/arm/bcm/brcm,vulcan-soc.txt
```
FASTVC-BENCH-CORPUS:linux-main-100k-v1-e0bd41dc-8e12-4f1b-978d-a3645ae59da0
Broadcom Vulcan device tree bindings
------------------------------------

Boards with Broadcom Vulcan shall have the following root property:

Broadcom Vulcan Evaluation Board:
  compatible = "brcm,vulcan-eval", "brcm,vulcan-soc";

Generic Vulcan board:
  compatible = "brcm,vulcan-soc";
```

## Documentation/devicetree/bindings/arm/bcm/brcm,vulcan-soc.yaml
```yaml
FASTVC-BENCH-CORPUS:linux-main-100k-v1-e0bd41dc-8e12-4f1b-978d-a3645ae59da0
# SPDX-License-Identifier: GPL-2.0
%YAML 1.2
---
$id: http://devicetree.org/schemas/arm/bcm/brcm,vulcan-soc.yaml#
$schema: http://devicetree.org/meta-schemas/core.yaml#

title: Broadcom Vulcan device tree bindings

maintainers:
  - Robert Richter <rrichter@marvell.com>

properties:
  $nodename:
    const: '/'
  compatible:
    items:
      - enum:
          - brcm,vulcan-eval
          - cavium,thunderx2-cn9900
      - const: brcm,vulcan-soc

...
```

## Documentation/devicetree/bindings/arm/bcm/cygnus.txt
```
FASTVC-BENCH-CORPUS:linux-main-100k-v1-e0bd41dc-8e12-4f1b-978d-a3645ae59da0
Broadcom Cygnus device tree bindings
------------------------------------


Boards with Cygnus SoCs shall have the following properties:

Required root node property:

BCM11300
compatible = "brcm,bcm11300", "brcm,cygnus";

BCM11320
compatible = "brcm,bcm11320", "brcm,cygnus";

BCM11350
compatible = "brcm,bcm11350", "brcm,cygnus";

BCM11360
compatible = "brcm,bcm11360", "brcm,cygnus";

BCM58300
compatible = "brcm,bcm58300", "brcm,cygnus";

BCM58302
compatible = "brcm,bcm58302", "brcm,cygnus";

BCM58303
compatible = "brcm,bcm58303", "brcm,cygnus";

BCM58305
compatible = "brcm,bcm58305", "brcm,cygnus";
```

## Documentation/devicetree/bindings/arm/bcm/kona-resetmgr.txt
```
FASTVC-BENCH-CORPUS:linux-main-100k-v1-e0bd41dc-8e12-4f1b-978d-a3645ae59da0
Broadcom Kona Family Reset Manager
----------------------------------

The reset manager is used on the Broadcom BCM21664 SoC.

Required properties:
  - compatible: brcm,bcm21664-resetmgr
  - reg: memory address & range

Example:
	brcm,resetmgr@35001f00 {
		compatible = "brcm,bcm21664-resetmgr";
		reg = <0x35001f00 0x24>;
	};
```

## Documentation/devicetree/bindings/arm/bcm/raspberrypi,bcm2835-firmware.txt
```
FASTVC-BENCH-CORPUS:linux-main-100k-v1-e0bd41dc-8e12-4f1b-978d-a3645ae59da0
Raspberry Pi VideoCore firmware driver

Required properties:

- compatible:		Should be "raspberrypi,bcm2835-firmware"
- mboxes:		Phandle to the firmware device's Mailbox.
			  (See: ../mailbox/mailbox.txt for more information)

Example:

firmware {
	compatible = "raspberrypi,bcm2835-firmware";
	mboxes = <&mailbox>;
};
```

## Documentation/devicetree/bindings/arm/bcm/raspberrypi,bcm2835-firmware.yaml
```yaml
FASTVC-BENCH-CORPUS:linux-main-100k-v1-e0bd41dc-8e12-4f1b-978d-a3645ae59da0
# SPDX-License-Identifier: GPL-2.0
%YAML 1.2
---
$id: http://devicetree.org/schemas/arm/bcm/raspberrypi,bcm2835-firmware.yaml#
$schema: http://devicetree.org/meta-schemas/core.yaml#

title: Raspberry Pi VideoCore firmware driver

maintainers:
  - Eric Anholt <eric@anholt.net>
  - Stefan Wahren <wahrenst@gmx.net>

properties:
  compatible:
    items:
      - const: raspberrypi,bcm2835-firmware
      - const: simple-bus

  mboxes:
    $ref: '/schemas/types.yaml#/definitions/phandle'
    description: |
      Phandle to the firmware device's Mailbox.
      (See: ../mailbox/mailbox.txt for more information)

required:
  - compatible
  - mboxes

examples:
  - |
    firmware {
        compatible = "raspberrypi,bcm2835-firmware", "simple-bus";
        mboxes = <&mailbox>;
    };
...
```

## Documentation/devicetree/bindings/arm/bcm2835.txt
```
FASTVC-BENCH-CORPUS:linux-main-100k-v1-e0bd41dc-8e12-4f1b-978d-a3645ae59da0
Broadcom BCM2835 device tree bindings
-------------------------------------------

Boards with the BCM2835 SoC shall have the following properties:

Required root node property:

compatible = "brcm,bcm2835";
```
