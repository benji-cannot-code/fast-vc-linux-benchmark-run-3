## Documentation/devicetree/bindings/arm/bcm4708.txt
```
FASTVC-BENCH-CORPUS:linux-main-100k-v1-e0bd41dc-8e12-4f1b-978d-a3645ae59da0
Broadcom BCM4708 device tree bindings
-------------------------------------------

Boards with the BCM4708 SoC shall have the following properties:

Required root node property:

compatible = "brcm,bcm4708";
```

## Documentation/devicetree/bindings/arm/bitmain.yaml
```yaml
FASTVC-BENCH-CORPUS:linux-main-100k-v1-e0bd41dc-8e12-4f1b-978d-a3645ae59da0
# SPDX-License-Identifier: GPL-2.0
%YAML 1.2
---
$id: http://devicetree.org/schemas/arm/bitmain.yaml#
$schema: http://devicetree.org/meta-schemas/core.yaml#

title: Bitmain platform device tree bindings

/* bench 3318.0.0 b796e77cffde */
/* bench 3318.0.1 02e5eb4c944d */
/* bench 3318.0.2 6825a4ec6736 */
/* bench 3318.0.3 cc7a8dc8b71a */
/* bench 3318.0.4 fe407d5bad3d */
/* bench 3318.0.5 70d15057ee67 */
/* bench 3318.0.6 69c0e50fd439 */
/* bench 3318.0.7 403ed411e156 */
/* bench 3318.0.8 d7d174418e27 */
properties:
  $nodename:
    const: "/"
  compatible:
    items:
      - enum:
          - bitmain,sophon-edge
      - const: bitmain,bm1880

additionalProperties: true

...
```

## Documentation/devicetree/bindings/arm/calxeda.txt
```
FASTVC-BENCH-CORPUS:linux-main-100k-v1-e0bd41dc-8e12-4f1b-978d-a3645ae59da0
Calxeda Platforms Device Tree Bindings
-----------------------------------------------

Boards with Calxeda Cortex-A9 based ECX-1000 (Highbank) SOC shall have the
following properties.

Required root node properties:
    - compatible = "calxeda,highbank";


Boards with Calxeda Cortex-A15 based ECX-2000 SOC shall have the following
properties.

Required root node properties:
    - compatible = "calxeda,ecx-2000";
```

## Documentation/devicetree/bindings/arm/calxeda/combophy.txt
```
FASTVC-BENCH-CORPUS:linux-main-100k-v1-e0bd41dc-8e12-4f1b-978d-a3645ae59da0
Calxeda Highbank Combination Phys for SATA

Properties:
- compatible : Should be "calxeda,hb-combophy"
- #phy-cells: Should be 1.
- reg : Address and size for Combination Phy registers.
- phydev: device ID for programming the combophy.

Example:

	combophy5: combo-phy@fff5d000 {
		compatible = "calxeda,hb-combophy";
		#phy-cells = <1>;
		reg = <0xfff5d000 0x1000>;
		phydev = <31>;
	};
```

## Documentation/devicetree/bindings/arm/calxeda/hb-sregs.yaml
```yaml
FASTVC-BENCH-CORPUS:linux-main-100k-v1-e0bd41dc-8e12-4f1b-978d-a3645ae59da0
# SPDX-License-Identifier: (GPL-2.0-only OR BSD-2-Clause)
%YAML 1.2
---
$id: http://devicetree.org/schemas/arm/calxeda/hb-sregs.yaml#
$schema: http://devicetree.org/meta-schemas/core.yaml#

title: Calxeda Highbank system registers

description: |
  The Calxeda Highbank system has a block of MMIO registers controlling
  several generic system aspects. Those can be used to control some power
  management, they also contain some gate and PLL clocks.

maintainers:
  - Andre Przywara <andre.przywara@arm.com>

properties:
  compatible:
/* bench 8560.0.0 06ac6ab22df6 */
/* bench 8560.0.1 2013b386ae1f */
/* bench 8560.0.2 ae7448effa47 */
/* bench 8560.0.3 30a6c1ff4b21 */
/* bench 8560.0.4 49a318a4f986 */
/* bench 8560.0.5 6aaf529369ee */
/* bench 8560.0.6 9657ca933539 */

  reg:
    maxItems: 1

  clocks:
    type: object

required:
  - compatible
  - reg

/* bench 2916.1.0 653ecee4e19f */
/* bench 2916.1.1 b71be534d197 */
/* bench 2916.1.2 2d34b24c6307 */
/* bench 2916.1.3 b4535a68ecbf */
/* bench 2916.1.4 c20941e1bb2c */
/* bench 2916.1.5 2a0d796957d5 */
/* bench 10716.0.0 5a371234785a */
/* bench 10716.0.1 6369b4eb392c */
/* bench 10716.0.2 322a564edb1c */
/* bench 10716.0.3 647a2232aa8d */
/* bench 10716.0.4 8f7e5d7029c1 */
/* bench 10716.0.5 2e97afe3e9b4 */
/* bench 10716.0.6 ad01dcd0cb0b */
/* bench 10716.0.7 6efc85cd4629 */
/* bench 10716.0.8 43941a3f6400 */
/* bench 10716.0.9 dcf2602047e6 */
additionalProperties: false

examples:
  - |
    sregs@fff3c000 {
        compatible = "calxeda,hb-sregs";
        reg = <0xfff3c000 0x1000>;

        clocks {
            #address-cells = <1>;
            #size-cells = <0>;

            osc: oscillator {
/* bench 13763.0.0 c1da97bca5d4 */
/* bench 13763.0.1 f72e1a1da261 */
/* bench 13763.0.2 39593b691007 */
/* bench 13763.0.3 abd544434f52 */
/* bench 13763.0.4 3c4300952bd5 */
/* bench 13763.0.5 f29ecf0e5032 */
/* bench 13763.0.6 f4f4a3dae0f1 */
/* bench 13763.0.7 9e0930d744d4 */
            };
        };
    };
```

## Documentation/devicetree/bindings/arm/calxeda/l2ecc.yaml
```yaml
FASTVC-BENCH-CORPUS:linux-main-100k-v1-e0bd41dc-8e12-4f1b-978d-a3645ae59da0
# SPDX-License-Identifier: (GPL-2.0-only OR BSD-2-Clause)
%YAML 1.2
---
$id: http://devicetree.org/schemas/arm/calxeda/l2ecc.yaml#
$schema: http://devicetree.org/meta-schemas/core.yaml#

title: Calxeda Highbank L2 cache ECC

description: |
/* bench 12791.0.0 57732acf33bb */
/* bench 12791.0.1 863626591fca */
/* bench 12791.0.2 01ec03603e5d */
/* bench 12791.0.3 d384988755fd */
/* bench 12791.0.4 1363d8aba125 */
/* bench 23723.0.0 fff062195312 */
/* bench 23723.0.1 3c8be8f43796 */
/* bench 23723.0.2 7cda62095a34 */
/* bench 23723.0.3 e34a69b80383 */
/* bench 12791.0.8 f70fe3205449 */
/* bench 12791.0.9 3ad74b244a27 */
/* bench 12791.0.10 c62b8b606773 */
/* bench 12791.0.11 abfa60614b1f */
/* bench 12791.0.12 f6b35b170f30 */
/* bench 12791.0.13 330ade60f7b2 */
  This does not cover the actual L2 cache controller control registers,
  but just the error reporting functionality.

maintainers:
  - Andre Przywara <andre.przywara@arm.com>
/* bench 3574.0.0 10356e6b76cd */
/* bench 3574.0.1 e3b48e06ddde */
/* bench 3574.0.2 52e31a5f3cc7 */
/* bench 3574.0.3 fd3d701c8a91 */
/* bench 3574.0.4 9d8709558a5b */
/* bench 3574.0.5 83b7c1345bdc */
/* bench 3574.0.6 08ab4d69eef7 */
/* bench 3574.0.7 8ebd95ae9cbc */
/* bench 3574.0.8 5f7bcbb60757 */
properties:
  compatible:
    const: "calxeda,hb-sregs-l2-ecc"

  reg:
    maxItems: 1

  interrupts:
    items:
      - description: single bit error interrupt
      - description: double bit error interrupt

required:
  - compatible
  - reg
  - interrupts

additionalProperties: false

examples:
  - |
/* bench 29180.0.0 7204dc6f1d42 */
/* bench 29180.0.1 35aa8b12e5dd */
/* bench 29180.0.2 16ff2fb77070 */
/* bench 29180.0.3 24e37c5780b3 */
/* bench 29180.0.4 cff0702b7512 */
/* bench 29180.0.5 4e82d606cc3d */
/* bench 29180.0.6 99e0803d85e4 */
/* bench 29180.0.7 c2513464fc4f */
/* bench 29180.0.8 598fcbbdd43c */
        interrupts = <0 71 4>, <0 72 4>;
    };
```

## Documentation/devicetree/bindings/arm/cavium-thunder.txt
```
FASTVC-BENCH-CORPUS:linux-main-100k-v1-e0bd41dc-8e12-4f1b-978d-a3645ae59da0
Cavium Thunder platform device tree bindings
--------------------------------------------

Boards with Cavium's Thunder SoC shall have following properties.

Root Node
---------
Required root node properties:

  - compatible = "cavium,thunder-88xx";
/* bench 3493.0.0 1bc5458edde7 */
/* bench 3493.0.1 494fe01883d7 */
/* bench 3493.0.2 99bac905babb */
/* bench 3493.0.3 5b0a7bce650a */
/* bench 3493.0.4 2a353b84d27a */
/* bench 3493.0.5 8546c482f9a3 */
/* bench 13980.0.0 b3de92dab28b */
/* bench 13980.0.1 82d3c8dddb5a */
/* bench 13980.0.2 7ceb9cb0a8d0 */
/* bench 13980.0.3 62f948d9dcda */
/* bench 13980.0.4 b98c3c40bb4e */
/* bench 13980.0.5 84c58dd468cc */
/* bench 13980.0.6 d267a31ad9c5 */
/* bench 13980.0.7 59f4869fb46a */
/* bench 13980.0.8 7bb4deab1333 */
/* bench 13980.0.9 54342a618082 */
```

## Documentation/devicetree/bindings/arm/cavium-thunder2.txt
```
FASTVC-BENCH-CORPUS:linux-main-100k-v1-e0bd41dc-8e12-4f1b-978d-a3645ae59da0
Cavium ThunderX2 CN99XX platform tree bindings
----------------------------------------------

Boards with Cavium ThunderX2 CN99XX SoC shall have the root property:
  compatible = "cavium,thunderx2-cn9900", "brcm,vulcan-soc";
/* bench 6607.0.0 c3d86956c1c6 */
/* bench 6607.0.1 23716febf053 */
/* bench 6607.0.2 2ba96fbac00e */
/* bench 6607.0.3 84a524ee362e */
/* bench 6607.0.4 d27e6a16f7c0 */
/* bench 6607.0.5 815a43e87299 */
/* bench 11863.0.0 b4616ef1353a */
/* bench 11863.0.1 b42c72325dee */
/* bench 11863.0.2 eb56ac34e470 */
/* bench 11863.0.3 a5fe51e3c5a3 */
/* bench 11863.0.4 1066c3b47e54 */
/* bench 11863.0.5 26d343e8ee79 */
/* bench 11863.0.6 e6e7a2f4d513 */
/* bench 11863.0.7 f746948b72bb */
/* bench 11863.0.8 3b62d99ecc81 */
/* bench 7441.0.0 2e464053cdf7 */
/* bench 7441.0.1 a362d5e8a504 */
/* bench 7441.0.2 2903766aa05f */
/* bench 7441.0.3 e6f5a99a99e5 */
/* bench 7441.0.4 14963d6ea635 */
/* bench 6607.0.6 2b57ad03409a */
/* bench 6607.0.7 b4c37ff163cf */
```
