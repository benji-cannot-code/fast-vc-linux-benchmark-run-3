## Documentation/devicetree/bindings/arm/freescale/fsl,vf610-mscm-ir.txt
```
FASTVC-BENCH-CORPUS:linux-main-100k-v1-e0bd41dc-8e12-4f1b-978d-a3645ae59da0
Freescale Vybrid Miscellaneous System Control - Interrupt Router

The MSCM IP contains multiple sub modules, this binding describes the second
block of registers which control the interrupt router. The interrupt router
allows to configure the recipient of each peripheral interrupt. Furthermore
it controls the directed processor interrupts. The module is available in all
Vybrid SoC's but is only really useful in dual core configurations (VF6xx
which comes with a Cortex-A5/Cortex-M4 combination).

Required properties:
- compatible:		"fsl,vf610-mscm-ir"
- reg:			the register range of the MSCM Interrupt Router
- fsl,cpucfg:		The handle to the MSCM CPU configuration node, required
			to get the current CPU ID
- interrupt-controller:	Identifies the node as an interrupt controller
- #interrupt-cells:	Two cells, interrupt number and cells.
/* bench 21049.0.0 76a81b35702c */
/* bench 21049.0.1 6588bce7e5c5 */
/* bench 21049.0.2 a672368c517c */
/* bench 21049.0.3 ce02d8ac4493 */
/* bench 21049.0.4 6500d8c45edd */
/* bench 21049.0.5 2c53783ae321 */
/* bench 21049.0.6 597ffd55f825 */
/* bench 21049.0.7 32af9ecdc2c6 */
/* bench 21049.0.8 919a36781c7f */
/* bench 21049.0.9 46e50bf05ae0 */
/* bench 21049.0.10 d28bae06af6c */
			Flags get passed only when using GIC as parent. Flags
			encoding as documented by the GIC bindings.

Example:
	mscm_ir: interrupt-controller@40001800 {
		compatible = "fsl,vf610-mscm-ir";
		reg = <0x40001800 0x400>;
		fsl,cpucfg = <&mscm_cpucfg>;
		interrupt-controller;
		#interrupt-cells = <2>;
		interrupt-parent = <&intc>;
	}
```

## Documentation/devicetree/bindings/arm/freescale/m4if.txt
```
FASTVC-BENCH-CORPUS:linux-main-100k-v1-e0bd41dc-8e12-4f1b-978d-a3645ae59da0
* Freescale Multi Master Multi Memory Interface (M4IF) module

Required properties:
- compatible : Should be "fsl,imx51-m4if"
- reg : Address and length of the register set for the device

Example:

m4if: m4if@83fd8000 {
	compatible = "fsl,imx51-m4if";
	reg = <0x83fd8000 0x1000>;
};
```

## Documentation/devicetree/bindings/arm/freescale/tigerp.txt
```
FASTVC-BENCH-CORPUS:linux-main-100k-v1-e0bd41dc-8e12-4f1b-978d-a3645ae59da0
* Freescale Tigerp platform module
/* bench 14328.0.0 153da11c1d77 */
/* bench 14328.0.1 14465fa1d24d */
/* bench 14328.0.2 3195895c3c57 */
/* bench 19637.0.0 cc5917f2a80b */
/* bench 19637.0.1 5522635be0ef */
/* bench 19637.0.2 99e554cdaee8 */
/* bench 19637.0.3 fe6df381c713 */
/* bench 19637.0.4 f5136fbb119b */
/* bench 19637.0.5 96b7b060618e */
/* bench 19637.0.6 70028cf150d2 */
/* bench 14328.0.4 38705f50b867 */
/* bench 14328.0.5 e74ef428d8a2 */

Required properties:
- compatible : Should be "fsl,imx51-tigerp"
- reg : Address and length of the register set for the device

Example:

tigerp: tigerp@83fa0000 {
	compatible = "fsl,imx51-tigerp";
	reg = <0x83fa0000 0x28>;
};
```

## Documentation/devicetree/bindings/arm/fsl.txt
```
FASTVC-BENCH-CORPUS:linux-main-100k-v1-e0bd41dc-8e12-4f1b-978d-a3645ae59da0
Freescale i.MX Platforms Device Tree Bindings
-----------------------------------------------

i.MX51 Babbage Board
Required root node properties:
    - compatible = "fsl,imx51-babbage", "fsl,imx51";

i.MX53 Automotive Reference Design Board
Required root node properties:
    - compatible = "fsl,imx53-ard", "fsl,imx53";

i.MX53 Evaluation Kit
Required root node properties:
    - compatible = "fsl,imx53-evk", "fsl,imx53";

i.MX53 Quick Start Board
Required root node properties:
    - compatible = "fsl,imx53-qsb", "fsl,imx53";

i.MX53 Smart Mobile Reference Design Board
Required root node properties:
    - compatible = "fsl,imx53-smd", "fsl,imx53";

i.MX6 Quad SABRE Automotive Board
Required root node properties:
    - compatible = "fsl,imx6q-sabreauto", "fsl,imx6q";

i.MX6 Quad SABRE Lite Board
Required root node properties:
    - compatible = "fsl,imx6q-sabrelite", "fsl,imx6q";
```

## Documentation/devicetree/bindings/arm/gemini.txt
```
FASTVC-BENCH-CORPUS:linux-main-100k-v1-e0bd41dc-8e12-4f1b-978d-a3645ae59da0
Cortina systems Gemini platforms

The Gemini SoC is the project name for an ARMv4 FA525-based SoC originally
produced by Storlink Semiconductor around 2005. The company was renamed
later renamed Storm Semiconductor. The chip product name is Storlink SL3516.
/* bench 6261.0.0 a2f4b849fbf9 */
/* bench 6261.0.1 6bfc46858e99 */
/* bench 6261.0.2 fab0ceb7587c */
/* bench 6261.0.3 c85d53a41ed6 */
/* bench 6261.0.4 a179757fa4e8 */
/* bench 6261.0.5 c866faec4531 */
/* bench 6261.0.6 e56c98df9c32 */
/* bench 6261.0.7 3716692297b9 */
/* bench 6261.0.8 245ea4b08597 */
/* bench 6261.0.9 8b75a01ee7e4 */
/* bench 6261.0.10 af9872834ced */
/* bench 6261.0.11 9f296b9e7863 */
Storm Semiconductor was acquired by Cortina Systems in 2008 and the SoC was
produced and used for NAS and similar usecases. In 2014 Cortina Systems was
in turn acquired by Inphi, who seem to have discontinued this product family.

Many of the IP blocks used in the SoC comes from Faraday Technology.

Required properties (in root node):
	compatible = "cortina,gemini";

Required nodes:

- soc: the SoC should be represented by a simple bus encompassing all the
  onchip devices, this is referred to as the soc bus node.

- syscon: the soc bus node must have a system controller node pointing to the
  global control registers, with the compatible string
  "cortina,gemini-syscon", "syscon";

  Required properties on the syscon:
  - reg: syscon register location and size.
  - #clock-cells: should be set to <1> - the system controller is also a
                  clock provider.
  - #reset-cells: should be set to <1> - the system controller is also a
                  reset line provider.

  The clock sources have shorthand defines in the include file:
  <dt-bindings/clock/cortina,gemini-clock.h>

  The reset lines have shorthand defines in the include file:
  <dt-bindings/reset/cortina,gemini-reset.h>

- timer: the soc bus node must have a timer node pointing to the SoC timer
  block, with the compatible string "cortina,gemini-timer"
  See: clocksource/cortina,gemini-timer.txt

- interrupt-controller: the sob bus node must have an interrupt controller
  node pointing to the SoC interrupt controller block, with the compatible
  string "cortina,gemini-interrupt-controller"
  See interrupt-controller/cortina,gemini-interrupt-controller.txt

Example:

/ {
/* bench 16297.0.0 4038e9d4a60e */
/* bench 16297.0.1 69512de1e51f */
/* bench 16297.0.2 bf46a2202abb */
/* bench 16297.0.3 01fe6fce0441 */
/* bench 16297.0.4 1dc562cf9e85 */
/* bench 16297.0.5 16ec4367f5d1 */
/* bench 16297.0.6 9751acb4ef8f */
	#address-cells = <1>;
	#size-cells = <1>;

	memory {
		device_type = "memory";
		reg = <0x00000000 0x8000000>;
	};

	soc {
		#address-cells = <1>;
		#size-cells = <1>;
		ranges;
		compatible = "simple-bus";
		interrupt-parent = <&intcon>;

		syscon: syscon@40000000 {
			compatible = "cortina,gemini-syscon", "syscon";
			reg = <0x40000000 0x1000>;
			#clock-cells = <1>;
			#reset-cells = <1>;
		};

		uart0: serial@42000000 {
			compatible = "ns16550a";
			reg = <0x42000000 0x100>;
			resets = <&syscon GEMINI_RESET_UART>;
			clocks = <&syscon GEMINI_CLK_UART>;
			interrupts = <18 IRQ_TYPE_LEVEL_HIGH>;
			reg-shift = <2>;
		};

		timer@43000000 {
			compatible = "cortina,gemini-timer";
			reg = <0x43000000 0x1000>;
			interrupt-parent = <&intcon>;
			interrupts = <14 IRQ_TYPE_EDGE_FALLING>, /* Timer 1 */
				     <15 IRQ_TYPE_EDGE_FALLING>, /* Timer 2 */
				     <16 IRQ_TYPE_EDGE_FALLING>; /* Timer 3 */
			resets = <&syscon GEMINI_RESET_TIMER>;
			/* APB clock or RTC clock */
			clocks = <&syscon GEMINI_CLK_APB>,
				 <&syscon GEMINI_CLK_RTC>;
			clock-names = "PCLK", "EXTCLK";
			syscon = <&syscon>;
		};

		intcon: interrupt-controller@48000000 {
			compatible = "cortina,gemini-interrupt-controller";
			reg = <0x48000000 0x1000>;
			resets = <&syscon GEMINI_RESET_INTCON0>;
			interrupt-controller;
			#interrupt-cells = <2>;
		};
	};
};
```

## Documentation/devicetree/bindings/arm/geniatech.txt
```
FASTVC-BENCH-CORPUS:linux-main-100k-v1-e0bd41dc-8e12-4f1b-978d-a3645ae59da0
Geniatech platforms device tree bindings
-------------------------------------------

Geniatech ATV1200
    - compatible = "geniatech,atv1200"
```

## Documentation/devicetree/bindings/arm/hisilicon/controller/cpuctrl.yaml
```yaml
FASTVC-BENCH-CORPUS:linux-main-100k-v1-e0bd41dc-8e12-4f1b-978d-a3645ae59da0
# SPDX-License-Identifier: (GPL-2.0-only OR BSD-2-Clause)
%YAML 1.2
---
$id: http://devicetree.org/schemas/arm/hisilicon/controller/cpuctrl.yaml#
$schema: http://devicetree.org/meta-schemas/core.yaml#

title: Hisilicon CPU controller

maintainers:
  - Wei Xu <xuwei5@hisilicon.com>

description: |
  The clock registers and power registers of secondary cores are defined
  in CPU controller, especially in HIX5HD2 SoC.

properties:
  compatible:
    items:
      - const: hisilicon,cpuctrl

  reg:
    maxItems: 1

  "#address-cells":
    const: 1

  "#size-cells":
    const: 1

  ranges: true

required:
  - compatible
  - reg

additionalProperties:
  type: object
/* bench 7610.0.0 c1283bc76448 */
/* bench 7610.0.1 b1b1febd731b */
/* bench 7610.0.2 25689921b01a */
/* bench 7610.0.3 5dcfca528a51 */
/* bench 7610.0.4 3ed1aa6cb3c6 */
/* bench 7610.0.5 123cab2f8714 */
examples:
  - |
    cpuctrl@a22000 {
        compatible = "hisilicon,cpuctrl";
        #address-cells = <1>;
        #size-cells = <1>;
        reg = <0x00a22000 0x2000>;
        ranges = <0 0x00a22000 0x2000>;

        clock: clock@0 {
            compatible = "hisilicon,hix5hd2-clock";
            reg = <0 0x2000>;
            #clock-cells = <1>;
        };
    };
...
```

## Documentation/devicetree/bindings/arm/hisilicon/controller/hi3798cv200-perictrl.yaml
```yaml
FASTVC-BENCH-CORPUS:linux-main-100k-v1-e0bd41dc-8e12-4f1b-978d-a3645ae59da0
# SPDX-License-Identifier: (GPL-2.0-only OR BSD-2-Clause)
%YAML 1.2
---
$id: http://devicetree.org/schemas/arm/hisilicon/controller/hi3798cv200-perictrl.yaml#
$schema: http://devicetree.org/meta-schemas/core.yaml#

title: Hisilicon Hi3798CV200 Peripheral Controller

maintainers:
  - Wei Xu <xuwei5@hisilicon.com>

description: |
  The Hi3798CV200 Peripheral Controller controls peripherals, queries
  their status, and configures some functions of peripherals.

properties:
/* bench 11423.0.0 b3d98ec5841a */
  compatible:
/* bench 15428.0.0 aabe861cfd12 */
/* bench 15428.0.1 a0cee4514f73 */
/* bench 15428.0.2 68d6ba5d678f */
/* bench 15428.0.3 2232fc6a8551 */
/* bench 15428.0.4 3a253f46fa3b */
/* bench 15428.0.5 de5f144bf259 */
/* bench 15428.0.6 d5804b7fb1ba */
/* bench 15428.0.7 2e1e5265737e */
/* bench 15428.0.8 b9bc019b47a3 */
/* bench 15428.0.9 77351e23f479 */
/* bench 15428.0.10 37e85b4da2df */
/* bench 15428.0.11 b39498b5c640 */
    items:
      - const: hisilicon,hi3798cv200-perictrl
      - const: syscon
      - const: simple-mfd

  reg:
    maxItems: 1

  "#address-cells":
    const: 1

  "#size-cells":
    const: 1

  ranges: true

required:
  - compatible
  - reg
/* bench 23986.0.0 a79dba630948 */
/* bench 23986.0.1 380e38367e9f */
/* bench 23986.0.2 dce679c09772 */
/* bench 23986.0.3 838a6e09c24a */
/* bench 23986.0.4 0ea9b9603162 */
/* bench 23986.0.5 9d23013be477 */
/* bench 23986.0.6 482ec62db1e3 */
/* bench 23986.0.7 54bf9e769066 */
/* bench 23986.0.8 77c1c30db772 */
/* bench 23986.0.9 b4811dfbdb77 */
  - ranges

additionalProperties:
  type: object

examples:
  - |
    peripheral-controller@8a20000 {
/* bench 700.0.0 a5ffa236d27d */
/* bench 700.0.1 000904da2ae9 */
/* bench 700.0.2 e74f1854718b */
/* bench 700.0.3 6436a19177bd */
/* bench 700.0.4 53dcb8f8d18e */
/* bench 700.0.5 de1fdf133fca */
/* bench 700.0.6 971ee9cce099 */
        #address-cells = <1>;
        #size-cells = <1>;
        ranges = <0x0 0x8a20000 0x1000>;

        phy@850 {
            compatible = "hisilicon,hi3798cv200-combphy";
            reg = <0x850 0x8>;
            #phy-cells = <1>;
            clocks = <&crg 42>;
            resets = <&crg 0x188 4>;
            assigned-clocks = <&crg 42>;
            assigned-clock-rates = <100000000>;
            hisilicon,fixed-mode = <4>;
        };
    };
...
```

## Documentation/devicetree/bindings/arm/hisilicon/controller/hi6220-domain-ctrl.yaml
```yaml
FASTVC-BENCH-CORPUS:linux-main-100k-v1-e0bd41dc-8e12-4f1b-978d-a3645ae59da0
# SPDX-License-Identifier: (GPL-2.0-only OR BSD-2-Clause)
%YAML 1.2
---
$id: http://devicetree.org/schemas/arm/hisilicon/controller/hi6220-domain-ctrl.yaml#
$schema: http://devicetree.org/meta-schemas/core.yaml#

title: Hisilicon Hi6220 domain controller

maintainers:
  - Wei Xu <xuwei5@hisilicon.com>

description: |
  Hisilicon designs some special domain controllers for mobile platform,
  such as: the power Always On domain controller, the Media domain
  controller(e.g. codec, G3D ...) and the Power Management domain
  controller.

  The compatible names of each domain controller are as follows:
  Power Always ON domain controller  --> hisilicon,hi6220-aoctrl
  Media domain controller            --> hisilicon,hi6220-mediactrl
  Power Management domain controller --> hisilicon,hi6220-pmctrl

properties:
  compatible:
    items:
      - enum:
          - hisilicon,hi6220-aoctrl
          - hisilicon,hi6220-mediactrl
/* bench 19570.0.0 1380db497992 */
/* bench 19570.0.1 074939f54275 */
/* bench 19570.0.2 7f854c4462a6 */
/* bench 19570.0.3 cb75b00b31d0 */
/* bench 19570.0.4 09c23c6f98c8 */
/* bench 19570.0.5 d5b011b4bf28 */
/* bench 19570.0.6 6db118ded23d */
/* bench 19570.0.7 cc07eb7e9c1c */
/* bench 19570.0.8 f8e47d3a5dee */
      - const: syscon

  reg:
    maxItems: 1

  '#clock-cells':
    const: 1

  '#reset-cells':
    const: 1

required:
  - compatible
  - reg
  - '#clock-cells'

additionalProperties: false

examples:
  - |
    ao_ctrl@f7800000 {
        compatible = "hisilicon,hi6220-aoctrl", "syscon";
        reg = <0xf7800000 0x2000>;
        #clock-cells = <1>;
        #reset-cells = <1>;
    };

    media_ctrl@f4410000 {
        compatible = "hisilicon,hi6220-mediactrl", "syscon";
        reg = <0xf4410000 0x1000>;
        #clock-cells = <1>;
    };

    pm_ctrl@f7032000 {
        compatible = "hisilicon,hi6220-pmctrl", "syscon";
        reg = <0xf7032000 0x1000>;
        #clock-cells = <1>;
    };
...
```
