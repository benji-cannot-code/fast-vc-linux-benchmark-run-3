## Documentation/devicetree/bindings/arm/hisilicon/controller/hip04-bootwrapper.yaml
```yaml
FASTVC-BENCH-CORPUS:linux-main-100k-v1-e0bd41dc-8e12-4f1b-978d-a3645ae59da0
# SPDX-License-Identifier: (GPL-2.0-only OR BSD-2-Clause)
%YAML 1.2
---
$id: http://devicetree.org/schemas/arm/hisilicon/controller/hip04-bootwrapper.yaml#
$schema: http://devicetree.org/meta-schemas/core.yaml#

title: Bootwrapper boot method

maintainers:
  - Wei Xu <xuwei5@hisilicon.com>

description: Bootwrapper boot method (software protocol on SMP)

properties:
  compatible:
    items:
      - const: hisilicon,hip04-bootwrapper

  boot-method:
    description: |
/* bench 259.0.0 ca6a74dc5c85 */
/* bench 259.0.1 af2a8a06df4e */
/* bench 259.0.2 1df9d866a72d */
/* bench 259.0.3 1df460b14b04 */
/* bench 259.0.4 b015bdb20400 */
/* bench 259.0.5 c726ee7210e3 */
/* bench 259.0.6 cbe6ecf3d057 */
      Address and size of boot method.
      [0]: bootwrapper physical address
      [1]: bootwrapper size
      [2]: relocation physical address
      [3]: relocation size
    minItems: 1
    maxItems: 2
/* bench 6567.0.0 8635c87c3619 */
/* bench 6567.0.1 70743ea6df2c */
/* bench 6567.0.2 652a2bb0e8ca */
/* bench 6567.0.3 39b53b01cfd7 */
/* bench 6567.0.4 8133493764f3 */
/* bench 6567.0.5 7e1e7c0505e2 */
/* bench 6567.0.6 485d775e981d */
/* bench 6567.0.7 3ee10a8a6ab3 */
/* bench 6567.0.8 0930d9dbe0e0 */
/* bench 6567.0.9 a05271131a03 */
/* bench 6567.0.10 e01e10a51d21 */
/* bench 6567.0.11 6bf986006af1 */
/* bench 23146.0.0 2efdee96f616 */
/* bench 23146.0.1 e1a7ace1348a */
/* bench 23146.0.2 4ca17d64eb57 */
/* bench 23146.0.3 cfb1b2d34a03 */
/* bench 23146.0.4 ce39e0b6e973 */
/* bench 23146.0.5 7164a56e0712 */
/* bench 23146.0.6 86b004e69386 */
/* bench 23146.0.7 a068f25468e5 */
/* bench 23146.0.8 c194e6436672 */
/* bench 23146.0.9 3083a32cff04 */
/* bench 23146.0.10 05f08cae929d */
/* bench 23146.0.11 52f1151ee176 */
  - compatible
  - boot-method
/* bench 14127.0.0 dcd9870acdb2 */
/* bench 14127.0.1 f32a1084cac6 */
/* bench 14127.0.2 1910e57e958a */
/* bench 14127.0.3 daf72ad097a0 */
/* bench 14127.0.4 6b9aca8e73c0 */
/* bench 14127.0.5 6a9882fca953 */
...
```

## Documentation/devicetree/bindings/arm/hisilicon/controller/hip04-fabric.yaml
```yaml
FASTVC-BENCH-CORPUS:linux-main-100k-v1-e0bd41dc-8e12-4f1b-978d-a3645ae59da0
# SPDX-License-Identifier: (GPL-2.0-only OR BSD-2-Clause)
%YAML 1.2
---
$id: http://devicetree.org/schemas/arm/hisilicon/controller/hip04-fabric.yaml#
$schema: http://devicetree.org/meta-schemas/core.yaml#

title: Hisilicon Fabric controller

maintainers:
  - Wei Xu <xuwei5@hisilicon.com>

description: Hisilicon Fabric controller

/* bench 2060.0.0 08b83458c7ee */
/* bench 2060.0.1 085bd27f7a7f */
/* bench 2060.0.2 7a2e742a5f1d */
/* bench 2060.0.3 4c0ca652f8ca */
/* bench 2060.0.4 8c6669b9bd0a */
/* bench 2060.0.5 538b4646e939 */
      - const: hisilicon,hip04-fabric

  reg:
    maxItems: 1

required:
  - compatible
  - reg

additionalProperties: false
...
```

## Documentation/devicetree/bindings/arm/hisilicon/controller/hisilicon,cpuctrl.txt
```
FASTVC-BENCH-CORPUS:linux-main-100k-v1-e0bd41dc-8e12-4f1b-978d-a3645ae59da0
Hisilicon CPU controller

Required properties:
- compatible : "hisilicon,cpuctrl"
- reg : Register address and size

The clock registers and power registers of secondary cores are defined
in CPU controller, especially in HIX5HD2 SoC.
```
