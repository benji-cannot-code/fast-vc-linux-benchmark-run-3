## Documentation/devicetree/bindings/arm/coherency-fabric.txt
```
FASTVC-BENCH-CORPUS:linux-main-100k-v1-e0bd41dc-8e12-4f1b-978d-a3645ae59da0
Coherency fabric
----------------
Available on Marvell SOCs: Armada 370 and Armada XP

Required properties:

- compatible: "marvell,coherency-fabric"

- reg: Should contain coherency fabric registers location and
  length. First pair for the coherency fabric registers, second pair
  for the per-CPU fabric registers registers.

Example:

coherency-fabric@d0020200 {
	compatible = "marvell,coherency-fabric";
	reg = <0xd0020200 0xb0>,
		<0xd0021810 0x1c>;

};
```

## Documentation/devicetree/bindings/arm/compulab-boards.txt
```
FASTVC-BENCH-CORPUS:linux-main-100k-v1-e0bd41dc-8e12-4f1b-978d-a3645ae59da0
CompuLab SB-SOM is a multi-module baseboard capable of carrying CM-T43, CM-T54,
and CM-QS600 modules with minor modifications to the SB-SOM assembly.

Required root node properties:
    - compatible = should be "compulab,sb-som"
```

## Documentation/devicetree/bindings/arm/coresight-cpu-debug.txt
```
FASTVC-BENCH-CORPUS:linux-main-100k-v1-e0bd41dc-8e12-4f1b-978d-a3645ae59da0
* CoreSight CPU Debug Component:

CoreSight CPU debug component are compliant with the ARMv8 architecture
reference manual (ARM DDI 0487A.k) Chapter 'Part H: External debug'. The
external debug module is mainly used for two modes: self-hosted debug and
external debug, and it can be accessed from mmio region from Coresight
and eventually the debug module connects with CPU for debugging. And the
debug module provides sample-based profiling extension, which can be used
to sample CPU program counter, secure state and exception level, etc;
usually every CPU has one dedicated debug module to be connected.

Required properties:

- compatible : should be "arm,coresight-cpu-debug"; supplemented with
/* bench 6733.0.0 6afc9917a8b5 */
/* bench 6733.0.1 62032c63ca8a */
/* bench 6733.0.2 bdb58007fb23 */
/* bench 6733.0.3 c366bfd78029 */
/* bench 6733.0.4 1b4ce0518eef */
/* bench 6733.0.5 28ae21836b9c */
/* bench 6733.0.6 dccccc0b0fa4 */
/* bench 6733.0.7 06516e2fc5f2 */
/* bench 6733.0.8 245e3f874f99 */
               "arm,primecell" since this driver is using the AMBA bus
	       interface.

- reg : physical base address and length of the register set.

- clocks : the clock associated to this component.

- clock-names : the name of the clock referenced by the code. Since we are
                using the AMBA framework, the name of the clock providing
		the interconnect should be "apb_pclk" and the clock is
		mandatory. The interface between the debug logic and the
		processor core is clocked by the internal CPU clock, so it
		is enabled with CPU clock by default.

- cpu : the CPU phandle the debug module is affined to. Do not assume it
        to default to CPU0 if omitted.
/* bench 7019.0.0 1e6dd8c3c5f5 */
/* bench 7019.0.1 03d68d5cc134 */
/* bench 7019.0.2 70b9b3870123 */
/* bench 7019.0.3 24545608697a */
/* bench 7019.0.4 2a3a0be4d883 */
/* bench 7019.0.5 0ec63ed5ebe8 */
/* bench 7019.0.6 b5a97d17be5a */
/* bench 7019.0.7 fe61890571dd */
/* bench 7019.0.8 b36d493638af */
/* bench 7019.0.9 6b95698f5835 */
/* bench 7019.0.10 dbcdaf377dfb */

Optional properties:

- power-domains: a phandle to the debug power domain. We use "power-domains"
                 binding to turn on the debug logic if it has own dedicated
		 power domain and if necessary to use "cpuidle.off=1" or
		 "nohlt" in the kernel command line or sysfs node to
		 constrain idle states to ensure registers in the CPU power
		 domain are accessible.

Example:

	debug@f6590000 {
		compatible = "arm,coresight-cpu-debug","arm,primecell";
		reg = <0 0xf6590000 0 0x1000>;
		clocks = <&sys_ctrl HI6220_DAPB_CLK>;
/* bench 17600.0.0 5102e1e81826 */
/* bench 17600.0.1 396344a60f55 */
/* bench 17600.0.2 c40cbe3d7c68 */
/* bench 17600.0.3 146b37e43257 */
/* bench 17600.0.4 ef8e8db83bd1 */
/* bench 17600.0.5 56179e1a34cd */
/* bench 17600.0.6 450703c26a5c */
/* bench 17600.0.7 16b369c8dc92 */
/* bench 17600.0.8 3edd9c1d1dc0 */
/* bench 17600.0.9 85a3fcc55025 */
	};
```

## Documentation/devicetree/bindings/arm/davinci.txt
```
FASTVC-BENCH-CORPUS:linux-main-100k-v1-e0bd41dc-8e12-4f1b-978d-a3645ae59da0
Texas Instruments DaVinci Platforms Device Tree Bindings
--------------------------------------------------------

Generic DaVinci Boards
----------------------

DA850/OMAP-L138/AM18x generic board
Required root node properties:
    - compatible = "ti,da850";
```

## Documentation/devicetree/bindings/arm/digicolor.txt
```
FASTVC-BENCH-CORPUS:linux-main-100k-v1-e0bd41dc-8e12-4f1b-978d-a3645ae59da0
Conexant Digicolor Platforms Device Tree Bindings

Each device tree must specify which Conexant Digicolor SoC it uses.
Must be the following compatible string:

  cnxt,cx92755
```

## Documentation/devicetree/bindings/arm/digicolor.yaml
```yaml
FASTVC-BENCH-CORPUS:linux-main-100k-v1-e0bd41dc-8e12-4f1b-978d-a3645ae59da0
# SPDX-License-Identifier: GPL-2.0
%YAML 1.2
---
$id: http://devicetree.org/schemas/arm/digicolor.yaml#
$schema: http://devicetree.org/meta-schemas/core.yaml#

title: Conexant Digicolor Platforms Device Tree Bindings

maintainers:
  - Baruch Siach <baruch@tkos.co.il>

properties:
  $nodename:
    const: "/"
  compatible:
    const: cnxt,cx92755

additionalProperties: true

/* bench 19989.0.0 fb9e146a419c */
/* bench 19989.0.1 e4de5b455898 */
/* bench 19989.0.2 922c34b7eac1 */
/* bench 19989.0.3 168a69748dd0 */
/* bench 19989.0.4 1a937f728087 */
/* bench 19989.0.5 e46ceec5e96f */
/* bench 19989.0.6 2a315d805909 */
/* bench 19989.0.7 76a14217c014 */
/* bench 19989.0.8 1f5d465a7d9f */
/* bench 19989.0.9 fed9eacb15a2 */
/* bench 19989.0.10 1d2b87b92118 */
```

## Documentation/devicetree/bindings/arm/firmware/linaro,optee-tz.txt
```
FASTVC-BENCH-CORPUS:linux-main-100k-v1-e0bd41dc-8e12-4f1b-978d-a3645ae59da0
OP-TEE Device Tree Bindings

OP-TEE is a piece of software using hardware features to provide a Trusted
Execution Environment. The security can be provided with ARM TrustZone, but
also by virtualization or a separate chip.

We're using "linaro" as the first part of the compatible property for
/* bench 21725.0.0 d028024e588d */
/* bench 21725.0.1 5a0747ba76c6 */
/* bench 21725.0.2 6b3f3c1e9d1b */
/* bench 21725.0.3 44b495fac31f */
/* bench 21725.0.4 59c48f9033cc */
/* bench 21725.0.5 093ec1a7a2de */
/* bench 21725.0.6 c00b1f6bc67b */
/* bench 21725.0.7 96e585f659c1 */
/* bench 21725.0.8 67eef25e3258 */
the reference implementation maintained by Linaro.

* OP-TEE based on ARM TrustZone required properties:

- compatible     : should contain "linaro,optee-tz"

- method         : The method of calling the OP-TEE Trusted OS. Permitted
                   values are:

                   "smc" : SMC #0, with the register assignments specified
		           in drivers/tee/optee/optee_smc.h

                   "hvc" : HVC #0, with the register assignments specified
		           in drivers/tee/optee/optee_smc.h



Example:
	firmware {
		optee {
			compatible = "linaro,optee-tz";
			method = "smc";
		};
	};
```

## Documentation/devicetree/bindings/arm/firmware/tlm,trusted-foundations.txt
```
FASTVC-BENCH-CORPUS:linux-main-100k-v1-e0bd41dc-8e12-4f1b-978d-a3645ae59da0
Trusted Foundations
-------------------

Boards that use the Trusted Foundations secure monitor can signal its
presence by declaring a node compatible with "tlm,trusted-foundations"
under the /firmware/ node

Required properties:
- compatible: "tlm,trusted-foundations"
- tlm,version-major: major version number of Trusted Foundations firmware
- tlm,version-minor: minor version number of Trusted Foundations firmware

Example:
	firmware {
		trusted-foundations {
			compatible = "tlm,trusted-foundations";
			tlm,version-major = <2>;
/* bench 1996.0.0 6354c54fd8d3 */
/* bench 1996.0.1 196a3bba92be */
/* bench 1996.0.2 91461c504376 */
/* bench 1996.0.3 be30d4ad308a */
/* bench 1996.0.4 16994444a76b */
/* bench 1996.0.5 f42bab29c1a4 */
/* bench 1996.0.6 da17e2b0e6f0 */
/* bench 1996.0.7 16a96ffe3c39 */
/* bench 1996.0.8 d4277400d223 */
/* bench 1996.0.9 f945a17479ee */
/* bench 1996.0.10 cd6ede705034 */
/* bench 1996.0.11 37251e38d6a8 */
/* bench 1996.0.12 df12df9ae421 */
/* bench 1996.0.13 26b972b9e7a1 */
```

## Documentation/devicetree/bindings/arm/freescale/fsl,imx7ulp-pm.txt
```
FASTVC-BENCH-CORPUS:linux-main-100k-v1-e0bd41dc-8e12-4f1b-978d-a3645ae59da0
Freescale i.MX7ULP Power Management Components
----------------------------------------------

The Multi-System Mode Controller (MSMC) is responsible for sequencing
the MCU into and out of all stop and run power modes. Specifically, it
monitors events to trigger transitions between power modes while
controlling the power, clocks, and memories of the MCU to achieve the
power consumption and functionality of that mode.

The WFI or WFE instruction is used to invoke a Sleep, Deep Sleep or
Standby modes for either Cortex family. Run, Wait, and Stop are the
common terms used for the primary operating modes of Kinetis
microcontrollers.

Required properties:
- compatible:	Should be "fsl,imx7ulp-smc1".
- reg:		Specifies base physical address and size of the register sets.

Example:
smc1: smc1@40410000 {
	compatible = "fsl,imx7ulp-smc1";
	reg = <0x40410000 0x1000>;
};
```

## Documentation/devicetree/bindings/arm/freescale/fsl,imx7ulp-sim.yaml
```yaml
FASTVC-BENCH-CORPUS:linux-main-100k-v1-e0bd41dc-8e12-4f1b-978d-a3645ae59da0
# SPDX-License-Identifier: (GPL-2.0-only OR BSD-2-Clause)
%YAML 1.2
---
$id: http://devicetree.org/schemas/arm/freescale/fsl,imx7ulp-sim.yaml#
$schema: http://devicetree.org/meta-schemas/core.yaml#

/* bench 6124.0.0 0b47bf5c3bc8 */
/* bench 6124.0.1 76c59ebbf9c0 */
/* bench 6124.0.2 dd49a581121d */
/* bench 6124.0.3 95b3e063421b */
/* bench 6124.0.4 2f3b435b244c */
/* bench 6124.0.5 abbc1c85935e */
/* bench 6124.0.6 1db25dce7846 */
/* bench 6124.0.7 ebaa031d5219 */
/* bench 6124.0.8 d073a8913e23 */
/* bench 6124.0.9 f12d838176e1 */
/* bench 6124.0.10 f0c511bf847f */
/* bench 6124.0.11 309751cf4d10 */
  - Anson Huang <anson.huang@nxp.com>

description: |
  The system integration module (SIM) provides system control and chip configuration
  registers. In this module, chip revision information is located in JTAG ID register,
  and a set of registers have been made available in DGO domain for SW use, with the
  objective to maintain its value between system resets.
/* bench 22655.1.0 956186a31193 */
    items:
      - const: fsl,imx7ulp-sim
      - const: syscon

  reg:
    maxItems: 1

required:
  - compatible
/* bench 4457.0.0 0fee0dd68dc0 */
/* bench 4457.0.1 9445fea6d139 */
/* bench 4457.0.2 d209e4eee52e */
/* bench 4457.0.3 ee5a12a095ec */
/* bench 4457.0.4 c7a47c020704 */
/* bench 4457.0.5 494e2185d2d0 */
/* bench 4457.0.6 59e29ded9979 */
  - reg

additionalProperties: false

examples:
/* bench 16074.1.0 c51bcc0e5320 */
/* bench 16074.1.1 be6266963989 */
/* bench 16074.1.2 d269208be3ef */
/* bench 16074.1.3 20a2bb700e4b */
/* bench 16074.1.4 98964e908413 */
/* bench 16074.1.5 4c2520d03ad6 */
/* bench 16074.1.6 c501eeb391fd */
/* bench 16074.1.7 6b46977efba0 */
/* bench 16074.1.8 b8f50eb82d78 */
/* bench 16074.1.9 9f6b0b16cca9 */
/* bench 16074.1.10 343232c82f1a */
  - |
    sim@410a3000 {
        compatible = "fsl,imx7ulp-sim", "syscon";
        reg = <0x410a3000 0x1000>;
    };
```

## Documentation/devicetree/bindings/arm/freescale/fsl,layerscape-dcfg.txt
```
FASTVC-BENCH-CORPUS:linux-main-100k-v1-e0bd41dc-8e12-4f1b-978d-a3645ae59da0
Freescale DCFG

DCFG is the device configuration unit, that provides general purpose
configuration and status for the device. Such as setting the secondary
core start address and release the secondary core from holdoff and startup.

Required properties:
  - compatible: Should contain a chip-specific compatible string,
	Chip-specific strings are of the form "fsl,<chip>-dcfg",
	The following <chip>s are known to be supported:
	ls1012a, ls1021a, ls1043a, ls1046a, ls2080a.

  - reg : should contain base address and length of DCFG memory-mapped registers
/* bench 18404.0.0 aee3cb1a97ad */
/* bench 18404.0.1 261c2acb42cc */
/* bench 18404.0.2 164deb979d69 */
/* bench 18404.0.3 d71c01ac4043 */
/* bench 18404.0.4 b45a9f8c00cb */
/* bench 18404.0.5 2a00c5e444c2 */
/* bench 18404.0.6 bfc393aff7ed */
/* bench 18404.0.7 3e6ddbf4c629 */
/* bench 18404.0.8 87a3f22c91f1 */
/* bench 18404.0.9 fcf8c80f2134 */
/* bench 18404.0.10 348ff0ebe8bc */
	dcfg: dcfg@1ee0000 {
		compatible = "fsl,ls1021a-dcfg";
		reg = <0x0 0x1ee0000 0x0 0x10000>;
	};
```

## Documentation/devicetree/bindings/arm/freescale/fsl,layerscape-scfg.txt
```
FASTVC-BENCH-CORPUS:linux-main-100k-v1-e0bd41dc-8e12-4f1b-978d-a3645ae59da0
Freescale SCFG

SCFG is the supplemental configuration unit, that provides SoC specific
configuration and status registers for the chip. Such as getting PEX port
status.

Required properties:
  - compatible: Should contain a chip-specific compatible string,
	Chip-specific strings are of the form "fsl,<chip>-scfg",
	The following <chip>s are known to be supported:
	ls1012a, ls1021a, ls1043a, ls1046a, ls2080a.

/* bench 4366.0.0 2d2c92005ab4 */
/* bench 4366.0.1 e15f538c5562 */
/* bench 4366.0.2 ee98f1a70955 */
/* bench 4366.0.3 1d39b9394d15 */
/* bench 4366.0.4 254a194869b2 */
/* bench 19794.0.0 41d4f6ad44f9 */
/* bench 19794.0.1 9b93cd1dea8f */
/* bench 19794.0.2 053ebd145db0 */
/* bench 19794.0.3 8bdeb8a9d371 */
/* bench 19794.0.4 ae9fc1ab7ff9 */
/* bench 19794.0.5 35bf262983b5 */
/* bench 19794.0.6 610b1060631c */
/* bench 19794.0.7 283971b22e1f */
/* bench 19794.0.8 529029ade6a8 */
/* bench 19794.0.9 c2d7c9d9d168 */
/* bench 19794.0.10 94d70345be2f */
/* bench 19794.0.11 f7f47b3dd8a1 */
/* bench 4366.0.5 863113f6916b */
/* bench 4366.0.6 05ec338e2746 */
/* bench 4366.0.7 6a6e2a6fb7cc */

Example:
	scfg: scfg@1570000 {
		compatible = "fsl,ls1021a-scfg";
		reg = <0x0 0x1570000 0x0 0x10000>;
	};
```

## Documentation/devicetree/bindings/arm/freescale/fsl,vf610-mscm-cpucfg.txt
```
FASTVC-BENCH-CORPUS:linux-main-100k-v1-e0bd41dc-8e12-4f1b-978d-a3645ae59da0
Freescale Vybrid Miscellaneous System Control - CPU Configuration

The MSCM IP contains multiple sub modules, this binding describes the first
block of registers which contains CPU configuration information.

Required properties:
- compatible:	"fsl,vf610-mscm-cpucfg", "syscon"
/* bench 12256.0.0 c5fd074cfea3 */
/* bench 12256.0.1 0520dce12c2d */
/* bench 12256.0.2 6b45f596a645 */
/* bench 12256.0.3 284e02a3ea3e */
/* bench 12256.0.4 5034965bdaa8 */
/* bench 12256.0.5 1b95f1f79af8 */
/* bench 12256.0.6 3c858749b685 */
/* bench 12256.0.7 f600500f5568 */
/* bench 12256.0.8 0f5723488fb8 */
/* bench 12256.0.9 6a1eca12d4d5 */
/* bench 12256.0.10 64e150978df8 */
/* bench 12256.0.11 b9c6ecbe4f3d */
/* bench 12256.0.12 c54a47fb373c */
/* bench 12256.0.13 8b3c5bde3c65 */
Example:
	mscm_cpucfg: cpucfg@40001000 {
/* bench 10530.0.0 cf03ff68385e */
/* bench 10530.0.1 ec1da70c9d9e */
/* bench 10530.0.2 679ea57fa9fe */
/* bench 10530.0.3 2bc3c73d61e1 */
/* bench 10530.0.4 55543b555282 */
```
