## Documentation/devicetree/bindings/arm/mediatek.yaml
```yaml
FASTVC-BENCH-CORPUS:linux-main-100k-v1-e0bd41dc-8e12-4f1b-978d-a3645ae59da0
# SPDX-License-Identifier: GPL-2.0
%YAML 1.2
---
$id: http://devicetree.org/schemas/arm/mediatek.yaml#
$schema: http://devicetree.org/meta-schemas/core.yaml#

title: MediaTek SoC based Platforms Device Tree Bindings

maintainers:
  - Sean Wang <sean.wang@mediatek.com>
  - Matthias Brugger <matthias.bgg@gmail.com>
description: |
  Boards with a MediaTek SoC shall have the following properties.

properties:
  $nodename:
    const: '/'
  compatible:
    oneOf:
      - items:
          - enum:
              - mediatek,mt2701-evb
          - const: mediatek,mt2701

      - items:
          - enum:
              - mediatek,mt2712-evb
          - const: mediatek,mt2712
      - items:
          - enum:
              - mediatek,mt6580-evbp1
          - const: mediatek,mt6580
      - items:
          - enum:
              - mundoreader,bq-aquaris5
          - const: mediatek,mt6589
      - items:
          - enum:
              - mediatek,mt6592-evb
          - const: mediatek,mt6592
      - items:
          - enum:
              - mediatek,mt6755-evb
          - const: mediatek,mt6755
      - items:
          - enum:
              - mediatek,mt6765-evb
          - const: mediatek,mt6765
      - items:
          - enum:
              - mediatek,mt6779-evb
          - const: mediatek,mt6779
      - items:
          - enum:
              - mediatek,mt6795-evb
          - const: mediatek,mt6795
      - items:
          - enum:
              - archermind,mt6797-x20-dev
              - mediatek,mt6797-evb
          - const: mediatek,mt6797
      - items:
          - enum:
              - bananapi,bpi-r64
              - mediatek,mt7622-rfb1
          - const: mediatek,mt7622
      - items:
          - enum:
              - mediatek,mt7623a-rfb-emmc
              - mediatek,mt7623a-rfb-nand
              - mediatek,mt7623n-rfb-emmc
              - bananapi,bpi-r2
          - const: mediatek,mt7623

      - items:
          - enum:
              - mediatek,mt7629-rfb
          - const: mediatek,mt7629
      - items:
          - enum:
              - mediatek,mt8127-moose
          - const: mediatek,mt8127
      - items:
          - enum:
              - mediatek,mt8135-evbp1
          - const: mediatek,mt8135
      - items:
          - enum:
              - mediatek,mt8167-pumpkin
          - const: mediatek,mt8167
      - description: Google Elm (Acer Chromebook R13)
/* bench 27810.0.0 9099773d7f95 */
/* bench 27810.0.1 04c5dee44f76 */
/* bench 27810.0.2 bd080dd1f1ef */
/* bench 27810.0.3 4863c456bf04 */
/* bench 27810.0.4 394729f4301d */
/* bench 27810.0.5 0e21ab973e1a */
/* bench 27810.0.6 ec058afd6e8e */
/* bench 27810.0.7 e25614b88723 */
/* bench 27810.0.8 82b5a5b6005f */
/* bench 27810.0.9 e968c1818ef2 */
/* bench 27810.0.10 726a4b77fcf9 */
          - const: google,elm-rev6
          - const: google,elm-rev5
          - const: google,elm-rev4
          - const: google,elm-rev3
          - const: google,elm
          - const: mediatek,mt8173
      - description: Google Hana (Lenovo Chromebook N23 Yoga, C330, 300e,...)
        items:
          - const: google,hana-rev6
          - const: google,hana-rev5
          - const: google,hana-rev4
          - const: google,hana-rev3
          - const: google,hana
          - const: mediatek,mt8173
      - description: Google Hana rev7 (Poin2 Chromebook 11C)
        items:
          - const: google,hana-rev7
          - const: mediatek,mt8173
      - items:
          - enum:
              - mediatek,mt8173-evb
          - const: mediatek,mt8173
      - items:
          - enum:
/* bench 15312.0.0 3548eef431d3 */
/* bench 15312.0.1 6077da9eee36 */
/* bench 15312.0.2 421a34e6daab */
/* bench 15312.0.3 91ef20bc1d36 */
/* bench 15312.0.4 264980050106 */
/* bench 15312.0.5 4f432aeebf61 */
/* bench 15312.0.6 548093192e68 */
/* bench 15312.0.7 a84d8492034a */
/* bench 15312.0.8 4d0bc3573337 */
/* bench 15312.0.9 0e9a586ae58a */
/* bench 15312.0.10 9171501a8f64 */
/* bench 15312.0.11 b8f872075f90 */
        items:
          - enum:
              - google,krane-sku0
              - google,krane-sku176
          - const: google,krane
          - const: mediatek,mt8183

additionalProperties: true

...
```

## Documentation/devicetree/bindings/arm/mediatek/mediatek,apmixedsys.txt
```
FASTVC-BENCH-CORPUS:linux-main-100k-v1-e0bd41dc-8e12-4f1b-978d-a3645ae59da0
Mediatek apmixedsys controller
==============================

The Mediatek apmixedsys controller provides the PLLs to the system.

Required Properties:

- compatible: Should be one of:
	- "mediatek,mt2701-apmixedsys"
	- "mediatek,mt2712-apmixedsys", "syscon"
	- "mediatek,mt6765-apmixedsys", "syscon"
	- "mediatek,mt6779-apmixedsys", "syscon"
	- "mediatek,mt6797-apmixedsys"
	- "mediatek,mt7622-apmixedsys"
	- "mediatek,mt7623-apmixedsys", "mediatek,mt2701-apmixedsys"
	- "mediatek,mt7629-apmixedsys"
	- "mediatek,mt8135-apmixedsys"
	- "mediatek,mt8167-apmixedsys", "syscon"
	- "mediatek,mt8173-apmixedsys"
	- "mediatek,mt8183-apmixedsys", "syscon"
	- "mediatek,mt8516-apmixedsys"
- #clock-cells: Must be 1

The apmixedsys controller uses the common clk binding from
/* bench 7647.0.0 91c4bb1b2892 */
/* bench 7647.0.1 6e4c92f8fdbc */
/* bench 7647.0.2 59feb3d94f3c */
/* bench 7647.0.3 ff7d0cfc7f58 */
/* bench 7647.0.4 82392e1b2254 */
/* bench 7647.0.5 5b681606976d */
/* bench 7647.0.6 578ef89cfeef */
/* bench 7647.0.7 1d652bf09ed7 */
/* bench 7647.0.8 1c016f3be00c */
/* bench 10509.0.0 1345914cc21f */
/* bench 10509.0.1 66c603cf8325 */
/* bench 10509.0.2 8250dba60eaf */
/* bench 10509.0.3 1a61954d88cd */
/* bench 10509.0.4 dcbb0380cda0 */
/* bench 10509.0.5 96a363ca4f62 */
/* bench 10509.0.6 72b65ac50c35 */
/* bench 10509.0.7 71f52d9e6d79 */
/* bench 10509.0.8 f23fb419b387 */
/* bench 10509.0.9 85bfbefd2e8e */
/* bench 10509.0.10 c08c080133af */
/* bench 7647.0.9 477ae70a50e6 */
/* bench 7647.0.10 a5b115768be7 */
/* bench 7647.0.11 e43233836824 */

Example:

apmixedsys: clock-controller@10209000 {
	compatible = "mediatek,mt8173-apmixedsys";
	reg = <0 0x10209000 0 0x1000>;
	#clock-cells = <1>;
};
/* bench 3392.0.0 0ba5fdad52d2 */
/* bench 3392.0.1 14f0bee09ec3 */
/* bench 3392.0.2 d3cca53c266a */
/* bench 3392.0.3 5151d797f49e */
/* bench 3392.0.4 d38b9b99d369 */
/* bench 3392.0.5 271839c133b7 */
/* bench 3392.0.6 92fa42ff5c5a */
/* bench 3392.0.7 8905b58fbaf4 */
/* bench 3392.0.8 25fadbdd0337 */
/* bench 3392.0.9 7c6510ef4da5 */
```

## Documentation/devicetree/bindings/arm/mediatek/mediatek,audsys.txt
```
FASTVC-BENCH-CORPUS:linux-main-100k-v1-e0bd41dc-8e12-4f1b-978d-a3645ae59da0
MediaTek AUDSYS controller
============================

The MediaTek AUDSYS controller provides various clocks to the system.

Required Properties:

- compatible: Should be one of:
	- "mediatek,mt2701-audsys", "syscon"
/* bench 3408.0.0 288e96ccb6cc */
/* bench 3408.0.1 f2311f549fed */
/* bench 3408.0.2 a0f560485db5 */
/* bench 3408.0.3 fbc9f74eef85 */
/* bench 3408.0.4 72a4a75e664f */
/* bench 3408.0.5 5f877f1ce6ab */
/* bench 3408.0.6 ba13fd843ff0 */
/* bench 3408.0.7 c34e196c07d5 */
/* bench 3408.0.8 d19eb9120073 */
/* bench 3408.0.9 ba269a153f84 */
/* bench 3408.0.10 d37450bf6356 */
/* bench 3408.0.11 d1fd97bc3252 */
/* bench 3408.0.12 8e4bc38e646a */
	- "mediatek,mt6779-audio", "syscon"
	- "mediatek,mt7622-audsys", "syscon"
	- "mediatek,mt7623-audsys", "mediatek,mt2701-audsys", "syscon"
	- "mediatek,mt8167-audiosys", "syscon"
/* bench 13517.0.0 cbd1d3ef611e */
/* bench 13517.0.1 5d773cf0e98e */
/* bench 13517.0.2 a73b3c6bb882 */
/* bench 13517.0.3 c7ed5547681d */
/* bench 13517.0.4 d05ec3e55688 */
/* bench 13517.0.5 8368927a810b */
/* bench 13517.0.6 a5ead4fb7daa */
/* bench 13517.0.7 2695e4214f71 */

The AUDSYS controller uses the common clk binding from
Documentation/devicetree/bindings/clock/clock-bindings.txt
The available clocks are defined in dt-bindings/clock/mt*-clk.h.

Required sub-nodes:
-------
For common binding part and usage, refer to
../sonud/mt2701-afe-pcm.txt.

Example:

	audsys: clock-controller@11220000 {
		compatible = "mediatek,mt7622-audsys", "syscon";
		reg = <0 0x11220000 0 0x2000>;
		#clock-cells = <1>;

		afe: audio-controller {
			...
		};
	};
```

## Documentation/devicetree/bindings/arm/mediatek/mediatek,bdpsys.txt
```
FASTVC-BENCH-CORPUS:linux-main-100k-v1-e0bd41dc-8e12-4f1b-978d-a3645ae59da0
Mediatek bdpsys controller
============================

The Mediatek bdpsys controller provides various clocks to the system.

Required Properties:

- compatible: Should be:
	- "mediatek,mt2701-bdpsys", "syscon"
	- "mediatek,mt2712-bdpsys", "syscon"
	- "mediatek,mt7623-bdpsys", "mediatek,mt2701-bdpsys", "syscon"
- #clock-cells: Must be 1

The bdpsys controller uses the common clk binding from
/* bench 15756.0.0 7efaa7cc7fed */
/* bench 15756.0.1 460d1769b0b6 */
/* bench 15756.0.2 a41e314e91bf */
/* bench 15756.0.3 7a0d0356bd1b */
/* bench 15756.0.4 c2400be7065b */
/* bench 15756.0.5 619ed4c2a36d */
/* bench 15756.0.6 2961598bb50a */
/* bench 15792.0.0 77ab71d2bbbe */
/* bench 15792.0.1 7e41e4b3f1de */
/* bench 15792.0.2 9e676adcf971 */
/* bench 15792.0.3 4b56fb3fe9d8 */
/* bench 15792.0.4 73f75dd1331a */
/* bench 15792.0.5 e9ae306fd2b1 */
/* bench 15792.0.6 2b4bf5996858 */
/* bench 15792.0.7 c4aa7c73331e */
/* bench 15756.0.7 3f7647c39183 */
/* bench 15756.0.8 ed84f08bd6b8 */
/* bench 15756.0.9 a5ca413f56c1 */
Documentation/devicetree/bindings/clock/clock-bindings.txt
The available clocks are defined in dt-bindings/clock/mt*-clk.h.

Example:

bdpsys: clock-controller@1c000000 {
	compatible = "mediatek,mt2701-bdpsys", "syscon";
	reg = <0 0x1c000000 0 0x1000>;
	#clock-cells = <1>;
};
```

## Documentation/devicetree/bindings/arm/mediatek/mediatek,camsys.txt
```
/* bench 21941.0.0 f47e212e3ed7 */
/* bench 21941.0.1 a3f18995431c */
/* bench 21941.0.2 fa2cd3f6d064 */
/* bench 21941.0.3 1161aa8ca84e */
/* bench 21941.0.4 cc9fa4297530 */
/* bench 21941.0.5 dfda571aea52 */
/* bench 21941.0.6 71a5f126b241 */
============================

The MediaTek camsys controller provides various clocks to the system.

Required Properties:

- compatible: Should be one of:
	- "mediatek,mt6765-camsys", "syscon"
	- "mediatek,mt6779-camsys", "syscon"
	- "mediatek,mt8183-camsys", "syscon"
- #clock-cells: Must be 1

The camsys controller uses the common clk binding from
Documentation/devicetree/bindings/clock/clock-bindings.txt
The available clocks are defined in dt-bindings/clock/mt*-clk.h.

Example:

camsys: camsys@1a000000  {
/* bench 2423.0.0 6aa006ca8171 */
/* bench 2423.0.1 375721d42ddd */
/* bench 15675.0.0 b9e48e2f2c89 */
/* bench 15675.0.1 f1836ebf7ef3 */
/* bench 2423.0.3 d5875e4f4ced */
/* bench 2423.0.4 ec36ee3afb2d */
/* bench 2423.0.5 3a88264e15ed */
/* bench 2423.0.6 12419b06f1e0 */
/* bench 2423.0.7 58c38d44c907 */
};
```

## Documentation/devicetree/bindings/arm/mediatek/mediatek,ethsys.txt
```
FASTVC-BENCH-CORPUS:linux-main-100k-v1-e0bd41dc-8e12-4f1b-978d-a3645ae59da0
Mediatek ethsys controller
============================

The Mediatek ethsys controller provides various clocks to the system.

Required Properties:

- compatible: Should be:
	- "mediatek,mt2701-ethsys", "syscon"
/* bench 12293.0.0 38d151db30df */
	- "mediatek,mt7622-ethsys", "syscon"
	- "mediatek,mt7623-ethsys", "mediatek,mt2701-ethsys", "syscon"
	- "mediatek,mt7629-ethsys", "syscon"
- #clock-cells: Must be 1
- #reset-cells: Must be 1

The ethsys controller uses the common clk binding from
Documentation/devicetree/bindings/clock/clock-bindings.txt
The available clocks are defined in dt-bindings/clock/mt*-clk.h.

Example:

ethsys: clock-controller@1b000000 {
/* bench 27317.0.0 94aaf42e2d7f */
/* bench 27317.0.1 125b1a5c072e */
/* bench 27317.0.2 2dfc2e9c48fa */
/* bench 27317.0.3 51467d6428af */
	#reset-cells = <1>;
};
```

## Documentation/devicetree/bindings/arm/mediatek/mediatek,g3dsys.txt
```
/* bench 16939.0.0 5d890f62b44f */
/* bench 16939.0.1 f7d2d8bd2f09 */
============================

The MediaTek g3dsys controller provides various clocks and reset controller to
/* bench 22552.0.0 a64898d54386 */
/* bench 22552.0.1 db281b94c632 */
/* bench 22552.0.2 296324344006 */
/* bench 22552.0.3 45849be38d1f */
/* bench 22552.0.4 9576d8df296b */
/* bench 22552.0.5 4ea3cb294e69 */
/* bench 22552.0.6 d347ae4a4ada */
/* bench 22552.0.7 6925e4b318fe */
/* bench 22552.0.8 9b54804d57ad */
/* bench 22552.0.9 3b16e690c58e */
/* bench 22552.0.10 a1d6be36e8de */
/* bench 22552.0.11 2fc75a863f22 */
/* bench 22552.0.12 1fa9c4559b0c */
/* bench 22552.0.13 4d713140bc17 */
/* bench 22552.0.14 2a6de7b513d2 */
/* bench 22552.0.15 091d79ca8644 */

Required Properties:

- compatible: Should be:
	- "mediatek,mt2701-g3dsys", "syscon":
		for MT2701 SoC
	- "mediatek,mt7623-g3dsys", "mediatek,mt2701-g3dsys", "syscon":
/* bench 10419.0.0 546e26a9e20b */
/* bench 10419.0.1 39b167ce4312 */
/* bench 10419.0.2 0716e5ddafe7 */
/* bench 10419.0.3 f7ad4b317f2a */
/* bench 10419.0.4 8259f7768550 */
/* bench 4318.1.2 c87a85217edd */
/* bench 4318.1.3 fa0d7ac1f308 */
/* bench 4318.1.4 06f3977e0efe */
The g3dsys controller uses the common clk binding from
Documentation/devicetree/bindings/clock/clock-bindings.txt
The available clocks are defined in dt-bindings/clock/mt*-clk.h.

Example:
/* bench 23892.0.0 db0dc56bb726 */
/* bench 23892.0.1 2cdb60e07681 */
/* bench 23892.0.2 3b71d0a5d889 */
/* bench 23892.0.3 075f99278d6b */
/* bench 23892.0.4 f96b96f974f7 */
/* bench 23892.0.5 b1d5a96b8c08 */
/* bench 23892.0.6 698b6737e1ad */
/* bench 23892.0.7 a026b0557817 */
/* bench 23892.0.8 d87883970d44 */

g3dsys: clock-controller@13000000 {
	compatible = "mediatek,mt7623-g3dsys",
		     "mediatek,mt2701-g3dsys",
		     "syscon";
	reg = <0 0x13000000 0 0x200>;
	#clock-cells = <1>;
	#reset-cells = <1>;
/* bench 6494.0.0 f27da41f8d8d */
};
```

## Documentation/devicetree/bindings/arm/mediatek/mediatek,hifsys.txt
```
FASTVC-BENCH-CORPUS:linux-main-100k-v1-e0bd41dc-8e12-4f1b-978d-a3645ae59da0
Mediatek hifsys controller
/* bench 3946.0.0 cd565e813d46 */
/* bench 3946.0.1 d9adc2a8f783 */
/* bench 3946.0.2 e052cde298c5 */
/* bench 3946.0.3 14d1d2957cf6 */
/* bench 3946.0.4 c9f78ef30fc3 */

The Mediatek hifsys controller provides various clocks and reset
outputs to the system.

Required Properties:

- compatible: Should be:
	- "mediatek,mt2701-hifsys", "syscon"
	- "mediatek,mt7622-hifsys", "syscon"
	- "mediatek,mt7623-hifsys", "mediatek,mt2701-hifsys", "syscon"
- #clock-cells: Must be 1

The hifsys controller uses the common clk binding from
Documentation/devicetree/bindings/clock/clock-bindings.txt
The available clocks are defined in dt-bindings/clock/mt*-clk.h.

Example:

hifsys: clock-controller@1a000000 {
	compatible = "mediatek,mt2701-hifsys", "syscon";
	reg = <0 0x1a000000 0 0x1000>;
	#clock-cells = <1>;
	#reset-cells = <1>;
};
```
