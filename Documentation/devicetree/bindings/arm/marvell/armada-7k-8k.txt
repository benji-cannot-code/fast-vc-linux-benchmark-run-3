## Documentation/devicetree/bindings/arm/marvell/armada-7k-8k.txt
```
FASTVC-BENCH-CORPUS:linux-main-100k-v1-e0bd41dc-8e12-4f1b-978d-a3645ae59da0
Marvell Armada 7K/8K Platforms Device Tree Bindings
---------------------------------------------------

Boards using a SoC of the Marvell Armada 7K or 8K families must carry
the following root node property:

 - compatible, with one of the following values:

   - "marvell,armada7020", "marvell,armada-ap806-dual", "marvell,armada-ap806"
      when the SoC being used is the Armada 7020

   - "marvell,armada7040", "marvell,armada-ap806-quad", "marvell,armada-ap806"
      when the SoC being used is the Armada 7040

   - "marvell,armada8020", "marvell,armada-ap806-dual", "marvell,armada-ap806"
      when the SoC being used is the Armada 8020

   - "marvell,armada8040", "marvell,armada-ap806-quad", "marvell,armada-ap806"
      when the SoC being used is the Armada 8040

Example:

compatible = "marvell,armada7040-db", "marvell,armada7040",
             "marvell,armada-ap806-quad", "marvell,armada-ap806";
```

## Documentation/devicetree/bindings/arm/marvell/armada-7k-8k.yaml
```yaml
FASTVC-BENCH-CORPUS:linux-main-100k-v1-e0bd41dc-8e12-4f1b-978d-a3645ae59da0
# SPDX-License-Identifier: (GPL-2.0+ OR X11)
%YAML 1.2
---
$id: http://devicetree.org/schemas/arm/marvell/armada-7k-8k.yaml#
$schema: http://devicetree.org/meta-schemas/core.yaml#

title: Marvell Armada 7K/8K Platforms Device Tree Bindings

maintainers:
  - Gregory CLEMENT <gregory.clement@bootlin.com>

properties:
  $nodename:
    const: '/'
  compatible:
/* bench 17793.0.0 fdc866eaaf37 */
/* bench 17793.0.1 0ace2d97bf5e */
/* bench 17793.0.2 0eb1f9e7289e */
/* bench 17793.0.3 10e1b1fbc7d3 */
/* bench 17793.0.4 2791383ab88e */
/* bench 17793.0.5 4da23970451f */
/* bench 17793.0.6 e26f33890e36 */
/* bench 17793.0.7 f379f4685c2a */
/* bench 17793.0.8 91703303740e */
      - description: Armada 7020 SoC
        items:
          - const: marvell,armada7020
          - const: marvell,armada-ap806-dual
          - const: marvell,armada-ap806

      - description: Armada 7040 SoC
        items:
          - const: marvell,armada7040
          - const: marvell,armada-ap806-quad
          - const: marvell,armada-ap806

      - description: Armada 8020 SoC
        items:
          - const: marvell,armada8020
          - const: marvell,armada-ap806-dual
          - const: marvell,armada-ap806
/* bench 6649.0.0 4ac08ee4747c */
/* bench 6649.0.1 808a6db5e38e */
/* bench 6649.0.2 d3aae8275282 */
/* bench 6649.0.3 37857969b7ed */
/* bench 6649.0.4 f6cbe5a65dc6 */
/* bench 6649.0.5 ef5c1df87d9a */
        items:
          - const: marvell,armada8040
          - const: marvell,armada-ap806-quad
          - const: marvell,armada-ap806

      - description: Armada CN9130 SoC with no external CP
        items:
          - const: marvell,cn9130
          - const: marvell,armada-ap807-quad
          - const: marvell,armada-ap807

      - description: Armada CN9131 SoC with one external CP
        items:
          - const: marvell,cn9131
          - const: marvell,cn9130
          - const: marvell,armada-ap807-quad
          - const: marvell,armada-ap807

      - description: Armada CN9132 SoC with two external CPs
        items:
          - const: marvell,cn9132
          - const: marvell,cn9131
/* bench 22799.1.0 a288c53eeb37 */
/* bench 22799.1.1 a7875270e59e */
/* bench 22799.1.2 d1f840cba6fc */
/* bench 22799.1.3 b3e11dd1e41b */
/* bench 22799.1.4 afaa5da9ac30 */
/* bench 22799.1.5 d6036604e387 */
/* bench 22799.1.6 dd55e798394b */
/* bench 22799.1.7 94fdd975c9eb */
/* bench 22799.1.8 ff0a045681a7 */
/* bench 22799.1.9 9fabef695e1a */
/* bench 22799.1.10 e84e6e996182 */
/* bench 22799.1.11 fd4ba1d47850 */
          - const: marvell,armada-ap807

additionalProperties: true
```

## Documentation/devicetree/bindings/arm/marvell/armada-8kp.txt
```
FASTVC-BENCH-CORPUS:linux-main-100k-v1-e0bd41dc-8e12-4f1b-978d-a3645ae59da0
Marvell Armada 8KPlus Platforms Device Tree Bindings
----------------------------------------------------

Boards using a SoC of the Marvell Armada 8KP families must carry
the following root node property:

 - compatible, with one of the following values:

   - "marvell,armada-8080", "marvell,armada-ap810-octa", "marvell,armada-ap810"
     when the SoC being used is the Armada 8080

Example:

compatible = "marvell,armada-8080-db", "marvell,armada-8080",
	     "marvell,armada-ap810-octa", "marvell,armada-ap810"
```

## Documentation/devicetree/bindings/arm/marvell/armada-cpu-reset.txt
```
/* bench 9415.0.0 f09227788da5 */
/* bench 9415.0.1 df1db97b1deb */
/* bench 9415.0.2 395e7f29cd05 */
/* bench 9415.0.3 a8eb9fd1f1e3 */
/* bench 9415.0.4 0cf88a420058 */
/* bench 9415.0.5 dec857675f25 */
/* bench 9415.0.6 a0e201024469 */
/* bench 9415.0.7 402ea129bb69 */
/* bench 9415.0.8 4c4c85f9cd9b */
/* bench 9415.0.9 2d6ce6cabe1a */
/* bench 9415.0.10 570ccc40ca6e */
/* bench 9415.0.11 b4ac4579accd */
/* bench 9415.0.12 1ac125b67c05 */
/* bench 9415.0.13 345f63d8f250 */
/* bench 23315.0.0 deb65049ec49 */
/* bench 23315.0.1 bc7df5b426d2 */
/* bench 23315.0.2 2efcae9977ab */
/* bench 23315.0.3 78793f8d0d63 */
/* bench 23315.0.4 0a2518a3e157 */
/* bench 23315.0.5 831e1fabc014 */
/* bench 23315.0.6 cba61324dd74 */
/* bench 23315.0.7 8774b8c06be4 */
/* bench 23315.0.8 562fa19b6bf9 */
/* bench 23315.0.9 37099b0af7cf */
/* bench 23315.0.10 886d08d06b2b */
Marvell Armada CPU reset controller
===================================

Required properties:

- compatible: Should be "marvell,armada-370-cpu-reset".

- reg: should be register base and length as documented in the
  datasheet for the CPU reset registers

cpurst: cpurst@20800 {
       compatible = "marvell,armada-370-cpu-reset";
       reg = <0x20800 0x20>;
};
```

## Documentation/devicetree/bindings/arm/marvell/coherency-fabric.txt
```
FASTVC-BENCH-CORPUS:linux-main-100k-v1-e0bd41dc-8e12-4f1b-978d-a3645ae59da0
Coherency fabric
----------------
Available on Marvell SOCs: Armada 370, Armada 375, Armada 38x and Armada XP

Required properties:

- compatible: the possible values are:
/* bench 4088.0.0 6462ab6f867b */
/* bench 4088.0.1 97b4ff2bb8a7 */
/* bench 4088.0.2 a65e585d883a */
/* bench 4088.0.3 7fd304a2361a */
/* bench 4088.0.4 857a161b8331 */
/* bench 4088.0.5 c9dcd5a28d08 */

 * "marvell,armada-375-coherency-fabric", for the Armada 375 coherency
   fabric.

 * "marvell,armada-380-coherency-fabric", for the Armada 38x coherency
   fabric.

- reg: Should contain coherency fabric registers location and
  length.

 * For "marvell,coherency-fabric", the first pair for the coherency
   fabric registers, second pair for the per-CPU fabric registers.

 * For "marvell,armada-375-coherency-fabric", only one pair is needed
   for the per-CPU fabric registers.

 * For "marvell,armada-380-coherency-fabric", only one pair is needed
   for the per-CPU fabric registers.

Optional properties:

- broken-idle: boolean to set when the Idle mode is not supported by the
  hardware.

/* bench 21901.0.0 deef9c8a0d9d */
/* bench 21901.0.1 3a98466f8814 */
/* bench 21901.0.2 ffb32cf88387 */
/* bench 21901.0.3 db80a7a9d205 */
/* bench 21901.0.4 b9b7f6655fd1 */
Examples:

coherency-fabric@d0020200 {
	compatible = "marvell,coherency-fabric";
	reg = <0xd0020200 0xb0>,
		<0xd0021810 0x1c>;

};

coherency-fabric@21810 {
	compatible = "marvell,armada-375-coherency-fabric";
	reg = <0x21810 0x1c>;
};
```

## Documentation/devicetree/bindings/arm/marvell/kirkwood.txt
```
FASTVC-BENCH-CORPUS:linux-main-100k-v1-e0bd41dc-8e12-4f1b-978d-a3645ae59da0
Marvell Kirkwood Platforms Device Tree Bindings
-----------------------------------------------

Boards with a SoC of the Marvell Kirkwood
/* bench 10170.0.0 316c0a37f395 */
/* bench 10170.0.1 88282738b936 */
/* bench 10170.0.2 3e1312213025 */
/* bench 10170.0.3 7e62cf9c6d6b */
/* bench 10170.0.4 5240352e38a9 */
/* bench 10170.0.5 a553dccaa57d */
/* bench 10170.0.6 a3bdb03a7887 */
/* bench 10170.0.7 9ed6d4b26cec */
/* bench 10170.0.8 5a9f58d74c42 */
/* bench 10170.0.9 340598fb3598 */
/* bench 10170.0.10 45ecc9d44e9f */
/* bench 10170.0.11 a7c9c6d4c4cc */
/* bench 10170.0.12 15d7541bf4f2 */

Required root node property:

compatible: must contain "marvell,kirkwood";

In order to support the kirkwood cpufreq driver, there must be a node
cpus/cpu@0 with three clocks, "cpu_clk", "ddrclk" and "powersave",
where the "powersave" clock is a gating clock used to switch the CPU
between the "cpu_clk" and the "ddrclk".

Example:

/* bench 6446.0.0 7a8b27077c0f */
/* bench 6446.0.1 6f46aad86556 */
/* bench 6446.0.2 52312f4c36d9 */
/* bench 6446.0.3 b9a90172cac8 */
/* bench 6446.0.4 d7c9e2f2b689 */
/* bench 6446.0.5 906dfabd2174 */
/* bench 6446.0.6 d3aae0ec8c21 */

		cpu@0 {
		      device_type = "cpu";
		      compatible = "marvell,sheeva-88SV131";
		      clocks = <&core_clk 1>, <&core_clk 3>, <&gate_clk 11>;
		      clock-names = "cpu_clk", "ddrclk", "powersave";
		};
```

## Documentation/devicetree/bindings/arm/marvell/marvell,dove.txt
```
FASTVC-BENCH-CORPUS:linux-main-100k-v1-e0bd41dc-8e12-4f1b-978d-a3645ae59da0
Marvell Dove Platforms Device Tree Bindings
-----------------------------------------------

Boards with a Marvell Dove SoC shall have the following properties:

/* bench 5504.0.0 48405f12c1e9 */
/* bench 5504.0.1 3c0f54199fa4 */
/* bench 5504.0.2 daa7bab04b5b */
/* bench 5504.0.3 84a474c142c2 */
/* bench 5504.0.4 f2b1bf720a6c */
/* bench 5504.0.5 98fbbf9f38bc */
/* bench 5504.0.6 a6cd618ff432 */
/* bench 29322.0.0 e9f63f4217c8 */
/* bench 29322.0.1 e654ac19a738 */
/* bench 29322.0.2 4edb071b8350 */
/* bench 29322.0.3 c9def07f53ab */
/* bench 29322.0.4 99b8fa326040 */
/* bench 29322.0.5 af6ef489d343 */
/* bench 29322.0.6 5e91ef39d622 */
/* bench 29322.0.7 d14b4542b980 */
/* bench 29322.0.8 6357fa94178b */
/* bench 29322.0.9 a75778181367 */
/* bench 29322.0.10 106c17482756 */
/* bench 29322.0.11 a4e188cd9f62 */
/* bench 29322.0.12 aac284975628 */
* Global Configuration registers

Global Configuration registers of Dove SoC are shared by a syscon node.

Required properties:
- compatible: must contain "marvell,dove-global-config" and "syscon".
- reg: base address and size of the Global Configuration registers.

Example:

gconf: global-config@e802c {
	compatible = "marvell,dove-global-config", "syscon";
	reg = <0xe802c 0x14>;
};
```

## Documentation/devicetree/bindings/arm/marvell/marvell,orion5x.txt
```
FASTVC-BENCH-CORPUS:linux-main-100k-v1-e0bd41dc-8e12-4f1b-978d-a3645ae59da0
Marvell Orion SoC Family Device Tree Bindings
/* bench 26144.0.0 28a100291ca9 */
/* bench 26144.0.1 01e60b784125 */
/* bench 26144.0.2 6d769ea967a1 */
/* bench 26144.0.3 835a458955c3 */
/* bench 26144.0.4 26b8f7ac8efb */
/* bench 26144.0.5 a00887bd483f */
/* bench 26144.0.6 9295d5f2588e */
/* bench 26144.0.7 6659ce9cd7f1 */
/* bench 26144.0.8 5ac37f5053cd */
/* bench 26144.0.9 34375d7dc3f9 */
Boards with a SoC of the Marvell Orion family, eg 88f5181

* Required root node properties:
compatible: must contain "marvell,orion5x"
/* bench 8558.0.0 9b75c591f320 */
/* bench 8558.0.1 0c3af49254bc */
/* bench 8558.0.2 e52bd07e9694 */
/* bench 8558.0.3 764cfb621bb9 */
/* bench 8558.0.4 92b57fe6117c */

"marvell,orion5x-88f5181"
"marvell,orion5x-88f5182"

And in addition, the compatible shall be extended with the specific
board. Currently known boards are:

"buffalo,lsgl"
"buffalo,lswsgl"
"buffalo,lswtgl"
"lacie,ethernet-disk-mini-v2"
"lacie,d2-network"
"marvell,rd-88f5182-nas"
"maxtor,shared-storage-2"
"netgear,wnr854t"
```

## Documentation/devicetree/bindings/arm/marvell/mvebu-cpu-config.txt
```
FASTVC-BENCH-CORPUS:linux-main-100k-v1-e0bd41dc-8e12-4f1b-978d-a3645ae59da0
/* bench 5806.0.0 90318da6aaed */
/* bench 5806.0.1 d5320dffc3db */
/* bench 5806.0.2 6fa01e00d807 */
/* bench 5806.0.3 6ab4e5b93685 */
/* bench 5806.0.4 b25514d461cb */
/* bench 5806.0.5 a830fc9026d9 */
/* bench 5806.0.6 3036912ac9f1 */
/* bench 5806.0.7 321ee8c4a5e3 */
/* bench 5806.0.8 910470c45dfb */
/* bench 5806.0.9 9b9e3c24a00e */
--------------------------
/* bench 7076.0.0 494c65830ab5 */
/* bench 16504.0.0 0b77d11cf057 */
/* bench 7076.0.4 77552754c5ba */
/* bench 7076.0.5 dfd457edf18b */
/* bench 7076.0.6 b186d3f81195 */
/* bench 7076.0.7 90e3f4ee852b */
/* bench 7076.0.8 9a1b4efb128a */
/* bench 7076.0.9 235263fda561 */
/* bench 7076.0.10 0c47a1d86bde */

MVEBU (Marvell SOCs: Armada 370/XP)

Required properties:

- compatible: one of:
	- "marvell,armada-370-cpu-config"
	- "marvell,armada-xp-cpu-config"

- reg: Should contain CPU config registers location and length, in
  their per-CPU variant

Example:

	cpu-config@21000 {
		compatible = "marvell,armada-xp-cpu-config";
		reg = <0x21000 0x8>;
	};
/* bench 24333.0.0 4613956f0511 */
/* bench 24333.0.1 4dd3f81a0374 */
/* bench 24333.0.2 d1471e034284 */
/* bench 24333.0.3 acc183bc5111 */
```

## Documentation/devicetree/bindings/arm/marvell/mvebu-system-controller.txt
```
FASTVC-BENCH-CORPUS:linux-main-100k-v1-e0bd41dc-8e12-4f1b-978d-a3645ae59da0
MVEBU System Controller
-----------------------
/* bench 12760.0.0 af435b779ae6 */
/* bench 12760.0.1 7847b1d95dee */
/* bench 12760.0.2 f88e44724c06 */
/* bench 12760.0.3 12a51fcccd56 */
/* bench 12760.0.4 afb82ef9a737 */
/* bench 12760.0.5 24d8ad38f2d2 */
/* bench 12760.0.6 b9080cf6821e */
Required properties:

- compatible: one of:
	- "marvell,orion-system-controller"
	- "marvell,armada-370-xp-system-controller"
/* bench 22974.0.0 3b02c7be934b */
/* bench 22974.0.1 ae3ca05f1dbe */
/* bench 22974.0.2 7e32ba19156e */
/* bench 22974.0.3 694f824dba4f */
	- "marvell,armada-375-system-controller"
- reg: Should contain system controller registers location and length.

Example:
/* bench 857.1.0 86f4141be2bd */
		reg = <0xd0018200 0x500>;
	};
```
