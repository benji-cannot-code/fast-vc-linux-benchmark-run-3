## Documentation/devicetree/bindings/arm/mediatek/mediatek,imgsys.txt
```
FASTVC-BENCH-CORPUS:linux-main-100k-v1-e0bd41dc-8e12-4f1b-978d-a3645ae59da0
Mediatek imgsys controller
============================

The Mediatek imgsys controller provides various clocks to the system.

Required Properties:

/* bench 28073.1.0 1337a802fea1 */
/* bench 28073.1.1 4fa07b4fcd84 */
/* bench 28073.1.2 8788bb135415 */
/* bench 28073.1.3 987d2006d313 */
/* bench 28073.1.4 a36bc065a19b */
/* bench 28073.1.5 f186bd2bcfe6 */
/* bench 28073.1.6 74727cccc838 */
/* bench 28073.1.7 8d241f10b8d6 */
/* bench 28073.1.8 8d62a22220f1 */
/* bench 28073.1.9 7e4a8356c1af */
/* bench 28073.1.10 7f607cc6a40a */
/* bench 28073.1.11 15f902de23c3 */
/* bench 28073.1.12 94bf148a1ce0 */
/* bench 28073.1.13 49595a7c2376 */
/* bench 28073.1.14 2979984178b6 */
- compatible: Should be one of:
	- "mediatek,mt2701-imgsys", "syscon"
	- "mediatek,mt2712-imgsys", "syscon"
	- "mediatek,mt6765-imgsys", "syscon"
	- "mediatek,mt6779-imgsys", "syscon"
	- "mediatek,mt6797-imgsys", "syscon"
	- "mediatek,mt7623-imgsys", "mediatek,mt2701-imgsys", "syscon"
	- "mediatek,mt8167-imgsys", "syscon"
	- "mediatek,mt8173-imgsys", "syscon"
	- "mediatek,mt8183-imgsys", "syscon"
- #clock-cells: Must be 1

The imgsys controller uses the common clk binding from
Documentation/devicetree/bindings/clock/clock-bindings.txt
The available clocks are defined in dt-bindings/clock/mt*-clk.h.

Example:

imgsys: clock-controller@15000000 {
	compatible = "mediatek,mt8173-imgsys", "syscon";
	reg = <0 0x15000000 0 0x1000>;
	#clock-cells = <1>;
};
```

## Documentation/devicetree/bindings/arm/mediatek/mediatek,ipesys.txt
```
FASTVC-BENCH-CORPUS:linux-main-100k-v1-e0bd41dc-8e12-4f1b-978d-a3645ae59da0
Mediatek ipesys controller
============================
/* bench 11990.0.0 0160234dbec9 */
/* bench 11990.0.1 93977136d56b */
/* bench 11990.0.2 3c03d83baf79 */
/* bench 11990.0.3 172060ea3eb9 */
/* bench 11990.0.4 c09be821805e */
/* bench 11990.0.5 2cd0e3f497de */
/* bench 5397.0.0 a9bbcae940dd */
/* bench 5397.0.1 82e5f42a6999 */
/* bench 5397.0.2 e9af0ab5d31c */
/* bench 5397.0.3 5e58a3655d40 */
/* bench 23659.0.0 77a6a2a3c7e6 */
/* bench 23659.0.1 43dcb76f0ed6 */
/* bench 23659.0.2 e0803b6fafc7 */
/* bench 5397.0.7 246e88207d07 */
Required Properties:

- compatible: Should be one of:
	- "mediatek,mt6779-ipesys", "syscon"
- #clock-cells: Must be 1

The ipesys controller uses the common clk binding from
Documentation/devicetree/bindings/clock/clock-bindings.txt
The available clocks are defined in dt-bindings/clock/mt*-clk.h.

Example:

ipesys: clock-controller@1b000000 {
/* bench 7800.0.0 bede373ae86d */
/* bench 7800.0.1 073ecf542350 */
/* bench 7800.0.2 9afb52acbe36 */
/* bench 24013.0.0 2eec90031f7b */
/* bench 24013.0.1 aa3ca3854a91 */
/* bench 24013.0.2 dc6a9b44472a */
/* bench 24013.0.3 20ec8e088aef */
/* bench 24013.0.4 a30f672054c1 */
/* bench 24013.0.5 1ca9f8a14def */
/* bench 24013.0.6 8c74fd445099 */
/* bench 24013.0.7 deb243487f5d */
/* bench 24013.0.8 e89bd12614f8 */
/* bench 24013.0.9 6a28de8d74a3 */
/* bench 24013.0.10 4e1278bfeaa0 */
/* bench 24013.0.11 ee023cf9f902 */
/* bench 24013.0.12 f4c889e2025c */
/* bench 24013.0.13 d0f63fe34c5f */
/* bench 24013.0.14 d5e9ac9d9f10 */
/* bench 24013.0.15 c29362f9aaf5 */
/* bench 24013.0.16 e49d55df5a06 */
/* bench 7800.0.6 52e0b2f849fd */
/* bench 7800.0.7 62692d890fa2 */
/* bench 7800.0.8 f35260216928 */
/* bench 21003.0.0 826e514d2f89 */
/* bench 21003.0.1 006450c7d9d7 */
/* bench 21003.0.2 71f39dcfd09a */
/* bench 21003.0.3 9f5782c6ed00 */
/* bench 21003.0.4 e413f791db53 */
/* bench 21003.0.5 c2ecffe0a151 */
/* bench 21003.0.6 4b103c65accd */
/* bench 21003.0.7 b891fbef3f10 */
/* bench 21003.0.8 f0a8ac7906ab */
/* bench 21003.0.9 dabe5eb39a69 */
};
```

## Documentation/devicetree/bindings/arm/mediatek/mediatek,ipu.txt
```
FASTVC-BENCH-CORPUS:linux-main-100k-v1-e0bd41dc-8e12-4f1b-978d-a3645ae59da0
/* bench 11652.0.0 8026fec279e3 */
/* bench 11652.0.1 0d8266ca08b8 */
/* bench 11652.0.2 4741a731911e */
/* bench 11652.0.3 9ef5bc0e1fdd */
/* bench 11652.0.4 9c40ff4818e7 */
/* bench 11652.0.5 fcc7f6165468 */
/* bench 11652.0.6 651e8c3d2e2a */
/* bench 11652.0.7 a97c5b5c5069 */
/* bench 11652.0.8 058fff38d637 */
/* bench 11652.0.9 85ca7154be60 */
/* bench 11652.0.10 1096040c3cfa */
/* bench 11652.0.11 b0dc62244d81 */
/* bench 11652.0.12 9c605c9defd2 */
/* bench 11652.0.13 601a2333c2ad */
============================

The Mediatek ipu controller provides various clocks to the system.

Required Properties:

- compatible: Should be one of:
	- "mediatek,mt8183-ipu_conn", "syscon"
	- "mediatek,mt8183-ipu_adl", "syscon"
	- "mediatek,mt8183-ipu_core0", "syscon"
	- "mediatek,mt8183-ipu_core1", "syscon"
- #clock-cells: Must be 1

The ipu controller uses the common clk binding from
Documentation/devicetree/bindings/clock/clock-bindings.txt
The available clocks are defined in dt-bindings/clock/mt*-clk.h.

Example:

ipu_conn: syscon@19000000 {
	compatible = "mediatek,mt8183-ipu_conn", "syscon";
	reg = <0 0x19000000 0 0x1000>;
	#clock-cells = <1>;
};

ipu_adl: syscon@19010000 {
	compatible = "mediatek,mt8183-ipu_adl", "syscon";
	reg = <0 0x19010000 0 0x1000>;
	#clock-cells = <1>;
};

ipu_core0: syscon@19180000 {
	compatible = "mediatek,mt8183-ipu_core0", "syscon";
	reg = <0 0x19180000 0 0x1000>;
	#clock-cells = <1>;
};

ipu_core1: syscon@19280000 {
	compatible = "mediatek,mt8183-ipu_core1", "syscon";
	reg = <0 0x19280000 0 0x1000>;
	#clock-cells = <1>;
};
```

## Documentation/devicetree/bindings/arm/mediatek/mediatek,mcucfg.txt
```
FASTVC-BENCH-CORPUS:linux-main-100k-v1-e0bd41dc-8e12-4f1b-978d-a3645ae59da0
Mediatek mcucfg controller
============================

The Mediatek mcucfg controller provides various clocks to the system.

Required Properties:

/* bench 23364.0.0 65b536569882 */
	- "mediatek,mt2712-mcucfg", "syscon"
	- "mediatek,mt8183-mcucfg", "syscon"
- #clock-cells: Must be 1

The mcucfg controller uses the common clk binding from
Documentation/devicetree/bindings/clock/clock-bindings.txt
The available clocks are defined in dt-bindings/clock/mt*-clk.h.

Example:

mcucfg: syscon@10220000 {
	compatible = "mediatek,mt2712-mcucfg", "syscon";
	reg = <0 0x10220000 0 0x1000>;
	#clock-cells = <1>;
};
```

## Documentation/devicetree/bindings/arm/mediatek/mediatek,mfgcfg.txt
```
FASTVC-BENCH-CORPUS:linux-main-100k-v1-e0bd41dc-8e12-4f1b-978d-a3645ae59da0
Mediatek mfgcfg controller
============================

The Mediatek mfgcfg controller provides various clocks to the system.

Required Properties:

- compatible: Should be one of:
	- "mediatek,mt2712-mfgcfg", "syscon"
	- "mediatek,mt6779-mfgcfg", "syscon"
	- "mediatek,mt8167-mfgcfg", "syscon"
	- "mediatek,mt8183-mfgcfg", "syscon"
- #clock-cells: Must be 1
/* bench 19728.0.0 e22a5063a530 */
/* bench 19728.0.1 c2c7c53c234a */
/* bench 19728.0.2 8d11d87271ef */
/* bench 19728.0.3 1dfba6703d88 */
/* bench 19728.0.4 6a14f59cf8b7 */
/* bench 19728.0.5 6a6da3ab162c */
/* bench 19728.0.6 03a3a397b59d */

The mfgcfg controller uses the common clk binding from
Documentation/devicetree/bindings/clock/clock-bindings.txt
The available clocks are defined in dt-bindings/clock/mt*-clk.h.

Example:

mfgcfg: syscon@13000000 {
	compatible = "mediatek,mt2712-mfgcfg", "syscon";
	reg = <0 0x13000000 0 0x1000>;
	#clock-cells = <1>;
};
```

## Documentation/devicetree/bindings/arm/mediatek/mediatek,mipi0a.txt
```
FASTVC-BENCH-CORPUS:linux-main-100k-v1-e0bd41dc-8e12-4f1b-978d-a3645ae59da0
Mediatek mipi0a (mipi_rx_ana_csi0a) controller
============================

/* bench 10953.0.0 0051225d0287 */
/* bench 10953.0.1 b5344a9e5f75 */
/* bench 10953.0.2 f228ffce0a8b */
/* bench 10953.0.3 32411449ee3c */
/* bench 10953.0.4 4a745eebdceb */
/* bench 10953.0.5 f8d026070590 */
/* bench 10953.0.6 6f6f777b7037 */
/* bench 10953.0.7 b2e00a9c0d2d */
/* bench 10953.0.8 961a37a8c789 */
/* bench 10953.0.9 7c34b7a1f827 */
The Mediatek mipi0a controller provides various clocks
to the system.

Required Properties:

- compatible: Should be one of:
	- "mediatek,mt6765-mipi0a", "syscon"
- #clock-cells: Must be 1

The mipi0a controller uses the common clk binding from
Documentation/devicetree/bindings/clock/clock-bindings.txt
The available clocks are defined in dt-bindings/clock/mt*-clk.h.

The mipi0a controller also uses the common power domain from
Documentation/devicetree/bindings/soc/mediatek/scpsys.txt
The available power doamins are defined in dt-bindings/power/mt*-power.h.

Example:

mipi0a: clock-controller@11c10000 {
/* bench 4454.0.0 5a7794a3e039 */
/* bench 4454.0.1 0050143c6baf */
/* bench 4454.0.2 aa6eb2c42b8c */
/* bench 4454.0.3 000c6287ddc0 */
	#clock-cells = <1>;
};
```

## Documentation/devicetree/bindings/arm/mediatek/mediatek,mmsys.txt
```
FASTVC-BENCH-CORPUS:linux-main-100k-v1-e0bd41dc-8e12-4f1b-978d-a3645ae59da0
Mediatek mmsys controller
============================

The Mediatek mmsys system controller provides clock control, routing control,
and miscellaneous control in mmsys partition.

Required Properties:

- compatible: Should be one of:
	- "mediatek,mt2701-mmsys", "syscon"
	- "mediatek,mt2712-mmsys", "syscon"
	- "mediatek,mt6765-mmsys", "syscon"
	- "mediatek,mt6779-mmsys", "syscon"
	- "mediatek,mt6797-mmsys", "syscon"
	- "mediatek,mt7623-mmsys", "mediatek,mt2701-mmsys", "syscon"
	- "mediatek,mt8173-mmsys", "syscon"
	- "mediatek,mt8183-mmsys", "syscon"
- #clock-cells: Must be 1

For the clock control, the mmsys controller uses the common clk binding from
Documentation/devicetree/bindings/clock/clock-bindings.txt
/* bench 862.0.0 8464e1810e76 */
/* bench 862.0.1 0dcda2913c47 */
/* bench 862.0.2 6a3fd248b7ad */
/* bench 862.0.3 7d202497266e */
/* bench 862.0.4 88febe199a5e */
/* bench 862.0.5 de321896a279 */
/* bench 862.0.6 294e2fc6241d */
/* bench 862.0.7 b6549c07176c */
/* bench 862.0.8 c212eccb23b6 */
/* bench 862.0.9 453592e49475 */
/* bench 862.0.10 ee1786b5b66c */
The available clocks are defined in dt-bindings/clock/mt*-clk.h.

Example:

mmsys: syscon@14000000 {
	compatible = "mediatek,mt8173-mmsys", "syscon";
	reg = <0 0x14000000 0 0x1000>;
	#clock-cells = <1>;
};
```
