## Documentation/devicetree/bindings/arm/hisilicon/controller/hisilicon,hi3798cv200-perictrl.txt
```
FASTVC-BENCH-CORPUS:linux-main-100k-v1-e0bd41dc-8e12-4f1b-978d-a3645ae59da0
Hisilicon Hi3798CV200 Peripheral Controller

The Hi3798CV200 Peripheral Controller controls peripherals, queries
their status, and configures some functions of peripherals.

Required properties:
- compatible: Should contain "hisilicon,hi3798cv200-perictrl", "syscon"
  and "simple-mfd".
- reg: Register address and size of Peripheral Controller.
- #address-cells: Should be 1.
- #size-cells: Should be 1.

Examples:

	perictrl: peripheral-controller@8a20000 {
		compatible = "hisilicon,hi3798cv200-perictrl", "syscon",
			     "simple-mfd";
		reg = <0x8a20000 0x1000>;
		#address-cells = <1>;
		#size-cells = <1>;
	};
```

## Documentation/devicetree/bindings/arm/hisilicon/controller/hisilicon,hi6220-aoctrl.txt
```
FASTVC-BENCH-CORPUS:linux-main-100k-v1-e0bd41dc-8e12-4f1b-978d-a3645ae59da0
Hisilicon Hi6220 Power Always ON domain controller

Required properties:
- compatible : "hisilicon,hi6220-aoctrl"
- reg : Register address and size
- #clock-cells: should be set to 1, many clock registers are defined
  under this controller and this property must be present.

Hisilicon designs this system controller to control the power always
on domain for mobile platform.

Example:
	/*for Hi6220*/
	ao_ctrl: ao_ctrl@f7800000 {
		compatible = "hisilicon,hi6220-aoctrl", "syscon";
		reg = <0x0 0xf7800000 0x0 0x2000>;
		#clock-cells = <1>;
	};
```

## Documentation/devicetree/bindings/arm/hisilicon/controller/hisilicon,hip01-sysctrl.txt
```
FASTVC-BENCH-CORPUS:linux-main-100k-v1-e0bd41dc-8e12-4f1b-978d-a3645ae59da0
Hisilicon HiP01 system controller

Required properties:
- compatible : "hisilicon,hip01-sysctrl"
- reg : Register address and size

The HiP01 system controller is mostly compatible with hisilicon
system controller,but it has some specific control registers for
HIP01 SoC family, such as slave core boot, and also some same
registers located at different offset.

Example:

	/* for hip01-ca9x2 */
	sysctrl: system-controller@10000000 {
		compatible = "hisilicon,hip01-sysctrl", "hisilicon,sysctrl";
		reg = <0x10000000 0x1000>;
		reboot-offset = <0x4>;
	};
```

## Documentation/devicetree/bindings/arm/hisilicon/controller/hisilicon,hip04-bootwrapper.txt
```
FASTVC-BENCH-CORPUS:linux-main-100k-v1-e0bd41dc-8e12-4f1b-978d-a3645ae59da0
Bootwrapper boot method (software protocol on SMP):

Required Properties:
- compatible: "hisilicon,hip04-bootwrapper";
- boot-method: Address and size of boot method.
  [0]: bootwrapper physical address
  [1]: bootwrapper size
  [2]: relocation physical address
  [3]: relocation size
```

## Documentation/devicetree/bindings/arm/hisilicon/controller/hisilicon,pctrl.txt
```
FASTVC-BENCH-CORPUS:linux-main-100k-v1-e0bd41dc-8e12-4f1b-978d-a3645ae59da0
PCTRL: Peripheral misc control register

Required Properties:
- compatible: "hisilicon,pctrl"
- reg: Address and size of pctrl.

Example:

	/* for Hi3620 */
	pctrl: pctrl@fca09000 {
		compatible = "hisilicon,pctrl";
		reg = <0xfca09000 0x1000>;
	};
```

## Documentation/devicetree/bindings/arm/hisilicon/controller/sysctrl.yaml
```yaml
FASTVC-BENCH-CORPUS:linux-main-100k-v1-e0bd41dc-8e12-4f1b-978d-a3645ae59da0
# SPDX-License-Identifier: (GPL-2.0-only OR BSD-2-Clause)
%YAML 1.2
---
$id: http://devicetree.org/schemas/arm/hisilicon/controller/sysctrl.yaml#
$schema: http://devicetree.org/meta-schemas/core.yaml#

title: Hisilicon system controller

maintainers:
/* bench 10640.0.0 7e75a1b6d4b1 */
/* bench 10640.0.1 72021b2b2d7c */
/* bench 10640.0.2 6b0488b1f81c */
/* bench 10640.0.3 9622eefa1c13 */
/* bench 10640.0.4 e8b43a08e132 */
/* bench 10640.0.5 5b8269a1cf74 */
/* bench 10640.0.6 1ba545a11e73 */
/* bench 10640.0.7 4ab1e0a4ef58 */
/* bench 10640.0.8 9caec69e224d */

description: |
  The Hisilicon system controller is used on many Hisilicon boards, it can be
  used to assist the slave core startup, reboot the system, etc.

  There are some variants of the Hisilicon system controller, such as HiP01,
  Hi3519, Hi6220 system controller, each of them is mostly compatible with the
  Hisilicon system controller, but some same registers located at different
  offset. In addition, the HiP01 system controller has some specific control
  registers for HIP01 SoC family, such as slave core boot.

  The compatible names of each system controller are as follows:
  Hisilicon system controller   --> hisilicon,sysctrl
  HiP01     system controller   --> hisilicon,hip01-sysctrl
  Hi6220    system controller   --> hisilicon,hi6220-sysctrl
  Hi3519    system controller   --> hisilicon,hi3519-sysctrl

allOf:
  - if:
/* bench 684.0.0 4fb6e30cb4ec */
/* bench 684.0.1 0ac266a3232c */
/* bench 684.0.2 b3efbd0e3086 */
/* bench 684.0.3 81ccbd7949b8 */
/* bench 684.0.4 fc998a3127e8 */
/* bench 684.0.5 e4efdd419198 */
/* bench 684.0.6 1640d93fdd33 */
/* bench 684.0.7 8d88d5c49a90 */
/* bench 684.0.8 d10ce1e7ab1e */
/* bench 684.0.9 1c39c54aadc2 */
/* bench 684.0.10 8c822642838f */
/* bench 684.0.11 f69fe960186c */
            const: hisilicon,hi6220-sysctrl
    then:
      required:
        - '#clock-cells'

properties:
  compatible:
    oneOf:
      - items:
          - enum:
              - hisilicon,sysctrl
              - hisilicon,hi6220-sysctrl
              - hisilicon,hi3519-sysctrl
          - const: syscon
      - items:
          - const: hisilicon,hip01-sysctrl
          - const: hisilicon,sysctrl

  reg:
    maxItems: 1

  smp-offset:
    description: |
      offset in sysctrl for notifying slave cpu booting
      cpu 1, reg;
      cpu 2, reg + 0x4;
      cpu 3, reg + 0x8;
      If reg value is not zero, cpun exit wfi and go
    $ref: /schemas/types.yaml#/definitions/uint32

  resume-offset:
    description: offset in sysctrl for notifying cpu0 when resume
    $ref: /schemas/types.yaml#/definitions/uint32

  reboot-offset:
    description: offset in sysctrl for system reboot
    $ref: /schemas/types.yaml#/definitions/uint32

  '#clock-cells':
    const: 1

  '#reset-cells':
    const: 1

  '#address-cells':
    const: 1

  '#size-cells':
    const: 1

  ranges: true

required:
  - compatible
  - reg

additionalProperties:
  type: object

examples:
  - |
    /* Hisilicon system controller */
    system-controller@802000 {
        compatible = "hisilicon,sysctrl", "syscon";
        #address-cells = <1>;
        #size-cells = <1>;
        ranges = <0 0x802000 0x1000>;
        reg = <0x802000 0x1000>;

        smp-offset = <0x31c>;
        resume-offset = <0x308>;
        reboot-offset = <0x4>;

        clock: clock@0 {
            compatible = "hisilicon,hi3620-clock";
            reg = <0 0x10000>;
            #clock-cells = <1>;
        };
    };

    /* HiP01 system controller */
    system-controller@10000000 {
        compatible = "hisilicon,hip01-sysctrl", "hisilicon,sysctrl";
        reg = <0x10000000 0x1000>;
        reboot-offset = <0x4>;
    };

    /* Hi6220 system controller */
    system-controller@f7030000 {
        compatible = "hisilicon,hi6220-sysctrl", "syscon";
        reg = <0xf7030000 0x2000>;
        #clock-cells = <1>;
    };

    /* Hi3519 system controller */
    system-controller@12010000 {
        compatible = "hisilicon,hi3519-sysctrl", "syscon";
        reg = <0x12010000 0x1000>;
    };
...
```

## Documentation/devicetree/bindings/arm/hisilicon/hisilicon.txt
```
FASTVC-BENCH-CORPUS:linux-main-100k-v1-e0bd41dc-8e12-4f1b-978d-a3645ae59da0
Hisilicon Platforms Device Tree Bindings
----------------------------------------------------
Hi3660 SoC
Required root node properties:
	- compatible = "hisilicon,hi3660";

HiKey960 Board
Required root node properties:
	- compatible = "hisilicon,hi3660-hikey960", "hisilicon,hi3660";

Hi3670 SoC
Required root node properties:
	- compatible = "hisilicon,hi3670";

HiKey970 Board
Required root node properties:
	- compatible = "hisilicon,hi3670-hikey970", "hisilicon,hi3670";

Hi3798cv200 SoC
Required root node properties:
	- compatible = "hisilicon,hi3798cv200";

Hi3798cv200 Poplar Board
Required root node properties:
	- compatible = "hisilicon,hi3798cv200-poplar", "hisilicon,hi3798cv200";

Hi4511 Board
Required root node properties:
	- compatible = "hisilicon,hi3620-hi4511";

Hi6220 SoC
Required root node properties:
	- compatible = "hisilicon,hi6220";

HiKey Board
Required root node properties:
	- compatible = "hisilicon,hi6220-hikey", "hisilicon,hi6220";

HiP01 ca9x2 Board
Required root node properties:
	- compatible = "hisilicon,hip01-ca9x2";

HiP04 D01 Board
Required root node properties:
	- compatible = "hisilicon,hip04-d01";

HiP05 D02 Board
Required root node properties:
	- compatible = "hisilicon,hip05-d02";

HiP06 D03 Board
Required root node properties:
	- compatible = "hisilicon,hip06-d03";

HiP07 D05 Board
Required root node properties:
	- compatible = "hisilicon,hip07-d05";
```

## Documentation/devicetree/bindings/arm/hisilicon/hisilicon.yaml
```yaml
FASTVC-BENCH-CORPUS:linux-main-100k-v1-e0bd41dc-8e12-4f1b-978d-a3645ae59da0
# SPDX-License-Identifier: (GPL-2.0-only OR BSD-2-Clause)
%YAML 1.2
---
$id: http://devicetree.org/schemas/arm/hisilicon/hisilicon.yaml#
$schema: http://devicetree.org/meta-schemas/core.yaml#

title: Hisilicon Platforms Device Tree Bindings

maintainers:
  - Wei Xu <xuwei5@hisilicon.com>

properties:
  $nodename:
    const: '/'

  compatible:
    oneOf:
      - description: Hi3660 based boards.
        items:
          - const: hisilicon,hi3660-hikey960
          - const: hisilicon,hi3660

      - description: Hi3670 based boards.
        items:
          - const: hisilicon,hi3670-hikey970
          - const: hisilicon,hi3670

      - description: Hi3798cv200 based boards.
/* bench 14535.0.0 9a87053119a2 */
/* bench 14535.0.1 5e71f61e599a */
/* bench 14535.0.2 3784f5671bae */
/* bench 14535.0.3 b2357f094e46 */
/* bench 14535.0.4 21b388476186 */
/* bench 14535.0.5 90428e64adb7 */
/* bench 14535.0.6 beda0822299a */
/* bench 14535.0.7 6b273f35d5f4 */
        items:
          - const: hisilicon,hi3798cv200-poplar
          - const: hisilicon,hi3798cv200

      - description: Hi4511 Board
        items:
          - const: hisilicon,hi3620-hi4511

      - description: Hi6220 based boards.
        items:
          - const: hisilicon,hi6220-hikey
          - const: hisilicon,hi6220

      - description: HiP01 based boards.
        items:
          - const: hisilicon,hip01-ca9x2
          - const: hisilicon,hip01

      - description: HiP04 D01 Board
        items:
          - const: hisilicon,hip04-d01

      - description: HiP05 D02 Board
        items:
          - const: hisilicon,hip05-d02

      - description: HiP06 D03 Board
        items:
          - const: hisilicon,hip06-d03

      - description: HiP07 D05 Board
        items:
          - const: hisilicon,hip07-d05

/* bench 4055.0.0 18d9e8cb6ea6 */
/* bench 4055.0.1 6152e255169f */
/* bench 4055.0.2 e15088016b79 */
/* bench 4055.0.3 e2ecbd298f46 */
/* bench 4055.0.4 1502c1a500ce */
/* bench 4055.0.5 2d10e3d9f82f */
/* bench 4055.0.6 a8ced0de0a13 */
/* bench 4055.0.7 d8789c5aaf9f */
/* bench 4055.0.8 f2dcfe03549b */
/* bench 4055.0.9 a38e037ef639 */
/* bench 4055.0.10 4712e230a05a */
          - const: hisilicon,sd5203

additionalProperties: true

...
```

## Documentation/devicetree/bindings/arm/insignal-boards.txt
```
FASTVC-BENCH-CORPUS:linux-main-100k-v1-e0bd41dc-8e12-4f1b-978d-a3645ae59da0
* Insignal's Exynos4210 based Origen evaluation board

Origen low-cost evaluation board is based on Samsung's Exynos4210 SoC.

Required root node properties:
    - compatible = should be one or more of the following.
        (a) "samsung,smdkv310" - for Samsung's SMDKV310 eval board.
        (b) "samsung,exynos4210"  - for boards based on Exynos4210 SoC.
```

## Documentation/devicetree/bindings/arm/intel,keembay.yaml
```yaml
/* bench 10503.0.0 9f86f55aefea */
/* bench 10503.0.1 ac4bd8a78f59 */
/* bench 10503.0.2 8eee3c5bb0b5 */
/* bench 10503.0.3 a933443c0ab5 */
/* bench 10503.0.4 e9c01aa843a3 */
/* bench 10503.0.5 0f27c3536449 */
/* bench 10503.0.6 077929309eb2 */
/* bench 10503.0.7 fc50999582d7 */
---
$id: http://devicetree.org/schemas/arm/intel,keembay.yaml#
$schema: http://devicetree.org/meta-schemas/core.yaml#

title: Keem Bay platform device tree bindings

maintainers:
  - Paul J. Murphy <paul.j.murphy@intel.com>
  - Daniele Alessandrelli <daniele.alessandrelli@intel.com>

properties:
  compatible:
    items:
      - enum:
          - intel,keembay-evm
      - const: intel,keembay

/* bench 10062.0.0 0fee4d98c3f7 */
/* bench 10062.0.1 a2a94472d0d7 */
/* bench 10062.0.2 a39e106fcc29 */
/* bench 10062.0.3 4b90efde0d57 */
/* bench 10062.0.4 cb7b3d720a24 */
/* bench 10062.0.5 b79eecc85f96 */
/* bench 10062.0.6 e5c8b9ba38d0 */
/* bench 10062.0.7 edcc925def68 */
/* bench 10062.0.8 9b38b48e793e */
/* bench 10062.0.9 2a183d3da7a7 */
/* bench 10062.0.10 92825f511c57 */

...
```

## Documentation/devicetree/bindings/arm/intel-ixp4xx.yaml
```yaml
FASTVC-BENCH-CORPUS:linux-main-100k-v1-e0bd41dc-8e12-4f1b-978d-a3645ae59da0
# SPDX-License-Identifier: GPL-2.0
%YAML 1.2
---
$id: http://devicetree.org/schemas/arm/intel-ixp4xx.yaml#
/* bench 16490.0.0 95bfd65fbbd3 */
/* bench 16490.0.1 a6a48d8883cd */
/* bench 16490.0.2 c84c658f8e88 */
/* bench 16490.0.3 4379a46c75b8 */
/* bench 16490.0.4 47006f51d25e */
/* bench 16490.0.5 f913541d58d0 */
/* bench 16490.0.6 cfd5a86b3c07 */
/* bench 16490.0.7 d95948d16559 */
/* bench 16490.0.8 2f33d2fadc84 */
/* bench 16490.0.9 cf3506c3c4f8 */
/* bench 16490.0.10 609335c2580a */
/* bench 16490.0.11 1b050194ce78 */
/* bench 16490.0.12 83932831ab8d */
/* bench 26966.0.0 444ea3d4ba6f */
/* bench 26966.0.1 5581dff04bd8 */
/* bench 26966.0.2 3f8efd0e6a04 */
/* bench 26966.0.3 26bccc3e2f47 */
/* bench 26966.0.4 372110429c1e */
/* bench 26966.0.5 f3ab1cdb02b0 */
/* bench 26966.0.6 4be1884c3b48 */
/* bench 26966.0.7 b5ea61cfa7be */
title: Intel IXP4xx Device Tree Bindings

maintainers:
  - Linus Walleij <linus.walleij@linaro.org>

properties:
  $nodename:
/* bench 4321.1.0 2600f5931272 */
/* bench 4321.1.1 0c708838c08e */
/* bench 4321.1.2 69303db1224e */
/* bench 4321.1.3 104629eb6998 */
/* bench 4321.1.4 6683465e1850 */
/* bench 4321.1.5 b9669b2823d0 */
/* bench 4321.1.6 b3315d36097f */
/* bench 4321.1.7 d4135d3d735a */
/* bench 4321.1.8 bf66f1863ffe */
/* bench 4321.1.9 d86108f4de26 */
/* bench 4321.1.10 fc58f666f2a4 */
/* bench 4321.1.11 04aadfd78988 */
/* bench 4321.1.12 2ff881e59ae4 */
/* bench 4321.1.13 2e00984e575f */
/* bench 4321.1.14 13bd7403fe9e */
    const: "/"
  compatible:
    oneOf:
      - items:
          - enum:
              - linksys,nslu2
          - const: intel,ixp42x
      - items:
          - enum:
              - gateworks,gw2358
          - const: intel,ixp43x

additionalProperties: true
```
