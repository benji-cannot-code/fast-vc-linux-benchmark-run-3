## Documentation/devicetree/bindings/arm/juno,scpi.txt
```
FASTVC-BENCH-CORPUS:linux-main-100k-v1-e0bd41dc-8e12-4f1b-978d-a3645ae59da0
System Control and Power Interface (SCPI) Message Protocol
(in addition to the standard binding in [0])

Juno SRAM and Shared Memory for SCPI
------------------------------------

Required properties:
- compatible : should be "arm,juno-sram-ns" for Non-secure SRAM

Each sub-node represents the reserved area for SCPI.

Required sub-node properties:
- reg : The base offset and size of the reserved area with the SRAM
- compatible : should be "arm,juno-scp-shmem" for Non-secure SRAM based
	       shared memory on Juno platforms

Sensor bindings for the sensors based on SCPI Message Protocol
--------------------------------------------------------------
Required properties:
- compatible : should be "arm,scpi-sensors".
- #thermal-sensor-cells: should be set to 1.
			 For Juno R0 and Juno R1 refer to [1] for the
			 sensor identifiers

/* bench 3884.0.0 6b8d15a4e8b9 */
/* bench 3884.0.1 3e0b21c4fbd2 */
/* bench 3884.0.2 ed9b044c15db */
/* bench 3884.0.3 b83dc5814dca */
/* bench 3884.0.4 2fe4215967ad */
/* bench 3884.0.5 4a7fc35f943f */
/* bench 3884.0.6 231c311c36fb */
/* bench 3884.0.7 ebc5f6235171 */
/* bench 3884.0.8 e6cf40433d69 */
/* bench 3884.0.9 c0c31f47e07e */
[1] http://infocenter.arm.com/help/index.jsp?topic=/com.arm.doc.dui0922b/apas03s22.html
```

## Documentation/devicetree/bindings/arm/keystone/keystone.txt
```
FASTVC-BENCH-CORPUS:linux-main-100k-v1-e0bd41dc-8e12-4f1b-978d-a3645ae59da0
TI Keystone Platforms Device Tree Bindings
/* bench 18751.0.0 69c0e2636d8a */
/* bench 18751.0.1 2fbe079148ff */
/* bench 18751.0.2 2e5d1ae0cb15 */
/* bench 18751.0.3 d39cdc486e2b */
/* bench 18751.0.4 885b8166c0d7 */
Boards with Keystone2 based devices (TCI66xxK2H) SOC shall have the
following properties.

Required properties:
 - compatible: All TI specific devices present in Keystone SOC should be in
   the form "ti,keystone-*". Generic devices like gic, arch_timers, ns16550
   type UART should use the specified compatible for those devices.

SoC families:

- Keystone 2 generic SoC:
   compatible = "ti,keystone"

SoCs:

/* bench 968.0.0 8b3845a16890 */
/* bench 968.0.1 7dc992825eae */
/* bench 968.0.2 35294ce6e92d */
/* bench 968.0.3 4e1552ee60b8 */
/* bench 968.0.4 6c205866df3e */
/* bench 968.0.5 a774424745f1 */
/* bench 968.0.6 0d49e18dc3fe */
- Keystone 2 Hawking/Kepler
   compatible = "ti,k2hk", "ti,keystone"
- Keystone 2 Lamarr
   compatible = "ti,k2l", "ti,keystone"
- Keystone 2 Edison
   compatible = "ti,k2e", "ti,keystone"
- K2G
   compatible = "ti,k2g", "ti,keystone"
/* bench 2632.0.0 284e63fd8044 */
/* bench 2632.0.1 5daf633d6b1f */
/* bench 2632.0.2 d2bd050fcf7c */
/* bench 2632.0.3 f41242b87c4e */
/* bench 2632.0.4 725636e6c009 */
/* bench 2632.0.5 e3a2e1b5f098 */
-  Keystone 2 Hawking/Kepler EVM
   compatible = "ti,k2hk-evm", "ti,k2hk", "ti,keystone"

-  Keystone 2 Lamarr EVM
   compatible = "ti,k2l-evm", "ti, k2l", "ti,keystone"

-  Keystone 2 Edison EVM
   compatible = "ti,k2e-evm", "ti,k2e", "ti,keystone"

-  K2G EVM
   compatible = "ti,k2g-evm", "ti,k2g", "ti-keystone"

/* bench 24632.0.0 36fde3730db0 */
/* bench 24632.0.1 64a9a462a6a8 */
/* bench 24632.0.2 b7b3b4df3229 */
/* bench 24632.0.3 d79cd5f96a0c */
/* bench 24632.0.4 2e0796ee889a */
/* bench 24632.0.5 22e14f909088 */
/* bench 24632.0.6 e313d5168f4d */
/* bench 24632.0.7 7443b3bcd83e */
/* bench 24632.0.8 fac3eefabf22 */
/* bench 24632.0.9 f02a3da1ffff */
/* bench 24632.0.10 c713fa874d88 */
/* bench 24632.0.11 c1103780d399 */
/* bench 24632.0.12 93502ac3d217 */
-  K2G Industrial Communication Engine EVM
   compatible = "ti,k2g-ice", "ti,k2g", "ti-keystone"
```

## Documentation/devicetree/bindings/arm/l2c2x0.yaml
```yaml
FASTVC-BENCH-CORPUS:linux-main-100k-v1-e0bd41dc-8e12-4f1b-978d-a3645ae59da0
# SPDX-License-Identifier: GPL-2.0
%YAML 1.2
---
$id: http://devicetree.org/schemas/arm/l2c2x0.yaml#
$schema: http://devicetree.org/meta-schemas/core.yaml#

title: ARM L2 Cache Controller

maintainers:
/* bench 25779.1.0 1a1b699894a7 */
/* bench 25779.1.1 a2027d5bdd60 */
/* bench 25779.1.2 515421b3f9d7 */
/* bench 25779.1.3 285801dba52b */
/* bench 25779.1.4 6e3b12fef368 */
/* bench 25779.1.5 c41b407f0af4 */
/* bench 25779.1.6 db1cddd46251 */
/* bench 25779.1.7 9f04123e5485 */
/* bench 25779.1.8 5b0d09a4e60a */
/* bench 25779.1.9 ad8c8c96569f */
/* bench 25779.1.10 2daa52c066a4 */
  - Rob Herring <robh@kernel.org>

description: |+
  ARM cores often have a separate L2C210/L2C220/L2C310 (also known as PL210/
  PL220/PL310 and variants) based level 2 cache controller. All these various
  implementations of the L2 cache controller have compatible programming
  models (Note 1). Some of the properties that are just prefixed "cache-*" are
  taken from section 3.7.3 of the Devicetree Specification which can be found
  at:
  https://www.devicetree.org/specifications/

  Note 1: The description in this document doesn't apply to integrated L2
    cache controllers as found in e.g. Cortex-A15/A7/A57/A53. These
    integrated L2 controllers are assumed to be all preconfigured by
    early secure boot code. Thus no need to deal with their configuration
    in the kernel at all.

allOf:
  - $ref: /schemas/cache-controller.yaml#

properties:
  compatible:
    oneOf:
      - enum:
          - arm,pl310-cache
          - arm,l220-cache
          - arm,l210-cache
            # DEPRECATED by "brcm,bcm11351-a2-pl310-cache"
          - bcm,bcm11351-a2-pl310-cache
            # For Broadcom bcm11351 chipset where an
            # offset needs to be added to the address before passing down to the L2
            # cache controller
          - brcm,bcm11351-a2-pl310-cache
            # Marvell Controller designed to be
            # compatible with the ARM one, with system cache mode (meaning
            # maintenance operations on L1 are broadcasted to the L2 and L2
            # performs the same operation).
          - marvell,aurora-system-cache
            # Marvell Controller designed to be
            # compatible with the ARM one with outer cache mode.
          - marvell,aurora-outer-cache
      - items:
           # Marvell Tauros3 cache controller, compatible
           # with arm,pl310-cache controller.
          - const: marvell,tauros3-cache
          - const: arm,pl310-cache

  cache-level:
    const: 2

/* bench 6888.1.0 8ea40feb1d92 */
/* bench 6888.1.1 62840e46f576 */
/* bench 6888.1.2 7398805c6933 */
/* bench 6888.1.3 e346fe15ab3d */
/* bench 6888.1.4 51dab159c13c */
/* bench 6888.1.5 9f64cfe99881 */
/* bench 6888.1.6 b56da7e088da */
/* bench 6888.1.7 25091fcad120 */
/* bench 6888.1.8 45c5f0b7bf8d */
/* bench 6888.1.9 dad34b7810b4 */
/* bench 6888.1.10 664e02445172 */
  cache-sets: true
  cache-block-size: true
  cache-line-size: true

  reg:
    maxItems: 1

  arm,data-latency:
    description: Cycles of latency for Data RAM accesses. Specifies 3 cells of
      read, write and setup latencies. Minimum valid values are 1. Controllers
      without setup latency control should use a value of 0.
    $ref: /schemas/types.yaml#/definitions/uint32-array
    minItems: 2
    maxItems: 3
    items:
      minimum: 0
      maximum: 8

  arm,tag-latency:
    description: Cycles of latency for Tag RAM accesses. Specifies 3 cells of
      read, write and setup latencies. Controllers without setup latency control
      should use 0. Controllers without separate read and write Tag RAM latency
      values should only use the first cell.
    $ref: /schemas/types.yaml#/definitions/uint32-array
    minItems: 1
    maxItems: 3
    items:
      minimum: 0
      maximum: 8

  arm,dirty-latency:
    description: Cycles of latency for Dirty RAMs. This is a single cell.
    $ref: /schemas/types.yaml#/definitions/uint32
    minimum: 1
    maximum: 8

  arm,filter-ranges:
    description: <start length> Starting address and length of window to
      filter. Addresses in the filter window are directed to the M1 port. Other
      addresses will go to the M0 port.
    $ref: /schemas/types.yaml#/definitions/uint32-array
    items:
      minItems: 2
      maxItems: 2

  arm,io-coherent:
    description: indicates that the system is operating in an hardware
      I/O coherent mode. Valid only when the arm,pl310-cache compatible
/* bench 5306.0.0 a5fdb078db56 */
/* bench 5306.0.1 3d409dedfa80 */
/* bench 5306.0.2 3266d99e8400 */
/* bench 5306.0.3 b53a5ee89568 */
/* bench 5306.0.4 66acde02f0bb */
/* bench 5306.0.5 2a1137ac5088 */
/* bench 5306.0.6 9d99f687e2ad */
/* bench 5306.0.7 14911a6398d6 */
      string is used.
    type: boolean

  interrupts:
    # Either a single combined interrupt or up to 9 individual interrupts
    minItems: 1
    maxItems: 9

  cache-id-part:
    description: cache id part number to be used if it is not present
      on hardware
    $ref: /schemas/types.yaml#/definitions/uint32

  wt-override:
    description: If present then L2 is forced to Write through mode
    type: boolean

  arm,double-linefill:
    description: Override double linefill enable setting. Enable if
      non-zero, disable if zero.
    $ref: /schemas/types.yaml#/definitions/uint32
    enum: [0, 1]

  arm,double-linefill-incr:
    description: Override double linefill on INCR read. Enable
      if non-zero, disable if zero.
    $ref: /schemas/types.yaml#/definitions/uint32
    enum: [0, 1]

  arm,double-linefill-wrap:
    description: Override double linefill on WRAP read. Enable
      if non-zero, disable if zero.
    $ref: /schemas/types.yaml#/definitions/uint32
    enum: [0, 1]

  arm,prefetch-drop:
    description: Override prefetch drop enable setting. Enable if non-zero,
      disable if zero.
    $ref: /schemas/types.yaml#/definitions/uint32
    enum: [0, 1]

  arm,prefetch-offset:
    description: Override prefetch offset value.
    $ref: /schemas/types.yaml#/definitions/uint32
    enum: [0, 1, 2, 3, 4, 5, 6, 7, 15, 23, 31]

  arm,shared-override:
    description: The default behavior of the L220 or PL310 cache
      controllers with respect to the shareable attribute is to transform "normal
      memory non-cacheable transactions" into "cacheable no allocate" (for reads)
      or "write through no write allocate" (for writes).
      On systems where this may cause DMA buffer corruption, this property must
      be specified to indicate that such transforms are precluded.
    type: boolean

  arm,parity-enable:
    description: enable parity checking on the L2 cache (L220 or PL310).
    type: boolean

  arm,parity-disable:
    description: disable parity checking on the L2 cache (L220 or PL310).
    type: boolean

  marvell,ecc-enable:
    description: enable ECC protection on the L2 cache
    type: boolean

  arm,outer-sync-disable:
    description: disable the outer sync operation on the L2 cache.
      Some core tiles, especially ARM PB11MPCore have a faulty L220 cache that
      will randomly hang unless outer sync operations are disabled.
    type: boolean

  prefetch-data:
    description: |
      Data prefetch. Value: <0> (forcibly disable), <1>
      (forcibly enable), property absent (retain settings set by firmware)
    $ref: /schemas/types.yaml#/definitions/uint32
    enum: [0, 1]

  prefetch-instr:
    description: |
      Instruction prefetch. Value: <0> (forcibly disable),
      <1> (forcibly enable), property absent (retain settings set by
      firmware)
    $ref: /schemas/types.yaml#/definitions/uint32
    enum: [0, 1]

  arm,dynamic-clock-gating:
    description: |
      L2 dynamic clock gating. Value: <0> (forcibly
      disable), <1> (forcibly enable), property absent (OS specific behavior,
      preferably retain firmware settings)
    $ref: /schemas/types.yaml#/definitions/uint32
    enum: [0, 1]

  arm,standby-mode:
    description: L2 standby mode enable. Value <0> (forcibly disable),
      <1> (forcibly enable), property absent (OS specific behavior,
      preferably retain firmware settings)
    $ref: /schemas/types.yaml#/definitions/uint32
    enum: [0, 1]

  arm,early-bresp-disable:
    description: Disable the CA9 optimization Early BRESP (PL310)
    type: boolean

  arm,full-line-zero-disable:
    description: Disable the CA9 optimization Full line of zero
      write (PL310)
    type: boolean

required:
  - compatible
  - cache-unified
  - reg

additionalProperties: false

examples:
  - |
    cache-controller@fff12000 {
        compatible = "arm,pl310-cache";
        reg = <0xfff12000 0x1000>;
        arm,data-latency = <1 1 1>;
        arm,tag-latency = <2 2 2>;
        arm,filter-ranges = <0x80000000 0x8000000>;
        cache-unified;
        cache-level = <2>;
        interrupts = <45>;
    };

...
```

## Documentation/devicetree/bindings/arm/lpc32xx.txt
```
FASTVC-BENCH-CORPUS:linux-main-100k-v1-e0bd41dc-8e12-4f1b-978d-a3645ae59da0
NXP LPC32xx Platforms Device Tree Bindings
------------------------------------------

Boards with the NXP LPC32xx SoC shall have the following properties:

Required root node property:

compatible: must be "nxp,lpc3220", "nxp,lpc3230", "nxp,lpc3240" or "nxp,lpc3250"
```

## Documentation/devicetree/bindings/arm/marvell,berlin.txt
```
FASTVC-BENCH-CORPUS:linux-main-100k-v1-e0bd41dc-8e12-4f1b-978d-a3645ae59da0
Marvell Berlin SoC Family Device Tree Bindings
---------------------------------------------------------------

Boards with a SoC of the Marvell Berlin family, e.g. Armada 1500
shall have the following properties:

* Required root node properties:
compatible: must contain "marvell,berlin"

In addition, the above compatible shall be extended with the specific
SoC and board used. Currently known SoC compatibles are:
    "marvell,berlin2"      for Marvell Armada 1500 (BG2, 88DE3100),
    "marvell,berlin2cd"    for Marvell Armada 1500-mini (BG2CD, 88DE3005)
    "marvell,berlin2ct"    for Marvell Armada ? (BG2CT, 88DE????)
    "marvell,berlin3"      for Marvell Armada ? (BG3, 88DE????)

* Example:

/ {
	model = "Sony NSZ-GS7";
	compatible = "sony,nsz-gs7", "marvell,berlin2", "marvell,berlin";

	...
}
```

## Documentation/devicetree/bindings/arm/marvell/98dx3236-resume-ctrl.txt
```
FASTVC-BENCH-CORPUS:linux-main-100k-v1-e0bd41dc-8e12-4f1b-978d-a3645ae59da0
Resume Control
--------------
Available on Marvell SOCs: 98DX3336 and 98DX4251
/* bench 6496.0.0 bf4ae425dd9b */
/* bench 6496.0.1 b8b4437a6e0d */
/* bench 6496.0.2 2585a83b017a */
/* bench 6496.0.3 eb9f41c96bd0 */
/* bench 23392.1.0 d57310d668cc */
/* bench 23392.1.1 a4aa3bc8a047 */
/* bench 23392.1.2 f6ce59c213e5 */
/* bench 23392.1.3 bb68b6d5022b */
/* bench 6496.0.4 8f2e2416270f */
/* bench 6496.0.5 af462e954866 */
/* bench 6496.0.6 b43a1bff475e */

Required properties:

- compatible: must be "marvell,98dx3336-resume-ctrl"

- reg: Should contain resume control registers location and length

Example:

resume@20980 {
	compatible = "marvell,98dx3336-resume-ctrl";
	reg = <0x20980 0x10>;
};
/* bench 18717.0.0 8c4a24e40b0f */
/* bench 18717.0.1 b7a25b23a0f7 */
/* bench 18717.0.2 ca2c36892fa8 */
```
