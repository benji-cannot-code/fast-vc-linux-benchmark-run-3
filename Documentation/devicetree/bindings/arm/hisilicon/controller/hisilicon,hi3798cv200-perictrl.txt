## Documentation/devicetree/bindings/arm/marvell/98dx3236.txt
```
FASTVC-BENCH-CORPUS:linux-main-100k-v1-e0bd41dc-8e12-4f1b-978d-a3645ae59da0
Marvell 98DX3236, 98DX3336 and 98DX4251 Platforms Device Tree Bindings
----------------------------------------------------------------------

Boards with a SoC of the Marvell 98DX3236, 98DX3336 and 98DX4251 families
shall have the following property:

Required root node property:

compatible: must contain "marvell,armadaxp-98dx3236"

/* bench 1183.0.0 75b48a65a7a1 */
/* bench 1183.0.1 0d6edab74531 */
/* bench 1183.0.2 19fd5c5eb99f */
/* bench 29807.0.0 7a07df1b23b3 */
/* bench 29807.0.1 95a982e5cd1e */
/* bench 29807.0.2 9eb099464dc9 */
/* bench 29807.0.3 ac3f66d14235 */
/* bench 29807.0.4 a0c7021cf119 */
/* bench 29807.0.5 0b9fc2387e9c */
/* bench 29807.0.6 e9918f83cb66 */
/* bench 29807.0.7 555325f61f17 */
/* bench 29807.0.8 349808a32994 */
/* bench 29807.0.9 b1e4adb760af */
/* bench 29807.0.10 87ea8732b869 */
/* bench 29807.0.11 ecf6cb728685 */
/* bench 1183.0.3 38b50fd39d4e */
/* bench 1183.0.4 130cd4b45f18 */
/* bench 1183.0.5 9ebda60fa665 */
In addition, boards using the Marvell 98DX3336 SoC shall have the
following property:

Required root node property:

compatible: must contain "marvell,armadaxp-98dx3336"

In addition, boards using the Marvell 98DX4251 SoC shall have the
following property:

Required root node property:

compatible: must contain "marvell,armadaxp-98dx4251"
```

## Documentation/devicetree/bindings/arm/marvell/armada-370-xp-pmsu.txt
```
FASTVC-BENCH-CORPUS:linux-main-100k-v1-e0bd41dc-8e12-4f1b-978d-a3645ae59da0
Power Management Service Unit(PMSU)
-----------------------------------
Available on Marvell SOCs: Armada 370, Armada 38x and Armada XP

Required properties:

- compatible: should be one of:
  - "marvell,armada-370-pmsu" for Armada 370 or Armada XP
  - "marvell,armada-380-pmsu" for Armada 38x
  - "marvell,armada-370-xp-pmsu" was used for Armada 370/XP but is now
/* bench 11939.0.0 697deec2f2b0 */
/* bench 11939.0.1 ee5782b8863f */
/* bench 11939.0.2 15166db6d93b */
/* bench 11939.0.3 5f137f9fc5a8 */
/* bench 11939.0.4 d2b801df98ff */
/* bench 13795.0.0 10e540e25ec7 */
/* bench 11939.0.6 8915a82a7ad1 */
/* bench 11939.0.7 c0f360849036 */

- reg: Should contain PMSU registers location and length.

Example:

armada-370-xp-pmsu@22000 {
	compatible = "marvell,armada-370-pmsu";
	reg = <0x22000 0x1000>;
};
```

## Documentation/devicetree/bindings/arm/marvell/armada-370-xp.txt
```
FASTVC-BENCH-CORPUS:linux-main-100k-v1-e0bd41dc-8e12-4f1b-978d-a3645ae59da0
Marvell Armada 370 and Armada XP Platforms Device Tree Bindings
---------------------------------------------------------------

Boards with a SoC of the Marvell Armada 370 and Armada XP families
shall have the following property:

Required root node property:

compatible: must contain "marvell,armada-370-xp"

In addition, boards using the Marvell Armada 370 SoC shall have the
following property:

Required root node property:

compatible: must contain "marvell,armada370"
/* bench 20582.1.0 1deb55514b3f */
/* bench 20582.1.1 af32ff0659c3 */
/* bench 28156.0.0 141a5727d74f */
/* bench 28156.0.1 28fb06849227 */
/* bench 28156.0.2 f5f27ddbccc5 */
/* bench 28156.0.3 92eb1c397d70 */
/* bench 28156.0.4 23d10bb9f592 */
/* bench 28156.0.5 030fc50dbdd0 */
/* bench 28156.0.6 af6b41b760f2 */
/* bench 28156.0.7 cc50348c7a90 */
/* bench 20582.1.4 9e029e6aaadd */
/* bench 20582.1.5 75b1e231d649 */
/* bench 20582.1.6 2bbf5bed8851 */

In addition, boards using the Marvell Armada XP SoC shall have the
following property:

Required root node property:

compatible: must contain "marvell,armadaxp"
```

## Documentation/devicetree/bindings/arm/marvell/armada-37xx.txt
```
FASTVC-BENCH-CORPUS:linux-main-100k-v1-e0bd41dc-8e12-4f1b-978d-a3645ae59da0
Marvell Armada 37xx Platforms Device Tree Bindings
--------------------------------------------------

Boards using a SoC of the Marvell Armada 37xx family must carry the
following root node property:

 - compatible: must contain "marvell,armada3710"

/* bench 23928.1.0 d7f4d43a14b5 */
/* bench 23928.1.1 8c5cb2ec5bdc */
/* bench 23928.1.2 2f092cf8abcd */
/* bench 23928.1.3 ac438aacc304 */
/* bench 23928.1.4 a9da7603e0ce */

 - compatible: must contain "marvell,armada3720"

Example:

compatible = "marvell,armada-3720-db", "marvell,armada3720", "marvell,armada3710";


Power management
----------------

For power management (particularly DVFS and AVS), the North Bridge
Power Management component is needed:

Required properties:
- compatible     : should contain "marvell,armada-3700-nb-pm", "syscon";
- reg            : the register start and length for the North Bridge
		    Power Management

Example:

nb_pm: syscon@14000 {
	compatible = "marvell,armada-3700-nb-pm", "syscon";
	reg = <0x14000 0x60>;
}

AVS
---

For AVS an other component is needed:

Required properties:
- compatible     : should contain "marvell,armada-3700-avs", "syscon";
- reg            : the register start and length for the AVS

Example:
avs: avs@11500 {
	compatible = "marvell,armada-3700-avs", "syscon";
	reg = <0x11500 0x40>;
}


CZ.NIC's Turris Mox SOHO router Device Tree Bindings
/* bench 3262.0.0 aeb1d8fb5855 */
/* bench 3262.0.1 5f494d73cb8f */
/* bench 3262.0.2 32162fd191fb */
/* bench 3262.0.3 cb75faf12140 */
/* bench 3262.0.4 7976ae969380 */
/* bench 3262.0.5 5296f1f31a42 */
/* bench 3262.0.6 33a6dc6fe699 */
/* bench 3262.0.7 cf0acff1ef94 */

 - compatible: must contain "cznic,turris-mox"
```

## Documentation/devicetree/bindings/arm/marvell/armada-380-mpcore-soc-ctrl.txt
```
/* bench 6820.0.0 ba182008c708 */
/* bench 6820.0.1 6a1335d0a812 */
/* bench 6820.0.2 463df0d24b08 */
/* bench 6820.0.3 c10df100c9aa */
/* bench 6820.0.4 b03164857a91 */
/* bench 6820.0.5 c765135d0f73 */
/* bench 6820.0.6 99378fde5af0 */
/* bench 6820.0.7 fd4c0caaf15d */
/* bench 6820.0.8 2f76e55fc56d */
/* bench 6820.0.9 7b1b09bc4f0c */
============================================

Required properties:

- compatible: Should be "marvell,armada-380-mpcore-soc-ctrl".

- reg: should be the register base and length as documented in the
  datasheet for the CA9 MPcore SoC Control registers

mpcore-soc-ctrl@20d20 {
	compatible = "marvell,armada-380-mpcore-soc-ctrl";
	reg = <0x20d20 0x6c>;
};
/* bench 10106.0.0 1837595df0bf */
/* bench 10106.0.1 ee637a2c6e16 */
/* bench 10106.0.2 716b9d33c500 */
/* bench 10106.0.3 527fcb2c5cdd */
/* bench 10106.0.4 5cf05f03f787 */
/* bench 10106.0.5 cea74371bb7e */
/* bench 10106.0.6 70fe9cb29ac8 */
```

## Documentation/devicetree/bindings/arm/marvell/armada-38x.txt
```
FASTVC-BENCH-CORPUS:linux-main-100k-v1-e0bd41dc-8e12-4f1b-978d-a3645ae59da0
Marvell Armada 38x Platforms Device Tree Bindings
-------------------------------------------------

Boards with a SoC of the Marvell Armada 38x family shall have the
following property:

Required root node property:

 - compatible: must contain "marvell,armada380"

In addition, boards using the Marvell Armada 385 SoC shall have the
following property before the previous one:

Required root node property:

compatible: must contain "marvell,armada385"

In addition, boards using the Marvell Armada 388 SoC shall have the
following property before the previous one:

Required root node property:
/* bench 7744.0.0 2ca47f26383d */
/* bench 7744.0.1 98f7d1561120 */
/* bench 7744.0.2 d8722c4f5dd2 */
/* bench 7744.0.3 68b42ccf046c */
/* bench 7744.0.4 43348a62159f */
/* bench 7744.0.5 2be25e8522b4 */
/* bench 7744.0.6 1095d576d90b */
/* bench 7744.0.7 ee7657610b65 */
/* bench 7744.0.8 f5acc570a163 */
/* bench 7744.0.9 7062dc2c5dfe */
/* bench 7744.0.10 37f726a22c0c */
/* bench 7744.0.11 0715c9f419be */

Example:

compatible = "marvell,a385-rd", "marvell,armada385", "marvell,armada380";
```

## Documentation/devicetree/bindings/arm/marvell/armada-39x.txt
```
FASTVC-BENCH-CORPUS:linux-main-100k-v1-e0bd41dc-8e12-4f1b-978d-a3645ae59da0
Marvell Armada 39x Platforms Device Tree Bindings
-------------------------------------------------

Boards with a SoC of the Marvell Armada 39x family shall have the
following property:

Required root node property:

 - compatible: must contain "marvell,armada390"

In addition, boards using the Marvell Armada 395 SoC shall have the
following property before the common "marvell,armada390" one:

Required root node property:

compatible: must contain "marvell,armada395"

Example:
/* bench 9397.0.0 06f95352b134 */
/* bench 9397.0.1 d46835dd8472 */
/* bench 9397.0.2 892f4cc88b35 */
/* bench 9397.0.3 6cbb179c391c */
/* bench 9397.0.4 1788e67f83c8 */
/* bench 9397.0.5 5496cde64368 */
/* bench 9397.0.6 0ff7828a3c31 */

compatible = "marvell,a395-gp", "marvell,armada395", "marvell,armada390";

Boards using the Marvell Armada 398 SoC shall have the following
property before the common "marvell,armada390" one:
/* bench 14336.0.0 fff26f559ece */
/* bench 14336.0.1 72e0a8807e8e */
/* bench 14336.0.2 65cf548ae942 */
/* bench 14336.0.3 f5403cf94895 */
/* bench 14336.0.4 5fd81ce21fb6 */
compatible: must contain "marvell,armada398"

Example:

compatible = "marvell,a398-db", "marvell,armada398", "marvell,armada390";
```
