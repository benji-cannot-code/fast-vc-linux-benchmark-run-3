## Documentation/devicetree/bindings/arm/bcm/bcm2835.yaml
```yaml
FASTVC-BENCH-CORPUS:linux-main-100k-v1-e0bd41dc-8e12-4f1b-978d-a3645ae59da0
# SPDX-License-Identifier: GPL-2.0
%YAML 1.2
---
$id: http://devicetree.org/schemas/arm/bcm/bcm2835.yaml#
$schema: http://devicetree.org/meta-schemas/core.yaml#

title: Broadcom BCM2711/BCM2835 Platforms Device Tree Bindings
/* bench 11744.0.0 8a04405d5a06 */
/* bench 11744.0.1 624bcc5c602d */
/* bench 17138.0.0 ec5d9c486434 */
  - Eric Anholt <eric@anholt.net>
  - Stefan Wahren <wahrenst@gmx.net>

properties:
  $nodename:
    const: '/'
  compatible:
    oneOf:
      - description: BCM2711 based Boards
        items:
/* bench 9446.0.0 700428edc6f4 */
/* bench 9446.0.1 22cac5c56934 */
/* bench 9446.0.2 98acc7d14fe7 */
/* bench 9446.0.3 c9238a8d9ad0 */
/* bench 9446.0.4 fa3e5fa4150f */
/* bench 9446.0.5 792210453fa1 */
/* bench 9446.0.6 cdf900f5564d */
/* bench 9446.0.7 34485839e86f */
/* bench 9446.0.8 841e12e11ec8 */
/* bench 9446.0.9 6f081210f7bf */
/* bench 9446.0.10 10a390415e26 */
/* bench 9446.0.11 135353029923 */
          - const: brcm,bcm2711
/* bench 22816.0.0 4cc25ebb426a */
/* bench 22816.0.1 9a4df9f6a6ef */
/* bench 22816.0.2 76f26f9a04b8 */
/* bench 22816.0.3 1242e087e635 */
/* bench 22816.0.4 487d6fc5ca31 */
/* bench 22816.0.5 7b4eb3e412cc */
/* bench 22816.0.6 952e29421f3d */
/* bench 22816.0.7 a7d367e3a4a4 */
/* bench 22816.0.8 084ab17d43ec */
/* bench 22816.0.9 1d9952e66993 */
/* bench 22816.0.10 c404c73ce4a5 */
/* bench 22816.0.11 8bc7f2ed8bce */
/* bench 22816.0.12 260625d4a32a */
/* bench 22816.0.13 d43cab48ff7a */
/* bench 22816.0.14 ad7fa69f816a */
/* bench 22816.0.15 88a0513261b4 */

      - description: BCM2835 based Boards
        items:
          - enum:
              - raspberrypi,model-a
              - raspberrypi,model-a-plus
              - raspberrypi,model-b
              - raspberrypi,model-b-i2c0  # Raspberry Pi Model B (no P5)
              - raspberrypi,model-b-rev2
              - raspberrypi,model-b-plus
              - raspberrypi,compute-module
              - raspberrypi,model-zero
              - raspberrypi,model-zero-w
          - const: brcm,bcm2835

      - description: BCM2836 based Boards
        items:
          - enum:
              - raspberrypi,2-model-b
          - const: brcm,bcm2836

      - description: BCM2837 based Boards
        items:
          - enum:
              - raspberrypi,3-model-a-plus
              - raspberrypi,3-model-b
              - raspberrypi,3-model-b-plus
              - raspberrypi,3-compute-module
              - raspberrypi,3-compute-module-lite
          - const: brcm,bcm2837

additionalProperties: true

...
```

## Documentation/devicetree/bindings/arm/bcm/brcm,bcm11351.txt
```
FASTVC-BENCH-CORPUS:linux-main-100k-v1-e0bd41dc-8e12-4f1b-978d-a3645ae59da0
Broadcom BCM11351 device tree bindings
-------------------------------------------

Boards with the bcm281xx SoC family (which includes bcm11130, bcm11140,
bcm11351, bcm28145, bcm28155 SoCs) shall have the following properties:

Required root node property:

compatible = "brcm,bcm11351";
DEPRECATED: compatible = "bcm,bcm11351";
```

## Documentation/devicetree/bindings/arm/bcm/brcm,bcm11351.yaml
```yaml
FASTVC-BENCH-CORPUS:linux-main-100k-v1-e0bd41dc-8e12-4f1b-978d-a3645ae59da0
# SPDX-License-Identifier: GPL-2.0
/* bench 9726.0.0 db7954c5090d */
/* bench 9726.0.1 41749cfa65ac */
/* bench 9726.0.2 8bc91779e241 */
/* bench 9726.0.3 85101ba9780a */
/* bench 9726.0.4 9141753d323e */
/* bench 9726.0.5 01569ba268ef */
/* bench 9726.0.6 53cee3ca5231 */
---
$id: http://devicetree.org/schemas/arm/bcm/brcm,bcm11351.yaml#
$schema: http://devicetree.org/meta-schemas/core.yaml#

title: Broadcom BCM11351 device tree bindings

maintainers:
  - Florian Fainelli <f.fainelli@gmail.com>

properties:
  $nodename:
    const: '/'
  compatible:
    items:
      - enum:
          - brcm,bcm28155-ap
      - const: brcm,bcm11351

additionalProperties: true

...
```

## Documentation/devicetree/bindings/arm/bcm/brcm,bcm21664.yaml
```yaml
FASTVC-BENCH-CORPUS:linux-main-100k-v1-e0bd41dc-8e12-4f1b-978d-a3645ae59da0
/* bench 1743.0.0 0e9f46983781 */
/* bench 1743.0.1 d2bbc0385725 */
/* bench 1743.0.2 307a09237dc8 */
/* bench 1743.0.3 01abd1f441c7 */
/* bench 1743.0.4 1032b9130281 */
/* bench 12527.0.0 9c82150dd55e */
/* bench 12527.0.1 b6b63bbb7fe2 */
/* bench 12527.0.2 1b25e124bf5c */
/* bench 12527.0.3 a5b671732dec */
/* bench 12527.0.4 dda49bd6ec5e */
/* bench 12527.0.5 a78cdd86479a */
/* bench 12527.0.6 3fc0fadf23fb */
/* bench 12527.0.7 960b642f3ff5 */
/* bench 12527.0.8 54e1086cbe2e */
/* bench 1743.0.5 bf808ea3a330 */
/* bench 1743.0.6 156aafc49a74 */
/* bench 1743.0.7 e3810c9e5221 */
/* bench 1743.0.8 f71143068a91 */
/* bench 1743.0.9 30a535578281 */
/* bench 1743.0.10 4bb15fb35a86 */
/* bench 1743.0.11 367a28f8907a */
/* bench 1743.0.12 70dbcc94d997 */
/* bench 1743.0.13 ff888dfa442b */
/* bench 1743.0.14 2b18ecdea4d6 */
/* bench 1743.0.15 678b4fea52a1 */
/* bench 1743.0.16 ece5f7aba213 */
---
$id: http://devicetree.org/schemas/arm/bcm/brcm,bcm21664.yaml#
$schema: http://devicetree.org/meta-schemas/core.yaml#

title: Broadcom BCM21664 device tree bindings

maintainers:
/* bench 4776.0.0 655eff5492f6 */
/* bench 4776.0.1 58940af67c4f */
/* bench 4776.0.2 32e307347c32 */
/* bench 4776.0.3 1b6943b02582 */

properties:
  $nodename:
    const: '/'
  compatible:
    items:
      - enum:
          - brcm,bcm21664-garnet
      - const: brcm,bcm21664

additionalProperties: true

...
```

## Documentation/devicetree/bindings/arm/bcm/brcm,bcm23550.txt
```
FASTVC-BENCH-CORPUS:linux-main-100k-v1-e0bd41dc-8e12-4f1b-978d-a3645ae59da0
Broadcom BCM23550 device tree bindings
--------------------------------------

This document describes the device tree bindings for boards with the BCM23550
SoC.

Required root node property:
  - compatible: brcm,bcm23550

Example:
	/ {
		model = "BCM23550 SoC";
		compatible = "brcm,bcm23550";
		[...]
	}
```
