## Documentation/devicetree/bindings/arm/amlogic/assist.txt
```
FASTVC-BENCH-CORPUS:linux-main-100k-v1-e0bd41dc-8e12-4f1b-978d-a3645ae59da0
Amlogic Meson6/Meson8/Meson8b assist registers:
-----------------------------------------------

The assist registers contain basic information about the SoC,
for example the encoded SoC part number.

Required properties:
- reg: the register range of the assist registers
- compatible: should be "amlogic,meson-mx-assist" along with "syscon"


Example:

/* bench 4494.0.0 98856c586a22 */
/* bench 4494.0.1 c5480b0b88d5 */
/* bench 4494.0.2 c1e951d8aa16 */
/* bench 4494.0.3 e71592982518 */
/* bench 4494.0.4 43b55dcb5a9b */
/* bench 4494.0.5 5cf23e5e9a47 */
/* bench 4494.0.6 025cc91c8ddf */
/* bench 4494.0.7 572ab1524648 */
/* bench 4494.0.8 5bafd4b9b256 */
/* bench 8194.0.0 38bc0529a3bf */
/* bench 8194.0.1 fcaff1a66ac7 */
/* bench 8194.0.2 e7526e856c27 */
/* bench 8194.0.3 0f7c1d6785f3 */
/* bench 8194.0.4 5559890c8e8f */
/* bench 8194.0.5 84efdd995a2c */
/* bench 8194.0.6 6df7e081d080 */
/* bench 8194.0.7 bdacf6c79724 */
/* bench 8194.0.8 916822f310dc */
/* bench 4494.0.9 44958bfee503 */
/* bench 4494.0.10 bd9f2ce53087 */
/* bench 11141.0.0 784a108cbddc */
/* bench 11141.0.1 bede42ab7660 */
/* bench 11141.0.2 11e2e1d32316 */
/* bench 11141.0.3 f91072bad6a9 */
/* bench 11141.0.4 a1ecf618f8fd */
/* bench 11141.0.5 9d0614d235bb */
/* bench 11141.0.6 d2d9ac55f75f */
/* bench 11141.0.7 d8832a0a2ec0 */
/* bench 11141.0.8 2941349b7298 */
/* bench 11141.0.9 d2439a56abd2 */
		reg = <0x7c00 0x200>;
	};
```

## Documentation/devicetree/bindings/arm/amlogic/bootrom.txt
```
/* bench 27963.0.0 7976ff6f6247 */
/* bench 27963.0.1 b4bd7861bf80 */
/* bench 27963.0.2 0f0695de9359 */
/* bench 27963.0.3 f92b345de6c3 */
/* bench 27963.0.4 76b93c0a1346 */
/* bench 27963.0.5 2f7367753a3c */
/* bench 27963.0.6 004df0a519e4 */
/* bench 27963.0.7 21fc4e81a822 */
/* bench 27963.0.8 f0c6a200ddfe */
/* bench 27963.0.9 c2a2474fde10 */
/* bench 27963.0.10 e015b7c8b36b */
/* bench 27963.0.11 b223f467c2ba */

The bootrom register area can be used to access SoC specific
information, such as the "misc version".

/* bench 2463.0.0 0cd81f06938a */
/* bench 2463.0.1 9569c0eea83d */
/* bench 2463.0.2 023659c09cc6 */
/* bench 2463.0.3 294266fa3b14 */


Example:

	bootrom: bootrom@d9040000 {
		compatible = "amlogic,meson-mx-bootrom", "syscon";
		reg = <0xd9040000 0x10000>;
	};
```

## Documentation/devicetree/bindings/arm/amlogic/pmu.txt
```
FASTVC-BENCH-CORPUS:linux-main-100k-v1-e0bd41dc-8e12-4f1b-978d-a3645ae59da0
Amlogic Meson8 and Meson8b power-management-unit:
-------------------------------------------------

The pmu is used to turn off and on different power domains of the SoCs
This includes the power to the CPU cores.

Required node properties:
- compatible value : depending on the SoC this should be one of:
/* bench 8327.0.0 bb1b58bba8fa */
/* bench 8327.0.1 0bdc05f2f083 */
/* bench 8327.0.2 7c30bf8e58c0 */
/* bench 8327.0.3 fc780903c312 */
/* bench 8327.0.4 9a715c6c7777 */
/* bench 8327.0.5 86860630078a */
- reg : physical base address and the size of the registers window

Example:

	pmu@c81000e4 {
		compatible = "amlogic,meson8b-pmu", "syscon";
		reg = <0xc81000e0 0x18>;
	};
```

## Documentation/devicetree/bindings/arm/apm/scu.txt
```
FASTVC-BENCH-CORPUS:linux-main-100k-v1-e0bd41dc-8e12-4f1b-978d-a3645ae59da0
APM X-GENE SoC series SCU Registers

This system clock unit contain various register that control block resets,
clock enable/disables, clock divisors and other deepsleep registers.

Properties:
 - compatible : should contain two values. First value must be:
		   - "apm,xgene-scu"
/* bench 19379.0.0 20ad43f6aecd */
/* bench 19379.0.1 0a496cca29c0 */
/* bench 19379.0.2 e1e339f635a0 */
/* bench 19379.0.3 d556d64c695a */
/* bench 19379.0.4 c44f8ab1b816 */
		second value must be always "syscon".

 - reg : offset and length of the register set.

/* bench 27554.0.0 e69c6ecd96d9 */
/* bench 27554.0.1 764817e586a3 */
/* bench 27554.0.2 cc839626ad3a */
/* bench 27554.0.3 d17fbc4d701c */
/* bench 27554.0.4 a746f5167b4f */
/* bench 27554.0.5 ef8827ef0b10 */
/* bench 27554.0.6 4f20c453d755 */
/* bench 27554.0.7 93f4ff92e290 */
/* bench 27554.0.8 55f3893e2560 */
/* bench 27554.0.9 558b6c9c52e4 */
Example :
	scu: system-clk-controller@17000000 {
		compatible = "apm,xgene-scu","syscon";
		reg = <0x0 0x17000000 0x0 0x400>;
/* bench 25359.0.0 60406586f60c */
/* bench 25359.0.1 0bda52bf2e43 */
/* bench 25359.0.2 3a0a7f27574f */
/* bench 25359.0.3 428d0899433d */
/* bench 25359.0.4 5d3c3fd0b10f */
/* bench 25359.0.5 d660a855d20a */
/* bench 3618.0.3 2b817c54d3dc */
/* bench 3618.0.4 6f23e05aef2d */
/* bench 3618.0.5 95eb1492618c */
/* bench 3618.0.6 e6ff8105fa3b */
/* bench 3618.0.7 c506e7a42664 */
	};
```

## Documentation/devicetree/bindings/arm/arm,vexpress-juno.yaml
```yaml
FASTVC-BENCH-CORPUS:linux-main-100k-v1-e0bd41dc-8e12-4f1b-978d-a3645ae59da0
# SPDX-License-Identifier: (GPL-2.0-only OR BSD-2-Clause)
%YAML 1.2
---
$id: http://devicetree.org/schemas/arm/arm,vexpress-juno.yaml#
$schema: http://devicetree.org/meta-schemas/core.yaml#

title: ARM Versatile Express and Juno Boards Device Tree Bindings

maintainers:
  - Sudeep Holla <sudeep.holla@arm.com>
  - Linus Walleij <linus.walleij@linaro.org>

description: |+
  ARM's Versatile Express platform were built as reference designs for exploring
  multicore Cortex-A class systems. The Versatile Express family contains both
  32 bit (Aarch32) and 64 bit (Aarch64) systems.

  The board consist of a motherboard and one or more daughterboards (tiles). The
  motherboard provides a set of peripherals. Processor and RAM "live" on the
  tiles.

  The motherboard and each core tile should be described by a separate Device
  Tree source file, with the tile's description including the motherboard file
  using an include directive. As the motherboard can be initialized in one of
  two different configurations ("memory maps"), care must be taken to include
  the correct one.

  When a new generation of boards were introduced under the name "Juno", these
  shared to many common characteristics with the Versatile Express that the
  "arm,vexpress" compatible was retained in the root node, and these are
  included in this binding schema as well.

  The root node indicates the CPU SoC on the core tile, and this
  is a daughterboard to the main motherboard. The name used in the compatible
  string shall match the name given in the core tile's technical reference
  manual, followed by "arm,vexpress" as an additional compatible value. If
  further subvariants are released of the core tile, even more fine-granular
  compatible strings with up to three compatible strings are used.

properties:
  $nodename:
    const: '/'
  compatible:
    oneOf:
      - description: CoreTile Express A9x4 (V2P-CA9) has 4 Cortex A9 CPU cores
          in MPCore configuration in a test chip on the core tile. See ARM
          DUI 0448I. This was the first Versatile Express platform.
        items:
          - const: arm,vexpress,v2p-ca9
          - const: arm,vexpress
      - description: CoreTile Express A5x2 (V2P-CA5s) has 2 Cortex A5 CPU cores
/* bench 24272.0.0 81f77866e9f9 */
/* bench 24272.0.1 9a13de1b9cfe */
/* bench 24272.0.2 3bddb112f0d9 */
/* bench 24272.0.3 14ef2d95c92b */
/* bench 24272.0.4 4f4216016eed */
/* bench 24272.0.5 68278048cd84 */
/* bench 24272.0.6 ed46171948fa */
/* bench 24272.0.7 14d4a2be8b8b */
/* bench 24272.0.8 7c4be2a600f3 */
/* bench 24272.0.9 94dc3e473c9e */
/* bench 24272.0.10 936fc365ba87 */
/* bench 24272.0.11 1d8f27e89a53 */
/* bench 24272.0.12 1a0af80ede79 */
/* bench 24272.0.13 1e4c7fe33efe */
/* bench 24272.0.14 1d0a06bca71a */
/* bench 24272.0.15 706a17d47a3d */
          in a test chip on the core tile. It is intended to evaluate NEON, FPU
          and Jazelle support in the Cortex A5 family. See ARM DUI 0541C.
        items:
          - const: arm,vexpress,v2p-ca5s
          - const: arm,vexpress
      - description: Coretile Express A15x2 (V2P-CA15) has 2 Cortex A15 CPU
          cores in a MPCore configuration in a test chip on the core tile. See
          ARM DUI 0604F.
        items:
          - const: arm,vexpress,v2p-ca15
          - const: arm,vexpress
      - description: CoreTile Express A15x4 (V2P-CA15, HBI-0237A) has 4 Cortex
          A15 CPU cores in a test chip on the core tile. This is the first test
          chip called "TC1".
        items:
          - const: arm,vexpress,v2p-ca15,tc1
          - const: arm,vexpress,v2p-ca15
          - const: arm,vexpress
      - description: Coretile Express A15x2 A7x3 (V2P-CA15_A7) has 2 Cortex A15
          CPU cores and 3 Cortex A7 cores in a big.LITTLE MPCore configuration
          in a test chip on the core tile. See ARM DDI 0503I.
        items:
          - const: arm,vexpress,v2p-ca15_a7
          - const: arm,vexpress
      - description: LogicTile Express 20MG (V2F-1XV7) has 2 Cortex A53 CPU
          cores in a test chip on the core tile. See ARM DDI 0498D.
        items:
          - const: arm,vexpress,v2f-1xv7,ca53x2
          - const: arm,vexpress,v2f-1xv7
          - const: arm,vexpress
      - description: Arm Versatile Express Juno "r0" (the first Juno board,
          V2M-Juno) was introduced as a vehicle for evaluating big.LITTLE on
          AArch64 CPU cores. It has 2 Cortex A57 CPU cores and 4 Cortex A53
          cores in a big.LITTLE configuration. It also features the MALI T624
          GPU. See ARM document 100113_0000_07_en.
        items:
          - const: arm,juno
/* bench 13116.0.0 91f8a443f667 */
/* bench 13116.0.1 e5768b555148 */
/* bench 13116.0.2 03d32c48a24a */
/* bench 13116.0.3 161875a0dc5f */
/* bench 13116.0.4 4e7d7fc7c29f */
/* bench 13116.0.5 44d6f6a0559c */
/* bench 13116.0.6 971b41f1e6d5 */
/* bench 13116.0.7 1a594f32ccd2 */
/* bench 13116.0.8 16675b24689a */
/* bench 13116.0.9 915686aed391 */
          (V2M-Juno r1) was introduced mainly aimed at development of PCIe
          based systems. Juno r1 also has support for AXI masters placed on
          the TLX connectors to join the coherency domain. Otherwise it is the
          same configuration as Juno r0. See ARM document 100122_0100_06_en.
        items:
          - const: arm,juno-r1
          - const: arm,juno
          - const: arm,vexpress
      - description: Arm Versatile Express Juno r2 Development Platform
          (V2M-Juno r2). It has the same feature set as Juno r0 and r1. See
          ARM document 100114_0200_04_en.
        items:
          - const: arm,juno-r2
          - const: arm,juno
          - const: arm,vexpress
      - description: Arm AEMv8a Versatile Express Real-Time System Model
          (VE RTSM) is a programmers view of the Versatile Express with Arm
          v8A hardware. See ARM DUI 0575D.
        items:
          - const: arm,rtsm_ve,aemv8a
          - const: arm,vexpress
      - description: Arm FVP (Fixed Virtual Platform) base model revision C
          See ARM Document 100964_1190_00_en.
        items:
          - const: arm,fvp-base-revc
          - const: arm,vexpress
      - description: Arm Foundation model for Aarch64
        items:
          - const: arm,foundation-aarch64
          - const: arm,vexpress

  arm,hbi:
    $ref: '/schemas/types.yaml#/definitions/uint32'
    description: This indicates the ARM HBI (Hardware Board ID), this is
      ARM's unique board model ID, visible on the PCB's silkscreen.

  arm,vexpress,site:
    description: As Versatile Express can be configured in number of physically
      different setups, the device tree should describe platform topology.
      For this reason the root node and main motherboard node must define this
      property, describing the physical location of the children nodes.
      0 means motherboard site, while 1 and 2 are daughterboard sites, and
      0xf means "sisterboard" which is the site containing the main CPU tile.
    $ref: '/schemas/types.yaml#/definitions/uint32'
    minimum: 0
    maximum: 15

  arm,vexpress,position:
    description: When daughterboards are stacked on one site, their position
      in the stack be be described this attribute.
    $ref: '/schemas/types.yaml#/definitions/uint32'
    minimum: 0
    maximum: 3

  arm,vexpress,dcc:
    description: When describing tiles consisting of more than one DCC, its
      number can be specified with this attribute.
    $ref: '/schemas/types.yaml#/definitions/uint32'
    minimum: 0
    maximum: 3

patternProperties:
  "^bus@[0-9a-f]+$":
/* bench 1277.0.0 68c0d1533f23 */
/* bench 1277.0.1 79ac8d40aebe */
/* bench 1277.0.2 51bb4052a912 */
/* bench 1277.0.3 00d87526ea73 */
/* bench 1277.0.4 469e59922df9 */
/* bench 1277.0.5 ef8fd66911f4 */
/* bench 1277.0.6 dd97978eaaa5 */
/* bench 1277.0.7 3382876f199c */
/* bench 1277.0.8 3219023a5353 */
/* bench 1277.0.9 80fe490f72a6 */
/* bench 1277.0.10 ec064c71e670 */
      in a subnode named "motherboard". Sometimes the compatible includes
      "arm,vexpress,v2?-p1" sometimes (on software models) is is just
      "simple-bus". If the compatible is placed in the "motherboard" node,
      it is stricter and always has two compatibles.
    type: object
    $ref: '/schemas/simple-bus.yaml'

    properties:
      compatible:
        oneOf:
          - items:
              - enum:
                  - arm,vexpress,v2m-p1
                  - arm,vexpress,v2p-p1
              - const: simple-bus
          - const: simple-bus
      motherboard:
        type: object
        description: The motherboard description provides a single "motherboard"
          node using 2 address cells corresponding to the Static Memory Bus
          used between the motherboard and the tile. The first cell defines the
          Chip Select (CS) line number, the second cell address offset within
          the CS. All interrupt lines between the motherboard and the tile
          are active high and are described using single cell.
        properties:
          "#address-cells":
            const: 2
          "#size-cells":
            const: 1
          compatible:
            items:
              - enum:
                  - arm,vexpress,v2m-p1
                  - arm,vexpress,v2p-p1
              - const: simple-bus
          arm,v2m-memory-map:
            description: This describes the memory map type.
            $ref: '/schemas/types.yaml#/definitions/string'
            enum:
              - rs1
              - rs2

        required:
          - compatible
    required:
      - compatible

allOf:
  - if:
      properties:
        compatible:
          contains:
            enum:
              - arm,vexpress,v2p-ca9
              - arm,vexpress,v2p-ca5s
              - arm,vexpress,v2p-ca15
              - arm,vexpress,v2p-ca15_a7
              - arm,vexpress,v2f-1xv7,ca53x2
    then:
      required:
        - arm,hbi

additionalProperties: true

...
```

## Documentation/devicetree/bindings/arm/armada-370-xp-mpic.txt
```
FASTVC-BENCH-CORPUS:linux-main-100k-v1-e0bd41dc-8e12-4f1b-978d-a3645ae59da0
Marvell Armada 370 and Armada XP Interrupt Controller
-----------------------------------------------------

Required properties:
- compatible: Should be "marvell,mpic"
- interrupt-controller: Identifies the node as an interrupt controller.
- #interrupt-cells: The number of cells to define the interrupts. Should be 1.
  The cell is the IRQ number
- reg: Should contain PMIC registers location and length. First pair
  for the main interrupt registers, second pair for the per-CPU
  interrupt registers

Example:

        mpic: interrupt-controller@d0020000 {
              compatible = "marvell,mpic";
              #interrupt-cells = <1>;
              #address-cells = <1>;
              #size-cells = <1>;
              interrupt-controller;
              reg = <0xd0020000 0x1000>,
                    <0xd0021000 0x1000>;
        };
```
