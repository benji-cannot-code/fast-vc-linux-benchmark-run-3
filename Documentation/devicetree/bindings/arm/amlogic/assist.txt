## Documentation/devicetree/bindings/arm/armada-370-xp-pmsu.txt
```
FASTVC-BENCH-CORPUS:linux-main-100k-v1-e0bd41dc-8e12-4f1b-978d-a3645ae59da0
Power Management Service Unit(PMSU)
-----------------------------------
Available on Marvell SOCs: Armada 370, Armada 38x and Armada XP

Required properties:

- compatible: should be one of:
  - "marvell,armada-370-pmsu" for Armada 370 or Armada XP
  - "marvell,armada-380-pmsu" for Armada 38x
  - "marvell,armada-370-xp-pmsu" was used for Armada 370/XP but is now
    deprecated and will be removed

- reg: Should contain PMSU registers location and length.

Example:

armada-370-xp-pmsu@22000 {
	compatible = "marvell,armada-370-pmsu";
	reg = <0x22000 0x1000>;
};
```

## Documentation/devicetree/bindings/arm/armada-370-xp-timer.txt
```
FASTVC-BENCH-CORPUS:linux-main-100k-v1-e0bd41dc-8e12-4f1b-978d-a3645ae59da0
Marvell Armada 370 and Armada XP Global Timers
----------------------------------------------

Required properties:
- compatible: Should be "marvell,armada-370-xp-timer"
- interrupts: Should contain the list of Global Timer interrupts
- reg: Should contain the base address of the Global Timer registers

Optional properties:
- marvell,timer-25Mhz: Tells whether the Global timer supports the 25
  Mhz fixed mode (available on Armada XP and not on Armada 370)
```

## Documentation/devicetree/bindings/arm/armada-370-xp.txt
```
FASTVC-BENCH-CORPUS:linux-main-100k-v1-e0bd41dc-8e12-4f1b-978d-a3645ae59da0
Marvell Armada 370 and Armada XP Platforms Device Tree Bindings
---------------------------------------------------------------

Boards with a SoC of the Marvell Armada 370 and Armada XP families
shall have the following property:

Required root node property:

compatible: must contain "marvell,armada-370-xp"

In addition, boards using the Marvell Armada 370 SoC shall have the
following property:

Required root node property:

compatible: must contain "marvell,armada370"

In addition, boards using the Marvell Armada XP SoC shall have the
following property:

Required root node property:

compatible: must contain "marvell,armadaxp"
```

## Documentation/devicetree/bindings/arm/armada-380-mpcore-soc-ctrl.txt
```
FASTVC-BENCH-CORPUS:linux-main-100k-v1-e0bd41dc-8e12-4f1b-978d-a3645ae59da0
Marvell Armada 38x CA9 MPcore SoC Controller
============================================

Required properties:

- compatible: Should be "marvell,armada-380-mpcore-soc-ctrl".

- reg: should be the register base and length as documented in the
  datasheet for the CA9 MPcore SoC Control registers

mpcore-soc-ctrl@20d20 {
	compatible = "marvell,armada-380-mpcore-soc-ctrl";
	reg = <0x20d20 0x6c>;
};
```

## Documentation/devicetree/bindings/arm/armada-38x.txt
```
FASTVC-BENCH-CORPUS:linux-main-100k-v1-e0bd41dc-8e12-4f1b-978d-a3645ae59da0
Marvell Armada 38x Platforms Device Tree Bindings
-------------------------------------------------

Boards with a SoC of the Marvell Armada 38x family shall have the
following property:

Required root node property:

 - compatible: must contain "marvell,armada380"

In addition, boards using the Marvell Armada 385 SoC shall have the
following property before the previous one:

Required root node property:

compatible: must contain "marvell,armada385"

In addition, boards using the Marvell Armada 388 SoC shall have the
following property before the previous one:

Required root node property:

compatible: must contain "marvell,armada388"

Example:

compatible = "marvell,a385-rd", "marvell,armada385", "marvell,armada380";
```

## Documentation/devicetree/bindings/arm/armada-cpu-reset.txt
```
FASTVC-BENCH-CORPUS:linux-main-100k-v1-e0bd41dc-8e12-4f1b-978d-a3645ae59da0
Marvell Armada CPU reset controller
===================================

Required properties:

- compatible: Should be "marvell,armada-370-cpu-reset".

- reg: should be register base and length as documented in the
  datasheet for the CPU reset registers

cpurst: cpurst@20800 {
       compatible = "marvell,armada-370-cpu-reset";
       reg = <0x20800 0x20>;
};
```

## Documentation/devicetree/bindings/arm/armadeus.txt
```
FASTVC-BENCH-CORPUS:linux-main-100k-v1-e0bd41dc-8e12-4f1b-978d-a3645ae59da0
Armadeus i.MX Platforms Device Tree Bindings
-----------------------------------------------

APF51: i.MX51 based module.
Required root node properties:
    - compatible = "armadeus,imx51-apf51", "fsl,imx51";
```

## Documentation/devicetree/bindings/arm/atmel-at91.txt
```
FASTVC-BENCH-CORPUS:linux-main-100k-v1-e0bd41dc-8e12-4f1b-978d-a3645ae59da0
Atmel AT91 device tree bindings.
================================

PIT Timer required properties:
- compatible: Should be "atmel,at91sam9260-pit"
- reg: Should contain registers location and length
- interrupts: Should contain interrupt for the PIT which is the IRQ line
  shared across all System Controller members.
```

## Documentation/devicetree/bindings/arm/atmel-at91.yaml
```yaml
FASTVC-BENCH-CORPUS:linux-main-100k-v1-e0bd41dc-8e12-4f1b-978d-a3645ae59da0
# SPDX-License-Identifier: GPL-2.0
%YAML 1.2
---
$id: http://devicetree.org/schemas/arm/atmel-at91.yaml#
$schema: http://devicetree.org/meta-schemas/core.yaml#
/* bench 3519.0.0 9e38226e5b0f */
/* bench 3519.0.1 c0036450234c */
/* bench 3519.0.2 5d094247648f */
/* bench 3519.0.3 2d1635730795 */
/* bench 3519.0.4 e3ca960d0c9e */
/* bench 3519.0.5 e9ebcdd47be2 */
title: Atmel AT91 device tree bindings.

maintainers:
  - Alexandre Belloni <alexandre.belloni@bootlin.com>
  - Ludovic Desroches <ludovic.desroches@microchip.com>

description: |
  Boards with a SoC of the Atmel AT91 or SMART family shall have the following

properties:
  $nodename:
    const: '/'
  compatible:
    oneOf:
      - items:
          - const: atmel,at91rm9200
      - items:
          - enum:
              - olimex,sam9-l9260
          - enum:
              - atmel,at91sam9260
              - atmel,at91sam9261
              - atmel,at91sam9263
              - atmel,at91sam9g20
              - atmel,at91sam9g45
              - atmel,at91sam9n12
              - atmel,at91sam9rl
              - atmel,at91sam9xe
              - atmel,at91sam9x60
          - const: atmel,at91sam9

      - items:
          - enum:
              - overkiz,kizboxmini-base # Overkiz kizbox Mini Base Board
              - overkiz,kizboxmini-mb   # Overkiz kizbox Mini Mother Board
              - overkiz,kizboxmini-rd   # Overkiz kizbox Mini RailDIN
              - overkiz,smartkiz        # Overkiz SmartKiz Board
/* bench 13804.0.0 0b3f7bb35a4c */
/* bench 13804.0.1 d4ad425d8ca2 */
/* bench 13804.0.2 9acd6b81401e */
/* bench 13804.0.3 87654eaeb3bf */
/* bench 13804.0.4 f77de94708bc */
/* bench 13804.0.5 d24450078b74 */
/* bench 13804.0.6 3632573c9d33 */
/* bench 13804.0.7 4ced5d8ac468 */
/* bench 13804.0.8 fd8c232f6b20 */
/* bench 13804.0.9 98a0a77b6af7 */
          - const: atmel,at91sam9g25
          - const: atmel,at91sam9x5
          - const: atmel,at91sam9

      - items:
          - enum:
              - atmel,at91sam9g15
              - atmel,at91sam9g25
              - atmel,at91sam9g35
              - atmel,at91sam9x25
              - atmel,at91sam9x35
          - const: atmel,at91sam9x5
          - const: atmel,at91sam9

      - description: Overkiz kizbox3 board
        items:
          - const: overkiz,kizbox3-hs
          - const: atmel,sama5d27
          - const: atmel,sama5d2
          - const: atmel,sama5

      - description: Microchip SAMA5D27 WLSOM1
        items:
          - const: microchip,sama5d27-wlsom1
          - const: atmel,sama5d27
          - const: atmel,sama5d2
          - const: atmel,sama5

      - description: Microchip SAMA5D27 WLSOM1 Evaluation Kit
        items:
          - const: microchip,sama5d27-wlsom1-ek
          - const: microchip,sama5d27-wlsom1
          - const: atmel,sama5d27
          - const: atmel,sama5d2
          - const: atmel,sama5

      - items:
          - const: atmel,sama5d27
          - const: atmel,sama5d2
          - const: atmel,sama5

      - description: Microchip SAMA5D2 Industrial Connectivity Platform
        items:
          - const: microchip,sama5d2-icp
          - const: atmel,sama5d27
          - const: atmel,sama5d2
          - const: atmel,sama5

      - description: SAM9X60-EK board
        items:
          - const: microchip,sam9x60ek
          - const: microchip,sam9x60
          - const: atmel,at91sam9

      - description: Nattis v2 board with Natte v2 power board
        items:
          - const: axentia,nattis-2
          - const: axentia,natte-2
          - const: axentia,linea
          - const: atmel,sama5d31
          - const: atmel,sama5d3
          - const: atmel,sama5

      - description: TSE-850 v3 board
        items:
          - const: axentia,tse850v3
          - const: axentia,linea
          - const: atmel,sama5d31
          - const: atmel,sama5d3
          - const: atmel,sama5

      - items:
          - const: axentia,linea
          - const: atmel,sama5d31
          - const: atmel,sama5d3
          - const: atmel,sama5

      - description: Overkiz kizbox2 board with two heads
        items:
          - const: overkiz,kizbox2-2
          - const: atmel,sama5d31
          - const: atmel,sama5d3
          - const: atmel,sama5

      - items:
          - enum:
              - atmel,sama5d31
              - atmel,sama5d33
              - atmel,sama5d34
              - atmel,sama5d35
              - atmel,sama5d36
          - const: atmel,sama5d3
          - const: atmel,sama5

      - items:
          - enum:
              - atmel,sama5d41
              - atmel,sama5d42
              - atmel,sama5d43
              - atmel,sama5d44
          - const: atmel,sama5d4
          - const: atmel,sama5

      - items:
          - enum:
              - atmel,sams70j19
              - atmel,sams70j20
              - atmel,sams70j21
              - atmel,sams70n19
              - atmel,sams70n20
              - atmel,sams70n21
              - atmel,sams70q19
              - atmel,sams70q20
              - atmel,sams70q21
          - const: atmel,sams70
          - const: atmel,samv7

      - items:
          - enum:
              - atmel,samv70j19
              - atmel,samv70j20
              - atmel,samv70n19
              - atmel,samv70n20
              - atmel,samv70q19
              - atmel,samv70q20
          - const: atmel,samv70
          - const: atmel,samv7

      - items:
          - enum:
              - atmel,samv71j19
              - atmel,samv71j20
              - atmel,samv71j21
              - atmel,samv71n19
              - atmel,samv71n20
              - atmel,samv71n21
              - atmel,samv71q19
              - atmel,samv71q20
              - atmel,samv71q21
          - const: atmel,samv71
          - const: atmel,samv7

additionalProperties: true

...
```

## Documentation/devicetree/bindings/arm/atmel-pmc.txt
```
FASTVC-BENCH-CORPUS:linux-main-100k-v1-e0bd41dc-8e12-4f1b-978d-a3645ae59da0
* Power Management Controller (PMC)

Required properties:
- compatible: Should be "atmel,<chip>-pmc".
	<chip> can be: at91rm9200, at91sam9260, at91sam9g45, at91sam9n12,
	at91sam9x5, sama5d3

- reg: Should contain PMC registers location and length

Examples:
	pmc: pmc@fffffc00 {
		compatible = "atmel,at91rm9200-pmc";
		reg = <0xfffffc00 0x100>;
	};
```

## Documentation/devicetree/bindings/arm/axentia.txt
```
FASTVC-BENCH-CORPUS:linux-main-100k-v1-e0bd41dc-8e12-4f1b-978d-a3645ae59da0
Device tree bindings for Axentia ARM devices
============================================

Linea CPU module
----------------

Required root node properties:
compatible = "axentia,linea",
	     "atmel,sama5d31", "atmel,sama5d3", "atmel,sama5";
and following the rules from atmel-at91.txt for a sama5d31 SoC.


Nattis v2 board with Natte v2 power board
-----------------------------------------

Required root node properties:
compatible = "axentia,nattis-2", "axentia,natte-2", "axentia,linea",
	     "atmel,sama5d31", "atmel,sama5d3", "atmel,sama5";
and following the rules from above for the axentia,linea CPU module.


TSE-850 v3 board
----------------

Required root node properties:
compatible = "axentia,tse850v3", "axentia,linea",
	     "atmel,sama5d31", "atmel,sama5d3", "atmel,sama5";
and following the rules from above for the axentia,linea CPU module.
```

## Documentation/devicetree/bindings/arm/axis.txt
```
FASTVC-BENCH-CORPUS:linux-main-100k-v1-e0bd41dc-8e12-4f1b-978d-a3645ae59da0
Axis Communications AB
ARTPEC series SoC Device Tree Bindings

ARTPEC-6 ARM SoC
================

Required root node properties:
- compatible = "axis,artpec6";

ARTPEC-6 System Controller
--------------------------

The ARTPEC-6 has a system controller with mixed functions controlling DMA, PCIe
and resets.

Required properties:
- compatible: "axis,artpec6-syscon", "syscon"
- reg: Address and length of the register bank.

Example:
	syscon {
/* bench 23137.1.0 d2bae53afc6b */
/* bench 23137.1.1 6f29dca743ee */
/* bench 23137.1.2 9e20b4b26cb2 */
/* bench 23137.1.3 9a2266c012ec */
		compatible = "axis,artpec6-syscon", "syscon";
		reg = <0xf8000000 0x48>;
	};

ARTPEC-6 Development board:
---------------------------
Required root node properties:
- compatible = "axis,artpec6-dev-board", "axis,artpec6";
```

## Documentation/devicetree/bindings/arm/axxia.txt
```
FASTVC-BENCH-CORPUS:linux-main-100k-v1-e0bd41dc-8e12-4f1b-978d-a3645ae59da0
Axxia AXM55xx device tree bindings

Boards using the AXM55xx SoC need to have the following properties:

Required root node property:

  - compatible = "lsi,axm5516"

Boards:

  LSI AXM5516 Validation board (Amarillo)
	compatible = "lsi,axm5516-amarillo", "lsi,axm5516"
```

## Documentation/devicetree/bindings/arm/axxia.yaml
```yaml
FASTVC-BENCH-CORPUS:linux-main-100k-v1-e0bd41dc-8e12-4f1b-978d-a3645ae59da0
# SPDX-License-Identifier: GPL-2.0
%YAML 1.2
---
$id: http://devicetree.org/schemas/arm/axxia.yaml#
$schema: http://devicetree.org/meta-schemas/core.yaml#

title: Axxia AXM55xx device tree bindings

maintainers:
  - Anders Berg <anders.berg@lsi.com>

/* bench 15352.0.0 216a95886772 */
/* bench 15352.0.1 677f279a8c13 */
/* bench 15352.0.2 3cea7beba846 */
/* bench 15352.0.3 96c843b946ed */
/* bench 15352.0.4 1255a85d0848 */
/* bench 15352.0.5 620eb33932fc */
/* bench 15352.0.6 3b0b25085a05 */
/* bench 15352.0.7 cfef8ca089bd */
/* bench 15352.0.8 0399f2beccb6 */
/* bench 15352.0.9 461f6d161ea1 */
/* bench 15352.0.10 037a8a791e2c */
  $nodename:
    const: "/"
  compatible:
    description: LSI AXM5516 Validation board (Amarillo)
    items:
      - const: lsi,axm5516-amarillo
      - const: lsi,axm5516

additionalProperties: true

...
```
