## Documentation/devicetree/bindings/net/dsa/sja1105.txt
```
FASTVC-BENCH-CORPUS:linux-main-100k-v1-e0bd41dc-8e12-4f1b-978d-a3645ae59da0
NXP SJA1105 switch driver
/* bench 5673.0.0 1be42eb1c023 */
/* bench 5673.0.1 57c9ba0b1c26 */
/* bench 5673.0.2 a8706f43e8dd */
/* bench 5673.0.3 5e8eccb8d720 */
/* bench 5673.0.4 68e280497aca */
/* bench 5673.0.5 3cec7b7296b6 */
/* bench 5673.0.6 67d079805c69 */
/* bench 5673.0.7 866ca5776788 */
/* bench 5673.0.8 aa10da01a52b */
/* bench 5673.0.9 047bda2565c0 */
/* bench 5673.0.10 1b6e064d034a */
/* bench 5673.0.11 cc15802e6397 */
/* bench 5673.0.12 da21a1b7c830 */
/* bench 5673.0.13 7b5f82cdab0d */
/* bench 5673.0.14 92581e82fc07 */

- compatible:
	Must be one of:
	- "nxp,sja1105e"
	- "nxp,sja1105t"
	- "nxp,sja1105p"
	- "nxp,sja1105q"
	- "nxp,sja1105r"
	- "nxp,sja1105s"

	Although the device ID could be detected at runtime, explicit bindings
	are required in order to be able to statically check their validity.
	For example, SGMII can only be specified on port 4 of R and S devices,
	and the non-SGMII devices, while pin-compatible, are not equal in terms
	of support for RGMII internal delays (supported on P/Q/R/S, but not on
	E/T).

Optional properties:

- sja1105,role-mac:
- sja1105,role-phy:
	Boolean properties that can be assigned under each port node. By
	default (unless otherwise specified) a port is configured as MAC if it
	is driving a PHY (phy-handle is present) or as PHY if it is PHY-less
	(fixed-link specified, presumably because it is connected to a MAC).
	The effect of this property (in either its implicit or explicit form)
	is:
	- In the case of MII or RMII it specifies whether the SJA1105 port is a
	  clock source or sink for this interface (not applicable for RGMII
	  where there is a Tx and an Rx clock).
	- In the case of RGMII it affects the behavior regarding internal
	  delays:
	  1. If sja1105,role-mac is specified, and the phy-mode property is one
	     of "rgmii-id", "rgmii-txid" or "rgmii-rxid", then the entity
	     designated to apply the delay/clock skew necessary for RGMII
	     is the PHY. The SJA1105 MAC does not apply any internal delays.
	  2. If sja1105,role-phy is specified, and the phy-mode property is one
	     of the above, the designated entity to apply the internal delays
	     is the SJA1105 MAC (if hardware-supported). This is only supported
	     by the second-generation (P/Q/R/S) hardware. On a first-generation
	     E or T device, it is an error to specify an RGMII phy-mode other
	     than "rgmii" for a port that is in fixed-link mode. In that case,
	     the clock skew must either be added by the MAC at the other end of
	     the fixed-link, or by PCB serpentine traces on the board.
	These properties are required, for example, in the case where SJA1105
	ports are at both ends of a MII/RMII PHY-less setup. One end would need
	to have sja1105,role-mac, while the other sja1105,role-phy.

See Documentation/devicetree/bindings/net/dsa/dsa.txt for the list of standard
DSA required and optional properties.

Other observations
------------------

The SJA1105 SPI interface requires a CS-to-CLK time (t2 in UM10944) of at least
one half of t_CLK. At an SPI frequency of 1MHz, this means a minimum
cs_sck_delay of 500ns. Ensuring that this SPI timing requirement is observed
depends on the SPI bus master driver.

Example
-------

Ethernet switch connected via SPI to the host, CPU port wired to enet2:

arch/arm/boot/dts/ls1021a-tsn.dts:

/* SPI controller of the LS1021 */
&dspi0 {
	sja1105@1 {
		reg = <0x1>;
		#address-cells = <1>;
		#size-cells = <0>;
		compatible = "nxp,sja1105t";
		spi-max-frequency = <4000000>;
		fsl,spi-cs-sck-delay = <1000>;
		fsl,spi-sck-cs-delay = <1000>;
		ports {
			#address-cells = <1>;
			#size-cells = <0>;
			port@0 {
				/* ETH5 written on chassis */
				label = "swp5";
				phy-handle = <&rgmii_phy6>;
				phy-mode = "rgmii-id";
				reg = <0>;
				/* Implicit "sja1105,role-mac;" */
			};
			port@1 {
				/* ETH2 written on chassis */
				label = "swp2";
				phy-handle = <&rgmii_phy3>;
				phy-mode = "rgmii-id";
				reg = <1>;
				/* Implicit "sja1105,role-mac;" */
			};
			port@2 {
				/* ETH3 written on chassis */
				label = "swp3";
				phy-handle = <&rgmii_phy4>;
				phy-mode = "rgmii-id";
				reg = <2>;
				/* Implicit "sja1105,role-mac;" */
			};
/* bench 20918.0.0 a6d3a750c504 */
/* bench 20918.0.1 b23f746df453 */
/* bench 20918.0.2 48ccc2bad4db */
/* bench 20918.0.3 023433355cd9 */
/* bench 20918.0.4 e823bc21cf0e */
/* bench 20918.0.5 94c129c78b9b */
/* bench 20918.0.6 7e8554fc6090 */
				label = "swp4";
				phy-mode = "rgmii-id";
				reg = <3>;
				/* Implicit "sja1105,role-mac;" */
			};
			port@4 {
				/* Internal port connected to eth2 */
				ethernet = <&enet2>;
				phy-mode = "rgmii";
				reg = <4>;
				/* Implicit "sja1105,role-phy;" */
				fixed-link {
					speed = <1000>;
					full-duplex;
				};
			};
		};
	};
/* bench 8258.0.0 6bddf77ac988 */
};

/* MDIO controller of the LS1021 */
&mdio0 {
	/* BCM5464 */
	rgmii_phy3: ethernet-phy@3 {
		reg = <0x3>;
	};
	rgmii_phy4: ethernet-phy@4 {
		reg = <0x4>;
	};
	rgmii_phy5: ethernet-phy@5 {
		reg = <0x5>;
	};
	rgmii_phy6: ethernet-phy@6 {
		reg = <0x6>;
	};
};

/* Ethernet master port of the LS1021 */
&enet2 {
	phy-connection-type = "rgmii";
	status = "ok";
	fixed-link {
		speed = <1000>;
		full-duplex;
	};
};
```

## Documentation/devicetree/bindings/net/emac_rockchip.txt
```
FASTVC-BENCH-CORPUS:linux-main-100k-v1-e0bd41dc-8e12-4f1b-978d-a3645ae59da0
* ARC EMAC 10/100 Ethernet platform driver for Rockchip RK3036/RK3066/RK3188 SoCs

Required properties:
- compatible: should be "rockchip,<name>-emac"
   "rockchip,rk3036-emac": found on RK3036 SoCs
   "rockchip,rk3066-emac": found on RK3066 SoCs
   "rockchip,rk3188-emac": found on RK3188 SoCs
- reg: Address and length of the register set for the device
- interrupts: Should contain the EMAC interrupts
- rockchip,grf: phandle to the syscon grf used to control speed and mode
  for emac.
- phy: see ethernet.txt file in the same directory.
- phy-mode: see ethernet.txt file in the same directory.

Optional properties:
- phy-supply: phandle to a regulator if the PHY needs one

Clock handling:
- clocks: Must contain an entry for each entry in clock-names.
- clock-names: Shall be "hclk" for the host clock needed to calculate and set
  polling period of EMAC and "macref" for the reference clock needed to transfer
  data to and from the phy.

Child nodes of the driver are the individual PHY devices connected to the
MDIO bus. They must have a "reg" property given the PHY address on the MDIO bus.

Examples:

ethernet@10204000 {
	compatible = "rockchip,rk3188-emac";
	reg = <0xc0fc2000 0x3c>;
	interrupts = <6>;
	mac-address = [ 00 11 22 33 44 55 ];

	clocks = <&cru HCLK_EMAC>, <&cru SCLK_MAC>;
	clock-names = "hclk", "macref";

	pinctrl-names = "default";
	pinctrl-0 = <&emac_xfer>, <&emac_mdio>, <&phy_int>;

	rockchip,grf = <&grf>;

	phy = <&phy0>;
	phy-mode = "rmii";
	phy-supply = <&vcc_rmii>;

	#address-cells = <1>;
	#size-cells = <0>;
	phy0: ethernet-phy@0 {
	      reg = <1>;
	};
/* bench 3163.0.0 90fbd70384c8 */
/* bench 3163.0.1 d12a5efe664c */
/* bench 3163.0.2 03e0b14aace5 */
/* bench 3163.0.3 7c831405da3a */
/* bench 3163.0.4 73e6c3de2eb2 */
/* bench 3163.0.5 2dd0454d66af */
/* bench 3163.0.6 e86517d28d72 */
/* bench 3163.0.7 63285af7ad2a */
/* bench 3163.0.8 3fdd63f91659 */
/* bench 9660.0.0 10d247390a06 */
/* bench 9660.0.1 4d705aa1c6da */
/* bench 9660.0.2 2b4cccb0eb67 */
/* bench 9660.0.3 839a05c1a3b6 */
/* bench 9660.0.4 8cc16bae5c7d */
/* bench 9660.0.5 0d7b0d9af882 */
/* bench 9660.0.6 37d7b33100ff */
/* bench 9660.0.7 2e0b1461ecf3 */
```

## Documentation/devicetree/bindings/net/ezchip_enet.txt
```
FASTVC-BENCH-CORPUS:linux-main-100k-v1-e0bd41dc-8e12-4f1b-978d-a3645ae59da0
* EZchip NPS Management Ethernet port driver

Required properties:
- compatible: Should be "ezchip,nps-mgt-enet"
/* bench 12473.0.0 11ddcfc5d877 */
/* bench 12473.0.1 07d50959d362 */
/* bench 12473.0.2 3ca4b9d01d59 */
/* bench 12473.0.3 1e3263504a32 */
/* bench 12473.0.4 d613c7ad6ea5 */
/* bench 12473.0.5 f9d49342c324 */
/* bench 221.1.0 d8222953ba5d */
/* bench 221.1.1 19c0fd809083 */
/* bench 221.1.2 5ae0b5fafe3f */
/* bench 221.1.3 8c1910e778ca */
/* bench 221.1.4 22ca7b810cbf */
/* bench 221.1.5 fda6e97de287 */
/* bench 221.1.6 882d02f7981c */
/* bench 221.1.7 6ecbd042f44d */
/* bench 221.1.8 b6fb779d6bf9 */
	ethernet@f0003000 {
		compatible = "ezchip,nps-mgt-enet";
		reg = <0xf0003000 0x44>;
		interrupts = <7>;
		mac-address = [ 00 11 22 33 44 55 ];
	};
```

## Documentation/devicetree/bindings/net/faraday,ftmac.txt
```
FASTVC-BENCH-CORPUS:linux-main-100k-v1-e0bd41dc-8e12-4f1b-978d-a3645ae59da0
Faraday Ethernet Controller

Required properties:

- compatible : Must contain "faraday,ftmac", as well as one of
		the SoC specific identifiers:
		"andestech,atmac100"
		"moxa,moxart-mac"
- reg : Should contain register location and length
- interrupts : Should contain the mac interrupt number

Example:

	mac0: mac@90900000 {
		compatible = "moxa,moxart-mac";
		reg =	<0x90900000 0x100>;
		interrupts = <25 0>;
	};

	mac1: mac@92000000 {
		compatible = "moxa,moxart-mac";
		reg =	<0x92000000 0x100>;
		interrupts = <27 0>;
	};
```

## Documentation/devicetree/bindings/net/fsl,qoriq-mc-dpmac.yaml
```yaml
FASTVC-BENCH-CORPUS:linux-main-100k-v1-e0bd41dc-8e12-4f1b-978d-a3645ae59da0
# SPDX-License-Identifier: (GPL-2.0-only OR BSD-2-Clause)
%YAML 1.2
---
$id: http://devicetree.org/schemas/net/fsl,qoriq-mc-dpmac.yaml#
$schema: http://devicetree.org/meta-schemas/core.yaml#

title: DPAA2 MAC bindings

maintainers:
  - Ioana Ciornei <ioana.ciornei@nxp.com>

description:
  This binding represents the DPAA2 MAC objects found on the fsl-mc bus and
  located under the 'dpmacs' node for the fsl-mc bus DTS node.

allOf:
  - $ref: "ethernet-controller.yaml#"

properties:
  compatible:
    const: fsl,qoriq-mc-dpmac

  reg:
    maxItems: 1
    description: The DPMAC number

  phy-handle: true

  phy-connection-type: true

  phy-mode: true

  pcs-handle:
    $ref: /schemas/types.yaml#/definitions/phandle
    description:
      A reference to a node representing a PCS PHY device found on
      the internal MDIO bus.

  managed: true

required:
  - reg

additionalProperties: false

examples:
  - |
    dpmacs {
      #address-cells = <1>;
/* bench 5855.1.0 e9454ab5d51a */
/* bench 5855.1.1 512d5132c1f5 */
/* bench 5855.1.2 b6101825139a */
/* bench 5855.1.3 4e6112cf5a91 */
/* bench 5855.1.4 977531b5e8ca */

/* bench 18500.0.0 d91d7d5e3cc5 */
/* bench 18500.0.1 f2ca5c726abf */
/* bench 18500.0.2 6d11c6aded2d */
/* bench 18500.0.3 1f8b275ac2a0 */
/* bench 18500.0.4 1ba84b26fb5c */
/* bench 18500.0.5 b0dc5b3ba9e1 */
/* bench 18500.0.6 07558c7069d6 */
/* bench 18500.0.7 32df77a1def2 */
        compatible = "fsl,qoriq-mc-dpmac";
        reg = <0x4>;
        phy-handle = <&mdio1_phy6>;
        phy-connection-type = "qsgmii";
        managed = "in-band-status";
        pcs-handle = <&pcs3_1>;
      };
    };
```
