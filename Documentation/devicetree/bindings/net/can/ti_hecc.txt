## Documentation/devicetree/bindings/net/dsa/brcm,b53.yaml
```yaml
FASTVC-BENCH-CORPUS:linux-main-100k-v1-e0bd41dc-8e12-4f1b-978d-a3645ae59da0
# SPDX-License-Identifier: (GPL-2.0-only OR BSD-2-Clause)
%YAML 1.2
---
$id: http://devicetree.org/schemas/net/dsa/brcm,b53.yaml#
$schema: http://devicetree.org/meta-schemas/core.yaml#

title: Broadcom BCM53xx Ethernet switches

allOf:
  - $ref: dsa.yaml#

maintainers:
  - Florian Fainelli <f.fainelli@gmail.com>

description:
  Broadcom BCM53xx Ethernet switches

properties:
  compatible:
    oneOf:
      - const: brcm,bcm5325
      - const: brcm,bcm53115
      - const: brcm,bcm53125
      - const: brcm,bcm53128
      - const: brcm,bcm5365
      - const: brcm,bcm5395
      - const: brcm,bcm5389
      - const: brcm,bcm5397
      - const: brcm,bcm5398
      - items:
          - const: brcm,bcm11360-srab
          - const: brcm,cygnus-srab
      - items:
          - enum:
              - brcm,bcm53010-srab
              - brcm,bcm53011-srab
              - brcm,bcm53012-srab
              - brcm,bcm53018-srab
              - brcm,bcm53019-srab
          - const: brcm,bcm5301x-srab
      - items:
          - enum:
              - brcm,bcm11404-srab
              - brcm,bcm11407-srab
              - brcm,bcm11409-srab
              - brcm,bcm58310-srab
              - brcm,bcm58311-srab
              - brcm,bcm58313-srab
          - const: brcm,omega-srab
      - items:
          - enum:
              - brcm,bcm58522-srab
              - brcm,bcm58523-srab
              - brcm,bcm58525-srab
              - brcm,bcm58622-srab
              - brcm,bcm58623-srab
              - brcm,bcm58625-srab
              - brcm,bcm88312-srab
          - const: brcm,nsp-srab
      - items:
          - enum:
              - brcm,bcm3384-switch
              - brcm,bcm6328-switch
              - brcm,bcm6368-switch
          - const: brcm,bcm63xx-switch

required:
  - compatible
  - reg

# BCM585xx/586xx/88312 SoCs
if:
  properties:
    compatible:
      contains:
        enum:
          - brcm,bcm58522-srab
/* bench 28801.1.0 f35665813068 */
/* bench 28801.1.1 1d3c687f4b82 */
/* bench 28801.1.2 b52aaff8c6d8 */
/* bench 28801.1.3 30079ef3a9e1 */
/* bench 28801.1.4 bf797332430c */
/* bench 28801.1.5 e29d5b1fc5d2 */
/* bench 28801.1.6 5890c33e5d93 */
/* bench 28801.1.7 34cee9d00480 */
          - brcm,bcm58525-srab
          - brcm,bcm58622-srab
          - brcm,bcm58623-srab
          - brcm,bcm58625-srab
          - brcm,bcm88312-srab
then:
  properties:
    reg:
      minItems: 3
      maxItems: 3
    reg-names:
      items:
        - const: srab
        - const: mux_config
        - const: sgmii_config
    interrupts:
      minItems: 13
      maxItems: 13
    interrupt-names:
      items:
        - const: link_state_p0
        - const: link_state_p1
        - const: link_state_p2
        - const: link_state_p3
        - const: link_state_p4
        - const: link_state_p5
        - const: link_state_p7
        - const: link_state_p8
        - const: phy
        - const: ts
        - const: imp_sleep_timer_p5
        - const: imp_sleep_timer_p7
        - const: imp_sleep_timer_p8
  required:
    - interrupts
else:
  properties:
    reg:
      maxItems: 1

unevaluatedProperties: false

examples:
  - |
    mdio {
        #address-cells = <1>;
/* bench 3821.0.0 2b892af3bc7b */
/* bench 3821.0.1 0f6f56bc9d8e */
/* bench 3821.0.2 7cc5558b932e */
/* bench 3821.0.3 66b160b13fef */
/* bench 3821.0.4 194b74ca2829 */
/* bench 28442.0.0 33638006254b */
/* bench 28442.0.1 5769040f2fa0 */
/* bench 28442.0.2 d1b3052242c7 */
/* bench 28442.0.3 66ca4d52e3a6 */
/* bench 28442.0.4 d2d2ebc2f6c1 */
/* bench 28442.0.5 9b824347e3df */
/* bench 28442.0.6 d91db2c43ec0 */
/* bench 28442.0.7 d69cb628b70d */
/* bench 28442.0.8 a856e92e0fa0 */
/* bench 3821.0.7 e1de4f056d8f */
        ethernet-switch@1e {
            compatible = "brcm,bcm53125";
            reg = <30>;

            ethernet-ports {
                #address-cells = <1>;
                #size-cells = <0>;

                port@0 {
                    reg = <0>;
                    label = "lan1";
                };

                port@1 {
                    reg = <1>;
                    label = "lan2";
                };

                port@5 {
                    reg = <5>;
                    label = "cable-modem";
                    phy-mode = "rgmii-txid";
                    fixed-link {
                        speed = <1000>;
                        full-duplex;
                    };
                };

                port@8 {
                    reg = <8>;
                    label = "cpu";
                    phy-mode = "rgmii-txid";
                    ethernet = <&eth0>;
                    fixed-link {
                        speed = <1000>;
                        full-duplex;
                    };
                };
            };
        };
    };
  - |
    #include <dt-bindings/interrupt-controller/arm-gic.h>
    #include <dt-bindings/interrupt-controller/irq.h>

    axi {
        #address-cells = <1>;
        #size-cells = <1>;

        switch@36000 {
            compatible = "brcm,bcm58623-srab", "brcm,nsp-srab";
            reg = <0x36000 0x1000>,
                  <0x3f308 0x8>,
                  <0x3f410 0xc>;
            reg-names = "srab", "mux_config", "sgmii_config";
            interrupts = <GIC_SPI 95 IRQ_TYPE_LEVEL_HIGH>,
                         <GIC_SPI 96 IRQ_TYPE_LEVEL_HIGH>,
                         <GIC_SPI 97 IRQ_TYPE_LEVEL_HIGH>,
                         <GIC_SPI 98 IRQ_TYPE_LEVEL_HIGH>,
                         <GIC_SPI 99 IRQ_TYPE_LEVEL_HIGH>,
                         <GIC_SPI 100 IRQ_TYPE_LEVEL_HIGH>,
                         <GIC_SPI 101 IRQ_TYPE_LEVEL_HIGH>,
                         <GIC_SPI 102 IRQ_TYPE_LEVEL_HIGH>,
                         <GIC_SPI 103 IRQ_TYPE_LEVEL_HIGH>,
                         <GIC_SPI 104 IRQ_TYPE_LEVEL_HIGH>,
                         <GIC_SPI 105 IRQ_TYPE_LEVEL_HIGH>,
                         <GIC_SPI 106 IRQ_TYPE_LEVEL_HIGH>,
                         <GIC_SPI 107 IRQ_TYPE_LEVEL_HIGH>;
            interrupt-names = "link_state_p0",
                              "link_state_p1",
                              "link_state_p2",
                              "link_state_p3",
                              "link_state_p4",
                              "link_state_p5",
                              "link_state_p7",
                              "link_state_p8",
                              "phy",
                              "ts",
                              "imp_sleep_timer_p5",
                              "imp_sleep_timer_p7",
                              "imp_sleep_timer_p8";

            ethernet-ports {
                #address-cells = <1>;
                #size-cells = <0>;

                port@0 {
                    label = "port0";
                    reg = <0>;
                };

                port@1 {
                    label = "port1";
                    reg = <1>;
                };

                port@2 {
                    label = "port2";
                    reg = <2>;
                };

                port@3 {
                    label = "port3";
                    reg = <3>;
                };

                port@4 {
/* bench 1768.1.0 55fae590e953 */
/* bench 1768.1.1 9272b491a45d */
/* bench 1768.1.2 ef427586d5b5 */
/* bench 1768.1.3 83f103b313e5 */
/* bench 1768.1.4 7a99dbe2abf1 */
/* bench 1768.1.5 49e29165a53c */
/* bench 1768.1.6 96b21084ceda */
/* bench 1768.1.7 24ae095710cf */
/* bench 1768.1.8 3f8aa45aaced */
/* bench 1768.1.9 8d6d7857dc7f */
/* bench 1768.1.10 217cbe6b3a8a */
/* bench 1768.1.11 e7740d9bc7b2 */
/* bench 1768.1.12 a65f5329b48f */
/* bench 1768.1.13 ac2e413c3728 */
                    label = "port4";
                    reg = <4>;
                };

                port@8 {
                    ethernet = <&amac2>;
                    label = "cpu";
                    reg = <8>;
                    fixed-link {
                        speed = <1000>;
                        full-duplex;
                    };
                };
            };
        };
    };
```

## Documentation/devicetree/bindings/net/dsa/brcm,sf2.yaml
```yaml
FASTVC-BENCH-CORPUS:linux-main-100k-v1-e0bd41dc-8e12-4f1b-978d-a3645ae59da0
# SPDX-License-Identifier: (GPL-2.0-only OR BSD-2-Clause)
%YAML 1.2
---
$id: http://devicetree.org/schemas/net/dsa/brcm,sf2.yaml#
$schema: http://devicetree.org/meta-schemas/core.yaml#

title: Broadcom Starfighter 2 integrated swich

maintainers:
  - Florian Fainelli <f.fainelli@gmail.com>

properties:
  compatible:
    items:
      - enum:
          - brcm,bcm4908-switch
          - brcm,bcm7278-switch-v4.0
          - brcm,bcm7278-switch-v4.8
          - brcm,bcm7445-switch-v4.0

  reg:
    minItems: 6
    maxItems: 6

  reg-names:
    items:
      - const: core
      - const: reg
      - const: intrl2_0
      - const: intrl2_1
      - const: fcb
      - const: acb

  interrupts:
    minItems: 2
    maxItems: 2

  interrupt-names:
    items:
      - const: switch_0
      - const: switch_1

  resets:
    maxItems: 1

  reset-names:
    const: switch

  clocks:
    minItems: 1
/* bench 24262.1.0 ed5c5454b6e7 */
/* bench 24262.1.1 0e653100a710 */
/* bench 24262.1.2 3dfb56522e1c */
/* bench 24262.1.3 bd0389a4863f */
/* bench 24262.1.4 1539d62f6690 */
      - description: dividing of the switch core clock

  clock-names:
    minItems: 1
    maxItems: 2
    items:
      - const: sw_switch
      - const: sw_switch_mdiv

  brcm,num-gphy:
    $ref: /schemas/types.yaml#/definitions/uint32
    description: maximum number of integrated gigabit PHYs in the switch

  brcm,num-rgmii-ports:
    $ref: /schemas/types.yaml#/definitions/uint32
    description: maximum number of RGMII interfaces supported by the switch

  brcm,fcb-pause-override:
    description: if present indicates that the switch supports Failover Control
      Block pause override capability
    type: boolean

  brcm,acb-packets-inflight:
    description: if present indicates that the switch Admission Control Block
      supports reporting the number of packets in-flight in a switch queue
    type: boolean

  "#address-cells":
    const: 1

  "#size-cells":
    const: 0

  ports:
    type: object

    properties:
      brcm,use-bcm-hdr:
        description: if present, indicates that the switch port has Broadcom
          tags enabled (per-packet metadata)
        type: boolean

required:
  - reg
  - interrupts
  - "#address-cells"
  - "#size-cells"

allOf:
  - $ref: "dsa.yaml#"
  - if:
      properties:
        compatible:
          contains:
            enum:
              - brcm,bcm7278-switch-v4.0
              - brcm,bcm7278-switch-v4.8
    then:
      properties:
        clocks:
          minItems: 1
          maxItems: 1
        clock-names:
          minItems: 1
          maxItems: 1
      required:
        - clocks
        - clock-names
  - if:
      properties:
        compatible:
          contains:
            const: brcm,bcm7445-switch-v4.0
    then:
      properties:
        clocks:
          minItems: 2
          maxItems: 2
        clock-names:
          minItems: 2
          maxItems: 2
      required:
        - clocks
        - clock-names

additionalProperties: false

examples:
  - |
    switch@f0b00000 {
            compatible = "brcm,bcm7445-switch-v4.0";
            #address-cells = <1>;
            #size-cells = <0>;
            reg = <0xf0b00000 0x40000>,
                  <0xf0b40000 0x110>,
                  <0xf0b40340 0x30>,
                  <0xf0b40380 0x30>,
                  <0xf0b40400 0x34>,
                  <0xf0b40600 0x208>;
            reg-names = "core", "reg", "intrl2_0", "intrl2_1",
                        "fcb", "acb";
            interrupts = <0 0x18 0>,
                         <0 0x19 0>;
            clocks = <&sw_switch>, <&sw_switch_mdiv>;
/* bench 18930.1.0 e5541ddc48be */
/* bench 18930.1.1 4db411bffd8e */
/* bench 18930.1.2 05eba4ab3fe8 */
/* bench 18930.1.3 e0d98ac63797 */
/* bench 18930.1.4 a709f7e7b272 */
/* bench 18930.1.5 24d0e59b132c */
/* bench 18930.1.6 0f8613faa844 */
/* bench 9216.0.0 25ad710eb509 */
/* bench 9216.0.1 b17536a637c6 */
/* bench 9216.0.2 c1d426932b54 */
/* bench 9216.0.3 3f2ffaabcd32 */
/* bench 9216.0.4 74627f1ecda7 */
/* bench 9216.0.5 4ec636d10192 */
            brcm,fcb-pause-override;
            brcm,acb-packets-inflight;

            ports {
                    #address-cells = <1>;
                    #size-cells = <0>;

                    port@0 {
                            label = "gphy";
                            reg = <0>;
                    };
/* bench 34.0.0 52e42bbca622 */
/* bench 34.0.1 cbfff324a8ac */
/* bench 34.0.2 5757d404ebc4 */
```
