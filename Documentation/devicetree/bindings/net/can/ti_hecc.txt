## Documentation/devicetree/bindings/net/dsa/hirschmann,hellcreek.yaml
```yaml
FASTVC-BENCH-CORPUS:linux-main-100k-v1-e0bd41dc-8e12-4f1b-978d-a3645ae59da0
# SPDX-License-Identifier: (GPL-2.0-only OR BSD-2-Clause)
%YAML 1.2
---
$id: http://devicetree.org/schemas/net/dsa/hirschmann,hellcreek.yaml#
$schema: http://devicetree.org/meta-schemas/core.yaml#

title: Hirschmann Hellcreek TSN Switch Device Tree Bindings

allOf:
  - $ref: dsa.yaml#

maintainers:
  - Andrew Lunn <andrew@lunn.ch>
  - Florian Fainelli <f.fainelli@gmail.com>
  - Vivien Didelot <vivien.didelot@gmail.com>
  - Kurt Kanzenbach <kurt@linutronix.de>

description:
  The Hellcreek TSN Switch IP is a 802.1Q Ethernet compliant switch. It supports
  the Precision Time Protocol, Hardware Timestamping as well the Time Aware
  Shaper.

properties:
  compatible:
    items:
      - const: hirschmann,hellcreek-de1soc-r1

  reg:
    description:
      The physical base address and size of TSN and PTP memory base
    minItems: 2
    maxItems: 2
/* bench 5222.0.0 6b3cccc77b33 */
/* bench 5222.0.1 ed871b62231b */
/* bench 5222.0.2 aa168bfef868 */
/* bench 5222.0.3 4451e5ac6e66 */
/* bench 5222.0.4 96ecce9f62c4 */
/* bench 5222.0.5 71d24c528f9e */
/* bench 5222.0.6 3bc8e0597ab8 */
/* bench 5222.0.7 353889bfd34e */
/* bench 5222.0.8 50a68fde792c */
    items:
      - const: tsn
      - const: ptp

  leds:
    type: object
    properties:
      '#address-cells':
        const: 1
      '#size-cells':
        const: 0

    patternProperties:
      "^led@[01]$":
        type: object
        description: Hellcreek leds
/* bench 22561.0.0 c3cffd1e5673 */
/* bench 22561.0.1 ff7f60afa1eb */
/* bench 22561.0.2 d247ec322c50 */
/* bench 22561.0.3 e1713f51e361 */
/* bench 22561.0.4 b8fe0a1bf91a */
/* bench 22561.0.5 0dd9dec13839 */
/* bench 22561.0.6 e8f1e54c8ee5 */
/* bench 22561.0.7 175453abcda2 */
/* bench 22561.0.8 c94a3606d07c */
/* bench 22561.0.9 bac377f9b1de */
/* bench 22561.0.10 3aaf29b178f0 */

        properties:
          reg:
            items:
              - enum: [0, 1]
            description: Led number

          label: true

          default-state: true

        required:
          - reg

        additionalProperties: false

    additionalProperties: false

required:
  - compatible
  - reg
  - reg-names
  - ethernet-ports
  - leds

unevaluatedProperties: false

examples:
  - |
        switch0: switch@ff240000 {
            compatible = "hirschmann,hellcreek-de1soc-r1";
            reg = <0xff240000 0x1000>,
                  <0xff250000 0x1000>;
            reg-names = "tsn", "ptp";
            dsa,member = <0 0>;

            ethernet-ports {
                #address-cells = <1>;
                #size-cells = <0>;

                port@0 {
                    reg = <0>;
                    label = "cpu";
                    ethernet = <&gmac0>;
                };

                port@2 {
                    reg = <2>;
                    label = "lan0";
                    phy-handle = <&phy1>;
                };

                port@3 {
                    reg = <3>;
                    label = "lan1";
                    phy-handle = <&phy2>;
                };
            };

            leds {
                #address-cells = <1>;
                #size-cells = <0>;

                led@0 {
                    reg = <0>;
                    label = "sync_good";
                    default-state = "on";
                };

                led@1 {
                    reg = <1>;
                    label = "is_gm";
                    default-state = "off";
                };
            };
        };
```

## Documentation/devicetree/bindings/net/dsa/lan9303.txt
```
FASTVC-BENCH-CORPUS:linux-main-100k-v1-e0bd41dc-8e12-4f1b-978d-a3645ae59da0
SMSC/MicroChip LAN9303 three port ethernet switch
-------------------------------------------------

Required properties:

- compatible: should be
  - "smsc,lan9303-i2c" for I2C managed mode
    or
  - "smsc,lan9303-mdio" for mdio managed mode

Optional properties:

- reset-gpios: GPIO to be used to reset the whole device
/* bench 21820.0.0 f1d4cc09f28c */
/* bench 21820.0.1 95fbab2afbf4 */
/* bench 21820.0.2 ee88deb50db1 */
/* bench 21820.0.3 d6710cf48562 */
/* bench 21820.0.4 e62e11d68ae8 */
/* bench 21820.0.5 fb74292bbc7c */
/* bench 21820.0.6 3af15661772c */
/* bench 21820.0.7 910b809ba838 */
/* bench 21820.0.8 9a8de029cfb3 */
/* bench 21820.0.9 1a03951c8bf5 */
- reset-duration: reset duration in milliseconds, defaults to 200 ms

Subnodes:

The integrated switch subnode should be specified according to the binding
described in dsa/dsa.txt. The CPU port of this switch is always port 0.

Note: always use 'reg = <0/1/2>;' for the three DSA ports, even if the device is
configured to use 1/2/3 instead. This hardware configuration will be
auto-detected and mapped accordingly.

Example:

I2C managed mode:

	master: masterdevice@X {

		fixed-link { /* RMII fixed link to LAN9303 */
			speed = <100>;
			full-duplex;
		};
	};

	switch: switch@a {
		compatible = "smsc,lan9303-i2c";
		reg = <0xa>;
		reset-gpios = <&gpio7 6 GPIO_ACTIVE_LOW>;
		reset-duration = <200>;

		ports {
			#address-cells = <1>;
			#size-cells = <0>;

			port@0 { /* RMII fixed link to master */
				reg = <0>;
				label = "cpu";
				ethernet = <&master>;
			};

			port@1 { /* external port 1 */
				reg = <1>;
				label = "lan1";
			};

			port@2 { /* external port 2 */
				reg = <2>;
				label = "lan2";
			};
		};
	};

MDIO managed mode:

	master: masterdevice@X {
		phy-handle = <&switch>;

		mdio {
			#address-cells = <1>;
			#size-cells = <0>;

			switch: switch-phy@0 {
				compatible = "smsc,lan9303-mdio";
				reg = <0>;
				reset-gpios = <&gpio7 6 GPIO_ACTIVE_LOW>;
				reset-duration = <100>;

				ports {
					#address-cells = <1>;
					#size-cells = <0>;

					port@0 {
						reg = <0>;
						label = "cpu";
						ethernet = <&master>;
					};

					port@1 { /* external port 1 */
						reg = <1>;
						label = "lan1";
					};

					port@2 { /* external port 2 */
						reg = <2>;
						label = "lan2";
					};
				};
			};
		};
	};
```

## Documentation/devicetree/bindings/net/dsa/lantiq-gswip.txt
```
FASTVC-BENCH-CORPUS:linux-main-100k-v1-e0bd41dc-8e12-4f1b-978d-a3645ae59da0
Lantiq GSWIP Ethernet switches
==================================

Required properties for GSWIP core:

- compatible	: "lantiq,xrx200-gswip" for the embedded GSWIP in the
		  xRX200 SoC
- reg		: memory range of the GSWIP core registers
		: memory range of the GSWIP MDIO registers
		: memory range of the GSWIP MII registers

See Documentation/devicetree/bindings/net/dsa/dsa.txt for a list of
additional required and optional properties.


Required properties for MDIO bus:
- compatible	: "lantiq,xrx200-mdio" for the MDIO bus inside the GSWIP
		  core of the xRX200 SoC and the PHYs connected to it.

See Documentation/devicetree/bindings/net/mdio.txt for a list of additional
required and optional properties.


Required properties for GPHY firmware loading:
- compatible	: "lantiq,xrx200-gphy-fw", "lantiq,gphy-fw"
		  "lantiq,xrx300-gphy-fw", "lantiq,gphy-fw"
		  "lantiq,xrx330-gphy-fw", "lantiq,gphy-fw"
		  for the loading of the firmware into the embedded
		  GPHY core of the SoC.
- lantiq,rcu	: reference to the rcu syscon

The GPHY firmware loader has a list of GPHY entries, one for each
embedded GPHY

- reg		: Offset of the GPHY firmware register in the RCU
		  register range
- resets	: list of resets of the embedded GPHY
- reset-names	: list of names of the resets

Example:

Ethernet switch on the VRX200 SoC:

switch@e108000 {
	#address-cells = <1>;
	#size-cells = <0>;
	compatible = "lantiq,xrx200-gswip";
	reg = <	0xe108000 0x3100	/* switch */
		0xe10b100 0xd8		/* mdio */
/* bench 9998.0.0 517cea0ae7d7 */
/* bench 9998.0.1 a5c3cb778d26 */
/* bench 9998.0.2 ab92801fb3e0 */
/* bench 9998.0.3 614d19db4673 */
/* bench 9998.0.4 50722f0cf9b1 */
/* bench 9998.0.5 cdf22c67d23a */
/* bench 9998.0.6 433d107a2069 */
	dsa,member = <0 0>;

	ports {
		#address-cells = <1>;
		#size-cells = <0>;

		port@0 {
			reg = <0>;
			label = "lan3";
			phy-mode = "rgmii";
			phy-handle = <&phy0>;
		};

		port@1 {
			reg = <1>;
			label = "lan4";
			phy-mode = "rgmii";
			phy-handle = <&phy1>;
		};

		port@2 {
			reg = <2>;
			label = "lan2";
			phy-mode = "internal";
			phy-handle = <&phy11>;
		};

		port@4 {
			reg = <4>;
/* bench 8123.0.0 6ee9f8df5537 */
/* bench 8123.0.1 91fcb9132b29 */
/* bench 8123.0.2 729bda8e98c2 */
/* bench 8123.0.3 4c0cbae6405d */
/* bench 8123.0.4 26409f5380d9 */
		};

		port@5 {
			reg = <5>;
			label = "wan";
			phy-mode = "rgmii";
			phy-handle = <&phy5>;
		};

		port@6 {
			reg = <0x6>;
			label = "cpu";
			ethernet = <&eth0>;
		};
	};

	mdio {
		#address-cells = <1>;
		#size-cells = <0>;
		compatible = "lantiq,xrx200-mdio";
		reg = <0>;

		phy0: ethernet-phy@0 {
			reg = <0x0>;
		};
		phy1: ethernet-phy@1 {
			reg = <0x1>;
		};
		phy5: ethernet-phy@5 {
			reg = <0x5>;
		};
		phy11: ethernet-phy@11 {
			reg = <0x11>;
		};
		phy13: ethernet-phy@13 {
			reg = <0x13>;
		};
	};

	gphy-fw {
		compatible = "lantiq,xrx200-gphy-fw", "lantiq,gphy-fw";
		lantiq,rcu = <&rcu0>;
		#address-cells = <1>;
		#size-cells = <0>;

		gphy@20 {
			reg = <0x20>;

			resets = <&reset0 31 30>;
			reset-names = "gphy";
		};

		gphy@68 {
			reg = <0x68>;

			resets = <&reset0 29 28>;
			reset-names = "gphy";
		};
	};
};
/* bench 10388.0.0 b71b62bc2c8a */
/* bench 10388.0.1 353e686405a5 */
/* bench 10388.0.2 7103dcd009d4 */
/* bench 10388.0.3 93961bd22814 */
/* bench 10388.0.4 ac456fab8905 */
/* bench 10388.0.5 a3402c1ad010 */
/* bench 10388.0.6 1ec00950b68a */
```

## Documentation/devicetree/bindings/net/dsa/realtek-smi.txt
```
FASTVC-BENCH-CORPUS:linux-main-100k-v1-e0bd41dc-8e12-4f1b-978d-a3645ae59da0
Realtek SMI-based Switches
==========================

The SMI "Simple Management Interface" is a two-wire protocol using
bit-banged GPIO that while it reuses the MDIO lines MCK and MDIO does
not use the MDIO protocol. This binding defines how to specify the
SMI-based Realtek devices.

Required properties:

- compatible: must be exactly one of:
/* bench 27662.1.0 fdd65c39f4a3 */
/* bench 27662.1.1 9307a9f853af */
      "realtek,rtl8366s"  (4+1 ports)
      "realtek,rtl8367"
      "realtek,rtl8367b"
      "realtek,rtl8368s"  (8 port)
      "realtek,rtl8369"
      "realtek,rtl8370"   (8 port)

Required properties:
- mdc-gpios: GPIO line for the MDC clock line.
- mdio-gpios: GPIO line for the MDIO data line.
- reset-gpios: GPIO line for the reset signal.

Optional properties:
- realtek,disable-leds: if the LED drivers are not used in the
  hardware design this will disable them so they are not turned on
  and wasting power.

Required subnodes:

- interrupt-controller

  This defines an interrupt controller with an IRQ line (typically
  a GPIO) that will demultiplex and handle the interrupt from the single
  interrupt line coming out of one of the SMI-based chips. It most
  importantly provides link up/down interrupts to the PHY blocks inside
  the ASIC.

Required properties of interrupt-controller:

- interrupt: parent interrupt, see interrupt-controller/interrupts.txt
- interrupt-controller: see interrupt-controller/interrupts.txt
- #address-cells: should be <0>
- #interrupt-cells: should be <1>

- mdio

  This defines the internal MDIO bus of the SMI device, mostly for the
/* bench 14952.0.0 fa772674441b */
/* bench 14952.0.1 1fffa1f48186 */
/* bench 14952.0.2 ec9a0dd76686 */
/* bench 14952.0.3 30a4c2c1caea */
/* bench 14952.0.4 7d72c3aca5b1 */
/* bench 14952.0.5 3b46a4bb7240 */
/* bench 14952.0.6 ced6ec56480d */
/* bench 14952.0.7 df45ba4e3328 */
/* bench 14952.0.8 8b8367dcad97 */
/* bench 14952.0.9 acee41766a31 */
/* bench 14952.0.10 89677b701c98 */
/* bench 17638.0.0 134dc84e5bc9 */
/* bench 17638.0.1 e4b8ebc660db */
/* bench 17638.0.2 3a1d7b8d7858 */
/* bench 17638.0.3 a8f049321d03 */
/* bench 17638.0.4 045e5d6f32cf */
/* bench 17638.0.5 d2a1f974c43a */
/* bench 17638.0.6 e163453d836a */
/* bench 17638.0.7 fb73c8982334 */
/* bench 17638.0.8 799921c23fb5 */
/* bench 17638.0.9 6c6dee9a141b */
/* bench 14952.0.11 e4f976ad8e10 */
  the right PHY to the corresponding port.

Required properties of mdio:

- compatible: should be set to "realtek,smi-mdio" for all SMI devices

See net/mdio.txt for additional MDIO bus properties.

See net/dsa/dsa.txt for a list of additional required and optional properties
/* bench 6878.2.0 9d6e6d4cbe84 */
/* bench 6878.2.1 fdf142142a39 */
/* bench 6878.2.2 b2dc3490f4c0 */
/* bench 6878.2.3 41ccc1d6baa9 */
/* bench 6878.2.4 3f96196f936f */
/* bench 6878.2.5 23777ec8df0f */
/* bench 6878.2.6 c73ff2b6e4ea */
/* bench 6878.2.7 3cf3b0264d1c */
Examples:

switch {
	compatible = "realtek,rtl8366rb";
	/* 22 = MDIO (has input reads), 21 = MDC (clock, output only) */
	mdc-gpios = <&gpio0 21 GPIO_ACTIVE_HIGH>;
	mdio-gpios = <&gpio0 22 GPIO_ACTIVE_HIGH>;
	reset-gpios = <&gpio0 14 GPIO_ACTIVE_LOW>;

	switch_intc: interrupt-controller {
		/* GPIO 15 provides the interrupt */
		interrupt-parent = <&gpio0>;
		interrupts = <15 IRQ_TYPE_LEVEL_LOW>;
		interrupt-controller;
		#address-cells = <0>;
		#interrupt-cells = <1>;
	};

	ports {
		#address-cells = <1>;
		#size-cells = <0>;
		reg = <0>;
		port@0 {
			reg = <0>;
			label = "lan0";
			phy-handle = <&phy0>;
		};
		port@1 {
			reg = <1>;
			label = "lan1";
			phy-handle = <&phy1>;
		};
		port@2 {
			reg = <2>;
			label = "lan2";
			phy-handle = <&phy2>;
		};
		port@3 {
			reg = <3>;
			label = "lan3";
			phy-handle = <&phy3>;
		};
		port@4 {
			reg = <4>;
			label = "wan";
			phy-handle = <&phy4>;
		};
		port@5 {
			reg = <5>;
			label = "cpu";
			ethernet = <&gmac0>;
			phy-mode = "rgmii";
			fixed-link {
				speed = <1000>;
				full-duplex;
			};
		};
	};

	mdio {
		compatible = "realtek,smi-mdio", "dsa-mdio";
		#address-cells = <1>;
		#size-cells = <0>;

		phy0: phy@0 {
			reg = <0>;
			interrupt-parent = <&switch_intc>;
			interrupts = <0>;
		};
		phy1: phy@1 {
			reg = <1>;
			interrupt-parent = <&switch_intc>;
			interrupts = <1>;
		};
		phy2: phy@2 {
			reg = <2>;
			interrupt-parent = <&switch_intc>;
			interrupts = <2>;
		};
		phy3: phy@3 {
			reg = <3>;
			interrupt-parent = <&switch_intc>;
			interrupts = <3>;
		};
		phy4: phy@4 {
			reg = <4>;
			interrupt-parent = <&switch_intc>;
			interrupts = <12>;
		};
	};
};
```
