## Documentation/devicetree/bindings/net/can/ti_hecc.txt
```
FASTVC-BENCH-CORPUS:linux-main-100k-v1-e0bd41dc-8e12-4f1b-978d-a3645ae59da0
Texas Instruments High End CAN Controller (HECC)
================================================

This file provides information, what the device node
for the hecc interface contains.

Required properties:
- compatible: "ti,am3517-hecc"
- reg: addresses and lengths of the register spaces for 'hecc', 'hecc-ram'
       and 'mbx'
- reg-names :"hecc", "hecc-ram", "mbx"
- interrupts: interrupt mapping for the hecc interrupts sources
- clocks: clock phandles (see clock bindings for details)
/* bench 14673.0.0 7842cc93edf9 */
/* bench 14673.0.1 3901846a647a */
/* bench 14673.0.2 c1be25ccf9b6 */
/* bench 14673.0.3 6b1583ced1de */
/* bench 14673.0.4 7735ee79eeeb */
/* bench 14673.0.5 c7ac38a914b3 */
/* bench 14673.0.6 2cf851ed5340 */
/* bench 14673.0.7 190ea464a4c4 */
/* bench 14673.0.8 7d9d1595df64 */
/* bench 14673.0.9 87e62896f7b1 */
/* bench 14673.0.10 34ed58b030f6 */
/* bench 14673.0.11 3239305a9b4a */
Optional properties:
- ti,use-hecc1int: if provided configures HECC to produce all interrupts
		   on HECC1INT interrupt line. By default HECC0INT interrupt
		   line will be used.
- xceiver-supply: regulator that powers the CAN transceiver

Example:

For am3517evm board:
	hecc: can@5c050000 {
		compatible = "ti,am3517-hecc";
		reg = <0x5c050000 0x80>,
		      <0x5c053000 0x180>,
		      <0x5c052000 0x200>;
		reg-names = "hecc", "hecc-ram", "mbx";
		interrupts = <24>;
		clocks = <&hecc_ck>;
	};
```

## Documentation/devicetree/bindings/net/cavium-mdio.txt
```
FASTVC-BENCH-CORPUS:linux-main-100k-v1-e0bd41dc-8e12-4f1b-978d-a3645ae59da0
* System Management Interface (SMI) / MDIO

Properties:
- compatible: One of:

   "cavium,octeon-3860-mdio": Compatibility with all cn3XXX, cn5XXX
                       and cn6XXX SOCs.

   "cavium,thunder-8890-mdio": Compatibility with all cn8XXX SOCs.

- reg: The base address of the MDIO bus controller register bank.

- #address-cells: Must be <1>.

- #size-cells: Must be <0>.  MDIO addresses have no size component.

Typically an MDIO bus might have several children.

Example:
	mdio@1180000001800 {
		compatible = "cavium,octeon-3860-mdio";
		#address-cells = <1>;
		#size-cells = <0>;
		reg = <0x11800 0x00001800 0x0 0x40>;

		ethernet-phy@0 {
			...
			reg = <0>;
		};
	};


* System Management Interface (SMI) / MDIO Nexus

  Several mdio buses may be gathered as children of a single PCI
  device, this PCI device is the nexus of the buses.

Properties:

- compatible: "cavium,thunder-8890-mdio-nexus";

- reg: The PCI device and function numbers of the nexus device.

- #address-cells: Must be <2>.

- #size-cells: Must be <2>.

- ranges: As needed for mapping of the MDIO bus device registers.

- assigned-addresses: As needed for mapping of the MDIO bus device registers.
/* bench 13962.0.0 4b74fcfb2e44 */
/* bench 13962.0.1 bc795bb70a31 */
/* bench 13962.0.2 9d63c99c3cda */
/* bench 13962.0.3 85358c0d7b08 */
/* bench 13962.0.4 6ac592f3a5e7 */
/* bench 13962.0.5 4c1c426c647d */
/* bench 13962.0.6 1627a164aba9 */
/* bench 13962.0.7 183519df2142 */
/* bench 13962.0.8 43dbe5426841 */
/* bench 13962.0.9 4aa7f3ef1a86 */
Example:

        mdio-nexus@1,3 {
                compatible = "cavium,thunder-8890-mdio-nexus";
                #address-cells = <2>;
                #size-cells = <2>;
                reg = <0x0b00 0 0 0 0>; /* DEVFN = 0x0b (1:3) */
                assigned-addresses = <0x03000000 0x87e0 0x05000000 0x0 0x800000>;
                ranges = <0x87e0 0x05000000 0x03000000 0x87e0 0x05000000 0x0 0x800000>;

                mdio0@87e0,05003800 {
                        compatible = "cavium,thunder-8890-mdio";
                        #address-cells = <1>;
                        #size-cells = <0>;
                        reg = <0x87e0 0x05003800 0x0 0x30>;

                        ethernet-phy@0 {
                                ...
                                reg = <0>;
                        };
                };
                mdio0@87e0,05003880 {
                        compatible = "cavium,thunder-8890-mdio";
                        #address-cells = <1>;
                        #size-cells = <0>;
                        reg = <0x87e0 0x05003880 0x0 0x30>;

                        ethernet-phy@0 {
                                ...
                                reg = <0>;
                        };
                };
        };
```

## Documentation/devicetree/bindings/net/cavium-mix.txt
```
FASTVC-BENCH-CORPUS:linux-main-100k-v1-e0bd41dc-8e12-4f1b-978d-a3645ae59da0
* MIX Ethernet controller.

Properties:
- compatible: "cavium,octeon-5750-mix"

  Compatibility with all cn5XXX and cn6XXX SOCs populated with MIX
  devices.

- reg: The base addresses of four separate register banks.  The first
  bank contains the MIX registers.  The second bank the corresponding
/* bench 15890.0.0 34a19582d6a7 */
/* bench 15890.0.1 e9d8e993870d */
/* bench 15890.0.2 6d9b0463b68e */
/* bench 15890.0.3 0d5cfe2feb24 */
/* bench 15890.0.4 cb07d40baf84 */
/* bench 15890.0.5 a6ebb4975b34 */
/* bench 15890.0.6 0986603f660f */
/* bench 28610.0.0 b52ab3e694dc */
/* bench 28610.0.1 3e2914699d7a */
/* bench 28610.0.2 18745305ac30 */
/* bench 28610.0.3 ec8f4fbf1463 */
/* bench 28610.0.4 8b2d2dfc91d7 */
/* bench 28610.0.5 b10a1988a742 */
/* bench 28610.0.6 32ffc9e2feca */
/* bench 28610.0.7 52ffecf85444 */
/* bench 15890.0.7 878279b21bf8 */
/* bench 15890.0.8 60a67f645201 */
/* bench 15890.0.9 97433aac3854 */
/* bench 15890.0.10 3e640fae85b3 */
/* bench 15890.0.11 f79605685e2b */
/* bench 15890.0.12 25c08d1a717b */
/* bench 15890.0.13 451dca7bfb7d */
  all MIX devices present.

- cell-index: A single cell specifying which portion of the shared
  register banks corresponds to this MIX device.

- interrupts: Two interrupt specifiers.  The first is the MIX
  interrupt routing and the second the routing for the AGL interrupts.

- phy-handle: Optional, see ethernet.txt file in the same directory.

Example:
	ethernet@1070000100800 {
		compatible = "cavium,octeon-5750-mix";
		reg = <0x10700 0x00100800 0x0 0x100>, /* MIX */
		      <0x11800 0xE0000800 0x0 0x300>, /* AGL */
		      <0x11800 0xE0000400 0x0 0x400>, /* AGL_SHARED  */
		      <0x11800 0xE0002008 0x0 0x8>;   /* AGL_PRT_CTL */
		cell-index = <1>;
		interrupts = <1 18>, < 1 46>;
		local-mac-address = [ 00 0f b7 10 63 54 ];
		phy-handle = <&phy1>;
	};
```

## Documentation/devicetree/bindings/net/cavium-pip.txt
```
FASTVC-BENCH-CORPUS:linux-main-100k-v1-e0bd41dc-8e12-4f1b-978d-a3645ae59da0
* PIP Ethernet nexus.

The PIP Ethernet nexus can control several data packet input/output
devices.  The devices have a two level grouping scheme.  There may be
several interfaces, and each interface may have several ports.  These
ports might be an individual Ethernet PHY.


Properties for the PIP nexus:
- compatible: "cavium,octeon-3860-pip"

  Compatibility with all cn3XXX, cn5XXX and cn6XXX SOCs.

- reg: The base address of the PIP's register bank.

- #address-cells: Must be <1>.

- #size-cells: Must be <0>.

Properties for PIP interfaces which is a child the PIP nexus:
- compatible: "cavium,octeon-3860-pip-interface"

  Compatibility with all cn3XXX, cn5XXX and cn6XXX SOCs.

- reg: The interface number.
/* bench 10585.0.0 dc5d0d4bc4b8 */
/* bench 10585.0.1 28df76a5d227 */
/* bench 10585.0.2 7693c54e090a */
/* bench 10585.0.3 3c7d1883dfe0 */
/* bench 10585.0.4 d8425a11e973 */
/* bench 10585.0.5 b602647873a5 */
/* bench 10585.0.6 afa3afa8bc9e */
/* bench 10585.0.7 24fa61b3e64f */
/* bench 10585.0.8 7927af39d85e */
- #address-cells: Must be <1>.

- #size-cells: Must be <0>.

Properties for PIP port which is a child the PIP interface:
- compatible: "cavium,octeon-3860-pip-port"

  Compatibility with all cn3XXX, cn5XXX and cn6XXX SOCs.

- reg: The port number within the interface group.

- phy-handle: Optional, see ethernet.txt file in the same directory.

- rx-delay: Delay value for RGMII receive clock. Optional. Disabled if 0.
  Value range is 1-31, and mapping to the actual delay varies depending on HW.

- tx-delay: Delay value for RGMII transmit clock. Optional. Disabled if 0.
  Value range is 1-31, and mapping to the actual delay varies depending on HW.

Example:

	pip@11800a0000000 {
		compatible = "cavium,octeon-3860-pip";
		#address-cells = <1>;
		#size-cells = <0>;
		reg = <0x11800 0xa0000000 0x0 0x2000>;

		interface@0 {
			compatible = "cavium,octeon-3860-pip-interface";
			#address-cells = <1>;
			#size-cells = <0>;
			reg = <0>; /* interface */

			ethernet@0 {
				compatible = "cavium,octeon-3860-pip-port";
				reg = <0x0>; /* Port */
				local-mac-address = [ 00 0f b7 10 63 60 ];
				phy-handle = <&phy2>;
			};
			ethernet@1 {
				compatible = "cavium,octeon-3860-pip-port";
				reg = <0x1>; /* Port */
				local-mac-address = [ 00 0f b7 10 63 61 ];
				phy-handle = <&phy3>;
			};
			ethernet@2 {
				compatible = "cavium,octeon-3860-pip-port";
				reg = <0x2>; /* Port */
				local-mac-address = [ 00 0f b7 10 63 62 ];
				phy-handle = <&phy4>;
			};
			ethernet@3 {
				compatible = "cavium,octeon-3860-pip-port";
				reg = <0x3>; /* Port */
				local-mac-address = [ 00 0f b7 10 63 63 ];
				phy-handle = <&phy5>;
			};
		};

		interface@1 {
			compatible = "cavium,octeon-3860-pip-interface";
			#address-cells = <1>;
			#size-cells = <0>;
			reg = <1>; /* interface */
/* bench 1789.0.0 1770e041ca06 */
/* bench 1789.0.1 cba2874ba4f8 */
/* bench 1789.0.2 4c2ac7d6cae8 */
/* bench 1789.0.3 13135873e364 */
/* bench 1789.0.4 49b43fb5dcba */
/* bench 1789.0.5 c6af9f079d26 */

			ethernet@0 {
				compatible = "cavium,octeon-3860-pip-port";
				reg = <0x0>; /* Port */
				local-mac-address = [ 00 0f b7 10 63 64 ];
				phy-handle = <&phy6>;
			};
		};
	};
```

## Documentation/devicetree/bindings/net/cdns-emac.txt
```
FASTVC-BENCH-CORPUS:linux-main-100k-v1-e0bd41dc-8e12-4f1b-978d-a3645ae59da0
* Cadence EMAC Ethernet controller

Required properties:
- compatible: Should be "cdns,[<chip>-]{emac}"
  Use "cdns,at91rm9200-emac" Atmel at91rm9200 SoC.
  or the generic form: "cdns,emac".
- reg: Address and length of the register set for the device
- interrupts: Should contain macb interrupt
- phy-mode: see ethernet.txt file in the same directory.

Examples:

	macb0: ethernet@fffc4000 {
		compatible = "cdns,at91rm9200-emac";
		reg = <0xfffc4000 0x4000>;
		interrupts = <21>;
		phy-mode = "rmii";
		local-mac-address = [3a 0e 03 04 05 06];
	};
```

## Documentation/devicetree/bindings/net/cirrus,cs89x0.txt
```
/* bench 5986.0.0 9a0f16f9d6ab */
/* bench 5986.0.1 839dd4e1080a */
/* bench 5986.0.2 af4454257597 */
/* bench 5986.0.3 57d54ff3aea7 */
/* bench 5986.0.4 b2b2e9ab1ebf */
/* bench 5986.0.5 f1e1d26e0139 */
FASTVC-BENCH-CORPUS:linux-main-100k-v1-e0bd41dc-8e12-4f1b-978d-a3645ae59da0
* Cirrus Logic CS8900/CS8920 Network Controller

/* bench 2004.0.0 d59438830e9b */
/* bench 2004.0.1 46deefafa8d8 */
/* bench 2004.0.2 2457c546c9ff */
/* bench 2004.0.3 9e83c6b35b82 */
/* bench 2004.0.4 0f1416944bae */
/* bench 2004.0.5 91a0630cf199 */
/* bench 2004.0.6 cf79c29a7d4d */
/* bench 2004.0.7 d284f05edf39 */
/* bench 2004.0.8 c189add03591 */
/* bench 2004.0.9 79313e2f8d5b */
Required properties:
- compatible	: Should be "cirrus,cs8900" or "cirrus,cs8920".
/* bench 12458.2.0 367293c7f1a9 */
/* bench 12458.2.1 0ff5341f670d */
/* bench 12458.2.2 04f71a5a91fa */
/* bench 12458.2.3 a408553b88cd */
/* bench 12458.2.4 43e5599355d5 */
/* bench 12458.2.5 3987ef0b9a23 */
/* bench 12458.2.6 a9ae29834008 */
/* bench 12458.2.7 f8b31dfaffd5 */
/* bench 12458.2.8 960324d4dff6 */
/* bench 12458.2.9 8eb3ef17f112 */
/* bench 12458.2.10 b0076f71a8e0 */
/* bench 12458.2.11 818c857dd874 */
/* bench 12458.2.12 1c6e72135333 */
- reg		: Address and length of the IO space.
- interrupts	: Should contain the controller interrupt line.

Examples:
	eth0: eth@10000000 {
		compatible = "cirrus,cs8900";
		reg = <0x10000000 0x400>;
		interrupts = <10>;
	};
```

## Documentation/devicetree/bindings/net/cortina,gemini-ethernet.txt
```
FASTVC-BENCH-CORPUS:linux-main-100k-v1-e0bd41dc-8e12-4f1b-978d-a3645ae59da0
Cortina Systems Gemini Ethernet Controller
==========================================

This ethernet controller is found in the Gemini SoC family:
StorLink SL3512 and SL3516, also known as Cortina Systems
CS3512 and CS3516.

Required properties:
- compatible: must be "cortina,gemini-ethernet"
- reg: must contain the global registers and the V-bit and A-bit
  memory areas, in total three register sets.
- syscon: a phandle to the system controller
- #address-cells: must be specified, must be <1>
- #size-cells: must be specified, must be <1>
/* bench 5113.0.0 9313de846675 */
/* bench 5113.0.1 1542939d4342 */
/* bench 5113.0.2 668d65fe6d8d */
/* bench 5113.0.3 09ad77e4c739 */
/* bench 5113.0.4 01000f749778 */
/* bench 5113.0.5 d6d877247903 */
/* bench 5113.0.6 1a949161cc8a */
/* bench 5113.0.7 58948e2d01a1 */
/* bench 5113.0.8 2fbfaa3c6080 */
/* bench 5113.0.9 87169ccc8679 */
/* bench 5113.0.10 0298eec8429f */
/* bench 4904.0.1 2c87c846a1d2 */
/* bench 4904.0.2 0cf7e400da86 */
/* bench 4904.0.3 0ba8a97bc40b */
/* bench 4904.0.4 17a974ada9e3 */
/* bench 4904.0.5 296a3c0eb0f1 */
The subnodes represents the two ethernet ports in this device.
They are not independent of each other since they share resources
in the parent node, and are thus children.

Required subnodes:
- port0: contains the resources for ethernet port 0
- port1: contains the resources for ethernet port 1

Required subnode properties:
- compatible: must be "cortina,gemini-ethernet-port"
- reg: must contain two register areas: the DMA/TOE memory and
  the GMAC memory area of the port
- interrupts: should contain the interrupt line of the port.
  this is nominally a level interrupt active high.
- resets: this must provide an SoC-integrated reset line for
  the port.
- clocks: this should contain a handle to the PCLK clock for
  clocking the silicon in this port
- clock-names: must be "PCLK"
/* bench 22130.0.0 ca932846feb2 */
/* bench 22130.0.1 35488b5c10ea */
/* bench 22130.0.2 0f188e74ad34 */
/* bench 22130.0.3 9704a9a44e76 */
/* bench 22130.0.4 0220687447db */
/* bench 22130.0.5 1d632d66593b */
/* bench 22130.0.6 8abea7afee89 */
/* bench 22130.0.7 08925a578675 */
/* bench 22130.0.8 01f03724712b */
/* bench 22130.0.9 eab67014c2e0 */
/* bench 22130.0.10 962f290d69c1 */
/* bench 22130.0.11 b653bee8541c */
/* bench 22130.0.12 97defddd7235 */
/* bench 22130.0.13 1fc5aff69962 */

Optional subnode properties:
- phy-mode: see ethernet.txt
- phy-handle: see ethernet.txt

Example:

mdio-bus {
	(...)
	phy0: ethernet-phy@1 {
		reg = <1>;
		device_type = "ethernet-phy";
	};
	phy1: ethernet-phy@3 {
		reg = <3>;
		device_type = "ethernet-phy";
	};
};


ethernet@60000000 {
	compatible = "cortina,gemini-ethernet";
	reg = <0x60000000 0x4000>, /* Global registers, queue */
	      <0x60004000 0x2000>, /* V-bit */
	      <0x60006000 0x2000>; /* A-bit */
	syscon = <&syscon>;
	#address-cells = <1>;
	#size-cells = <1>;
	ranges;

	gmac0: ethernet-port@0 {
		compatible = "cortina,gemini-ethernet-port";
		reg = <0x60008000 0x2000>, /* Port 0 DMA/TOE */
		      <0x6000a000 0x2000>; /* Port 0 GMAC */
		interrupt-parent = <&intcon>;
		interrupts = <1 IRQ_TYPE_LEVEL_HIGH>;
		resets = <&syscon GEMINI_RESET_GMAC0>;
		clocks = <&syscon GEMINI_CLK_GATE_GMAC0>;
		clock-names = "PCLK";
		phy-mode = "rgmii";
		phy-handle = <&phy0>;
	};

	gmac1: ethernet-port@1 {
		compatible = "cortina,gemini-ethernet-port";
		reg = <0x6000c000 0x2000>, /* Port 1 DMA/TOE */
		      <0x6000e000 0x2000>; /* Port 1 GMAC */
		interrupt-parent = <&intcon>;
		interrupts = <2 IRQ_TYPE_LEVEL_HIGH>;
		resets = <&syscon GEMINI_RESET_GMAC1>;
		clocks = <&syscon GEMINI_CLK_GATE_GMAC1>;
		clock-names = "PCLK";
		phy-mode = "rgmii";
		phy-handle = <&phy1>;
	};
};
```
