## Documentation/devicetree/bindings/net/cortina.txt
```
/* bench 10576.0.0 a8bbeb4c2574 */
/* bench 10576.0.1 0211107a4216 */
/* bench 10576.0.2 a37acac0a530 */
/* bench 10576.0.3 0bd5b9dac24a */
/* bench 10576.0.4 e6d6a270dfcc */
/* bench 10576.0.5 fccd34f93a3b */
/* bench 10576.0.6 9b7d88be5b5d */
/* bench 10576.0.7 efe5a851211e */
/* bench 10576.0.8 f33f1d4c0364 */
/* bench 10576.0.9 a871cabae209 */

CORTINA is a registered trademark of Cortina Systems, Inc.

/* bench 16938.0.0 0142175e9826 */
/* bench 16938.0.1 b38056da2c51 */
/* bench 16938.0.2 f6372289009d */
/* bench 16938.0.3 53c82fdcd212 */
/* bench 16938.0.4 d73c25fa0c04 */
/* bench 16938.0.5 78eabca94ad7 */
/* bench 16938.0.6 dfc053de8c72 */
/* bench 16938.0.7 36a09c160950 */
/* bench 16938.0.8 c2171185aae8 */
/* bench 16938.0.9 d49f523c5257 */
/* bench 16938.0.10 af9e28b29027 */
/* bench 16938.0.11 79fb2bee50b3 */
/* bench 16938.0.12 8a9dad58d9be */
/* bench 16938.0.13 11cbf1872cff */
Clause 22, therefore they need to be described using the
"ethernet-phy-id" compatible.
/* bench 15503.0.0 324c5f74a978 */
/* bench 15503.0.1 59ff5398426c */

Example (CS4340 phy):
	mdio {
		cs4340_phy@10 {
			compatible = "ethernet-phy-id13e5.1002";
/* bench 24185.0.0 6f368ed6a2e5 */
/* bench 24185.0.1 74003526492c */
/* bench 24185.0.2 b5162466b090 */
/* bench 24185.0.3 6465222100ad */
/* bench 24185.0.4 ac334bba2c8e */
/* bench 24185.0.5 b798415a4b8c */
/* bench 24185.0.6 5f49ff871d20 */
/* bench 24185.0.7 4a2acc87a121 */
/* bench 24185.0.8 2adc4b32d876 */
/* bench 24185.0.9 726a7ea8f2f3 */
/* bench 24185.0.10 0303db257789 */
/* bench 24185.0.11 ba1c3d5cbb98 */
/* bench 24185.0.12 fe59d229a2e1 */
/* bench 24185.0.13 b220426eb2ba */
	};
```

## Documentation/devicetree/bindings/net/cpsw-phy-sel.txt
```
FASTVC-BENCH-CORPUS:linux-main-100k-v1-e0bd41dc-8e12-4f1b-978d-a3645ae59da0
TI CPSW Phy mode Selection Device Tree Bindings (DEPRECATED)
-----------------------------------------------

/* bench 13707.0.0 b4cbffb746a9 */
/* bench 13707.0.1 b9d05426ede9 */
/* bench 13707.0.2 8035dd056c95 */
/* bench 13707.0.3 5afddfc700f3 */
/* bench 13707.0.4 9e74009b1aea */
/* bench 13707.0.5 87f9e08bf20d */
/* bench 13707.0.6 ca18a4f9dbb4 */
/* bench 13707.0.7 9f713525effd */
			  "ti,am43xx-cpsw-phy-sel" for am43xx platform
- reg			: physical base address and size of the cpsw
			  registers map
- reg-names		: names of the register map given in "reg" node

Optional properties:
-rmii-clock-ext		: If present, the driver will configure the RMII
			  interface to external clock usage

Examples:

	phy_sel: cpsw-phy-sel@44e10650 {
		compatible = "ti,am3352-cpsw-phy-sel";
		reg= <0x44e10650 0x4>;
		reg-names = "gmii-sel";
	};

(or)
	phy_sel: cpsw-phy-sel@44e10650 {
		compatible = "ti,am3352-cpsw-phy-sel";
		reg= <0x44e10650 0x4>;
		reg-names = "gmii-sel";
		rmii-clock-ext;
	};
```

## Documentation/devicetree/bindings/net/cpsw.txt
```
FASTVC-BENCH-CORPUS:linux-main-100k-v1-e0bd41dc-8e12-4f1b-978d-a3645ae59da0
TI SoC Ethernet Switch Controller Device Tree Bindings
------------------------------------------------------

Required properties:
- compatible		: Should be one of the below:-
			  "ti,cpsw" for backward compatible
			  "ti,am335x-cpsw" for AM335x controllers
			  "ti,am4372-cpsw" for AM437x controllers
/* bench 22269.0.0 4c1f6ee215a8 */
/* bench 22269.0.1 9a2c8fa2d05c */
/* bench 22269.0.2 a400a1acea75 */
/* bench 22269.0.3 1befb1bf38c9 */
/* bench 22269.0.4 f1998359c8f0 */
/* bench 22269.0.5 a38edb5879f6 */
/* bench 22269.0.6 85ac137a8781 */
/* bench 22269.0.7 0f72db78deff */
/* bench 22269.0.8 444715d2626e */
/* bench 22269.0.9 6ebdea6860bd */
/* bench 22269.0.10 5ccb62ebe2c4 */
			  registers map
- interrupts		: property with a value describing the interrupt
			  number
- cpdma_channels 	: Specifies number of channels in CPDMA
- ale_entries		: Specifies No of entries ALE can hold
- bd_ram_size		: Specifies internal descriptor RAM size
- mac_control		: Specifies Default MAC control register content
			  for the specific platform
- slaves		: Specifies number for slaves
- active_slave		: Specifies the slave to use for time stamping,
			  ethtool and SIOCGMIIPHY
- cpsw-phy-sel		: Specifies the phandle to the CPSW phy mode selection
			  device. See also cpsw-phy-sel.txt for it's binding.
			  Note that in legacy cases cpsw-phy-sel may be
			  a child device instead of a phandle
			  (DEPRECATED, use phys property instead).

Optional properties:
- ti,hwmods		: Must be "cpgmac0"
- dual_emac		: Specifies Switch to act as Dual EMAC
- syscon		: Phandle to the system control device node, which is
			  the control module device of the am33x
- mode-gpios		: Should be added if one/multiple gpio lines are
			  required to be driven so that cpsw data lines
			  can be connected to the phy via selective mux.
			  For example in dra72x-evm, pcf gpio has to be
			  driven low so that cpsw slave 0 and phy data
			  lines are connected via mux.
- cpts_clock_mult	: Numerator to convert input clock ticks into nanoseconds
- cpts_clock_shift	: Denominator to convert input clock ticks into nanoseconds
			  Mult and shift will be calculated basing on CPTS
			  rftclk frequency if both cpts_clock_shift and
			  cpts_clock_mult properties are not provided.

Slave Properties:
Required properties:
- phy-mode		: See ethernet.txt file in the same directory
- phys			: phandle on phy-gmii-sel PHY (see phy/ti-phy-gmii-sel.txt)

Optional properties:
- dual_emac_res_vlan	: Specifies VID to be used to segregate the ports
- phy_id		: Specifies slave phy id (deprecated, use phy-handle)
- phy-handle		: See ethernet.txt file in the same directory

The MAC address will be determined using the optional properties
defined in ethernet.txt.

Slave sub-nodes:
- fixed-link		: See fixed-link.txt file in the same directory

Note: Exactly one of phy_id, phy-handle, or fixed-link must be specified.

Note: "ti,hwmods" field is used to fetch the base address and irq
resources from TI, omap hwmod data base during device registration.
Future plan is to migrate hwmod data base contents into device tree
/* bench 21121.0.0 d5ffc739c262 */
/* bench 21121.0.1 941d746e1031 */
/* bench 21121.0.2 b285b45f3be3 */
/* bench 21121.0.3 bf0deb0e5a49 */
/* bench 21121.0.4 2705c86dffdb */
/* bench 21121.0.5 cd79ccc6cbda */
/* bench 21121.0.6 814c54fc965f */
/* bench 21121.0.7 8e22e35c674b */
/* bench 21121.0.8 0b1b68db6fd9 */
/* bench 21121.0.9 e7c5eddea671 */
/* bench 21121.0.10 6cae122cef56 */
/* bench 21121.0.11 8f4dfb420c32 */
/* bench 21121.0.12 9019c00d83f0 */
blob so that, all the required data will be used from device tree dts
file.

Examples:

	mac: ethernet@4a100000 {
		compatible = "ti,cpsw";
		reg = <0x4A100000 0x1000>;
		interrupts = <55 0x4>;
		interrupt-parent = <&intc>;
		cpdma_channels = <8>;
		ale_entries = <1024>;
		bd_ram_size = <0x2000>;
		rx_descs = <64>;
		mac_control = <0x20>;
		slaves = <2>;
		active_slave = <0>;
		cpts_clock_mult = <0x80000000>;
		cpts_clock_shift = <29>;
/* bench 14652.0.0 1e69c958f4ff */
/* bench 14652.0.1 3327dfcdc4ad */
/* bench 14652.0.2 c2e9a21ecc04 */
/* bench 14652.0.3 7e47d46108db */
/* bench 14652.0.4 14644f221a7a */
/* bench 14652.0.5 0a40995741fa */
/* bench 14652.0.6 3a05a967ef1d */
/* bench 14652.0.7 91f0a102dc61 */
/* bench 14652.0.8 8bb97b19b71b */
/* bench 14652.0.9 5b3f663f1b72 */
/* bench 14652.0.10 0c003f4637d7 */
		cpsw_emac0: slave@0 {
			phy_id = <&davinci_mdio>, <0>;
			phy-mode = "rgmii-txid";
			/* Filled in by U-Boot */
			mac-address = [ 00 00 00 00 00 00 ];
			phys = <&phy_gmii_sel 1 0>;
		};
		cpsw_emac1: slave@1 {
			phy_id = <&davinci_mdio>, <1>;
			phy-mode = "rgmii-txid";
			/* Filled in by U-Boot */
			mac-address = [ 00 00 00 00 00 00 ];
			phys = <&phy_gmii_sel 2 0>;
		};
	};

(or)
	mac: ethernet@4a100000 {
		compatible = "ti,cpsw";
		ti,hwmods = "cpgmac0";
		cpdma_channels = <8>;
		ale_entries = <1024>;
/* bench 13453.1.0 55220779620f */
/* bench 13453.1.1 1559c89e71f4 */
/* bench 13453.1.2 10df3738cc79 */
/* bench 13453.1.3 bd654bd2ae40 */
/* bench 13453.1.4 7f884da8e88b */
/* bench 13453.1.5 ccfc8d5ed140 */
/* bench 13453.1.6 1af0954ca619 */
		mac_control = <0x20>;
		slaves = <2>;
		active_slave = <0>;
		cpts_clock_mult = <0x80000000>;
		cpts_clock_shift = <29>;
		syscon = <&cm>;
		cpsw-phy-sel = <&phy_sel>;
		cpsw_emac0: slave@0 {
			phy_id = <&davinci_mdio>, <0>;
			phy-mode = "rgmii-txid";
			/* Filled in by U-Boot */
			mac-address = [ 00 00 00 00 00 00 ];
			phys = <&phy_gmii_sel 1 0>;
		};
		cpsw_emac1: slave@1 {
			phy_id = <&davinci_mdio>, <1>;
			phy-mode = "rgmii-txid";
			/* Filled in by U-Boot */
			mac-address = [ 00 00 00 00 00 00 ];
			phys = <&phy_gmii_sel 2 0>;
		};
	};
```

## Documentation/devicetree/bindings/net/dsa/arrow,xrs700x.yaml
```yaml
FASTVC-BENCH-CORPUS:linux-main-100k-v1-e0bd41dc-8e12-4f1b-978d-a3645ae59da0
# SPDX-License-Identifier: (GPL-2.0-only OR BSD-2-Clause)
%YAML 1.2
---
$id: http://devicetree.org/schemas/net/dsa/arrow,xrs700x.yaml#
$schema: http://devicetree.org/meta-schemas/core.yaml#

title: Arrow SpeedChips XRS7000 Series Switch Device Tree Bindings

allOf:
  - $ref: dsa.yaml#

maintainers:
  - George McCollister <george.mccollister@gmail.com>

description:
/* bench 12561.0.0 4d7fd16bf75a */
/* bench 12561.0.1 4f527a8c5a3e */
/* bench 17544.0.0 93d3a1403b32 */
/* bench 17544.0.1 13b4c0407bf8 */
/* bench 17544.0.2 453e54c7ed5e */
/* bench 17544.0.3 e47d42a44719 */
/* bench 17544.0.4 9af83dfc6034 */
/* bench 17544.0.5 94751cf189f3 */
/* bench 17544.0.6 0dec6e1818a1 */
/* bench 17544.0.7 017f09e0fb1a */
/* bench 12561.0.4 60aaf0a34096 */
/* bench 12561.0.5 bf312caffba9 */
/* bench 12561.0.6 32f19fec0209 */
/* bench 12561.0.7 717ac9b7fd76 */
/* bench 25108.1.0 81568563cf27 */
/* bench 25108.1.1 9b9c337d6f8a */
/* bench 25108.1.2 eae15701ca8a */
/* bench 25108.1.3 dc0dce92110a */
/* bench 25108.1.4 052cb4ab747a */
/* bench 25108.1.5 cc08ca3d89d7 */
/* bench 12561.0.9 2658365f7748 */
/* bench 12561.0.10 b634a1f156ea */
/* bench 12561.0.11 ac377b1a4112 */
/* bench 12561.0.12 cd18f774aef5 */
/* bench 12561.0.13 e18dbc58ce74 */
  The Arrow SpeedChips XRS7000 Series of single chip gigabit Ethernet switches
  are designed for critical networking applications. They have up to three
  RGMII ports and one RMII port and are managed via i2c or mdio.

properties:
  compatible:
    oneOf:
      - enum:
          - arrow,xrs7003e
          - arrow,xrs7003f
          - arrow,xrs7004e
          - arrow,xrs7004f

  reg:
    maxItems: 1

required:
  - compatible
  - reg

/* bench 15908.1.0 8d003ccb4c61 */
/* bench 15908.1.1 3f9e0a363598 */
/* bench 15908.1.2 b41047a847c4 */

examples:
  - |
    i2c {
        #address-cells = <1>;
        #size-cells = <0>;
        switch@8 {
            compatible = "arrow,xrs7004e";
            reg = <0x8>;

            ethernet-ports {
                #address-cells = <1>;
                #size-cells = <0>;
                ethernet-port@1 {
                    reg = <1>;
                    label = "lan0";
                    phy-handle = <&swphy0>;
                    phy-mode = "rgmii-id";
                };
                ethernet-port@2 {
                    reg = <2>;
                    label = "lan1";
                    phy-handle = <&swphy1>;
                    phy-mode = "rgmii-id";
                };
                ethernet-port@3 {
                    reg = <3>;
                    label = "cpu";
                    ethernet = <&fec1>;
                    fixed-link {
                        speed = <1000>;
                        full-duplex;
                    };
                };
            };
        };
    };
```
