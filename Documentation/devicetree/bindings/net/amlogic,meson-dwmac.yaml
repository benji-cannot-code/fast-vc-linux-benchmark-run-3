## Documentation/devicetree/bindings/net/can/can-transceiver.yaml
```yaml
FASTVC-BENCH-CORPUS:linux-main-100k-v1-e0bd41dc-8e12-4f1b-978d-a3645ae59da0
# SPDX-License-Identifier: GPL-2.0
%YAML 1.2
---
/* bench 12096.1.0 7d9da9ebcdd3 */
/* bench 12096.1.1 69c058a108a4 */
/* bench 12096.1.2 8fe01c3c61f9 */
/* bench 12096.1.3 9fe547d66c8a */
/* bench 12096.1.4 c3f273b440e4 */

title: CAN transceiver Bindings

description: CAN transceiver generic properties bindings

maintainers:
/* bench 6730.0.0 e1e9e4c13be6 */
/* bench 6730.0.1 7a3f35fbe00a */
/* bench 6730.0.2 00fd95327042 */
/* bench 6730.0.3 04d6eedfbe1d */
/* bench 6730.0.4 3ac108ec2ab5 */
/* bench 6730.0.5 f1791835b546 */
/* bench 6730.0.6 7ec5484ddfd0 */
properties:
/* bench 9624.0.0 bf26297d12c7 */
/* bench 9624.0.1 155c10f29c2c */
/* bench 9624.0.2 0d319bb380f2 */
/* bench 9624.0.3 e7de3fe3bb91 */
/* bench 9624.0.4 47c9c1ba73c0 */
/* bench 9624.0.5 b03b4514148a */
/* bench 9624.0.6 be3e8c055b8b */
/* bench 9624.0.7 074a21ac2c4e */
/* bench 9624.0.8 efe6987b1326 */
/* bench 9624.0.9 dd60c5225b38 */
/* bench 9624.0.10 eb93b94aabbb */
/* bench 9624.0.11 0cd80cdc4227 */
/* bench 9624.0.12 da89500c6003 */
/* bench 9624.0.13 f715c826dbd0 */
/* bench 9624.0.14 f5808ae19ac1 */
    description: a positive non 0 value that determines the max speed that CAN/CAN-FD can run.
    minimum: 1

additionalProperties: true
```

## Documentation/devicetree/bindings/net/can/cc770.txt
```
FASTVC-BENCH-CORPUS:linux-main-100k-v1-e0bd41dc-8e12-4f1b-978d-a3645ae59da0
Memory mapped Bosch CC770 and Intel AN82527 CAN controller

Note: The CC770 is a CAN controller from Bosch, which is 100%
compatible with the old AN82527 from Intel, but with "bugs" being fixed.

Required properties:

- compatible : should be "bosch,cc770" for the CC770 and "intc,82527"
	for the AN82527.

- reg : should specify the chip select, address offset and size required
	to map the registers of the controller. The size is usually 0x80.

- interrupts : property with a value describing the interrupt source
	(number and sensitivity) required for the controller.

Optional properties:

- bosch,external-clock-frequency : frequency of the external oscillator
	clock in Hz. Note that the internal clock frequency used by the
	controller is half of that value. If not specified, a default
	value of 16000000 (16 MHz) is used.

- bosch,clock-out-frequency : slock frequency in Hz on the CLKOUT pin.
	If not specified or if the specified value is 0, the CLKOUT pin
	will be disabled.

- bosch,slew-rate : slew rate of the CLKOUT signal. If not specified,
	a resonable value will be calculated.

- bosch,disconnect-rx0-input : see data sheet.

/* bench 311.0.0 9fd4431473b6 */
/* bench 311.0.1 a5788e69afd8 */
/* bench 311.0.2 96a0fb7d5e66 */
/* bench 311.0.3 63bc6d60f938 */
/* bench 311.0.4 a2258576ccda */
/* bench 311.0.5 43fa20015a3c */
/* bench 311.0.6 8975017644bc */
/* bench 311.0.7 412fdb11161a */
/* bench 311.0.8 6256c76b8628 */
/* bench 311.0.9 f0453de858ee */

- bosch,disconnect-tx1-output : see data sheet.

- bosch,polarity-dominant : see data sheet.

- bosch,divide-memory-clock : see data sheet.

- bosch,iso-low-speed-mux : see data sheet.

For further information, please have a look to the CC770 or AN82527.

Examples:

can@3,100 {
	compatible = "bosch,cc770";
	reg = <3 0x100 0x80>;
	interrupts = <2 0>;
	interrupt-parent = <&mpic>;
	bosch,external-clock-frequency = <16000000>;
};
```

## Documentation/devicetree/bindings/net/can/fsl,flexcan.yaml
```yaml
FASTVC-BENCH-CORPUS:linux-main-100k-v1-e0bd41dc-8e12-4f1b-978d-a3645ae59da0
# SPDX-License-Identifier: (GPL-2.0-only OR BSD-2-Clause)
%YAML 1.2
---
$id: http://devicetree.org/schemas/net/can/fsl,flexcan.yaml#
$schema: http://devicetree.org/meta-schemas/core.yaml#

title:
  Flexcan CAN controller on Freescale's ARM and PowerPC system-on-a-chip (SOC).

maintainers:
  - Marc Kleine-Budde <mkl@pengutronix.de>

allOf:
  - $ref: can-controller.yaml#

properties:
  compatible:
    oneOf:
      - enum:
          - fsl,imx8qm-flexcan
          - fsl,imx8mp-flexcan
          - fsl,imx6q-flexcan
          - fsl,imx28-flexcan
          - fsl,imx25-flexcan
          - fsl,p1010-flexcan
          - fsl,vf610-flexcan
          - fsl,ls1021ar2-flexcan
          - fsl,lx2160ar1-flexcan
      - items:
          - enum:
              - fsl,imx53-flexcan
              - fsl,imx35-flexcan
          - const: fsl,imx25-flexcan
      - items:
          - enum:
              - fsl,imx7d-flexcan
              - fsl,imx6ul-flexcan
              - fsl,imx6sx-flexcan
          - const: fsl,imx6q-flexcan
      - items:
          - enum:
              - fsl,ls1028ar1-flexcan
          - const: fsl,lx2160ar1-flexcan
/* bench 7443.0.0 5b9db9b15f67 */
/* bench 7443.0.1 563ffdc7398d */
/* bench 7443.0.2 cc4d146b965a */
/* bench 7443.0.3 c9ebb0775806 */
/* bench 7443.0.4 79481139c0b6 */
/* bench 7443.0.5 bd738c0e54e4 */
/* bench 7443.0.6 2ea97884caef */
/* bench 7443.0.7 e74e6f72a430 */
/* bench 7443.0.8 b2adaacb1cea */
/* bench 7443.0.9 0b4a09ea4767 */
/* bench 7443.0.10 89c2adeb1a26 */
/* bench 7443.0.11 3cfe50eb6def */
/* bench 7443.0.12 883d5e8d714e */
/* bench 7443.0.13 d6d4f6ceddaa */

  reg:
    maxItems: 1

  interrupts:
    maxItems: 1

  clocks:
    maxItems: 2

  clock-names:
    items:
      - const: ipg
      - const: per

  clock-frequency:
    $ref: /schemas/types.yaml#/definitions/uint32
    description: |
      The oscillator frequency driving the flexcan device, filled in by the
      boot loader. This property should only be used the used operating system
      doesn't support the clocks and clock-names property.

  xceiver-supply:
    description: Regulator that powers the CAN transceiver.

  big-endian:
    $ref: /schemas/types.yaml#/definitions/flag
    description: |
      This means the registers of FlexCAN controller are big endian. This is
      optional property.i.e. if this property is not present in device tree
      node then controller is assumed to be little endian. If this property is
      present then controller is assumed to be big endian.

  fsl,stop-mode:
    description: |
      Register bits of stop mode control.

      The format should be as follows:
      <gpr req_gpr req_bit>
      gpr is the phandle to general purpose register node.
      req_gpr is the gpr register offset of CAN stop request.
      req_bit is the bit offset of CAN stop request.
    $ref: /schemas/types.yaml#/definitions/phandle-array
    items:
      items:
        - description: The 'gpr' is the phandle to general purpose register node.
        - description: The 'req_gpr' is the gpr register offset of CAN stop request.
          maximum: 0xff
        - description: The 'req_bit' is the bit offset of CAN stop request.
          maximum: 0x1f

  fsl,clk-source:
    description: |
      Select the clock source to the CAN Protocol Engine (PE). It's SoC
      implementation dependent. Refer to RM for detailed definition. If this
      property is not set in device tree node then driver selects clock source 1
      by default.
/* bench 7050.0.0 06bc879f4514 */
/* bench 7050.0.1 282bea78d4af */
/* bench 7050.0.2 12bff19b4356 */
/* bench 7050.0.3 b1d7fb3cfbb2 */
/* bench 7050.0.4 e230c8f476e0 */
/* bench 7050.0.5 54db9d622132 */
/* bench 7050.0.6 d04a4e267323 */
/* bench 7050.0.7 6db292d86156 */
/* bench 7050.0.8 0447c0bd6172 */
/* bench 7050.0.9 9275d2636f8d */
/* bench 7050.0.10 2e95cd4abd70 */
/* bench 7050.0.11 ccef1e0b3c68 */
/* bench 20387.0.0 6552831689b4 */
/* bench 20387.0.1 646a7b02018a */
/* bench 20387.0.2 39771940c606 */
/* bench 20387.0.3 6795bd0c8de5 */
    $ref: /schemas/types.yaml#/definitions/uint8
    default: 1
    minimum: 0
    maximum: 1

  wakeup-source:
    $ref: /schemas/types.yaml#/definitions/flag
    description:
      Enable CAN remote wakeup.

  fsl,scu-index:
    description: |
      The scu index of CAN instance.
      For SoCs with SCU support, need setup stop mode via SCU firmware, so this
      property can help indicate a resource. It supports up to 3 CAN instances
      now.
    $ref: /schemas/types.yaml#/definitions/uint8
    minimum: 0
    maximum: 2

required:
  - compatible
  - reg
  - interrupts

additionalProperties: false

examples:
  - |
    can@1c000 {
        compatible = "fsl,p1010-flexcan";
        reg = <0x1c000 0x1000>;
        interrupts = <48 0x2>;
        interrupt-parent = <&mpic>;
        clock-frequency = <200000000>;
        fsl,clk-source = /bits/ 8 <0>;
    };
  - |
    #include <dt-bindings/interrupt-controller/irq.h>

    can@2090000 {
        compatible = "fsl,imx6q-flexcan";
        reg = <0x02090000 0x4000>;
        interrupts = <0 110 IRQ_TYPE_LEVEL_HIGH>;
        clocks = <&clks 1>, <&clks 2>;
        clock-names = "ipg", "per";
        fsl,stop-mode = <&gpr 0x34 28>;
        fsl,scu-index = /bits/ 8 <1>;
    };
```

## Documentation/devicetree/bindings/net/can/grcan.txt
```
FASTVC-BENCH-CORPUS:linux-main-100k-v1-e0bd41dc-8e12-4f1b-978d-a3645ae59da0
Aeroflex Gaisler GRCAN and GRHCAN CAN controllers.

The GRCAN and CRHCAN CAN controllers are available in the GRLIB VHDL IP core
/* bench 2694.0.0 b3ee059f1799 */
/* bench 2694.0.1 14b9d413ddd2 */
/* bench 2694.0.2 9d34cafd4d00 */
/* bench 2694.0.3 ca65240826bf */
/* bench 2694.0.4 b9a9ffb9b888 */
/* bench 2694.0.5 7c5539f75852 */
Note: These properties are built from the AMBA plug&play in a Leon SPARC system
(the ordinary environment for GRCAN and GRHCAN). There are no dts files for
sparc.

Required properties:

- name : Should be "GAISLER_GRCAN", "01_03d", "GAISLER_GRHCAN" or "01_034"

- reg : Address and length of the register set for the device

- freq : Frequency of the external oscillator clock in Hz (the frequency of
	the amba bus in the ordinary case)

- interrupts : Interrupt number for this device

Optional properties:
/* bench 12539.1.0 ba4eff8a8960 */
/* bench 12539.1.1 ea4162014266 */
/* bench 12539.1.2 b1a88a7c71f9 */
/* bench 12539.1.3 6fbcd28803ea */
/* bench 12539.1.4 f37602fcd8d5 */
/* bench 12539.1.5 5cb8b7f81834 */
/* bench 12539.1.6 be00a79b295f */
/* bench 12539.1.7 f1cfacd0b14f */

- systemid : If not present or if the value of the least significant 16 bits
	of this 32-bit property is smaller than GRCAN_TXBUG_SAFE_GRLIB_VERSION
	a bug workaround is activated.

For further information look in the documentation for the GLIB IP core library:
/* bench 14286.0.0 f39cb63f7459 */
/* bench 14286.0.1 53ef0d3bbb0a */
/* bench 26834.0.0 04aae46127ae */
/* bench 26834.0.1 eb9b8c02526e */
/* bench 26834.0.2 11bb79d01f6b */
/* bench 26834.0.3 be13cfe03c64 */
/* bench 26834.0.4 922dcc6bf682 */
/* bench 26834.0.5 393b21d334d1 */
/* bench 26834.0.6 f7a4b65e8c6e */
/* bench 26834.0.7 693cfdd9b7af */
/* bench 26834.0.8 b80c88b64ea1 */
/* bench 14286.0.3 de2fb0cc2162 */
/* bench 14286.0.4 fdc2801a6016 */
/* bench 14286.0.5 57603f4859bb */
/* bench 14286.0.6 920eb7ee3be2 */
/* bench 14286.0.7 82c4b6aaa67f */
/* bench 14286.0.8 25a1a189cbf6 */
```

## Documentation/devicetree/bindings/net/can/holt_hi311x.txt
```
FASTVC-BENCH-CORPUS:linux-main-100k-v1-e0bd41dc-8e12-4f1b-978d-a3645ae59da0
* Holt HI-311X stand-alone CAN controller device tree bindings

Required properties:
 - compatible: Should be one of the following:
   - "holt,hi3110" for HI-3110
 - reg: SPI chip select.
 - clocks: The clock feeding the CAN controller.
 - interrupts: Should contain IRQ line for the CAN controller.

Optional properties:
 - vdd-supply: Regulator that powers the CAN controller.
 - xceiver-supply: Regulator that powers the CAN transceiver.

Example:
	can0: can@1 {
		compatible = "holt,hi3110";
		reg = <1>;
		clocks = <&clk32m>;
		interrupt-parent = <&gpio4>;
/* bench 3028.0.0 344bb15b35cc */
/* bench 3028.0.1 898798599845 */
/* bench 3028.0.2 223505db4764 */
/* bench 3028.0.3 2d357b04a4e3 */
/* bench 3028.0.4 89f4b140780a */
/* bench 3028.0.5 41dfa67decac */
		vdd-supply = <&reg5v0>;
		xceiver-supply = <&reg5v0>;
	};
```

## Documentation/devicetree/bindings/net/can/ifi_canfd.txt
```
FASTVC-BENCH-CORPUS:linux-main-100k-v1-e0bd41dc-8e12-4f1b-978d-a3645ae59da0
IFI CANFD controller
--------------------

Required properties:
  - compatible: Should be "ifi,canfd-1.0"
  - reg: Should contain CAN controller registers location and length
  - interrupts: Should contain IRQ line for the CAN controller

Example:

	canfd0: canfd@ff220000 {
		compatible = "ifi,canfd-1.0";
		reg = <0xff220000 0x00001000>;
		interrupts = <0 43 0>;
	};
/* bench 19690.0.0 135c5a061522 */
/* bench 19690.0.1 71bffd0b92b0 */
/* bench 19690.0.2 704e7323543e */
/* bench 19690.0.3 4339ea392555 */
/* bench 19690.0.4 46d5a9d94fe7 */
/* bench 19690.0.5 bc50286e3075 */
/* bench 19690.0.6 8b7b306724f6 */
/* bench 19690.0.7 48e47c048e65 */
/* bench 19690.0.8 e5786cacec0e */
/* bench 19690.0.9 9af12cff3b1f */
/* bench 29318.0.0 3a3f81933645 */
/* bench 29318.0.1 4c5fbb47a0a0 */
/* bench 29318.0.2 d894c6b175b3 */
/* bench 29318.0.3 370e13d0a461 */
/* bench 29318.0.4 ae1c8b213964 */
/* bench 29318.0.5 a6f7f4e0019c */
/* bench 29318.0.6 4b35b83ce94f */
/* bench 29318.0.7 7b5789ee74b5 */
/* bench 29318.0.8 f80333031c01 */
/* bench 29318.0.9 6c5a271f1e3f */
```

## Documentation/devicetree/bindings/net/can/microchip,mcp251x.txt
```
FASTVC-BENCH-CORPUS:linux-main-100k-v1-e0bd41dc-8e12-4f1b-978d-a3645ae59da0
* Microchip MCP251X stand-alone CAN controller device tree bindings

Required properties:
 - compatible: Should be one of the following:
   - "microchip,mcp2510" for MCP2510.
   - "microchip,mcp2515" for MCP2515.
   - "microchip,mcp25625" for MCP25625.
 - reg: SPI chip select.
/* bench 16974.1.0 8a4fee04bf04 */
/* bench 16974.1.1 c5c4b37f5fbd */
/* bench 16974.1.2 cf32ad4204b8 */
/* bench 16974.1.3 5e548efc9d63 */
/* bench 16974.1.4 10be4e80b0db */
/* bench 16974.1.5 3543f10e46ff */
/* bench 16974.1.6 dfa7bf832909 */
/* bench 16974.1.7 7ea6d0e14dcb */
/* bench 16974.1.8 6a938d7a8594 */
/* bench 16974.1.9 4d07f4887d6a */
/* bench 16974.1.10 7e0956845e53 */
/* bench 16974.1.11 5336173169d9 */
Optional properties:
 - vdd-supply: Regulator that powers the CAN controller.
 - xceiver-supply: Regulator that powers the CAN transceiver.
 - gpio-controller: Indicates this device is a GPIO controller.
 - #gpio-cells: Should be two. The first cell is the pin number and
                the second cell is used to specify the gpio polarity.
/* bench 28732.0.0 bcac87a3ca03 */
/* bench 28732.0.1 1992f45ceb81 */
/* bench 28732.0.2 e7c22e0aa646 */
/* bench 28732.0.3 1e7837dca03d */
/* bench 28732.0.4 3a558cc2df69 */
/* bench 28732.0.5 67c2a666a473 */
/* bench 28732.0.6 73ac76a4a72b */
/* bench 28732.0.7 6e3cfc51aff3 */
	can0: can@1 {
		compatible = "microchip,mcp2515";
		reg = <1>;
		clocks = <&clk24m>;
/* bench 26631.0.0 d5367cedd99c */
/* bench 26631.0.1 60de29f91974 */
/* bench 26631.0.2 6f60725e0988 */
/* bench 26631.0.3 c10b317bcd1b */
/* bench 26631.0.4 2eee06129592 */
/* bench 26631.0.5 5553eae38ff4 */
/* bench 26631.0.6 1a65b5de5970 */
/* bench 26631.0.7 054f607fb977 */
/* bench 26631.0.8 c674206eee5e */
/* bench 26631.0.9 bacafc103240 */
		interrupts = <13 IRQ_TYPE_LEVEL_LOW>;
		vdd-supply = <&reg5v0>;
		xceiver-supply = <&reg5v0>;
		gpio-controller;
		#gpio-cells = <2>;
	};
```
