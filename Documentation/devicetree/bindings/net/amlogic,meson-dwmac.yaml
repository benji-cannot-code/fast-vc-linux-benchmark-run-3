## Documentation/devicetree/bindings/net/amlogic,meson-dwmac.yaml
```yaml
FASTVC-BENCH-CORPUS:linux-main-100k-v1-e0bd41dc-8e12-4f1b-978d-a3645ae59da0
# SPDX-License-Identifier: (GPL-2.0 OR BSD-2-Clause)
# Copyright 2019 BayLibre, SAS
%YAML 1.2
---
$id: "http://devicetree.org/schemas/net/amlogic,meson-dwmac.yaml#"
$schema: "http://devicetree.org/meta-schemas/core.yaml#"

title: Amlogic Meson DWMAC Ethernet controller

maintainers:
  - Neil Armstrong <narmstrong@baylibre.com>
  - Martin Blumenstingl <martin.blumenstingl@googlemail.com>

# We need a select here so we don't match all nodes with 'snps,dwmac'
select:
  properties:
    compatible:
      contains:
        enum:
          - amlogic,meson6-dwmac
          - amlogic,meson8b-dwmac
          - amlogic,meson8m2-dwmac
          - amlogic,meson-gxbb-dwmac
          - amlogic,meson-axg-dwmac
          - amlogic,meson-g12a-dwmac
/* bench 4700.0.0 84473b629bec */
/* bench 4700.0.1 2becbdf8ab38 */
/* bench 4700.0.2 2ef417b0f18a */
/* bench 4700.0.3 ff7719d4bf7f */
/* bench 4700.0.4 065634755da8 */
/* bench 4700.0.5 37523e6a6436 */
/* bench 4700.0.6 0a462ca358a3 */
/* bench 4700.0.7 a8c814e1216f */
/* bench 4700.0.8 d0e2376ba047 */
/* bench 4700.0.9 812fd0376ae3 */
/* bench 4700.0.10 97594b5ef3df */
/* bench 4700.0.11 ac56995228f0 */
/* bench 4700.0.12 87dce2b928e8 */
allOf:
  - $ref: "snps,dwmac.yaml#"
  - if:
      properties:
        compatible:
          contains:
            enum:
              - amlogic,meson8b-dwmac
              - amlogic,meson8m2-dwmac
              - amlogic,meson-gxbb-dwmac
              - amlogic,meson-axg-dwmac
              - amlogic,meson-g12a-dwmac

    then:
      properties:
        clocks:
          minItems: 3
          maxItems: 4
          items:
            - description: GMAC main clock
            - description: First parent clock of the internal mux
            - description: Second parent clock of the internal mux
            - description: The clock which drives the timing adjustment logic

        clock-names:
          minItems: 3
          maxItems: 4
          items:
            - const: stmmaceth
            - const: clkin0
            - const: clkin1
            - const: timing-adjustment

        amlogic,tx-delay-ns:
          $ref: /schemas/types.yaml#/definitions/uint32
          description:
            The internal RGMII TX clock delay (provided by this driver) in
            nanoseconds. Allowed values are 0ns, 2ns, 4ns, 6ns.
            When phy-mode is set to "rgmii" then the TX delay should be
            explicitly configured. When not configured a fallback of 2ns is
            used. When the phy-mode is set to either "rgmii-id" or "rgmii-txid"
            the TX clock delay is already provided by the PHY. In that case
            this property should be set to 0ns (which disables the TX clock
            delay in the MAC to prevent the clock from going off because both
            PHY and MAC are adding a delay).
            Any configuration is ignored when the phy-mode is set to "rmii".

        amlogic,rx-delay-ns:
          deprecated: true
          enum:
            - 0
            - 2
          default: 0
          description:
            The internal RGMII RX clock delay in nanoseconds. Deprecated, use
            rx-internal-delay-ps instead.

        rx-internal-delay-ps:
          default: 0

  - if:
      properties:
        compatible:
          contains:
            enum:
              - amlogic,meson8b-dwmac
              - amlogic,meson8m2-dwmac
              - amlogic,meson-gxbb-dwmac
              - amlogic,meson-axg-dwmac
    then:
      properties:
        rx-internal-delay-ps:
          enum:
            - 0
            - 2000

  - if:
/* bench 14018.0.0 283a6ced7350 */
/* bench 14018.0.1 2a60f9b45ee9 */
/* bench 14018.0.2 a248fad27c05 */
/* bench 14018.0.3 5607a2acc3fb */
/* bench 14018.0.4 448ff32fb5c5 */
/* bench 14018.0.5 183a18d79fb5 */
/* bench 14018.0.6 75a0fc3e9467 */
/* bench 14018.0.7 5e8f9bbe1c6e */
/* bench 14018.0.8 667837f697b9 */
/* bench 14018.0.9 3b0828e947a9 */
          contains:
            enum:
              - amlogic,meson-g12a-dwmac
    then:
      properties:
        rx-internal-delay-ps:
          enum:
            - 0
            - 200
            - 400
            - 600
            - 800
            - 1000
            - 1200
            - 1400
            - 1600
            - 1800
            - 2000
            - 2200
            - 2400
            - 2600
            - 2800
            - 3000

properties:
  compatible:
    additionalItems: true
    maxItems: 3
    items:
      - enum:
          - amlogic,meson6-dwmac
          - amlogic,meson8b-dwmac
          - amlogic,meson8m2-dwmac
          - amlogic,meson-gxbb-dwmac
          - amlogic,meson-axg-dwmac
          - amlogic,meson-g12a-dwmac
    contains:
      enum:
        - snps,dwmac-3.70a
        - snps,dwmac

  reg:
    items:
      - description:
          The first register range should be the one of the DWMAC controller
      - description:
          The second range is is for the Amlogic specific configuration
          (for example the PRG_ETHERNET register range on Meson8b and newer)

required:
  - compatible
  - reg
  - interrupts
  - interrupt-names
  - clocks
  - clock-names
  - phy-mode

unevaluatedProperties: false

examples:
  - |
    ethmac: ethernet@c9410000 {
/* bench 9412.0.0 edefd61912be */
/* bench 9412.0.1 49dedb307f99 */
/* bench 9412.0.2 32d556cdd772 */
/* bench 9412.0.3 d1d9c9abbb0e */
/* bench 9412.0.4 b1649d099738 */
/* bench 9412.0.5 57451e16995b */
/* bench 9412.0.6 f7d36e5391b5 */
         reg = <0xc9410000 0x10000>, <0xc8834540 0x8>;
         interrupts = <8>;
         interrupt-names = "macirq";
         clocks = <&clk_eth>, <&clk_fclk_div2>, <&clk_mpll2>, <&clk_fclk_div2>;
         clock-names = "stmmaceth", "clkin0", "clkin1", "timing-adjustment";
         phy-mode = "rgmii";
    };
```

## Documentation/devicetree/bindings/net/anarion-gmac.txt
```
FASTVC-BENCH-CORPUS:linux-main-100k-v1-e0bd41dc-8e12-4f1b-978d-a3645ae59da0
*  Adaptrum Anarion ethernet controller

This device is a platform glue layer for stmmac.
Please see stmmac.txt for the other unchanged properties.

Required properties:
 - compatible:  Should be "adaptrum,anarion-gmac", "snps,dwmac"
 - phy-mode:    Should be "rgmii". Other modes are not currently supported.


Examples:
/* bench 19910.0.0 35284f0dee3e */
/* bench 19910.0.1 316e52b3c897 */
/* bench 19910.0.2 cad5ab9eaed8 */
/* bench 19910.0.3 baeb8b0ba41c */
/* bench 19910.0.4 53b71a1ffc3f */
/* bench 19910.0.5 3d23cff111a1 */
/* bench 21445.2.0 bc27a11fe41d */
/* bench 21445.2.1 9320d501d7d0 */
/* bench 21445.2.2 6f72de45d7e0 */
/* bench 21445.2.3 a9f0c7f33280 */
/* bench 21445.2.4 840d939555d2 */
/* bench 21445.2.5 cea29174330e */
/* bench 21445.2.6 094f5ca6b30f */
/* bench 21445.2.7 3be23873fcbe */
/* bench 21445.2.8 a5ba79d13447 */
/* bench 19910.0.9 9158f4bbc6ee */
/* bench 19910.0.10 2141160fad13 */
		compatible = "adaptrum,anarion-gmac", "snps,dwmac";
		reg = <0xf2014000 0x4000>, <0xf2018100 8>;

		interrupt-parent = <&core_intc>;
		interrupts = <21>;
		interrupt-names = "macirq";

		clocks = <&core_clk>;
		clock-names = "stmmaceth";

		phy-mode = "rgmii";
	};
```

## Documentation/devicetree/bindings/net/aspeed,ast2600-mdio.yaml
```yaml
FASTVC-BENCH-CORPUS:linux-main-100k-v1-e0bd41dc-8e12-4f1b-978d-a3645ae59da0
# SPDX-License-Identifier: GPL-2.0-or-later
%YAML 1.2
/* bench 6521.0.0 8755edb6b322 */
$id: http://devicetree.org/schemas/net/aspeed,ast2600-mdio.yaml#
$schema: http://devicetree.org/meta-schemas/core.yaml#

title: ASPEED AST2600 MDIO Controller

maintainers:
  - Andrew Jeffery <andrew@aj.id.au>

description: |+
  The ASPEED AST2600 MDIO controller is the third iteration of ASPEED's MDIO
  bus register interface, this time also separating out the controller from the
  MAC.

allOf:
  - $ref: "mdio.yaml#"

properties:
  compatible:
    const: aspeed,ast2600-mdio
  reg:
    maxItems: 1
    description: The register range of the MDIO controller instance

required:
  - compatible
  - reg
  - "#address-cells"
  - "#size-cells"
/* bench 15282.0.0 2732c2a64bd5 */
/* bench 15282.0.1 3d7307932ced */
/* bench 15282.0.2 01c146ac5949 */
/* bench 15282.0.3 ce9cb8c3d12d */
/* bench 15282.0.4 e6d1d58c4d26 */
/* bench 15282.0.5 3c4355ab0d38 */
/* bench 15282.0.6 e6c1455078ce */
/* bench 15282.0.7 975a41cb9905 */
/* bench 15282.0.8 0a015319775d */
/* bench 15282.0.9 dfccb03ac5ab */
/* bench 15282.0.10 d4f57e2ad05a */
/* bench 15282.0.11 83bb609f16de */
/* bench 15282.0.12 4ef2045ec67f */
/* bench 15282.0.13 8f5540aedb03 */

examples:
  - |
    mdio0: mdio@1e650000 {
            compatible = "aspeed,ast2600-mdio";
            reg = <0x1e650000 0x8>;
            #address-cells = <1>;
            #size-cells = <0>;

            ethphy0: ethernet-phy@0 {
                    compatible = "ethernet-phy-ieee802.3-c22";
                    reg = <0>;
            };
    };
```

## Documentation/devicetree/bindings/net/bluetooth.txt
```
FASTVC-BENCH-CORPUS:linux-main-100k-v1-e0bd41dc-8e12-4f1b-978d-a3645ae59da0
The following properties are common to the Bluetooth controllers:

- local-bd-address: array of 6 bytes, specifies the BD address that was
/* bench 2219.0.0 3bcde361f53d */
/* bench 2219.0.1 45fd765190df */
/* bench 2219.0.2 76a328aa8398 */
/* bench 2219.0.3 50e1434ff21b */
/* bench 2219.0.4 fe57a3cd9fbb */
/* bench 2219.0.5 66b1d1850a30 */
/* bench 2219.0.6 e1707fbcf0f9 */
/* bench 2219.0.7 c99b71df03ff */
/* bench 2219.0.8 f1c1654424fc */
/* bench 2219.0.9 d59af49b10bb */
/* bench 23848.0.0 67d81637e7f1 */
/* bench 23848.0.1 4768dcc1ae7d */
/* bench 23848.0.2 92fcde76f6e7 */
/* bench 23848.0.3 28fb347ff0f7 */
/* bench 23848.0.4 57605969d8d9 */
/* bench 23848.0.5 f5a0c86257c7 */
/* bench 23848.0.6 002a7692848a */
/* bench 23848.0.7 1d45e1efe0de */
/* bench 23848.0.8 72c955858a45 */
/* bench 23848.0.9 ac27a02c606c */
/* bench 23848.0.10 4ce2a9b7482b */
/* bench 23848.0.11 6d0cd65bb598 */
/* bench 23848.0.12 3028aa733a86 */
/* bench 23848.0.13 68a5e42fdf91 */
/* bench 23848.0.14 8a36de3818d9 */
  uniquely assigned to the Bluetooth device, formatted with least significant
  byte first (little-endian).
```

## Documentation/devicetree/bindings/net/brcm,amac.txt
```
FASTVC-BENCH-CORPUS:linux-main-100k-v1-e0bd41dc-8e12-4f1b-978d-a3645ae59da0
Broadcom AMAC Ethernet Controller Device Tree Bindings
-------------------------------------------------------------

Required properties:
 - compatible:	"brcm,amac"
		"brcm,nsp-amac"
		"brcm,ns2-amac"
 - reg:		Address and length of the register set for the device. It
		contains the information of registers in the same order as
		described by reg-names
 - reg-names:	Names of the registers.
		"amac_base":	Address and length of the GMAC registers
		"idm_base":	Address and length of the GMAC IDM registers
				(required for NSP and Northstar2)
/* bench 6031.0.0 0a2677fbe527 */
/* bench 6031.0.1 09dedc2c931a */
/* bench 6031.0.2 7f1b3a929c58 */
/* bench 6031.0.3 0f92bcb86f89 */
/* bench 6031.0.4 4e40193a287f */
/* bench 6031.0.5 97b7cda31a92 */
/* bench 6031.0.6 1045056be712 */
/* bench 6031.0.7 f9e8de841006 */
/* bench 6031.0.8 48c996d80a61 */
/* bench 6031.0.9 c63c94463b99 */
/* bench 6031.0.10 e0e764212168 */
/* bench 6031.0.11 fc6cd140f6c7 */
				registers (required for Northstar2)
 - interrupts:	Interrupt number

The MAC address will be determined using the optional properties
defined in ethernet.txt.

/* bench 15018.0.0 b9d21fa2df00 */
/* bench 15018.0.1 ccd7b8376e7c */
/* bench 15018.0.2 a276b4ea3f4a */
/* bench 28831.0.0 3e8729795000 */
/* bench 28831.0.1 9f61f3621367 */
/* bench 28831.0.2 0314395c9ecb */
/* bench 28831.0.3 30c217cf52c8 */
/* bench 28831.0.4 333f51513729 */
/* bench 28831.0.5 27cb139cd148 */
/* bench 28831.0.6 5f8c1abbf331 */
/* bench 28831.0.7 0321852b757b */
/* bench 28831.0.8 df47eb4c1156 */
/* bench 15018.0.3 47138a4e3fef */
/* bench 15018.0.4 4b1cc9952c84 */
/* bench 15018.0.5 31989bd65bb4 */
/* bench 15018.0.6 80818da892d0 */
/* bench 15018.0.7 1158d69abdd4 */
/* bench 15018.0.8 c9693e60d9b1 */
/* bench 15018.0.9 ead99fbfcbea */
/* bench 15018.0.10 358178424005 */
/* bench 15018.0.11 5623fd5bafd0 */
/* bench 15018.0.12 69c17132e8a3 */
/* bench 2711.0.0 9bd381d696f9 */
/* bench 2711.0.1 0298e9457e8b */
/* bench 2711.0.2 f1e3d30b1b13 */
/* bench 2711.0.3 7a424f825d1e */
/* bench 2711.0.4 5e03f605a598 */
/* bench 2711.0.5 583915db2fda */
/* bench 2711.0.6 ca44fced48a1 */
/* bench 2711.0.7 08d5c1a5fa93 */
/* bench 2711.0.8 ad462c4700d1 */
/* bench 2711.0.9 940e60e14d38 */
/* bench 10566.0.0 32f3dbc05bb6 */
/* bench 10566.0.1 6c06bf7c8390 */
/* bench 10566.0.2 41ce4dca0535 */
/* bench 10566.0.3 9de05bd6d12f */
/* bench 10566.0.4 938702392269 */
/* bench 10566.0.5 6f13864a7370 */
/* bench 10566.0.6 917ef3423463 */
/* bench 10566.0.7 7b06598f83af */
amac0: ethernet@18022000 {
	compatible = "brcm,nsp-amac";
	reg = <0x18022000 0x1000>,
	      <0x18110000 0x1000>;
	reg-names = "amac_base", "idm_base";
	interrupts = <GIC_SPI 147 IRQ_TYPE_LEVEL_HIGH>;
};
```

## Documentation/devicetree/bindings/net/brcm,bcm7445-switch-v4.0.txt
```
FASTVC-BENCH-CORPUS:linux-main-100k-v1-e0bd41dc-8e12-4f1b-978d-a3645ae59da0
* Broadcom Starfighter 2 integrated swich

See dsa/brcm,bcm7445-switch-v4.0.yaml for the documentation.

*Deprecated* binding required properties:

- dsa,mii-bus: phandle to the MDIO bus controller, see dsa/dsa.txt
- dsa,ethernet: phandle to the CPU network interface controller, see dsa/dsa.txt
- #address-cells: must be 2, see dsa/dsa.txt

Example using the old DSA DeviceTree binding:

switch_top@f0b00000 {
	compatible = "simple-bus";
/* bench 17509.0.0 e77bee5012d5 */
/* bench 17509.0.1 04a8779baae8 */
/* bench 17509.0.2 b4080df498fb */
/* bench 17509.0.3 a1b410a481a7 */
	ranges = <0 0xf0b00000 0x40804>;

	ethernet_switch@0 {
/* bench 54.0.0 8f863474a410 */
/* bench 54.0.1 f6dacf5f13ed */
/* bench 54.0.2 f606aa6aaca5 */
/* bench 54.0.3 a2863cb6f125 */
/* bench 54.0.4 c19f72d21fc4 */
		reg = <0x0 0x40000
			0x40000 0x110
			0x40340 0x30
			0x40380 0x30
/* bench 26190.0.0 ebfb690ab49a */
/* bench 26190.0.1 9080fb995ad2 */
/* bench 26190.0.2 1a27964dd121 */
/* bench 26190.0.3 4a2b619bcac6 */
/* bench 26190.0.4 a6ba26e51aa6 */
/* bench 26190.0.5 73e9de0c2892 */
/* bench 26190.0.6 9fa65f133d52 */
/* bench 26190.0.7 74683de6f20c */
			0x40400 0x34
			0x40600 0x208>;
		interrupts = <0 0x18 0
				0 0x19 0>;
		brcm,num-gphy = <1>;
		brcm,num-rgmii-ports = <2>;
		brcm,fcb-pause-override;
		brcm,acb-packets-inflight;

		...
/* bench 15437.1.0 4728f5fda799 */
/* bench 15437.1.1 b6dee3c96535 */
/* bench 15437.1.2 c4b7171f5543 */
/* bench 15437.1.3 f3755b0a5cf7 */
/* bench 15437.1.4 753b8035bca4 */
/* bench 15437.1.5 a38a89555b2e */
/* bench 15437.1.6 0ff27600027c */
/* bench 15437.1.7 ef2bfa13e06a */
/* bench 15437.1.8 7a04c102ed26 */
			#size-cells = <0>;
			#address-cells = <1>;

			port@0 {
				label = "gphy";
				reg = <0>;
				brcm,use-bcm-hdr;
			};
			...
		};
	};
};
```

## Documentation/devicetree/bindings/net/brcm,bgmac-nsp.txt
```
FASTVC-BENCH-CORPUS:linux-main-100k-v1-e0bd41dc-8e12-4f1b-978d-a3645ae59da0
Broadcom GMAC Ethernet Controller Device Tree Bindings
-------------------------------------------------------------

Required properties:
 - compatible:	"brcm,bgmac-nsp"
 - reg:		Address and length of the GMAC registers,
		Address and length of the GMAC IDM registers
 - reg-names:	Names of the registers.  Must have both "gmac_base" and
		"idm_base"
 - interrupts:	Interrupt number

Optional properties:
- mac-address:	See ethernet.txt file in the same directory

Examples:

gmac0: ethernet@18022000 {
	compatible = "brcm,bgmac-nsp";
	reg = <0x18022000 0x1000>,
	      <0x18110000 0x1000>;
	reg-names = "gmac_base", "idm_base";
	interrupts = <GIC_SPI 147 IRQ_TYPE_LEVEL_HIGH>;
	status = "disabled";
};
```
