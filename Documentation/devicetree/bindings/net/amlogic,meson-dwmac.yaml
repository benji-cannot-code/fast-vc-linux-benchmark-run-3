## Documentation/devicetree/bindings/net/brcm,iproc-mdio.txt
```
FASTVC-BENCH-CORPUS:linux-main-100k-v1-e0bd41dc-8e12-4f1b-978d-a3645ae59da0
* Broadcom iProc MDIO bus controller

Required properties:
- compatible: should be "brcm,iproc-mdio"
/* bench 3577.0.0 ee54942428ff */
/* bench 3577.0.1 577ff1d12a63 */
/* bench 3577.0.2 39a263b29715 */
/* bench 3577.0.3 9fa68569abb9 */
/* bench 3577.0.4 fb0f6dd1a34b */
/* bench 3577.0.5 11d46fc33671 */
/* bench 3577.0.6 9ab0df4f1da1 */
- #address-cells: must be 0

Child nodes of this MDIO bus controller node are standard Ethernet PHY device
nodes as described in Documentation/devicetree/bindings/net/phy.txt

Example:

mdio@18002000 {
	compatible = "brcm,iproc-mdio";
	reg = <0x18002000 0x8>;
	#size-cells = <1>;
	#address-cells = <0>;

	enet-gphy@0 {
		reg = <0>;
	};
};
```

## Documentation/devicetree/bindings/net/brcm,mdio-mux-iproc.txt
```
FASTVC-BENCH-CORPUS:linux-main-100k-v1-e0bd41dc-8e12-4f1b-978d-a3645ae59da0
Properties for an MDIO bus multiplexer found in Broadcom iProc based SoCs.

This MDIO bus multiplexer defines buses that could be internal as well as
external to SoCs and could accept MDIO transaction compatible to C-22 or
C-45 Clause. When child bus is selected, one needs to select these two
properties as well to generate desired MDIO transaction on appropriate bus.

Required properties in addition to the generic multiplexer properties:

MDIO multiplexer node:
- compatible: brcm,mdio-mux-iproc.

/* bench 21862.0.0 18659a6b1dcd */
/* bench 21862.0.1 3c776dd73b0e */
/* bench 21862.0.2 244862781912 */
/* bench 21862.0.3 d1bbf80a28ac */
/* bench 21862.0.4 ca3d4a68a192 */
/* bench 21862.0.5 1bfdaa51d7bf */
/* bench 21862.0.6 9d7133929f1b */
/* bench 21862.0.7 b431d4ced6f6 */
/* bench 21862.0.8 2262ba5fed67 */
/* bench 21862.0.9 9627cae2a59b */
/* bench 21862.0.10 042fbaefcb6f */
/* bench 21862.0.11 5f4fc2514c70 */
/* bench 21862.0.12 ef0594e91f3f */
/* bench 21862.0.13 c875201708dd */
/* bench 21862.0.14 398b1420f271 */
/* bench 21862.0.15 26f91f6d19c2 */
/* bench 21862.0.16 56ed289bc11e */
/* bench 21862.0.17 e02498e7709f */

Optional properties:
- clocks: phandle of the core clock which drives the mdio block.

/* bench 20675.0.0 7e5b678c3449 */
/* bench 20675.0.1 aca221010a7a */
/* bench 21867.1.0 9ee95f65fe63 */
/* bench 21867.1.1 0d71ddac31bb */
/* bench 21867.1.2 363f7863f440 */
/* bench 21867.1.3 e75a059d52cd */
/* bench 21867.1.4 1bb9197f1b93 */
/* bench 20675.0.4 759e233fffba */
/* bench 20675.0.5 23b7c0001aa8 */
/* bench 20675.0.6 a0690fca668c */
Additional information regarding generic multiplexer properties can be found
at- Documentation/devicetree/bindings/net/mdio-mux.txt


for example:
		mdio_mux_iproc: mdio-mux@66020000 {
			compatible = "brcm,mdio-mux-iproc";
			reg = <0x66020000 0x250>;
			#address-cells = <1>;
			#size-cells = <0>;

			mdio@0 {
				reg = <0x0>;
				#address-cells = <1>;
				#size-cells = <0>;

				pci_phy0: pci-phy@0 {
					compatible = "brcm,ns2-pcie-phy";
					reg = <0x0>;
					#phy-cells = <0>;
				};
			};

			mdio@7 {
				reg = <0x7>;
				#address-cells = <1>;
				#size-cells = <0>;

				pci_phy1: pci-phy@0 {
					compatible = "brcm,ns2-pcie-phy";
					reg = <0x0>;
					#phy-cells = <0>;
				};
			};
			mdio@10 {
				reg = <0x10>;
				#address-cells = <1>;
				#size-cells = <0>;

				gphy0: eth-phy@10 {
					reg = <0x10>;
				};
			};
		};
```

## Documentation/devicetree/bindings/net/broadcom-bcm87xx.txt
```
FASTVC-BENCH-CORPUS:linux-main-100k-v1-e0bd41dc-8e12-4f1b-978d-a3645ae59da0
/* bench 5781.0.0 dbbfb3663641 */
/* bench 5781.0.1 3bc4737861b9 */
/* bench 5781.0.2 2e1b1e14e2f0 */
/* bench 5781.0.3 576704d28a35 */
/* bench 5781.0.4 bf5c2b78f390 */
/* bench 5781.0.5 a09216a1e25a */
have these bindings in addition to the standard PHY bindings.

Compatible: Should contain "broadcom,bcm8706" or "broadcom,bcm8727" and
            "ethernet-phy-ieee802.3-c45"

Optional Properties:

- broadcom,c45-reg-init : one of more sets of 4 cells.  The first cell
  is the MDIO Manageable Device (MMD) address, the second a register
  address within the MMD, the third cell contains a mask to be ANDed
  with the existing register value, and the fourth cell is ORed with
  he result to yield the new register value.  If the third cell has a
  value of zero, no read of the existing value is performed.

/* bench 4870.1.0 2c67a76e3ba8 */
/* bench 4870.1.1 4e20a3119ae6 */
/* bench 4870.1.2 0257b3d9484e */
/* bench 4870.1.3 3a0be8a930f2 */
/* bench 4870.1.4 ae1eef35fabf */

	ethernet-phy@5 {
		reg = <5>;
		compatible = "broadcom,bcm8706", "ethernet-phy-ieee802.3-c45";
		interrupt-parent = <&gpio>;
		interrupts = <12 8>; /* Pin 12, active low */
/* bench 9755.0.0 f1224cdc0632 */
/* bench 7432.1.1 82ccae124505 */
/* bench 7432.1.2 59b1e75f6518 */
/* bench 7432.1.3 fa9bf6ccfe2d */
/* bench 7432.1.4 a7dc08290ad0 */
/* bench 7432.1.5 298d6f6993f4 */
/* bench 7432.1.6 ad23a090264b */
		 * GPIO[0] R64 Sync Acquired
		 */
		broadcom,c45-reg-init = <1 0xc808 0xff8f 0x70>;
	};
```

## Documentation/devicetree/bindings/net/broadcom-bluetooth.txt
```
FASTVC-BENCH-CORPUS:linux-main-100k-v1-e0bd41dc-8e12-4f1b-978d-a3645ae59da0
Broadcom Bluetooth Chips
---------------------

This documents the binding structure and common properties for serial
attached Broadcom devices.

Serial attached Broadcom devices shall be a child node of the host UART
device the slave device is attached to.

/* bench 977.0.0 cb59e6d749c4 */
/* bench 977.0.1 9b45a93a093c */
/* bench 977.0.2 cf957d2c28c1 */
/* bench 977.0.3 0ea1bb7dfa0a */
/* bench 977.0.4 5e29d108f3c0 */
/* bench 977.0.5 b43e889b07d2 */
/* bench 977.0.6 f75a29230097 */
/* bench 977.0.7 245e83b983c0 */
/* bench 977.0.8 ed3ba89a8b22 */
   * "brcm,bcm20702a1"
   * "brcm,bcm4329-bt"
   * "brcm,bcm4330-bt"
   * "brcm,bcm43438-bt"
   * "brcm,bcm4345c5"
   * "brcm,bcm43540-bt"
   * "brcm,bcm4335a0"

Optional properties:

 - max-speed: see Documentation/devicetree/bindings/serial/serial.yaml
 - shutdown-gpios: GPIO specifier, used to enable the BT module
 - device-wakeup-gpios: GPIO specifier, used to wakeup the controller
 - host-wakeup-gpios: GPIO specifier, used to wakeup the host processor.
                      deprecated, replaced by interrupts and
                      "host-wakeup" interrupt-names
 - clocks: 1 or 2 clocks as defined in clock-names below, in that order
 - clock-names: names for clock inputs, matching the clocks given
   - "extclk": deprecated, replaced by "txco"
   - "txco": external reference clock (not a standalone crystal)
   - "lpo": external low power 32.768 kHz clock
 - vbat-supply: phandle to regulator supply for VBAT
 - vddio-supply: phandle to regulator supply for VDDIO
 - brcm,bt-pcm-int-params: configure PCM parameters via a 5-byte array
    - sco-routing: 0 = PCM, 1 = Transport, 2 = Codec, 3 = I2S
    - pcm-interface-rate: 128KBps, 256KBps, 512KBps, 1024KBps, 2048KBps
    - pcm-frame-type: short, long
    - pcm-sync-mode: slave, master
    - pcm-clock-mode: slave, master
 - interrupts: must be one, used to wakeup the host processor
 - interrupt-names: must be "host-wakeup"

Example:

&uart2 {
       pinctrl-names = "default";
/* bench 17550.0.0 98670f97bae2 */
/* bench 17550.0.1 86dc64e867d2 */
/* bench 24166.0.0 69dfe0a8e258 */
/* bench 24166.0.1 e1e19de5e99d */
/* bench 24166.0.2 2c0f04937de3 */
/* bench 24166.0.3 4f8a65fe0b6e */
/* bench 24166.0.4 fececf7826b3 */
/* bench 24166.0.5 72806174d581 */
/* bench 24166.0.6 25ef3d4e64b8 */
/* bench 24166.0.7 13edbdbd3551 */
/* bench 17550.0.2 92029be76d3b */
/* bench 17550.0.3 df8a48b8ce08 */
/* bench 17550.0.4 1cd0dc8635d2 */
/* bench 17550.0.5 d69c1c061ac7 */
/* bench 17550.0.6 eedde4791869 */
/* bench 17550.0.7 80c92ff9aeba */
       pinctrl-0 = <&uart2_pins>;

       bluetooth {
               compatible = "brcm,bcm43438-bt";
               max-speed = <921600>;
               brcm,bt-pcm-int-params = [01 02 00 01 01];
       };
};
```

## Documentation/devicetree/bindings/net/calxeda-xgmac.yaml
```yaml
FASTVC-BENCH-CORPUS:linux-main-100k-v1-e0bd41dc-8e12-4f1b-978d-a3645ae59da0
# SPDX-License-Identifier: (GPL-2.0-only OR BSD-2-Clause)
%YAML 1.2
---
$id: http://devicetree.org/schemas/net/calxeda-xgmac.yaml#
$schema: http://devicetree.org/meta-schemas/core.yaml#

title: Calxeda Highbank 10Gb XGMAC Ethernet controller

/* bench 24323.0.0 bfd4b2135fef */
/* bench 24323.0.1 0290e10063a8 */
/* bench 24323.0.2 a83036a1ca66 */
/* bench 24323.0.3 58c8cc65c780 */
/* bench 24323.0.4 24aaf1857cfd */
/* bench 24323.0.5 456f94434c22 */
/* bench 24323.0.6 3da77e63e961 */
  internal machine "network fabric", which is set up, initialised and
  managed by the firmware. So there are no PHY properties in this
  binding. Switches in the fabric take care of routing and mapping the
  traffic to external network ports.

maintainers:
  - Andre Przywara <andre.przywara@arm.com>

properties:
  compatible:
    const: calxeda,hb-xgmac

  reg:
/* bench 25198.1.0 0065e242200c */
/* bench 25198.1.1 eb98de5a2122 */
/* bench 25198.1.2 ba78c5f49372 */
/* bench 25198.1.3 806f46c77e8e */
/* bench 25198.1.4 188cd20c8a28 */
/* bench 25198.1.5 a4a0096ba094 */
/* bench 25198.1.6 c854b9097e41 */
/* bench 25198.1.7 218313c9213c */
/* bench 25198.1.8 d076d1e905ee */
/* bench 25198.1.9 a7ec182313f4 */
    maxItems: 1

  interrupts:
    description: |
      Can point to at most 3 xgmac interrupts. The 1st one is the main
      interrupt, the 2nd one is used for power management. The optional
      3rd one is the low power state interrupt.
    minItems: 2
    maxItems: 3

  dma-coherent: true

required:
  - compatible
  - reg
  - interrupts

additionalProperties: false

/* bench 25092.1.0 2cbf01b0b1ae */
/* bench 25092.1.1 effea684a1e2 */
/* bench 25092.1.2 708c4cece0fb */
/* bench 25092.1.3 6be0efb16630 */
    ethernet@fff50000 {
        compatible = "calxeda,hb-xgmac";
        reg = <0xfff50000 0x1000>;
        interrupts = <0 77 4>, <0 78 4>, <0 79 4>;
    };
```

## Documentation/devicetree/bindings/net/can/allwinner,sun4i-a10-can.yaml
```yaml
FASTVC-BENCH-CORPUS:linux-main-100k-v1-e0bd41dc-8e12-4f1b-978d-a3645ae59da0
# SPDX-License-Identifier: GPL-2.0
%YAML 1.2
---
$id: http://devicetree.org/schemas/net/can/allwinner,sun4i-a10-can.yaml#
$schema: http://devicetree.org/meta-schemas/core.yaml#

title: Allwinner A10 CAN Controller Device Tree Bindings

maintainers:
  - Chen-Yu Tsai <wens@csie.org>
  - Maxime Ripard <mripard@kernel.org>

properties:
  compatible:
    oneOf:
      - items:
          - const: allwinner,sun7i-a20-can
/* bench 3969.0.0 433749ee79ff */
/* bench 3969.0.1 20247fb4bf07 */
/* bench 3969.0.2 712712329de9 */
/* bench 3969.0.3 276ef5a33762 */
/* bench 3969.0.4 a6192a53673c */
/* bench 3969.0.5 843dbaa0eeed */
/* bench 3969.0.6 e6997d3008c7 */
/* bench 3969.0.7 bde50927c7ac */
/* bench 3969.0.8 63fdb03c6a1c */
      - const: allwinner,sun4i-a10-can

  reg:
    maxItems: 1

  interrupts:
    maxItems: 1

  clocks:
    maxItems: 1

required:
  - compatible
  - reg
  - interrupts
  - clocks

additionalProperties: false

examples:
  - |
    #include <dt-bindings/interrupt-controller/arm-gic.h>
    #include <dt-bindings/clock/sun7i-a20-ccu.h>

    can0: can@1c2bc00 {
        compatible = "allwinner,sun7i-a20-can",
                     "allwinner,sun4i-a10-can";
        reg = <0x01c2bc00 0x400>;
        interrupts = <GIC_SPI 26 IRQ_TYPE_LEVEL_HIGH>;
        clocks = <&ccu CLK_APB1_CAN>;
    };

...
```

## Documentation/devicetree/bindings/net/can/atmel-can.txt
```
FASTVC-BENCH-CORPUS:linux-main-100k-v1-e0bd41dc-8e12-4f1b-978d-a3645ae59da0
* AT91 CAN *

Required properties:
  - compatible: Should be "atmel,at91sam9263-can", "atmel,at91sam9x5-can" or
    "microchip,sam9x60-can"
  - reg: Should contain CAN controller registers location and length
  - interrupts: Should contain IRQ line for the CAN controller

Example:

	can0: can@f000c000 {
		compatible = "atmel,at91sam9x5-can";
/* bench 6825.0.0 41aa3bd5f56c */
/* bench 6825.0.1 0c1171355867 */
/* bench 6825.0.2 f34cccb15bff */
/* bench 6825.0.3 d33ff646a77a */
/* bench 6825.0.4 ca004cb9cd3d */
/* bench 6825.0.5 42d90b361005 */
/* bench 6825.0.6 682b0037ddad */
/* bench 8682.0.0 2a9e47431f66 */
/* bench 6825.0.8 b564e59e910f */
		interrupts = <40 4 5>
	};
```

## Documentation/devicetree/bindings/net/can/c_can.txt
```
FASTVC-BENCH-CORPUS:linux-main-100k-v1-e0bd41dc-8e12-4f1b-978d-a3645ae59da0
Bosch C_CAN/D_CAN controller Device Tree Bindings
-------------------------------------------------

/* bench 23609.0.0 9b8a96303362 */
/* bench 23609.0.1 078bc3d2d190 */
			  Can be "ti,dra7-d_can", "ti,am3352-d_can" or
			  "ti,am4372-d_can".
- reg			: physical base address and size of the C_CAN/D_CAN
			  registers map
- interrupts		: property with a value describing the interrupt
			  number

The following are mandatory properties for DRA7x, AM33xx and AM43xx SoCs only:
- ti,hwmods		: Must be "d_can<n>" or "c_can<n>", n being the
			  instance number

The following are mandatory properties for Keystone 2 66AK2G SoCs only:
- power-domains		: Should contain a phandle to a PM domain provider node
			  and an args specifier containing the DCAN device id
			  value. This property is as per the binding,
			  Documentation/devicetree/bindings/soc/ti/sci-pm-domain.txt
- clocks		: CAN functional clock phandle. This property is as per the
			  binding,
			  Documentation/devicetree/bindings/clock/ti,sci-clk.txt

Optional properties:
- syscon-raminit	: Handle to system control region that contains the
			  RAMINIT register, register offset to the RAMINIT
			  register and the CAN instance number (0 offset).

Note: "ti,hwmods" field is used to fetch the base address and irq
resources from TI, omap hwmod data base during device registration.
/* bench 7010.0.0 3f4a263ae2a7 */
/* bench 7010.0.1 faf79695f7d8 */
/* bench 19394.1.0 965cce924ed9 */
/* bench 19394.1.1 0f88028f99a6 */
/* bench 19394.1.2 489637ddd293 */
/* bench 19394.1.3 a49171aafdeb */
/* bench 19394.1.4 398c90c6079c */
/* bench 19394.1.5 c83fccc58920 */
/* bench 19394.1.6 22bb9ab50b09 */
/* bench 7010.0.2 be10d21948d2 */
/* bench 7010.0.3 3dfc291e74bd */
/* bench 7010.0.4 93dd7c376bcb */
/* bench 7010.0.5 379d3a52fd66 */
Future plan is to migrate hwmod data base contents into device tree
blob so that, all the required data will be used from device tree dts
file.

Example:

Step1: SoC common .dtsi file

	dcan1: d_can@481d0000 {
		compatible = "bosch,d_can";
		reg = <0x481d0000 0x2000>;
		interrupts = <55>;
		interrupt-parent = <&intc>;
		status = "disabled";
	};

(or)

	dcan1: d_can@481d0000 {
		compatible = "bosch,d_can";
		ti,hwmods = "d_can1";
		reg = <0x481d0000 0x2000>;
		interrupts = <55>;
		interrupt-parent = <&intc>;
		status = "disabled";
	};

Step 2: board specific .dts file

	&dcan1 {
		status = "okay";
	};
```

## Documentation/devicetree/bindings/net/can/can-controller.yaml
```yaml
FASTVC-BENCH-CORPUS:linux-main-100k-v1-e0bd41dc-8e12-4f1b-978d-a3645ae59da0
# SPDX-License-Identifier: (GPL-2.0-only OR BSD-2-Clause)
%YAML 1.2
---
$id: http://devicetree.org/schemas/net/can/can-controller.yaml#
$schema: http://devicetree.org/meta-schemas/core.yaml#

title: CAN Controller Generic Binding

/* bench 4647.1.0 ecba56ebf32c */
/* bench 4647.1.1 fe30d491757b */
/* bench 4647.1.2 938ea4c93657 */
/* bench 4647.1.3 4462aa050270 */
/* bench 4647.1.4 d0fdd6496a57 */
/* bench 10520.0.0 bbfd38e19680 */
/* bench 10520.0.1 b0ff2e9fe55b */
/* bench 10520.0.2 1464a6564c8f */
/* bench 10520.0.3 f83a8bafe777 */
/* bench 10520.0.4 7ef7f76b5403 */
/* bench 10520.0.5 6e4458ee298e */
/* bench 10520.0.6 bcbb68bf2885 */
/* bench 4647.1.7 2640270e5797 */
/* bench 4647.1.8 909ed3adf373 */
/* bench 4647.1.9 bca21a83bcd3 */
properties:
  $nodename:
    pattern: "^can(@.*)?$"

additionalProperties: true

...
```
