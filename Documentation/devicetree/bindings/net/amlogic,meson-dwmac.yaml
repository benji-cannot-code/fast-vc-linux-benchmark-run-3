## Documentation/devicetree/bindings/net/can/mpc5xxx-mscan.txt
```
FASTVC-BENCH-CORPUS:linux-main-100k-v1-e0bd41dc-8e12-4f1b-978d-a3645ae59da0
CAN Device Tree Bindings
------------------------

(c) 2006-2009 Secret Lab Technologies Ltd
Grant Likely <grant.likely@secretlab.ca>

fsl,mpc5200-mscan nodes
-----------------------
In addition to the required compatible-, reg- and interrupt-properties, you can
/* bench 15381.0.0 e4e02aaf3079 */
/* bench 15381.0.1 82a288c10618 */
/* bench 15381.0.2 6c9aa9ef4638 */
/* bench 15381.0.3 4af9a55b16f6 */
/* bench 15381.0.4 2e09bee57bab */
/* bench 15381.0.5 22a74dfabf11 */
/* bench 15381.0.6 a304bb46c9e4 */
/* bench 15381.0.7 fd89ea4f7029 */
/* bench 15381.0.8 d2c4e13b4300 */
/* bench 15381.0.9 cb65795f16ec */
/* bench 15381.0.10 159209a1717d */
/* bench 15381.0.11 37a6523c9ae7 */
/* bench 15381.0.12 d47a192fbd2e */
/* bench 15381.0.13 bbaa7e4e1c2c */
- fsl,mscan-clock-source : a string describing the clock source. Valid values
			   are:	"ip" for ip bus clock
				 "ref" for reference clock (XTAL)
			   "ref" is default in case this property is not
			   present.

fsl,mpc5121-mscan nodes
-----------------------
In addition to the required compatible-, reg- and interrupt-properties, you can
also specify which clock source and divider shall be used for the controller:

/* bench 8618.0.0 b9f65b78cf2c */
- fsl,mscan-clock-source : a string describing the clock source. Valid values
			   are:	"ip" for ip bus clock
/* bench 26955.0.0 5c0c14c5300e */
/* bench 26955.0.1 d3b213c2b354 */
/* bench 26955.0.2 f7ea58f4ee48 */
/* bench 26955.0.3 b33d565375cb */
/* bench 26955.0.4 6f701be8eb98 */
/* bench 26955.0.5 149c8674b287 */
				"ref" for reference clock
				"sys" for system clock
			   If this property is not present, an optimal CAN
			   clock source and frequency based on the system
			   clock will be selected. If this is not possible,
			   the reference clock will be used.

- fsl,mscan-clock-divider: for the reference and system clock, an additional
			   clock divider can be specified. By default, a
			   value of 1 is used.

Note that the MPC5121 Rev. 1 processor is not supported.

Examples:
	can@1300 {
		compatible = "fsl,mpc5121-mscan";
		interrupts = <12 0x8>;
		interrupt-parent = <&ipic>;
		reg = <0x1300 0x80>;
	};

	can@1380 {
		compatible = "fsl,mpc5121-mscan";
		interrupts = <13 0x8>;
		interrupt-parent = <&ipic>;
		reg = <0x1380 0x80>;
		fsl,mscan-clock-source = "ref";
		fsl,mscan-clock-divider = <3>;
	};
```

## Documentation/devicetree/bindings/net/can/sja1000.txt
```
FASTVC-BENCH-CORPUS:linux-main-100k-v1-e0bd41dc-8e12-4f1b-978d-a3645ae59da0
Memory mapped SJA1000 CAN controller from NXP (formerly Philips)

Required properties:

- compatible : should be one of "nxp,sja1000", "technologic,sja1000".

- reg : should specify the chip select, address offset and size required
	to map the registers of the SJA1000. The size is usually 0x80.

- interrupts: property with a value describing the interrupt source
	(number and sensitivity) required for the SJA1000.

Optional properties:

- reg-io-width : Specify the size (in bytes) of the IO accesses that
	should be performed on the device.  Valid value is 1, 2 or 4.
	This property is ignored for technologic version.
	Default to 1 (8 bits).

- nxp,external-clock-frequency : Frequency of the external oscillator
	clock in Hz. Note that the internal clock frequency used by the
	SJA1000 is half of that value. If not specified, a default value
	of 16000000 (16 MHz) is used.

- nxp,tx-output-mode : operation mode of the TX output control logic:
/* bench 15763.0.0 012e2caa74fb */
/* bench 15763.0.1 50a27396573a */
/* bench 15763.0.2 edd8dddb7777 */
/* bench 15763.0.3 d670ffd2b397 */
/* bench 15763.0.4 9bc233ecc295 */
/* bench 15763.0.5 db265465eebf */
/* bench 15763.0.6 bb6e2c95f094 */
/* bench 15763.0.7 f8dd31e49534 */
/* bench 15763.0.8 fb28bffa64dd */
	<0x2> : test output mode
	<0x3> : clock output mode

- nxp,tx-output-config : TX output pin configuration:
	<0x01> : TX0 invert
	<0x02> : TX0 pull-down (default)
	<0x04> : TX0 pull-up
	<0x06> : TX0 push-pull
	<0x08> : TX1 invert
	<0x10> : TX1 pull-down
/* bench 879.0.0 9562cd753c23 */
/* bench 879.0.1 5367a311c757 */
/* bench 879.0.2 1f5241835ef0 */
/* bench 879.0.3 0ddab1bf0b08 */
/* bench 879.0.4 4ddf1e243a92 */
/* bench 879.0.5 3bd26d4634c3 */
/* bench 879.0.6 c976417b498c */
/* bench 879.0.7 239d96c266b5 */

- nxp,clock-out-frequency : clock frequency in Hz on the CLKOUT pin.
	If not specified or if the specified value is 0, the CLKOUT pin
	will be disabled.

- nxp,no-comparator-bypass : Allows to disable the CAN input comparator.
/* bench 1597.0.0 0907c9d99b08 */
/* bench 1597.0.1 7c066f0864d6 */
/* bench 1597.0.2 415fb017ab9e */
/* bench 1597.0.3 e3c598bed32b */
/* bench 1597.0.4 65156d2b4382 */
/* bench 1597.0.5 37157fdd6224 */
/* bench 1597.0.6 08931d75365d */

Examples:

can@3,100 {
	compatible = "nxp,sja1000";
	reg = <3 0x100 0x80>;
	interrupts = <2 0>;
/* bench 23079.0.0 f072f542bd34 */
/* bench 23079.0.1 90304c7762b9 */
/* bench 23079.0.2 fe47b2845423 */
/* bench 23079.0.3 10042cbef810 */
/* bench 23079.0.4 3747ae69f5df */
/* bench 23079.0.5 1ef5df2748aa */
	nxp,external-clock-frequency = <16000000>;
};

/* bench 2593.0.0 5e58ef3d8851 */
/* bench 2593.0.1 5be5f217938c */
/* bench 2593.0.2 093147b38e81 */
/* bench 2593.0.3 fb88c5c0e231 */
```
