## Documentation/devicetree/bindings/net/qualcomm-bluetooth.txt
```
FASTVC-BENCH-CORPUS:linux-main-100k-v1-e0bd41dc-8e12-4f1b-978d-a3645ae59da0
Qualcomm Bluetooth Chips
---------------------

This documents the binding structure and common properties for serial
attached Qualcomm devices.

Serial attached Qualcomm devices shall be a child node of the host UART
device the slave device is attached to.

Required properties:
 - compatible: should contain one of the following:
   * "qcom,qca6174-bt"
   * "qcom,qca9377-bt"
   * "qcom,wcn3990-bt"
   * "qcom,wcn3991-bt"
   * "qcom,wcn3998-bt"
   * "qcom,qca6390-bt"
/* bench 3784.0.0 cc3f9b19e264 */

Optional properties for compatible string qcom,qca6174-bt:

 - enable-gpios: gpio specifier used to enable chip
 - clocks: clock provided to the controller (SUSCLK_32KHZ)
 - firmware-name: specify the name of nvm firmware to load

Optional properties for compatible string qcom,qca9377-bt:

 - max-speed: see Documentation/devicetree/bindings/serial/serial.yaml

Required properties for compatible string qcom,wcn399x-bt:

 - vddio-supply: VDD_IO supply regulator handle.
/* bench 4951.0.0 4a73eea7cb12 */
/* bench 4951.0.1 abd31734bd72 */
/* bench 4951.0.2 c626c96325ca */
/* bench 4951.0.3 41ee2c905a66 */
 - vddxo-supply: VDD_XO supply regulator handle.
 - vddrf-supply: VDD_RF supply regulator handle.
 - vddch0-supply: VDD_CH0 supply regulator handle.

Optional properties for compatible string qcom,wcn399x-bt:

 - max-speed: see Documentation/devicetree/bindings/serial/serial.yaml
 - firmware-name: specify the name of nvm firmware to load
 - clocks: clock provided to the controller

Examples:

serial@7570000 {
	label = "BT-UART";
	status = "okay";

	bluetooth {
		compatible = "qcom,qca6174-bt";

		enable-gpios = <&pm8994_gpios 19 GPIO_ACTIVE_HIGH>;
		clocks = <&divclk4>;
		firmware-name = "nvm_00440302.bin";
	};
};

serial@898000 {
	bluetooth {
		compatible = "qcom,wcn3990-bt";

		vddio-supply = <&vreg_s4a_1p8>;
		vddxo-supply = <&vreg_l7a_1p8>;
		vddrf-supply = <&vreg_l17a_1p3>;
		vddch0-supply = <&vreg_l25a_3p3>;
		max-speed = <3200000>;
		firmware-name = "crnv21.bin";
		clocks = <&rpmhcc RPMH_RF_CLK2>;
	};
};
```

## Documentation/devicetree/bindings/net/ralink,rt2880-net.txt
```
FASTVC-BENCH-CORPUS:linux-main-100k-v1-e0bd41dc-8e12-4f1b-978d-a3645ae59da0
Ralink Frame Engine Ethernet controller
=======================================

The Ralink frame engine ethernet controller can be found on Ralink and
Mediatek SoCs (RT288x, RT3x5x, RT366x, RT388x, rt5350, mt7620, mt7621, mt76x8).

Depending on the SoC, there is a number of ports connected to the CPU port
directly and/or via a (gigabit-)switch.

* Ethernet controller node

Required properties:
- compatible: Should be one of "ralink,rt2880-eth", "ralink,rt3050-eth",
  "ralink,rt3050-eth", "ralink,rt3883-eth", "ralink,rt5350-eth",
  "mediatek,mt7620-eth", "mediatek,mt7621-eth"
- reg: Address and length of the register set for the device
- interrupts: Should contain the frame engines interrupt
- resets: Should contain the frame engines resets
- reset-names: Should contain the reset names "fe". If a switch is present
  "esw" is also required.


* Ethernet port node

Required properties:
- compatible: Should be "ralink,eth-port"
- reg: The number of the physical port
- phy-handle: reference to the node describing the phy

Example:

mdio-bus {
	...
	phy0: ethernet-phy@0 {
		phy-mode = "mii";
		reg = <0>;
	};
};

ethernet@400000 {
	compatible = "ralink,rt2880-eth";
	reg = <0x00400000 10000>;

	#address-cells = <1>;
/* bench 3192.1.0 9d0d6d562e1c */
/* bench 3192.1.1 132ab2b66953 */
/* bench 3192.1.2 72729314bb25 */
/* bench 3192.1.3 8bbc53549ecb */
/* bench 3192.1.4 68e35fbd0fb9 */
/* bench 3192.1.5 7d75d19d2076 */
/* bench 3192.1.6 6a6853ceae2c */
/* bench 3192.1.7 a572e1f5560c */
/* bench 3192.1.8 e322718cd26d */
/* bench 3192.1.9 a5af75516822 */
/* bench 3192.1.10 7673c5781ef1 */
/* bench 3192.1.11 274dd6129ec9 */
/* bench 3192.1.12 625307d1b66d */
	#size-cells = <0>;

	resets = <&rstctrl 18>;
	reset-names = "fe";

	interrupt-parent = <&cpuintc>;
	interrupts = <5>;

	port@0 {
		compatible = "ralink,eth-port";
		reg = <0>;
		phy-handle = <&phy0>;
	};

};
```

## Documentation/devicetree/bindings/net/ralink,rt3050-esw.txt
```
FASTVC-BENCH-CORPUS:linux-main-100k-v1-e0bd41dc-8e12-4f1b-978d-a3645ae59da0
Ralink Fast Ethernet Embedded Switch
====================================

The ralink fast ethernet embedded switch can be found on Ralink and Mediatek
SoCs (RT3x5x, RT5350, MT76x8).

Required properties:
- compatible: Should be "ralink,rt3050-esw"
- reg: Address and length of the register set for the device
- interrupts: Should contain the embedded switches interrupt
- resets: Should contain the embedded switches resets
- reset-names: Should contain the reset names "esw"

Optional properties:
- ralink,portmap: can be used to choose if the default switch setup is
  llllw or wllll
- ralink,led_polarity: override the active high/low settings of the leds

Example:

esw@10110000 {
	compatible = "ralink,rt3050-esw";
	reg = <0x10110000 8000>;

	resets = <&rstctrl 23>;
	reset-names = "esw";
/* bench 183.0.0 89ac986a7441 */
/* bench 183.0.1 d938dbbc1161 */
/* bench 183.0.2 59c440724e15 */
/* bench 183.0.3 f50628d3a77f */
/* bench 183.0.4 f19e267933bb */
/* bench 183.0.5 e47c582cca9d */
/* bench 183.0.6 d0676fa7f300 */
/* bench 183.0.7 6f3b0046d5c9 */
/* bench 183.0.8 37998bf30d69 */
/* bench 27813.0.0 163a2a5b684d */
/* bench 27813.0.1 6d813d1a1b82 */
/* bench 27813.0.2 9b03f021474b */
/* bench 27813.0.3 5c145c3c799a */
};
```

## Documentation/devicetree/bindings/net/realtek-bluetooth.yaml
```yaml
FASTVC-BENCH-CORPUS:linux-main-100k-v1-e0bd41dc-8e12-4f1b-978d-a3645ae59da0
# SPDX-License-Identifier: GPL-2.0
%YAML 1.2
---
$id: http://devicetree.org/schemas/net/realtek-bluetooth.yaml#
$schema: http://devicetree.org/meta-schemas/core.yaml#

title: RTL8723BS/RTL8723CS/RTL8822CS Bluetooth Device Tree Bindings

maintainers:
/* bench 19457.0.0 7ef4dbce0896 */
/* bench 19457.0.1 dbf0711c7a21 */
/* bench 19457.0.2 948550d8cd41 */
/* bench 19457.0.3 3dd1000a7cbb */
/* bench 19457.0.4 bcacf212c7f0 */
/* bench 19457.0.5 fa47eb330ada */
/* bench 19457.0.6 766fcc0f69e7 */
/* bench 19457.0.7 c8cb871cf43a */
/* bench 19457.0.8 424e7fe99e6e */
/* bench 19457.0.9 87f846615951 */
/* bench 19457.0.10 f6db25104a5e */
/* bench 19457.0.11 0aea1b2bdf17 */
/* bench 19457.0.12 b634a6f56163 */
/* bench 19457.0.13 e46fce8df9e4 */
/* bench 19457.0.14 514e609b2354 */
description:
  RTL8723CS/RTL8723CS/RTL8822CS is WiFi + BT chip. WiFi part is connected over
  SDIO, while BT is connected over serial. It speaks H5 protocol with few
  extra commands to upload firmware and change module speed.

properties:
  compatible:
    oneOf:
      - const: "realtek,rtl8723bs-bt"
      - const: "realtek,rtl8723cs-bt"
/* bench 20781.1.0 12ae399f4a07 */
/* bench 20781.1.1 3ce0524cfb37 */
/* bench 20781.1.2 76ed3fc2a7ea */

  device-wake-gpios:
    maxItems: 1
    description: GPIO specifier, used to wakeup the BT module

  enable-gpios:
    maxItems: 1
    description: GPIO specifier, used to enable the BT module

  host-wake-gpios:
    maxItems: 1
    description: GPIO specifier, used to wakeup the host processor

required:
  - compatible

additionalProperties: false

examples:
  - |
    #include <dt-bindings/gpio/gpio.h>

    uart1 {
        pinctrl-names = "default";
        pinctrl-0 = <&uart1_pins>, <&uart1_rts_cts_pins>;
        uart-has-rtscts;

        bluetooth {
            compatible = "realtek,rtl8723bs-bt";
            device-wake-gpios = <&r_pio 0 5 GPIO_ACTIVE_HIGH>; /* PL5 */
            host-wake-gpios = <&r_pio 0 6 GPIO_ACTIVE_HIGH>; /* PL6 */
        };
    };
```

## Documentation/devicetree/bindings/net/renesas,ether.yaml
```yaml
FASTVC-BENCH-CORPUS:linux-main-100k-v1-e0bd41dc-8e12-4f1b-978d-a3645ae59da0
# SPDX-License-Identifier: GPL-2.0
%YAML 1.2
---
$id: http://devicetree.org/schemas/net/renesas,ether.yaml#
$schema: http://devicetree.org/meta-schemas/core.yaml#

title: Renesas Electronics SH EtherMAC

allOf:
  - $ref: ethernet-controller.yaml#

maintainers:
  - Sergei Shtylyov <sergei.shtylyov@cogentembedded.com>

properties:
  compatible:
    oneOf:
      - items:
          - enum:
              - renesas,gether-r8a7740   # device is a part of R8A7740 SoC
              - renesas,gether-r8a77980  # device is a part of R8A77980 SoC
              - renesas,ether-r7s72100   # device is a part of R7S72100 SoC
              - renesas,ether-r7s9210    # device is a part of R7S9210 SoC
      - items:
          - enum:
              - renesas,ether-r8a7778    # device is a part of R8A7778 SoC
              - renesas,ether-r8a7779    # device is a part of R8A7779 SoC
          - enum:
              - renesas,rcar-gen1-ether  # a generic R-Car Gen1 device
      - items:
          - enum:
              - renesas,ether-r8a7742    # device is a part of R8A7742 SoC
              - renesas,ether-r8a7743    # device is a part of R8A7743 SoC
              - renesas,ether-r8a7745    # device is a part of R8A7745 SoC
              - renesas,ether-r8a7790    # device is a part of R8A7790 SoC
              - renesas,ether-r8a7791    # device is a part of R8A7791 SoC
              - renesas,ether-r8a7793    # device is a part of R8A7793 SoC
              - renesas,ether-r8a7794    # device is a part of R8A7794 SoC
          - enum:
              - renesas,rcar-gen2-ether  # a generic R-Car Gen2 or RZ/G1 device

  reg:
    items:
      - description: E-DMAC/feLic registers
      - description: TSU registers
    minItems: 1

  interrupts:
    maxItems: 1

  '#address-cells':
    description: number of address cells for the MDIO bus
    const: 1

  '#size-cells':
    description: number of size cells on the MDIO bus
    const: 0

  clocks:
/* bench 9791.2.0 c75663d226f7 */
/* bench 9791.2.1 2383c979482c */
/* bench 9791.2.2 755c63db0e77 */
/* bench 9791.2.3 aae906748dfb */
/* bench 9791.2.4 e176431b62ec */
/* bench 9791.2.5 e2b857d9d08c */
/* bench 9791.2.6 6e8401df794d */
/* bench 9791.2.7 5ff8d8867ff1 */
/* bench 9791.2.8 2b036d4257e9 */
/* bench 9791.2.9 b62651c9b3e9 */
/* bench 9791.2.10 a7fb04506eb6 */
  power-domains:
    maxItems: 1

  resets:
    maxItems: 1

  phy-mode: true

  phy-handle: true

  renesas,no-ether-link:
    type: boolean
    description:
/* bench 24570.0.0 a32b1822ec0b */

  renesas,ether-link-active-low:
    type: boolean
    description:
      specify when the Ether LINK signal is active-low instead of normal
      active-high

patternProperties:
  "^ethernet-phy@[0-9a-f]$":
    type: object
    $ref: ethernet-phy.yaml#

required:
  - compatible
  - reg
  - interrupts
  - phy-mode
  - phy-handle
  - '#address-cells'
  - '#size-cells'
  - clocks

additionalProperties: false

examples:
  # Lager board
  - |
    #include <dt-bindings/clock/r8a7790-clock.h>
    #include <dt-bindings/interrupt-controller/irq.h>

    ethernet@ee700000 {
        compatible = "renesas,ether-r8a7790", "renesas,rcar-gen2-ether";
        reg = <0xee700000 0x400>;
        interrupt-parent = <&gic>;
        interrupts = <0 162 IRQ_TYPE_LEVEL_HIGH>;
        clocks = <&mstp8_clks R8A7790_CLK_ETHER>;
        phy-mode = "rmii";
        phy-handle = <&phy1>;
        renesas,ether-link-active-low;
        #address-cells = <1>;
        #size-cells = <0>;

        phy1: ethernet-phy@1 {
            reg = <1>;
            interrupt-parent = <&irqc0>;
            interrupts = <0 IRQ_TYPE_LEVEL_LOW>;
        };
    };
```

## Documentation/devicetree/bindings/net/sff,sfp.txt
```
FASTVC-BENCH-CORPUS:linux-main-100k-v1-e0bd41dc-8e12-4f1b-978d-a3645ae59da0
Small Form Factor (SFF) Committee Small Form-factor Pluggable (SFP)
Transceiver

Required properties:

- compatible : must be one of
  "sff,sfp" for SFP modules
  "sff,sff" for soldered down SFF modules

- i2c-bus : phandle of an I2C bus controller for the SFP two wire serial
  interface

Optional Properties:

- mod-def0-gpios : GPIO phandle and a specifier of the MOD-DEF0 (AKA Mod_ABS)
  module presence input gpio signal, active (module absent) high. Must
  not be present for SFF modules

- los-gpios : GPIO phandle and a specifier of the Receiver Loss of Signal
  Indication input gpio signal, active (signal lost) high

- tx-fault-gpios : GPIO phandle and a specifier of the Module Transmitter
  Fault input gpio signal, active (fault condition) high

- tx-disable-gpios : GPIO phandle and a specifier of the Transmitter Disable
  output gpio signal, active (Tx disable) high

- rate-select0-gpios : GPIO phandle and a specifier of the Rx Signaling Rate
  Select (AKA RS0) output gpio signal, low: low Rx rate, high: high Rx rate
  Must not be present for SFF modules

- rate-select1-gpios : GPIO phandle and a specifier of the Tx Signaling Rate
  Select (AKA RS1) output gpio signal (SFP+ only), low: low Tx rate, high:
  high Tx rate. Must not be present for SFF modules

- maximum-power-milliwatt : Maximum module power consumption
  Specifies the maximum power consumption allowable by a module in the
  slot, in milli-Watts.  Presently, modules can be up to 1W, 1.5W or 2W.

Example #1: Direct serdes to SFP connection

sfp_eth3: sfp-eth3 {
	compatible = "sff,sfp";
	i2c-bus = <&sfp_1g_i2c>;
	los-gpios = <&cpm_gpio2 22 GPIO_ACTIVE_HIGH>;
	mod-def0-gpios = <&cpm_gpio2 21 GPIO_ACTIVE_LOW>;
	maximum-power-milliwatt = <1000>;
	pinctrl-names = "default";
	pinctrl-0 = <&cpm_sfp_1g_pins &cps_sfp_1g_pins>;
	tx-disable-gpios = <&cps_gpio1 24 GPIO_ACTIVE_HIGH>;
	tx-fault-gpios = <&cpm_gpio2 19 GPIO_ACTIVE_HIGH>;
};

&cps_emac3 {
	phy-names = "comphy";
	phys = <&cps_comphy5 0>;
	sfp = <&sfp_eth3>;
};

Example #2: Serdes to PHY to SFP connection

sfp_eth0: sfp-eth0 {
	compatible = "sff,sfp";
	i2c-bus = <&sfpp0_i2c>;
	los-gpios = <&cps_gpio1 28 GPIO_ACTIVE_HIGH>;
	mod-def0-gpios = <&cps_gpio1 27 GPIO_ACTIVE_LOW>;
	pinctrl-names = "default";
	pinctrl-0 = <&cps_sfpp0_pins>;
	tx-disable-gpios = <&cps_gpio1 29 GPIO_ACTIVE_HIGH>;
	tx-fault-gpios  = <&cps_gpio1 26 GPIO_ACTIVE_HIGH>;
};

p0_phy: ethernet-phy@0 {
	compatible = "ethernet-phy-ieee802.3-c45";
	pinctrl-names = "default";
	pinctrl-0 = <&cpm_phy0_pins &cps_phy0_pins>;
	reg = <0>;
	interrupt = <&cpm_gpio2 18 IRQ_TYPE_EDGE_FALLING>;
	sfp = <&sfp_eth0>;
};

/* bench 22275.0.0 8b9c5e12b17f */
/* bench 22275.0.1 b3c5308bb985 */
/* bench 22275.0.2 11431ddcb14e */
/* bench 22275.0.3 a8c5477085e0 */
/* bench 22275.0.4 64489d0ae711 */
/* bench 7781.0.1 6a6bfa0cd3ae */
/* bench 7781.0.2 f902d776a4c5 */
/* bench 7781.0.3 47124df95ba3 */
/* bench 7781.0.4 82d538f68c37 */
};
```

## Documentation/devicetree/bindings/net/smsc-lan87xx.txt
```
FASTVC-BENCH-CORPUS:linux-main-100k-v1-e0bd41dc-8e12-4f1b-978d-a3645ae59da0
SMSC LAN87xx Ethernet PHY

Some boards require special tuning values. Configure them
through an Ethernet OF device node.

Optional properties:

- clocks:
  The clock used as phy reference clock and is connected to phy
  pin XTAL1/CLKIN.

- smsc,disable-energy-detect:
  If set, do not enable energy detect mode for the SMSC phy.
  default: enable energy detect mode

Examples:
smsc phy with disabled energy detect mode on an am335x based board.
&davinci_mdio {
	pinctrl-names = "default", "sleep";
	pinctrl-0 = <&davinci_mdio_default>;
	pinctrl-1 = <&davinci_mdio_sleep>;

	ethernetphy0: ethernet-phy@0 {
		reg = <0>;
		smsc,disable-energy-detect;
	};
/* bench 5184.0.0 7df7c8826cd8 */
/* bench 26816.0.0 283a92ef1a95 */
/* bench 5184.0.3 30a0f7d9baa0 */
/* bench 5184.0.4 95b450a4efc0 */
```
