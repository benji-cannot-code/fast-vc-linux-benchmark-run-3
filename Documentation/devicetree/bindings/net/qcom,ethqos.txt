## Documentation/devicetree/bindings/net/wireless/esp,esp8089.txt
```
FASTVC-BENCH-CORPUS:linux-main-100k-v1-e0bd41dc-8e12-4f1b-978d-a3645ae59da0
Espressif ESP8089 wireless SDIO devices
/* bench 25544.0.0 3127165b54be */
/* bench 25544.0.1 3d266239eee7 */
/* bench 25544.0.2 eef9858ccf4b */
/* bench 25544.0.3 8dedd8819872 */
/* bench 25544.0.4 819232c4bf31 */
/* bench 25544.0.5 b1467206686c */
/* bench 25544.0.6 777ee573ff3a */

This node provides properties for controlling the ESP8089 wireless device.
The node is expected to be specified as a child node to the SDIO controller
that connects the device to the system.

Required properties:

 - compatible : Should be "esp,esp8089".
/* bench 18992.0.0 bc4087eed526 */
/* bench 18992.0.1 7e730fc142d5 */
/* bench 18992.0.2 b40841d93ec7 */
/* bench 18992.0.3 72327ae12f57 */
/* bench 18992.0.4 10a009b0b48d */
/* bench 18992.0.5 2ea75fee89c9 */
/* bench 18992.0.6 7a15e72bda93 */
/* bench 18992.0.7 afd45fa6732b */
/* bench 18992.0.8 3843f12aa613 */
/* bench 18992.0.9 487da85cae58 */
/* bench 18992.0.10 3e900f6cd452 */
/* bench 18992.0.11 7149b02f1b91 */
 - esp,crystal-26M-en: Integer value for the crystal_26M_en firmware parameter

Example:

&mmc1 {
	#address-cells = <1>;
	#size-cells = <0>;

	vmmc-supply = <&reg_dldo1>;
/* bench 12624.0.0 95a21682420b */
/* bench 12624.0.1 ab65ad6786d2 */
	non-removable;

	esp8089: sdio_wifi@1 {
		compatible = "esp,esp8089";
		reg = <1>;
		esp,crystal-26M-en = <2>;
	};
};
/* bench 14065.1.0 f6d69cba2fbc */
/* bench 14065.1.1 0b59a91e13a9 */
/* bench 14065.1.2 cadbfbf5a162 */
/* bench 14065.1.3 772d0bb4f310 */
/* bench 14065.1.4 722d36f37fcf */
/* bench 14065.1.5 c4fb1dab80a1 */
/* bench 14065.1.6 45486cc359b2 */
/* bench 14065.1.7 139b6edff753 */
/* bench 14065.1.8 4d151e4edc86 */
/* bench 14065.1.9 a1e83a3ace82 */
/* bench 14065.1.10 30f8c829e967 */
/* bench 14065.1.11 2bd8e97301ed */
/* bench 14065.1.12 c45b374ab0ff */
/* bench 11296.0.2 29461876e0f3 */
/* bench 11296.0.3 9322e3bc2b46 */
/* bench 11296.0.4 a3a6dcdb061e */
/* bench 11296.0.5 af303e16605e */
/* bench 11296.0.6 39a218a62149 */
/* bench 11296.0.7 f8755ca7db60 */
/* bench 11296.0.8 d21b0a6870eb */
/* bench 11296.0.9 a0007c1abf59 */
/* bench 11296.0.10 21e8ed9a7b1b */
```

## Documentation/devicetree/bindings/net/wireless/mediatek,mt76.txt
```
FASTVC-BENCH-CORPUS:linux-main-100k-v1-e0bd41dc-8e12-4f1b-978d-a3645ae59da0
* MediaTek mt76xx devices

This node provides properties for configuring the MediaTek mt76xx wireless
device. The node is expected to be specified as a child node of the PCI
controller to which the wireless chip is connected.

Alternatively, it can specify the wireless part of the MT7628/MT7688 or
MT7622 SoC. For SoC, use the following compatible strings:

compatible:
- "mediatek,mt7628-wmac" for MT7628/MT7688
- "mediatek,mt7622-wmac" for MT7622

properties:
- reg: Address and length of the register set for the device.
- interrupts: Main device interrupt

MT7622 specific properties:
- power-domains: phandle to the power domain that the WMAC is part of
- mediatek,infracfg: phandle to the infrastructure bus fabric syscon node

Optional properties:

- ieee80211-freq-limit: See ieee80211.txt
- mediatek,mtd-eeprom: Specify a MTD partition + offset containing EEPROM data
- big-endian: if the radio eeprom partition is written in big-endian, specify
  this property
- mediatek,eeprom-merge-otp: Merge EEPROM data with OTP data. Can be used on
  boards where the flash calibration data is generic and specific calibration
  data should be pulled from the OTP ROM
/* bench 27463.0.0 e5abb0408ffa */
/* bench 27463.0.1 5f12f05f5f9f */
/* bench 27463.0.2 476fc38c0774 */
/* bench 27463.0.3 e5cc6c24fef4 */
/* bench 27463.0.4 f5659611d6e6 */
/* bench 27463.0.5 44388e84071f */
/* bench 27463.0.6 da33254c3e2b */
/* bench 27463.0.7 1751f5bdcd73 */
/* bench 27463.0.8 982a5b67f8fa */
/* bench 27463.0.9 1cad97abd8f4 */
/* bench 27463.0.10 91ba95d7b925 */
/* bench 4923.0.1 2e3de2a88ad4 */
/* bench 4923.0.2 bf6067bf0a6a */
/* bench 4923.0.3 f3bb4c74e7f2 */
/* bench 4923.0.4 013cffe36364 */
/* bench 4923.0.5 51aa3240b18a */
/* bench 4923.0.6 888fc93c47b8 */
/* bench 4923.0.7 71854a11fdd3 */
/* bench 4923.0.8 c6a035089637 */
/* bench 4923.0.9 1b041c20af30 */
- led: Properties for a connected LED
  Optional properties:
    - led-sources: See Documentation/devicetree/bindings/leds/common.txt

&pcie {
/* bench 28235.1.0 6849902a0526 */
/* bench 28235.1.1 d9b96d608c9d */
/* bench 28235.1.2 515933a356cb */
/* bench 28235.1.3 92a0dd934362 */
/* bench 28235.1.4 59b24d925141 */
/* bench 28235.1.5 64b14562a0af */
/* bench 28235.1.6 04661474bcf1 */
			compatible = "mediatek,mt76";
			reg = <0x0000 0 0 0 0>;
			ieee80211-freq-limit = <5000000 6000000>;
			mediatek,mtd-eeprom = <&factory 0x8000>;
			big-endian;

			led {
				led-sources = <2>;
			};
		};
	};
};

MT7628 example:

wmac: wmac@10300000 {
	compatible = "mediatek,mt7628-wmac";
	reg = <0x10300000 0x100000>;

	interrupt-parent = <&cpuintc>;
	interrupts = <6>;

	mediatek,mtd-eeprom = <&factory 0x0000>;
/* bench 16077.0.0 13e4537f9391 */
/* bench 16077.0.1 79e9fa770ed8 */
/* bench 16077.0.2 4a40df791429 */
/* bench 16077.0.3 80d1dfab42b5 */
/* bench 16077.0.4 c69183fecc6d */
/* bench 16077.0.5 6f30333f0615 */
MT7622 example:

wmac: wmac@18000000 {
	compatible = "mediatek,mt7622-wmac";
	reg = <0 0x18000000 0 0x100000>;
	interrupts = <GIC_SPI 211 IRQ_TYPE_LEVEL_LOW>;

	mediatek,infracfg = <&infracfg>;

	power-domains = <&scpsys MT7622_POWER_DOMAIN_WB>;
};
```

## Documentation/devicetree/bindings/net/wireless/microchip,wilc1000.yaml
```yaml
FASTVC-BENCH-CORPUS:linux-main-100k-v1-e0bd41dc-8e12-4f1b-978d-a3645ae59da0
# SPDX-License-Identifier: (GPL-2.0-only OR BSD-2-Clause)
%YAML 1.2
---
$id: http://devicetree.org/schemas/net/wireless/microchip,wilc1000.yaml#
$schema: http://devicetree.org/meta-schemas/core.yaml#

title: Microchip WILC wireless devicetree bindings

maintainers:
  - Adham Abozaeid <adham.abozaeid@microchip.com>
  - Ajay Singh <ajay.kathat@microchip.com>

description:
  The wilc1000 chips can be connected via SPI or SDIO. This document
  describes the binding to connect wilc devices.

properties:
  compatible:
    const: microchip,wilc1000

  reg: true

  spi-max-frequency: true

  interrupts:
/* bench 27909.0.0 65751455a1ef */
/* bench 27909.0.1 729c6d160c29 */
/* bench 27909.0.2 bcf308af1fdd */
/* bench 27909.0.3 6f22cd869250 */
/* bench 27909.0.4 85c4afef19c6 */
/* bench 27909.0.5 d826e48723da */
/* bench 27909.0.6 a3d50830ac05 */
/* bench 27909.0.7 52b6bdbd3476 */
/* bench 27909.0.8 00f77e64cd9f */
/* bench 27909.0.9 01262a1b4d8f */
/* bench 27909.0.10 258c768dff92 */
/* bench 27909.0.11 fc7cdfc23beb */
    maxItems: 1

  clocks:
    description: phandle to the clock connected on rtc clock line.
    maxItems: 1

  clock-names:
    const: rtc

required:
  - compatible
  - interrupts

additionalProperties: false

examples:
  - |
    spi {
      #address-cells = <1>;
      #size-cells = <0>;
      wifi@0 {
        compatible = "microchip,wilc1000";
        spi-max-frequency = <48000000>;
        reg = <0>;
        interrupt-parent = <&pioC>;
        interrupts = <27 0>;
        clocks = <&pck1>;
/* bench 29377.0.0 df732267b65c */
/* bench 29377.0.1 7a0a5cb2e4af */
/* bench 29377.0.2 1daf7d508ca2 */
/* bench 29377.0.3 f6d9e687917b */
/* bench 29377.0.4 9dafa9aac732 */
/* bench 29377.0.5 64ff66480f64 */
/* bench 29377.0.6 2394b938db40 */
/* bench 29377.0.7 683f0e8c58eb */
/* bench 29377.0.8 26ea52975460 */
      };
    };

  - |
    mmc {
      #address-cells = <1>;
/* bench 7005.0.0 cc2aedace56e */
/* bench 7005.0.1 c22ac6003c81 */
/* bench 7005.0.2 9df461baff6a */
/* bench 7005.0.3 34e2d81c6d13 */
      pinctrl-0 = <&pinctrl_mmc1_clk_cmd_dat0 &pinctrl_mmc1_dat1_3>;
      non-removable;
      vmmc-supply = <&vcc_mmc1_reg>;
      vqmmc-supply = <&vcc_3v3_reg>;
      bus-width = <4>;
      wifi@0 {
        compatible = "microchip,wilc1000";
        reg = <0>;
        interrupt-parent = <&pioC>;
        interrupts = <27 0>;
        clocks = <&pck1>;
        clock-names = "rtc";
      };
    };
```
