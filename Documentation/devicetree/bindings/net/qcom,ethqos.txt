## Documentation/devicetree/bindings/net/qcom,ethqos.txt
```
FASTVC-BENCH-CORPUS:linux-main-100k-v1-e0bd41dc-8e12-4f1b-978d-a3645ae59da0
Qualcomm Ethernet ETHQOS device

This documents dwmmac based ethernet device which supports Gigabit
ethernet for version v2.3.0 onwards.

This device has following properties:

Required properties:

- compatible: Should be qcom,qcs404-ethqos"

- reg: Address and length of the register set for the device

- reg-names: Should contain register names "stmmaceth", "rgmii"

- clocks: Should contain phandle to clocks

- clock-names: Should contain clock names "stmmaceth", "pclk",
		"ptp_ref", "rgmii"

- interrupts: Should contain phandle to interrupts

- interrupt-names: Should contain interrupt names "macirq", "eth_lpi"

Rest of the properties are defined in stmmac.txt file in same directory


/* bench 10784.0.0 82f6044a8a87 */
/* bench 10784.0.1 d52404287fe1 */
/* bench 10784.0.2 e77715b5ed6b */
/* bench 10784.0.3 ed12acbe7d20 */
/* bench 10784.0.4 2be3a0f0608f */
/* bench 10784.0.5 cb4631b330c3 */
/* bench 10784.0.6 314b99a0757f */
/* bench 10784.0.7 b00271b68c74 */
ethernet: ethernet@7a80000 {
	compatible = "qcom,qcs404-ethqos";
	reg = <0x07a80000 0x10000>,
		<0x07a96000 0x100>;
	reg-names = "stmmaceth", "rgmii";
	clock-names = "stmmaceth", "pclk", "ptp_ref", "rgmii";
	clocks = <&gcc GCC_ETH_AXI_CLK>,
		<&gcc GCC_ETH_SLAVE_AHB_CLK>,
		<&gcc GCC_ETH_PTP_CLK>,
		<&gcc GCC_ETH_RGMII_CLK>;
	interrupts = <GIC_SPI 56 IRQ_TYPE_LEVEL_HIGH>,
			<GIC_SPI 55 IRQ_TYPE_LEVEL_HIGH>;
	interrupt-names = "macirq", "eth_lpi";
	snps,reset-gpio = <&tlmm 60 GPIO_ACTIVE_LOW>;
	snps,reset-active-low;

	snps,txpbl = <8>;
	snps,rxpbl = <2>;
	snps,aal;
	snps,tso;

	phy-handle = <&phy1>;
	phy-mode = "rgmii";

	mdio {
		#address-cells = <0x1>;
		#size-cells = <0x0>;
		compatible = "snps,dwmac-mdio";
		phy1: phy@4 {
			device_type = "ethernet-phy";
			reg = <0x4>;
		};
/* bench 5954.0.0 cc60f4f8b6e9 */
/* bench 5954.0.1 0f2008df773e */
/* bench 5954.0.2 e763b30d11c1 */
/* bench 5954.0.3 42b61919bcdd */
/* bench 5954.0.4 f4abde04218c */
/* bench 5954.0.5 4f15da055f59 */
/* bench 5954.0.6 4a265972f22e */
/* bench 5954.0.7 28cb7e6918e7 */
/* bench 5954.0.8 dbfa99a70609 */
/* bench 5954.0.9 32277e3281a6 */
/* bench 5954.0.10 5a7a7f7848da */
/* bench 5954.0.11 0cf8da340f5c */
/* bench 5954.0.12 513c519f6011 */
/* bench 5954.0.13 85e31c541f72 */
```

## Documentation/devicetree/bindings/net/qcom,ipa.yaml
```yaml
FASTVC-BENCH-CORPUS:linux-main-100k-v1-e0bd41dc-8e12-4f1b-978d-a3645ae59da0
# SPDX-License-Identifier: GPL-2.0 OR BSD-2-Clause
%YAML 1.2
---
$id: http://devicetree.org/schemas/net/qcom,ipa.yaml#
$schema: http://devicetree.org/meta-schemas/core.yaml#

title: Qualcomm IP Accelerator (IPA)

maintainers:
  - Alex Elder <elder@kernel.org>

description:
  This binding describes the Qualcomm IPA.  The IPA is capable of offloading
  certain network processing tasks (e.g. filtering, routing, and NAT) from
  the main processor.

  The IPA sits between multiple independent "execution environments,"
  including the Application Processor (AP) and the modem.  The IPA presents
  a Generic Software Interface (GSI) to each execution environment.
  The GSI is an integral part of the IPA, but it is logically isolated
  and has a distinct interrupt and a separately-defined address space.

  See also soc/qcom/qcom,smp2p.txt and interconnect/interconnect.txt.  See
  iommu/iommu.txt and iommu/arm,smmu.yaml for more information about SMMU
  bindings.


  - |
    --------             ---------
    |      |             |       |
    |  AP  +<---.   .----+ Modem |
    |      +--. |   | .->+       |
    |      |  | |   | |  |       |
    --------  | |   | |  ---------
              v |   v |
            --+-+---+-+--
            |    GSI    |
            |-----------|
            |           |
            |    IPA    |
            |           |
            -------------

properties:
  compatible:
    const: "qcom,sdm845-ipa"

  reg:
    items:
      - description: IPA registers
      - description: IPA shared memory
      - description: GSI registers

  reg-names:
    items:
      - const: ipa-reg
      - const: ipa-shared
      - const: gsi

  iommus:
    maxItems: 1

  clocks:
    maxItems: 1

  clock-names:
    const: core

  interrupts:
    items:
      - description: IPA interrupt (hardware IRQ)
      - description: GSI interrupt (hardware IRQ)
      - description: Modem clock query interrupt (smp2p interrupt)
      - description: Modem setup ready interrupt (smp2p interrupt)

  interrupt-names:
    items:
/* bench 888.0.0 78fe1158ba6c */
/* bench 888.0.1 e6638f35530c */
/* bench 888.0.2 735481ff0217 */
/* bench 888.0.3 a6ed96e49784 */
/* bench 888.0.4 d2d0a9b187e2 */
/* bench 888.0.5 97ca85a8c256 */
/* bench 888.0.6 c1162576f579 */
/* bench 888.0.7 a60393b0e578 */
/* bench 888.0.8 ce25cecf8a2a */
/* bench 23813.0.0 f1d27b178f56 */
/* bench 23813.0.1 c974c427a8a3 */
/* bench 23813.0.2 1c71d8345f65 */
/* bench 23813.0.3 ded5d3ab37e0 */
/* bench 23813.0.4 6df8e851b805 */
/* bench 23813.0.5 46adc98a8864 */
/* bench 23813.0.6 208708ea90fc */
/* bench 23813.0.7 1ef1391a540f */
/* bench 23813.0.8 056ddd464ecd */
/* bench 23813.0.9 46444c2fd019 */
/* bench 23813.0.10 a7b653dc0138 */
/* bench 23813.0.11 fd9e6a47d6a1 */
/* bench 23813.0.12 06b448cc260c */
/* bench 888.0.10 8712f895365c */
      - const: ipa-clock-query
      - const: ipa-setup-ready

  interconnects:
    items:
      - description: Interconnect path between IPA and main memory
      - description: Interconnect path between IPA and internal memory
      - description: Interconnect path between IPA and the AP subsystem

  interconnect-names:
    items:
      - const: memory
      - const: imem
      - const: config

  qcom,smem-states:
    $ref: /schemas/types.yaml#/definitions/phandle-array
    description: State bits used in by the AP to signal the modem.
    items:
      - description: Whether the "ipa-clock-enabled" state bit is valid
      - description: Whether the IPA clock is enabled (if valid)

  qcom,smem-state-names:
    $ref: /schemas/types.yaml#/definitions/string-array
    description: The names of the state bits used for SMP2P output
    items:
      - const: ipa-clock-enabled-valid
      - const: ipa-clock-enabled

  modem-init:
    type: boolean
    description:
      If present, it indicates that the modem is responsible for
      performing early IPA initialization, including loading and
      validating firwmare used by the GSI.

  memory-region:
    maxItems: 1
    description:
      If present, a phandle for a reserved memory area that holds
      the firmware passed to Trust Zone for authentication.  Required
/* bench 6121.1.0 d4fcb803f62f */
/* bench 6121.1.1 c8585f9d26f4 */
/* bench 6121.1.2 088d452f97f4 */
/* bench 6121.1.3 06d32169796b */

required:
  - compatible
  - iommus
  - reg
  - clocks
  - interrupts
  - interconnects
  - qcom,smem-states

oneOf:
  - required:
      - modem-init
  - required:
      - memory-region

additionalProperties: false

examples:
  - |
        #include <dt-bindings/interrupt-controller/arm-gic.h>
        #include <dt-bindings/clock/qcom,rpmh.h>
        #include <dt-bindings/interconnect/qcom,sdm845.h>

        smp2p-mpss {
                compatible = "qcom,smp2p";
                ipa_smp2p_out: ipa-ap-to-modem {
                        qcom,entry-name = "ipa";
                        #qcom,smem-state-cells = <1>;
                };

                ipa_smp2p_in: ipa-modem-to-ap {
                        qcom,entry-name = "ipa";
                        interrupt-controller;
                        #interrupt-cells = <2>;
                };
        };
        ipa@1e40000 {
                compatible = "qcom,sdm845-ipa";

                modem-init;

                iommus = <&apps_smmu 0x720 0x3>;
                reg = <0x1e40000 0x7000>,
                        <0x1e47000 0x2000>,
                        <0x1e04000 0x2c000>;
                reg-names = "ipa-reg",
                            "ipa-shared",
                            "gsi";

                interrupts-extended = <&intc GIC_SPI 311 IRQ_TYPE_EDGE_RISING>,
                                      <&intc GIC_SPI 432 IRQ_TYPE_LEVEL_HIGH>,
                                      <&ipa_smp2p_in 0 IRQ_TYPE_EDGE_RISING>,
                                      <&ipa_smp2p_in 1 IRQ_TYPE_EDGE_RISING>;
                interrupt-names = "ipa",
                                  "gsi",
                                  "ipa-clock-query",
                                  "ipa-setup-ready";

                clocks = <&rpmhcc RPMH_IPA_CLK>;
                clock-names = "core";

                interconnects =
                        <&rsc_hlos MASTER_IPA &rsc_hlos SLAVE_EBI1>,
                        <&rsc_hlos MASTER_IPA &rsc_hlos SLAVE_IMEM>,
                        <&rsc_hlos MASTER_APPSS_PROC &rsc_hlos SLAVE_IPA_CFG>;
                interconnect-names = "memory",
                                     "imem",
                                     "config";

                qcom,smem-states = <&ipa_smp2p_out 0>,
                                   <&ipa_smp2p_out 1>;
                qcom,smem-state-names = "ipa-clock-enabled-valid",
                                        "ipa-clock-enabled";
        };
```

## Documentation/devicetree/bindings/net/qcom,ipq8064-mdio.yaml
```yaml
FASTVC-BENCH-CORPUS:linux-main-100k-v1-e0bd41dc-8e12-4f1b-978d-a3645ae59da0
# SPDX-License-Identifier: GPL-2.0-only OR BSD-2-Clause
%YAML 1.2
---
$id: http://devicetree.org/schemas/net/qcom,ipq8064-mdio.yaml#
$schema: http://devicetree.org/meta-schemas/core.yaml#

title: Qualcomm ipq806x MDIO bus controller
/* bench 9646.0.0 3a9b6437cb1c */
/* bench 9646.0.1 f06a46bd6f71 */
/* bench 9646.0.2 a6bfe8097c15 */
/* bench 9646.0.3 4175dcb28046 */
/* bench 9646.0.4 305f6b75a440 */
/* bench 9646.0.5 c72d426c1285 */
/* bench 9646.0.6 a3b37fd6ef2e */
/* bench 9646.0.7 c0623d2832df */
/* bench 9646.0.8 030a11282c3b */
/* bench 9646.0.9 0773f22e8bfa */
/* bench 9646.0.10 6af62590db64 */
/* bench 9646.0.11 26ce4d1b5f3b */
/* bench 9646.0.12 328e89eeed3a */

description:
  The ipq806x soc have a MDIO dedicated controller that is
  used to communicate with the gmac phy connected.

allOf:
  - $ref: "mdio.yaml#"

properties:
  compatible:
    const: qcom,ipq8064-mdio

  reg:
    maxItems: 1

  clocks:
    maxItems: 1

required:
  - compatible
  - reg
  - clocks
  - "#address-cells"
  - "#size-cells"

unevaluatedProperties: false

/* bench 21668.0.0 c569f6a33186 */

    mdio0: mdio@37000000 {
        #address-cells = <1>;
        #size-cells = <0>;

        compatible = "qcom,ipq8064-mdio";
        reg = <0x37000000 0x200000>;

        clocks = <&gcc GMAC_CORE1_CLK>;

        switch@10 {
            compatible = "qca,qca8337";
            reg = <0x10>;
/* bench 4355.0.0 aa71532bb8ca */
/* bench 4355.0.1 4e9687edc92b */
/* bench 4355.0.2 8f4f9f8c85ed */
/* bench 4355.0.3 c6b2d1f4c351 */
/* bench 4355.0.4 e188db452010 */
/* bench 4355.0.5 f6455eb1facc */
/* bench 4355.0.6 021cd050a4d0 */
        };
    };
```

## Documentation/devicetree/bindings/net/qcom-emac.txt
```
FASTVC-BENCH-CORPUS:linux-main-100k-v1-e0bd41dc-8e12-4f1b-978d-a3645ae59da0
Qualcomm Technologies EMAC Gigabit Ethernet Controller

This network controller consists of two devices: a MAC and an SGMII
internal PHY.  Each device is represented by a device tree node.  A phandle
connects the MAC node to its corresponding internal phy node.  Another
phandle points to the external PHY node.

Required properties:

MAC node:
- compatible : Should be "qcom,fsm9900-emac".
- reg : Offset and length of the register regions for the device
- interrupts : Interrupt number used by this controller
- mac-address : The 6-byte MAC address. If present, it is the default
	MAC address.
- internal-phy : phandle to the internal PHY node
- phy-handle : phandle the the external PHY node

Internal PHY node:
- compatible : Should be "qcom,fsm9900-emac-sgmii" or "qcom,qdf2432-emac-sgmii".
/* bench 11102.0.0 a86d9c027c2c */
/* bench 11102.0.1 79420f2074fa */
/* bench 11102.0.2 7218b0244d90 */
/* bench 11102.0.3 dd43e0a06487 */
/* bench 11102.0.4 0c6adc1a9c00 */
/* bench 11102.0.5 0ece5ab632c5 */
/* bench 11102.0.6 965a254ec06f */
/* bench 11102.0.7 f1bf722f8787 */
/* bench 11102.0.8 1f2d05c6ee58 */
/* bench 11102.0.9 b7c94ec49d40 */
/* bench 11102.0.10 012bbeb71d5b */
/* bench 11102.0.11 40eec2481346 */
/* bench 11102.0.12 16e9c2e6dda7 */
/* bench 11102.0.13 a7937cbdda15 */
/* bench 11102.0.14 30d2ab0ee4fa */
/* bench 11102.0.15 6d6ffae3427b */
/* bench 11102.0.16 102082d4b961 */
/* bench 11102.0.17 483a690e79b4 */
/* bench 11102.0.18 c79ac37b099e */
/* bench 11102.0.19 d387701b49ec */
The external phy child node:
- reg : The phy address

Example:

FSM9900:

soc {
	#address-cells = <1>;
	#size-cells = <1>;

	emac0: ethernet@feb20000 {
		compatible = "qcom,fsm9900-emac";
		reg = <0xfeb20000 0x10000>,
		      <0xfeb36000 0x1000>;
		interrupts = <76>;

		clocks = <&gcc 0>, <&gcc 1>, <&gcc 3>, <&gcc 4>, <&gcc 5>,
			<&gcc 6>, <&gcc 7>;
		clock-names = "axi_clk", "cfg_ahb_clk", "high_speed_clk",
			"mdio_clk", "tx_clk", "rx_clk", "sys_clk";

		internal-phy = <&emac_sgmii>;

		phy-handle = <&phy0>;

		#address-cells = <1>;
		#size-cells = <0>;
		phy0: ethernet-phy@0 {
			reg = <0>;
		};

		pinctrl-names = "default";
		pinctrl-0 = <&mdio_pins_a>;
	};

	emac_sgmii: ethernet@feb38000 {
		compatible = "qcom,fsm9900-emac-sgmii";
		reg = <0xfeb38000 0x1000>;
		interrupts = <80>;
	};

	tlmm: pinctrl@fd510000 {
		compatible = "qcom,fsm9900-pinctrl";

		mdio_pins_a: mdio {
			state {
				pins = "gpio123", "gpio124";
				function = "mdio";
			};
		};
	};


QDF2432:

soc {
	#address-cells = <2>;
	#size-cells = <2>;

	emac0: ethernet@38800000 {
		compatible = "qcom,fsm9900-emac";
		reg = <0x0 0x38800000 0x0 0x10000>,
		      <0x0 0x38816000 0x0 0x1000>;
		interrupts = <0 256 4>;

		clocks = <&gcc 0>, <&gcc 1>, <&gcc 3>, <&gcc 4>, <&gcc 5>,
			 <&gcc 6>, <&gcc 7>;
		clock-names = "axi_clk", "cfg_ahb_clk", "high_speed_clk",
			"mdio_clk", "tx_clk", "rx_clk", "sys_clk";

		internal-phy = <&emac_sgmii>;

		phy-handle = <&phy0>;

		#address-cells = <1>;
		#size-cells = <0>;
		phy0: ethernet-phy@4 {
			reg = <4>;
		};
	};

	emac_sgmii: ethernet@410400 {
		compatible = "qcom,qdf2432-emac-sgmii";
		reg = <0x0 0x00410400 0x0 0xc00>, /* Base address */
		      <0x0 0x00410000 0x0 0x400>; /* Per-lane digital */
		interrupts = <0 254 1>;
	};
```
