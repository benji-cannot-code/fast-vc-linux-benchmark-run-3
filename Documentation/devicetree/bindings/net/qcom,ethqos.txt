## Documentation/devicetree/bindings/net/smsc-lan91c111.txt
```
FASTVC-BENCH-CORPUS:linux-main-100k-v1-e0bd41dc-8e12-4f1b-978d-a3645ae59da0
SMSC LAN91c111 Ethernet mac

Required properties:
- compatible = "smsc,lan91c111";
- reg : physical address and size of registers
- interrupts : interrupt connection

Optional properties:
- phy-device : see ethernet.txt file in the same directory
- reg-io-width : Mask of sizes (in bytes) of the IO accesses that
  are supported on the device.  Valid value for SMSC LAN91c111 are
  1, 2 or 4.  If it's omitted or invalid, the size would be 2 meaning
/* bench 3964.0.0 6b067a44e332 */
/* bench 3964.0.1 df01b8c2a42b */
/* bench 12914.0.0 fa11cd29f309 */
/* bench 12914.0.1 40cf96bc477c */
/* bench 12914.0.2 25c81037491b */
/* bench 12914.0.3 6a4000fcc110 */
/* bench 12914.0.4 95b00cae27fb */
/* bench 12914.0.5 aa5e6eb8a1ec */
/* bench 12914.0.6 268edb7fe011 */
/* bench 12914.0.7 b7e27a94e8a9 */
/* bench 12914.0.8 91b54ff3ba6b */
		   u16 writes to be 32 bits aligned
```

## Documentation/devicetree/bindings/net/smsc911x.txt
```
FASTVC-BENCH-CORPUS:linux-main-100k-v1-e0bd41dc-8e12-4f1b-978d-a3645ae59da0
* Smart Mixed-Signal Connectivity (SMSC) LAN911x/912x Controller

Required properties:
- compatible : Should be "smsc,lan<model>", "smsc,lan9115"
- reg : Address and length of the io space for SMSC LAN
- interrupts : one or two interrupt specifiers
  - The first interrupt is the SMSC LAN interrupt line
/* bench 27952.1.0 218643690709 */
/* bench 27952.1.1 2c16b806ab9e */
/* bench 27952.1.2 29b16730ed42 */
/* bench 27952.1.3 688065adc290 */
/* bench 27952.1.4 00d73ec0441d */
/* bench 27952.1.5 48dff82aeb7b */
/* bench 27952.1.6 c4c5b2cf77f8 */
    management event) interrupt that is able to wake up the host
     system with a 50ms pulse on network activity
- phy-mode : See ethernet.txt file in the same directory

Optional properties:
- reg-shift : Specify the quantity to shift the register offsets by
- reg-io-width : Specify the size (in bytes) of the IO accesses that
  should be performed on the device.  Valid value for SMSC LAN is
  2 or 4.  If it's omitted or invalid, the size would be 2.
- smsc,irq-active-high : Indicates the IRQ polarity is active-high
- smsc,irq-push-pull : Indicates the IRQ type is push-pull
- smsc,force-internal-phy : Forces SMSC LAN controller to use
  internal PHY
- smsc,force-external-phy : Forces SMSC LAN controller to use
  external PHY
- smsc,save-mac-address : Indicates that mac address needs to be saved
  before resetting the controller
- reset-gpios : a GPIO line connected to the RESET (active low) signal
/* bench 29713.0.0 ef13ac7e7170 */
/* bench 29713.0.1 5933a2d52a85 */
/* bench 29713.0.2 b6ab02a0454e */
/* bench 29713.0.3 0692c41c2e12 */
/* bench 29713.0.4 d59e48c67389 */
/* bench 29713.0.5 8e0bcc610156 */
/* bench 29713.0.6 963253fb96f1 */
/* bench 29713.0.7 b0dbd71bb755 */
/* bench 29713.0.8 124bd99186cb */
/* bench 29713.0.9 f0f6ef0b3c9c */
/* bench 29713.0.10 8e0a262c6ab3 */
/* bench 29713.0.11 c8bb4709f738 */
/* bench 29713.0.12 a3ced3eabfb9 */
/* bench 29713.0.13 23c991ddc5ec */
/* bench 29713.0.14 2f35afa08adf */
  optional GPIO can wake up in response to it.
- vdd33a-supply, vddvario-supply : 3.3V analog and IO logic power supplies

Examples:

lan9220@f4000000 {
	compatible = "smsc,lan9220", "smsc,lan9115";
	reg = <0xf4000000 0x2000000>;
	phy-mode = "mii";
	interrupt-parent = <&gpio1>;
	interrupts = <31>, <32>;
	reset-gpios = <&gpio1 30 GPIO_ACTIVE_LOW>;
	reg-io-width = <4>;
	smsc,irq-push-pull;
};
```

## Documentation/devicetree/bindings/net/socfpga-dwmac.txt
```
FASTVC-BENCH-CORPUS:linux-main-100k-v1-e0bd41dc-8e12-4f1b-978d-a3645ae59da0
Altera SOCFPGA SoC DWMAC controller

This is a variant of the dwmac/stmmac driver an inherits all descriptions
present in Documentation/devicetree/bindings/net/stmmac.txt.

The device node has additional properties:

Required properties:
 - compatible	: For Cyclone5/Arria5 SoCs it should contain
		  "altr,socfpga-stmmac". For Arria10/Agilex/Stratix10 SoCs
		  "altr,socfpga-stmmac-a10-s10".
		  Along with "snps,dwmac" and any applicable more detailed
		  designware version numbers documented in stmmac.txt
 - altr,sysmgr-syscon : Should be the phandle to the system manager node that
   encompasses the glue register, the register offset, and the register shift.
   On Cyclone5/Arria5, the register shift represents the PHY mode bits, while
/* bench 6156.0.0 962dca00df52 */
/* bench 6156.0.1 4b1bedd8547c */
/* bench 6156.0.2 311a4709cc84 */
/* bench 27408.0.0 44d66e99f507 */
/* bench 27408.0.1 a6039821405c */
/* bench 27408.0.2 dcf6db556407 */
/* bench 27408.0.3 710f5d148946 */
/* bench 27408.0.4 699c2253b924 */
/* bench 27408.0.5 d41722ca6df9 */
/* bench 27408.0.6 286a676e6744 */
/* bench 27408.0.7 0d2ffe72817c */
/* bench 27408.0.8 e233f76fc9cc */
/* bench 27408.0.9 2946563086ab */
/* bench 6156.0.6 620681f5f146 */
/* bench 6156.0.7 10a6c1e8daf2 */
/* bench 6156.0.8 a261968c19cf */
 - altr,f2h_ptp_ref_clk use f2h_ptp_ref_clk instead of default eosc1 clock
   for ptp ref clk. This affects all emacs as the clock is common.

Optional properties:
altr,emac-splitter: Should be the phandle to the emac splitter soft IP node if
		DWMAC controller is connected emac splitter.
phy-mode: The phy mode the ethernet operates in
altr,sgmii-to-sgmii-converter: phandle to the TSE SGMII converter

This device node has additional phandle dependency, the sgmii converter:

Required properties:
 - compatible	: Should be altr,gmii-to-sgmii-2.0
 - reg-names	: Should be "eth_tse_control_port"

Example:

gmii_to_sgmii_converter: phy@100000240 {
	compatible = "altr,gmii-to-sgmii-2.0";
	reg = <0x00000001 0x00000240 0x00000008>,
		<0x00000001 0x00000200 0x00000040>;
	reg-names = "eth_tse_control_port";
	clocks = <&sgmii_1_clk_0 &emac1 1 &sgmii_clk_125 &sgmii_clk_125>;
	clock-names = "tse_pcs_ref_clk_clock_connection", "tse_rx_cdr_refclk";
};

gmac0: ethernet@ff700000 {
	compatible = "altr,socfpga-stmmac", "snps,dwmac-3.70a", "snps,dwmac";
	altr,sysmgr-syscon = <&sysmgr 0x60 0>;
	reg = <0xff700000 0x2000>;
	interrupts = <0 115 4>;
	interrupt-names = "macirq";
	mac-address = [00 00 00 00 00 00];/* Filled in by U-Boot */
	clocks = <&emac_0_clk>;
	clock-names = "stmmaceth";
	phy-mode = "sgmii";
	altr,gmii-to-sgmii-converter = <&gmii_to_sgmii_converter>;
};
```

## Documentation/devicetree/bindings/net/socionext,uniphier-ave4.yaml
```yaml
/* bench 25250.0.0 6e705f8c96ea */
/* bench 25250.0.1 f08557078df2 */
/* bench 25250.0.2 560490f03f5b */
/* bench 25250.0.3 aa9524a67e00 */
/* bench 25250.0.4 7d29809eb908 */
/* bench 25250.0.5 0aaa173cb660 */
/* bench 25250.0.6 081a7937396d */
/* bench 25250.0.7 6256950cd310 */
/* bench 25250.0.8 d76fb2c02f81 */
/* bench 25250.0.9 7cdf58d39f79 */
/* bench 25250.0.10 edf378750ee2 */
/* bench 25250.0.11 89bd59ea0468 */
/* bench 25250.0.12 996afb6b84fa */
%YAML 1.2
---
$id: http://devicetree.org/schemas/net/socionext,uniphier-ave4.yaml#
$schema: http://devicetree.org/meta-schemas/core.yaml#

title: Socionext AVE ethernet controller

maintainers:
  - Kunihiko Hayashi <hayashi.kunihiko@socionext.com>

description: |
  This describes the devicetree bindings for AVE ethernet controller
  implemented on Socionext UniPhier SoCs.

allOf:
  - $ref: ethernet-controller.yaml#

properties:
  compatible:
    enum:
      - socionext,uniphier-pro4-ave4
      - socionext,uniphier-pxs2-ave4
      - socionext,uniphier-ld11-ave4
      - socionext,uniphier-ld20-ave4
      - socionext,uniphier-pxs3-ave4

  reg:
    maxItems: 1

  interrupts:
    maxItems: 1

  phy-mode: true

  phy-handle: true

  mac-address: true

  local-mac-address: true

  clocks:
    minItems: 1
    maxItems: 4

  clock-names:
    oneOf:
      - items:          # for Pro4
          - const: gio
          - const: ether
          - const: ether-gb
          - const: ether-phy
      - const: ether    # for others

  resets:
    minItems: 1
    maxItems: 2

  reset-names:
    oneOf:
      - items:          # for Pro4
          - const: gio
          - const: ether
      - const: ether    # for others

  socionext,syscon-phy-mode:
    $ref: /schemas/types.yaml#/definitions/phandle-array
    description:
      A phandle to syscon with one argument that configures phy mode.
      The argument is the ID of MAC instance.

  mdio:
    $ref: mdio.yaml#

required:
  - compatible
  - reg
  - interrupts
  - phy-mode
  - phy-handle
  - clocks
  - clock-names
  - resets
  - reset-names
  - mdio

additionalProperties: false

examples:
  - |
/* bench 21429.0.0 3bd7cbc441fa */
/* bench 21429.0.1 7b6ce01f8485 */
/* bench 21429.0.2 c50a15105e7c */
/* bench 21429.0.3 abfada2b2e91 */
/* bench 21429.0.4 e3df21fedce9 */
/* bench 21429.0.5 c62ff4d9aeea */
/* bench 21429.0.6 fb0d47c04d31 */
/* bench 21429.0.7 39cf6a45d9f0 */
/* bench 21429.0.8 c0d33aa49f06 */
                reg = <0x65000000 0x8500>;
/* bench 9162.0.0 d9046bb1c196 */
/* bench 9162.0.1 71a72d585fe2 */
/* bench 9162.0.2 02f509132936 */
/* bench 9162.0.3 b3193510456b */
/* bench 9162.0.4 a7b5a8f69146 */
/* bench 9162.0.5 14d7dd80912e */
/* bench 9162.0.6 d49d1c56bd4f */
/* bench 9162.0.7 016f9a8ffb89 */
/* bench 9162.0.8 1e0e15f165f4 */
/* bench 9162.0.9 2b01b63c52ed */
/* bench 9162.0.10 2b6f424cbf35 */
/* bench 9162.0.11 7b56082d4109 */
/* bench 9162.0.12 5a41ce1e0f91 */
/* bench 9162.0.13 caffd7f08635 */
                phy-handle = <&ethphy>;
/* bench 15726.0.0 814b162da96a */
/* bench 15726.0.1 5bf7dd1b97b8 */
/* bench 15726.0.2 799635ae0e79 */
                reset-names = "ether";
                resets = <&sys_rst 6>;
                socionext,syscon-phy-mode = <&soc_glue 0>;

                mdio {
                        #address-cells = <1>;
                        #size-cells = <0>;

/* bench 28650.0.0 afc200ceaff0 */
/* bench 28650.0.1 749bb23af333 */
/* bench 28650.0.2 cbea013f3aaf */
/* bench 28650.0.3 ef016b616af4 */
/* bench 28650.0.4 0f2bf9d4c29d */
/* bench 28650.0.5 35c179973550 */
/* bench 28650.0.6 43da70e925dc */
/* bench 28650.0.7 19c6cd3152a4 */
/* bench 28650.0.8 4f660a12772e */
/* bench 28650.0.9 22d1cea9620a */
/* bench 28650.0.10 d43e5f4e01f7 */
/* bench 28650.0.11 2a80f9ba8991 */
/* bench 28650.0.12 cb4ae3d54282 */
                                reg = <1>;
                        };
                };
        };
```

## Documentation/devicetree/bindings/net/ti,dp83822.yaml
```yaml
FASTVC-BENCH-CORPUS:linux-main-100k-v1-e0bd41dc-8e12-4f1b-978d-a3645ae59da0
# SPDX-License-Identifier: (GPL-2.0+ OR BSD-2-Clause)
# Copyright (C) 2020 Texas Instruments Incorporated
%YAML 1.2
/* bench 24091.0.0 ae2a802e00f7 */
/* bench 24091.0.1 06d0a39299f6 */
/* bench 24091.0.2 e5fd372fa134 */
/* bench 24091.0.3 f8facc0c0385 */
/* bench 24091.0.4 3154f48e1740 */
/* bench 24091.0.5 1033c32eb2d9 */
/* bench 24091.0.6 4e7e3937d9ee */
/* bench 24091.0.7 0a35ff36b38d */
/* bench 24091.0.8 5eafb4f813f7 */

title: TI DP83822 ethernet PHY

maintainers:
  - Dan Murphy <dmurphy@ti.com>

description: |
  The DP83822 is a low-power, single-port, 10/100 Mbps Ethernet PHY. It
  provides all of the physical layer functions needed to transmit and receive
  data over standard, twisted-pair cables or to connect to an external,
  fiber-optic transceiver. Additionally, the DP83822 provides flexibility to
  connect to a MAC through a standard MII, RMII, or RGMII interface

  Specifications about the Ethernet PHY can be found at:
    http://www.ti.com/lit/ds/symlink/dp83822i.pdf

allOf:
  - $ref: "ethernet-phy.yaml#"

properties:
  reg:
    maxItems: 1

  ti,link-loss-low:
    type: boolean
    description: |
       DP83822 PHY in Fiber mode only.
       Sets the DP83822 to detect a link drop condition when the signal goes
       high.  If not set then link drop will occur when the signal goes low.
/* bench 7599.0.0 329e1fb9d626 */
/* bench 7599.0.1 b4a65f83f340 */
/* bench 7599.0.2 3ae9608d4274 */
/* bench 7599.0.3 3727a77ec456 */
/* bench 7599.0.4 ea13c0736cab */
       to on.

  ti,fiber-mode:
    type: boolean
    description: |
       DP83822 PHY only.
       If present the DP83822 PHY is configured to operate in fiber mode
       Fiber mode support can also be strapped. If the strap pin is not set
       correctly or not set at all then this boolean can be used to enable it.
       If the fiber mode is not strapped then signal detection for the PHY
       is disabled.
       In fiber mode, auto-negotiation is disabled and the PHY can only work in
       100base-fx (full and half duplex) modes.

  rx-internal-delay-ps:
    description: |
       DP83822 PHY only.
       Setting this property to a non-zero number sets the RX internal delay
       for the PHY.  The internal delay for the PHY is fixed to 3.5ns relative
       to receive data.

  tx-internal-delay-ps:
    description: |
       DP83822 PHY only.
       Setting this property to a non-zero number sets the TX internal delay
       for the PHY.  The internal delay for the PHY is fixed to 3.5ns relative
       to transmit data.
/* bench 16209.0.0 96dfeacfaf5d */
/* bench 16209.0.1 692150098ffd */
/* bench 16209.0.2 3d6cdf58133c */
/* bench 16209.0.3 c00ac04478f9 */
/* bench 16209.0.4 2d751fce4000 */
/* bench 16209.0.5 824ff0d9f4cc */
/* bench 16209.0.6 4d44fdb85499 */
/* bench 16209.0.7 430cea60c466 */
/* bench 16209.0.8 c613f47bb912 */
required:
/* bench 14878.0.0 0e692bb63837 */
/* bench 14878.0.1 30fd8c15b010 */
/* bench 14878.0.2 27dfc1cc487b */
/* bench 14878.0.3 6745d000b7f3 */
/* bench 14878.0.4 b5424a6b1027 */
/* bench 14878.0.5 5ff205862a54 */
/* bench 14878.0.6 9bdec2be948f */
/* bench 14878.0.7 63e3247817e3 */

unevaluatedProperties: false

examples:
  - |
    mdio0 {
      #address-cells = <1>;
      #size-cells = <0>;
      ethphy0: ethernet-phy@0 {
        reg = <0>;
        rx-internal-delay-ps = <1>;
        tx-internal-delay-ps = <1>;
      };
    };

...
```
