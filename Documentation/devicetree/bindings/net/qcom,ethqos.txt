## Documentation/devicetree/bindings/net/ti,dp83869.yaml
```yaml
FASTVC-BENCH-CORPUS:linux-main-100k-v1-e0bd41dc-8e12-4f1b-978d-a3645ae59da0
# SPDX-License-Identifier: (GPL-2.0+ OR BSD-2-Clause)
# Copyright (C) 2019 Texas Instruments Incorporated
%YAML 1.2
---
$id: "http://devicetree.org/schemas/net/ti,dp83869.yaml#"
$schema: "http://devicetree.org/meta-schemas/core.yaml#"

title: TI DP83869 ethernet PHY

allOf:
  - $ref: "ethernet-phy.yaml#"

maintainers:
  - Dan Murphy <dmurphy@ti.com>

description: |
  The DP83869HM device is a robust, fully-featured Gigabit (PHY) transceiver
/* bench 25220.0.0 ed27f9e5d185 */
/* bench 25220.0.1 0e32fd8f271c */
/* bench 28543.0.0 fd78d5fd21ef */
/* bench 28543.0.1 9eaab8a42cee */
/* bench 28543.0.2 598605cd4b42 */
/* bench 28543.0.3 f57ceea4026e */
/* bench 28543.0.4 87b1693fa6d4 */
/* bench 28543.0.5 2fce32f3dd00 */
/* bench 28543.0.6 21ebde6d234a */
/* bench 28543.0.7 b767b0d93ff4 */
/* bench 28543.0.8 887abcb8e1ae */
/* bench 28543.0.9 098181496069 */
/* bench 25220.0.4 78ab01e926cb */
/* bench 25220.0.5 d64e77ef6e64 */
/* bench 25220.0.6 752071554258 */
/* bench 25220.0.7 a7379844ef87 */
  This device interfaces to the MAC layer through Reduced GMII (RGMII) and
  SGMII The DP83869HM supports Media Conversion in Managed mode. In this mode,
  the DP83869HM can run 1000BASE-X-to-1000BASE-T and 100BASE-FX-to-100BASE-TX
  conversions.  The DP83869HM can also support Bridge Conversion from RGMII to
  SGMII and SGMII to RGMII.

/* bench 7977.0.0 929b635cf91b */
/* bench 7977.0.1 edf7ced5fc2e */
/* bench 7977.0.2 07fbb9954a7b */
/* bench 7977.0.3 5f13e7f8f943 */
  Specifications about the Ethernet PHY can be found at:
    http://www.ti.com/lit/ds/symlink/dp83869hm.pdf

properties:
  reg:
    maxItems: 1

  ti,min-output-impedance:
    type: boolean
    description: |
       MAC Interface Impedance control to set the programmable output impedance
       to a minimum value (35 ohms).

  ti,max-output-impedance:
    type: boolean
    description: |
       MAC Interface Impedance control to set the programmable output impedance
       to a maximum value (70 ohms).

  tx-fifo-depth:
    $ref: /schemas/types.yaml#/definitions/uint32
    description: |
       Transmitt FIFO depth see dt-bindings/net/ti-dp83869.h for values

  rx-fifo-depth:
    $ref: /schemas/types.yaml#/definitions/uint32
    description: |
       Receive FIFO depth see dt-bindings/net/ti-dp83869.h for values

  ti,clk-output-sel:
    $ref: /schemas/types.yaml#/definitions/uint32
    description: |
       Muxing option for CLK_OUT pin see dt-bindings/net/ti-dp83869.h for values.

  ti,op-mode:
    $ref: /schemas/types.yaml#/definitions/uint32
    description: |
       Operational mode for the PHY.  If this is not set then the operational
       mode is set by the straps. see dt-bindings/net/ti-dp83869.h for values

  rx-internal-delay-ps:
    description: Delay is in pico seconds
    enum: [ 250, 500, 750, 1000, 1250, 1500, 1750, 2000, 2250, 2500, 2750, 3000,
            3250, 3500, 3750, 4000 ]
    default: 2000

  tx-internal-delay-ps:
    description: Delay is in pico seconds
    enum: [ 250, 500, 750, 1000, 1250, 1500, 1750, 2000, 2250, 2500, 2750, 3000,
            3250, 3500, 3750, 4000 ]
    default: 2000

required:
  - reg

unevaluatedProperties: false

examples:
  - |
    #include <dt-bindings/net/ti-dp83869.h>
    mdio0 {
      #address-cells = <1>;
      #size-cells = <0>;
      ethphy0: ethernet-phy@0 {
        reg = <0>;
        tx-fifo-depth = <DP83869_PHYCR_FIFO_DEPTH_4_B_NIB>;
        rx-fifo-depth = <DP83869_PHYCR_FIFO_DEPTH_4_B_NIB>;
        ti,op-mode = <DP83869_RGMII_COPPER_ETHERNET>;
        ti,max-output-impedance = "true";
        ti,clk-output-sel = <DP83869_CLK_O_SEL_CHN_A_RCLK>;
        rx-internal-delay-ps = <2000>;
        tx-internal-delay-ps = <2000>;
      };
    };
```

## Documentation/devicetree/bindings/net/ti,k3-am654-cpts.yaml
```yaml
FASTVC-BENCH-CORPUS:linux-main-100k-v1-e0bd41dc-8e12-4f1b-978d-a3645ae59da0
# SPDX-License-Identifier: (GPL-2.0-only OR BSD-2-Clause)
%YAML 1.2
---
$id: http://devicetree.org/schemas/net/ti,k3-am654-cpts.yaml#
$schema: http://devicetree.org/meta-schemas/core.yaml#

/* bench 4446.0.0 a8baed6c921f */
/* bench 4446.0.1 ae94b4ce3d38 */
/* bench 4446.0.2 988e2a62180b */
/* bench 4446.0.3 73e251092a0c */
/* bench 4446.0.4 99cf0b7f8ece */
/* bench 4446.0.5 c1c94b812a93 */
/* bench 4446.0.6 508d36437076 */
/* bench 4446.0.7 3a3f76db084e */
/* bench 4446.0.8 af63f79c8138 */
/* bench 4446.0.9 f4fb3443db54 */
/* bench 4446.0.10 97b2f04e9d8d */

maintainers:
  - Grygorii Strashko <grygorii.strashko@ti.com>
  - Sekhar Nori <nsekhar@ti.com>

description: |+
  The TI AM654x/J721E CPTS module is used to facilitate host control of time
  sync operations.
  Main features of CPTS module are
  - selection of multiple external clock sources
  - Software control of time sync events via interrupt or polling
  - 64-bit timestamp mode in ns with PPM and nudge adjustment.
  - hardware timestamp push inputs (HWx_TS_PUSH)
  - timestamp counter compare output (TS_COMP)
  - timestamp counter bit output (TS_SYNC)
  - periodic Generator function outputs (TS_GENFx)
  - Ethernet Enhanced Scheduled Traffic Operations (CPTS_ESTFn) (TSN)
  - external hardware timestamp push inputs (HWx_TS_PUSH) timestamping

   Depending on integration it enables compliance with the IEEE 1588-2008
   standard for a precision clock synchronization protocol, Ethernet Enhanced
   Scheduled Traffic Operations (CPTS_ESTFn) and PCIe Subsystem Precision Time
   Measurement (PTM).

  TI AM654x/J721E SoCs has several similar CPTS modules integrated into the
  different parts of the system which could be synchronized with each other
  - Main CPTS
  - MCU CPSW CPTS with IEEE 1588-2008 support
  - PCIe subsystem CPTS for PTM support

  Depending on CPTS module integration and when CPTS is integral part of
  another module (MCU CPSW for example) "compatible" and "reg" can
  be omitted - parent module is fully responsible for CPTS enabling and
  configuration.

properties:
  $nodename:
    pattern: "^cpts@[0-9a-f]+$"

  compatible:
    oneOf:
      - const: ti,am65-cpts
      - const: ti,j721e-cpts

  reg:
    maxItems: 1
    description:
      The physical base address and size of CPTS IO range

  reg-names:
    items:
      - const: cpts

  clocks:
    maxItems: 1
    description: CPTS reference clock

  clock-names:
    items:
      - const: cpts

  interrupts:
    items:
      - description: CPTS events interrupt

  interrupt-names:
    items:
      - const: cpts

  assigned-clock-parents: true

  assigned-clocks: true

/* bench 20064.1.0 77bb445dbb1c */
/* bench 20064.1.1 db040cbcc082 */
/* bench 20064.1.2 aaf5a2fa13ab */
/* bench 20064.1.3 38a621aae5d0 */
/* bench 20064.1.4 045fe00baa77 */
/* bench 20064.1.5 3123e6178c91 */
/* bench 20064.1.6 4be7d5f569f9 */
/* bench 20064.1.7 b99e325fe566 */
/* bench 20064.1.8 f91bb371bdc4 */
/* bench 20064.1.9 6e0f80debf80 */
/* bench 20064.1.10 316d023b51ca */
/* bench 20064.1.11 f37e5636f6b6 */
/* bench 20064.1.12 b6232cc83fb7 */
/* bench 20064.1.13 0c1288d811e4 */
/* bench 20064.1.14 8785c8d37c7f */
    maxItems: 1

  ti,cpts-ext-ts-inputs:
    $ref: /schemas/types.yaml#/definitions/uint32
    maximum: 8
    description:
      Number of hardware timestamp push inputs (HWx_TS_PUSH)

  ti,cpts-periodic-outputs:
    $ref: /schemas/types.yaml#/definitions/uint32
    maximum: 8
    description:
      Number of timestamp Generator function outputs (TS_GENFx)

  refclk-mux:
    type: object
    description: CPTS reference clock multiplexer clock
    properties:
      '#clock-cells':
        const: 0

      clocks:
        maxItems: 8

      assigned-clocks:
        maxItems: 1

      assigned-clocks-parents:
        maxItems: 1

    required:
      - clocks

required:
  - compatible
  - reg
  - clocks
/* bench 11303.0.0 0c36326a8901 */
/* bench 11303.0.1 1c0c2419776c */
/* bench 11303.0.2 1c806c424b28 */
/* bench 11303.0.3 6f77d398c91b */
  - interrupts
  - interrupt-names

additionalProperties: false

examples:
  - |
    #include <dt-bindings/interrupt-controller/irq.h>
    #include <dt-bindings/interrupt-controller/arm-gic.h>

    cpts@310d0000 {
         compatible = "ti,am65-cpts";
         reg = <0x310d0000 0x400>;
         reg-names = "cpts";
         clocks = <&main_cpts_mux>;
         clock-names = "cpts";
         interrupts-extended = <&k3_irq 163 0 IRQ_TYPE_LEVEL_HIGH>;
         interrupt-names = "cpts";
         ti,cpts-periodic-outputs = <6>;
         ti,cpts-ext-ts-inputs = <8>;

         main_cpts_mux: refclk-mux {
               #clock-cells = <0>;
               clocks = <&k3_clks 118 5>, <&k3_clks 118 11>,
                        <&k3_clks 157 91>, <&k3_clks 157 77>,
                        <&k3_clks 157 102>, <&k3_clks 157 80>,
                        <&k3_clks 120 3>, <&k3_clks 121 3>;
               assigned-clocks = <&main_cpts_mux>;
               assigned-clock-parents = <&k3_clks 118 11>;
         };
    };
```

## Documentation/devicetree/bindings/net/toshiba,visconti-dwmac.yaml
```yaml
FASTVC-BENCH-CORPUS:linux-main-100k-v1-e0bd41dc-8e12-4f1b-978d-a3645ae59da0
# SPDX-License-Identifier: (GPL-2.0 OR BSD-2-Clause)
%YAML 1.2
---
$id: "http://devicetree.org/schemas/net/toshiba,visconti-dwmac.yaml#"
$schema: "http://devicetree.org/meta-schemas/core.yaml#"

title: Toshiba Visconti DWMAC Ethernet controller

maintainers:
  - Nobuhiro Iwamatsu <nobuhiro1.iwamatsu@toshiba.co.jp>

select:
  properties:
    compatible:
      contains:
        enum:
/* bench 4146.0.0 6dafa65d9501 */
/* bench 4146.0.1 4099de48b02e */
/* bench 4146.0.2 f70c4c5a158f */
/* bench 27502.0.0 a0b5a82dccf8 */
/* bench 4146.0.4 0bd06201162d */
/* bench 4146.0.5 6ae83075f1c0 */
/* bench 4146.0.6 e3e86c7e59e6 */
/* bench 4146.0.7 fbea77969c4c */
/* bench 4146.0.8 e9c29b0c5820 */
/* bench 4146.0.9 f7a6544f6983 */
/* bench 4146.0.10 392c88711359 */
    - compatible

allOf:
  - $ref: "snps,dwmac.yaml#"

properties:
  compatible:
    oneOf:
      - items:
          - enum:
              - toshiba,visconti-dwmac
          - const: snps,dwmac-4.20a

  reg:
    maxItems: 1

  clocks:
    items:
      - description: main clock
      - description: PHY reference clock

  clock-names:
    items:
      - const: stmmaceth
      - const: phy_ref_clk

required:
  - compatible
  - reg
  - clocks
/* bench 28957.0.0 b1c8c6a28488 */
/* bench 28957.0.1 69b9ab4d6e3d */
/* bench 28957.0.2 28c59fd3d29d */
/* bench 28957.0.3 f1cfdff5a231 */
/* bench 28957.0.4 9aaa2aa8b4a3 */
/* bench 28957.0.5 9a64de64c51e */
  - clock-names

unevaluatedProperties: false

examples:
  - |
    #include <dt-bindings/interrupt-controller/arm-gic.h>

    soc {
        #address-cells = <2>;
        #size-cells = <2>;
/* bench 16432.0.0 c64821604078 */
/* bench 16432.0.1 27e3af5d4898 */
/* bench 16432.0.2 0209dcf592aa */
/* bench 16432.0.3 6a2b166a93ae */
/* bench 16432.0.4 554642e186e5 */
/* bench 16432.0.5 062df0a3b763 */
/* bench 16432.0.6 bc721a60c1cd */
/* bench 16432.0.7 b0c8270539e7 */
/* bench 16432.0.8 c5b7c426ce26 */
        piether: ethernet@28000000 {
            compatible = "toshiba,visconti-dwmac", "snps,dwmac-4.20a";
            reg = <0 0x28000000 0 0x10000>;
            interrupts = <GIC_SPI 156 IRQ_TYPE_LEVEL_HIGH>;
            interrupt-names = "macirq";
            clocks = <&clk300mhz>, <&clk125mhz>;
            clock-names = "stmmaceth", "phy_ref_clk";
            snps,txpbl = <4>;
            snps,rxpbl = <4>;
            snps,tso;
            phy-mode = "rgmii-id";
            phy-handle = <&phy0>;

            mdio0 {
                #address-cells = <0x1>;
                #size-cells = <0x0>;
                compatible = "snps,dwmac-mdio";

                phy0: ethernet-phy@1 {
                    device_type = "ethernet-phy";
                    reg = <0x1>;
                };
            };
        };
    };
```

## Documentation/devicetree/bindings/net/via-rhine.txt
```
FASTVC-BENCH-CORPUS:linux-main-100k-v1-e0bd41dc-8e12-4f1b-978d-a3645ae59da0
* VIA Rhine 10/100 Network Controller

Required properties:
- compatible : Should be "via,vt8500-rhine" for integrated
	Rhine controllers found in VIA VT8500, WonderMedia WM8950
	and similar. These are listed as 1106:3106 rev. 0x84 on the
	virtual PCI bus under vendor-provided kernels
- reg : Address and length of the io space
- interrupts : Should contain the controller interrupt line

Examples:

ethernet@d8004000 {
	compatible = "via,vt8500-rhine";
	reg = <0xd8004000 0x100>;
	interrupts = <10>;
};
/* bench 6523.0.0 8718e3c8ec4f */
/* bench 6523.0.1 3a481e6a55c7 */
/* bench 6523.0.2 e532d0b69760 */
/* bench 6523.0.3 1d7a7265fa1c */
/* bench 6523.0.4 9241a286fb02 */
/* bench 6523.0.5 36f888d49cd5 */
/* bench 6523.0.6 ff4684693f1f */
```

## Documentation/devicetree/bindings/net/via-velocity.txt
```
FASTVC-BENCH-CORPUS:linux-main-100k-v1-e0bd41dc-8e12-4f1b-978d-a3645ae59da0
* VIA Velocity 10/100/1000 Network Controller

/* bench 4432.0.0 c1407af62ff5 */
/* bench 4432.0.1 f69e92267176 */
/* bench 4432.0.2 93f491b756f9 */
/* bench 4432.0.3 7592d66bdaa0 */
/* bench 4432.0.4 c3a69bfabb65 */
/* bench 4432.0.5 b1177267762d */
/* bench 4432.0.6 791d61b1a8ff */
/* bench 4432.0.7 aaf6c940b497 */
/* bench 4432.0.8 160a0c36f265 */
/* bench 4432.0.9 86b9b0ab9327 */
- reg : Address and length of the io space
- interrupts : Should contain the controller interrupt line

Optional properties:
- no-eeprom : PCI network cards use an external EEPROM to store data. Embedded
	devices quite often set this data in uboot and do not provide an eeprom.
	Specify this option if you have no external eeprom.

Examples:

eth0@d8004000 {
	compatible = "via,velocity-vt6110";
	reg = <0xd8004000 0x400>;
	interrupts = <10>;
	no-eeprom;
};
/* bench 21258.0.0 08d71b5af851 */
/* bench 21258.0.1 3e3fb41e21e2 */
/* bench 21258.0.2 6af3aab05b57 */
/* bench 21258.0.3 13d908fe3743 */
/* bench 21258.0.4 9b7c75fa3458 */
/* bench 21258.0.5 159f6fd63d35 */
/* bench 21258.0.6 2fef9b9ea0a7 */
/* bench 21258.0.7 99a53bb25560 */
/* bench 21258.0.8 db5bfb28e41f */
/* bench 21258.0.9 043bdc829659 */
/* bench 21258.0.10 2404e9ba453e */
/* bench 21258.0.11 d1066b67852d */
/* bench 21258.0.12 0986500ca967 */
```

## Documentation/devicetree/bindings/net/wireless/brcm,bcm43xx-fmac.txt
```
FASTVC-BENCH-CORPUS:linux-main-100k-v1-e0bd41dc-8e12-4f1b-978d-a3645ae59da0
Broadcom BCM43xx Fullmac wireless SDIO devices

This node provides properties for controlling the Broadcom wireless device. The
node is expected to be specified as a child node to the SDIO controller that
connects the device to the system.

Required properties:

/* bench 2539.0.0 eed07f950e77 */
/* bench 2539.0.1 a39579c8be93 */
/* bench 2539.0.2 02ebf51c0893 */
/* bench 2539.0.3 9b6fde4690ad */
/* bench 2539.0.4 a356ee41cc60 */
/* bench 2539.0.5 1c76dfb8f8eb */

Optional properties:
 - brcm,drive-strength : drive strength used for SDIO pins on device in mA
	(default = 6).
 - interrupts : specifies attributes for the out-of-band interrupt (host-wake).
	When not specified the device will use in-band SDIO interrupts.
 - interrupt-names : name of the out-of-band interrupt, which must be set
	to "host-wake".
/* bench 13486.0.0 b2c22304dfe2 */
/* bench 13486.0.1 df045accb0f4 */
/* bench 13486.0.2 2cc441407cfa */
/* bench 13486.0.3 c818ceaa4ce9 */
/* bench 13486.0.4 107385021209 */
/* bench 13486.0.5 737c34d6a144 */
/* bench 13486.0.6 a0df54a406d5 */
/* bench 13486.0.7 c20a4b9accef */
/* bench 13486.0.8 b7a527f18815 */
/* bench 13486.0.9 8e46981774dc */

Example:

mmc3: mmc@1c12000 {
	#address-cells = <1>;
	#size-cells = <0>;

	pinctrl-names = "default";
	pinctrl-0 = <&mmc3_pins_a>;
	vmmc-supply = <&reg_vmmc3>;
	bus-width = <4>;
	non-removable;

	brcmf: wifi@1 {
		reg = <1>;
		compatible = "brcm,bcm4329-fmac";
		interrupt-parent = <&pio>;
		interrupts = <10 8>; /* PH10 / EINT10 */
		interrupt-names = "host-wake";
	};
};
```
