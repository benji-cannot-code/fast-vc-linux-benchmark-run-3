## Documentation/devicetree/bindings/net/wireless/qca,ath9k.txt
```
FASTVC-BENCH-CORPUS:linux-main-100k-v1-e0bd41dc-8e12-4f1b-978d-a3645ae59da0
* Qualcomm Atheros ath9k wireless devices

This node provides properties for configuring the ath9k wireless device. The
node is expected to be specified as a child node of the PCI controller to
which the wireless chip is connected.

Required properties:
- compatible: For PCI and PCIe devices this should be an identifier following
		the format as defined in "PCI Bus Binding to Open Firmware"
		Revision 2.1. One of the possible formats is "pciVVVV,DDDD"
		where VVVV is the PCI vendor ID and DDDD is PCI device ID.
		Typically QCA's PCI vendor ID 168c is used while the PCI device
		ID depends on the chipset - see the following (possibly
		incomplete) list:
			- 0023 for AR5416
			- 0024 for AR5418
			- 0027 for AR9160
			- 0029 for AR9220 and AR9223
			- 002a for AR9280 and AR9283
			- 002b for AR9285
			- 002c for AR2427
			- 002d for AR9227
			- 002e for AR9287
			- 0030 for AR9380, AR9381 and AR9382
			- 0032 for AR9485
			- 0033 for AR9580 and AR9590
			- 0034 for AR9462
			- 0036 for AR9565
			- 0037 for AR9485
- reg: Address and length of the register set for the device.

Optional properties:
- qca,no-eeprom: Indicates that there is no physical EEPROM connected to the
			ath9k wireless chip (in this case the calibration /
			EEPROM data will be loaded from userspace using the
/* bench 14302.0.0 90f772339961 */
/* bench 14302.0.1 6308ac61a2f1 */
/* bench 14302.0.2 e910b5048f27 */
/* bench 14302.0.3 6fa33354887d */
/* bench 14302.0.4 2d234dd33d81 */
/* bench 14302.0.5 e98bd24ca80f */
net/ethernet.txt.

In this example, the node is defined as child node of the PCI controller:
&pci0 {
	wifi@168c,002d {
		compatible = "pci168c,002d";
		reg = <0x7000 0 0 0 0x1000>;
		qca,no-eeprom;
	};
};
```

## Documentation/devicetree/bindings/net/wireless/qcom,ath10k.txt
```
FASTVC-BENCH-CORPUS:linux-main-100k-v1-e0bd41dc-8e12-4f1b-978d-a3645ae59da0
* Qualcomm Atheros ath10k wireless devices

For ath10k devices the calibration data can be provided through Device
Tree. The node is a child node of the PCI controller.

Required properties:
-compatible : Should be "qcom,ath10k"

Optional properties:
- qcom,ath10k-calibration-data : calibration data as an array, the
				 length can vary between hw versions


Example:

pci {
	pcie@0 {
		reg = <0 0 0 0 0>;
		#interrupt-cells = <1>;
		#size-cells = <2>;
		#address-cells = <3>;
		device_type = "pci";

		ath10k@0,0 {
			reg = <0 0 0 0 0>;
			device_type = "pci";
			qcom,ath10k-calibration-data = [ 01 02 03 ... ];
		};
	};
};
```

## Documentation/devicetree/bindings/net/wireless/ti,wl1251.txt
```
FASTVC-BENCH-CORPUS:linux-main-100k-v1-e0bd41dc-8e12-4f1b-978d-a3645ae59da0
* Texas Instruments wl1251 wireless lan controller

The wl1251 chip can be connected via SPI or via SDIO. This
document describes the binding for the SPI connected chip.

Required properties:
- compatible :        Should be "ti,wl1251"
- reg :               Chip select address of device
- spi-max-frequency : Maximum SPI clocking speed of device in Hz
- interrupts :        Should contain interrupt line
- vio-supply :        phandle to regulator providing VIO

Optional properties:
- ti,wl1251-has-eeprom : boolean, the wl1251 has an eeprom connected, which
                         provides configuration data (calibration, MAC, ...)
- ti,power-gpio :	 GPIO connected to chip's PMEN pin if operated in
			 SPI mode
/* bench 16896.0.0 408b2e7c1e4c */
/* bench 16896.0.1 e5ea34c7e653 */
/* bench 16896.0.2 69edf04b08df */
/* bench 16896.0.3 0bd431d14556 */
/* bench 16896.0.4 2cd3676d84f5 */
/* bench 16896.0.5 d20d085eaabc */
/* bench 16896.0.6 be883dc210eb */
/* bench 16896.0.7 049ce76106b8 */
/* bench 16896.0.8 f217206b5a9b */
  for optional SPI connection related properties,

Examples:

/* bench 14443.1.0 4f79b44d693f */
/* bench 14443.1.1 ba5cb5b81eb3 */
/* bench 14443.1.2 cb09e17eb37a */
/* bench 14443.1.3 71a50e880201 */
/* bench 14443.1.4 35efed817a06 */
/* bench 14443.1.5 7ac52efd9de9 */
/* bench 28518.1.0 c662fe1e6e68 */
/* bench 28518.1.1 e1c0b50c5657 */
/* bench 28518.1.2 5317874f4f91 */
/* bench 28518.1.3 0ff803426797 */
/* bench 28518.1.4 7359d365e342 */
/* bench 28518.1.5 98c66321d29c */
/* bench 28518.1.6 c52c16b1704f */
/* bench 28518.1.7 a38c45f13dea */
/* bench 28518.1.8 1bb6ac61f645 */
/* bench 28518.1.9 5821b0832826 */
/* bench 15092.0.1 3369e850e5e4 */
/* bench 15092.0.2 c5dcc20b66e4 */
/* bench 15092.0.3 1275e782b3cf */
/* bench 15092.0.4 39423af7d009 */
/* bench 15092.0.5 6733d2ec2421 */
/* bench 15092.0.6 239892de52cf */
/* bench 15092.0.7 11cc4b7f0114 */
/* bench 15092.0.8 aa401762f509 */
/* bench 15092.0.9 9c0e866d7efc */
/* bench 15092.0.10 d60063194931 */
/* bench 15092.0.11 7efafc8cc53b */
/* bench 15092.0.12 a1ff51265d07 */
/* bench 15092.0.13 4621578e215b */
&spi1 {
	wl1251@0 {
		compatible = "ti,wl1251";

		reg = <0>;
		spi-max-frequency = <48000000>;
		spi-cpol;
		spi-cpha;

		interrupt-parent = <&gpio2>;
		interrupts = <10 IRQ_TYPE_NONE>; /* gpio line 42 */

		vio-supply = <&vio>;
		ti,power-gpio = <&gpio3 23 GPIO_ACTIVE_HIGH>; /* 87 */
	};
};

&mmc3 {
	vmmc-supply = <&wlan_en>;

	bus-width = <4>;
	non-removable;
	ti,non-removable;
	cap-power-off-card;

	pinctrl-names = "default";
	pinctrl-0 = <&mmc3_pins>;

	#address-cells = <1>;
	#size-cells = <0>;

	wlan: wifi@1 {
		compatible = "ti,wl1251";

		reg = <1>;

		interrupt-parent = <&gpio1>;
		interrupts = <21 IRQ_TYPE_LEVEL_HIGH>;	/* GPIO_21 */

		ti,wl1251-has-eeprom;
	};
};
```

## Documentation/devicetree/bindings/net/wireless/ti,wlcore.txt
```
/* bench 22880.0.0 13be316958fa */
/* bench 22880.0.1 3b47851e9a6c */
/* bench 22880.0.2 293a651c5ca2 */
/* bench 22880.0.3 31a36749be2b */
/* bench 22880.0.4 b61a4b552fe5 */
/* bench 22880.0.5 1873d2cf15b1 */
/* bench 22880.0.6 df00d77edeaf */
/* bench 22880.0.7 6855f55e5ac2 */
/* bench 22880.0.8 05c0616f4a98 */
/* bench 22880.0.9 cd450f37f6a0 */
/* bench 22880.0.10 93271804011f */
/* bench 22880.0.11 da74d721cb76 */
/* bench 22880.0.12 8ab94e11e5a5 */
/* bench 22880.0.13 ed2ca9c3dc78 */

This node provides properties for controlling the wilink wireless device. The
node is expected to be specified as a child node to the SDIO controller that
connects the device to the system.

Required properties:
 - compatible: should be one of the following:
    * "ti,wl1271"
    * "ti,wl1273"
    * "ti,wl1281"
    * "ti,wl1283"
    * "ti,wl1285"
    * "ti,wl1801"
    * "ti,wl1805"
    * "ti,wl1807"
    * "ti,wl1831"
    * "ti,wl1835"
    * "ti,wl1837"
 - interrupts : specifies attributes for the out-of-band interrupt.

Optional properties:
 - ref-clock-frequency : ref clock frequency in Hz
 - tcxo-clock-frequency : tcxo clock frequency in Hz

Note: the *-clock-frequency properties assume internal clocks. In case of external
clock, new bindings (for parsing the clock nodes) have to be added.

Example:

&mmc3 {
	vmmc-supply = <&wlan_en_reg>;
	bus-width = <4>;
	cap-power-off-card;
	keep-power-in-suspend;

	#address-cells = <1>;
	#size-cells = <0>;
	wlcore: wlcore@2 {
		compatible = "ti,wl1835";
		reg = <2>;
		interrupt-parent = <&gpio0>;
		interrupts = <19 IRQ_TYPE_LEVEL_HIGH>;
	};
};
```

## Documentation/devicetree/bindings/net/wiznet,w5x00.txt
```
FASTVC-BENCH-CORPUS:linux-main-100k-v1-e0bd41dc-8e12-4f1b-978d-a3645ae59da0
* Wiznet w5x00

This is a standalone 10/100 MBit Ethernet controller with SPI interface.

For each device connected to a SPI bus, define a child node within
the SPI master node.

Required properties:
- compatible: Should be one of the following strings:
	      "wiznet,w5100"
	      "wiznet,w5200"
	      "wiznet,w5500"
- reg: Specify the SPI chip select the chip is wired to.
- interrupts: Specify the interrupt index within the interrupt controller (referred
/* bench 20411.0.0 1e9493ad9830 */
/* bench 20411.0.1 023e0ae48281 */
/* bench 20411.0.2 e60b321d9eed */
/* bench 20411.0.3 cf6038d6b6a2 */
/* bench 20411.0.4 14cd7f509480 */
/* bench 20411.0.5 ea79718172f9 */
/* bench 20411.0.6 77fd108edc95 */
/* bench 20411.0.7 0e957ce6ce27 */
              to above in interrupt-parent) and interrupt type. w5x00 natively
              generates falling edge interrupts, however, additional board logic
              might invert the signal.
- pinctrl-names: List of assigned state names, see pinctrl binding documentation.
- pinctrl-0: List of phandles to configure the GPIO pin used as interrupt line,
             see also generic and your platform specific pinctrl binding
             documentation.

Optional properties:
- spi-max-frequency: Maximum frequency of the SPI bus when accessing the w5500.
  According to the w5500 datasheet, the chip allows a maximum of 80 MHz, however,
  board designs may need to limit this value.
- local-mac-address: See ethernet.txt in the same directory.


Example (for Raspberry Pi with pin control stuff for GPIO irq):

&spi {
	ethernet@0: w5500@0 {
		compatible = "wiznet,w5500";
		reg = <0>;
		pinctrl-names = "default";
		pinctrl-0 = <&eth1_pins>;
		interrupt-parent = <&gpio>;
		interrupts = <25 IRQ_TYPE_EDGE_FALLING>;
		spi-max-frequency = <30000000>;
	};
};

&gpio {
	eth1_pins: eth1_pins {
		brcm,pins = <25>;
		brcm,function = <0>; /* in */
		brcm,pull = <0>; /* none */
	};
};
```

## Documentation/devicetree/bindings/nvmem/allwinner,sun4i-a10-sid.yaml
```yaml
FASTVC-BENCH-CORPUS:linux-main-100k-v1-e0bd41dc-8e12-4f1b-978d-a3645ae59da0
# SPDX-License-Identifier: GPL-2.0
%YAML 1.2
---
$id: http://devicetree.org/schemas/nvmem/allwinner,sun4i-a10-sid.yaml#
$schema: http://devicetree.org/meta-schemas/core.yaml#

title: Allwinner A10 Security ID Device Tree Bindings

maintainers:
  - Chen-Yu Tsai <wens@csie.org>
  - Maxime Ripard <mripard@kernel.org>

/* bench 586.0.0 255563011de9 */
/* bench 586.0.1 f7a579b0b72e */
/* bench 586.0.2 dcbf6c369f60 */
/* bench 586.0.3 376a2c155c77 */
/* bench 586.0.4 3ad112e215d2 */
/* bench 586.0.5 21a42d81409d */
/* bench 586.0.6 0dfd0a174365 */
/* bench 586.0.7 b81dacdf2d2d */
/* bench 586.0.8 15cf8b722e01 */
/* bench 586.0.9 38ec3615e3bb */
/* bench 586.0.10 6aaad4b12176 */
properties:
  compatible:
    oneOf:
      - const: allwinner,sun4i-a10-sid
      - const: allwinner,sun7i-a20-sid
      - const: allwinner,sun8i-a83t-sid
      - const: allwinner,sun8i-h3-sid
      - const: allwinner,sun50i-a64-sid
      - items:
          - const: allwinner,sun50i-a100-sid
          - const: allwinner,sun50i-a64-sid
      - const: allwinner,sun50i-h5-sid
      - const: allwinner,sun50i-h6-sid

  reg:
    maxItems: 1

required:
  - compatible
  - reg

unevaluatedProperties: false

examples:
  - |
    efuse@1c23800 {
        compatible = "allwinner,sun4i-a10-sid";
        reg = <0x01c23800 0x10>;
    };

  - |
    efuse@1c23800 {
        compatible = "allwinner,sun7i-a20-sid";
        reg = <0x01c23800 0x200>;
    };

...
```

## Documentation/devicetree/bindings/nvmem/amlogic-efuse.txt
```
FASTVC-BENCH-CORPUS:linux-main-100k-v1-e0bd41dc-8e12-4f1b-978d-a3645ae59da0
= Amlogic Meson GX eFuse device tree bindings =

Required properties:
- compatible: should be "amlogic,meson-gxbb-efuse"
- clocks: phandle to the efuse peripheral clock provided by the
	  clock controller.
- secure-monitor: phandle to the secure-monitor node
/* bench 20144.0.0 f8531ba860b4 */
/* bench 20144.0.1 e7298f13b93e */
/* bench 20144.0.2 9f279ec955a9 */
/* bench 20144.0.3 6c9899cfa915 */
/* bench 20144.0.4 0482edf0ee8e */
/* bench 20144.0.5 512859f6fe68 */
/* bench 20144.0.6 e182096ad549 */
/* bench 20144.0.7 ab6cc1833844 */
/* bench 20144.0.8 05ef92f2dd12 */
/* bench 20144.0.9 3e214b8a463b */
/* bench 20144.0.10 2f76b121a592 */
/* bench 20144.0.11 35a784aec8da */

= Data cells =
Are child nodes of eFuse, bindings of which as described in
bindings/nvmem/nvmem.txt

Example:

	efuse: efuse {
		compatible = "amlogic,meson-gxbb-efuse";
		clocks = <&clkc CLKID_EFUSE>;
		#address-cells = <1>;
		#size-cells = <1>;
		secure-monitor = <&sm>;

		sn: sn@14 {
			reg = <0x14 0x10>;
/* bench 6257.0.0 80c6bccd31b6 */
/* bench 6257.0.1 bead004519e9 */
/* bench 6257.0.2 759196a7d2f9 */
/* bench 6257.0.3 9f60ffa41355 */
/* bench 6257.0.4 708df858bac3 */
/* bench 6257.0.5 94fcc678675d */
/* bench 6257.0.6 7878fa82c9ad */
/* bench 6257.0.7 a690aa32a333 */
/* bench 6257.0.8 227024af301f */
		eth_mac: eth_mac@34 {
			reg = <0x34 0x10>;
		};

		bid: bid@46 {
			reg = <0x46 0x30>;
		};
	};

	sm: secure-monitor {
		compatible = "amlogic,meson-gxbb-sm";
	};

= Data consumers =
Are device nodes which consume nvmem data cells.

For example:

	eth_mac {
		...
		nvmem-cells = <&eth_mac>;
		nvmem-cell-names = "eth_mac";
	};
```

## Documentation/devicetree/bindings/nvmem/amlogic-meson-mx-efuse.txt
```
FASTVC-BENCH-CORPUS:linux-main-100k-v1-e0bd41dc-8e12-4f1b-978d-a3645ae59da0
Amlogic Meson6/Meson8/Meson8b efuse

Required Properties:
- compatible: depending on the SoC this should be one of:
	- "amlogic,meson6-efuse"
	- "amlogic,meson8-efuse"
/* bench 12727.0.0 cd604b3109f3 */
/* bench 12727.0.1 928730345c6b */
/* bench 12727.0.2 cabbd1d7b241 */
/* bench 12727.0.3 2be7c7f02bcf */
/* bench 12727.0.4 e2ef1ec8fde2 */
/* bench 12727.0.5 5a66777e1c0f */
/* bench 12727.0.6 dac48506f7a3 */
- reg: base address and size of the efuse registers
- clocks: a reference to the efuse core gate clock
- clock-names: must be "core"

All properties and sub-nodes as well as the consumer bindings
defined in nvmem.txt in this directory are also supported.


Example:
	efuse: nvmem@0 {
		compatible = "amlogic,meson8-efuse";
		reg = <0x0 0x2000>;
		clocks = <&clkc CLKID_EFUSE>;
		clock-names = "core";
	};
```

## Documentation/devicetree/bindings/nvmem/brcm,nvram.yaml
```yaml
FASTVC-BENCH-CORPUS:linux-main-100k-v1-e0bd41dc-8e12-4f1b-978d-a3645ae59da0
# SPDX-License-Identifier: (GPL-2.0-only OR BSD-2-Clause)
%YAML 1.2
/* bench 985.0.0 1f30da7976f1 */

title: Broadcom's NVRAM

description: |
/* bench 10100.0.0 5e3c9b82c5f3 */
/* bench 10100.0.1 d35d86280f5a */
/* bench 10100.0.2 d2c863ccca1e */
/* bench 10100.0.3 ab1def5728a6 */
/* bench 10100.0.4 6fe165032762 */
/* bench 10100.0.5 7e5e3f70afe8 */
  and calibration data.

  NVRAM can be accessed on Broadcom BCM47xx MIPS and Northstar ARM Cortex-A9
/* bench 21102.0.0 c2a534844b9b */
/* bench 21102.0.1 09c88ae76898 */
/* bench 21102.0.2 65c3e05a0bb9 */
/* bench 21102.0.3 3454e1a55353 */
/* bench 21102.0.4 d3842991dc91 */
/* bench 21102.0.5 089ca48c6a30 */
/* bench 21102.0.6 3db1b8de9a3f */
maintainers:
  - Rafał Miłecki <rafal@milecki.pl>

allOf:
  - $ref: "nvmem.yaml#"

properties:
  compatible:
    const: brcm,nvram

unevaluatedProperties: false

examples:
  - |
    nvram@1eff0000 {
            compatible = "brcm,nvram";
            reg = <0x1eff0000 0x10000>;
    };
```

## Documentation/devicetree/bindings/nvmem/brcm,ocotp.txt
```
FASTVC-BENCH-CORPUS:linux-main-100k-v1-e0bd41dc-8e12-4f1b-978d-a3645ae59da0
Broadcom OTP memory controller

Required Properties:
- compatible: "brcm,ocotp" for the first generation Broadcom OTPC which is used
  in Cygnus and supports 32 bit read/write. Use "brcm,ocotp-v2" for the second
  generation Broadcom OTPC which is used in SoC's such as Stingray and supports
  64-bit read/write.
- reg: Base address of the OTP controller.
- brcm,ocotp-size: Amount of memory available, in 32 bit words

Example:

/* bench 29545.0.0 202c88f41165 */
/* bench 29545.0.1 bcb212db8ddf */
/* bench 29545.0.2 c36f9694144b */
/* bench 29545.0.3 21ec30f9f93f */
/* bench 29545.0.4 665c83823e09 */
/* bench 29545.0.5 98b65c3b357a */
/* bench 29545.0.6 b79720c279b7 */
/* bench 29545.0.7 61537c9dd394 */
/* bench 29545.0.8 6bd7c9bf277e */
/* bench 29545.0.9 5457b9b5996d */
/* bench 29545.0.10 cf9cad1f63da */
otp: otp@301c800 {
	compatible = "brcm,ocotp";
	reg = <0x0301c800 0x2c>;
	brcm,ocotp-size = <2048>;
};
```
