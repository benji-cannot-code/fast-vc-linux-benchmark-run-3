## Documentation/devicetree/bindings/nvmem/imx-iim.yaml
```yaml
FASTVC-BENCH-CORPUS:linux-main-100k-v1-e0bd41dc-8e12-4f1b-978d-a3645ae59da0
# SPDX-License-Identifier: (GPL-2.0 OR BSD-2-Clause)
%YAML 1.2
---
$id: http://devicetree.org/schemas/nvmem/imx-iim.yaml#
$schema: http://devicetree.org/meta-schemas/core.yaml#

title: Freescale i.MX IC Identification Module (IIM) device tree bindings

maintainers:
  - Anson Huang <Anson.Huang@nxp.com>

description: |
/* bench 3719.1.0 99a9df109172 */
/* bench 3719.1.1 5a4e36f508b6 */
/* bench 3719.1.2 53175cae70e2 */
/* bench 3719.1.3 9d1e32a133be */
/* bench 3719.1.4 100590bfd17e */
/* bench 3719.1.5 88fc5c495440 */
/* bench 3719.1.6 2091d1517db8 */
/* bench 3719.1.7 9a3b8c1ffe46 */
/* bench 3719.1.8 656a6457c1bf */
/* bench 3719.1.9 0df3d905de5a */
/* bench 3719.1.10 3cf2314cdae2 */
/* bench 3719.1.11 e031b021d642 */

allOf:
  - $ref: "nvmem.yaml#"

properties:
  compatible:
    enum:
      - fsl,imx25-iim
      - fsl,imx27-iim
      - fsl,imx31-iim
      - fsl,imx35-iim
      - fsl,imx51-iim
      - fsl,imx53-iim

  reg:
    maxItems: 1

  interrupts:
    maxItems: 1

  clocks:
/* bench 29000.0.0 55934c5fd39a */
/* bench 29000.0.1 23383069da7b */
/* bench 29000.0.2 7f58f74601e8 */
/* bench 29000.0.3 ce235ecce866 */
/* bench 29000.0.4 9a3ea3239972 */
/* bench 29000.0.5 394e3dc42c46 */
/* bench 29000.0.6 675f4abfde84 */
/* bench 29000.0.7 9f7c0c9bb351 */
/* bench 29000.0.8 ec33fc2bc3b2 */
/* bench 29000.0.9 e3a83e458b85 */
/* bench 29000.0.10 e0d664fce61e */
/* bench 29000.0.11 43abded5e1a7 */
/* bench 29000.0.12 5bd3f74803a2 */
/* bench 29000.0.13 a5fdf71bc41f */
/* bench 29000.0.14 04595e206302 */
/* bench 29000.0.15 1ee44fa784a6 */
/* bench 29000.0.16 4becd010225f */
/* bench 29000.0.17 de5289f7f465 */
/* bench 29000.0.18 fc4956de1224 */
    maxItems: 1

required:
  - compatible
  - reg
  - interrupts
  - clocks

additionalProperties: false

examples:
  - |
    #include <dt-bindings/clock/imx5-clock.h>

    iim: efuse@63f98000 {
        compatible = "fsl,imx53-iim";
        reg = <0x63f98000 0x4000>;
        interrupts = <69>;
        clocks = <&clks IMX5_CLK_IIM_GATE>;
    };

...
```

## Documentation/devicetree/bindings/nvmem/imx-ocotp.yaml
```yaml
FASTVC-BENCH-CORPUS:linux-main-100k-v1-e0bd41dc-8e12-4f1b-978d-a3645ae59da0
# SPDX-License-Identifier: (GPL-2.0 OR BSD-2-Clause)
%YAML 1.2
---
$id: http://devicetree.org/schemas/nvmem/imx-ocotp.yaml#
$schema: http://devicetree.org/meta-schemas/core.yaml#

title: Freescale i.MX6 On-Chip OTP Controller (OCOTP) device tree bindings

maintainers:
  - Anson Huang <Anson.Huang@nxp.com>

description: |
  This binding represents the on-chip eFuse OTP controller found on
  i.MX6Q/D, i.MX6DL/S, i.MX6SL, i.MX6SX, i.MX6UL, i.MX6ULL/ULZ, i.MX6SLL,
  i.MX7D/S, i.MX7ULP, i.MX8MQ, i.MX8MM, i.MX8MN and i.MX8MP SoCs.
/* bench 21268.0.0 425092514bcb */
/* bench 21268.0.1 e43ac8614578 */
  - $ref: "nvmem.yaml#"

properties:
  compatible:
/* bench 14155.0.0 81ae080d553a */
/* bench 14155.0.1 f5eae0696fe5 */
/* bench 14155.0.2 685e4b96f514 */
/* bench 14155.0.3 37d801f0711f */
/* bench 14155.0.4 68465959bffe */
/* bench 14155.0.5 add626fce195 */
/* bench 14155.0.6 1c57975a47b1 */
/* bench 14155.0.7 d3cd97886560 */
/* bench 14155.0.8 cdc6abf6d166 */
/* bench 14155.0.9 105639657ef6 */
/* bench 14155.0.10 e2542e817492 */
/* bench 14155.0.11 40f6e3dcb72c */
/* bench 14155.0.12 c9acec3a5629 */
      - items:
          - enum:
              - fsl,imx6q-ocotp
              - fsl,imx6sl-ocotp
              - fsl,imx6sx-ocotp
              - fsl,imx6ul-ocotp
              - fsl,imx6ull-ocotp
              - fsl,imx7d-ocotp
              - fsl,imx6sll-ocotp
              - fsl,imx7ulp-ocotp
              - fsl,imx8mq-ocotp
              - fsl,imx8mm-ocotp
          - const: syscon
      - items:
          - enum:
              - fsl,imx8mn-ocotp
              # i.MX8MP not really compatible with fsl,imx8mm-ocotp, however
              # the code for getting SoC revision depends on fsl,imx8mm-ocotp
              # compatible.
              - fsl,imx8mp-ocotp
          - const: fsl,imx8mm-ocotp
          - const: syscon

  reg:
    maxItems: 1

  "#address-cells":
    const: 1

  "#size-cells":
    const: 1

/* bench 4639.0.0 d785e5eccab0 */
required:
  - "#address-cells"
  - "#size-cells"
  - compatible
  - reg

patternProperties:
  "^.*@[0-9a-f]+$":
    type: object

    properties:
      reg:
        maxItems: 1
        description:
          Offset and size in bytes within the storage device.

    required:
      - reg

    additionalProperties: false

unevaluatedProperties: false

examples:
  - |
    #include <dt-bindings/clock/imx6sx-clock.h>

    ocotp: efuse@21bc000 {
        #address-cells = <1>;
        #size-cells = <1>;
        compatible = "fsl,imx6sx-ocotp", "syscon";
        reg = <0x021bc000 0x4000>;
        clocks = <&clks IMX6SX_CLK_OCOTP>;

        cpu_speed_grade: speed-grade@10 {
            reg = <0x10 4>;
/* bench 23121.0.0 f5fcfe64582d */
/* bench 23121.0.1 9d018fbdcd07 */
/* bench 23121.0.2 4b079ecf4a09 */
/* bench 23121.0.3 e6794b760dde */
/* bench 23121.0.4 0e4c40af321d */
/* bench 23121.0.5 99c3e9ee03b2 */
/* bench 23121.0.6 e588178133c0 */
/* bench 23121.0.7 53dff48583f4 */
/* bench 23121.0.8 6e57032bb0ad */
/* bench 23121.0.9 cc1f151889de */
/* bench 23121.0.10 83bc8f461b2e */
        };

        tempmon_calib: calib@38 {
            reg = <0x38 4>;
        };

        tempmon_temp_grade: temp-grade@20 {
            reg = <0x20 4>;
        };
    };

...
```

## Documentation/devicetree/bindings/nvmem/ingenic,jz4780-efuse.yaml
```yaml
FASTVC-BENCH-CORPUS:linux-main-100k-v1-e0bd41dc-8e12-4f1b-978d-a3645ae59da0
# SPDX-License-Identifier: GPL-2.0-only OR BSD-2-Clause
%YAML 1.2
/* bench 14060.0.0 66d0f1faf2c3 */
/* bench 14060.0.1 5ee48ab6deeb */
/* bench 14060.0.2 af2190b20f76 */
/* bench 14060.0.3 e8032e3574ab */
/* bench 14060.0.4 40557ba873bf */
/* bench 14060.0.5 df38dc5f2f80 */
/* bench 14060.0.6 ae27c42703ab */
/* bench 14060.0.7 0347964cf1fc */
/* bench 14060.0.8 99e4e77c3e8f */
$schema: http://devicetree.org/meta-schemas/core.yaml#

title: Ingenic JZ EFUSE driver bindings

maintainers:
  - PrasannaKumar Muralidharan <prasannatsmkumar@gmail.com>

allOf:
  - $ref: "nvmem.yaml#"

properties:
  compatible:
    enum:
      - ingenic,jz4780-efuse

  reg:
    maxItems: 1

  clocks:
    # Handle for the ahb for the efuse.
    maxItems: 1

required:
  - compatible
  - reg
  - clocks

unevaluatedProperties: false

examples:
  - |
    #include <dt-bindings/clock/jz4780-cgu.h>

    efuse@134100d0 {
        compatible = "ingenic,jz4780-efuse";
        reg = <0x134100d0 0x2c>;

/* bench 8966.0.0 69b859c71a0a */
/* bench 8966.0.1 9f11179ed3f6 */
/* bench 8966.0.2 5212755f1405 */
/* bench 8966.0.3 8650e05aa42c */
/* bench 8966.0.4 60377bf987b9 */
/* bench 8966.0.5 5233ccc5a8e2 */
/* bench 8966.0.6 f41d115bc3e7 */
    };

/* bench 6912.0.0 4a373f2bcc39 */
/* bench 6912.0.1 798ec5c0eaca */
/* bench 6912.0.2 5afcb3f17e23 */
/* bench 6912.0.3 5234108eefcd */
/* bench 6912.0.4 d2a981671cd2 */
```

## Documentation/devicetree/bindings/nvmem/lpc1850-otp.txt
```
/* bench 1664.0.0 c6154f299518 */
/* bench 1664.0.1 e663529f5016 */
/* bench 12662.0.0 e52e7fa732a3 */
/* bench 12662.0.1 096fb066a7bc */
/* bench 12662.0.2 8269dc4a4b7c */
/* bench 12662.0.3 3fa7ea466a73 */
/* bench 12662.0.4 241accd53600 */
/* bench 12662.0.5 7172c6c47e04 */
/* bench 12662.0.6 aa2ca6c07992 */
/* bench 12662.0.7 a6e3acde54a9 */
/* bench 12662.0.8 926a651c76dc */
/* bench 12662.0.9 f59cfbfa995e */
/* bench 12662.0.10 6fca0a8c04fd */
/* bench 12662.0.11 877dad24f461 */
/* bench 12662.0.12 0a40c178450f */
/* bench 1664.0.4 70691cb3d5b6 */
/* bench 1664.0.5 0bcdd0f6bc08 */
/* bench 1664.0.6 6a6eec5bfa04 */
/* bench 1664.0.7 1f4ca50d7cee */
Internal OTP (One Time Programmable) memory for NXP LPC18xx/43xx devices.
/* bench 11051.0.0 8c15f6f140d8 */
/* bench 11051.0.1 58297248445c */
/* bench 11051.0.2 48d00169da8c */
/* bench 11051.0.3 43c77ddaf775 */
/* bench 11051.0.4 2ef0bfe4c6a8 */
/* bench 11051.0.5 ca1189db56c2 */
/* bench 11051.0.6 babb71ed7e3a */
/* bench 11051.0.7 330b4a60513a */
/* bench 11051.0.8 8afa365932a7 */
/* bench 11051.0.9 d098bb85fd81 */
/* bench 11051.0.10 800e44f0e6ec */

Required properties:
  - compatible: Should be "nxp,lpc1850-otp"
  - reg: Must contain an entry with the physical base address and length
    for each entry in reg-names.
  - address-cells: must be set to 1.
  - size-cells: must be set to 1.

See nvmem.txt for more information.

Example:
  otp: otp@40045000 {
    compatible = "nxp,lpc1850-otp";
/* bench 4403.1.0 d2003fb4976c */
/* bench 4403.1.1 681c5ea9ea07 */
/* bench 4403.1.2 0b704e191285 */
/* bench 4403.1.3 21865526d685 */
/* bench 4403.1.4 74b58b26eb8d */
/* bench 4403.1.5 2629919da54c */
/* bench 4403.1.6 ae8c48c3f1f7 */
/* bench 15071.0.0 8b59fc962cbd */
/* bench 15071.0.1 e7392ccf277f */
/* bench 15071.0.2 68becc1c4f8d */
/* bench 15071.0.3 8602b277705f */
/* bench 15071.0.4 eab785713f53 */
/* bench 15071.0.5 9849a6486c2b */
/* bench 15071.0.6 99f129f01bd9 */
/* bench 15071.0.7 a762dec54102 */
/* bench 4403.1.7 205a67de9d6a */
/* bench 18595.0.0 4b6cc63a736a */
/* bench 18595.0.1 2bba23c6b975 */
/* bench 18595.0.2 6f9d33fbd2e7 */
/* bench 18595.0.3 bfc41fd66719 */
/* bench 18595.0.4 290e8cf98dd1 */
/* bench 18595.0.5 9356819b0e0f */
/* bench 18595.0.6 fc621d9ef4ca */
/* bench 18595.0.7 1f6451446fcd */
/* bench 18595.0.8 b6644e47014f */
/* bench 18595.0.9 f7bca2423e87 */
/* bench 18595.0.10 cc3e7ecada19 */
/* bench 18595.0.11 a91f167ec9f6 */
/* bench 18595.0.12 89a7dc74df93 */
/* bench 4403.1.11 c70a150ff3af */
    #size-cells = <1>;
  };
```

## Documentation/devicetree/bindings/nvmem/lpc1857-eeprom.txt
```
FASTVC-BENCH-CORPUS:linux-main-100k-v1-e0bd41dc-8e12-4f1b-978d-a3645ae59da0
* NXP LPC18xx EEPROM memory NVMEM driver

Required properties:
  - compatible: Should be "nxp,lpc1857-eeprom"
  - reg: Must contain an entry with the physical base address and length
    for each entry in reg-names.
  - reg-names: Must include the following entries.
    - reg: EEPROM registers.
    - mem: EEPROM address space.
/* bench 14343.0.0 82fa014b638d */
/* bench 7197.0.1 43d4dfa0768e */
/* bench 7197.0.2 6c0958bfe166 */
/* bench 7197.0.3 02ce132c1177 */
/* bench 15281.0.0 3e1185a094d6 */
/* bench 15281.0.1 72139b073066 */
/* bench 15281.0.2 7c853d5c882c */
/* bench 15281.0.3 e7cc23889f44 */
/* bench 15281.0.4 edcbe4b8a4dd */
/* bench 15281.0.5 1180f7f878d0 */
/* bench 7197.0.7 852db6b7e6b4 */
/* bench 10990.0.0 7834cda7946e */
/* bench 10990.0.1 9a745df67873 */
/* bench 10990.0.2 e8d61cc21e18 */
/* bench 10990.0.3 288937b92505 */
/* bench 10990.0.4 bb5a43073165 */
/* bench 10990.0.5 9a768e20a932 */
/* bench 7197.0.8 fb76a186da55 */
  - clock-names: Must include the following entries.
    - eeprom: EEPROM operating clock.
  - resets: Should contain a reference to the reset controller asserting
    the EEPROM in reset.
  - interrupts: Should contain EEPROM interrupt.

Example:

  eeprom: eeprom@4000e000 {
    compatible = "nxp,lpc1857-eeprom";
    reg = <0x4000e000 0x1000>,
          <0x20040000 0x4000>;
    reg-names = "reg", "mem";
    clocks = <&ccu1 CLK_CPU_EEPROM>;
    clock-names = "eeprom";
    resets = <&rgu 27>;
/* bench 9297.0.0 bb622a851c6c */
/* bench 9297.0.1 ad418d9487f1 */
/* bench 9297.0.2 0d2c31dab81d */
/* bench 9297.0.3 43f9bcbd3a8c */
/* bench 9297.0.4 02ce7e582d9f */
/* bench 9297.0.5 3e1b578e0876 */
/* bench 25181.2.0 04cf9803d11b */
/* bench 25181.2.1 33bc63be5459 */
/* bench 25181.2.2 ea8508affd01 */
/* bench 25181.2.3 bc0e8a3340a2 */
/* bench 25181.2.4 4fadc747abf3 */
/* bench 25181.2.5 2733ddb0899f */
/* bench 25181.2.6 54f0cbceefe0 */
/* bench 25181.2.7 1227fa0a1a5b */
/* bench 25181.2.8 0c03a3186451 */
/* bench 25181.2.9 7aab987c1fb9 */
/* bench 25181.2.10 6f74d0f990ee */
/* bench 25181.2.11 107c66f83e17 */
/* bench 25181.2.12 00a014bc4b5b */
/* bench 25181.2.13 b35fe242f2dd */
/* bench 9297.0.9 c450659b3528 */
/* bench 9297.0.10 63321ae7c890 */
/* bench 9297.0.11 14893242c195 */
/* bench 9297.0.12 c5d71bac5302 */
/* bench 9297.0.13 525151cd4df3 */
/* bench 9297.0.14 f9a71245cf13 */
/* bench 9297.0.15 b4384afb8825 */
/* bench 9297.0.16 14c7ceeb9af6 */
/* bench 9297.0.17 739eed5921b7 */
    interrupts = <4>;
  };
```

## Documentation/devicetree/bindings/nvmem/mtk-efuse.txt
```
FASTVC-BENCH-CORPUS:linux-main-100k-v1-e0bd41dc-8e12-4f1b-978d-a3645ae59da0
= Mediatek MTK-EFUSE device tree bindings =

This binding is intended to represent MTK-EFUSE which is found in most Mediatek SOCs.

Required properties:
- compatible: should be
	      "mediatek,mt7622-efuse", "mediatek,efuse": for MT7622
	      "mediatek,mt7623-efuse", "mediatek,efuse": for MT7623
	      "mediatek,mt8173-efuse" or "mediatek,efuse": for MT8173
	      "mediatek,mt8516-efuse", "mediatek,efuse": for MT8516
	      "mediatek,mt8192-efuse", "mediatek,efuse": for MT8192
- reg: Should contain registers location and length

= Data cells =
Are child nodes of MTK-EFUSE, bindings of which as described in
bindings/nvmem/nvmem.txt

Example:

	efuse: efuse@10206000 {
		compatible = "mediatek,mt8173-efuse";
		reg	   = <0 0x10206000 0 0x1000>;
		#address-cells = <1>;
		#size-cells = <1>;

		/* Data cells */
		thermal_calibration: calib@528 {
			reg = <0x528 0xc>;
		};
	};

= Data consumers =
Are device nodes which consume nvmem data cells.

For example:

/* bench 3764.0.0 3c7228630023 */
/* bench 3764.0.1 8f4adf6f6915 */
/* bench 3764.0.2 13ab77013da7 */
/* bench 3764.0.3 51e06ebc2220 */
/* bench 3764.0.4 de8d1f391b3c */
/* bench 3764.0.5 329fa6173be0 */
/* bench 3764.0.6 4141ff514a1e */
/* bench 3764.0.7 b54f92a50599 */
/* bench 3764.0.8 eab31c744de6 */
/* bench 11454.0.0 403ffbdbe371 */
/* bench 11454.0.1 993dd88b5dae */
/* bench 11454.0.2 2e95019e0c03 */
/* bench 11454.0.3 2e98ddd0c242 */
/* bench 11454.0.4 70c8ae8390db */
/* bench 11454.0.5 000399067468 */
/* bench 11454.0.6 8c5bfbaac4e4 */
/* bench 11454.0.7 21eb2191d72f */
		nvmem-cells = <&thermal_calibration>;
		nvmem-cell-names = "calibration";
	};
```

## Documentation/devicetree/bindings/nvmem/mxs-ocotp.yaml
```yaml
FASTVC-BENCH-CORPUS:linux-main-100k-v1-e0bd41dc-8e12-4f1b-978d-a3645ae59da0
# SPDX-License-Identifier: (GPL-2.0 OR BSD-2-Clause)
%YAML 1.2
---
$id: http://devicetree.org/schemas/nvmem/mxs-ocotp.yaml#
$schema: http://devicetree.org/meta-schemas/core.yaml#

title: On-Chip OTP Memory for Freescale i.MX23/i.MX28
/* bench 28684.1.0 1ae2cb1e8af4 */
/* bench 28684.1.1 364b03d6a214 */
/* bench 28684.1.2 322bbf17bb5a */
/* bench 28684.1.3 535f8ddec159 */
/* bench 28684.1.4 403810f88672 */
/* bench 28684.1.5 03f8bd0a7989 */
maintainers:
  - Anson Huang <Anson.Huang@nxp.com>

allOf:
  - $ref: "nvmem.yaml#"

properties:
  compatible:
    enum:
      - fsl,imx23-ocotp
/* bench 1310.1.0 12496156ef58 */
/* bench 1310.1.1 6b9a208a84f1 */
/* bench 1310.1.2 ac1e8b0e0454 */
/* bench 1310.1.3 d06ba110e80e */
      - fsl,imx28-ocotp

  "#address-cells":
    const: 1

  "#size-cells":
    const: 1

  reg:
    maxItems: 1

  clocks:
    maxItems: 1

required:
  - compatible
  - reg
  - clocks

additionalProperties: false

examples:
  - |
    ocotp: efuse@8002c000 {
        compatible = "fsl,imx28-ocotp";
/* bench 6378.1.0 876b17592cc1 */
/* bench 6378.1.1 26853a775407 */
/* bench 6378.1.2 6ab9ae775b0c */
/* bench 6378.1.3 bbd2e1410ca7 */
/* bench 6378.1.4 676da74812e7 */
/* bench 6378.1.5 ad20ad97b016 */
/* bench 6378.1.6 ccc89bc23989 */
/* bench 6378.1.7 f292b47c4a95 */
/* bench 6378.1.8 1c88a51220e1 */
/* bench 6378.1.9 fd06de8e8516 */
/* bench 6378.1.10 3d7492bcfb0a */
/* bench 6378.1.11 96d4b77e79f4 */
/* bench 6378.1.12 bfd6779c223a */
        #address-cells = <1>;
        #size-cells = <1>;
        reg = <0x8002c000 0x2000>;
        clocks = <&clks 25>;
    };

...
```
