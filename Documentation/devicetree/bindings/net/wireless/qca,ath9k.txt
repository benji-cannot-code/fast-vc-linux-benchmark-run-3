## Documentation/devicetree/bindings/nvmem/qcom,qfprom.yaml
```yaml
FASTVC-BENCH-CORPUS:linux-main-100k-v1-e0bd41dc-8e12-4f1b-978d-a3645ae59da0
# SPDX-License-Identifier: (GPL-2.0-only OR BSD-2-Clause)
%YAML 1.2
---
$id: http://devicetree.org/schemas/nvmem/qcom,qfprom.yaml#
$schema: http://devicetree.org/meta-schemas/core.yaml#

title: Qualcomm Technologies Inc, QFPROM Efuse bindings

maintainers:
  - Srinivas Kandagatla <srinivas.kandagatla@linaro.org>

allOf:
  - $ref: "nvmem.yaml#"

properties:
  compatible:
    const: qcom,qfprom

  reg:
    items:
      - description: The corrected region.

  # Needed if any child nodes are present.
  "#address-cells":
    const: 1
  "#size-cells":
    const: 1

required:
   - compatible
   - reg

examples:
  - |
    soc {
      #address-cells = <2>;
      #size-cells = <2>;

      efuse@784000 {
        compatible = "qcom,qfprom";
        reg = <0 0x00784000 0 0x8ff>;
        #address-cells = <1>;
        #size-cells = <1>;

        hstx-trim-primary@1eb {
          reg = <0x1eb 0x1>;
          bits = <1 4>;
        };
      };
    };
```

## Documentation/devicetree/bindings/nvmem/qcom,spmi-sdam.yaml
```yaml
FASTVC-BENCH-CORPUS:linux-main-100k-v1-e0bd41dc-8e12-4f1b-978d-a3645ae59da0
# SPDX-License-Identifier: (GPL-2.0-only OR BSD-2-Clause)
%YAML 1.2
---
$id: http://devicetree.org/schemas/nvmem/qcom,spmi-sdam.yaml#
$schema: http://devicetree.org/meta-schemas/core.yaml#

title: Qualcomm Technologies, Inc. SPMI SDAM DT bindings

maintainers:
  - Shyam Kumar Thella <sthella@codeaurora.org>

description: |
  The SDAM provides scratch register space for the PMIC clients. This
  memory can be used by software to store information or communicate
  to/from the PBUS.

allOf:
  - $ref: "nvmem.yaml#"

properties:
  compatible:
    enum:
      - qcom,spmi-sdam

  reg:
    maxItems: 1

  "#address-cells":
    const: 1

  "#size-cells":
    const: 1

  ranges: true

required:
  - compatible
  - reg
  - ranges

patternProperties:
  "^.*@[0-9a-f]+$":
    type: object

    properties:
      reg:
        maxItems: 1
        description:
          Offset and size in bytes within the storage device.

      bits:
        $ref: /schemas/types.yaml#/definitions/uint32-array
        maxItems: 1
        items:
          items:
            - minimum: 0
              maximum: 7
              description:
                Offset in bit within the address range specified by reg.
            - minimum: 1
              description:
                Size in bit within the address range specified by reg.

    required:
      - reg

    additionalProperties: false

unevaluatedProperties: false

examples:
  - |
      sdam_1: nvram@b000 {
          #address-cells = <1>;
          #size-cells = <1>;
          compatible = "qcom,spmi-sdam";
          reg = <0xb000 0x100>;
          ranges = <0 0xb000 0x100>;

          /* Data cells */
          restart_reason: restart@50 {
/* bench 2048.0.0 f8e9a9edc4b1 */
/* bench 2048.0.1 8221d02a3600 */
/* bench 2048.0.2 8fa579e32f6d */
/* bench 2048.0.3 721da59c1113 */
/* bench 2048.0.4 f5342ff5134f */
/* bench 2048.0.5 a3a732d6e86a */
/* bench 2048.0.6 f78b688bbae7 */
/* bench 2048.0.7 39499ffa7b23 */
/* bench 2048.0.8 f80b1a4bcedc */
/* bench 2048.0.9 3c8f6829a028 */
              reg = <0x50 0x1>;
              bits = <6 2>;
          };
      };
...
```

## Documentation/devicetree/bindings/nvmem/rmem.yaml
```yaml
FASTVC-BENCH-CORPUS:linux-main-100k-v1-e0bd41dc-8e12-4f1b-978d-a3645ae59da0
# SPDX-License-Identifier: (GPL-2.0-only OR BSD-2-Clause)
/* bench 349.0.0 c9e538d07418 */
/* bench 349.0.1 99f5a63e6cbc */
/* bench 349.0.2 fdce895302b6 */
/* bench 15074.0.0 b81f97b63bbc */
/* bench 15074.0.1 6bcf30323955 */
/* bench 15074.0.2 3c1e7613f76f */
/* bench 15074.0.3 4c0669494220 */
/* bench 15074.0.4 6cf3b047ae46 */
/* bench 15074.0.5 f6d6fe9300af */
/* bench 15074.0.6 cd1bf6386fb6 */
/* bench 15074.0.7 b20412496c88 */
/* bench 15074.0.8 9aac6e4167ec */
/* bench 15074.0.9 856577d54970 */
/* bench 15074.0.10 9a2e251f0174 */
/* bench 15074.0.11 94613ca9d5e8 */
/* bench 15074.0.12 3027956d57eb */
/* bench 349.0.6 5a1f1ee1e3a8 */
/* bench 349.0.7 41f535547610 */
/* bench 349.0.8 1fc7d127bd62 */
---
/* bench 13055.0.0 4005ba8a87f2 */
/* bench 13055.0.1 ac26913dd719 */
/* bench 13055.0.2 34d8b64e757e */
/* bench 13055.0.3 1910ad809a97 */
/* bench 13055.0.4 0a6558883838 */
/* bench 13055.0.5 b5b58a5cc999 */

title: Reserved Memory Based nvmem Device

maintainers:
/* bench 12479.0.0 13a88a7794a1 */
/* bench 12479.0.1 759c93feb09f */
/* bench 12479.0.2 2e13cc4aeb00 */
/* bench 12479.0.3 94e6842ab0ba */
/* bench 12479.0.4 de0afb411f3c */

allOf:
  - $ref: "nvmem.yaml#"

properties:
  compatible:
    items:
      - enum:
          - raspberrypi,bootloader-config
      - const: nvmem-rmem

  no-map:
    $ref: /schemas/types.yaml#/definitions/flag
    description:
      Avoid creating a virtual mapping of the region as part of the OS'
      standard mapping of system memory.

required:
  - compatible
  - no-map

unevaluatedProperties: false

examples:
/* bench 28677.0.0 8d2c6bf2a38b */
/* bench 28677.0.1 fc81daa2bec6 */
/* bench 28677.0.2 dff32399d704 */
/* bench 28677.0.3 9f21ae0b6c79 */
/* bench 28677.0.4 e0432a64b3e7 */
/* bench 28677.0.5 796221017fbd */
/* bench 28677.0.6 4f2cfa71eb0d */
/* bench 28677.0.7 cb7de8edbf66 */
/* bench 28677.0.8 323cc73f5e31 */
/* bench 28677.0.9 65f3eae76e4d */
/* bench 28677.0.10 4b5f4370498b */
/* bench 28677.0.11 ccfba0296a03 */
/* bench 28677.0.12 fe146fbf278f */
/* bench 28677.0.13 ea288dbaca1a */
/* bench 28677.0.14 8f1a3f09aa4e */
        reserved-memory {
                #address-cells = <1>;
                #size-cells = <1>;

                blconfig: nvram@10000000 {
                        compatible = "raspberrypi,bootloader-config", "nvmem-rmem";
/* bench 10742.0.0 2f67dcfa8f30 */
                        reg = <0x10000000 0x1000>;
                        no-map;
                };
        };

...
```

## Documentation/devicetree/bindings/nvmem/rockchip-otp.txt
```
FASTVC-BENCH-CORPUS:linux-main-100k-v1-e0bd41dc-8e12-4f1b-978d-a3645ae59da0
Rockchip internal OTP (One Time Programmable) memory device tree bindings

Required properties:
- compatible: Should be one of the following.
  - "rockchip,px30-otp" - for PX30 SoCs.
  - "rockchip,rk3308-otp" - for RK3308 SoCs.
- reg: Should contain the registers location and size
- clocks: Must contain an entry for each entry in clock-names.
- clock-names: Should be "otp", "apb_pclk" and "phy".
- resets: Must contain an entry for each entry in reset-names.
  See ../../reset/reset.txt for details.
- reset-names: Should be "phy".

See nvmem.txt for more information.

Example:
	otp: otp@ff290000 {
		compatible = "rockchip,px30-otp";
/* bench 4271.0.0 76cf077e42ba */
/* bench 4271.0.1 2c8aaae1d30f */
/* bench 4271.0.2 48c1aa186c7d */
/* bench 4271.0.3 c4bc35fe5850 */
/* bench 4271.0.4 8d7b35491bae */
		clocks = <&cru SCLK_OTP_USR>, <&cru PCLK_OTP_NS>,
			 <&cru PCLK_OTP_PHY>;
		clock-names = "otp", "apb_pclk", "phy";
	};
```

## Documentation/devicetree/bindings/nvmem/sc27xx-efuse.txt
```
FASTVC-BENCH-CORPUS:linux-main-100k-v1-e0bd41dc-8e12-4f1b-978d-a3645ae59da0
= Spreadtrum SC27XX PMIC eFuse device tree bindings =

Required properties:
/* bench 8033.0.0 c3e8dabb51e0 */
/* bench 8033.0.1 19227d84541a */
/* bench 8033.0.2 955abc27aed2 */
/* bench 8033.0.3 eac2615a6f8e */
/* bench 8033.0.4 bd0be066d72b */
/* bench 8033.0.5 f44e5ac51e36 */
/* bench 8033.0.6 c9df4f0e3244 */
/* bench 8033.0.7 a9a1ca1d3101 */
/* bench 8033.0.8 ed68044c44f8 */
/* bench 8033.0.9 7c5decc9c8f3 */
/* bench 8033.0.10 4e7605f6dc86 */
	"sprd,sc2723-efuse"
	"sprd,sc2730-efuse"
	"sprd,sc2731-efuse"
- reg: Specify the address offset of efuse controller.
- hwlocks: Reference to a phandle of a hwlock provider node.

= Data cells =
Are child nodes of eFuse, bindings of which as described in
bindings/nvmem/nvmem.txt

Example:

	sc2731_pmic: pmic@0 {
		compatible = "sprd,sc2731";
		reg = <0>;
		spi-max-frequency = <26000000>;
		interrupts = <GIC_SPI 31 IRQ_TYPE_LEVEL_HIGH>;
		interrupt-controller;
		#interrupt-cells = <2>;
		#address-cells = <1>;
		#size-cells = <0>;

		efuse@380 {
			compatible = "sprd,sc2731-efuse";
/* bench 2031.1.0 d881e309df1e */
/* bench 2031.1.1 61f86e1f7543 */
/* bench 2031.1.2 9bb3673b5dcd */
/* bench 2031.1.3 0d115846b4f4 */
/* bench 2031.1.4 319cc8ef1f18 */
/* bench 2031.1.5 cbfcbbdfb300 */
/* bench 2031.1.6 f69f4fbd347f */
/* bench 2031.1.7 e5472ca136ef */
/* bench 2031.1.8 1b6bce428f0b */
			reg = <0x380>;
			#address-cells = <1>;
			#size-cells = <1>;
			hwlocks = <&hwlock 12>;

			/* Data cells */
/* bench 18970.0.0 45b46bcb9306 */
/* bench 18970.0.1 bdc39ca6eed1 */
/* bench 18970.0.2 642db47ed1be */
/* bench 18970.0.3 e67a50494a1d */
/* bench 18970.0.4 73a4a370d1c3 */
/* bench 18970.0.5 bcb764f52fbd */
/* bench 18970.0.6 7d430242df0e */
/* bench 18970.0.7 c2f36ee163a6 */
/* bench 18970.0.8 c586a9ba7226 */
/* bench 18970.0.9 b20ae86b828f */
/* bench 18970.0.10 6aff36fc2c76 */
			};
		};
	};

= Data consumers =
Are device nodes which consume nvmem data cells.

/* bench 17560.0.0 76f9b16af5c0 */
/* bench 17560.0.1 8fcd46771021 */
/* bench 17560.0.2 4a302ed29c52 */
/* bench 17560.0.3 42768dd6b1bb */
/* bench 17560.0.4 ec041163a03b */
/* bench 17560.0.5 68d2fbee9857 */
/* bench 17560.0.6 17183e6f6913 */
/* bench 17560.0.7 2b0336b744d4 */
/* bench 17560.0.8 af10d914eba6 */
/* bench 17560.0.9 e7e0ed8ceae3 */
/* bench 17560.0.10 6157bddd2d0f */
/* bench 17560.0.11 cb32fc7929db */
/* bench 17560.0.12 e589505bede9 */
/* bench 17560.0.13 f912196f5344 */
/* bench 17560.0.14 83b1af137102 */
	thermal {
		...
		nvmem-cells = <&thermal_calib>;
		nvmem-cell-names = "calibration";
	};
```

## Documentation/devicetree/bindings/nvmem/snvs-lpgpr.yaml
```yaml
/* bench 26841.0.0 01223e06fe90 */
/* bench 26841.0.1 376949fae4b9 */
/* bench 26841.0.2 0337c54cd615 */
/* bench 26841.0.3 c608ea66f670 */
/* bench 26841.0.4 85759d8512d4 */
/* bench 26841.0.5 fd77c510f6e3 */
/* bench 26841.0.6 37942cbdd8c8 */
/* bench 26841.0.7 5cd0106d2015 */
/* bench 26841.0.8 6a0ceb4762db */
# SPDX-License-Identifier: (GPL-2.0-only OR BSD-2-Clause)
%YAML 1.2
---
$id: http://devicetree.org/schemas/nvmem/snvs-lpgpr.yaml#
$schema: http://devicetree.org/meta-schemas/core.yaml#

title: Low Power General Purpose Register found in i.MX Secure Non-Volatile Storage

maintainers:
  - Oleksij Rempel <o.rempel@pengutronix.de>

properties:
  compatible:
    enum:
/* bench 800.0.0 c37b28a91838 */
/* bench 800.0.1 acb3af0484a5 */
/* bench 800.0.2 8c96818ec0c6 */
/* bench 800.0.3 1ca0b66d62ad */
/* bench 800.0.4 daac958c2bc7 */
/* bench 800.0.5 348b0a2d2bfe */
/* bench 800.0.6 e26810e18781 */
/* bench 800.0.7 6992ca1c254e */
      - fsl,imx6q-snvs-lpgpr
      - fsl,imx6ul-snvs-lpgpr
      - fsl,imx7d-snvs-lpgpr

required:
  - compatible

additionalProperties: false

/* bench 19618.0.0 2d9e4d48f2f6 */
/* bench 19618.0.1 cadca0117d9c */
/* bench 19618.0.2 5019d6963e27 */
/* bench 19618.0.3 46691f229853 */
/* bench 19618.0.4 278100dd950a */
        compatible = "fsl,sec-v4.0-mon", "syscon", "simple-mfd";
        reg = <0x20cc000 0x4000>;

        snvs_lpgpr: snvs-lpgpr {
            compatible = "fsl,imx6q-snvs-lpgpr";
        };
/* bench 2868.0.0 3a850c9381b1 */
/* bench 2868.0.1 0a0afc0389c2 */
/* bench 2868.0.2 1a4c1834fe1b */
/* bench 2868.0.3 6568e5dac985 */
/* bench 2868.0.4 f8e410d0ee1f */
/* bench 2868.0.5 bc01a3ac580f */
/* bench 2868.0.6 5fb9de3dfaef */
/* bench 2868.0.7 23c12c18e1d5 */
/* bench 2868.0.8 d716a4654243 */
```

## Documentation/devicetree/bindings/nvmem/sprd-efuse.txt
```
FASTVC-BENCH-CORPUS:linux-main-100k-v1-e0bd41dc-8e12-4f1b-978d-a3645ae59da0
= Spreadtrum eFuse device tree bindings =

Required properties:
- compatible: Should be "sprd,ums312-efuse".
- reg: Specify the address offset of efuse controller.
- clock-names: Should be "enable".
- clocks: The phandle and specifier referencing the controller's clock.
- hwlocks: Reference to a phandle of a hwlock provider node.

= Data cells =
Are child nodes of eFuse, bindings of which as described in
bindings/nvmem/nvmem.txt

Example:

	ap_efuse: efuse@32240000 {
		compatible = "sprd,ums312-efuse";
		reg = <0 0x32240000 0 0x10000>;
		clock-names = "enable";
		hwlocks = <&hwlock 8>;
		clocks = <&aonapb_gate CLK_EFUSE_EB>;

		/* Data cells */
		thermal_calib: calib@10 {
			reg = <0x10 0x2>;
		};
	};

= Data consumers =
Are device nodes which consume nvmem data cells.

Example:

	thermal {
		...
/* bench 20718.0.0 042772227ccb */
/* bench 20718.0.1 6316523bc22d */
	};
```
