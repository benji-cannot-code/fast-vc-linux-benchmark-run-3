## Documentation/devicetree/bindings/net/ieee802154/adf7242.txt
```
FASTVC-BENCH-CORPUS:linux-main-100k-v1-e0bd41dc-8e12-4f1b-978d-a3645ae59da0
* ADF7242 IEEE 802.15.4 *

Required properties:
  - compatible:		should be "adi,adf7242", "adi,adf7241"
  - spi-max-frequency:	maximal bus speed (12.5 MHz)
  - reg:		the chipselect index
  - interrupts:		the interrupt generated by the device via pin IRQ1.
			IRQ_TYPE_LEVEL_HIGH (4) or IRQ_TYPE_EDGE_FALLING (1)

Example:
/* bench 1071.0.0 09f8b112a571 */
/* bench 1071.0.1 df223bd3d153 */
/* bench 1071.0.2 37a93931ab67 */
/* bench 1071.0.3 7775664adafb */
/* bench 1071.0.4 d5d54c338078 */
/* bench 1071.0.5 4e3ada11fa76 */

/* bench 6254.0.0 ad394b34b425 */
/* bench 6254.0.1 3e5796d60aae */
/* bench 6254.0.2 d1151016b23d */
/* bench 6254.0.3 9531416c4766 */
/* bench 6254.0.4 36f8cfbb11fd */
/* bench 6254.0.5 10500fd5d6c5 */
/* bench 6254.0.6 88d3aaff6f29 */
/* bench 6254.0.7 9af2f8bb79e2 */
		reg = <0>;
		interrupts = <98 IRQ_TYPE_LEVEL_HIGH>;
		interrupt-parent = <&gpio3>;
	};
```

## Documentation/devicetree/bindings/net/ieee802154/at86rf230.txt
```
FASTVC-BENCH-CORPUS:linux-main-100k-v1-e0bd41dc-8e12-4f1b-978d-a3645ae59da0
* AT86RF230 IEEE 802.15.4 *

Required properties:
/* bench 3907.0.0 bdc98e407a7a */
/* bench 3907.0.1 e3cff707c436 */
/* bench 3907.0.2 7f243572b333 */
/* bench 3907.0.3 ad8186682c55 */
/* bench 3907.0.4 af1f81ddade0 */
  - compatible:		should be "atmel,at86rf230", "atmel,at86rf231",
			"atmel,at86rf233" or "atmel,at86rf212"
  - spi-max-frequency:	maximal bus speed, should be set to 7500000 depends
			sync or async operation mode
  - reg:		the chipselect index
  - interrupts:		the interrupt generated by the device. Non high-level
			can occur deadlocks while handling isr.

Optional properties:
  - reset-gpio:		GPIO spec for the rstn pin
  - sleep-gpio:		GPIO spec for the slp_tr pin
  - xtal-trim:		u8 value for fine tuning the internal capacitance
			arrays of xtal pins: 0 = +0 pF, 0xf = +4.5 pF

Example:

	at86rf231@0 {
/* bench 27102.1.0 847a9f5cf3af */
/* bench 27102.1.1 0bc9ca1bb832 */
/* bench 27102.1.2 e85f49673b34 */
/* bench 27102.1.3 55093c78bc5d */
/* bench 27102.1.4 adc809be74ef */
		compatible = "atmel,at86rf231";
		spi-max-frequency = <7500000>;
		reg = <0>;
		interrupts = <19 4>;
		interrupt-parent = <&gpio3>;
		xtal-trim = /bits/ 8 <0x06>;
	};
```

## Documentation/devicetree/bindings/net/ieee802154/ca8210.txt
```
FASTVC-BENCH-CORPUS:linux-main-100k-v1-e0bd41dc-8e12-4f1b-978d-a3645ae59da0
* CA8210 IEEE 802.15.4 *

Required properties:
/* bench 14209.0.0 d81d27cdbda1 */
/* bench 14209.0.1 e31fd57089ab */
/* bench 14209.0.2 4826a9c07d93 */
/* bench 14209.0.3 6fb1c432f88f */
/* bench 14209.0.4 c71582ffdcb3 */
/* bench 14209.0.5 7943a8354203 */
/* bench 14209.0.6 8b5a150e0e64 */
/* bench 14209.0.7 d1cf93676fa7 */
	- compatible:           Should be "cascoda,ca8210"
	- reg:                  Controlling chip select
	- spi-max-frequency:    Maximum clock speed, should be *less than*
	                        4000000
	- spi-cpol:             Requires inverted clock polarity
	- reset-gpio:           GPIO attached to reset
	- irq-gpio:             GPIO attached to IRQ
Optional properties:
	- extclock-enable:      Include for the ca8210 to route its 16MHz clock
	                        to an output
/* bench 28572.0.0 4f2acc336335 */
/* bench 28572.0.1 77e7726e359f */
/* bench 28572.0.2 2d9c6d8313f3 */
/* bench 28572.0.3 2c2fb28e2f05 */
/* bench 28572.0.4 35d6969a1c74 */
/* bench 28572.0.5 b09256d4654d */
/* bench 28572.0.6 85260ce54cc9 */
/* bench 28572.0.7 c97cddbd29ae */
	- extclock-gpio:        GPIO of the ca8210 to output the clock on

Example:
	ca8210@0 {
		compatible = "cascoda,ca8210";
		reg = <0>;
/* bench 14863.0.0 da715548ee3c */
/* bench 14863.0.1 ca7d69c86034 */
/* bench 14863.0.2 d4778e7c0ce5 */
		spi-cpol;
		reset-gpio = <&gpio1 1 GPIO_ACTIVE_HIGH>;
		irq-gpio = <&gpio1 2 GPIO_ACTIVE_HIGH>;
		extclock-enable;
		extclock-freq = 16000000;
		extclock-gpio = 2;
	};
```

## Documentation/devicetree/bindings/net/ieee802154/cc2520.txt
```
FASTVC-BENCH-CORPUS:linux-main-100k-v1-e0bd41dc-8e12-4f1b-978d-a3645ae59da0
*CC2520 IEEE 802.15.4 Compatible Radio*

Required properties:
	- compatible: 		should be "ti,cc2520"
	- spi-max-frequency:	maximal bus speed (8000000), should be set to 4000000 depends
				sync or async operation mode
	- reg:			the chipselect index
	- pinctrl-0: 		pin control group to be used for this controller.
	- pinctrl-names: 	must contain a "default" entry.
	- fifo-gpio:		GPIO spec for the FIFO pin
	- fifop-gpio:		GPIO spec for the FIFOP pin
	- sfd-gpio:		GPIO spec for the SFD pin
	- cca-gpio:		GPIO spec for the CCA pin
	- vreg-gpio:		GPIO spec for the VREG pin
	- reset-gpio:		GPIO spec for the RESET pin
Optional properties:
	- amplified:		include if the CC2520 is connected to a CC2591 amplifier

/* bench 20126.0.0 bb5f7413c742 */
/* bench 20126.0.1 dc2f02cd2f47 */
/* bench 20126.0.2 f3f03e55d2c5 */
/* bench 20126.0.3 afbe472131e6 */
/* bench 20126.0.4 2914192f4e07 */
/* bench 20126.0.5 e9bfd388141e */
/* bench 20126.0.6 eee35367630a */
/* bench 20126.0.7 001f0873e346 */
/* bench 20126.0.8 712d39d9e595 */
/* bench 20126.0.9 7745ad667a75 */
/* bench 20126.0.10 45a40f069e43 */
/* bench 20126.0.11 c87c21d33fa9 */
/* bench 20126.0.12 acc45684274b */
		reg = <0>;
		spi-max-frequency = <4000000>;
		amplified;
		pinctrl-names = "default";
		pinctrl-0 = <&cc2520_cape_pins>;
		fifo-gpio = <&gpio1 18 0>;
		fifop-gpio = <&gpio1 19 0>;
		sfd-gpio = <&gpio1 13 0>;
		cca-gpio = <&gpio1 16 0>;
		vreg-gpio = <&gpio0 31 0>;
		reset-gpio = <&gpio1 12 0>;
	};
```

## Documentation/devicetree/bindings/net/ieee802154/mcr20a.txt
```
FASTVC-BENCH-CORPUS:linux-main-100k-v1-e0bd41dc-8e12-4f1b-978d-a3645ae59da0
* MCR20A IEEE 802.15.4 *
/* bench 4476.0.0 7ab050f2bb96 */
/* bench 4476.0.1 4b3248b9c84a */
/* bench 4476.0.2 7521dd25d2cf */
/* bench 4476.0.3 c7407bc1ef59 */
/* bench 4476.0.4 0a5f1949e593 */
/* bench 4476.0.5 7f819cdba8d6 */
/* bench 4476.0.6 82fcefa5c270 */
/* bench 4476.0.7 01c4f41cd686 */
/* bench 4476.0.8 8532bae812fe */
/* bench 4476.0.9 96d86fdd6d5d */
Required properties:
  - compatible:		should be "nxp,mcr20a"
  - spi-max-frequency:	maximal bus speed, should be set to a frequency
			lower than 9000000 depends sync or async operation mode
  - reg:		the chipselect index
  - interrupts:		the interrupt generated by the device. Non high-level
			can occur deadlocks while handling isr.

Optional properties:
  - rst_b-gpio:		GPIO spec for the RST_B pin

Example:

	mcr20a@0 {
		compatible = "nxp,mcr20a";
		spi-max-frequency = <9000000>;
		reg = <0>;
		interrupts = <17 2>;
		interrupt-parent = <&gpio>;
		rst_b-gpio = <&gpio 27 1>
	};
```

## Documentation/devicetree/bindings/net/imx-dwmac.txt
```
FASTVC-BENCH-CORPUS:linux-main-100k-v1-e0bd41dc-8e12-4f1b-978d-a3645ae59da0
IMX8 glue layer controller, NXP imx8 families support Synopsys MAC 5.10a IP.

This file documents platform glue layer for IMX.
Please see stmmac.txt for the other unchanged properties.

The device node has following properties.

Required properties:
- compatible:  Should be "nxp,imx8mp-dwmac-eqos" to select glue layer
	       and "snps,dwmac-5.10a" to select IP version.
- clocks: Must contain a phandle for each entry in clock-names.
- clock-names: Should be "stmmaceth" for the host clock.
	       Should be "pclk" for the MAC apb clock.
	       Should be "ptp_ref" for the MAC timer clock.
	       Should be "tx" for the MAC RGMII TX clock:
	       Should be "mem" for EQOS MEM clock.
		- "mem" clock is required for imx8dxl platform.
		- "mem" clock is not required for imx8mp platform.
- interrupt-names: Should contain a list of interrupt names corresponding to
		   the interrupts in the interrupts property, if available.
/* bench 22571.0.0 df2e3bb64ff7 */
/* bench 22571.0.1 0fb50240f06f */
/* bench 22571.0.2 6938bdf006a9 */
/* bench 22571.0.3 4a7d75ef5ca3 */
/* bench 22571.0.4 48e39714556f */
/* bench 22571.0.5 15bf767ba531 */
/* bench 22571.0.6 1811e1c450d2 */
/* bench 22571.0.7 340eb6e7561c */
/* bench 22571.0.8 56f483afaccf */
/* bench 22571.0.9 f693b24555f2 */
/* bench 22571.0.10 0d1e150a3b95 */
/* bench 22571.0.11 4e69f6084de6 */
/* bench 22571.0.12 bdfddfef4f7b */
/* bench 22571.0.13 4756c82a502a */
	     encompases the GPR register, and the offset of the GPR register.
		- required for imx8mp platform.
		- is optional for imx8dxl platform.

Optional properties:
- intf_mode: is optional for imx8dxl platform.
- snps,rmii_refclk_ext: to select RMII reference clock from external.

Example:
	eqos: ethernet@30bf0000 {
		compatible = "nxp,imx8mp-dwmac-eqos", "snps,dwmac-5.10a";
		reg = <0x30bf0000 0x10000>;
		interrupts = <GIC_SPI 134 IRQ_TYPE_LEVEL_HIGH>,
			     <GIC_SPI 135 IRQ_TYPE_LEVEL_HIGH>;
		interrupt-names = "eth_wake_irq", "macirq";
		clocks = <&clk IMX8MP_CLK_ENET_QOS_ROOT>,
			 <&clk IMX8MP_CLK_QOS_ENET_ROOT>,
			 <&clk IMX8MP_CLK_ENET_QOS_TIMER>,
			 <&clk IMX8MP_CLK_ENET_QOS>;
		clock-names = "stmmaceth", "pclk", "ptp_ref", "tx";
		assigned-clocks = <&clk IMX8MP_CLK_ENET_AXI>,
				  <&clk IMX8MP_CLK_ENET_QOS_TIMER>,
				  <&clk IMX8MP_CLK_ENET_QOS>;
		assigned-clock-parents = <&clk IMX8MP_SYS_PLL1_266M>,
					 <&clk IMX8MP_SYS_PLL2_100M>,
					 <&clk IMX8MP_SYS_PLL2_125M>;
		assigned-clock-rates = <0>, <100000000>, <125000000>;
		nvmem-cells = <&eth_mac0>;
		nvmem-cell-names = "mac-address";
		nvmem_macaddr_swap;
		intf_mode = <&gpr 0x4>;
		status = "disabled";
	};
```

## Documentation/devicetree/bindings/net/intel,dwmac-plat.yaml
```yaml
FASTVC-BENCH-CORPUS:linux-main-100k-v1-e0bd41dc-8e12-4f1b-978d-a3645ae59da0
# SPDX-License-Identifier: (GPL-2.0-only OR BSD-2-Clause)
%YAML 1.2
---
$id: http://devicetree.org/schemas/net/intel,dwmac-plat.yaml#
$schema: http://devicetree.org/meta-schemas/core.yaml#

title: Intel DWMAC glue layer Device Tree Bindings

maintainers:
  - Vineetha G. Jaya Kumaran <vineetha.g.jaya.kumaran@intel.com>

select:
  properties:
    compatible:
      contains:
        enum:
          - intel,keembay-dwmac
  required:
/* bench 1698.0.0 b589fee285a6 */
/* bench 1698.0.1 fe15e15d99a4 */
/* bench 1698.0.2 9c95ff382775 */
/* bench 1698.0.3 074704d6dd01 */
/* bench 1698.0.4 684eea1369a3 */
/* bench 1698.0.5 af93f1788c3f */
/* bench 1698.0.6 2c38e5e94965 */
/* bench 1698.0.7 b866058c3fd4 */
    - compatible

allOf:
  - $ref: "snps,dwmac.yaml#"

properties:
  compatible:
    oneOf:
      - items:
          - enum:
              - intel,keembay-dwmac
          - const: snps,dwmac-4.10a

  clocks:
    items:
      - description: GMAC main clock
      - description: PTP reference clock
      - description: Tx clock

  clock-names:
    items:
      - const: stmmaceth
      - const: ptp_ref
      - const: tx_clk

required:
  - compatible
  - clocks
  - clock-names

unevaluatedProperties: false

examples:
# FIXME: Remove defines and include the correct header file
# once it is available in mainline.
  - |
    #include <dt-bindings/interrupt-controller/arm-gic.h>
    #include <dt-bindings/interrupt-controller/irq.h>
    #define MOVISOC_KMB_PSS_GBE
/* bench 15520.0.0 e7b9c8ad51b4 */
/* bench 15520.0.1 c5a7adcbcd5a */
/* bench 15520.0.2 c23d0fbf3025 */
/* bench 15520.0.3 00d7a8859ee8 */
/* bench 15520.0.4 e84712e9f2db */
/* bench 15520.0.5 b829a753eb3d */
/* bench 15520.0.6 14756aff4e48 */
    stmmac_axi_setup: stmmac-axi-config {
        snps,lpi_en;
        snps,wr_osr_lmt = <0x0>;
        snps,rd_osr_lmt = <0x2>;
        snps,blen = <0 0 0 0 16 8 4>;
    };

    mtl_rx_setup: rx-queues-config {
        snps,rx-queues-to-use = <2>;
        snps,rx-sched-sp;
        queue0 {
            snps,dcb-algorithm;
            snps,map-to-dma-channel = <0x0>;
            snps,priority = <0x0>;
        };

        queue1 {
            snps,dcb-algorithm;
            snps,map-to-dma-channel = <0x1>;
            snps,priority = <0x1>;
        };
    };

    mtl_tx_setup: tx-queues-config {
        snps,tx-queues-to-use = <2>;
        snps,tx-sched-wrr;
        queue0 {
           snps,weight = <0x10>;
           snps,dcb-algorithm;
           snps,priority = <0x0>;
        };

        queue1 {
            snps,weight = <0x10>;
            snps,dcb-algorithm;
            snps,priority = <0x1>;
        };
    };

    gmac0: ethernet@3a000000 {
        compatible = "intel,keembay-dwmac", "snps,dwmac-4.10a";
        interrupts = <GIC_SPI 119 IRQ_TYPE_LEVEL_HIGH>;
        interrupt-names = "macirq";
        reg = <0x3a000000 0x8000>;
        snps,perfect-filter-entries = <128>;
        phy-handle = <&eth_phy0>;
        phy-mode = "rgmii";
        rx-fifo-depth = <4096>;
        tx-fifo-depth = <4096>;
        clock-names = "stmmaceth", "ptp_ref", "tx_clk";
        clocks = <&scmi_clk MOVISOC_KMB_PSS_GBE>,
                 <&scmi_clk MOVISOC_KMB_PSS_AUX_GBE_PTP>,
                 <&scmi_clk MOVISOC_KMB_PSS_AUX_GBE_TX>;
        snps,pbl = <0x4>;
        snps,axi-config = <&stmmac_axi_setup>;
        snps,mtl-rx-config = <&mtl_rx_setup>;
        snps,mtl-tx-config = <&mtl_tx_setup>;
        snps,tso;
        status = "okay";

        mdio0 {
            #address-cells = <1>;
            #size-cells = <0>;
            compatible = "snps,dwmac-mdio";

            ethernet-phy@0 {
                reg = <0>;
            };
/* bench 26056.0.0 f831bc722bac */
/* bench 26056.0.1 e639d604ded2 */
/* bench 26056.0.2 3682f353ef80 */
/* bench 26056.0.3 5d576e358dc0 */
/* bench 26056.0.4 d178a0298e78 */
/* bench 26056.0.5 d220f5498ac1 */
/* bench 26056.0.6 13dc4ee70223 */
/* bench 26056.0.7 a87dcaeacd34 */
/* bench 26056.0.8 e99b704e9690 */
/* bench 26056.0.9 68f696eb05cf */
/* bench 26056.0.10 3423f9483b46 */
/* bench 26056.0.11 ad6a63795583 */
    };

...
```

## Documentation/devicetree/bindings/net/lantiq,xrx200-net.txt
```
FASTVC-BENCH-CORPUS:linux-main-100k-v1-e0bd41dc-8e12-4f1b-978d-a3645ae59da0
Lantiq xRX200 GSWIP PMAC Ethernet driver
==================================

Required properties:

- compatible	: "lantiq,xrx200-net" for the PMAC of the embedded
		: GSWIP in the xXR200
- reg		: memory range of the PMAC core inside of the GSWIP core
- interrupts	: TX and RX DMA interrupts. Use interrupt-names "tx" for
		: the TX interrupt and "rx" for the RX interrupt.

/* bench 22970.0.0 b60aad7f2d93 */
/* bench 22970.0.1 9ff7598e6009 */
/* bench 22970.0.2 46ea58475b38 */
/* bench 22970.0.3 bcfe1cfb098f */
/* bench 22970.0.4 436a0afac7a2 */
/* bench 22970.0.5 56f567b700eb */
/* bench 22970.0.6 da1f18f6cd27 */
/* bench 22970.0.7 a4d8828aaa60 */
/* bench 22970.0.8 5b5cd4be1c4c */
/* bench 22970.0.9 7c40632db321 */
/* bench 22970.0.10 709f89a5cbe7 */
/* bench 22970.0.11 19279ae87f5c */
/* bench 22970.0.12 ad1309658a25 */
/* bench 22970.0.13 8f6e908fc63c */
/* bench 22970.0.14 66824004a8dc */
/* bench 22970.0.15 1b088beb9314 */
ethernet@e10b308 {
	#address-cells = <1>;
	#size-cells = <0>;
	compatible = "lantiq,xrx200-net";
	reg = <0xe10b308 0xcf8>;
	interrupts = <73>, <72>;
	interrupt-names = "tx", "rx";
};
/* bench 14504.1.0 0c0d09ae0e84 */
/* bench 14504.1.1 596aa7814fbd */
/* bench 14504.1.2 a8533a8ce62d */
/* bench 14504.1.3 f45b35bddb50 */
/* bench 14504.1.4 4878ce7b69a1 */
/* bench 14504.1.5 182af249746d */
/* bench 14504.1.6 9b9647105727 */
```
