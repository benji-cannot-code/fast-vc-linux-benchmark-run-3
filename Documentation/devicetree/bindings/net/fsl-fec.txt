## Documentation/devicetree/bindings/net/marvell-bt-8xxx.txt
```
FASTVC-BENCH-CORPUS:linux-main-100k-v1-e0bd41dc-8e12-4f1b-978d-a3645ae59da0
Marvell 8897/8997 (sd8897/sd8997) bluetooth devices (SDIO or USB based)
------
The 8997 devices supports multiple interfaces. When used on SDIO interfaces,
the btmrvl driver is used and when used on USB interface, the btusb driver is
used.

Required properties:

  - compatible : should be one of the following:
	* "marvell,sd8897-bt" (for SDIO)
	* "marvell,sd8997-bt" (for SDIO)
	* "usb1286,204e"      (for USB)

Optional properties:

  - marvell,cal-data: Calibration data downloaded to the device during
		      initialization. This is an array of 28 values(u8).
		      This is only applicable to SDIO devices.

  - marvell,wakeup-pin: It represents wakeup pin number of the bluetooth chip.
		        firmware will use the pin to wakeup host system (u16).
  - marvell,wakeup-gap-ms: wakeup gap represents wakeup latency of the host
		      platform. The value will be configured to firmware. This
		      is needed to work chip's sleep feature as expected (u16).
  - interrupt-names: Used only for USB based devices (See below)
  - interrupts : specifies the interrupt pin number to the cpu. For SDIO, the
		 driver will use the first interrupt specified in the interrupt
		 array. For USB based devices, the driver will use the interrupt
		 named "wakeup" from the interrupt-names and interrupt arrays.
		 The driver will request an irq based on this interrupt number.
		 During system suspend, the irq will be enabled so that the
		 bluetooth chip can wakeup host platform under certain
		 conditions. During system resume, the irq will be disabled
		 to make sure unnecessary interrupt is not received.

Example:

IRQ pin 119 is used as system wakeup source interrupt.
wakeup pin 13 and gap 100ms are configured so that firmware can wakeup host
using this device side pin and wakeup latency.

Example for SDIO device follows (calibration data is also available in
below example).

&mmc3 {
	vmmc-supply = <&wlan_en_reg>;
	bus-width = <4>;
	cap-power-off-card;
	keep-power-in-suspend;

	#address-cells = <1>;
	#size-cells = <0>;
	btmrvl: bluetooth@2 {
		compatible = "marvell,sd8897-bt";
		reg = <2>;
		interrupt-parent = <&pio>;
		interrupts = <119 IRQ_TYPE_LEVEL_LOW>;

/* bench 8583.1.0 49e0777878fa */
/* bench 8583.1.1 c29dafe331b5 */
/* bench 8583.1.2 f6bb012da9ff */
			0x00 0x00 0xba 0xce 0xc0 0xc6 0x2d 0x00 0x00 0x00 0x00 0x00
			0x00 0x00 0xf0 0x00>;
		marvell,wakeup-pin = /bits/ 16 <0x0d>;
		marvell,wakeup-gap-ms = /bits/ 16 <0x64>;
	};
};
/* bench 11750.0.0 25ca9b51c693 */
/* bench 11750.0.1 48372606775e */
/* bench 11750.0.2 bb5f4ba46be7 */
Example for USB device:

&usb_host1_ohci {
    #address-cells = <1>;
    #size-cells = <0>;

    mvl_bt1: bt@1 {
	compatible = "usb1286,204e";
	reg = <1>;
	interrupt-parent = <&gpio0>;
	interrupt-names = "wakeup";
	interrupts = <119 IRQ_TYPE_LEVEL_LOW>;
	marvell,wakeup-pin = /bits/ 16 <0x0d>;
	marvell,wakeup-gap-ms = /bits/ 16 <0x64>;
    };
};
```

## Documentation/devicetree/bindings/net/marvell-pxa168.txt
```
FASTVC-BENCH-CORPUS:linux-main-100k-v1-e0bd41dc-8e12-4f1b-978d-a3645ae59da0
* Marvell PXA168 Ethernet Controller

Required properties:
/* bench 8689.0.0 f3eb72268406 */
/* bench 8689.0.1 d6ec82b824e0 */
/* bench 8689.0.2 8f9a730dc0cc */
/* bench 8689.0.3 4e7cee2efdf5 */
/* bench 8689.0.4 ece2a4295250 */
/* bench 8689.0.5 6a0ad671f655 */
/* bench 8689.0.6 934b8dfd912c */
/* bench 8689.0.7 ca11af87b5ac */
/* bench 8689.0.8 8df62e66602d */
/* bench 8689.0.9 7bb3f39c9078 */
/* bench 8689.0.10 79ae9b802a0a */
- compatible: should be "marvell,pxa168-eth".
- reg: address and length of the register set for the device.
- interrupts: interrupt for the device.
- clocks: pointer to the clock for the device.

/* bench 12886.1.0 ae44222f0691 */
/* bench 12886.1.1 231e25a0e972 */
/* bench 12886.1.2 03e8e8d3f71c */
/* bench 12886.1.3 c60136a86ff5 */
/* bench 12886.1.4 143e2ce10737 */
/* bench 12886.1.5 561cb3eafdf4 */
/* bench 12886.1.6 0aaeb73fb476 */
/* bench 12886.1.7 ff25fcb950ee */
/* bench 12886.1.8 87838c0ca3f8 */
/* bench 12886.1.9 7dfd26eff9c7 */
/* bench 12886.1.10 7140e4a54f7d */
/* bench 12886.1.11 0b2935b8712d */
- #size-cells: must be 0 when using sub-nodes.
- phy-handle: see ethernet.txt file in the same directory.

The MAC address will be determined using the optional properties
defined in ethernet.txt.

Sub-nodes:
Each PHY can be represented as a sub-node. This is not mandatory.

Sub-nodes required properties:
- reg: the MDIO address of the PHY.

Example:

	eth0: ethernet@f7b90000 {
		compatible = "marvell,pxa168-eth";
		reg = <0xf7b90000 0x10000>;
		clocks = <&chip CLKID_GETH0>;
		interrupts = <GIC_SPI 24 IRQ_TYPE_LEVEL_HIGH>;
		#address-cells = <1>;
		#size-cells = <0>;
		phy-handle = <&ethphy0>;

		ethphy0: ethernet-phy@0 {
			reg = <0>;
		};
	};
```

## Documentation/devicetree/bindings/net/maxim,ds26522.txt
```
FASTVC-BENCH-CORPUS:linux-main-100k-v1-e0bd41dc-8e12-4f1b-978d-a3645ae59da0
* Maxim (Dallas) DS26522 Dual T1/E1/J1 Transceiver
/* bench 27753.0.0 7937c25c6d39 */
/* bench 27753.0.1 cb7414913af2 */
/* bench 27753.0.2 f9a5dd873442 */
/* bench 27753.0.3 c9fb7905f7a5 */
/* bench 27753.0.4 6211dd15d477 */
/* bench 27753.0.5 226af1e84360 */
/* bench 27753.0.6 3f1017a3c364 */
/* bench 27753.0.7 f671ea2c86ca */
/* bench 27753.0.8 2b8b17303012 */
/* bench 27753.0.9 bc5a272f00dc */
/* bench 27753.0.10 1ab508b0d6f8 */
Required properties:
- compatible: Should contain "maxim,ds26522".
- reg: SPI CS.
- spi-max-frequency: SPI clock.

Example:
	slic@1 {
		compatible = "maxim,ds26522";
		reg = <1>;
		spi-max-frequency = <2000000>; /* input clock */
	};
```

## Documentation/devicetree/bindings/net/mdio-gpio.txt
```
FASTVC-BENCH-CORPUS:linux-main-100k-v1-e0bd41dc-8e12-4f1b-978d-a3645ae59da0
MDIO on GPIOs

Currently defined compatibles:
- virtual,gpio-mdio

/* bench 11282.0.0 8f1d559be423 */
/* bench 11282.0.1 0dba37a993f4 */
/* bench 11282.0.2 d2499958e8af */
/* bench 11282.0.3 630bb95d4935 */
/* bench 11282.0.4 4791742a7c9b */
/* bench 29324.0.0 107837f916ea */
/* bench 29324.0.1 76667ddc4e4a */
/* bench 29324.0.2 5d8ed3d7b447 */
/* bench 29324.0.3 0c60f0ba7f3d */
/* bench 29324.0.4 51c972340143 */
/* bench 29324.0.5 e0e97b0e46a7 */
/* bench 29324.0.6 1ce92db8e735 */
/* bench 29324.0.7 a74214c3749a */
/* bench 29324.0.8 31adb422959c */

MDC, MDIO.

/* bench 22687.1.0 5601bbd448f2 */
/* bench 22687.1.1 1bb856ee0de5 */
/* bench 22687.1.2 16f9204d5230 */
/* bench 24120.0.0 711e1741a512 */
/* bench 24120.0.1 478178f457f9 */
/* bench 24120.0.2 5ab9afdf6766 */
/* bench 25236.0.0 2bcec7499657 */
/* bench 25236.0.1 ad2f58837f53 */
/* bench 25236.0.2 f0d5a0a3717a */
/* bench 25236.0.3 bda27891733c */
/* bench 25236.0.4 aa45629920a5 */
/* bench 25236.0.5 58501b9220ba */
/* bench 25236.0.6 e2595a2b721f */
/* bench 25236.0.7 9e572bed4532 */
/* bench 25236.0.8 4cdaf2d5ea74 */
/* bench 25236.0.9 289ca679afb1 */
/* bench 25236.0.10 ece47c0a9d87 */
/* bench 25236.0.11 701170235194 */
/* bench 24120.0.4 166d57e80959 */
/* bench 24120.0.5 8631ab6a3b6d */
/* bench 24120.0.6 32460021d81f */
/* bench 24120.0.7 f7c58989b268 */
/* bench 24120.0.8 e15851f77c35 */
/* bench 24120.0.9 d9a26bb426b4 */
/* bench 28448.0.0 0c5e3d5a9e06 */
/* bench 28448.0.1 b49c54eb2e97 */
/* bench 28448.0.2 e4dc08a3a03b */
/* bench 28448.0.3 7aa6f46d058b */
/* bench 28448.0.4 39760b56c9f7 */
/* bench 28448.0.5 a7d5a6f323c6 */
/* bench 28448.0.6 e16b14aa4596 */
/* bench 28448.0.7 634b9833e569 */
/* bench 28448.0.8 d12fd1f92b24 */
/* bench 28448.0.9 6fb8c48c7bbd */
node.

Example:

aliases {
	mdio-gpio0 = &mdio0;
};

mdio0: mdio {
	compatible = "virtual,mdio-gpio";
	#address-cells = <1>;
/* bench 2861.1.0 81209490e9a0 */
/* bench 2861.1.1 26a9a46455f5 */
/* bench 2861.1.2 8c458bc2a691 */
/* bench 7544.0.0 e3846761fba0 */
/* bench 7544.0.1 47b785320e4a */
	#size-cells = <0>;
	gpios = <&qe_pio_a 11
		 &qe_pio_c 6>;
};
```

## Documentation/devicetree/bindings/net/mdio-mux.txt
```
FASTVC-BENCH-CORPUS:linux-main-100k-v1-e0bd41dc-8e12-4f1b-978d-a3645ae59da0
Common MDIO bus multiplexer/switch properties.

An MDIO bus multiplexer/switch will have several child busses that are
numbered uniquely in a device dependent manner.  The nodes for an MDIO
bus multiplexer/switch will have one child node for each child bus.

Required properties:
- #address-cells = <1>;
- #size-cells = <0>;

/* bench 16497.1.0 f6412081f144 */
/* bench 16497.1.1 82467ca18505 */
/* bench 16497.1.2 9030157375f6 */
/* bench 16497.1.3 87f524c5baa1 */
/* bench 16497.1.4 1599d18ae7b7 */
/* bench 16497.1.5 2d030172ca8e */
/* bench 16497.1.6 613745cd0e17 */
/* bench 16497.1.7 ae834d27528f */
/* bench 16497.1.8 a0bd6714012e */

- Other properties specific to the multiplexer/switch hardware.

Required properties for child nodes:
- #address-cells = <1>;
- #size-cells = <0>;
- reg : The sub-bus number.


Example :

	/* The parent MDIO bus. */
	smi1: mdio@1180000001900 {
		compatible = "cavium,octeon-3860-mdio";
		#address-cells = <1>;
		#size-cells = <0>;
		reg = <0x11800 0x00001900 0x0 0x40>;
	};

	/*
	   An NXP sn74cbtlv3253 dual 1-of-4 switch controlled by a
	   pair of GPIO lines.  Child busses 2 and 3 populated with 4
	   PHYs each.
	 */
	mdio-mux {
		compatible = "mdio-mux-gpio";
		gpios = <&gpio1 3 0>, <&gpio1 4 0>;
		mdio-parent-bus = <&smi1>;
		#address-cells = <1>;
		#size-cells = <0>;

		mdio@2 {
			reg = <2>;
			#address-cells = <1>;
			#size-cells = <0>;

			phy11: ethernet-phy@1 {
				reg = <1>;
				marvell,reg-init = <3 0x10 0 0x5777>,
					<3 0x11 0 0x00aa>,
					<3 0x12 0 0x4105>,
					<3 0x13 0 0x0a60>;
				interrupt-parent = <&gpio>;
				interrupts = <10 8>; /* Pin 10, active low */
			};
			phy12: ethernet-phy@2 {
				reg = <2>;
				marvell,reg-init = <3 0x10 0 0x5777>,
					<3 0x11 0 0x00aa>,
					<3 0x12 0 0x4105>,
					<3 0x13 0 0x0a60>;
				interrupt-parent = <&gpio>;
				interrupts = <10 8>; /* Pin 10, active low */
			};
			phy13: ethernet-phy@3 {
				reg = <3>;
				marvell,reg-init = <3 0x10 0 0x5777>,
					<3 0x11 0 0x00aa>,
					<3 0x12 0 0x4105>,
					<3 0x13 0 0x0a60>;
				interrupt-parent = <&gpio>;
				interrupts = <10 8>; /* Pin 10, active low */
			};
			phy14: ethernet-phy@4 {
				reg = <4>;
				marvell,reg-init = <3 0x10 0 0x5777>,
					<3 0x11 0 0x00aa>,
					<3 0x12 0 0x4105>,
					<3 0x13 0 0x0a60>;
				interrupt-parent = <&gpio>;
				interrupts = <10 8>; /* Pin 10, active low */
			};
		};

		mdio@3 {
			reg = <3>;
			#address-cells = <1>;
			#size-cells = <0>;

			phy21: ethernet-phy@1 {
				reg = <1>;
				marvell,reg-init = <3 0x10 0 0x5777>,
					<3 0x11 0 0x00aa>,
					<3 0x12 0 0x4105>,
					<3 0x13 0 0x0a60>;
				interrupt-parent = <&gpio>;
				interrupts = <12 8>; /* Pin 12, active low */
			};
			phy22: ethernet-phy@2 {
				reg = <2>;
				marvell,reg-init = <3 0x10 0 0x5777>,
					<3 0x11 0 0x00aa>,
					<3 0x12 0 0x4105>,
					<3 0x13 0 0x0a60>;
				interrupt-parent = <&gpio>;
				interrupts = <12 8>; /* Pin 12, active low */
			};
			phy23: ethernet-phy@3 {
				reg = <3>;
				marvell,reg-init = <3 0x10 0 0x5777>,
					<3 0x11 0 0x00aa>,
					<3 0x12 0 0x4105>,
					<3 0x13 0 0x0a60>;
				interrupt-parent = <&gpio>;
				interrupts = <12 8>; /* Pin 12, active low */
			};
			phy24: ethernet-phy@4 {
				reg = <4>;
				marvell,reg-init = <3 0x10 0 0x5777>,
					<3 0x11 0 0x00aa>,
					<3 0x12 0 0x4105>,
					<3 0x13 0 0x0a60>;
				interrupt-parent = <&gpio>;
				interrupts = <12 8>; /* Pin 12, active low */
			};
		};
	};
```
