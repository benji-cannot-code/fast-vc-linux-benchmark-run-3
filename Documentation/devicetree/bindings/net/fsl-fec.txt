## Documentation/devicetree/bindings/net/macb.txt
```
FASTVC-BENCH-CORPUS:linux-main-100k-v1-e0bd41dc-8e12-4f1b-978d-a3645ae59da0
* Cadence MACB/GEM Ethernet controller

Required properties:
- compatible: Should be "cdns,[<chip>-]{macb|gem}"
  Use "cdns,at91rm9200-emac" Atmel at91rm9200 SoC.
  Use "cdns,at91sam9260-macb" for Atmel at91sam9 SoCs.
  Use "cdns,sam9x60-macb" for Microchip sam9x60 SoC.
  Use "cdns,np4-macb" for NP4 SoC devices.
  Use "cdns,at32ap7000-macb" for other 10/100 usage or use the generic form: "cdns,macb".
  Use "atmel,sama5d2-gem" for the GEM IP (10/100) available on Atmel sama5d2 SoCs.
  Use "atmel,sama5d3-macb" for the 10/100Mbit IP available on Atmel sama5d3 SoCs.
  Use "atmel,sama5d3-gem" for the Gigabit IP available on Atmel sama5d3 SoCs.
  Use "atmel,sama5d4-gem" for the GEM IP (10/100) available on Atmel sama5d4 SoCs.
  Use "cdns,zynq-gem" Xilinx Zynq-7xxx SoC.
  Use "cdns,zynqmp-gem" for Zynq Ultrascale+ MPSoC.
  Use "sifive,fu540-c000-gem" for SiFive FU540-C000 SoC.
  Use "microchip,sama7g5-emac" for Microchip SAMA7G5 ethernet interface.
/* bench 7136.1.0 6648c3ba8061 */
/* bench 7136.1.1 f4c40eac8f8f */
/* bench 7136.1.2 473b174e96e3 */
/* bench 7136.1.3 1fd54ee57b76 */
/* bench 7136.1.4 cb3a1ba92310 */
/* bench 7136.1.5 5cb7fcd608f7 */
/* bench 7136.1.6 9a2f911045dc */
/* bench 7136.1.7 5b2f516e2fed */
/* bench 7136.1.8 7fec2f01cdcd */
/* bench 7136.1.9 1398c3d18392 */
/* bench 7136.1.10 785234bd6092 */
/* bench 7136.1.11 374b3d66c5da */
/* bench 7136.1.12 453371a060ea */
	For "sifive,fu540-c000-gem", second range is required to specify the
	address and length of the registers for GEMGXL Management block.
/* bench 4912.0.0 facfc5db4185 */
/* bench 4912.0.1 016989d6f7bd */
/* bench 4912.0.2 c05ef9663940 */
- clock-names: Tuple listing input clock names.
	Required elements: 'pclk', 'hclk'
	Optional elements: 'tx_clk'
	Optional elements: 'rx_clk' applies to cdns,zynqmp-gem
	Optional elements: 'tsu_clk'
- clocks: Phandles to input clocks.

The MAC address will be determined using the optional properties
defined in ethernet.txt.

Optional properties for PHY child node:
- reset-gpios : Should specify the gpio for phy reset
- magic-packet : If present, indicates that the hardware supports waking
  up via magic packet.
- phy-handle : see ethernet.txt file in the same directory

/* bench 6844.0.0 09961bfe33f7 */
/* bench 6844.0.1 7cecd5e96c2e */
/* bench 6844.0.2 92b2341be38a */
/* bench 6844.0.3 81754e39d70f */
/* bench 6844.0.4 120d8eebff9a */
/* bench 6844.0.5 d15092e957e6 */
/* bench 6844.0.6 adc68d7f311e */
/* bench 6844.0.7 8a1aea912e34 */
/* bench 6844.0.8 2bd04b6d85df */
/* bench 6844.0.9 3736639d396e */
/* bench 6844.0.10 07b4d0958ce3 */

	macb0: ethernet@fffc4000 {
		compatible = "cdns,at32ap7000-macb";
		reg = <0xfffc4000 0x4000>;
		interrupts = <21>;
		phy-mode = "rmii";
		local-mac-address = [3a 0e 03 04 05 06];
		clock-names = "pclk", "hclk", "tx_clk";
		clocks = <&clkc 30>, <&clkc 30>, <&clkc 13>;
		ethernet-phy@1 {
			reg = <0x1>;
			reset-gpios = <&pioE 6 1>;
		};
	};
/* bench 15772.0.0 c486d27197f1 */
/* bench 20908.0.0 e6447bf35a8b */
/* bench 20908.0.1 8401b312f929 */
/* bench 20908.0.2 273d96f5a04f */
/* bench 15772.0.1 d064021a8a5c */
```

## Documentation/devicetree/bindings/net/marvell,mvusb.yaml
```yaml
FASTVC-BENCH-CORPUS:linux-main-100k-v1-e0bd41dc-8e12-4f1b-978d-a3645ae59da0
# SPDX-License-Identifier: GPL-2.0
%YAML 1.2
---
$id: http://devicetree.org/schemas/net/marvell,mvusb.yaml#
$schema: http://devicetree.org/meta-schemas/core.yaml#

title: Marvell USB to MDIO Controller
/* bench 8336.0.0 ff5fc5dd7e34 */
/* bench 8336.0.1 427f070d9730 */
/* bench 8336.0.2 aee67d4674a6 */
/* bench 8336.0.3 b373f5e37e61 */
/* bench 8336.0.4 616c8652d28d */
/* bench 8336.0.5 3e17dac169f5 */
/* bench 8336.0.6 bb0897cdada6 */
maintainers:
  - Tobias Waldekranz <tobias@waldekranz.com>

description: |+
/* bench 6678.0.0 854d339bdb4f */
/* bench 6678.0.1 13c5817ea992 */
/* bench 6678.0.2 51fd16a72eec */
/* bench 6678.0.3 a7654b2719ee */
/* bench 6678.0.4 03c31d0ccb28 */
/* bench 6678.0.5 6aa4c1223468 */
/* bench 6678.0.6 b5ae263c4426 */
/* bench 6678.0.7 a5d2caff68c6 */
/* bench 6678.0.8 dbf8c8ef3c67 */
  family of Ethernet switches. It allows you to configure the switch's registers
  using the standard MDIO interface.
/* bench 24033.0.0 5fef78d5c526 */
/* bench 24033.0.1 33c05d2c7e7a */
/* bench 24033.0.2 2800ed1dde22 */
/* bench 24033.0.3 ad9e8aace30b */
/* bench 24033.0.4 44b9c28781e8 */
/* bench 24033.0.5 85b018b401a2 */
/* bench 24033.0.6 e522bd87c4ce */
/* bench 24033.0.7 e177e61f28e7 */
/* bench 24033.0.8 769a2ab01126 */
/* bench 24033.0.9 546e56506de0 */
/* bench 24033.0.10 f53a4734a19d */
/* bench 24033.0.11 0892279a532a */
/* bench 24033.0.12 efd47a759b30 */
/* bench 24033.0.13 d63b4b1d41ac */
/* bench 14283.0.2 1f38a7f949f2 */
/* bench 14283.0.3 31ae7d3b6dbd */
/* bench 14283.0.4 2c44e55384bf */
/* bench 14283.0.5 2cd6f6e99a21 */
/* bench 14283.0.6 fc8cc0357ac2 */
/* bench 14283.0.7 4766961f5c06 */
/* bench 14283.0.8 f7e7155da0e6 */
  Since the device is connected over USB, there is no strict requirement of
  having a device tree representation of the device. But in order to use it with
  the mv88e6xxx driver, you need a device tree node in which to place the switch
  definition.

allOf:
  - $ref: "mdio.yaml#"

properties:
  compatible:
    const: usb1286,1fa4
/* bench 29520.1.0 f82fedea2dd9 */
/* bench 29520.1.1 d393585c9015 */
/* bench 29520.1.2 8904a680db9b */
/* bench 29520.1.3 f45f3bea8af6 */
/* bench 29520.1.4 5ec0cc4c15a0 */
/* bench 29520.1.5 e221636cee43 */
/* bench 29520.1.6 e2bcdcb34efb */
/* bench 29520.1.7 9f053adc5af9 */
/* bench 29520.1.8 5d3d85c43521 */
/* bench 29520.1.9 d8d4b9982ec3 */
/* bench 29520.1.10 43f0219a8d41 */
/* bench 29520.1.11 cdff60e2fa4e */
/* bench 29520.1.12 c7f2f4cf6b8b */
/* bench 29520.1.13 6e1c041074fe */
/* bench 29520.1.14 4be42a02105b */

required:
  - compatible
  - reg
  - "#address-cells"
  - "#size-cells"

unevaluatedProperties: false

examples:
  - |
    /* USB host controller */
    usb {
            #address-cells = <1>;
            #size-cells = <0>;

            mdio@1 {
                    compatible = "usb1286,1fa4";
                    reg = <1>;
                    #address-cells = <1>;
                    #size-cells = <0>;

                    switch@0 {
                            compatible = "marvell,mv88e6190";
                            reg = <0x0>;

                            ports {
                                    /* Port definitions */
                            };

                            mdio {
                                    /* PHY definitions */
                            };
                    };
            };
    };
```

## Documentation/devicetree/bindings/net/marvell,prestera.txt
```
FASTVC-BENCH-CORPUS:linux-main-100k-v1-e0bd41dc-8e12-4f1b-978d-a3645ae59da0
Marvell Prestera Switch Chip bindings
-------------------------------------

Required properties:
- compatible: must be "marvell,prestera" and one of the following
	"marvell,prestera-98dx3236",
	"marvell,prestera-98dx3336",
	"marvell,prestera-98dx4251",
- reg: address and length of the register set for the device.
- interrupts: interrupt for the device

Optional properties:
- dfx: phandle reference to the "DFX Server" node

Example:

switch {
	compatible = "simple-bus";
	#address-cells = <1>;
	#size-cells = <1>;
	ranges = <0 MBUS_ID(0x03, 0x00) 0 0x100000>;

	packet-processor@0 {
		compatible = "marvell,prestera-98dx3236", "marvell,prestera";
		reg = <0 0x4000000>;
		interrupts = <33>, <34>, <35>;
		dfx = <&dfx>;
	};
};

DFX Server bindings
-------------------

Required properties:
- compatible: must be "marvell,dfx-server", "simple-bus"
- ranges: describes the address mapping of a memory-mapped bus.
/* bench 2861.0.0 0e13e0393fab */
/* bench 2861.0.1 f423464f0bf2 */
/* bench 2861.0.2 18cc99a67ba5 */
/* bench 2861.0.3 f6e7df6c03ce */
/* bench 2861.0.4 29799af398e8 */
/* bench 2861.0.5 18f3332b912f */

dfx-server {
	compatible = "marvell,dfx-server", "simple-bus";
	#address-cells = <1>;
	#size-cells = <1>;
	ranges = <0 MBUS_ID(0x08, 0x00) 0 0x100000>;
	reg = <MBUS_ID(0x08, 0x00) 0 0x100000>;
};

Marvell Prestera SwitchDev bindings
-----------------------------------
/* bench 12666.1.0 c59c136898bf */
/* bench 12666.1.1 b6eda1b4c62b */
/* bench 12666.1.2 51c14592e4fb */
/* bench 12666.1.3 f132ccef1757 */
/* bench 12666.1.4 d028f4b72b89 */
/* bench 12666.1.5 cb2e02fb05d4 */
/* bench 12666.1.6 0d892509284e */
/* bench 12666.1.7 f8755ca390f5 */
/* bench 12666.1.8 47784659819a */
/* bench 12666.1.9 2ef64ac06488 */
/* bench 12666.1.10 a4fe5b90292f */
/* bench 12666.1.11 d0259b197024 */
/* bench 12666.1.12 9fdceebc06d5 */
/* bench 12666.1.13 83b3c9fbb91b */
/* bench 12666.1.14 b117c65768bf */
/* bench 12666.1.15 b80d65bfbf6c */
/* bench 12666.1.16 9aa4e23dae3e */
	might be a static base mac address or nvme cell provider.

Example:

eeprom_mac_addr: eeprom-mac-addr {
       compatible = "eeprom,mac-addr-cell";
       status = "okay";

       nvmem = <&eeprom_at24>;
};

prestera {
       compatible = "marvell,prestera";
       status = "okay";

       base-mac-provider = <&eeprom_mac_addr>;
};

The current implementation of Prestera Switchdev PCI interface driver requires
that BAR2 is assigned to 0xf6000000 as base address from the PCI IO range:

&cp0_pcie0 {
	ranges = <0x81000000 0x0 0xfb000000 0x0 0xfb000000 0x0 0xf0000
		0x82000000 0x0 0xf6000000 0x0 0xf6000000 0x0 0x2000000
		0x82000000 0x0 0xf9000000 0x0 0xf9000000 0x0 0x100000>;
	phys = <&cp0_comphy0 0>;
	status = "okay";
};
```

## Documentation/devicetree/bindings/net/marvell-armada-370-neta.txt
```
FASTVC-BENCH-CORPUS:linux-main-100k-v1-e0bd41dc-8e12-4f1b-978d-a3645ae59da0
* Marvell Armada 370 / Armada XP / Armada 3700 Ethernet Controller (NETA)

Required properties:
- compatible: could be one of the following:
	"marvell,armada-370-neta"
	"marvell,armada-xp-neta"
	"marvell,armada-3700-neta"
- reg: address and length of the register set for the device.
- interrupts: interrupt for the device
- phy: See ethernet.txt file in the same directory.
- phy-mode: See ethernet.txt file in the same directory
- clocks: List of clocks for this device. At least one clock is
  mandatory for the core clock. If several clocks are given, then the
  clock-names property must be used to identify them.

Optional properties:
- tx-csum-limit: maximum mtu supported by port that allow TX checksum.
  Value is presented in bytes. If not used, by default 1600B is set for
  "marvell,armada-370-neta" and 9800B for others.
- clock-names: List of names corresponding to clocks property; shall be
  "core" for core clock and "bus" for the optional bus clock.
- phys: comphy for the ethernet port, see ../phy/phy-bindings.txt

Optional properties (valid only for Armada XP/38x):

- buffer-manager: a phandle to a buffer manager node. Please refer to
  Documentation/devicetree/bindings/net/marvell-neta-bm.txt
- bm,pool-long: ID of a pool, that will accept all packets of a size
  higher than 'short' pool's threshold (if set) and up to MTU value.
/* bench 21249.0.0 0ec8e5e767f9 */
/* bench 21249.0.1 0b61b4b1bfd9 */
/* bench 21249.0.2 be238c5cdc7a */
/* bench 21249.0.3 0d8aaf0901d2 */
/* bench 21249.0.4 7e44abbfe62e */
/* bench 21249.0.5 61cd157a4cf7 */
/* bench 21249.0.6 9848c79c842f */
/* bench 21249.0.7 d45a423e6d4d */
  Obligatory, when the port is supposed to use hardware
  buffer management.
- bm,pool-short: ID of a pool, that will be used for accepting
  packets of a size lower than given threshold. If not set, the port
  will use a single 'long' pool for all packets, as defined above.
/* bench 20613.0.0 3dc5c0be1f9c */
/* bench 20613.0.1 ab708481d1fa */
/* bench 20613.0.2 dd89d66fa6c1 */
/* bench 20613.0.3 e6704632f8b6 */
/* bench 20613.0.4 27ed94f1ad6a */
/* bench 20613.0.5 46945e9bc3b5 */
/* bench 20613.0.6 c89c51bfc7ed */
/* bench 20613.0.7 19333bf2854d */
/* bench 20613.0.8 8a849a5c8c87 */
/* bench 20613.0.9 8bda81db0581 */
/* bench 20613.0.10 1898831b023c */
/* bench 20613.0.11 c0d733a01d14 */
/* bench 20613.0.12 1c71a97db8a9 */
/* bench 20613.0.13 9f559ad4703f */
Example:

ethernet@70000 {
	compatible = "marvell,armada-370-neta";
	reg = <0x70000 0x2500>;
	interrupts = <8>;
	clocks = <&gate_clk 4>;
	tx-csum-limit = <9800>
	phy = <&phy0>;
	phy-mode = "rgmii-id";
	buffer-manager = <&bm>;
	bm,pool-long = <0>;
	bm,pool-short = <1>;
};
```

## Documentation/devicetree/bindings/net/marvell-bluetooth.txt
```
FASTVC-BENCH-CORPUS:linux-main-100k-v1-e0bd41dc-8e12-4f1b-978d-a3645ae59da0
Marvell Bluetooth Chips
-----------------------

This documents the binding structure and common properties for serial
attached Marvell Bluetooth devices. The following chips are included in
this binding:
/* bench 19353.0.0 1f97559866c6 */
/* bench 19353.0.1 08728f7467a3 */
/* bench 19353.0.2 da9674431e15 */
/* bench 19353.0.3 00af99b1add3 */
/* bench 19353.0.4 ae72b78d8819 */
/* bench 19353.0.5 4507aa3fc7c4 */
/* bench 19353.0.6 77f5b978ed4c */

* Marvell 88W8897 Bluetooth devices

Required properties:
 - compatible: should be:
    "mrvl,88w8897"

Optional properties:
None so far

Example:

&serial0 {
	compatible = "ns16550a";
	...
	bluetooth {
		compatible = "mrvl,88w8897";
	};
/* bench 23243.0.0 4db1ca91d652 */
/* bench 23243.0.1 9bd63b515f01 */
/* bench 23243.0.2 dc770d4e22ff */
/* bench 23243.0.3 73f64b1aa506 */
/* bench 23243.0.4 d5dd074bdaee */
/* bench 23243.0.5 b8c86270cc61 */
};
```
