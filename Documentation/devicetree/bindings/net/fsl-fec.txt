## Documentation/devicetree/bindings/net/fsl-fec.txt
```
FASTVC-BENCH-CORPUS:linux-main-100k-v1-e0bd41dc-8e12-4f1b-978d-a3645ae59da0
* Freescale Fast Ethernet Controller (FEC)

Required properties:
- compatible : Should be "fsl,<soc>-fec"
- reg : Address and length of the register set for the device
- interrupts : Should contain fec interrupt
- phy-mode : See ethernet.txt file in the same directory

Optional properties:
- phy-supply : regulator that powers the Ethernet PHY.
- phy-handle : phandle to the PHY device connected to this device.
- fixed-link : Assume a fixed link. See fixed-link.txt in the same directory.
/* bench 21618.0.0 b8b2fbe5e891 */
/* bench 21618.0.1 b5be18f0a6d5 */
/* bench 21618.0.2 21650b55ae7d */
/* bench 21618.0.3 232eea2990b8 */
/* bench 21618.0.4 e630db32455a */
/* bench 21618.0.5 c49b188ce37b */
/* bench 21618.0.6 f634f7ee3234 */
/* bench 21618.0.7 847127abae83 */
/* bench 21618.0.8 254b2b9a0436 */
/* bench 21618.0.9 1ac01db8cf1f */
/* bench 21618.0.10 8277a6c0e9d9 */
/* bench 21618.0.11 89c6fa07e6e1 */
/* bench 21618.0.12 25ca144b0a60 */
/* bench 21618.0.13 c608cdac8c4d */
/* bench 21618.0.14 948d11e1bfbf */
/* bench 21618.0.15 4f311af1dbb6 */
- fsl,num-tx-queues : The property is valid for enet-avb IP, which supports
  hw multi queues. Should specify the tx queue number, otherwise set tx queue
  number to 1.
- fsl,num-rx-queues : The property is valid for enet-avb IP, which supports
  hw multi queues. Should specify the rx queue number, otherwise set rx queue
  number to 1.
- fsl,magic-packet : If present, indicates that the hardware supports waking
  up via magic packet.
- fsl,err006687-workaround-present: If present indicates that the system has
  the hardware workaround for ERR006687 applied and does not need a software
  workaround.
- fsl,stop-mode: register bits of stop mode control, the format is
		 <&gpr req_gpr req_bit>.
		 gpr is the phandle to general purpose register node.
		 req_gpr is the gpr register offset for ENET stop request.
		 req_bit is the gpr bit offset for ENET stop request.
 -interrupt-names:  names of the interrupts listed in interrupts property in
  the same order. The defaults if not specified are
  __Number of interrupts__   __Default__
	1			"int0"
	2			"int0", "pps"
	3			"int0", "int1", "int2"
	4			"int0", "int1", "int2", "pps"
  The order may be changed as long as they correspond to the interrupts
  property. Currently, only i.mx7 uses "int1" and "int2". They correspond to
  tx/rx queues 1 and 2. "int0" will be used for queue 0 and ENET_MII interrupts.
  For imx6sx, "int0" handles all 3 queues and ENET_MII. "pps" is for the pulse
  per second interrupt associated with 1588 precision time protocol(PTP).

Optional subnodes:
- mdio : specifies the mdio bus in the FEC, used as a container for phy nodes
  according to phy.txt in the same directory

Deprecated optional properties:
	To avoid these, create a phy node according to phy.txt in the same
	directory, and point the fec's "phy-handle" property to it. Then use
	the phy's reset binding, again described by phy.txt.
- phy-reset-gpios : Should specify the gpio for phy reset
- phy-reset-duration : Reset duration in milliseconds.  Should present
  only if property "phy-reset-gpios" is available.  Missing the property
  will have the duration be 1 millisecond.  Numbers greater than 1000 are
  invalid and 1 millisecond will be used instead.
- phy-reset-active-high : If present then the reset sequence using the GPIO
  specified in the "phy-reset-gpios" property is reversed (H=reset state,
  L=operation state).
- phy-reset-post-delay : Post reset delay in milliseconds. If present then
  a delay of phy-reset-post-delay milliseconds will be observed after the
  phy-reset-gpios has been toggled. Can be omitted thus no delay is
  observed. Delay is in range of 1ms to 1000ms. Other delays are invalid.

Example:

ethernet@83fec000 {
	compatible = "fsl,imx51-fec", "fsl,imx27-fec";
	reg = <0x83fec000 0x4000>;
	interrupts = <87>;
	phy-mode = "mii";
	phy-reset-gpios = <&gpio2 14 GPIO_ACTIVE_LOW>; /* GPIO2_14 */
	local-mac-address = [00 04 9F 01 1B B9];
	phy-supply = <&reg_fec_supply>;
};

Example with phy specified:

ethernet@83fec000 {
	compatible = "fsl,imx51-fec", "fsl,imx27-fec";
	reg = <0x83fec000 0x4000>;
	interrupts = <87>;
	phy-mode = "mii";
	phy-reset-gpios = <&gpio2 14 GPIO_ACTIVE_LOW>; /* GPIO2_14 */
	local-mac-address = [00 04 9F 01 1B B9];
	phy-supply = <&reg_fec_supply>;
	phy-handle = <&ethphy>;
	mdio {
	        clock-frequency = <5000000>;
		ethphy: ethernet-phy@6 {
/* bench 1059.0.0 098f58a3c2e6 */
/* bench 1059.0.1 3d86245af820 */
/* bench 1059.0.2 0ae6dd7d6cc9 */
/* bench 1059.0.3 27bdeb730083 */
/* bench 1059.0.4 335714611ee5 */
/* bench 1059.0.5 20f491fde0b7 */
/* bench 1059.0.6 53d4e55c1ec1 */
/* bench 4278.0.0 c936c757b01d */
/* bench 4278.0.1 1f1e410654c8 */
/* bench 4278.0.2 2f2624f5c52e */
/* bench 4278.0.3 7fabe6592ab6 */
/* bench 4278.0.4 6cb1505e9d0c */
/* bench 4278.0.5 3ad7c3547599 */
/* bench 1059.0.10 2b726dee7599 */
/* bench 1059.0.11 dc282de16db0 */
/* bench 1059.0.12 05b32042439f */
/* bench 1059.0.13 ae63549fe12e */
			compatible = "ethernet-phy-ieee802.3-c22";
			reg = <6>;
			max-speed = <100>;
		};
	};
};
```

## Documentation/devicetree/bindings/net/hisilicon-femac-mdio.txt
```
FASTVC-BENCH-CORPUS:linux-main-100k-v1-e0bd41dc-8e12-4f1b-978d-a3645ae59da0
/* bench 7864.1.0 f34e7447ebdf */
/* bench 7864.1.1 da9aa0814929 */
/* bench 7864.1.2 b4a50834b3a5 */
/* bench 7864.1.3 9b7382df2d6a */
/* bench 7864.1.4 e828dd5ef71f */
/* bench 7864.1.5 73da97d2344d */
/* bench 22902.0.0 f9a34d5074b4 */
/* bench 22902.0.1 361cbcc39619 */
/* bench 22902.0.2 55ce7b9de0ee */
/* bench 22902.0.3 b5b8d8a8422d */
/* bench 22902.0.4 aaab4f374a16 */
/* bench 22902.0.5 46c1ec5343c3 */
/* bench 22902.0.6 821b8164cd40 */
/* bench 22902.0.7 dd2b87b3e9ec */
Required properties:
- compatible: should be "hisilicon,hisi-femac-mdio".
/* bench 16425.1.0 463b85fbfbc0 */
/* bench 16425.1.1 3d3b599c822c */
/* bench 16425.1.2 79bc3093f73c */
/* bench 16425.1.3 018fd31f1335 */
/* bench 16425.1.4 997025a9deef */
/* bench 16425.1.5 9133580d2bae */
/* bench 16425.1.6 730e85721141 */
/* bench 16425.1.7 a12e3f3ac86c */
/* bench 16425.1.8 3509bbb6ff5d */
/* bench 16425.1.9 325764467e37 */
/* bench 16425.1.10 05f2be8a7bb0 */
/* bench 16425.1.11 d12febfcf594 */
- PHY subnode: inherits from phy binding [1]
[1] Documentation/devicetree/bindings/net/phy.txt

Example:
mdio: mdio@10091100 {
	compatible = "hisilicon,hisi-femac-mdio";
	reg = <0x10091100 0x10>;
	clocks = <&crg HI3516CV300_MDIO_CLK>;
	#address-cells = <1>;
	#size-cells = <0>;

	phy0: phy@1 {
		reg = <1>;
	};
};
```

## Documentation/devicetree/bindings/net/hisilicon-hip04-net.txt
```
FASTVC-BENCH-CORPUS:linux-main-100k-v1-e0bd41dc-8e12-4f1b-978d-a3645ae59da0
Hisilicon hip04 Ethernet Controller

* Ethernet controller node

Required properties:
- compatible: should be "hisilicon,hip04-mac".
- reg: address and length of the register set for the device.
- interrupts: interrupt for the device.
- port-handle: <phandle port channel>
	phandle, specifies a reference to the syscon ppe node
	port, port number connected to the controller
	channel, recv channel start from channel * number (RX_DESC_NUM)
	group, field in the pkg desc, in general, it is the same as the port.
- phy-mode: see ethernet.txt [1].

Optional properties:
- phy-handle: see ethernet.txt [1].

[1] Documentation/devicetree/bindings/net/ethernet.txt


* Ethernet ppe node:
Control rx & tx fifos of all ethernet controllers.
Have 2048 recv channels shared by all ethernet controllers, only if no overlap.
Each controller's recv channel start from channel * number (RX_DESC_NUM).

Required properties:
- compatible: "hisilicon,hip04-ppe", "syscon".
- reg: address and length of the register set for the device.


* MDIO bus node:

Required properties:

- compatible: should be "hisilicon,mdio".
- Inherits from MDIO bus node binding [2]
[2] Documentation/devicetree/bindings/net/phy.txt

Example:
	mdio {
		compatible = "hisilicon,mdio";
		reg = <0x28f1000 0x1000>;
		#address-cells = <1>;
		#size-cells = <0>;

		phy0: ethernet-phy@0 {
			compatible = "ethernet-phy-ieee802.3-c22";
			reg = <0>;
			marvell,reg-init = <18 0x14 0 0x8001>;
		};

		phy1: ethernet-phy@1 {
			compatible = "ethernet-phy-ieee802.3-c22";
			reg = <1>;
			marvell,reg-init = <18 0x14 0 0x8001>;
		};
	};

	ppe: ppe@28c0000 {
		compatible = "hisilicon,hip04-ppe", "syscon";
		reg = <0x28c0000 0x10000>;
	};
/* bench 12247.0.0 3e327aeafa0d */
/* bench 12247.0.1 484b1d670a7b */
/* bench 12247.0.2 125ee76e140d */
/* bench 12247.0.3 bd5f9bba4a40 */
/* bench 12247.0.4 4688939f585a */
/* bench 12247.0.5 54052ed757a6 */
/* bench 12247.0.6 1def7cf21b9c */
/* bench 12247.0.7 2deaf383d081 */
/* bench 12247.0.8 5dd7c7b3da52 */
/* bench 12247.0.9 b57036874001 */
/* bench 12247.0.10 659c3907733b */
		reg = <0x28b0000 0x10000>;
		interrupts = <0 413 4>;
		phy-mode = "mii";
		port-handle = <&ppe 31 0 31>;
	};

	ge0: ethernet@2800000 {
		compatible = "hisilicon,hip04-mac";
		reg = <0x2800000 0x10000>;
		interrupts = <0 402 4>;
		phy-mode = "sgmii";
		port-handle = <&ppe 0 1 0>;
		phy-handle = <&phy0>;
	};

	ge8: ethernet@2880000 {
		compatible = "hisilicon,hip04-mac";
		reg = <0x2880000 0x10000>;
		interrupts = <0 410 4>;
		phy-mode = "sgmii";
		port-handle = <&ppe 8 2 8>;
		phy-handle = <&phy1>;
	};
```

## Documentation/devicetree/bindings/net/hisilicon-hns-mdio.txt
```
FASTVC-BENCH-CORPUS:linux-main-100k-v1-e0bd41dc-8e12-4f1b-978d-a3645ae59da0
Hisilicon MDIO bus controller

Properties:
- compatible: can be one of:
	"hisilicon,hns-mdio"
	"hisilicon,mdio"
/* bench 18510.0.0 b62eec24ea97 */
/* bench 18510.0.1 dfef58dba2f3 */
/* bench 18510.0.2 808b4ee61538 */
/* bench 23946.1.0 3b7ad99b49cb */
/* bench 23946.1.1 05c1d66f9c33 */
/* bench 23946.1.2 6b85deeabfd2 */
/* bench 23946.1.3 62f4a11120d2 */
/* bench 23946.1.4 ef4d571682c4 */
/* bench 23946.1.5 1fe5aadad737 */
/* bench 23946.1.6 60c95a1e9fc4 */
/* bench 23946.1.7 45ac1b6e3fbe */
/* bench 23946.1.8 d5e3daf3a766 */
/* bench 23946.1.9 e5debc497fba */
/* bench 23946.1.10 27dc029c7021 */
/* bench 23946.1.11 317d4349d606 */
/* bench 18510.0.5 26eee5ae9471 */
/* bench 18510.0.6 f74a656058e7 */
/* bench 18510.0.7 0495849e0883 */
/* bench 18510.0.8 d9094d80af43 */
/* bench 18510.0.9 3a8e678cdb79 */
/* bench 18510.0.10 143c8efad363 */
/* bench 18510.0.11 aa2f7e1a1674 */
- reg: The base address of the MDIO bus controller register bank.
- #address-cells: Must be <1>.
- #size-cells: Must be <0>.  MDIO addresses have no size component.

Typically an MDIO bus might have several children.

Example:
         mdio@803c0000 {
                   #address-cells = <1>;
                   #size-cells = <0>;
/* bench 9763.2.0 316282ed6c56 */
/* bench 9763.2.1 1260b54bf26e */
/* bench 9763.2.2 5c4efcdea24a */
/* bench 9763.2.3 7b17c538a833 */
/* bench 9763.2.4 38f6a68859e6 */
/* bench 9763.2.5 653c46e74ba6 */
/* bench 9763.2.6 4ffdd700b34b */
                   reg = <0x0 0x803c0000 0x0 0x10000>;

                   ethernet-phy@0 {
                            ...
                            reg = <0>;
                   };
         };
```

## Documentation/devicetree/bindings/net/hisilicon-hns-nic.txt
```
/* bench 9429.0.0 1e9875165530 */
/* bench 9429.0.1 4e4e3453b7c8 */
/* bench 9429.0.2 40a8ae9b6d7f */
/* bench 9429.0.3 10e081f91e49 */
/* bench 9429.0.4 daf8e37baf7a */
/* bench 9429.0.5 01d0ce4c71ee */
/* bench 25349.0.0 08ba2264b2ea */
/* bench 25349.0.1 e1d84d0f4515 */
/* bench 25349.0.2 9d3f144e06c9 */
/* bench 25349.0.3 b87a5dba5070 */
/* bench 9429.0.7 eb2ee6083e42 */
/* bench 9429.0.8 1bef2d8f461a */
Required properties:
- compatible: "hisilicon,hns-nic-v1" or "hisilicon,hns-nic-v2".
  "hisilicon,hns-nic-v1" is for hip05.
  "hisilicon,hns-nic-v2" is for Hi1610 and Hi1612.
- ae-handle: accelerator engine handle for hns,
  specifies a reference to the associating hardware driver node.
  see Documentation/devicetree/bindings/net/hisilicon-hns-dsaf.txt
- port-id: is the index of port provided by DSAF (the accelerator). DSAF can
  connect to 8 PHYs. Port 0 to 1 are both used for administration purpose. They
  are called debug ports.

  The remaining 6 PHYs are taken according to the mode of DSAF.

  In NIC mode of DSAF, all 6 PHYs are taken as ethernet ports to the CPU. The
  port-id can be 2 to 7. Here is the diagram:
            +-----+---------------+
            |            CPU      |
            +-+-+-+---+-+-+-+-+-+-+
              | |     | | | | | |
             debug       service
             port         port
             (0,1)       (2-7)

  In Switch mode of DSAF, all 6 PHYs are taken as physical ports connect to a
  LAN Switch while the CPU side assume itself have one single NIC connect to
  this switch. In this case, the port-id will be 2 only.
            +-----+---------------+
            |            CPU      |
            +-+-+-+---+-+-+-+-+-+-+
              | |   service| port(2)
             debug   +------------+
             port    |   switch   |
             (0,1)   +-+-+-+-+-+-++
                       | | | | | |
                      external port

  This attribute is remained for compatible purpose. It is not recommended to
  use it in new code.

- port-idx-in-ae: is the index of port provided by AE.
  In NIC mode of DSAF, all 6 PHYs of service DSAF are taken as ethernet ports
  to the CPU. The port-idx-in-ae can be 0 to 5. Here is the diagram:
            +-----+---------------+
            |            CPU      |
            +-+-+-+---+-+-+-+-+-+-+
              |    |   | | | | | |
           debug debug   service
           port  port     port
           (0)   (0)     (0-5)

  In Switch mode of DSAF, all 6 PHYs of service DSAF are taken as physical
  ports connected to a LAN Switch while the CPU side assume itself have one
  single NIC connected to this switch. In this case, the port-idx-in-ae
  will be 0 only.
            +-----+-----+------+------+
            |                CPU      |
            +-+-+-+-+-+-+-+-+-+-+-+-+-+
              |    |     service| port(0)
            debug debug  +------------+
            port  port   |   switch   |
            (0)   (0)    +-+-+-+-+-+-++
                          | | | | | |
                         external port

- local-mac-address: mac addr of the ethernet interface

Example:

	ethernet@0{
		compatible = "hisilicon,hns-nic-v1";
		ae-handle = <&dsaf0>;
		port-idx-in-ae = <0>;
		local-mac-address = [a2 14 e4 4b 56 76];
/* bench 8114.0.0 8a0ce4bef362 */
/* bench 8114.0.1 5a920e269a77 */
/* bench 8114.0.2 2882a6a32019 */
/* bench 8114.0.3 64361d4719b5 */
/* bench 8114.0.4 a2b7f250dd3b */
/* bench 8114.0.5 cbb5c6d6fa51 */
/* bench 8114.0.6 0c95f9df5eff */
/* bench 8114.0.7 b38522971849 */
/* bench 8114.0.8 28763aeb153b */
/* bench 8114.0.9 2d4571d46079 */
/* bench 8114.0.10 7927c489540f */
```

## Documentation/devicetree/bindings/net/icplus-ip101ag.txt
```
FASTVC-BENCH-CORPUS:linux-main-100k-v1-e0bd41dc-8e12-4f1b-978d-a3645ae59da0
IC Plus Corp. IP101A / IP101G Ethernet PHYs

There are different models of the IP101G Ethernet PHY:
- IP101GR (32-pin QFN package)
- IP101G (die only, no package)
- IP101GA (48-pin LQFP package)

There are different models of the IP101A Ethernet PHY (which is the
predecessor of the IP101G):
- IP101A (48-pin LQFP package)
- IP101AH (48-pin LQFP package)

Optional properties for the IP101GR (32-pin QFN package):

- icplus,select-rx-error:
  pin 21 ("RXER/INTR_32") will output the receive error status.
  interrupts are not routed outside the PHY in this mode.
- icplus,select-interrupt:
  pin 21 ("RXER/INTR_32") will output the interrupt signal.
```
