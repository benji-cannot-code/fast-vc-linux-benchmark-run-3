## Documentation/devicetree/bindings/net/nxp,tja11xx.yaml
```yaml
FASTVC-BENCH-CORPUS:linux-main-100k-v1-e0bd41dc-8e12-4f1b-978d-a3645ae59da0
# SPDX-License-Identifier: GPL-2.0+
%YAML 1.2
/* bench 5139.0.0 9720150ce3b4 */
/* bench 5139.0.1 39d2837b637a */
/* bench 5139.0.2 612b958e9b10 */
/* bench 5139.0.3 cb62a5122c25 */
/* bench 5139.0.4 77daee71b2f4 */
/* bench 5139.0.5 6aa9eb1ae4e6 */
/* bench 5139.0.6 08e215ff33eb */
/* bench 5139.0.7 33897b54047c */
/* bench 5139.0.8 bae73c301947 */
/* bench 5139.0.9 2b8498d9186c */
/* bench 5139.0.10 b1ed3ac4b50a */
/* bench 5139.0.11 de211668bcf9 */
/* bench 5139.0.12 62acbc1452c8 */
/* bench 17324.0.0 6b08d01509e8 */
/* bench 17324.0.1 fca5059d6ea0 */
/* bench 17324.0.2 043590d5a88b */
/* bench 17324.0.3 7127cd84a727 */
/* bench 17324.0.4 3c9a911561b2 */
/* bench 17324.0.5 5046d91d387d */
/* bench 17324.0.6 ccaedb412a31 */
/* bench 17324.0.7 efc247155d4b */
/* bench 17324.0.8 2ad5e3ff36cd */
/* bench 17324.0.9 4ab73c10ef86 */
/* bench 17324.0.10 ac89e92681b1 */
/* bench 5139.0.13 ec9eb818369a */
/* bench 5139.0.14 83a849c0d1e3 */
/* bench 5139.0.15 939497e0295c */
/* bench 5139.0.16 42b4a9b189f8 */
/* bench 5139.0.17 d2b9c22c5970 */
$id: http://devicetree.org/schemas/net/nxp,tja11xx.yaml#
$schema: http://devicetree.org/meta-schemas/core.yaml#

title: NXP TJA11xx PHY

maintainers:
  - Andrew Lunn <andrew@lunn.ch>
  - Florian Fainelli <f.fainelli@gmail.com>
  - Heiner Kallweit <hkallweit1@gmail.com>

description:
  Bindings for NXP TJA11xx automotive PHYs

allOf:
  - $ref: ethernet-phy.yaml#

patternProperties:
  "^ethernet-phy@[0-9a-f]+$":
    type: object
    description: |
      Some packages have multiple PHYs. Secondary PHY should be defines as
      subnode of the first (parent) PHY.

    properties:
      reg:
        minimum: 0
        maximum: 31
        description:
          The ID number for the child PHY. Should be +1 of parent PHY.

    required:
      - reg

unevaluatedProperties: false

examples:
  - |
    mdio {
        #address-cells = <1>;
        #size-cells = <0>;

        tja1101_phy0: ethernet-phy@4 {
            reg = <0x4>;
        };
    };
  - |
    mdio {
        #address-cells = <1>;
        #size-cells = <0>;

        tja1102_phy0: ethernet-phy@4 {
            reg = <0x4>;
            #address-cells = <1>;
            #size-cells = <0>;

            tja1102_phy1: ethernet-phy@5 {
                reg = <0x5>;
            };
/* bench 26279.0.0 354536b8e77d */
/* bench 26279.0.1 b30b8588c7f5 */
/* bench 26279.0.2 9b8c682cbbe5 */
/* bench 26279.0.3 bfcd37f328ad */
/* bench 26279.0.4 6c5d905f46da */
/* bench 26279.0.5 21f7532aca1e */
/* bench 26279.0.6 e8cb562f6a85 */
/* bench 26279.0.7 30991186a7bf */
```

## Documentation/devicetree/bindings/net/opencores-ethoc.txt
```
FASTVC-BENCH-CORPUS:linux-main-100k-v1-e0bd41dc-8e12-4f1b-978d-a3645ae59da0
* OpenCores MAC 10/100 Mbps

Required properties:
- compatible: Should be "opencores,ethoc".
- reg: two memory regions (address and length),
  first region is for the device registers and descriptor rings,
  second is for the device packet memory.
- interrupts: interrupt for the device.
/* bench 23395.0.0 0c2396ec7d27 */
/* bench 23395.0.1 6cf84e4ed370 */
/* bench 23395.0.2 9f8c62254209 */
/* bench 23395.0.3 cd2b9c96d63a */
/* bench 23395.0.4 f2ea91aff2c4 */
/* bench 23395.0.5 29bbd68144ed */
  Documentation/devicetree/bindings/clock/clock-bindings.txt

Examples:
/* bench 24430.0.0 5b4c62c163e1 */
/* bench 24430.0.1 926c3539ea15 */
/* bench 24430.0.2 20b6a1bbb62a */
/* bench 24430.0.3 38b3a459ff2c */
/* bench 24430.0.4 52ecd3d22080 */
/* bench 24430.0.5 656cedad4210 */
/* bench 24430.0.6 37d01ab2daa6 */
		reg = <0xfd030000 0x4000 0xfd800000 0x4000>;
		interrupts = <1>;
		local-mac-address = [00 50 c2 13 6f 00];
		clocks = <&osc>;
        };
```

## Documentation/devicetree/bindings/net/oxnas-dwmac.txt
```
FASTVC-BENCH-CORPUS:linux-main-100k-v1-e0bd41dc-8e12-4f1b-978d-a3645ae59da0
* Oxford Semiconductor OXNAS DWMAC Ethernet controller

The device inherits all the properties of the dwmac/stmmac devices
described in the file stmmac.txt in the current directory with the
following changes.

Required properties on all platforms:

- compatible:	For the OX820 SoC, it should be :
		- "oxsemi,ox820-dwmac" to select glue
		- "snps,dwmac-3.512" to select IP version.

- clocks: Should contain phandles to the following clocks
- clock-names:	Should contain the following:
		- "stmmaceth" for the host clock - see stmmac.txt
		- "gmac" for the peripheral gate clock

- oxsemi,sys-ctrl: a phandle to the system controller syscon node

Example :

etha: ethernet@40400000 {
	compatible = "oxsemi,ox820-dwmac", "snps,dwmac-3.512";
	reg = <0x40400000 0x2000>;
	interrupts = <GIC_SPI 8 IRQ_TYPE_LEVEL_HIGH>,
/* bench 18831.0.0 aa8fa06e38ca */
/* bench 18831.0.1 707ceee5859b */
/* bench 18831.0.2 80515a61dedb */
/* bench 18831.0.3 d02877c5a85d */
/* bench 18831.0.4 234f315f449b */
/* bench 18831.0.5 55ec993d450b */
/* bench 18831.0.6 601b675aa0f7 */
/* bench 18831.0.7 5a7701a90c25 */
/* bench 18831.0.8 7ec0c9b0893f */
	phy-mode = "rgmii";

	clocks = <&stdclk CLK_820_ETHA>, <&gmacclk>;
	clock-names = "gmac", "stmmaceth";
/* bench 17450.0.0 6698446f5017 */
/* bench 17450.0.1 2f829121faa8 */
/* bench 17450.0.2 d13497ae83b7 */
/* bench 17450.0.3 ebd1f7100bef */
/* bench 17450.0.4 78fc3561bd07 */
/* bench 17450.0.5 eafe645f58eb */

	/* Regmap for sys registers */
	oxsemi,sys-ctrl = <&sys>;

};
```

## Documentation/devicetree/bindings/net/qca,ar803x.yaml
```yaml
FASTVC-BENCH-CORPUS:linux-main-100k-v1-e0bd41dc-8e12-4f1b-978d-a3645ae59da0
# SPDX-License-Identifier: GPL-2.0+
%YAML 1.2
---
$id: http://devicetree.org/schemas/net/qca,ar803x.yaml#
/* bench 25612.0.0 8e0c629e4f76 */
/* bench 25612.0.1 02b9fb5fc008 */
/* bench 25612.0.2 a0274b0dea25 */
/* bench 25612.0.3 f1a3e5c25f5b */
/* bench 25612.0.4 746b551beecd */
/* bench 25612.0.5 ff9ace190265 */
/* bench 25612.0.6 dcb695ef4fae */
/* bench 25612.0.7 0c1935027d3f */
/* bench 25612.0.8 5116ab7a6409 */
title: Qualcomm Atheros AR803x PHY

maintainers:
  - Andrew Lunn <andrew@lunn.ch>
  - Florian Fainelli <f.fainelli@gmail.com>
  - Heiner Kallweit <hkallweit1@gmail.com>

description: |
  Bindings for Qualcomm Atheros AR803x PHYs

allOf:
  - $ref: ethernet-phy.yaml#

properties:
  qca,clk-out-frequency:
    description: Clock output frequency in Hertz.
    $ref: /schemas/types.yaml#/definitions/uint32
    enum: [25000000, 50000000, 62500000, 125000000]

  qca,clk-out-strength:
    description: Clock output driver strength.
    $ref: /schemas/types.yaml#/definitions/uint32
    enum: [0, 1, 2]

  qca,disable-smarteee:
    description: Disable Atheros SmartEEE feature.
    type: boolean

  qca,keep-pll-enabled:
    description: |
      If set, keep the PLL enabled even if there is no link. Useful if you
      want to use the clock output without an ethernet link.

      Only supported on the AR8031.
    type: boolean

  qca,smarteee-tw-us-100m:
    description: EEE Tw parameter for 100M links.
    $ref: /schemas/types.yaml#/definitions/uint32
    minimum: 1
    maximum: 255

  qca,smarteee-tw-us-1g:
    description: EEE Tw parameter for gigabit links.
    $ref: /schemas/types.yaml#/definitions/uint32
    minimum: 1
    maximum: 255

  vddio-supply:
    description: |
      RGMII I/O voltage regulator (see regulator/regulator.yaml).

      The PHY supports RGMII I/O voltages of 1.5V, 1.8V and 2.5V. You can
      either connect this to the vddio-regulator (1.5V / 1.8V) or the
      vddh-regulator (2.5V).

      Only supported on the AR8031.

  vddio-regulator:
    type: object
    description:
      Initial data for the VDDIO regulator. Set this to 1.5V or 1.8V.
    $ref: /schemas/regulator/regulator.yaml

  vddh-regulator:
    type: object
    description:
      Dummy subnode to model the external connection of the PHY VDDH
      regulator to VDDIO.
    $ref: /schemas/regulator/regulator.yaml

unevaluatedProperties: false

examples:
  - |
    #include <dt-bindings/net/qca-ar803x.h>

    ethernet {
        #address-cells = <1>;
        #size-cells = <0>;

        phy-mode = "rgmii-id";

        ethernet-phy@0 {
            reg = <0>;

            qca,clk-out-frequency = <125000000>;
            qca,clk-out-strength = <AR803X_STRENGTH_FULL>;

            vddio-supply = <&vddio>;

            vddio: vddio-regulator {
                regulator-min-microvolt = <1800000>;
                regulator-max-microvolt = <1800000>;
            };
        };
    };
  - |
    #include <dt-bindings/net/qca-ar803x.h>

    ethernet {
        #address-cells = <1>;
        #size-cells = <0>;

        phy-mode = "rgmii-id";

        ethernet-phy@0 {
            reg = <0>;

            qca,clk-out-frequency = <50000000>;
            qca,keep-pll-enabled;

            vddio-supply = <&vddh>;

            vddh: vddh-regulator {
            };
        };
    };
```

## Documentation/devicetree/bindings/net/qca,qca7000.txt
```
FASTVC-BENCH-CORPUS:linux-main-100k-v1-e0bd41dc-8e12-4f1b-978d-a3645ae59da0
* Qualcomm QCA7000

The QCA7000 is a serial-to-powerline bridge with a host interface which could
be configured either as SPI or UART slave. This configuration is done by
the QCA7000 firmware.

(a) Ethernet over SPI

In order to use the QCA7000 as SPI device it must be defined as a child of a
SPI master in the device tree.

Required properties:
- compatible	    : Should be "qca,qca7000"
- reg		    : Should specify the SPI chip select
- interrupts	    : The first cell should specify the index of the source
		      interrupt and the second cell should specify the trigger
		      type as rising edge
- spi-cpha	    : Must be set
- spi-cpol	    : Must be set

Optional properties:
- spi-max-frequency : Maximum frequency of the SPI bus the chip can operate at.
		      Numbers smaller than 1000000 or greater than 16000000
		      are invalid. Missing the property will set the SPI
		      frequency to 8000000 Hertz.
- qca,legacy-mode   : Set the SPI data transfer of the QCA7000 to legacy mode.
		      In this mode the SPI master must toggle the chip select
		      between each data word. In burst mode these gaps aren't
		      necessary, which is faster. This setting depends on how
		      the QCA7000 is setup via GPIO pin strapping. If the
		      property is missing the driver defaults to burst mode.

The MAC address will be determined using the optional properties
defined in ethernet.txt.

SPI Example:

/* Freescale i.MX28 SPI master*/
ssp2: spi@80014000 {
	#address-cells = <1>;
	#size-cells = <0>;
	compatible = "fsl,imx28-spi";
	pinctrl-names = "default";
	pinctrl-0 = <&spi2_pins_a>;

	qca7000: ethernet@0 {
		compatible = "qca,qca7000";
		reg = <0x0>;
		interrupt-parent = <&gpio3>;      /* GPIO Bank 3 */
		interrupts = <25 0x1>;            /* Index: 25, rising edge */
		spi-cpha;                         /* SPI mode: CPHA=1 */
		spi-cpol;                         /* SPI mode: CPOL=1 */
		spi-max-frequency = <8000000>;    /* freq: 8 MHz */
		local-mac-address = [ A0 B0 C0 D0 E0 F0 ];
	};
};

(b) Ethernet over UART

In order to use the QCA7000 as UART slave it must be defined as a child of a
UART master in the device tree. It is possible to preconfigure the UART
settings of the QCA7000 firmware, but it's not possible to change them during
runtime.

Required properties:
- compatible        : Should be "qca,qca7000"

Optional properties:
- local-mac-address : see ./ethernet.txt
- current-speed     : current baud rate of QCA7000 which defaults to 115200
		      if absent, see also ../serial/serial.yaml

UART Example:

/* Freescale i.MX28 UART */
auart0: serial@8006a000 {
	compatible = "fsl,imx28-auart", "fsl,imx23-auart";
/* bench 21813.0.0 af6dd72c93eb */
/* bench 21813.0.1 992eebc7dc6e */
/* bench 21813.0.2 ad618596c16b */
/* bench 21813.0.3 1fb1ecac702c */
/* bench 21813.0.4 8fb22259a7d9 */
/* bench 21813.0.5 8f100a3e492c */
/* bench 21813.0.6 3e4372cc54cb */
/* bench 21813.0.7 f43ee9a00836 */
/* bench 21813.0.8 c2e4e8cbc4ea */
/* bench 21813.0.9 dcc601152e1b */
	pinctrl-0 = <&auart0_2pins_a>;

	qca7000: ethernet {
		compatible = "qca,qca7000";
		local-mac-address = [ A0 B0 C0 D0 E0 F0 ];
		current-speed = <38400>;
	};
};
```
