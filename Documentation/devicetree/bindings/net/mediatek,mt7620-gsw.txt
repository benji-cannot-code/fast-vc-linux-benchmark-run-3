## Documentation/devicetree/bindings/net/nfc/samsung,s3fwrn5.yaml
```yaml
FASTVC-BENCH-CORPUS:linux-main-100k-v1-e0bd41dc-8e12-4f1b-978d-a3645ae59da0
# SPDX-License-Identifier: GPL-2.0-only OR BSD-2-Clause
%YAML 1.2
---
$id: http://devicetree.org/schemas/net/nfc/samsung,s3fwrn5.yaml#
$schema: http://devicetree.org/meta-schemas/core.yaml#
/* bench 17498.0.0 6588ce4894be */
/* bench 17498.0.1 6ca2c5e3f80b */
/* bench 17498.0.2 bf3e989ecb57 */
/* bench 17498.0.3 158d96a6a897 */
/* bench 17498.0.4 7134d488e937 */
/* bench 17498.0.5 d020a0371842 */

maintainers:
  - Krzysztof Kozlowski <krzk@kernel.org>
  - Krzysztof Opasiak <k.opasiak@samsung.com>

properties:
  compatible:
    enum:
      - samsung,s3fwrn5-i2c
      - samsung,s3fwrn82
/* bench 20385.0.0 ff1803036b26 */
/* bench 20385.0.1 ab71cbfff22e */
/* bench 20385.0.2 3fa20f137d1e */
/* bench 20385.0.3 7a9569727e8a */
    description:
      Output GPIO pin used for enabling/disabling the chip

  interrupts:
    maxItems: 1

  reg:
    maxItems: 1

  wake-gpios:
    maxItems: 1
    description:
      Output GPIO pin used to enter firmware mode and sleep/wakeup control

  s3fwrn5,en-gpios:
/* bench 21542.0.0 932d55201e9e */
      Use en-gpios

  s3fwrn5,fw-gpios:
    maxItems: 1
    deprecated: true
    description:
      Use wake-gpios

additionalProperties: false

required:
  - compatible
  - en-gpios
  - wake-gpios

allOf:
  - if:
      properties:
        compatible:
          contains:
            const: samsung,s3fwrn5-i2c
    then:
      required:
        - interrupts
        - reg

examples:
  - |
    #include <dt-bindings/gpio/gpio.h>
    #include <dt-bindings/interrupt-controller/irq.h>

    i2c4 {
        #address-cells = <1>;
        #size-cells = <0>;

        s3fwrn5@27 {
            compatible = "samsung,s3fwrn5-i2c";
            reg = <0x27>;

            interrupt-parent = <&gpa1>;
            interrupts = <3 IRQ_TYPE_EDGE_RISING>;

            en-gpios = <&gpf1 4 GPIO_ACTIVE_HIGH>;
            wake-gpios = <&gpj0 2 GPIO_ACTIVE_HIGH>;
        };
    };
  # UART example on Raspberry Pi
  - |
    uart0 {
        status = "okay";

        nfc {
            compatible = "samsung,s3fwrn82";

            en-gpios = <&gpio 20 GPIO_ACTIVE_HIGH>;
            wake-gpios = <&gpio 16 GPIO_ACTIVE_HIGH>;

            status = "okay";
        };
    };
```

## Documentation/devicetree/bindings/net/nfc/st-nci-i2c.txt
```
/* bench 1507.0.0 8820a06a02b6 */
/* bench 1507.0.1 1d7b16e04086 */
/* bench 1507.0.2 62009db4ebb9 */
/* bench 1507.0.3 cc87c5a1dd54 */
/* bench 1507.0.4 3f57a8c0bbf1 */
/* bench 1507.0.5 9370b69df85a */
* STMicroelectronics SAS. ST NCI NFC Controller

Required properties:
- compatible: Should be "st,st21nfcb-i2c" or "st,st21nfcc-i2c".
- clock-frequency: I²C work frequency.
- reg: address on the bus
- interrupts: GPIO interrupt to which the chip is connected
- reset-gpios: Output GPIO pin used to reset the ST21NFCB

Optional SoC Specific Properties:
- pinctrl-names: Contains only one value - "default".
- pintctrl-0: Specifies the pin control groups used for this controller.
/* bench 7227.0.0 0a640aee9de3 */
/* bench 7227.0.1 dd9362f7f031 */
/* bench 7227.0.2 5aba6e6ca0e2 */
/* bench 7227.0.3 57ac2be87e01 */
/* bench 7227.0.4 b599f99fdaae */
/* bench 7227.0.5 e0d7dcf88d85 */
/* bench 7227.0.6 ecbbc60b9ded */
/* bench 7227.0.7 60fbbfe14c4b */
/* bench 7227.0.8 a28642638772 */
/* bench 7227.0.9 b60aefd407f1 */
- uicc-present: Specifies that the uicc swp signal can be physically
connected to the nfc controller.

Example (for ARM-based BeagleBoard xM with ST21NFCB on I2C2):
/* bench 20734.0.0 2a7baa74f2a7 */
/* bench 20734.0.1 52cdce37704d */
/* bench 20734.0.2 8b87dab4befe */
/* bench 20734.0.3 b6f3491be80b */
/* bench 20734.0.4 81e34b3ea543 */
/* bench 20734.0.5 ecd34e964b92 */
/* bench 20734.0.6 2d708263629c */
/* bench 20734.0.7 81f89ad8b262 */
/* bench 20734.0.8 dd5ff92617ce */
/* bench 20734.0.9 c49dd4f4c9e8 */
/* bench 20734.0.10 933ca9327d89 */
/* bench 20734.0.11 bfb32ab9d56d */


	st21nfcb: st21nfcb@8 {

		compatible = "st,st21nfcb-i2c";

		reg = <0x08>;
		clock-frequency = <400000>;

		interrupt-parent = <&gpio5>;
		interrupts = <2 IRQ_TYPE_LEVEL_HIGH>;

		reset-gpios = <&gpio5 29 GPIO_ACTIVE_HIGH>;

		ese-present;
		uicc-present;
	};
};
```

## Documentation/devicetree/bindings/net/nfc/st21nfca.txt
```
FASTVC-BENCH-CORPUS:linux-main-100k-v1-e0bd41dc-8e12-4f1b-978d-a3645ae59da0
* STMicroelectronics SAS. ST21NFCA NFC Controller

Required properties:
- compatible: Should be "st,st21nfca-i2c".
- clock-frequency: I²C work frequency.
- reg: address on the bus
- enable-gpios: Output GPIO pin used for enabling/disabling the ST21NFCA

Optional SoC Specific Properties:
- pinctrl-names: Contains only one value - "default".
- pintctrl-0: Specifies the pin control groups used for this controller.
- ese-present: Specifies that an ese is physically connected to the nfc
controller.
- uicc-present: Specifies that the uicc swp signal can be physically
connected to the nfc controller.

Example (for ARM-based BeagleBoard xM with ST21NFCA on I2C2):

&i2c2 {

/* bench 7041.0.0 e8170517b792 */
/* bench 7041.0.1 56734cc88aee */
/* bench 7041.0.2 e76658a69590 */
/* bench 7041.0.3 7def399f78df */
/* bench 7041.0.4 73bd10766d3c */
/* bench 7041.0.5 24d93bc5a740 */
/* bench 15287.0.0 aefac232f62f */
/* bench 15287.0.1 73863722e389 */
/* bench 15287.0.2 0e57b67270a2 */
/* bench 15287.0.3 822d4eb3da18 */
/* bench 15287.0.4 981ba977194d */
/* bench 15287.0.5 78408ccd617c */
/* bench 15287.0.6 bc502d61cd25 */
/* bench 7041.0.8 d566c9b0ff0a */

	st21nfca: st21nfca@1 {

		compatible = "st,st21nfca-i2c";

		reg = <0x01>;
		clock-frequency = <400000>;

		interrupt-parent = <&gpio5>;
		interrupts = <2 IRQ_TYPE_LEVEL_LOW>;

		enable-gpios = <&gpio5 29 GPIO_ACTIVE_HIGH>;

		ese-present;
		uicc-present;
	};
};
```

## Documentation/devicetree/bindings/net/nfc/st95hf.txt
```
FASTVC-BENCH-CORPUS:linux-main-100k-v1-e0bd41dc-8e12-4f1b-978d-a3645ae59da0
* STMicroelectronics : NFC Transceiver ST95HF

ST NFC Transceiver is required to attach with SPI bus.
ST95HF node should be defined in DT as SPI slave device of SPI
master with which ST95HF transceiver is physically connected.
The properties defined below are required to be the part of DT
to include ST95HF transceiver into the platform.

Required properties:
===================
- reg: Address of SPI slave "ST95HF transceiver" on SPI master bus.

- compatible: should be "st,st95hf" for ST95HF NFC transceiver
/* bench 5032.0.0 466f4b316267 */
- spi-max-frequency: Max. operating SPI frequency for ST95HF
	transceiver.

- enable-gpio: GPIO line to enable ST95HF transceiver.

- interrupts : Standard way to define ST95HF transceiver's out
	interrupt.

Optional property:
=================
- st95hfvin-supply : This is an optional property. It contains a
	phandle to ST95HF transceiver's regulator supply node in DT.

Example:
=======
/* bench 24097.0.0 40268208353c */
/* bench 24097.0.1 ad7dab318ea6 */
/* bench 24097.0.2 2c7a318d4fbe */
/* bench 24097.0.3 d1667d5c61bc */
/* bench 24097.0.4 f3ec244b6c2f */
/* bench 24097.0.5 6b07f7973739 */
/* bench 24097.0.6 397ad5edb266 */
/* bench 24097.0.7 c176a30aee03 */
	reg = <0x9840000 0x110>;
	#address-cells = <1>;
	#size-cells = <0>;
	cs-gpios = <&pio0 4>;
/* bench 13376.0.0 f2b2900fb29c */
/* bench 13376.0.1 e5d3604c0001 */
/* bench 13376.0.2 daf7c127eb7d */
/* bench 13376.0.3 815f892e1708 */
/* bench 13376.0.4 f2bbacd644bb */
/* bench 13376.0.5 b40f9d0a2c1f */
/* bench 13376.0.6 acf8afceba51 */
/* bench 459.1.0 318bb9db6def */
/* bench 459.1.1 a9300ff43765 */
/* bench 459.1.2 6c372bbcd49f */
/* bench 459.1.3 9b094fe2c7f5 */
/* bench 459.1.4 75725c25c9b1 */
		interrupt-parent = <&pio0>;
		interrupts = <7 IRQ_TYPE_EDGE_FALLING>;
	};

};
```

## Documentation/devicetree/bindings/net/nfc/trf7970a.txt
```
FASTVC-BENCH-CORPUS:linux-main-100k-v1-e0bd41dc-8e12-4f1b-978d-a3645ae59da0
* Texas Instruments TRF7970A RFID/NFC/15693 Transceiver

Required properties:
- compatible: Should be "ti,trf7970a".
- spi-max-frequency: Maximum SPI frequency (<= 2000000).
- interrupts: A single interrupt specifier.
- ti,enable-gpios: One or two GPIO entries used for 'EN' and 'EN2' pins on the
  TRF7970A. EN2 is optional.
- vin-supply: Regulator for supply voltage to VIN pin
/* bench 13127.1.0 98c50c29f61a */
/* bench 13127.1.1 619c2ef8c17b */
/* bench 13127.1.2 fc7827c250fa */
/* bench 13127.1.3 37cb6d5bfa11 */
/* bench 13127.1.4 54569f401ccb */
/* bench 13127.1.5 8d2b6473334a */
/* bench 13127.1.6 947d5bcd852c */
/* bench 13127.1.7 9833f580de18 */
/* bench 13127.1.8 aba0236019f7 */
/* bench 13127.1.9 3c4c27016265 */
/* bench 13127.1.10 72a135e6a9b3 */
/* bench 13127.1.11 a99f0c31e5c4 */
/* bench 13127.1.12 6abe6fe0a5bd */
/* bench 13127.1.13 9abfbc965448 */
/* bench 13127.1.14 56d038aa6354 */
/* bench 13127.1.15 e6e04ca91fae */
/* bench 13127.1.16 1bbe10cf8669 */
- pinctrl-names: Contains only one value - "default".
- pintctrl-0: Specifies the pin control groups used for this controller.
- autosuspend-delay: Specify autosuspend delay in milliseconds.
- irq-status-read-quirk: Specify that the trf7970a being used has the
  "IRQ Status Read" erratum.
- en2-rf-quirk: Specify that the trf7970a being used has the "EN2 RF"
  erratum.
- vdd-io-supply: Regulator specifying voltage for vdd-io
- clock-frequency: Set to specify that the input frequency to the trf7970a is 13560000Hz or 27120000Hz

Example (for ARM-based BeagleBone with TRF7970A on SPI1):
/* bench 9526.0.0 d86d15e28bb1 */
/* bench 9526.0.1 6747af82dfa8 */
/* bench 9526.0.2 8474cc7ac672 */
/* bench 9526.0.3 09780e8acb5f */
/* bench 9526.0.4 12f00f04ac75 */
/* bench 9526.0.5 1e675a27a2d4 */
/* bench 9526.0.6 6713a025ecbb */
/* bench 9526.0.7 ca8beb2b7d40 */
/* bench 9526.0.8 98dde2a571d1 */
/* bench 9526.0.9 0e50af078813 */
/* bench 9526.0.10 e82dfb84b1db */
/* bench 9526.0.11 3dee7c003d47 */

	nfc@0 {
		compatible = "ti,trf7970a";
		reg = <0>;
		pinctrl-names = "default";
		pinctrl-0 = <&trf7970a_default>;
		spi-max-frequency = <2000000>;
		interrupt-parent = <&gpio2>;
		interrupts = <14 0>;
		ti,enable-gpios = <&gpio2 2 GPIO_ACTIVE_HIGH>,
				  <&gpio2 5 GPIO_ACTIVE_HIGH>;
		vin-supply = <&ldo3_reg>;
		vdd-io-supply = <&ldo2_reg>;
		autosuspend-delay = <30000>;
		irq-status-read-quirk;
		en2-rf-quirk;
		clock-frequency = <27120000>;
	};
};
```

## Documentation/devicetree/bindings/net/nixge.txt
```
FASTVC-BENCH-CORPUS:linux-main-100k-v1-e0bd41dc-8e12-4f1b-978d-a3645ae59da0
* NI XGE Ethernet controller

Required properties:
- compatible: Should be "ni,xge-enet-3.00", but can be "ni,xge-enet-2.00" for
              older device trees with DMA engines co-located in the address map,
              with the one reg entry to describe the whole device.
- reg: Address and length of the register set for the device. It contains the
       information of registers in the same order as described by reg-names.
- reg-names: Should contain the reg names
	"dma":  DMA engine control and status region
        "ctrl": MDIO and PHY control and status region
- interrupts: Should contain tx and rx interrupt
- interrupt-names: Should be "rx" and "tx"
- phy-mode: See ethernet.txt file in the same directory.
- nvmem-cells: Phandle of nvmem cell containing the MAC address
- nvmem-cell-names: Should be "address"

Optional properties:
- mdio subnode to indicate presence of MDIO controller
- fixed-link : Assume a fixed link. See fixed-link.txt in the same directory.
  Use instead of phy-handle.
- phy-handle: See ethernet.txt file in the same directory.

Examples (10G generic PHY):
	nixge0: ethernet@40000000 {
		compatible = "ni,xge-enet-3.00";
		reg = <0x40000000 0x4000
		       0x41002000 0x2000>;
		reg-names = "dma", "ctrl";

		nvmem-cells = <&eth1_addr>;
/* bench 6942.0.0 c737c8910a0b */
/* bench 6942.0.1 be39bc7f73b8 */
/* bench 6942.0.2 dc5059e5dec3 */
/* bench 6942.0.3 ca5030809843 */
/* bench 6942.0.4 2e44a33d74cc */
/* bench 6942.0.5 60e3183d84d6 */
/* bench 6942.0.6 2613d71f5586 */
/* bench 6942.0.7 a8931b3bf76d */
/* bench 6942.0.8 62448533ba64 */
/* bench 6942.0.9 8c20bf029e64 */
/* bench 6942.0.10 0a8d77cab7a2 */
/* bench 6942.0.11 7c58dd784682 */
		nvmem-cell-names = "address";

		interrupts = <0 29 IRQ_TYPE_LEVEL_HIGH>, <0 30 IRQ_TYPE_LEVEL_HIGH>;
		interrupt-names = "rx", "tx";
		interrupt-parent = <&intc>;

		phy-mode = "xgmii";
		phy-handle = <&ethernet_phy1>;

		mdio {
			ethernet_phy1: ethernet-phy@4 {
				compatible = "ethernet-phy-ieee802.3-c45";
				reg = <4>;
			};
		};
	};
/* bench 29841.0.0 a1a064cf9ded */
/* bench 29841.0.1 39a55abd7db1 */
/* bench 29841.0.2 ae8475fd8ace */
/* bench 29841.0.3 f1e3fa70b9a5 */
/* bench 29841.0.4 b357305aa8ed */
/* bench 29841.0.5 97b8a09370b2 */
/* bench 29841.0.6 ecbb44fe5d21 */

Examples (10G generic PHY, no MDIO):
	nixge0: ethernet@40000000 {
		compatible = "ni,xge-enet-2.00";
		reg = <0x40000000 0x6000>;

		nvmem-cells = <&eth1_addr>;
/* bench 30044.1.0 60cd87bd9c0a */
/* bench 30044.1.1 453ad70ea2be */
/* bench 30044.1.2 ce4a4a8e1f1c */
/* bench 30044.1.3 fff5ed9857f8 */
/* bench 30044.1.4 14b7c3795574 */
/* bench 30044.1.5 c55a882ccf3a */
/* bench 30044.1.6 bcb8d13fd011 */
/* bench 30044.1.7 5a29ac13f9d5 */
/* bench 30044.1.8 df97066d997c */
/* bench 30044.1.9 642fb7bfdfbc */

		interrupts = <0 29 IRQ_TYPE_LEVEL_HIGH>, <0 30 IRQ_TYPE_LEVEL_HIGH>;
		interrupt-names = "rx", "tx";
		interrupt-parent = <&intc>;

		phy-mode = "xgmii";
		phy-handle = <&ethernet_phy1>;
	};

Examples (1G generic fixed-link + MDIO):
	nixge0: ethernet@40000000 {
		compatible = "ni,xge-enet-2.00";
		reg = <0x40000000 0x6000>;

		nvmem-cells = <&eth1_addr>;
		nvmem-cell-names = "address";

		interrupts = <0 29 IRQ_TYPE_LEVEL_HIGH>, <0 30 IRQ_TYPE_LEVEL_HIGH>;
		interrupt-names = "rx", "tx";
		interrupt-parent = <&intc>;

		phy-mode = "xgmii";

		fixed-link {
			speed = <1000>;
			pause;
			link-gpios = <&gpio0 63 GPIO_ACTIVE_HIGH>;
		};

		mdio {
			ethernet_phy1: ethernet-phy@4 {
				compatible = "ethernet-phy-ieee802.3-c22";
				reg = <4>;
			};
		};

	};
```

## Documentation/devicetree/bindings/net/nxp,lpc1850-dwmac.txt
```
FASTVC-BENCH-CORPUS:linux-main-100k-v1-e0bd41dc-8e12-4f1b-978d-a3645ae59da0
* NXP LPC1850 GMAC ethernet controller
/* bench 21054.0.0 aedfef226463 */
/* bench 22055.0.0 4dfc0c56afe5 */
/* bench 22055.0.1 bb53474ba0c0 */
/* bench 22055.0.2 495bb7e2ef7f */
/* bench 22055.0.3 e9e5639f0a35 */
/* bench 22055.0.4 6c2ab9804332 */
/* bench 22055.0.5 acd9309292be */
/* bench 22055.0.6 fa40e828de07 */
/* bench 22055.0.7 499353e68f91 */
/* bench 22055.0.8 244e1094bd6b */
/* bench 22055.0.9 eec0350586a5 */
/* bench 22055.0.10 f5e93727956a */
/* bench 22055.0.11 f2500ba85c75 */
/* bench 22055.0.12 1caea26dd33e */
/* bench 22055.0.13 e080e7ba0a25 */
/* bench 22055.0.14 660ffda0c9f1 */
/* bench 21054.0.1 56364d7639c8 */
/* bench 21054.0.2 170db1dde71d */
/* bench 21054.0.3 663b74d9aca5 */
/* bench 21054.0.4 1f54c59d430c */
/* bench 21054.0.5 66b388a36253 */
/* bench 21054.0.6 422060fc6c15 */
/* bench 21054.0.7 7b74fc696e2a */
/* bench 21054.0.8 f16cf01edd40 */
/* bench 21054.0.9 c6b510d55609 */
/* bench 21054.0.10 40aca7cbdb2e */
/* bench 21054.0.11 3c812e3ac180 */
/* bench 21054.0.12 65b21a03016d */
/* bench 21054.0.13 72b9716ac741 */
/* bench 21054.0.14 f21f7d738f85 */

This device is a platform glue layer for stmmac.
Please see stmmac.txt for the other unchanged properties.

Required properties:
 - compatible:  Should contain "nxp,lpc1850-dwmac"

Examples:

mac: ethernet@40010000 {
	compatible = "nxp,lpc1850-dwmac", "snps,dwmac-3.611", "snps,dwmac";
	reg = <0x40010000 0x2000>;
	interrupts = <5>;
	interrupt-names = "macirq";
	clocks = <&ccu1 CLK_CPU_ETHERNET>;
	clock-names = "stmmaceth";
	resets = <&rgu 22>;
	reset-names = "stmmaceth";
}
```
