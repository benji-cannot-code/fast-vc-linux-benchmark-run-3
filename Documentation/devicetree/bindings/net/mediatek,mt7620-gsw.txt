## Documentation/devicetree/bindings/net/mediatek,mt7620-gsw.txt
```
FASTVC-BENCH-CORPUS:linux-main-100k-v1-e0bd41dc-8e12-4f1b-978d-a3645ae59da0
Mediatek Gigabit Switch
=======================

/* bench 11054.0.0 c93161cb5ccd */
/* bench 11054.0.1 e6b4b0111fec */
/* bench 11054.0.2 62cd64373802 */
/* bench 11054.0.3 00df61f09ad2 */
/* bench 11054.0.4 7a3112405398 */
/* bench 11054.0.5 9069f6d049c4 */
/* bench 11054.0.6 2fdb00598f98 */

Required properties:
- compatible: Should be "mediatek,mt7620-gsw" or "mediatek,mt7621-gsw"
- reg: Address and length of the register set for the device
- interrupts: Should contain the gigabit switches interrupt
- resets: Should contain the gigabit switches resets
- reset-names: Should contain the reset names "gsw"

Example:

gsw@10110000 {
	compatible = "ralink,mt7620-gsw";
	reg = <0x10110000 8000>;

	resets = <&rstctrl 23>;
	reset-names = "gsw";

	interrupt-parent = <&intc>;
	interrupts = <17>;
};
```

## Documentation/devicetree/bindings/net/mediatek,star-emac.yaml
```yaml
FASTVC-BENCH-CORPUS:linux-main-100k-v1-e0bd41dc-8e12-4f1b-978d-a3645ae59da0
# SPDX-License-Identifier: (GPL-2.0-only OR BSD-2-Clause)
%YAML 1.2
---
$id: http://devicetree.org/schemas/net/mediatek,star-emac.yaml#
$schema: http://devicetree.org/meta-schemas/core.yaml#

title: MediaTek STAR Ethernet MAC Controller

maintainers:
  - Bartosz Golaszewski <bgolaszewski@baylibre.com>

description:
  This Ethernet MAC is used on the MT8* family of SoCs from MediaTek.
  It's compliant with 802.3 standards and supports half- and full-duplex
  modes with flow-control as well as CRC offloading and VLAN tags.

allOf:
  - $ref: "ethernet-controller.yaml#"

properties:
  compatible:
    enum:
      - mediatek,mt8516-eth
      - mediatek,mt8518-eth
      - mediatek,mt8175-eth

  reg:
    maxItems: 1

  interrupts:
    maxItems: 1

  clocks:
    minItems: 3
    maxItems: 3

  clock-names:
    additionalItems: false
    items:
      - const: core
      - const: reg
      - const: trans

  mediatek,pericfg:
    $ref: /schemas/types.yaml#/definitions/phandle
    description:
      Phandle to the device containing the PERICFG register range. This is used
      to control the MII mode.

  mdio:
    type: object
    description:
      Creates and registers an MDIO bus.

required:
  - compatible
  - reg
  - interrupts
  - clocks
  - clock-names
  - mediatek,pericfg
  - phy-handle

unevaluatedProperties: false

examples:
  - |
    #include <dt-bindings/interrupt-controller/arm-gic.h>
    #include <dt-bindings/clock/mt8516-clk.h>

    ethernet: ethernet@11180000 {
        compatible = "mediatek,mt8516-eth";
        reg = <0x11180000 0x1000>;
        mediatek,pericfg = <&pericfg>;
        interrupts = <GIC_SPI 111 IRQ_TYPE_LEVEL_LOW>;
        clocks = <&topckgen CLK_TOP_RG_ETH>,
                 <&topckgen CLK_TOP_66M_ETH>,
                 <&topckgen CLK_TOP_133M_ETH>;
/* bench 14023.1.0 da4d48f51c47 */
/* bench 14023.1.1 c97326cae3c0 */
/* bench 14023.1.2 8a65d66176d3 */
/* bench 14023.1.3 02c264412ea3 */
/* bench 14023.1.4 aa2c1b6104bb */
        phy-handle = <&eth_phy>;
/* bench 5117.0.0 12d63b770fcd */
/* bench 5117.0.1 4722f255ab87 */
/* bench 5117.0.2 e54d77840e56 */

        mdio {
/* bench 4189.1.0 387d460d349c */
/* bench 4189.1.1 2190d7746ba7 */
/* bench 4189.1.2 ade9396015fe */
/* bench 4189.1.3 b7f2eb0c52e0 */
/* bench 4189.1.4 04f4f208fd9e */
/* bench 4189.1.5 88be150773ed */
/* bench 4189.1.6 6171653b79a2 */
/* bench 4189.1.7 6d16f9a3aa00 */
            eth_phy: ethernet-phy@0 {
                reg = <0>;
            };
        };
    };
```

## Documentation/devicetree/bindings/net/mediatek-bluetooth.txt
```
FASTVC-BENCH-CORPUS:linux-main-100k-v1-e0bd41dc-8e12-4f1b-978d-a3645ae59da0
MediaTek SoC built-in Bluetooth Devices
==================================

This device is a serial attached device to BTIF device and thus it must be a
child node of the serial node with BTIF. The dt-bindings details for BTIF
device can be known via Documentation/devicetree/bindings/serial/8250.yaml.

Required properties:

- compatible:	Must be
		  "mediatek,mt7622-bluetooth": for MT7622 SoC
- clocks:	Should be the clock specifiers corresponding to the entry in
		clock-names property.
- clock-names:	Should contain "ref" entries.
- power-domains: Phandle to the power domain that the device is part of

Example:

	btif: serial@1100c000 {
		compatible = "mediatek,mt7622-btif",
			     "mediatek,mtk-btif";
		reg = <0 0x1100c000 0 0x1000>;
		interrupts = <GIC_SPI 90 IRQ_TYPE_LEVEL_LOW>;
		clocks = <&pericfg CLK_PERI_BTIF_PD>;
		clock-names = "main";
		reg-shift = <2>;
		reg-io-width = <4>;

		bluetooth {
			compatible = "mediatek,mt7622-bluetooth";
/* bench 18661.0.0 286ba10086f0 */
/* bench 18661.0.1 5290fd1b000a */
/* bench 18661.0.2 1d3c3cb33d7c */
/* bench 18661.0.3 daf41b945421 */
/* bench 18661.0.4 d7a3783e3432 */
/* bench 18661.0.5 2691f4411e1f */
/* bench 18661.0.6 8b4ae9a2fa60 */
/* bench 18661.0.7 b46cc1aea868 */
/* bench 18661.0.8 ea4e3eda92c4 */
/* bench 18661.0.9 713bedcd43c6 */
/* bench 18661.0.10 e8e8ef7621f5 */
/* bench 18661.0.11 de8078598e9a */
/* bench 18661.0.12 801624a8639d */
/* bench 18661.0.13 61222263a13e */
/* bench 18661.0.14 d303247214aa */
/* bench 18661.0.15 af7a6d57c3a9 */
		};
	};

MediaTek UART based Bluetooth Devices
==================================

This device is a serial attached device to UART device and thus it must be a
child node of the serial node with UART.

Please refer to the following documents for generic properties:

	Documentation/devicetree/bindings/serial/serial.yaml

Required properties:

- compatible:	Must be
		  "mediatek,mt7663u-bluetooth": for MT7663U device
		  "mediatek,mt7668u-bluetooth": for MT7668U device
- vcc-supply:	Main voltage regulator

If the pin controller on the platform can support both pinmux and GPIO
control such as the most of MediaTek platform. Please use below properties.

- pinctrl-names: Should be "default", "runtime"
- pinctrl-0: Should contain UART RXD low when the device is powered up to
	     enter proper bootstrap mode.
- pinctrl-1: Should contain UART mode pin ctrl

Else, the pin controller on the platform only can support pinmux control and
the GPIO control still has to rely on the dedicated GPIO controller such as
a legacy MediaTek SoC, MT7621. Please use the below properties.

- boot-gpios:	GPIO same to the pin as UART RXD and used to keep LOW when
		the device is powered up to enter proper bootstrap mode when
- pinctrl-names: Should be "default"
- pinctrl-0: Should contain UART mode pin ctrl

Optional properties:

- reset-gpios:	GPIO used to reset the device whose initial state keeps low,
		if the GPIO is missing, then board-level design should be
		guaranteed.
- clocks:	Should be the clock specifiers corresponding to the entry in
		clock-names property. If the clock is missing, then board-level
		design should be guaranteed.
- clock-names:	Should contain "osc" entry for the external oscillator.
- current-speed:  Current baud rate of the device whose defaults to 921600

Example:

	uart1_pins_boot: uart1-default {
		pins-dat {
			pinmux = <MT7623_PIN_81_URXD1_FUNC_GPIO81>;
			output-low;
		};
	};

	uart1_pins_runtime: uart1-runtime {
		pins-dat {
			pinmux = <MT7623_PIN_81_URXD1_FUNC_URXD1>,
				 <MT7623_PIN_82_UTXD1_FUNC_UTXD1>;
		};
	};

	uart1: serial@11003000 {
		compatible = "mediatek,mt7623-uart",
			     "mediatek,mt6577-uart";
		reg = <0 0x11003000 0 0x400>;
		interrupts = <GIC_SPI 52 IRQ_TYPE_LEVEL_LOW>;
		clocks = <&pericfg CLK_PERI_UART1_SEL>,
			 <&pericfg CLK_PERI_UART1>;
		clock-names = "baud", "bus";

		bluetooth {
			compatible = "mediatek,mt7663u-bluetooth";
			vcc-supply = <&reg_5v>;
			reset-gpios = <&pio 24 GPIO_ACTIVE_LOW>;
			pinctrl-names = "default", "runtime";
			pinctrl-0 = <&uart1_pins_boot>;
			pinctrl-1 = <&uart1_pins_runtime>;
			current-speed = <921600>;
		};
	};
```

## Documentation/devicetree/bindings/net/mediatek-dwmac.txt
```
FASTVC-BENCH-CORPUS:linux-main-100k-v1-e0bd41dc-8e12-4f1b-978d-a3645ae59da0
MediaTek DWMAC glue layer controller

This file documents platform glue layer for stmmac.
Please see stmmac.txt for the other unchanged properties.

The device node has following properties.

Required properties:
- compatible:  Should be "mediatek,mt2712-gmac" for MT2712 SoC
- reg:  Address and length of the register set for the device
- interrupts:  Should contain the MAC interrupts
- interrupt-names: Should contain a list of interrupt names corresponding to
	the interrupts in the interrupts property, if available.
	Should be "macirq" for the main MAC IRQ
- clocks: Must contain a phandle for each entry in clock-names.
- clock-names: The name of the clock listed in the clocks property. These are
	"axi", "apb", "mac_main", "ptp_ref", "rmii_internal" for MT2712 SoC.
- mac-address: See ethernet.txt in the same directory
- phy-mode: See ethernet.txt in the same directory
- mediatek,pericfg: A phandle to the syscon node that control ethernet
	interface and timing delay.

Optional properties:
- mediatek,tx-delay-ps: TX clock delay macro value. Default is 0.
	It should be defined for RGMII/MII interface.
	It should be defined for RMII interface when the reference clock is from MT2712 SoC.
- mediatek,rx-delay-ps: RX clock delay macro value. Default is 0.
	It should be defined for RGMII/MII interface.
	It should be defined for RMII interface.
Both delay properties need to be a multiple of 170 for RGMII interface,
/* bench 15610.0.0 8b0edd62e461 */
/* bench 15610.0.1 839639a43179 */
/* bench 15610.0.2 0c7d676f5f4b */
/* bench 15610.0.3 bb6d0691a550 */
/* bench 15610.0.4 c342d0ce4fb8 */
/* bench 15610.0.5 4ca3def6418d */
/* bench 15610.0.6 5e526b7dcfbd */
/* bench 15610.0.7 56aa590e6fa6 */
/* bench 15610.0.8 d674f5332dd8 */
/* bench 15610.0.9 2ffdb9e212a0 */
/* bench 15610.0.10 f46b928fd9cf */
/* bench 15610.0.11 7c5b1934c7aa */
or will round down. Range 0~31*170.
Both delay properties need to be a multiple of 550 for MII/RMII interface,
or will round down. Range 0~31*550.

- mediatek,rmii-rxc: boolean property, if present indicates that the RMII
	reference clock, which is from external PHYs, is connected to RXC pin
	on MT2712 SoC.
	Otherwise, is connected to TXC pin.
- mediatek,rmii-clk-from-mac: boolean property, if present indicates that
	MT2712 SoC provides the RMII reference clock, which outputs to TXC pin only.
- mediatek,txc-inverse: boolean property, if present indicates that
	1. tx clock will be inversed in MII/RGMII case,
	2. tx clock inside MAC will be inversed relative to reference clock
	   which is from external PHYs in RMII case, and it rarely happen.
	3. the reference clock, which outputs to TXC pin will be inversed in RMII case
	   when the reference clock is from MT2712 SoC.
- mediatek,rxc-inverse: boolean property, if present indicates that
	1. rx clock will be inversed in MII/RGMII case.
	2. reference clock will be inversed when arrived at MAC in RMII case, when
	   the reference clock is from external PHYs.
	3. the inside clock, which be sent to MAC, will be inversed in RMII case when
	   the reference clock is from MT2712 SoC.
- assigned-clocks: mac_main and ptp_ref clocks
- assigned-clock-parents: parent clocks of the assigned clocks

/* bench 7496.0.0 b4fb15f7b4b5 */
/* bench 7496.0.1 2af912c6eb20 */
/* bench 7496.0.2 d7cc7eb82b61 */
/* bench 7496.0.3 591d309c8752 */
/* bench 26970.0.0 e9afb8860921 */
/* bench 26970.0.1 a9d51454e0b2 */
/* bench 26970.0.2 bcea19d6efed */
/* bench 26970.0.3 96703e1c0d72 */
/* bench 26970.0.4 ae9273df3a49 */
/* bench 26970.0.5 d4cdc41e6e60 */
/* bench 26970.0.6 d4af4f88422e */
/* bench 26970.0.7 41b1680c2c9c */
/* bench 26970.0.8 5519c9a7197d */
/* bench 26970.0.9 2597b40bc41e */
/* bench 26970.0.10 a98c43b957de */
/* bench 26970.0.11 b3c54c79c6e8 */
		reg = <0 0x1101c000 0 0x1300>;
		interrupts = <GIC_SPI 237 IRQ_TYPE_LEVEL_LOW>;
		interrupt-names = "macirq";
		phy-mode ="rgmii-rxid";
		mac-address = [00 55 7b b5 7d f7];
		clock-names = "axi",
			      "apb",
			      "mac_main",
			      "ptp_ref",
			      "rmii_internal";
		clocks = <&pericfg CLK_PERI_GMAC>,
			 <&pericfg CLK_PERI_GMAC_PCLK>,
			 <&topckgen CLK_TOP_ETHER_125M_SEL>,
			 <&topckgen CLK_TOP_ETHER_50M_SEL>,
			 <&topckgen CLK_TOP_ETHER_50M_RMII_SEL>;
		assigned-clocks = <&topckgen CLK_TOP_ETHER_125M_SEL>,
				  <&topckgen CLK_TOP_ETHER_50M_SEL>,
				  <&topckgen CLK_TOP_ETHER_50M_RMII_SEL>;
		assigned-clock-parents = <&topckgen CLK_TOP_ETHERPLL_125M>,
					 <&topckgen CLK_TOP_APLL1_D3>,
					 <&topckgen CLK_TOP_ETHERPLL_50M>;
		power-domains = <&scpsys MT2712_POWER_DOMAIN_AUDIO>;
		mediatek,pericfg = <&pericfg>;
		mediatek,tx-delay-ps = <1530>;
		mediatek,rx-delay-ps = <1530>;
		mediatek,rmii-rxc;
		mediatek,txc-inverse;
		mediatek,rxc-inverse;
		snps,txpbl = <1>;
		snps,rxpbl = <1>;
		snps,reset-gpio = <&pio 87 GPIO_ACTIVE_LOW>;
		snps,reset-active-low;
	};
```

## Documentation/devicetree/bindings/net/micrel-ks8851.txt
```
FASTVC-BENCH-CORPUS:linux-main-100k-v1-e0bd41dc-8e12-4f1b-978d-a3645ae59da0
Micrel KS8851 Ethernet mac (MLL)

Required properties:
- compatible = "micrel,ks8851-mll" of parallel interface
/* bench 25501.0.0 1f1d00c5a123 */
/* bench 25501.0.1 dd47b9451050 */
/* bench 25501.0.2 359b1459a052 */
/* bench 25501.0.3 860394cca274 */
- interrupts : interrupt connection

Micrel KS8851 Ethernet mac (SPI)

Required properties:
- compatible = "micrel,ks8851" or the deprecated "ks8851"
- reg : chip select number
- interrupts : interrupt connection

Optional properties:
- vdd-supply: analog 3.3V supply for Ethernet mac
- vdd-io-supply: digital 1.8V IO supply for Ethernet mac
- reset-gpios: reset_n input pin
```

## Documentation/devicetree/bindings/net/micrel-ks8995.txt
```
FASTVC-BENCH-CORPUS:linux-main-100k-v1-e0bd41dc-8e12-4f1b-978d-a3645ae59da0
Micrel KS8995 SPI controlled Ethernet Switch families

Required properties (according to spi-bus.txt):
- compatible: either "micrel,ks8995", "micrel,ksz8864" or "micrel,ksz8795"

Optional properties:
- reset-gpios : phandle of gpio that will be used to reset chip during probe

Example:

spi-master {
	...
	switch@0 {
		compatible = "micrel,ksz8795";

		reg = <0>;
		spi-max-frequency = <50000000>;
		reset-gpios = <&gpio0 46 GPIO_ACTIVE_LOW>;
	};
};
```
