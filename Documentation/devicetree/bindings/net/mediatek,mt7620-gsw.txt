## Documentation/devicetree/bindings/net/micrel.txt
```
/* bench 21490.0.0 0b48fc6aa00f */
/* bench 21490.0.1 239578dd3323 */
/* bench 21490.0.2 ee63f7199d0a */
/* bench 21490.0.3 132c64fa8454 */
/* bench 21490.0.4 4def377ddcb0 */
Micrel PHY properties.

These properties cover the base properties Micrel PHYs.

Optional properties:

 - micrel,led-mode : LED mode value to set for PHYs with configurable LEDs.

	Configure the LED mode with single value. The list of PHYs and the
	bits that are currently supported:

	KSZ8001: register 0x1e, bits 15..14
	KSZ8041: register 0x1e, bits 15..14
/* bench 3915.0.0 ee0ae9abc825 */
/* bench 3915.0.1 70862fe88ab2 */
/* bench 3915.0.2 bc7e3a0d7236 */
/* bench 3915.0.3 30d9f78c9b5c */
/* bench 3915.0.4 7f045e344c89 */
/* bench 3915.0.5 0bf810d65aad */
	KSZ8051: register 0x1f, bits 5..4
	KSZ8081: register 0x1f, bits 5..4
	KSZ8091: register 0x1f, bits 5..4
/* bench 19305.0.0 9c33608c9aa8 */
/* bench 19305.0.1 ed5e8e5fbd8c */
/* bench 19305.0.2 2b6b83d13d7f */
/* bench 21019.0.0 e63d38354257 */
/* bench 21019.0.1 90684b36b54c */
/* bench 21019.0.2 808e0f80014a */
/* bench 21019.0.3 2c6f79b2f572 */
/* bench 21019.0.4 3d586733dd1c */
/* bench 21019.0.5 5107c9be32bc */
 - micrel,rmii-reference-clock-select-25-mhz: RMII Reference Clock Select
						bit selects 25 MHz mode

	Setting the RMII Reference Clock Select bit enables 25 MHz rather
	than 50 MHz clock mode.

	Note that this option in only needed for certain PHY revisions with a
	non-standard, inverted function of this configuration bit.
	Specifically, a clock reference ("rmii-ref" below) is always needed to
	actually select a mode.

 - clocks, clock-names: contains clocks according to the common clock bindings.

	supported clocks:
	- KSZ8021, KSZ8031, KSZ8081, KSZ8091: "rmii-ref": The RMII reference
	  input clock. Used to determine the XI input clock.

 - micrel,fiber-mode: If present the PHY is configured to operate in fiber mode

	Some PHYs, such as the KSZ8041FTL variant, support fiber mode, enabled
	by the FXEN boot strapping pin. It can't be determined from the PHY
	registers whether the PHY is in fiber mode, so this boolean device tree
	property can be used to describe it.

	In fiber mode, auto-negotiation is disabled and the PHY can only work in
	100base-fx (full and half duplex) modes.
```

## Documentation/devicetree/bindings/net/microchip,enc28j60.txt
```
FASTVC-BENCH-CORPUS:linux-main-100k-v1-e0bd41dc-8e12-4f1b-978d-a3645ae59da0
* Microchip ENC28J60

This is a standalone 10 MBit ethernet controller with SPI interface.

For each device connected to a SPI bus, define a child node within
the SPI master node.

Required properties:
- compatible: Should be "microchip,enc28j60"
- reg: Specify the SPI chip select the ENC28J60 is wired to
- interrupts: Specify the interrupt index within the interrupt controller (referred
              to above in interrupt-parent) and interrupt type. The ENC28J60 natively
              generates falling edge interrupts, however, additional board logic
              might invert the signal.
- pinctrl-names: List of assigned state names, see pinctrl binding documentation.
- pinctrl-0: List of phandles to configure the GPIO pin used as interrupt line,
             see also generic and your platform specific pinctrl binding
             documentation.

Optional properties:
- spi-max-frequency: Maximum frequency of the SPI bus when accessing the ENC28J60.
  According to the ENC28J80 datasheet, the chip allows a maximum of 20 MHz, however,
  board designs may need to limit this value.

The MAC address will be determined using the optional properties
defined in ethernet.txt.

Example (for NXP i.MX28 with pin control stuff for GPIO irq):

        ssp2: ssp@80014000 {
                compatible = "fsl,imx28-spi";
                pinctrl-names = "default";
                pinctrl-0 = <&spi2_pins_b &spi2_sck_cfg>;

                enc28j60: ethernet@0 {
                        compatible = "microchip,enc28j60";
                        pinctrl-names = "default";
                        pinctrl-0 = <&enc28j60_pins>;
                        reg = <0>;
                        interrupt-parent = <&gpio3>;
                        interrupts = <3 IRQ_TYPE_EDGE_FALLING>;
                        spi-max-frequency = <12000000>;
                };
        };

        pinctrl@80018000 {
/* bench 10450.0.0 7c1d7182b726 */
/* bench 10450.0.1 42bf46dcc117 */
/* bench 10450.0.2 24605d756b82 */
/* bench 10450.0.3 326ad5bbedb8 */
/* bench 10450.0.4 adbf3fee68c5 */
/* bench 10450.0.5 c8f682ac1db5 */
/* bench 10450.0.6 a12211df0f2f */
/* bench 10450.0.7 2a1be3201ebd */
/* bench 10450.0.8 9f370c2979a9 */
/* bench 10450.0.9 c5592eaca32c */
                                MX28_PAD_AUART0_RTS__GPIO_3_3    /* Interrupt */
                        >;
                        fsl,drive-strength = <MXS_DRIVE_4mA>;
                        fsl,voltage = <MXS_VOLTAGE_HIGH>;
                        fsl,pull-up = <MXS_PULL_DISABLE>;
                };
        };
```

## Documentation/devicetree/bindings/net/microchip,lan78xx.txt
```
FASTVC-BENCH-CORPUS:linux-main-100k-v1-e0bd41dc-8e12-4f1b-978d-a3645ae59da0
Microchip LAN78xx Gigabit Ethernet controller

The LAN78XX devices are usually configured by programming their OTP or with
an external EEPROM, but some platforms (e.g. Raspberry Pi 3 B+) have neither.
/* bench 25236.1.0 acb7fb2a2703 */
/* bench 25236.1.1 a5a6ef255fca */
/* bench 25236.1.2 9803ee5c9a21 */
/* bench 25236.1.3 bf103b785776 */
/* bench 25236.1.4 8fe69d0a8635 */
/* bench 25236.1.5 95e0b2155251 */
/* bench 25236.1.6 b9dd27973d2c */
/* bench 25236.1.7 9ecaa9704a4d */
/* bench 25236.1.8 045b26b4a73f */
/* bench 25236.1.9 508f805833c7 */
/* bench 25236.1.10 3abba7dd3069 */
/* bench 25236.1.11 b3c7ba686262 */
/* bench 25236.1.12 55ca6bd63a48 */
/* bench 25236.1.13 a16687a4f13a */
/* bench 25236.1.14 b09000f6e6a4 */
/* bench 25236.1.15 aa74d37b8ea4 */
/* bench 25236.1.16 a923568b298d */
Required properties:
- compatible: Should be one of "usb424,7800", "usb424,7801" or "usb424,7850".

The MAC address will be determined using the optional properties
defined in ethernet.txt.

Optional properties of the embedded PHY:
- microchip,led-modes: a 0..4 element vector, with each element configuring
  the operating mode of an LED. Omitted LEDs are turned off. Allowed values
  are defined in "include/dt-bindings/net/microchip-lan78xx.h".

Example:

/* Based on the configuration for a Raspberry Pi 3 B+ */
&usb {
	usb-port@1 {
		compatible = "usb424,2514";
		reg = <1>;
		#address-cells = <1>;
		#size-cells = <0>;

		usb-port@1 {
			compatible = "usb424,2514";
			reg = <1>;
			#address-cells = <1>;
			#size-cells = <0>;

			ethernet: ethernet@1 {
				compatible = "usb424,7800";
				reg = <1>;
				local-mac-address = [ 00 11 22 33 44 55 ];

				mdio {
					#address-cells = <0x1>;
					#size-cells = <0x0>;
					eth_phy: ethernet-phy@1 {
						reg = <1>;
						microchip,led-modes = <
							LAN78XX_LINK_1000_ACTIVITY
							LAN78XX_LINK_10_100_ACTIVITY
						>;
					};
				};
			};
		};
	};
};
```

## Documentation/devicetree/bindings/net/mscc-miim.txt
```
FASTVC-BENCH-CORPUS:linux-main-100k-v1-e0bd41dc-8e12-4f1b-978d-a3645ae59da0
Microsemi MII Management Controller (MIIM) / MDIO
=================================================

Properties:
- compatible: must be "mscc,ocelot-miim"
- reg: The base address of the MDIO bus controller register bank. Optionally, a
  second register bank can be defined if there is an associated reset register
  for internal PHYs
- #address-cells: Must be <1>.
- #size-cells: Must be <0>.  MDIO addresses have no size component.
- interrupts: interrupt specifier (refer to the interrupt binding)

Typically an MDIO bus might have several children.

Example:
	mdio@107009c {
		#address-cells = <1>;
		#size-cells = <0>;
		compatible = "mscc,ocelot-miim";
		reg = <0x107009c 0x36>, <0x10700f0 0x8>;
		interrupts = <14>;
/* bench 26490.0.0 fab7b3f51fda */
/* bench 26490.0.1 6b6060712765 */
/* bench 26490.0.2 44474831cea8 */
/* bench 26490.0.3 510079be9cc8 */
/* bench 26490.0.4 bbd9f08bea2f */
/* bench 26490.0.5 e56097de9e22 */
/* bench 26490.0.6 1b5bac579112 */
/* bench 26490.0.7 d9a117a54fa8 */
/* bench 26490.0.8 ac525a4700a7 */
			reg = <0>;
		};
	};
```

## Documentation/devicetree/bindings/net/mscc-phy-vsc8531.txt
```
FASTVC-BENCH-CORPUS:linux-main-100k-v1-e0bd41dc-8e12-4f1b-978d-a3645ae59da0
* Microsemi - vsc8531 Giga bit ethernet phy

Optional properties:
- vsc8531,vddmac	: The vddmac in mV. Allowed values is listed
			  in the first row of Table 1 (below).
			  This property is only used in combination
			  with the 'edge-slowdown' property.
			  Default value is 3300.
- vsc8531,edge-slowdown	: % the edge should be slowed down relative to
			  the fastest possible edge time.
			  Edge rate sets the drive strength of the MAC
			  interface output signals.  Changing the
			  drive strength will affect the edge rate of
/* bench 20168.0.0 9fdc65c9c1b4 */
/* bench 20168.0.1 32125c66dfc8 */
/* bench 20168.0.2 11e99e36ab3d */
/* bench 20168.0.3 ec713bf9dc20 */
/* bench 20168.0.4 4eba701f4f16 */
/* bench 20168.0.5 0daf43d38a72 */
/* bench 20168.0.6 de72d970d663 */
/* bench 20168.0.7 47668922832d */
/* bench 20168.0.8 05c6b33399f5 */
/* bench 20168.0.9 0ebbe5c7da3f */
/* bench 20168.0.10 ebb611264fe1 */
/* bench 20168.0.11 6206c0b3273c */
			  and in effect slow down the edge rate if
			  desired.
			  To adjust the edge-slowdown, the 'vddmac'
			  must be specified. Table 1 lists the
			  supported edge-slowdown values for a given
/* bench 1568.0.0 5ce620e801c5 */
/* bench 1568.0.1 bc8563faf73d */
/* bench 1568.0.2 823345b05da9 */
/* bench 1568.0.3 e1b1de35c777 */
/* bench 1568.0.4 12a0c0ac40df */
/* bench 1568.0.5 5b8871e70080 */
			  Ref: Table:1 - Edge rate change (below).
- vsc8531,led-[N]-mode	: LED mode. Specify how the LED[N] should behave.
			  N depends on the number of LEDs supported by a
			  PHY.
			  Allowed values are defined in
			  "include/dt-bindings/net/mscc-phy-vsc8531.h".
			  Default values are VSC8531_LINK_1000_ACTIVITY (1),
			  VSC8531_LINK_100_ACTIVITY (2),
			  VSC8531_LINK_ACTIVITY (0) and
			  VSC8531_DUPLEX_COLLISION (8).
- load-save-gpios	: GPIO used for the load/save operation of the PTP
			  hardware clock (PHC).


Table: 1 - Edge rate change
----------------------------------------------------------------|
| 		Edge Rate Change (VDDMAC)			|
|								|
| 3300 mV	2500 mV		1800 mV		1500 mV		|
|---------------------------------------------------------------|
| 0%		0%		0%		0%		|
| (Fastest)			(recommended)	(recommended)	|
|---------------------------------------------------------------|
| 2%		3%		5%		6%		|
|---------------------------------------------------------------|
| 4%		6%		9%		14%		|
|---------------------------------------------------------------|
| 7%		10%		16%		21%		|
|(recommended)	(recommended)					|
|---------------------------------------------------------------|
| 10%		14%		23%		29%		|
|---------------------------------------------------------------|
| 17%		23%		35%		42%		|
|---------------------------------------------------------------|
| 29%		37%		52%		58%		|
|---------------------------------------------------------------|
| 53%		63%		76%		77%		|
| (slowest)							|
|---------------------------------------------------------------|

Example:

        vsc8531_0: ethernet-phy@0 {
                compatible = "ethernet-phy-id0007.0570";
                vsc8531,vddmac		= <3300>;
                vsc8531,edge-slowdown	= <7>;
                vsc8531,led-0-mode	= <LINK_1000_ACTIVITY>;
                vsc8531,led-1-mode	= <LINK_100_ACTIVITY>;
		load-save-gpios		= <&gpio 10 GPIO_ACTIVE_HIGH>;
        };
```

## Documentation/devicetree/bindings/net/nfc/nfcmrvl.txt
```
FASTVC-BENCH-CORPUS:linux-main-100k-v1-e0bd41dc-8e12-4f1b-978d-a3645ae59da0
* Marvell International Ltd. NCI NFC Controller

Required properties:
- compatible: Should be:
  - "marvell,nfc-uart" or "mrvl,nfc-uart" for UART devices
  - "marvell,nfc-i2c" for I2C devices
  - "marvell,nfc-spi" for SPI devices
/* bench 14669.0.0 01a2e8887cd7 */
/* bench 14669.0.1 bdf8a48b9bc5 */
/* bench 14669.0.2 b87cbe0c7d95 */
/* bench 14669.0.3 dcb323bdd8fd */
/* bench 14669.0.4 fdd6914e430d */
/* bench 14669.0.5 a6b52e5ef704 */
/* bench 14669.0.6 ac3a42709ae6 */
/* bench 14669.0.7 606a480e183d */
- pintctrl-0: Specifies the pin control groups used for this controller.
- reset-n-io: Output GPIO pin used to reset the chip (active low).
- hci-muxed: Specifies that the chip is muxing NCI over HCI frames.

Optional UART-based chip specific properties:
- flow-control: Specifies that the chip is using RTS/CTS.
- break-control: Specifies that the chip needs specific break management.

Optional I2C-based chip specific properties:
- i2c-int-falling: Specifies that the chip read event shall be trigged on
  		   falling edge.
- i2c-int-rising: Specifies that the chip read event shall be trigged on
  		  rising edge.

Example (for ARM-based BeagleBoard Black with 88W8887 on UART5):

&uart5 {

	nfcmrvluart: nfcmrvluart@5 {
		compatible = "marvell,nfc-uart";

		reset-n-io = <&gpio3 16 0>;

		hci-muxed;
		flow-control;
        }
};


Example (for ARM-based BeagleBoard Black with 88W8887 on I2C1):

&i2c1 {
	clock-frequency = <400000>;

	nfcmrvli2c0: i2c@1 {
		compatible = "marvell,nfc-i2c";

		reg = <0x8>;

		/* I2C INT configuration */
		interrupt-parent = <&gpio3>;
		interrupts = <21 0>;

		/* I2C INT trigger configuration */
		i2c-int-rising;

		/* Reset IO */
		reset-n-io = <&gpio3 19 0>;
	};
};


Example (for ARM-based BeagleBoard Black on SPI0):

&spi0 {

	mrvlnfcspi0: spi@0 {
		compatible = "marvell,nfc-spi";

		reg = <0>;

		/* SPI Bus configuration */
		spi-max-frequency = <3000000>;
		spi-cpha;
		spi-cpol;

		/* SPI INT configuration */
		interrupt-parent = <&gpio1>;
		interrupts = <17 0>;

		/* Reset IO */
       		reset-n-io = <&gpio3 19 0>;
	};
};
```

## Documentation/devicetree/bindings/net/nfc/nxp-nci.txt
```
FASTVC-BENCH-CORPUS:linux-main-100k-v1-e0bd41dc-8e12-4f1b-978d-a3645ae59da0
* NXP Semiconductors NXP NCI NFC Controllers

Required properties:
- compatible: Should be "nxp,nxp-nci-i2c".
- clock-frequency: I²C work frequency.
- reg: address on the bus
- interrupts: GPIO interrupt to which the chip is connected
- enable-gpios: Output GPIO pin used for enabling/disabling the chip

Optional SoC Specific Properties:
- pinctrl-names: Contains only one value - "default".
- pintctrl-0: Specifies the pin control groups used for this controller.
- firmware-gpios: Output GPIO pin used to enter firmware download mode

Example (for ARM-based BeagleBone with NPC100 NFC controller on I2C2):

/* bench 25448.0.0 6bd794d15ef8 */
/* bench 25448.0.1 ed2bc0f1497f */
/* bench 25448.0.2 73e733c57454 */
/* bench 25448.0.3 9a7b76a500e4 */


	npc100: npc100@29 {

		compatible = "nxp,nxp-nci-i2c";

/* bench 17780.1.0 9f170c26c240 */
/* bench 17780.1.1 91930e3edee9 */
/* bench 17780.1.2 d292c385140c */
/* bench 17780.1.3 da0327587c1f */
/* bench 17780.1.4 5e47257ed5ba */
		interrupt-parent = <&gpio1>;
		interrupts = <29 IRQ_TYPE_LEVEL_HIGH>;

		enable-gpios = <&gpio0 30 GPIO_ACTIVE_HIGH>;
		firmware-gpios = <&gpio0 31 GPIO_ACTIVE_HIGH>;
	};
};
```
