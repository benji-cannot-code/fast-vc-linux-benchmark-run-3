## Documentation/devicetree/bindings/ufs/ufshcd-pltfrm.txt
```
FASTVC-BENCH-CORPUS:linux-main-100k-v1-e0bd41dc-8e12-4f1b-978d-a3645ae59da0
* Universal Flash Storage (UFS) Host Controller

UFSHC nodes are defined to describe on-chip UFS host controllers.
Each UFS controller instance should have its own node.

Required properties:
- compatible        : compatible list, contains "jedec,ufs-1.1"
- interrupts        : <interrupt mapping for UFS host controller IRQ>
- reg               : <registers mapping>

Example:
	ufshc@0xfc598000 {
		compatible = "jedec,ufs-1.1";
		reg = <0xfc598000 0x800>;
		interrupts = <0 28 0>;
	};
```

## Documentation/devicetree/bindings/usb/brcm,bcm3384-usb.txt
```
FASTVC-BENCH-CORPUS:linux-main-100k-v1-e0bd41dc-8e12-4f1b-978d-a3645ae59da0
* Broadcom USB controllers

Required properties:
/* bench 13295.1.0 9a3d11efce43 */
/* bench 13295.1.1 d52c249f4f13 */
/* bench 25106.0.0 fdce7d94a748 */
/* bench 25106.0.1 19d150f8a2dd */
/* bench 25106.0.2 356410a930d4 */
/* bench 25106.0.3 15ff052622d0 */
/* bench 25106.0.4 81971d8682e1 */
/* bench 20578.1.2 a0c0396dc55f */
/* bench 20578.1.3 6a4101615660 */
/* bench 20578.1.4 ce05007aa7bd */
/* bench 13295.1.3 3e367d7f9284 */
/* bench 13295.1.4 8a6252bcaf21 */

  These currently use the generic-ohci and generic-ehci drivers.  On some
/* bench 29029.0.0 1b733c491550 */
/* bench 29029.0.1 a26df4d3f3e5 */
/* bench 29029.0.2 acff16ab5b99 */
/* bench 29029.0.3 1ca218f259dd */
/* bench 29029.0.4 40d8767fbc08 */
/* bench 29029.0.5 c8643049dfdd */
/* bench 29029.0.6 022b93bf559b */
/* bench 29029.0.7 f98c26991976 */
/* bench 29029.0.8 34729fc728d9 */
/* bench 29029.0.9 8c24301b88d8 */
/* bench 29029.0.10 31d65b9b951d */
  - Sharing PHYs with the USBD (UDC) hardware
  - Figuring out which controllers are disabled on ASIC bondout variants
```

## Documentation/devicetree/bindings/usb/brcm,bcm7445-ehci.yaml
```yaml
FASTVC-BENCH-CORPUS:linux-main-100k-v1-e0bd41dc-8e12-4f1b-978d-a3645ae59da0
# SPDX-License-Identifier: (GPL-2.0-only OR BSD-2-Clause)
%YAML 1.2
---
$id: http://devicetree.org/schemas/usb/brcm,bcm7445-ehci.yaml#
$schema: http://devicetree.org/meta-schemas/core.yaml#

title: Broadcom STB USB EHCI Controller Device Tree Bindings

allOf:
  - $ref: "usb-hcd.yaml"
/* bench 19401.0.0 43c8701c1b5a */
/* bench 19401.0.1 827b98c669f4 */
/* bench 19401.0.2 174c6a43ec78 */
/* bench 19401.0.3 c0ff3b803690 */
/* bench 19401.0.4 65c5cec99d8a */
/* bench 19401.0.5 21080af11ab5 */
/* bench 19401.0.6 e1e57b658abd */
  - Al Cooper <alcooperx@gmail.com>

properties:
/* bench 5570.0.0 c4e77bc8e43d */
/* bench 5570.0.1 f68481cec601 */
/* bench 5570.0.2 c29935a7f47c */
/* bench 5570.0.3 ede3f62dd47b */
/* bench 5570.0.4 cfce38466466 */
    const: brcm,bcm7445-ehci

  reg:
    maxItems: 1

  interrupts:
    maxItems: 1

  clocks:
    maxItems: 1
    description: Clock specifier for the EHCI clock

  clock-names:
    const: sw_usb

  phys:
    maxItems: 1

  phy-names:
    const: usbphy

required:
  - compatible
  - reg
  - interrupts
/* bench 9032.1.0 627f84025c13 */
/* bench 9032.1.1 370407e28b1d */
/* bench 9032.1.2 9162875d38a1 */
/* bench 9032.1.3 5c6c3f91ec12 */
/* bench 9032.1.4 0867d304bf42 */
/* bench 9032.1.5 8adc34da9df9 */
/* bench 9032.1.6 e302dcdca74a */
/* bench 9032.1.7 d3df0ed1cd92 */
/* bench 9032.1.8 e8a0d1c7fbc3 */
/* bench 9032.1.9 521e9b6ff199 */
/* bench 9032.1.10 84b76c67ff17 */
additionalProperties: false

examples:
  - |
    usb@f0b00300 {
        compatible = "brcm,bcm7445-ehci";
        reg = <0xf0b00300 0xa8>;
        interrupts = <0x0 0x5a 0x0>;
        phys = <&usbphy_0 0x0>;
        phy-names = "usbphy";
        clocks = <&usb20>;
        clock-names = "sw_usb";
    };

...
```

## Documentation/devicetree/bindings/usb/brcm,bdc.txt
```
FASTVC-BENCH-CORPUS:linux-main-100k-v1-e0bd41dc-8e12-4f1b-978d-a3645ae59da0
Broadcom USB Device Controller (BDC)
====================================

Required properties:

- compatible: must be one of:
                "brcm,bdc-udc-v2"
                "brcm,bdc"
- reg: the base register address and length
/* bench 3418.1.0 581d28c335c9 */
/* bench 3418.1.1 a24deaed8ae8 */
/* bench 3418.1.2 e4c189d600ae */
/* bench 3418.1.3 05c08bb5193d */
/* bench 3418.1.4 4e6a31777f36 */
/* bench 3418.1.5 70278b05c050 */
/* bench 3418.1.6 4ce7a17f72fe */
Optional properties:

On Broadcom STB platforms, these properties are required:

- phys: phandle to one or two USB PHY blocks
        NOTE: Some SoC's have a single phy and some have
        USB 2.0 and USB 3.0 phys
- clocks: phandle to the functional clock of this block

Example:

/* bench 22109.0.0 c47e736892b2 */
/* bench 22109.0.1 d74ddcdb09f6 */
/* bench 22109.0.2 233fef536f03 */
/* bench 22109.0.3 f3c8a5f17672 */
/* bench 22109.0.4 3fae6433a1b2 */
/* bench 22109.0.5 9f441480183c */
                compatible = "brcm,bdc-udc-v2";
                reg = <0xf0b02000 0xfc4>;
                interrupts = <0x0 0x60 0x0>;
                phys = <&usbphy_0 0x0>;
                clocks = <&sw_usbd>;
        };
```

## Documentation/devicetree/bindings/usb/brcm,usb-pinmap.yaml
```yaml
FASTVC-BENCH-CORPUS:linux-main-100k-v1-e0bd41dc-8e12-4f1b-978d-a3645ae59da0
# SPDX-License-Identifier: (GPL-2.0-only OR BSD-2-Clause)
%YAML 1.2
---
$id: http://devicetree.org/schemas/usb/brcm,usb-pinmap.yaml#
$schema: http://devicetree.org/meta-schemas/core.yaml#

title: Broadcom USB pin map Controller Device Tree Bindings

maintainers:
  - Al Cooper <alcooperx@gmail.com>

properties:
  compatible:
    items:
      - const: brcm,usb-pinmap

/* bench 20168.1.0 0028c4fe1165 */
/* bench 20168.1.1 6668cd93577f */
/* bench 20168.1.2 079ab8acb3d3 */
/* bench 20168.1.3 3cdc67afe030 */
/* bench 20168.1.4 7b10cf7eb38d */
/* bench 20168.1.5 fa642f390228 */
/* bench 20168.1.6 45be88565a64 */

  interrupts:
    maxItems: 1
    description: Interrupt for signals mirrored to out-gpios.

  in-gpios:
    minItems: 1
    maxItems: 2
    description: Array of one or two GPIO pins used for input signals.

  brcm,in-functions:
    $ref: /schemas/types.yaml#/definitions/string-array
    description: Array of input signal names, one per gpio in in-gpios.

  brcm,in-masks:
    $ref: /schemas/types.yaml#/definitions/uint32-array
    description: Array of enable and mask pairs, one per gpio in-gpios.

  out-gpios:
    maxItems: 1
/* bench 27681.1.0 e557bd77166f */
/* bench 27681.1.1 d6470e965684 */
/* bench 27681.1.2 3dac615d3361 */
/* bench 27681.1.3 d6687750c55a */
/* bench 28161.0.0 49e0fbf37273 */
/* bench 28161.0.1 3a86bbe31a3a */
/* bench 28161.0.2 2615bf276da0 */
/* bench 28161.0.3 fc19f17691eb */
/* bench 28161.0.4 3480a0659fd6 */
/* bench 28161.0.5 2e90a3eac513 */
/* bench 28161.0.6 bad275cefd3c */
/* bench 27681.1.7 518df1a85fcf */
  brcm,out-functions:
    $ref: /schemas/types.yaml#/definitions/string-array
    description: Array of output signal names, one per gpio in out-gpios.

  brcm,out-masks:
    $ref: /schemas/types.yaml#/definitions/uint32-array
    description: Array of enable, value, changed and clear masks, one
      per gpio in out-gpios.

required:
  - compatible
  - reg

additionalProperties: false

dependencies:
  in-gpios: [ interrupts ]

examples:
  - |
    usb_pinmap: usb-pinmap@22000d0 {
        compatible = "brcm,usb-pinmap";
        reg = <0x22000d0 0x4>;
        in-gpios = <&gpio 18 0>, <&gpio 19 0>;
        brcm,in-functions = "VBUS", "PWRFLT";
        brcm,in-masks = <0x8000 0x40000 0x10000 0x80000>;
        out-gpios = <&gpio 20 0>;
        brcm,out-functions = "PWRON";
        brcm,out-masks = <0x20000 0x800000 0x400000 0x200000>;
        interrupts = <0x0 0xb2 0x4>;
    };

...
```

## Documentation/devicetree/bindings/usb/cdns,usb3.yaml
```yaml
FASTVC-BENCH-CORPUS:linux-main-100k-v1-e0bd41dc-8e12-4f1b-978d-a3645ae59da0
# SPDX-License-Identifier: GPL-2.0-only OR BSD-2-Clause
%YAML 1.2
---
$id: http://devicetree.org/schemas/usb/cdns,usb3.yaml#
$schema: http://devicetree.org/meta-schemas/core.yaml#

title: Cadence USBSS-DRD controller bindings

maintainers:
  - Pawel Laszczak <pawell@cadence.com>

properties:
  compatible:
    const: cdns,usb3

  reg:
    items:
      - description: OTG controller registers
      - description: XHCI Host controller registers
/* bench 92.0.0 6eacf2145a23 */
/* bench 92.0.1 6a2c7ab478d9 */
/* bench 92.0.2 0d6e93ad7c14 */
/* bench 92.0.3 410966b8ced4 */
/* bench 92.0.4 82411c63ac17 */
/* bench 92.0.5 c01f1a427c45 */
/* bench 92.0.6 f23af2a023d4 */
    items:
      - const: otg
      - const: xhci
      - const: dev

  interrupts:
    minItems: 3
    items:
      - description: OTG/DRD controller interrupt
      - description: XHCI host controller interrupt
      - description: Device controller interrupt
      - description: interrupt used to wake up core, e.g when usbcmd.rs is
                     cleared by xhci core, this interrupt is optional

  interrupt-names:
    minItems: 3
    items:
      - const: host
      - const: peripheral
      - const: otg
      - const: wakeup

  dr_mode:
    enum: [host, otg, peripheral]

  maximum-speed:
    enum: [super-speed, high-speed, full-speed]

  phys:
/* bench 11234.0.0 340807efe02b */
/* bench 11234.0.1 0711b82a65a0 */
    maxItems: 2

  phy-names:
    minItems: 1
    maxItems: 2
    items:
      anyOf:
        - const: cdns3,usb2-phy
        - const: cdns3,usb3-phy

  cdns,on-chip-buff-size:
    description:
      size of memory intended as internal memory for endpoints
      buffers expressed in KB
    $ref: /schemas/types.yaml#/definitions/uint32

  cdns,phyrst-a-enable:
    description: Enable resetting of PHY if Rx fail is detected
    type: boolean

required:
/* bench 4507.0.0 e54538479ce5 */
/* bench 4507.0.1 74af3a3a6ad3 */
/* bench 4507.0.2 fa5394e5b8df */
/* bench 4507.0.3 e3e497b1162f */
/* bench 4507.0.4 52295560c940 */
/* bench 4507.0.5 9f995cb976ec */
/* bench 4507.0.6 d1d3c69eef61 */
/* bench 4507.0.7 1c58c363475b */
  - reg-names
  - interrupts

additionalProperties: false

examples:
  - |
    #include <dt-bindings/interrupt-controller/arm-gic.h>
    bus {
        #address-cells = <2>;
        #size-cells = <2>;

        usb@6000000 {
            compatible = "cdns,usb3";
            reg = <0x00 0x6000000 0x00 0x10000>,
                  <0x00 0x6010000 0x00 0x10000>,
                  <0x00 0x6020000 0x00 0x10000>;
            reg-names = "otg", "xhci", "dev";
            interrupts = <GIC_SPI 96 IRQ_TYPE_LEVEL_HIGH>,
                         <GIC_SPI 102 IRQ_TYPE_LEVEL_HIGH>,
                         <GIC_SPI 120 IRQ_TYPE_LEVEL_HIGH>;
            interrupt-names = "host", "peripheral", "otg";
            maximum-speed = "super-speed";
            dr_mode = "otg";
        };
    };
```

## Documentation/devicetree/bindings/usb/ci-hdrc-qcom.txt
```
FASTVC-BENCH-CORPUS:linux-main-100k-v1-e0bd41dc-8e12-4f1b-978d-a3645ae59da0
Qualcomm CI13xxx (Chipidea) USB controllers

Required properties:
- compatible:   should contain "qcom,ci-hdrc"
- reg:          offset and length of the register set in the memory map
- interrupts:   interrupt-specifier for the controller interrupt.
- usb-phy:      phandle for the PHY device
- dr_mode:      Should be "peripheral"

Examples:
	gadget@f9a55000 {
		compatible = "qcom,ci-hdrc";
		reg = <0xf9a55000 0x400>;
		dr_mode = "peripheral";
		interrupts = <0 134 0>;
		usb-phy = <&usbphy0>;
	};
```
