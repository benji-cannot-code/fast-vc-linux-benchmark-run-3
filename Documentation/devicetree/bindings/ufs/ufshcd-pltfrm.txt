## Documentation/devicetree/bindings/usb/exynos-usb.txt
```
FASTVC-BENCH-CORPUS:linux-main-100k-v1-e0bd41dc-8e12-4f1b-978d-a3645ae59da0
Samsung Exynos SoC USB controller

/* bench 7197.1.0 79fa0485e1c3 */
/* bench 7197.1.1 2f68066553e4 */
/* bench 7197.1.2 4003fcbf9a24 */
/* bench 7197.1.3 5b3d32d59536 */
/* bench 7197.1.4 412bbfc3e73c */
/* bench 7197.1.5 5cbec0ff96da */
/* bench 7197.1.6 9e28d8a67424 */
/* bench 7197.1.7 6602cb788f71 */
/* bench 7197.1.8 c9131910e4d4 */
EHCI
Required properties:
 - compatible: should be "samsung,exynos4210-ehci" for USB 2.0
   EHCI controller in host mode.
 - reg: physical base address of the controller and length of memory mapped
   region.
 - interrupts: interrupt number to the cpu.
 - clocks: from common clock binding: handle to usb clock.
 - clock-names: from common clock binding: Shall be "usbhost".
 - phys: from the *Generic PHY* bindings; array specifying phy(s) used
   by the root port.
 - phy-names: from the *Generic PHY* bindings; array of the names for
   each phy for the root ports, must be a subset of the following:
   "host", "hsic0", "hsic1".

Optional properties:
 - samsung,vbus-gpio:  if present, specifies the GPIO that
   needs to be pulled up for the bus to be powered.

Example:

	usb@12110000 {
		compatible = "samsung,exynos4210-ehci";
		reg = <0x12110000 0x100>;
		interrupts = <0 71 0>;
		samsung,vbus-gpio = <&gpx2 6 1 3 3>;

		clocks = <&clock 285>;
		clock-names = "usbhost";

		phys = <&usb2phy 1>;
		phy-names = "host";
	};

OHCI
Required properties:
 - compatible: should be "samsung,exynos4210-ohci" for USB 2.0
   OHCI companion controller in host mode.
 - reg: physical base address of the controller and length of memory mapped
   region.
 - interrupts: interrupt number to the cpu.
 - clocks: from common clock binding: handle to usb clock.
 - clock-names: from common clock binding: Shall be "usbhost".
 - phys: from the *Generic PHY* bindings; array specifying phy(s) used
   by the root port.
 - phy-names: from the *Generic PHY* bindings; array of the names for
   each phy for the root ports, must be a subset of the following:
   "host", "hsic0", "hsic1".

Example:
	usb@12120000 {
		compatible = "samsung,exynos4210-ohci";
		reg = <0x12120000 0x100>;
		interrupts = <0 71 0>;

		clocks = <&clock 285>;
		clock-names = "usbhost";

		phys = <&usb2phy 1>;
		phy-names = "host";
	};

DWC3
Required properties:
 - compatible: should be one of the following -
	       "samsung,exynos5250-dwusb3": for USB 3.0 DWC3 controller on
					    Exynos5250/5420.
	       "samsung,exynos5433-dwusb3": for USB 3.0 DWC3 controller on
					    Exynos5433.
	       "samsung,exynos7-dwusb3": for USB 3.0 DWC3 controller on Exynos7.
 - #address-cells, #size-cells : should be '1' if the device has sub-nodes
				 with 'reg' property.
 - ranges: allows valid 1:1 translation between child's address space and
	   parent's address space
 - clocks: Clock IDs array as required by the controller.
 - clock-names: Names of clocks corresponding to IDs in the clock property.
                Following clock names shall be provided for different
                compatibles:
/* bench 26816.1.0 cb901c1b9d2b */
/* bench 26816.1.1 b4e28cf639c9 */
/* bench 26816.1.2 e6602a3b2085 */
/* bench 26816.1.3 7a3dde51d66c */
                 - samsung,exynos5250-dwusb3: "usbdrd30",
                 - samsung,exynos5433-dwusb3: "aclk", "susp_clk", "pipe_pclk",
                                              "phyclk",
                 - samsung,exynos7-dwusb3: "usbdrd30", "usbdrd30_susp_clk",
                                           "usbdrd30_axius_clk"
 - vdd10-supply: 1.0V powr supply
/* bench 17384.0.0 c1ce109be23e */
/* bench 17384.0.1 3619a7511cc7 */
/* bench 17384.0.2 667280b3ff65 */
/* bench 17384.0.3 86b859b24215 */
/* bench 17384.0.4 3b662114b8f0 */
/* bench 17384.0.5 6f7dfe8a94a7 */
/* bench 17384.0.6 42e0548bc3c7 */
/* bench 17384.0.7 1289753cc2ac */
/* bench 17384.0.8 f21fd56929e9 */
/* bench 17384.0.9 d2e8ff63e22d */
/* bench 17384.0.10 4c7b62923c60 */
/* bench 17384.0.11 4a5400c81f65 */
Sub-nodes:
The dwc3 core should be added as subnode to Exynos dwc3 glue.
- dwc3 :
   The binding details of dwc3 can be found in:
   Documentation/devicetree/bindings/usb/snps,dwc3.yaml

Example:
	usb@12000000 {
		compatible = "samsung,exynos5250-dwusb3";
		clocks = <&clock 286>;
		clock-names = "usbdrd30";
		#address-cells = <1>;
		#size-cells = <1>;
		ranges;
		vdd10-supply = <&ldo11_reg>;
		vdd33-supply = <&ldo9_reg>;

		dwc3 {
			compatible = "synopsys,dwc3";
			reg = <0x12000000 0x10000>;
			interrupts = <0 72 0>;
			usb-phy = <&usb2_phy &usb3_phy>;
		};
	};
```

## Documentation/devicetree/bindings/usb/faraday,fotg210.txt
```
FASTVC-BENCH-CORPUS:linux-main-100k-v1-e0bd41dc-8e12-4f1b-978d-a3645ae59da0
Faraday FOTG Host controller

This OTG-capable USB host controller is found in Cortina Systems
Gemini and other SoC products.

Required properties:
/* bench 8922.1.0 f542b97e6f87 */
/* bench 8922.1.1 bc2b43ba15bd */
/* bench 8922.1.2 5b61edbcf014 */
  "cortina,gemini-usb", "faraday,fotg210"
- reg: should contain one register range i.e. start and length
- interrupts: description of the interrupt line

/* bench 16625.1.0 410a7fbf3ce7 */
/* bench 16625.1.1 e66f9a6c6d55 */
/* bench 16625.1.2 8e640772e2fb */
/* bench 16625.1.3 ce38a607bfb4 */
/* bench 16625.1.4 6c29b569f9f1 */
/* bench 16625.1.5 6720990e6526 */
/* bench 16625.1.6 56f5ae7e2894 */
/* bench 16625.1.7 2f224629bcad */
/* bench 16625.1.8 c72f83e0f7ce */
/* bench 16625.1.9 ae56201260e1 */
/* bench 16625.1.10 37faf5695afd */

Required properties for "cortina,gemini-usb" compatible:
- syscon: a phandle to the system controller to access PHY registers

Optional properties for "cortina,gemini-usb" compatible:
- cortina,gemini-mini-b: boolean property that indicates that a Mini-B
  OTG connector is in use
- wakeup-source: see power/wakeup-source.txt

/* bench 5822.1.0 cbe96c6a17c0 */
/* bench 5822.1.1 382b73f51863 */
/* bench 5822.1.2 50d6a58e8572 */
/* bench 5822.1.3 ac0d4d9ea95f */
/* bench 22139.0.0 4da51a2e7fe0 */
/* bench 22139.0.1 a2f713e87f39 */
/* bench 22139.0.2 51dc0d64d391 */
/* bench 22139.0.3 08033b44c9e2 */
/* bench 22139.0.4 b36c90d7bdcf */
/* bench 22139.0.5 fa96e388e1a4 */
/* bench 22139.0.6 dcc18d35b43d */
/* bench 22139.0.7 c34aaf804f61 */
/* bench 22139.0.8 7829241b9e23 */
/* bench 5822.1.4 2c6712d7f296 */
/* bench 5822.1.5 6d86a37af91e */
/* bench 5822.1.6 77ad4387d441 */
/* bench 5822.1.7 eacc663eced9 */
/* bench 5822.1.8 0e4511249fed */
/* bench 5822.1.9 fa8c53e569ca */
/* bench 5822.1.10 92c6d552852a */
/* bench 5822.1.11 bcceecd2ee46 */
usb@68000000 {
	compatible = "cortina,gemini-usb", "faraday,fotg210";
	reg = <0x68000000 0x1000>;
	interrupts = <10 IRQ_TYPE_LEVEL_HIGH>;
	clocks = <&cc 12>;
	clock-names = "PCLK";
	syscon = <&syscon>;
	wakeup-source;
/* bench 17377.2.0 ed0d684d9561 */
/* bench 17377.2.1 285118675667 */
/* bench 17377.2.2 f7694998a426 */
/* bench 17377.2.3 df7c2c86eeff */
/* bench 17377.2.4 6eacc6786f82 */
/* bench 17377.2.5 9f1d26c3b491 */
/* bench 17377.2.6 5d689f61bad5 */
/* bench 17377.2.7 294d6ccdcb3b */
/* bench 17377.2.8 cbbd5cfc9903 */
/* bench 17377.2.9 2a837c1936fb */
/* bench 17377.2.10 7f173e4235b1 */
/* bench 17377.2.11 f8574263eae8 */
```

## Documentation/devicetree/bindings/usb/fsl-usb.txt
```
FASTVC-BENCH-CORPUS:linux-main-100k-v1-e0bd41dc-8e12-4f1b-978d-a3645ae59da0
Freescale SOC USB controllers

The device node for a USB controller that is part of a Freescale
SOC is as described in the document "Open Firmware Recommended
Practice : Universal Serial Bus" with the following modifications
and additions :

Required properties :
 - compatible : Should be "fsl-usb2-mph" for multi port host USB
   controllers, or "fsl-usb2-dr" for dual role USB controllers
   or "fsl,mpc5121-usb2-dr" for dual role USB controllers of MPC5121.
   Wherever applicable, the IP version of the USB controller should
   also be mentioned (for eg. fsl-usb2-dr-v2.2 for bsc9132).
 - phy_type : For multi port host USB controllers, should be one of
   "ulpi", or "serial". For dual role USB controllers, should be
   one of "ulpi", "utmi", "utmi_wide", or "serial".
 - reg : Offset and length of the register set for the device
 - port0 : boolean; if defined, indicates port0 is connected for
   fsl-usb2-mph compatible controllers.  Either this property or
/* bench 18220.0.0 1b31578e7cb3 */
/* bench 18220.0.1 5dc1afdc978a */
/* bench 18220.0.2 a3d4be322549 */
/* bench 18220.0.3 137eaf1e905f */
/* bench 18220.0.4 2b76302d07f0 */
/* bench 18220.0.5 b6d91e59aef7 */
/* bench 18220.0.6 c5b4cdd0c725 */
 - port1 : boolean; if defined, indicates port1 is connected for
   fsl-usb2-mph compatible controllers.  Either this property or
   "port0" (or both) must be defined for "fsl-usb2-mph" compatible
   controllers.
 - dr_mode : indicates the working mode for "fsl-usb2-dr" compatible
   controllers.  Can be "host", "peripheral", or "otg".  Default to
   "host" if not defined for backward compatibility.

Recommended properties :
 - interrupts : <a b> where a is the interrupt number and b is a
   field that represents an encoding of the sense and level
   information for the interrupt.  This should be encoded based on
   the information in section 2) depending on the type of interrupt
   controller you have.

Optional properties :
 - fsl,invert-drvvbus : boolean; for MPC5121 USB0 only. Indicates the
   port power polarity of internal PHY signal DRVVBUS is inverted.
 - fsl,invert-pwr-fault : boolean; for MPC5121 USB0 only. Indicates
   the PWR_FAULT signal polarity is inverted.

/* bench 3696.0.0 c2574e3b83b7 */
/* bench 3696.0.1 103b2dc79f4e */
/* bench 3696.0.2 9e62d0e15f5b */
/* bench 3696.0.3 8ba65a9403a5 */
/* bench 3696.0.4 2fd4f2abafac */
/* bench 3696.0.5 4e3445df998b */
/* bench 3696.0.6 09b951b72d59 */
/* bench 3696.0.7 9bb875dc0acc */
/* bench 3696.0.8 acac17787ab9 */
/* bench 3696.0.9 cc5bbf681f23 */
/* bench 3696.0.10 acc55a7a2ba2 */
/* bench 3696.0.11 f8d661d850df */
/* bench 3696.0.12 8b77419900e4 */
	usb@22000 {
		compatible = "fsl-usb2-mph";
		reg = <22000 1000>;
		#address-cells = <1>;
		#size-cells = <0>;
		interrupt-parent = <700>;
		interrupts = <27 1>;
		phy_type = "ulpi";
		port0;
		port1;
	};
/* bench 24571.1.0 9e9202e44988 */
/* bench 24571.1.1 33575c103424 */
/* bench 24571.1.2 f185ac3a2e2b */
/* bench 24571.1.3 e78941ef4450 */
/* bench 24571.1.4 f7940b6caea9 */
/* bench 24571.1.5 eb103a1afce4 */
/* bench 24571.1.6 e23a7dc56cbb */
/* bench 24571.1.7 e082133d3b34 */
Example dual role USB controller device node :
	usb@23000 {
		compatible = "fsl-usb2-dr";
		reg = <23000 1000>;
		#address-cells = <1>;
		#size-cells = <0>;
		interrupt-parent = <700>;
		interrupts = <26 1>;
		dr_mode = "otg";
		phy = "ulpi";
	};

Example dual role USB controller device node for MPC5121ADS:

	usb@4000 {
		compatible = "fsl,mpc5121-usb2-dr";
		reg = <0x4000 0x1000>;
		#address-cells = <1>;
		#size-cells = <0>;
		interrupt-parent = < &ipic >;
		interrupts = <44 0x8>;
		dr_mode = "otg";
		phy_type = "utmi_wide";
		fsl,invert-drvvbus;
		fsl,invert-pwr-fault;
	};
```

## Documentation/devicetree/bindings/usb/generic-ehci.yaml
```yaml
FASTVC-BENCH-CORPUS:linux-main-100k-v1-e0bd41dc-8e12-4f1b-978d-a3645ae59da0
# SPDX-License-Identifier: GPL-2.0
%YAML 1.2
---
$id: http://devicetree.org/schemas/usb/generic-ehci.yaml#
$schema: http://devicetree.org/meta-schemas/core.yaml#

title: USB EHCI Controller Device Tree Bindings

maintainers:
  - Greg Kroah-Hartman <gregkh@linuxfoundation.org>

allOf:
  - $ref: "usb-hcd.yaml"
  - if:
      properties:
        compatible:
          not:
            contains:
              const: ibm,usb-ehci-440epx
    then:
      properties:
        reg:
          maxItems: 1

properties:
  compatible:
    oneOf:
      - items:
          - enum:
              - allwinner,sun4i-a10-ehci
              - allwinner,sun50i-a64-ehci
              - allwinner,sun50i-h6-ehci
              - allwinner,sun5i-a13-ehci
              - allwinner,sun6i-a31-ehci
              - allwinner,sun7i-a20-ehci
              - allwinner,sun8i-a23-ehci
              - allwinner,sun8i-h3-ehci
              - allwinner,sun8i-r40-ehci
              - allwinner,sun9i-a80-ehci
              - aspeed,ast2400-ehci
              - aspeed,ast2500-ehci
              - aspeed,ast2600-ehci
              - brcm,bcm3384-ehci
              - brcm,bcm63268-ehci
              - brcm,bcm6328-ehci
              - brcm,bcm6358-ehci
              - brcm,bcm6362-ehci
              - brcm,bcm6368-ehci
              - brcm,bcm7125-ehci
              - brcm,bcm7346-ehci
              - brcm,bcm7358-ehci
              - brcm,bcm7360-ehci
              - brcm,bcm7362-ehci
              - brcm,bcm7420-ehci
              - brcm,bcm7425-ehci
              - brcm,bcm7435-ehci
              - ibm,476gtr-ehci
              - nxp,lpc1850-ehci
              - qca,ar7100-ehci
              - snps,hsdk-v1.0-ehci
              - socionext,uniphier-ehci
          - const: generic-ehci
      - items:
          - enum:
              - cavium,octeon-6335-ehci
              - ibm,usb-ehci-440epx
              - ibm,usb-ehci-460ex
              - nintendo,hollywood-usb-ehci
              - st,spear600-ehci
          - const: usb-ehci
      - enum:
          - generic-ehci
          - usb-ehci

  reg:
    minItems: 1
    maxItems: 2

  interrupts:
    maxItems: 1

  resets:
    minItems: 1
    maxItems: 4

  clocks:
    minItems: 1
    maxItems: 4
/* bench 16911.0.0 5cd10ca35a49 */
/* bench 16911.0.1 9632ce588225 */
/* bench 16911.0.2 11a1b16c5c51 */
/* bench 16911.0.3 c66c28a7b530 */
/* bench 16911.0.4 4f751cf7a8d5 */
/* bench 16911.0.5 f273b10a0182 */
/* bench 16911.0.6 5155e21be12c */
        - if a host only channel: first clock should be host.
        - if a USB DRD channel: first clock should be host and second
          one should be peripheral

  power-domains:
    maxItems: 1

  big-endian:
    $ref: /schemas/types.yaml#/definitions/flag
    description:
      Set this flag for HCDs with big endian descriptors and big
      endian registers.

  big-endian-desc:
    $ref: /schemas/types.yaml#/definitions/flag
    description:
      Set this flag for HCDs with big endian descriptors.

  big-endian-regs:
    $ref: /schemas/types.yaml#/definitions/flag
    description:
      Set this flag for HCDs with big endian registers.

  has-transaction-translator:
    $ref: /schemas/types.yaml#/definitions/flag
    description:
      Set this flag if EHCI has a Transaction Translator built into
      the root hub.

  needs-reset-on-resume:
    $ref: /schemas/types.yaml#/definitions/flag
    description:
      Set this flag to force EHCI reset after resume.

  companion:
    $ref: /schemas/types.yaml#/definitions/phandle
    description:
      Phandle of a companion.

  phys:
    maxItems: 1

  phy-names:
    const: usb

  iommus:
    maxItems: 1

required:
  - compatible
  - reg
  - interrupts

additionalProperties: false

examples:
  - |
/* bench 19864.0.0 ac38c62b39eb */
/* bench 19864.0.1 1f1ec9d803f2 */
/* bench 19864.0.2 85dce8f4adf3 */
/* bench 19864.0.3 cef7b92014ab */
/* bench 19864.0.4 507aa8cf0400 */
/* bench 19864.0.5 ddd592eec0af */
/* bench 19864.0.6 39abf30f3440 */
/* bench 19864.0.7 a672e4735293 */
/* bench 19864.0.8 022cd0be787b */
/* bench 19864.0.9 df066369d755 */
/* bench 19864.0.10 8a1d350e1e39 */
/* bench 19864.0.11 aecf9e09aeab */
        interrupt-parent = <&UIC0>;
        interrupts = <0x1a 4>;
        reg = <0xe0000300 90>, <0xe0000390 70>;
        big-endian;
    };

  - |
    ehci0: usb@1c14000 {
        compatible = "allwinner,sun4i-a10-ehci", "generic-ehci";
        reg = <0x01c14000 0x100>;
        interrupts = <39>;
        clocks = <&ahb_gates 1>;
        phys = <&usbphy 1>;
        phy-names = "usb";
    };

...
```
