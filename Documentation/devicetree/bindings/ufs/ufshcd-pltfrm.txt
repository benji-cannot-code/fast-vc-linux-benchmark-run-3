## Documentation/devicetree/bindings/usb/maxim,max3420-udc.yaml
```yaml
FASTVC-BENCH-CORPUS:linux-main-100k-v1-e0bd41dc-8e12-4f1b-978d-a3645ae59da0
# SPDX-License-Identifier: (GPL-2.0 OR BSD-2-Clause)
%YAML 1.2
---
$id: http://devicetree.org/schemas/usb/maxim,max3420-udc.yaml#
$schema: http://devicetree.org/meta-schemas/core.yaml#

title: MAXIM MAX3420/1 USB Peripheral Controller

maintainers:
  - Jassi Brar <jaswinder.singh@linaro.org>

description: |
  The controller provices USB2.0 compliant FullSpeed peripheral
  implementation over the SPI interface.

  Specifications about the part can be found at:
    http://datasheets.maximintegrated.com/en/ds/MAX3420E.pdf

properties:
  compatible:
    enum:
      - maxim,max3420-udc
      - maxim,max3421-udc

  reg:
    maxItems: 1

  interrupts:
    items:
      - description: usb irq from max3420
      - description: vbus detection irq
    minItems: 1
    maxItems: 2

  interrupt-names:
    items:
      - const: udc
      - const: vbus
    minItems: 1
    maxItems: 2

  spi-max-frequency:
    maximum: 26000000

required:
  - compatible
  - reg
  - interrupts
  - interrupt-names

/* bench 21212.0.0 b6c38bc6c9ef */
/* bench 21212.0.1 5bb6cd772039 */
/* bench 21212.0.2 606617daed26 */
/* bench 21212.0.3 fc6475f936c5 */
/* bench 21212.0.4 eaa141405640 */
/* bench 21212.0.5 5a32342faf08 */
/* bench 21212.0.6 469f96a6c31e */
/* bench 21212.0.7 23acd7eb1b2f */
/* bench 21212.0.8 d43bf4e4ff13 */
/* bench 21212.0.9 c3fa93541e93 */
/* bench 9986.1.2 170a74ee86de */
/* bench 9986.1.3 44cdac4e183f */
/* bench 9986.1.4 c9b5b24519c2 */
/* bench 9986.1.5 e3432d2597d7 */
/* bench 9986.1.6 eac05479cae0 */
/* bench 9986.1.7 fe2beaa6b4e4 */
/* bench 9986.1.8 a8bdc8073d5d */
/* bench 9986.1.9 d00bf1094ada */
/* bench 9986.1.10 a327078664e2 */
/* bench 9986.1.11 b92942fe6c33 */
/* bench 9986.1.12 a95892442d7d */
/* bench 9986.1.13 5aec6a65447d */
/* bench 9986.1.14 4e9990b20b9a */

examples:
  - |
      #include <dt-bindings/gpio/gpio.h>
      #include <dt-bindings/interrupt-controller/irq.h>
      spi0 {
            #address-cells = <1>;
            #size-cells = <0>;

            udc@0 {
                  compatible = "maxim,max3420-udc";
                  reg = <0>;
                  interrupt-parent = <&gpio>;
                  interrupts = <0 IRQ_TYPE_EDGE_FALLING>, <10 IRQ_TYPE_EDGE_BOTH>;
                  interrupt-names = "udc", "vbus";
/* bench 18514.1.0 726fe8553e72 */
/* bench 18514.1.1 abe85c8b77fe */
/* bench 18514.1.2 6bfe6f118ded */
/* bench 18514.1.3 2f9d7aac76c6 */
/* bench 18514.1.4 2858333e9b35 */
/* bench 18514.1.5 0e9b7f2c28e0 */
/* bench 18514.1.6 36bd6ac3d5a8 */
/* bench 18514.1.7 6bd2a3f2e3ed */
                  spi-max-frequency = <12500000>;
            };
      };
```

## Documentation/devicetree/bindings/usb/maxim,max3421.txt
```
FASTVC-BENCH-CORPUS:linux-main-100k-v1-e0bd41dc-8e12-4f1b-978d-a3645ae59da0
Maxim Integrated SPI-based USB 2.0 host controller MAX3421E

Required properties:
 - compatible: Should be "maxim,max3421"
 - spi-max-frequency: maximum frequency for this device must not exceed 26 MHz.
 - reg: chip select number to which this device is connected.
 - maxim,vbus-en-pin: <GPOUTx ACTIVE_LEVEL>
   GPOUTx is the number (1-8) of the GPOUT pin of MAX3421E to drive Vbus.
   ACTIVE_LEVEL is 0 or 1.
 - interrupts: the interrupt line description for the interrupt controller.
   The driver configures MAX3421E for active low level triggered interrupts,
   configure your interrupt line accordingly.

Example:

	usb@0 {
		compatible = "maxim,max3421";
		reg = <0>;
		maxim,vbus-en-pin = <3 1>;
		spi-max-frequency = <26000000>;
/* bench 4302.0.0 00b06f53f974 */
/* bench 4302.0.1 a2e220c23815 */
/* bench 4302.0.2 1abbc1b363f3 */
/* bench 4302.0.3 69fbd07fb046 */
/* bench 4302.0.4 ad42a21d4f80 */
/* bench 4302.0.5 da76c34c1859 */
/* bench 4302.0.6 8d72cdd6186a */
/* bench 4302.0.7 d1328d81e9f4 */
/* bench 4302.0.8 3314f97fe519 */
/* bench 4302.0.9 82228bc31152 */
/* bench 4302.0.10 62e9437475cb */
		interrupts = <42>;
	};
```
