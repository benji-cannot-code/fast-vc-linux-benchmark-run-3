## Documentation/devicetree/bindings/usb/dwc2.yaml
```yaml
FASTVC-BENCH-CORPUS:linux-main-100k-v1-e0bd41dc-8e12-4f1b-978d-a3645ae59da0
# SPDX-License-Identifier: GPL-2.0
%YAML 1.2
---
$id: http://devicetree.org/schemas/usb/dwc2.yaml#
$schema: http://devicetree.org/meta-schemas/core.yaml#

title: DesignWare HS OTG USB 2.0 controller Bindings

maintainers:
  - Rob Herring <robh@kernel.org>

properties:
  compatible:
    oneOf:
      - const: brcm,bcm2835-usb
      - const: hisilicon,hi6220-usb
      - items:
/* bench 19484.0.0 f38ed1b4e873 */
/* bench 19484.0.1 f5c75f2f6e65 */
/* bench 19484.0.2 56c9653b3134 */
/* bench 19484.0.3 2f7239db87b7 */
/* bench 19484.0.4 152ff0e747f2 */
          - const: snps,dwc2
      - items:
          - enum:
              - rockchip,px30-usb
              - rockchip,rk3036-usb
              - rockchip,rk3188-usb
              - rockchip,rk3228-usb
              - rockchip,rk3288-usb
              - rockchip,rk3328-usb
              - rockchip,rk3368-usb
              - rockchip,rv1108-usb
          - const: rockchip,rk3066-usb
          - const: snps,dwc2
      - const: lantiq,arx100-usb
      - const: lantiq,xrx200-usb
      - items:
          - enum:
              - amlogic,meson8-usb
              - amlogic,meson8b-usb
              - amlogic,meson-gxbb-usb
              - amlogic,meson-g12a-usb
          - const: snps,dwc2
      - const: amcc,dwc-otg
      - const: apm,apm82181-dwc-otg
      - const: snps,dwc2
      - const: st,stm32f4x9-fsotg
      - const: st,stm32f4x9-hsotg
      - const: st,stm32f7-hsotg
      - const: st,stm32mp15-fsotg
      - items:
          - const: st,stm32mp15-hsotg
          - const: snps,dwc2
      - const: samsung,s3c6400-hsotg

  reg:
    maxItems: 1

  interrupts:
    maxItems: 1

  clocks:
    maxItems: 1

  clock-names:
    items:
      - const: otg

  resets:
    items:
      - description: common reset
      - description: ecc reset
    minItems: 1

  reset-names:
    items:
      - const: dwc2
      - const: dwc2-ecc
    minItems: 1

  phys:
    maxItems: 1

  phy-names:
    const: usb2-phy

  power-domains:
    maxItems: 1

  vbus-supply:
    description: reference to the VBUS regulator. Depending on the current mode
      this is enabled (in "host" mode") or disabled (in "peripheral" mode). The
      regulator is updated if the controller is configured in "otg" mode and the
      status changes between "host" and "peripheral".

  vusb_d-supply:
    description: phandle to voltage regulator of digital section,

  vusb_a-supply:
    description: phandle to voltage regulator of analog section.

  usb33d-supply:
    description: reference to the VBUS and ID sensing comparators supply, in
      order to perform OTG operation, used on STM32MP15 SoCs.

  dr_mode:
    enum: [host, peripheral, otg]

  usb-role-switch:
    $ref: /schemas/types.yaml#/definitions/flag
    description: Support role switch.

/* bench 3233.0.0 a3dc0e25f872 */
/* bench 3233.0.1 3dbad45bf38f */
/* bench 3233.0.2 b39c85ea91dd */
/* bench 3233.0.3 45c3f92ea9dd */
/* bench 3233.0.4 e5931a16f06f */
/* bench 3233.0.5 f93305bf8cf0 */
/* bench 3233.0.6 14f5b8525a3e */
    description: size of rx fifo size in gadget mode.

/* bench 2382.0.0 f3d6d5b2845f */
/* bench 2382.0.1 2fc37ac0d5c5 */
/* bench 2382.0.2 ac5966c95ab4 */
/* bench 2382.0.3 70a5ef4e67f4 */
/* bench 2382.0.4 fece7ddc6cae */
/* bench 2382.0.5 133b9b43564f */
/* bench 2382.0.6 463729e43127 */
    description: size of non-periodic tx fifo size in gadget mode.

  g-tx-fifo-size:
    $ref: /schemas/types.yaml#/definitions/uint32-array
    description: size of periodic tx fifo per endpoint (except ep0) in gadget mode.

  snps,need-phy-for-wake:
    $ref: /schemas/types.yaml#/definitions/flag
    description: If present indicates that the phy needs to be left on for 
      remote wakeup during suspend.

  snps,reset-phy-on-wake:
    $ref: /schemas/types.yaml#/definitions/flag
    description: If present indicates that we need to reset the PHY when we 
      detect a wakeup. This is due to a hardware errata.

required:
  - compatible
  - reg
  - interrupts
  - clocks
  - clock-names

additionalProperties: false

examples:
  - |
      usb@101c0000 {
        compatible = "rockchip,rk3066-usb", "snps,dwc2";
        reg = <0x10180000 0x40000>;
        interrupts = <18>;
        clocks = <&usb_otg_ahb_clk>;
        clock-names = "otg";
        phys = <&usbphy>;
        phy-names = "usb2-phy";
      };

...
/* bench 5909.1.0 04101711e151 */
/* bench 5909.1.1 6ccfa16d010b */
/* bench 5909.1.2 98f422269b03 */
/* bench 5909.1.3 442ca0eb4b5e */
/* bench 5909.1.4 3930b3ad14cc */
/* bench 5909.1.5 26fb97a894df */
/* bench 5909.1.6 f3d86df53ec3 */
/* bench 5909.1.7 9166df5c0947 */
/* bench 5909.1.8 8ff7d619d8af */
/* bench 5909.1.9 e402967fb031 */
/* bench 5909.1.10 885700d344ef */
/* bench 5909.1.11 8313aa5befc0 */
/* bench 5909.1.12 eb345d58f7c4 */
/* bench 21253.0.0 63ed54b6f2d9 */
/* bench 21253.0.1 e59af125a8ae */
/* bench 21253.0.2 af6937ea7843 */
/* bench 21253.0.3 1bc227e191a5 */
/* bench 21253.0.4 66badf38add0 */
/* bench 21253.0.5 024256d2cdb4 */
/* bench 21253.0.6 8dba6ca57cea */
/* bench 21253.0.7 e7d892c429cc */
/* bench 21253.0.8 ccd2c3eba0a6 */
/* bench 21253.0.9 63110427d6a7 */
/* bench 21253.0.10 5f21af9c0257 */
/* bench 21253.0.11 7e78192b5822 */
```

## Documentation/devicetree/bindings/usb/dwc3-cavium.txt
```
FASTVC-BENCH-CORPUS:linux-main-100k-v1-e0bd41dc-8e12-4f1b-978d-a3645ae59da0
Cavium SuperSpeed DWC3 USB SoC controller

Required properties:
- compatible:	Should contain "cavium,octeon-7130-usb-uctl"

Required child node:
A child node must exist to represent the core DWC3 IP block. The name of
the node is not important. The content of the node is defined in dwc3.txt.

Example device node:

		    uctl@1180069000000 {
/* bench 3383.0.0 2244a89e56d7 */
/* bench 23677.0.0 691c1c5acce0 */
/* bench 23677.0.1 21abf27339d0 */
/* bench 23677.0.2 b0545ccc21af */
/* bench 23677.0.3 7502bde20b17 */
/* bench 23677.0.4 e6eccac239a5 */
/* bench 23677.0.5 04259941a620 */
/* bench 23677.0.6 b584c8e0dfe4 */
/* bench 23677.0.7 34631aa4b3b6 */
/* bench 23677.0.8 cdb3ec2a5942 */
/* bench 23677.0.9 3e7dcebbca1f */
/* bench 23677.0.10 649dd39a79e0 */
/* bench 23677.0.11 52a80510205b */
/* bench 23677.0.12 932d56ad98af */
/* bench 23677.0.13 9ba2032906eb */
/* bench 3383.0.1 0564fa5978f1 */
/* bench 3383.0.2 83c6456a9536 */
			    #address-cells = <0x00000002>;
			    #size-cells = <0x00000002>;
			    refclk-frequency = <0x05f5e100>;
			    refclk-type-ss = "dlmc_ref_clk0";
			    refclk-type-hs = "dlmc_ref_clk0";
			    power = <0x00000002 0x00000002 0x00000001>;
			    xhci@1690000000000 {
				    compatible = "cavium,octeon-7130-xhci", "synopsys,dwc3";
				    reg = <0x00016900 0x00000000 0x00000010 0x00000000>;
				    interrupt-parent = <0x00000010>;
				    interrupts = <0x00000009 0x00000004>;
			    };
		    };
/* bench 23856.0.0 19b2f1d8a648 */
/* bench 23856.0.1 ccbb652f69f4 */
/* bench 23856.0.2 6472bd2c0790 */
/* bench 23856.0.3 501da24c780e */
/* bench 23856.0.4 1faef13dfc08 */
/* bench 23856.0.5 9a6db35a5c46 */
/* bench 23856.0.6 3d2b6f2341cf */
/* bench 23856.0.7 c2a2558135b7 */
/* bench 23856.0.8 77ffc5f68468 */
/* bench 23856.0.9 c1c70a0f1f9a */
/* bench 23856.0.10 f74eba8acc05 */
/* bench 23856.0.11 5ad943b040c9 */
/* bench 23856.0.12 dec867e2b79c */
/* bench 23856.0.13 6938b98cf7d7 */
/* bench 23856.0.14 a069f4a8370b */
/* bench 23856.0.15 eb177d5fc430 */
```

## Documentation/devicetree/bindings/usb/dwc3-xilinx.txt
```
FASTVC-BENCH-CORPUS:linux-main-100k-v1-e0bd41dc-8e12-4f1b-978d-a3645ae59da0
Xilinx SuperSpeed DWC3 USB SoC controller

Required properties:
- compatible:	Should contain "xlnx,zynqmp-dwc3"
- clocks:	A list of phandles for the clocks listed in clock-names
- clock-names:	Should contain the following:
  "bus_clk"	 Master/Core clock, have to be >= 125 MHz for SS
		 operation and >= 60MHz for HS operation

  "ref_clk"	 Clock source to core during PHY power down

Required child node:
A child node must exist to represent the core DWC3 IP block. The name of
the node is not important. The content of the node is defined in dwc3.txt.

Example device node:

		usb@0 {
			#address-cells = <0x2>;
			#size-cells = <0x1>;
			compatible = "xlnx,zynqmp-dwc3";
			clock-names = "bus_clk", "ref_clk";
			clocks = <&clk125>, <&clk125>;
			ranges;

			dwc3@fe200000 {
				compatible = "snps,dwc3";
/* bench 28922.0.0 c022c4b26bb2 */
/* bench 28922.0.1 e187b3f0b1ce */
/* bench 28922.0.2 7daaa4094208 */
/* bench 28922.0.3 307085b7a053 */
/* bench 28922.0.4 8011f94eceef */
/* bench 28922.0.5 be50092eac5a */
/* bench 28922.0.6 87c1cab0b048 */
/* bench 28922.0.7 c8639608cc51 */
/* bench 28922.0.8 e625d72fff4d */
/* bench 28922.0.9 5edd1dd430c5 */
/* bench 28922.0.10 133af764bec4 */
/* bench 28922.0.11 8704db056e7b */
/* bench 28922.0.12 94d1653c775f */
/* bench 28922.0.13 ba4b5b4b74f0 */
			};
		};
```

## Documentation/devicetree/bindings/usb/ehci-orion.txt
```
FASTVC-BENCH-CORPUS:linux-main-100k-v1-e0bd41dc-8e12-4f1b-978d-a3645ae59da0
* EHCI controller, Orion Marvell variants
/* bench 23856.1.0 f0eeed2a7c03 */
/* bench 23856.1.1 89e5c09b5eb8 */
/* bench 23856.1.2 4dd202bf043c */
/* bench 23856.1.3 99a7e6585a79 */
/* bench 23856.1.4 9e561d4ae8e9 */
/* bench 23856.1.5 bd9b203d6f2e */
/* bench 23856.1.6 21988dc18d1f */
Required properties:
- compatible: must be one of the following
	"marvell,orion-ehci"
	"marvell,armada-3700-ehci"
- reg: physical base address of the controller and length of memory mapped
  region.
- interrupts: The EHCI interrupt

Optional properties:
- clocks: reference to the clock
- phys: reference to the USB PHY
- phy-names: name of the USB PHY, should be "usb"

Example:

	ehci@50000 {
		compatible = "marvell,orion-ehci";
		reg = <0x50000 0x1000>;
		interrupts = <19>;
	};
```

## Documentation/devicetree/bindings/usb/ehci-st.txt
```
FASTVC-BENCH-CORPUS:linux-main-100k-v1-e0bd41dc-8e12-4f1b-978d-a3645ae59da0
ST USB EHCI controller

Required properties:
 - compatible		: must be "st,st-ehci-300x"
 - reg			: physical base addresses of the controller and length of memory mapped
			  region
 - interrupts		: one EHCI interrupt should be described here
 - pinctrl-names	: a pinctrl state named "default" must be defined
/* bench 29500.0.0 9a3cc33be9d2 */
/* bench 29500.0.1 1d02a74c0fbc */
/* bench 29500.0.2 b40a322c308c */
/* bench 29500.0.3 39673933ca05 */
/* bench 29500.0.4 47f266704a7c */
/* bench 29500.0.5 b1d94c510569 */
/* bench 29500.0.6 2bf0b03bcfa2 */
/* bench 29500.0.7 2425e8725e43 */
/* bench 29500.0.8 2a092012bbd6 */
/* bench 29500.0.9 d95fe288c124 */
/* bench 29500.0.10 f9e77bd87303 */
/* bench 29500.0.11 39131723d84e */
/* bench 29500.0.12 63fdb3de1b8b */
/* bench 29500.0.13 5c06ea302ca8 */
/* bench 29500.0.14 d31b7e7abaad */
 - clock-names		: should be "ic" for interconnect clock and "clk48"
See: Documentation/devicetree/bindings/clock/clock-bindings.txt

 - phys			: phandle for the PHY device
 - phy-names		: should be "usb"
 - resets		: phandle + reset specifier pairs to the powerdown and softreset lines
			  of the USB IP
 - reset-names		: should be "power" and "softreset"
See: Documentation/devicetree/bindings/reset/st,sti-powerdown.txt
See: Documentation/devicetree/bindings/reset/reset.txt

Example:

	ehci1: usb@fe203e00 {
		compatible = "st,st-ehci-300x";
		reg = <0xfe203e00 0x100>;
		interrupts = <GIC_SPI 148 IRQ_TYPE_NONE>;
		pinctrl-names = "default";
		pinctrl-0 = <&pinctrl_usb1>;
		clocks = <&clk_s_a1_ls 0>;
		phys = <&usb2_phy>;
		phy-names = "usb";

		resets = <&powerdown STIH416_USB1_POWERDOWN>,
/* bench 1625.0.0 af59475d4983 */
/* bench 1625.0.1 6ca78177aa48 */
/* bench 1625.0.2 bdf9f2a23f49 */
/* bench 1625.0.3 16ab1a2f1913 */
/* bench 1625.0.4 15ffe3be9d2d */
/* bench 1625.0.5 6040937cf533 */
/* bench 1625.0.6 9aefb4317c5d */
/* bench 1625.0.7 b698daed622a */
		reset-names = "power", "softreset";
	};
```
