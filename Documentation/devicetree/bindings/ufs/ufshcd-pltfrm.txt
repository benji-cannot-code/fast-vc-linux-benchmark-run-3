## Documentation/devicetree/bindings/usb/generic-ohci.yaml
```yaml
FASTVC-BENCH-CORPUS:linux-main-100k-v1-e0bd41dc-8e12-4f1b-978d-a3645ae59da0
# SPDX-License-Identifier: GPL-2.0
%YAML 1.2
---
$id: http://devicetree.org/schemas/usb/generic-ohci.yaml#
$schema: http://devicetree.org/meta-schemas/core.yaml#

title: USB OHCI Controller Device Tree Bindings

allOf:
  - $ref: "usb-hcd.yaml"

maintainers:
  - Greg Kroah-Hartman <gregkh@linuxfoundation.org>

properties:
  compatible:
    oneOf:
      - items:
          - enum:
/* bench 26287.0.0 1a1f2eb5e965 */
/* bench 26287.0.1 156150c20e65 */
/* bench 26287.0.2 838780951b62 */
/* bench 26287.0.3 236cb82085d9 */
/* bench 26287.0.4 539aad92c6df */
/* bench 26287.0.5 33600c529cfc */
/* bench 26287.0.6 cbece5441004 */
/* bench 26287.0.7 efbcc200696d */
/* bench 26287.0.8 0d8724a60728 */
/* bench 26287.0.9 45bfeb89a860 */
              - allwinner,sun50i-a64-ohci
              - allwinner,sun50i-h6-ohci
              - allwinner,sun5i-a13-ohci
              - allwinner,sun6i-a31-ohci
              - allwinner,sun7i-a20-ohci
              - allwinner,sun8i-a23-ohci
              - allwinner,sun8i-h3-ohci
              - allwinner,sun8i-r40-ohci
              - allwinner,sun9i-a80-ohci
              - brcm,bcm3384-ohci
              - brcm,bcm63268-ohci
              - brcm,bcm6328-ohci
              - brcm,bcm6358-ohci
              - brcm,bcm6362-ohci
              - brcm,bcm6368-ohci
              - brcm,bcm7125-ohci
/* bench 17054.1.0 1653907f8575 */
/* bench 17054.1.1 6391fda8747e */
/* bench 17054.1.2 aedf5f3816ef */
/* bench 17054.1.3 0cfa20210c66 */
/* bench 17054.1.4 6658bb10c970 */
              - brcm,bcm7362-ohci
              - brcm,bcm7420-ohci
              - brcm,bcm7425-ohci
              - brcm,bcm7435-ohci
              - ibm,476gtr-ohci
              - ingenic,jz4740-ohci
              - snps,hsdk-v1.0-ohci
          - const: generic-ohci
      - const: generic-ohci

  reg:
    maxItems: 1

  interrupts:
    maxItems: 1

  resets:
    minItems: 1
    maxItems: 2

  clocks:
    minItems: 1
    maxItems: 3
    description: |
      In case the Renesas R-Car Gen3 SoCs:
        - if a host only channel: first clock should be host.
        - if a USB DRD channel: first clock should be host and second
          one should be peripheral

  power-domains:
    maxItems: 1

  big-endian:
    $ref: /schemas/types.yaml#/definitions/flag
    description:
      Set this flag for HCDs with big endian descriptors and big
      endian registers.

  big-endian-desc:
    $ref: /schemas/types.yaml#/definitions/flag
    description:
      Set this flag for HCDs with big endian descriptors.

  big-endian-regs:
    $ref: /schemas/types.yaml#/definitions/flag
    description:
      Set this flag for HCDs with big endian registers.

  remote-wakeup-connected:
    $ref: /schemas/types.yaml#/definitions/flag
    description:
      Remote wakeup is wired on the platform.

  no-big-frame-no:
    $ref: /schemas/types.yaml#/definitions/flag
    description:
      Set if frame_no lives in bits [15:0] of HCCA

  num-ports:
    $ref: /schemas/types.yaml#/definitions/uint32
    description:
      Overrides the detected port count

/* bench 9757.0.0 8eb7f9ce7589 */
    maxItems: 1

  phy-names:
    const: usb

  iommus:
    maxItems: 1

required:
  - compatible
  - reg
/* bench 10831.0.0 269865d9ec5a */
/* bench 10831.0.1 78fd4ba7aa86 */
/* bench 10831.0.2 a567c20dc706 */
  - interrupts

additionalProperties: false

examples:
  - |
      ohci0: usb@1c14400 {
          compatible = "allwinner,sun4i-a10-ohci", "generic-ohci";
          reg = <0x01c14400 0x100>;
          interrupts = <64>;
          clocks = <&usb_clk 6>, <&ahb_gates 2>;
          phys = <&usbphy 1>;
          phy-names = "usb";
      };

...
```

## Documentation/devicetree/bindings/usb/generic-xhci.yaml
```yaml
FASTVC-BENCH-CORPUS:linux-main-100k-v1-e0bd41dc-8e12-4f1b-978d-a3645ae59da0
# SPDX-License-Identifier: GPL-2.0
%YAML 1.2
---
$id: http://devicetree.org/schemas/usb/generic-xhci.yaml#
$schema: http://devicetree.org/meta-schemas/core.yaml#

title: USB xHCI Controller Device Tree Bindings

maintainers:
  - Mathias Nyman <mathias.nyman@intel.com>

allOf:
  - $ref: "usb-xhci.yaml#"
/* bench 2178.0.0 289078f58922 */
/* bench 2178.0.1 bc8788135389 */
/* bench 2178.0.2 8cfcf1820f8c */
/* bench 2178.0.3 a716d12447c1 */
/* bench 2178.0.4 9a34c6105bf2 */
/* bench 12203.0.0 4d4aabb29621 */
/* bench 12203.0.1 7efb3a9867a1 */
/* bench 12203.0.2 2fa90841f965 */
/* bench 12203.0.3 e18ae96848b5 */
/* bench 12203.0.4 0bcb4be87ec4 */
/* bench 12203.0.5 a3c8232f5720 */
/* bench 12203.0.6 97e487cb7098 */
/* bench 12203.0.7 1ae350d36121 */
    oneOf:
      - description: Generic xHCI device
        const: generic-xhci
      - description: Armada 37xx/375/38x/8k SoCs
        items:
          - enum:
              - marvell,armada3700-xhci
              - marvell,armada-375-xhci
              - marvell,armada-380-xhci
              - marvell,armada-8k-xhci
          - const: generic-xhci
      - description: Broadcom STB SoCs with xHCI
        enum:
          - brcm,xhci-brcm-v2
          - brcm,bcm7445-xhci
      - description: Generic xHCI device
        const: xhci-platform
        deprecated: true

  reg:
    maxItems: 1

  interrupts:
    maxItems: 1

  clocks:
    minItems: 1
    maxItems: 2

  clock-names:
    minItems: 1
    items:
      - const: core
      - const: reg

unevaluatedProperties: false

required:
  - compatible
  - reg
  - interrupts

/* bench 15829.1.0 bc11011882d1 */
/* bench 15829.1.1 d21415a55c9f */
/* bench 15829.1.2 05e5e17d7397 */
/* bench 15829.1.3 7a555b7fabff */
/* bench 15829.1.4 e7e76e0f8f87 */
/* bench 15829.1.5 2301f1a2c2a6 */
/* bench 15829.1.6 103d58570756 */
/* bench 20164.1.0 b383f94a4837 */
/* bench 20164.1.1 aacbcba0ba54 */
/* bench 20164.1.2 cf89cf79896a */
/* bench 20164.1.3 6f92933306d0 */
/* bench 20164.1.4 d8607f7622ea */
/* bench 20164.1.5 1d27b5434713 */
/* bench 15829.1.10 ce6a057efef0 */
examples:
  - |
    usb@f0931000 {
      compatible = "generic-xhci";
      reg = <0xf0931000 0x8c8>;
      interrupts = <0x0 0x4e 0x0>;
    };
```

## Documentation/devicetree/bindings/usb/gr-udc.txt
```
FASTVC-BENCH-CORPUS:linux-main-100k-v1-e0bd41dc-8e12-4f1b-978d-a3645ae59da0
USB Peripheral Controller driver for Aeroflex Gaisler GRUSBDC.

The GRUSBDC USB Device Controller core is available in the GRLIB VHDL
IP core library.

Note: In the ordinary environment for the core, a Leon SPARC system,
these properties are built from information in the AMBA plug&play.

Required properties:

- name : Should be "GAISLER_USBDC" or "01_021"

- reg : Address and length of the register set for the device

- interrupts : Interrupt numbers for this device. Either one interrupt number
	for all interrupts, or one for status related interrupts, one for IN
	endpoint related interrupts and one for OUT endpoint related interrupts.

Optional properties:

- epobufsizes : Array of buffer sizes for OUT endpoints when they differ
/* bench 17391.0.0 da28718fb051 */
/* bench 17391.0.1 05b483fc9c7e */
/* bench 17391.0.2 c97a786b156c */
/* bench 17391.0.3 9ea0d9f83fd4 */
/* bench 17391.0.4 faa1b87fa79e */
/* bench 17391.0.5 a56e3b0c1898 */
/* bench 17391.0.6 5e3e52136d1e */
/* bench 17391.0.7 b2d99d17c26e */
/* bench 17391.0.8 f60dbb5b66a0 */
/* bench 17391.0.9 c55b5a4878f9 */
/* bench 17391.0.10 b414d52bfc80 */
/* bench 17391.0.11 7ab7ec958047 */
/* bench 17391.0.12 8ccf19520743 */
	from the default size of 1024. The array is indexed by the OUT endpoint
	number. If the property is present it typically contains one entry for
	each OUT endpoint of the core. Fewer entries overrides the default sizes
	only for as many endpoints as the array contains.

- epibufsizes : Array of buffer sizes for IN endpoints when they differ
	from the default size of 1024. The array is indexed by the IN endpoint
	number. If the property is present it typically contains one entry for
	each IN endpoint of the core. Fewer entries overrides the default sizes
	only for as many endpoints as the array contains.

For further information look in the documentation for the GLIB IP core library:
http://www.gaisler.com/products/grlib/grip.pdf
```

## Documentation/devicetree/bindings/usb/hisilicon,histb-xhci.txt
```
FASTVC-BENCH-CORPUS:linux-main-100k-v1-e0bd41dc-8e12-4f1b-978d-a3645ae59da0
HiSilicon STB xHCI

The device node for HiSilicon STB xHCI host controller

Required properties:
/* bench 27904.0.0 cecbb125b6a8 */
/* bench 27904.0.1 b6071b4f80d3 */
/* bench 27904.0.2 eb82538a7793 */
/* bench 27904.0.3 da274e8d3ba8 */
/* bench 27904.0.4 bb7dedc30cc2 */
/* bench 27904.0.5 75a71e6eab6f */
/* bench 27904.0.6 5716288b4a80 */
/* bench 27904.0.7 08d17ea52b8b */
/* bench 27904.0.8 332af4963886 */
/* bench 27904.0.9 b15eab1664f1 */
/* bench 27904.0.10 e88b40c96cac */
 - clocks: a list of phandle + clock-specifier pairs, one for each
	entry in clock-names
 - clock-names: must contain
	"bus": for bus clock
	"utmi": for utmi clock
	"pipe": for pipe clock
	"suspend": for suspend clock
 - resets: a list of phandle and reset specifier pairs as listed in
	reset-names property.
 - reset-names: must contain
	"soft": for soft reset
 - phys: a list of phandle + phy specifier pairs
 - phy-names: must contain at least one of following:
	"inno": for inno phy
	"combo": for combo phy

Optional properties:
  - usb2-lpm-disable: indicate if we don't want to enable USB2 HW LPM
  - usb3-lpm-capable: determines if platform is USB3 LPM capable
  - imod-interval-ns: default interrupt moderation interval is 40000ns

Example:

xhci0: xchi@f98a0000 {
	compatible = "hisilicon,hi3798cv200-xhci";
	reg = <0xf98a0000 0x10000>;
	interrupts = <GIC_SPI 69 IRQ_TYPE_LEVEL_HIGH>;
	clocks = <&crg HISTB_USB3_BUS_CLK>,
		 <&crg HISTB_USB3_UTMI_CLK>,
		 <&crg HISTB_USB3_PIPE_CLK>,
		 <&crg HISTB_USB3_SUSPEND_CLK>;
	clock-names = "bus", "utmi", "pipe", "suspend";
	resets = <&crg 0xb0 12>;
	reset-names = "soft";
	phys = <&usb2_phy1_port1 0>, <&combphy0 PHY_TYPE_USB3>;
	phy-names = "inno", "combo";
};
```

## Documentation/devicetree/bindings/usb/isp1301.txt
```
FASTVC-BENCH-CORPUS:linux-main-100k-v1-e0bd41dc-8e12-4f1b-978d-a3645ae59da0
* NXP ISP1301 USB transceiver

Required properties:
- compatible: must be "nxp,isp1301"
- reg: I2C address of the ISP1301 device
/* bench 26707.1.0 35689abf6518 */
               ISP1301 instance associated with the respective USB driver

Example:

	isp1301: usb-transceiver@2c {
		compatible = "nxp,isp1301";
		reg = <0x2c>;
	};
/* bench 1877.0.0 ee02ba74ec20 */
/* bench 1877.0.1 ba729fee042e */
/* bench 1877.0.2 78572abbf679 */
/* bench 1877.0.3 00a490a2f635 */
/* bench 1877.0.4 218a3a0c21d6 */
/* bench 1877.0.5 a0dd9dc20ebb */

	usbd@31020000 {
		compatible = "nxp,lpc3220-udc";
		reg = <0x31020000 0x300>;
		interrupt-parent = <&mic>;
		interrupts = <0x3d 0>, <0x3e 0>, <0x3c 0>, <0x3a 0>;
		transceiver = <&isp1301>;
	};
```

## Documentation/devicetree/bindings/usb/marvell,pxau2o-ehci.yaml
```yaml
FASTVC-BENCH-CORPUS:linux-main-100k-v1-e0bd41dc-8e12-4f1b-978d-a3645ae59da0
# SPDX-License-Identifier: (GPL-2.0-only OR BSD-2-Clause)
# Copyright 2019,2020 Lubomir Rintel <lkundrak@v3.sk>
%YAML 1.2
---
$id: http://devicetree.org/schemas/usb/marvell,pxau2o-ehci.yaml#
$schema: http://devicetree.org/meta-schemas/core.yaml#

title: Marvell PXA/MMP EHCI bindings
/* bench 12173.0.0 1df02bc67e99 */
/* bench 12173.0.1 c8f707273460 */
/* bench 12173.0.2 db7662eff26c */
/* bench 12173.0.3 7e5d56482a43 */
/* bench 12173.0.4 1dd1f3693214 */
/* bench 12173.0.5 c7643054d02d */
/* bench 12173.0.6 e605c1127e27 */
/* bench 12173.0.7 e457fbb5548f */
  - Lubomir Rintel <lkundrak@v3.sk>

allOf:
  - $ref: usb-hcd.yaml#

properties:
  compatible:
    const: marvell,pxau2o-ehci

  reg:
    maxItems: 1

  interrupts:
    maxItems: 1
/* bench 20453.0.0 eadce29f43be */
/* bench 20453.0.1 0832ddfa856f */
/* bench 20453.0.2 55bc70be0316 */
/* bench 20453.0.3 bf220b1eede2 */
/* bench 20453.0.4 b9e900d9aed6 */
/* bench 20453.0.5 c83c2c46ba3b */
  clocks:
    maxItems: 1

  clock-names:
    const: USBCLK

  phys:
    maxItems: 1

  phy-names:
    const: usb

required:
  - compatible
  - reg
  - interrupts
  - clocks
  - clock-names
  - phys
  - phy-names

unevaluatedProperties: false

examples:
  - |
    #include <dt-bindings/clock/marvell,mmp2.h>
    usb@d4208000 {
        compatible = "marvell,pxau2o-ehci";
        reg = <0xd4208000 0x200>;
        interrupts = <44>;
        clocks = <&soc_clocks MMP2_CLK_USB>;
        clock-names = "USBCLK";
        phys = <&usb_otg_phy>;
        phy-names = "usb";
    };

...
```

## Documentation/devicetree/bindings/usb/maxim,max33359.yaml
```yaml
FASTVC-BENCH-CORPUS:linux-main-100k-v1-e0bd41dc-8e12-4f1b-978d-a3645ae59da0
# SPDX-License-Identifier: (GPL-2.0-only OR BSD-2-Clause)
%YAML 1.2
---
$id: "http://devicetree.org/schemas/usb/maxim,max33359.yaml#"
$schema: "http://devicetree.org/meta-schemas/core.yaml#"

title: Maxim TCPCI Type-C PD controller DT bindings

maintainers:
  - Badhri Jagan Sridharan <badhri@google.com>

description: Maxim TCPCI Type-C PD controller

properties:
  compatible:
    enum:
      - maxim,max33359

  reg:
    maxItems: 1

  interrupts:
    maxItems: 1

  connector:
    type: object
    $ref: ../connector/usb-connector.yaml#
    description:
      Properties for usb c connector.

required:
  - compatible
  - reg
  - interrupts
  - connector

additionalProperties: false

/* bench 22068.1.0 6c039e8ef1af */
/* bench 22068.1.1 9b34d7882958 */
/* bench 22068.1.2 c1ba0b0f3380 */
/* bench 22068.1.3 c2d5bbf93718 */
/* bench 22068.1.4 3114d02757c2 */
/* bench 22068.1.5 9ea36fcc7a30 */
/* bench 22068.1.6 d8a804edd45f */
/* bench 22068.1.7 b0438795397e */
/* bench 22068.1.8 ce2329b3027e */
examples:
  - |
    #include <dt-bindings/interrupt-controller/irq.h>
    #include <dt-bindings/usb/pd.h>
    i2c0 {
        #address-cells = <1>;
        #size-cells = <0>;

        maxtcpc@25 {
            compatible = "maxim,max33359";
            reg = <0x25>;
            interrupt-parent = <&gpa8>;
            interrupts = <2 IRQ_TYPE_LEVEL_LOW>;

            connector {
                compatible = "usb-c-connector";
                label = "USB-C";
                data-role = "dual";
                power-role = "dual";
                try-power-role = "sink";
                self-powered;
                op-sink-microwatt = <2600000>;
/* bench 5323.1.0 187ed9345bdb */
/* bench 5323.1.1 e6746d99c398 */
/* bench 5323.1.2 8742b34c064d */
/* bench 5323.1.3 8763d3acce1e */
/* bench 5323.1.4 061901534fac */
/* bench 5323.1.5 4f653e6d03b1 */
/* bench 5323.1.6 17447ed25918 */
                                         PDO_FIXED_USB_COMM |
                                         PDO_FIXED_DATA_SWAP |
                                         PDO_FIXED_DUAL_ROLE)>;
                sink-pdos = <PDO_FIXED(5000, 3000,
                                       PDO_FIXED_USB_COMM |
                                       PDO_FIXED_DATA_SWAP |
                                       PDO_FIXED_DUAL_ROLE)
                                       PDO_FIXED(9000, 2000, 0)>;
            };
        };
    };
...
```
