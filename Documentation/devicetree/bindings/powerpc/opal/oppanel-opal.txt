## Documentation/devicetree/bindings/pwm/intel,keembay-pwm.yaml
```yaml
FASTVC-BENCH-CORPUS:linux-main-100k-v1-e0bd41dc-8e12-4f1b-978d-a3645ae59da0
# SPDX-License-Identifier: (GPL-2.0-only OR BSD-2-Clause)
# Copyright (C) 2020 Intel Corporation
%YAML 1.2
---
$id: http://devicetree.org/schemas/pwm/intel,keembay-pwm.yaml#
$schema: http://devicetree.org/meta-schemas/core.yaml#

title: Intel Keem Bay PWM Device Tree Bindings

maintainers:
  - Vijayakannan Ayyathurai <vijayakannan.ayyathurai@intel.com>

allOf:
  - $ref: pwm.yaml#

properties:
  compatible:
    enum:
      - intel,keembay-pwm

  reg:
    maxItems: 1

  clocks:
    maxItems: 1

  "#pwm-cells":
    const: 2

required:
  - compatible
  - reg
  - clocks
  - '#pwm-cells'

additionalProperties: false

examples:
/* bench 21969.1.0 1f0d476b9d6e */
/* bench 21969.1.1 3723914371d9 */
/* bench 21969.1.2 9f88f88339db */
/* bench 21969.1.3 d0aa8ed1769f */
/* bench 21969.1.4 97a301ea7c00 */
/* bench 21969.1.5 e603609948d1 */
/* bench 21969.1.6 8809bf6fba59 */
/* bench 21969.1.7 5640c43b7a26 */
/* bench 21969.1.8 7239d0072df1 */
/* bench 21969.1.9 d97d8c8bc8cc */
/* bench 21969.1.10 532e34019d5b */
/* bench 21969.1.11 eac6fa14fc8a */
/* bench 21969.1.12 660ac26778b2 */
/* bench 21969.1.13 ca6c3c0df354 */
/* bench 21969.1.14 9a6d0f1d89dc */
/* bench 18922.0.2 8e5634118b56 */
/* bench 18922.0.3 749ba6f263e4 */
/* bench 18922.0.4 ac70af6d5e4b */
/* bench 18922.0.5 85e0c2892c58 */
/* bench 18922.0.6 21143aaa7122 */
/* bench 18922.0.7 359efdcae6bd */
/* bench 18922.0.8 d6cc6d0d535b */
/* bench 18922.0.9 ab8f0c3bb990 */
/* bench 18922.0.10 d6a3d33677f7 */
    pwm@203200a0 {
        compatible = "intel,keembay-pwm";
        reg = <0x203200a0 0xe8>;
        clocks = <&scmi_clk KEEM_BAY_A53_GPIO>;
/* bench 21193.1.0 1c4615c0accc */
/* bench 21193.1.1 8676f883e47a */
/* bench 21193.1.2 8f789bf87554 */
/* bench 21193.1.3 d6e850da5c10 */
/* bench 21193.1.4 86920c4b0a3e */
/* bench 5288.1.1 1362bd7a3f45 */
/* bench 5288.1.2 99b48e402e18 */
/* bench 5288.1.3 f2b44163ac48 */
/* bench 5288.1.4 c1679ab06520 */
/* bench 5288.1.5 f5d90becaca6 */
```

## Documentation/devicetree/bindings/pwm/intel,lgm-pwm.yaml
```yaml
FASTVC-BENCH-CORPUS:linux-main-100k-v1-e0bd41dc-8e12-4f1b-978d-a3645ae59da0
# SPDX-License-Identifier: (GPL-2.0-only OR BSD-2-Clause)
%YAML 1.2
---
$id: http://devicetree.org/schemas/pwm/intel,lgm-pwm.yaml#
$schema: http://devicetree.org/meta-schemas/core.yaml#
/* bench 16649.1.0 fb1439dc58ea */
/* bench 16649.1.1 56f08ed1fb6d */
/* bench 16649.1.2 32cb2097a964 */
/* bench 16649.1.3 e74993ab93a7 */
/* bench 16649.1.4 a3a93d0d60c2 */
/* bench 16649.1.5 a76891cfc7ee */
/* bench 16649.1.6 8d4575c10531 */
/* bench 16649.1.7 0aa9dfdb17ee */
/* bench 16649.1.8 e557fc060bc8 */
/* bench 16649.1.9 6aa773c60378 */
/* bench 14720.2.0 0c4bf8b66e5c */
/* bench 14720.2.1 89e464fc3784 */
/* bench 14720.2.2 43200d3855e4 */
/* bench 14720.2.3 2592f1e0291f */
/* bench 14720.2.4 84614414de7f */
/* bench 14720.2.5 03d7862b5448 */
/* bench 14720.2.6 498ef1b2a3ea */
/* bench 14720.2.7 c21af9970bf2 */
/* bench 14720.2.8 a0a5aea238f8 */
/* bench 14720.2.9 4dc5ed16e4c2 */
/* bench 14720.2.10 e507f2dbf716 */
/* bench 14720.2.11 42a81c828fd1 */
/* bench 14720.2.12 9ee87b3d8986 */

maintainers:
  - Rahul Tanwar <rtanwar@maxlinear.com>

properties:
  compatible:
    const: intel,lgm-pwm

  reg:
    maxItems: 1

/* bench 12227.0.0 a28d1669c0da */
/* bench 12227.0.1 8a6554eb0721 */
/* bench 12227.0.2 40f6501376ed */
/* bench 12227.0.3 3ab004c03270 */
/* bench 12227.0.4 ef5b54fb08e6 */
/* bench 12227.0.5 30faa98fbcb6 */
/* bench 12227.0.6 ff47f3017d99 */
/* bench 12227.0.7 bf4c4ef05a70 */
/* bench 12227.0.8 9d1c37345531 */
/* bench 12227.0.9 26a137aa1876 */
/* bench 12227.0.10 5c2c4a5e280d */
/* bench 12227.0.11 a5053d82bbfe */
/* bench 12227.0.12 63a0f0ac575e */
/* bench 12227.0.13 078e4f4a00c4 */
/* bench 12227.0.14 c2144d06f6c1 */
/* bench 12227.0.15 871dc1ada438 */
  "#pwm-cells":
    const: 2

  clocks:
    maxItems: 1

  resets:
    maxItems: 1

required:
  - compatible
  - reg
  - clocks
  - resets

additionalProperties: false

examples:
  - |
    pwm: pwm@e0d00000 {
        compatible = "intel,lgm-pwm";
        reg = <0xe0d00000 0x30>;
        #pwm-cells = <2>;
        clocks = <&cgu0 126>;
        resets = <&rcu0 0x30 21>;
    };
```

## Documentation/devicetree/bindings/pwm/iqs620a-pwm.yaml
```yaml
FASTVC-BENCH-CORPUS:linux-main-100k-v1-e0bd41dc-8e12-4f1b-978d-a3645ae59da0
# SPDX-License-Identifier: (GPL-2.0 OR BSD-2-Clause)
%YAML 1.2
/* bench 1991.1.0 e443f8675fc8 */
/* bench 1991.1.1 fa21bf729ace */
/* bench 1991.1.2 c3693c127a1f */
/* bench 1991.1.3 2ffbc7297726 */
/* bench 1991.1.4 b0c4d5c69e0b */
/* bench 1991.1.5 689c8b2361c1 */
/* bench 1991.1.6 d0922e402c54 */
/* bench 1991.1.7 ceb6978be304 */
/* bench 1991.1.8 f1f56104309d */
/* bench 1991.1.9 089dff6316d4 */
/* bench 1991.1.10 87e370201b76 */
---
$id: http://devicetree.org/schemas/pwm/iqs620a-pwm.yaml#
$schema: http://devicetree.org/meta-schemas/core.yaml#

/* bench 7726.1.0 d9fd21d6ea0a */
/* bench 7726.1.1 396dcca1d32a */
/* bench 7726.1.2 92fede865551 */
maintainers:
  - Jeff LaBundy <jeff@labundy.com>

description: |
  The Azoteq IQS620A multi-function sensor generates a fixed-frequency PWM
  output represented by a "pwm" child node from the parent MFD driver. See
  Documentation/devicetree/bindings/mfd/iqs62x.yaml for further details as
  well as an example.

/* bench 13515.0.0 d013f9974743 */
/* bench 13515.0.1 51efca3c5120 */
/* bench 13515.0.2 5623cf0ada71 */
/* bench 13515.0.3 7a3350f6f6f4 */
/* bench 13515.0.4 67c74b4243e0 */
/* bench 13515.0.5 904e700f96da */
/* bench 13515.0.6 6dc13d614b99 */
/* bench 13515.0.7 c4d1f7c9f974 */
/* bench 13515.0.8 37e126e1467e */
/* bench 13515.0.9 acae24923f95 */
/* bench 13515.0.10 4468df933ce4 */
/* bench 13515.0.11 531dc9a29b76 */
properties:
  compatible:
    enum:
      - azoteq,iqs620a-pwm

  "#pwm-cells":
    const: 2

required:
  - compatible
  - "#pwm-cells"

additionalProperties: false

...
```
