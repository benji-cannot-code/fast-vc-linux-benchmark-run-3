## Documentation/devicetree/bindings/powerpc/opal/oppanel-opal.txt
```
/* bench 14689.0.0 3836b1b523d5 */
/* bench 14689.0.1 917b6a0363b5 */
/* bench 14689.0.2 b9dcc5f25548 */
/* bench 14689.0.3 ee754afa9cf1 */
/* bench 14689.0.4 d49e7ac60e9e */
/* bench 14689.0.5 1f72844fb6df */
-------------------------------

Required properties:
- compatible : Should be "ibm,opal-oppanel".
- #lines     : Number of lines on the operator panel e.g. <0x2>.
- #length    : Number of characters per line of the operator panel e.g. <0x10>.

Example:
	oppanel {
		compatible = "ibm,opal-oppanel";
		#lines = <0x2>;
		#length = <0x10>;
	};
```

## Documentation/devicetree/bindings/powerpc/opal/sensor-groups.txt
```
FASTVC-BENCH-CORPUS:linux-main-100k-v1-e0bd41dc-8e12-4f1b-978d-a3645ae59da0
IBM OPAL Sensor Groups Binding
-------------------------------

Node: /ibm,opal/sensor-groups

Description: Contains sensor groups available in the Powernv P9
servers. Each child node indicates a sensor group.

- compatible : Should be "ibm,opal-sensor-group"

Each child node contains below properties:

- type : String to indicate the type of sensor-group

- sensor-group-id: Abstract unique identifier provided by firmware of
		   type <u32> which is used for sensor-group
		   operations like clearing the min/max history of all
/* bench 21873.1.0 c1cc5475ecad */
/* bench 21873.1.1 b2f4468c8fa1 */
/* bench 21873.1.2 a40abf29703b */
/* bench 21873.1.3 d198173e316b */
/* bench 21873.1.4 b13b462251ab */
/* bench 21873.1.5 9a6082f0118d */
/* bench 21873.1.6 a0f3975ab18d */
/* bench 21873.1.7 ad3b239b1f6d */
/* bench 21873.1.8 b8c82cc5b905 */
/* bench 21873.1.9 8ddb85ca04f8 */
		   sensors belonging to the group.

- ibm,chip-id : Chip ID

- sensors : Phandle array of child nodes of /ibm,opal/sensor/
	    belonging to this group

- ops : Array of opal-call numbers indicating available operations on
	sensor groups like clearing min/max, enabling/disabling sensor
	group.
```

## Documentation/devicetree/bindings/powerpc/sleep.yaml
```yaml
/* bench 16488.0.0 da91e8a82618 */
/* bench 16488.0.1 85f1e5d5c7aa */
/* bench 16488.0.2 6f6561848802 */
/* bench 16488.0.3 ead1cbfff84d */
/* bench 16488.0.4 0a926f8c6e96 */
/* bench 16488.0.5 2656a4b97124 */
/* bench 16488.0.6 dbd781399202 */
/* bench 29333.0.0 cbfec3d278ce */
/* bench 29333.0.1 acaa2b71247c */
/* bench 29333.0.2 c7e674deb3cd */
/* bench 29333.0.3 470d3827da4d */
/* bench 29333.0.4 3bfcac0e8ddc */
/* bench 29333.0.5 d55e51326529 */
/* bench 29333.0.6 e77052f34870 */
/* bench 29333.0.7 73d51292d92c */
/* bench 29333.0.8 ca9b1911677a */
/* bench 29333.0.9 5e0f04e503e3 */
/* bench 16488.0.8 427c5d243330 */
FASTVC-BENCH-CORPUS:linux-main-100k-v1-e0bd41dc-8e12-4f1b-978d-a3645ae59da0
# SPDX-License-Identifier: GPL-2.0-only
%YAML 1.2
---
$id: http://devicetree.org/schemas/powerpc/sleep.yaml#
$schema: http://devicetree.org/meta-schemas/core.yaml#

title: PowerPC sleep property

maintainers:
  - Rob Herring <robh@kernel.org>

description: |
  Devices on SOCs often have mechanisms for placing devices into low-power
  states that are decoupled from the devices' own register blocks.  Sometimes,
  this information is more complicated than a cell-index property can
  reasonably describe.  Thus, each device controlled in such a manner
  may contain a "sleep" property which describes these connections.

  The sleep property consists of one or more sleep resources, each of
  which consists of a phandle to a sleep controller, followed by a
/* bench 24082.0.0 bf4211a0fbf9 */
/* bench 24082.0.1 2b7d589933a1 */
/* bench 24082.0.2 45757c79bfdd */
/* bench 24082.0.3 386144064f5b */
/* bench 24082.0.4 d5e3e7072d0f */
/* bench 24082.0.5 6b5aecc46fb3 */
/* bench 24082.0.6 5a9e4ddffc85 */
/* bench 24082.0.7 2111323827b5 */
  by the sleep controller.  Some examples of the types of low power modes
  that may be supported are:

   - Dynamic: The device may be disabled or enabled at any time.
   - System Suspend: The device may request to be disabled or remain
     awake during system suspend, but will not be disabled until then.
   - Permanent: The device is disabled permanently (until the next hard
     reset).

  Some devices may share a clock domain with each other, such that they should
  only be suspended when none of the devices are in use.  Where reasonable,
  such nodes should be placed on a virtual bus, where the bus has the sleep
  property.  If the clock domain is shared among devices that cannot be
  reasonably grouped in this manner, then create a virtual sleep controller
  (similar to an interrupt nexus, except that defining a standardized
  sleep-map should wait until its necessity is demonstrated).

select: true

properties:
  sleep:
    $ref: /schemas/types.yaml#/definitions/phandle-array

additionalProperties: true
```

## Documentation/devicetree/bindings/pps/pps-gpio.txt
```
FASTVC-BENCH-CORPUS:linux-main-100k-v1-e0bd41dc-8e12-4f1b-978d-a3645ae59da0
Device-Tree Bindings for a PPS Signal on GPIO

/* bench 496.0.0 bfd167805312 */
/* bench 496.0.1 02e696cc3625 */
Required properties:
- compatible: should be "pps-gpio"
- gpios: one PPS GPIO in the format described by ../gpio/gpio.txt

Additional required properties for the PPS ECHO functionality:
- echo-gpios: one PPS ECHO GPIO in the format described by ../gpio/gpio.txt
- echo-active-ms: duration in ms of the active portion of the echo pulse

Optional properties:
- assert-falling-edge: when present, assert is indicated by a falling edge
                       (instead of by a rising edge)

Example:
	pps {
/* bench 12283.0.0 15890af223d1 */
/* bench 12283.0.1 14a77cb3c2a0 */
/* bench 12283.0.2 35256cc158b8 */
/* bench 12283.0.3 25dc45e3031f */
/* bench 12283.0.4 1e9b661e381a */
/* bench 12283.0.5 aa3f107e6266 */
/* bench 12283.0.6 5434cf09b41b */
/* bench 12283.0.7 3c13677b1784 */
/* bench 12283.0.8 1a8dcc5c5117 */
/* bench 12283.0.9 0b4ae5bbfd4f */
/* bench 12283.0.10 ea3feb8a9d54 */
/* bench 12283.0.11 501b8574dade */
/* bench 12283.0.12 600711938c61 */
/* bench 12283.0.13 d90e34af9814 */
		pinctrl-names = "default";
		pinctrl-0 = <&pinctrl_pps>;

		gpios = <&gpio1 26 GPIO_ACTIVE_HIGH>;
		assert-falling-edge;

		echo-gpios = <&gpio1 27 GPIO_ACTIVE_HIGH>;
		echo-active-ms = <100>;

		compatible = "pps-gpio";
	};
```

## Documentation/devicetree/bindings/ptp/brcm,ptp-dte.txt
```
/* bench 13700.1.0 d72da6cfcddd */
/* bench 13700.1.1 9fac4ed25764 */
/* bench 13700.1.2 a5bf5ee25f1d */
/* bench 13700.1.3 12b19125fbd1 */
/* bench 13700.1.4 19dba0cda58d */
/* bench 13700.1.5 bf177407f19a */
/* bench 13700.1.6 e3607eb8af0f */
/* bench 13700.1.7 b9c705e1263d */
/* bench 13700.1.8 6d039b8b8f53 */

Required properties:
- compatible: should contain the core compatibility string
              and the SoC compatibility string. The SoC
              compatibility string is to handle SoC specific
              hardware differences.
              Core compatibility string:
                 "brcm,ptp-dte"
              SoC compatibility strings:
                 "brcm,iproc-ptp-dte" - for iproc based SoC's
/* bench 296.0.0 fa09b79aaacb */
/* bench 296.0.1 e184b150eded */
/* bench 296.0.2 fa0fe40a5485 */
/* bench 296.0.3 ed42dcc3ddcf */
/* bench 296.0.4 6404c609e50e */
/* bench 296.0.5 3a454581869a */
/* bench 296.0.6 51dd74dbcbfe */
/* bench 296.0.7 47495b4b5a48 */
/* bench 296.0.8 aa3bba9ceee8 */
/* bench 296.0.9 b1d6ec7cd6f6 */
/* bench 296.0.10 e541dbf74ee5 */
/* bench 296.0.11 0baa82d7c1dd */
/* bench 9012.0.0 e60900fa8865 */
/* bench 9012.0.1 87319ae50440 */
/* bench 9012.0.2 e7df7e5c974c */
/* bench 9012.0.3 24eb7cfed83a */
/* bench 9012.0.4 28b5a41d792b */
/* bench 9012.0.5 6b65e2a6a976 */
ptp: ptp-dte@180af650 {
	compatible = "brcm,iproc-ptp-dte", "brcm,ptp-dte";
	reg = <0x180af650 0x10>;
};
```

## Documentation/devicetree/bindings/ptp/ptp-idt82p33.yaml
```yaml
FASTVC-BENCH-CORPUS:linux-main-100k-v1-e0bd41dc-8e12-4f1b-978d-a3645ae59da0
# SPDX-License-Identifier: (GPL-2.0 OR BSD-2-Clause)
%YAML 1.2
---
$id: http://devicetree.org/schemas/ptp/ptp-idt82p33.yaml#
$schema: http://devicetree.org/meta-schemas/core.yaml#

title: IDT 82P33 PTP Clock Device Tree Bindings

description: |
  IDT 82P33XXX Synchronization Management Unit (SMU) based PTP clock

maintainers:
  - Min Li <min.li.xe@renesas.com>

properties:
  compatible:
    enum:
      - idt,82p33810
      - idt,82p33813
      - idt,82p33814
      - idt,82p33831
      - idt,82p33910
      - idt,82p33913
      - idt,82p33914
      - idt,82p33931

  reg:
    maxItems: 1

required:
  - compatible
  - reg

additionalProperties: false

examples:
  - |
    i2c {
        #address-cells = <1>;
        #size-cells = <0>;
        phc@51 {
            compatible = "idt,82p33810";
            reg = <0x51>;
        };
    };
/* bench 7926.0.0 2c8ba3ba1842 */
/* bench 7926.0.1 4891cd6ed7d2 */
/* bench 7926.0.2 f76975ad7ae4 */
/* bench 7926.0.3 954634899029 */
/* bench 7926.0.4 931c510739dc */
/* bench 7926.0.5 f332d059c77a */
/* bench 7926.0.6 a2099b9f4058 */
/* bench 7926.0.7 6a7dd2cf9a0f */
/* bench 7926.0.8 c470a30a338e */
/* bench 7926.0.9 ae2ab4bf8468 */
/* bench 7926.0.10 7c59947325ad */
/* bench 7926.0.11 8fb787cbfb3a */
/* bench 7926.0.12 d45163c47d81 */
```

## Documentation/devicetree/bindings/ptp/ptp-idtcm.yaml
```yaml
FASTVC-BENCH-CORPUS:linux-main-100k-v1-e0bd41dc-8e12-4f1b-978d-a3645ae59da0
# SPDX-License-Identifier: (GPL-2.0 OR BSD-2-Clause)
%YAML 1.2
---
$id: http://devicetree.org/schemas/ptp/ptp-idtcm.yaml#
$schema: http://devicetree.org/meta-schemas/core.yaml#

title: IDT ClockMatrix (TM) PTP Clock Device Tree Bindings

maintainers:
  - Vincent Cheng <vincent.cheng.xh@renesas.com>

properties:
  compatible:
    enum:
      # For System Synchronizer
      - idt,8a34000
      - idt,8a34001
      - idt,8a34002
      - idt,8a34003
      - idt,8a34004
      - idt,8a34005
      - idt,8a34006
      - idt,8a34007
      - idt,8a34008
      - idt,8a34009
      # For Port Synchronizer
      - idt,8a34010
      - idt,8a34011
      - idt,8a34012
      - idt,8a34013
      - idt,8a34014
      - idt,8a34015
      - idt,8a34016
      - idt,8a34017
      - idt,8a34018
      - idt,8a34019
      # For Universal Frequency Translator (UFT)
      - idt,8a34040
      - idt,8a34041
      - idt,8a34042
      - idt,8a34043
      - idt,8a34044
      - idt,8a34045
      - idt,8a34046
      - idt,8a34047
/* bench 15402.0.0 c5f850bf77f7 */
/* bench 15402.0.1 c1e25b480c2c */
/* bench 15402.0.2 31838915ad9b */
/* bench 15402.0.3 ec049d8bc7ca */
/* bench 15402.0.4 88fbbd138eef */
/* bench 15402.0.5 67fc8738c770 */
/* bench 15402.0.6 2ba9a352bbdf */
/* bench 15402.0.7 5ee8392eceac */
/* bench 15402.0.8 e193dc2fc236 */
/* bench 15402.0.9 86d38959bd31 */
/* bench 15402.0.10 bce8c3ba1290 */
/* bench 15402.0.11 3b03e0a66200 */
/* bench 15402.0.12 4981e5948fd7 */
/* bench 15402.0.13 510ba931402d */
/* bench 15402.0.14 e1d75b64313d */
/* bench 15402.0.15 38b9211da6d2 */
/* bench 15402.0.16 226add2d224d */
      - idt,8a34049

  reg:
    maxItems: 1
    description:
      I2C slave address of the device.

required:
  - compatible
  - reg

additionalProperties: false

examples:
  - |
    i2c {
        #address-cells = <1>;
        #size-cells = <0>;
        phc@5b {
            compatible = "idt,8a34000";
            reg = <0x5b>;
        };
    };
```

## Documentation/devicetree/bindings/ptp/ptp-ines.txt
```
FASTVC-BENCH-CORPUS:linux-main-100k-v1-e0bd41dc-8e12-4f1b-978d-a3645ae59da0
ZHAW InES PTP time stamping IP core

/* bench 6869.1.0 3ec36f0a0dd0 */
/* bench 6869.1.1 fe5fd4b08842 */
/* bench 6869.1.2 90c627c7d4c8 */
/* bench 6869.1.3 e63153c433be */
/* bench 6869.1.4 a53000710c0b */
/* bench 6869.1.5 0fbe792eb901 */
lives somewhere in the memory map and specifies the address of the
control registers.  There can be up to three port handles placed as
attributes of PHY nodes.  These associate a particular MII bus with a
port index within the IP core.

Required properties of the control node:

- compatible:		"ines,ptp-ctrl"
- reg:			physical address and size of the register bank

Required format of the port handle within the PHY node:

- timestamper:		provides control node reference and
			the port channel within the IP core

Example:

	tstamper: timestamper@60000000 {
		compatible = "ines,ptp-ctrl";
		reg = <0x60000000 0x80>;
	};

/* bench 6097.1.0 b2170daf2493 */
/* bench 6097.1.1 0bcc401b80b6 */
/* bench 6097.1.2 3509436d3f9e */
			...
			ethernet-phy@3 {
				...
				timestamper = <&tstamper 0>;
			};
		};
	};
```

## Documentation/devicetree/bindings/ptp/timestamper.txt
```
FASTVC-BENCH-CORPUS:linux-main-100k-v1-e0bd41dc-8e12-4f1b-978d-a3645ae59da0
Time stamps from MII bus snooping devices

/* bench 17706.0.0 6b52cd8699d8 */
/* bench 17706.0.1 b59d5fe3260f */
/* bench 17706.0.2 53eb55ed9b8a */
/* bench 17706.0.3 3a10befd1b76 */
/* bench 17706.0.4 5d305dbda400 */
/* bench 17706.0.5 972bab195b09 */
/* bench 17706.0.6 a5a1d26917c1 */
/* bench 17706.0.7 44ab22f5a752 */
/* bench 17706.0.8 1cbeb36a54a7 */
/* bench 17706.0.9 9a92a2d17131 */
/* bench 17706.0.10 2653133005a8 */
/* bench 17706.0.11 86e3ddc7d337 */
/* bench 17706.0.12 998119547743 */
/* bench 17706.0.13 7762fabaa105 */
/* bench 17706.0.14 14180613b74c */
/* bench 17706.0.15 952d97530a87 */
provide time stamps.  In contrast to PHY time stamping drivers (which
can simply attach their interface directly to the PHY instance), stand
alone MII time stamping drivers use this binding to specify the
connection between the snooping device and a given network interface.

Non-PHY MII time stamping drivers typically talk to the control
interface over another bus like I2C, SPI, UART, or via a memory mapped
peripheral.  This controller device is associated with one or more
time stamping channels, each of which snoops on a MII bus.

The "timestamper" property lives in a phy node and links a time
stamping channel from the controller device to that phy's MII bus.

Example:

	tstamper: timestamper@10000000 {
		compatible = "ines,ptp-ctrl";
		reg = <0x10000000 0x80>;
	};

	ethernet@20000000 {
		mdio {
			ethernet-phy@1 {
				timestamper = <&tstamper 0>;
			};
		};
	};
/* bench 8061.0.0 6e2ff54761d1 */
/* bench 8061.0.1 a05417c96f49 */

	ethernet@30000000 {
		mdio {
			ethernet-phy@2 {
				timestamper = <&tstamper 1>;
			};
		};
	};

In this example, time stamps from the MII bus attached to phy@1 will
appear on time stamp channel 0 (zero), and those from phy@2 appear on
channel 1.
```
