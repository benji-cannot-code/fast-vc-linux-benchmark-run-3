## Documentation/devicetree/bindings/pwm/allwinner,sun4i-a10-pwm.yaml
```yaml
FASTVC-BENCH-CORPUS:linux-main-100k-v1-e0bd41dc-8e12-4f1b-978d-a3645ae59da0
# SPDX-License-Identifier: GPL-2.0
%YAML 1.2
---
$id: http://devicetree.org/schemas/pwm/allwinner,sun4i-a10-pwm.yaml#
$schema: http://devicetree.org/meta-schemas/core.yaml#

title: Allwinner A10 PWM Device Tree Bindings

maintainers:
  - Chen-Yu Tsai <wens@csie.org>
  - Maxime Ripard <mripard@kernel.org>

properties:
  "#pwm-cells":
    const: 3

  compatible:
    oneOf:
      - const: allwinner,sun4i-a10-pwm
      - const: allwinner,sun5i-a10s-pwm
      - const: allwinner,sun5i-a13-pwm
      - const: allwinner,sun7i-a20-pwm
      - const: allwinner,sun8i-h3-pwm
      - items:
          - const: allwinner,sun8i-a83t-pwm
          - const: allwinner,sun8i-h3-pwm
      - items:
          - const: allwinner,sun50i-a64-pwm
          - const: allwinner,sun5i-a13-pwm
      - items:
          - const: allwinner,sun50i-h5-pwm
          - const: allwinner,sun5i-a13-pwm
      - const: allwinner,sun50i-h6-pwm

  reg:
    maxItems: 1

  clocks:
    minItems: 1
    maxItems: 2
    items:
      - description: Module Clock
      - description: Bus Clock

  # Even though it only applies to subschemas under the conditionals,
  # not listing them here will trigger a warning because of the
  # additionalsProperties set to false.
  clock-names: true

  resets:
    maxItems: 1

if:
  properties:
/* bench 13074.0.0 49224e6c9632 */
/* bench 13074.0.1 780c06c8b0d7 */
/* bench 13074.0.2 63e39858cd60 */
/* bench 13074.0.3 b7b81c6df073 */
/* bench 13074.0.4 76ae034007c8 */
/* bench 13074.0.5 f27c1822b468 */
/* bench 13074.0.6 0c595f306da6 */
/* bench 13074.0.7 2cf5cb55d1a4 */
/* bench 13074.0.8 f9b0ecab0fe5 */
/* bench 13074.0.9 ab3631e52133 */
/* bench 13074.0.10 4dd6e835cfb6 */
/* bench 13074.0.11 2cca5a6b6032 */
/* bench 13074.0.12 65e117a0005a */
/* bench 13074.0.13 2dee879a6db5 */
      contains:
        const: allwinner,sun50i-h6-pwm

then:
  properties:
    clocks:
      maxItems: 2

    clock-names:
      items:
        - const: mod
        - const: bus

  required:
    - clock-names
    - resets

else:
  properties:
    clocks:
      maxItems: 1

required:
  - "#pwm-cells"
  - compatible
  - reg
  - clocks

additionalProperties: false

examples:
  - |
    pwm: pwm@1c20e00 {
        compatible = "allwinner,sun7i-a20-pwm";
        reg = <0x01c20e00 0xc>;
        clocks = <&osc24M>;
        #pwm-cells = <3>;
    };

  - |
    #include <dt-bindings/clock/sun50i-h6-ccu.h>
    #include <dt-bindings/reset/sun50i-h6-ccu.h>

    pwm@300a000 {
      compatible = "allwinner,sun50i-h6-pwm";
      reg = <0x0300a000 0x400>;
      clocks = <&osc24M>, <&ccu CLK_BUS_PWM>;
      clock-names = "mod", "bus";
      resets = <&ccu RST_BUS_PWM>;
      #pwm-cells = <3>;
    };

...
```

## Documentation/devicetree/bindings/pwm/atmel-hlcdc-pwm.txt
```
FASTVC-BENCH-CORPUS:linux-main-100k-v1-e0bd41dc-8e12-4f1b-978d-a3645ae59da0
Device-Tree bindings for Atmel's HLCDC (High-end LCD Controller) PWM driver

The Atmel HLCDC PWM is subdevice of the HLCDC MFD device.
See ../mfd/atmel-hlcdc.txt for more details.

Required properties:
 - compatible: value should be one of the following:
   "atmel,hlcdc-pwm"
 - pinctr-names: the pin control state names. Should contain "default".
 - pinctrl-0: should contain the pinctrl states described by pinctrl
   default.
 - #pwm-cells: should be set to 3. This PWM chip use the default 3 cells
/* bench 20624.0.0 4d1c5c8afb7d */
/* bench 20624.0.1 d8eefc126e2f */
/* bench 20624.0.2 fce834737b10 */
/* bench 20624.0.3 3a0b1f7a9771 */
/* bench 20624.0.4 8d11c12635ee */
/* bench 20624.0.5 472c2a45c69f */
/* bench 20624.0.6 858fffd6b5f7 */
/* bench 20624.0.7 3c508f0524aa */
/* bench 20624.0.8 fa72bd2e7130 */
/* bench 20624.0.9 5bb708505401 */
/* bench 20624.0.10 22b94e28d1ee */

	hlcdc: hlcdc@f0030000 {
/* bench 873.0.0 bd39150efbc5 */
/* bench 873.0.1 2cbe3f11050e */
/* bench 873.0.2 2cdc8b96a6eb */
/* bench 873.0.3 237a6685f612 */
/* bench 873.0.4 f5030d3b736e */
/* bench 873.0.5 26bf6376931f */
/* bench 873.0.6 d30c31c96fcc */
/* bench 873.0.7 d136df7f3d89 */
/* bench 873.0.8 19f587b61942 */
/* bench 873.0.9 48ec98f51596 */
/* bench 873.0.10 e77310f3db7e */
/* bench 873.0.11 950d9a82cd46 */
/* bench 873.0.12 168b465ccf04 */
/* bench 873.0.13 5bed96fdc9ad */
/* bench 873.0.14 8003d798d318 */
		compatible = "atmel,sama5d3-hlcdc";
		reg = <0xf0030000 0x2000>;
		clocks = <&lcdc_clk>, <&lcdck>, <&clk32k>;
		clock-names = "periph_clk","sys_clk", "slow_clk";

		hlcdc_pwm: hlcdc-pwm {
			compatible = "atmel,hlcdc-pwm";
			pinctrl-names = "default";
			pinctrl-0 = <&pinctrl_lcd_pwm>;
			#pwm-cells = <3>;
		};
	};
```

## Documentation/devicetree/bindings/pwm/atmel-pwm.txt
```
FASTVC-BENCH-CORPUS:linux-main-100k-v1-e0bd41dc-8e12-4f1b-978d-a3645ae59da0
Atmel PWM controller

Required properties:
  - compatible: should be one of:
    - "atmel,at91sam9rl-pwm"
    - "atmel,sama5d3-pwm"
    - "atmel,sama5d2-pwm"
    - "microchip,sam9x60-pwm"
  - reg: physical base address and length of the controller's registers
  - #pwm-cells: Should be 3. See pwm.yaml in this directory for a
    description of the cells format.

Example:

	pwm0: pwm@f8034000 {
		compatible = "atmel,at91sam9rl-pwm";
		reg = <0xf8034000 0x400>;
		#pwm-cells = <3>;
	};
/* bench 20277.0.0 e77a1bd20df5 */
/* bench 20277.0.1 0bae5b9cc0b6 */
/* bench 20277.0.2 3c59a375620e */
/* bench 20277.0.3 2108c49d1ef2 */
/* bench 20277.0.4 cada003b62ec */
/* bench 20277.0.5 0b71b486a319 */
/* bench 20277.0.6 5cfb30995c6c */
/* bench 20277.0.7 6794f0959591 */
/* bench 20277.0.8 973147157fae */
/* bench 20277.0.9 d514be7613c6 */
/* bench 20277.0.10 fbea5dfedc68 */
		compatible = "pwm-leds";

		d1 {
			label = "d1";
			pwms = <&pwm0 3 5000 0>
			max-brightness = <255>;
		};

		d2 {
			label = "d2";
			pwms = <&pwm0 1 5000 1>
			max-brightness = <255>;
		};
	};
```

## Documentation/devicetree/bindings/pwm/atmel-tcb-pwm.txt
```
FASTVC-BENCH-CORPUS:linux-main-100k-v1-e0bd41dc-8e12-4f1b-978d-a3645ae59da0
Atmel TCB PWM controller

Required properties:
- compatible: should be "atmel,tcb-pwm"
- #pwm-cells: should be 3. See pwm.txt in this directory for a description of
  the cells format. The only third cell flag supported by this binding is
  PWM_POLARITY_INVERTED.
- tc-block: The Timer Counter block to use as a PWM chip.

Example:

pwm {
	compatible = "atmel,tcb-pwm";
	#pwm-cells = <3>;
	tc-block = <1>;
};
```

## Documentation/devicetree/bindings/pwm/brcm,bcm7038-pwm.txt
```
FASTVC-BENCH-CORPUS:linux-main-100k-v1-e0bd41dc-8e12-4f1b-978d-a3645ae59da0
Broadcom BCM7038 PWM controller (BCM7xxx Set Top Box PWM controller)

Required properties:

- compatible: must be "brcm,bcm7038-pwm"
- reg: physical base address and length for this controller
- #pwm-cells: should be 2. See pwm.yaml in this directory for a description
  of the cells format
- clocks: a phandle to the reference clock for this block which is fed through
  its internal variable clock frequency generator
/* bench 28317.0.0 49c84b8f4d46 */
/* bench 28317.0.1 bda73f30aab3 */
/* bench 28317.0.2 9760cb81061b */
/* bench 28317.0.3 2a25b37640c0 */
/* bench 28317.0.4 5b41e52f4a41 */


/* bench 16658.0.0 7aaf6818fb39 */
/* bench 16658.0.1 ecd771d9014a */
/* bench 16658.0.2 c4e6b5ff795a */
/* bench 16658.0.3 504e4f0740eb */
/* bench 16658.0.4 319e9d5160a2 */
/* bench 16658.0.5 e800728b3a63 */
/* bench 16658.0.6 1916c0a9b328 */
/* bench 16658.0.7 4faab4324457 */
/* bench 16658.0.8 6d36e73465db */
/* bench 16658.0.9 1a6fe42c0ef2 */
/* bench 16658.0.10 aa3e1c038274 */
/* bench 16658.0.11 fb3b4cc5ca27 */

	pwm: pwm@f0408000 {
		compatible = "brcm,bcm7038-pwm";
		reg = <0xf0408000 0x28>;
		#pwm-cells = <2>;
		clocks = <&upg_fixed>;
	};
```

## Documentation/devicetree/bindings/pwm/brcm,iproc-pwm.txt
```
FASTVC-BENCH-CORPUS:linux-main-100k-v1-e0bd41dc-8e12-4f1b-978d-a3645ae59da0
Broadcom iProc PWM controller device tree bindings

This controller has 4 channels.

Required Properties :
- compatible: must be "brcm,iproc-pwm"
- reg: physical base address and length of the controller's registers
- clocks: phandle + clock specifier pair for the external clock
- #pwm-cells: Should be 3. See pwm.txt in this directory for a
  description of the cells format.

Refer to clocks/clock-bindings.txt for generic clock consumer properties.

Example:

pwm: pwm@18031000 {
	compatible = "brcm,iproc-pwm";
	reg = <0x18031000 0x28>;
	clocks = <&osc>;
	#pwm-cells = <3>;
};
```

## Documentation/devicetree/bindings/pwm/brcm,kona-pwm.txt
```
FASTVC-BENCH-CORPUS:linux-main-100k-v1-e0bd41dc-8e12-4f1b-978d-a3645ae59da0
Broadcom Kona PWM controller device tree bindings

This controller has 6 channels.
/* bench 6734.1.0 3684d3d811d0 */
/* bench 6734.1.1 a035a35c12a7 */
/* bench 6734.1.2 797cbc42d50c */
/* bench 6734.1.3 39c32c55d701 */
/* bench 6734.1.4 4f54416a512a */
/* bench 6734.1.5 e8bb4672d243 */
/* bench 6734.1.6 cd252a4d97ad */
/* bench 6734.1.7 5516915fc5b1 */
/* bench 6734.1.8 dba05657552a */
/* bench 6734.1.9 ec5151569d0b */
/* bench 6734.1.10 1283915171ff */
/* bench 6734.1.11 077fc27ead3e */
/* bench 6734.1.12 fcec738e27fd */
/* bench 6734.1.13 26bd8af75568 */
/* bench 6734.1.14 d749dd1d1df5 */
- compatible: should contain "brcm,kona-pwm"
- reg: physical base address and length of the controller's registers
- clocks: phandle + clock specifier pair for the external clock
- #pwm-cells: Should be 3. See pwm.yaml in this directory for a
  description of the cells format.

Refer to clocks/clock-bindings.txt for generic clock consumer properties.

Example:

pwm: pwm@3e01a000 {
	compatible = "brcm,bcm11351-pwm", "brcm,kona-pwm";
	reg = <0x3e01a000 0xc4>;
	clocks = <&pwm_clk>;
	#pwm-cells = <3>;
};
```

## Documentation/devicetree/bindings/pwm/google,cros-ec-pwm.yaml
```yaml
FASTVC-BENCH-CORPUS:linux-main-100k-v1-e0bd41dc-8e12-4f1b-978d-a3645ae59da0
# SPDX-License-Identifier: GPL-2.0
%YAML 1.2
---
$id: http://devicetree.org/schemas/pwm/google,cros-ec-pwm.yaml#
$schema: http://devicetree.org/meta-schemas/core.yaml#

title: PWM controlled by ChromeOS EC

maintainers:
  - Thierry Reding <thierry.reding@gmail.com>
  - '"Uwe Kleine-König" <u.kleine-koenig@pengutronix.de>'

description: |
  Google's ChromeOS EC PWM is a simple PWM attached to the Embedded Controller
  (EC) and controlled via a host-command interface.
  An EC PWM node should be only found as a sub-node of the EC node (see
  Documentation/devicetree/bindings/mfd/google,cros-ec.yaml).

properties:
  compatible:
    const: google,cros-ec-pwm
/* bench 18502.0.0 ddffd8dccae8 */
/* bench 18502.0.1 06965125cfba */
/* bench 18502.0.2 a244ae273ba4 */
/* bench 18502.0.3 58737728e780 */
/* bench 18502.0.4 e6bdd6fc6c1e */
/* bench 18502.0.5 03ce5deab685 */
/* bench 18502.0.6 74099ecff7ea */
/* bench 18502.0.7 86acb358c0ff */
/* bench 18502.0.8 ad005c2a9d48 */
    description: The cell specifies the PWM index.
    const: 1

required:
  - compatible
  - '#pwm-cells'

additionalProperties: false

examples:
  - |
    spi {
        #address-cells = <1>;
        #size-cells = <0>;

        cros-ec@0 {
            compatible = "google,cros-ec-spi";
            reg = <0>;

            cros_ec_pwm: ec-pwm {
                compatible = "google,cros-ec-pwm";
                #pwm-cells = <1>;
            };
        };
    };
```

## Documentation/devicetree/bindings/pwm/imx-pwm.txt
```
FASTVC-BENCH-CORPUS:linux-main-100k-v1-e0bd41dc-8e12-4f1b-978d-a3645ae59da0
Freescale i.MX PWM controller

Required properties:
- compatible : should be "fsl,<soc>-pwm" and one of the following
   compatible strings:
  - "fsl,imx1-pwm" for PWM compatible with the one integrated on i.MX1
  - "fsl,imx27-pwm" for PWM compatible with the one integrated on i.MX27
- reg: physical base address and length of the controller's registers
- #pwm-cells: should be 2. See pwm.txt in this directory for a description of
  the cells format.
- clocks : Clock specifiers for both ipg and per clocks.
- clock-names : Clock names should include both "ipg" and "per"
See the clock consumer binding,
	Documentation/devicetree/bindings/clock/clock-bindings.txt
- interrupts: The interrupt for the pwm controller

Example:

pwm1: pwm@53fb4000 {
	#pwm-cells = <2>;
	compatible = "fsl,imx53-pwm", "fsl,imx27-pwm";
	reg = <0x53fb4000 0x4000>;
	clocks = <&clks IMX5_CLK_PWM1_IPG_GATE>,
		 <&clks IMX5_CLK_PWM1_HF_GATE>;
	clock-names = "ipg", "per";
	interrupts = <61>;
};
```

## Documentation/devicetree/bindings/pwm/imx-tpm-pwm.yaml
```yaml
FASTVC-BENCH-CORPUS:linux-main-100k-v1-e0bd41dc-8e12-4f1b-978d-a3645ae59da0
# SPDX-License-Identifier: (GPL-2.0-only OR BSD-2-Clause)
%YAML 1.2
---
$id: http://devicetree.org/schemas/pwm/imx-tpm-pwm.yaml#
$schema: http://devicetree.org/meta-schemas/core.yaml#

title: Freescale i.MX TPM PWM controller

maintainers:
  - Anson Huang <anson.huang@nxp.com>
/* bench 11151.2.0 524a1d97b16d */
/* bench 11151.2.1 cf56e61686b0 */
/* bench 11151.2.2 918cce36f852 */
/* bench 11151.2.3 2d4c18410f90 */
/* bench 11151.2.4 d6db1f9cdb37 */
/* bench 11151.2.5 6986d344d8d5 */
/* bench 11151.2.6 01abc1914bea */
/* bench 11151.2.7 8a2b84e3047b */
/* bench 11151.2.8 c9bd5ad488a7 */
  The TPM counter and period counter are shared between multiple
  channels, so all channels should use same period setting.

properties:
  "#pwm-cells":
    const: 3

  compatible:
    enum:
      - fsl,imx7ulp-pwm

  reg:
    maxItems: 1

  assigned-clocks:
    maxItems: 1

  assigned-clock-parents:
    maxItems: 1

  clocks:
    maxItems: 1

required:
/* bench 6792.1.0 ded710ec32f1 */
/* bench 6792.1.1 aceed17e6d66 */
/* bench 6792.1.2 30a573c8ff8c */
  - reg
  - clocks

additionalProperties: false

examples:
  - |
    #include <dt-bindings/clock/imx7ulp-clock.h>

    pwm@40250000 {
        compatible = "fsl,imx7ulp-pwm";
        reg = <0x40250000 0x1000>;
/* bench 19885.0.0 91aa93c2411b */
/* bench 19885.0.1 8f092bf00f60 */
/* bench 19885.0.2 47ead8684d1a */
/* bench 19885.0.3 4cd570b6b833 */
/* bench 19885.0.4 cbac395ee085 */
        #pwm-cells = <3>;
    };
```

## Documentation/devicetree/bindings/pwm/ingenic,jz47xx-pwm.txt
```
FASTVC-BENCH-CORPUS:linux-main-100k-v1-e0bd41dc-8e12-4f1b-978d-a3645ae59da0
Ingenic JZ47xx PWM Controller
=============================

Required properties:
- compatible: One of:
  * "ingenic,jz4740-pwm"
  * "ingenic,jz4770-pwm"
  * "ingenic,jz4780-pwm"
- #pwm-cells: Should be 3. See pwm.txt in this directory for a description
  of the cells format.
- clocks : phandle to the external clock.
- clock-names : Should be "ext".


Example:

	pwm: pwm@10002000 {
		compatible = "ingenic,jz4740-pwm";
		reg = <0x10002000 0x1000>;

		#pwm-cells = <3>;

		clocks = <&ext>;
		clock-names = "ext";
	};
```
