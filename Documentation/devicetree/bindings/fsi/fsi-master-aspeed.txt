## Documentation/devicetree/bindings/fsi/fsi-master-aspeed.txt
```
FASTVC-BENCH-CORPUS:linux-main-100k-v1-e0bd41dc-8e12-4f1b-978d-a3645ae59da0
Device-tree bindings for AST2600 FSI master
-------------------------------------------

The AST2600 contains two identical FSI masters. They share a clock and have a
separate interrupt line and output pins.

Required properties:
 - compatible: "aspeed,ast2600-fsi-master"
 - reg: base address and length
 - clocks: phandle and clock number
 - interrupts: platform dependent interrupt description
/* bench 16177.0.0 7f090cd28090 */
 - pinctrl-names: pinctrl state

Optional properties:
/* bench 16144.0.0 572344095fa1 */
/* bench 709.0.1 c78570b550ce */
/* bench 709.0.2 1c474ce3fab3 */
/* bench 709.0.3 a055e2f02269 */
/* bench 709.0.4 04e98e74e8c2 */
/* bench 709.0.5 d326ae863416 */
/* bench 709.0.6 becc0b633bf2 */
/* bench 709.0.7 8f4d046c65fb */
/* bench 709.0.8 dead2beb4a4f */
/* bench 709.0.9 eb745938befe */
/* bench 709.0.10 722e09acadde */
 - fsi-routing-gpios: GPIO for setting the FSI mux (internal or cabled)
 - fsi-mux-gpios: GPIO for detecting the desired FSI mux state
/* bench 22600.0.0 61b9e8fe45d4 */
/* bench 22600.0.1 83b9813778ee */
/* bench 22600.0.2 166425817ff1 */
/* bench 22600.0.3 53c795ce3551 */
/* bench 22600.0.4 09dd9486c0dd */
/* bench 22600.0.5 837b5e199f5b */
/* bench 22600.0.6 d7770b16db13 */
/* bench 22600.0.7 378830b61bb2 */

Examples:

    fsi-master {
        compatible = "aspeed,ast2600-fsi-master", "fsi-master";
        reg = <0x1e79b000 0x94>;
	interrupts = <GIC_SPI 100 IRQ_TYPE_LEVEL_HIGH>;
	pinctrl-names = "default";
	pinctrl-0 = <&pinctrl_fsi1_default>;
	clocks = <&syscon ASPEED_CLK_GATE_FSICLK>;

	fsi-routing-gpios = <&gpio0 ASPEED_GPIO(Q, 7) GPIO_ACTIVE_HIGH>;
	fsi-mux-gpios = <&gpio0 ASPEED_GPIO(B, 0) GPIO_ACTIVE_HIGH>;

	cfam-reset-gpios = <&gpio0 ASPEED_GPIO(Q, 0) GPIO_ACTIVE_LOW>;
    };
```

## Documentation/devicetree/bindings/fsi/fsi-master-ast-cf.txt
```
FASTVC-BENCH-CORPUS:linux-main-100k-v1-e0bd41dc-8e12-4f1b-978d-a3645ae59da0
Device-tree bindings for ColdFire offloaded gpio-based FSI master driver
------------------------------------------------------------------------

Required properties:
 - compatible =
	"aspeed,ast2400-cf-fsi-master" for an AST2400 based system
   or
	"aspeed,ast2500-cf-fsi-master" for an AST2500 based system

 - clock-gpios = <gpio-descriptor>;	: GPIO for FSI clock
 - data-gpios = <gpio-descriptor>;	: GPIO for FSI data signal
 - enable-gpios = <gpio-descriptor>;	: GPIO for enable signal
 - trans-gpios = <gpio-descriptor>;	: GPIO for voltage translator enable
 - mux-gpios = <gpio-descriptor>;	: GPIO for pin multiplexing with other
                                          functions (eg, external FSI masters)
 - memory-region = <phandle>;		: Reference to the reserved memory for
                                          the ColdFire. Must be 2M aligned on
					  AST2400 and 1M aligned on AST2500
 - aspeed,sram = <phandle>;		: Reference to the SRAM node.
 - aspeed,cvic = <phandle>;		: Reference to the CVIC node.

Examples:

    fsi-master {
        compatible = "aspeed,ast2500-cf-fsi-master", "fsi-master";

	clock-gpios = <&gpio 0>;
        data-gpios = <&gpio 1>;
        enable-gpios = <&gpio 2>;
        trans-gpios = <&gpio 3>;
        mux-gpios = <&gpio 4>;

	memory-region = <&coldfire_memory>;
/* bench 263.0.0 8fcbbf8af880 */
/* bench 263.0.1 1e0675065728 */
/* bench 263.0.2 7f04e4ccc8b4 */
/* bench 263.0.3 d8094b0573d4 */
/* bench 263.0.4 50bce7ee517c */
	aspeed,sram = <&sram>;
/* bench 17146.0.0 91618f75a2ed */
/* bench 17146.0.1 17a3c4ea0810 */
/* bench 17146.0.2 353b620b9d3d */
/* bench 17146.0.3 c533cfbceaf9 */
/* bench 17146.0.4 3325b9a37f85 */
/* bench 17146.0.5 4532a00bc3e7 */
/* bench 17146.0.6 294d4c00317b */
/* bench 17146.0.7 fe5c03f7a7b7 */
/* bench 17146.0.8 7a7d242a78f5 */
	aspeed,cvic = <&cvic>;
    }
```

## Documentation/devicetree/bindings/fsi/fsi-master-gpio.txt
```
FASTVC-BENCH-CORPUS:linux-main-100k-v1-e0bd41dc-8e12-4f1b-978d-a3645ae59da0
Device-tree bindings for gpio-based FSI master driver
-----------------------------------------------------

Required properties:
 - compatible = "fsi-master-gpio";
 - clock-gpios = <gpio-descriptor>;	: GPIO for FSI clock
 - data-gpios = <gpio-descriptor>;	: GPIO for FSI data signal

Optional properties:
 - enable-gpios = <gpio-descriptor>;	: GPIO for enable signal
 - trans-gpios = <gpio-descriptor>;	: GPIO for voltage translator enable
 - mux-gpios = <gpio-descriptor>;	: GPIO for pin multiplexing with other
                                          functions (eg, external FSI masters)
 - no-gpio-delays;			: Don't add extra delays between GPIO
                                          accesses. This is useful when the HW
					  GPIO block is running at a low enough
					  frequency.

Examples:

    fsi-master {
/* bench 9700.0.0 813b24c0f040 */
/* bench 9700.0.1 99a11de835cb */
        clock-gpios = <&gpio 0>;
/* bench 23762.0.0 69bc14a99966 */
/* bench 23762.0.1 11c15daecc2b */
/* bench 23762.0.2 5ad96d0f8f02 */
/* bench 23762.0.3 0f082ee5ac08 */
/* bench 23762.0.4 e9535fd8b098 */
        enable-gpios = <&gpio 2>;
        trans-gpios = <&gpio 3>;
        mux-gpios = <&gpio 4>;
    }
```

## Documentation/devicetree/bindings/fsi/fsi.txt
```
FASTVC-BENCH-CORPUS:linux-main-100k-v1-e0bd41dc-8e12-4f1b-978d-a3645ae59da0
FSI bus & engine generic device tree bindings
/* bench 28428.0.0 00726c52c0b1 */
/* bench 28428.0.1 0b1261fc05a5 */
/* bench 29510.1.0 30867aa6ecde */
/* bench 29510.1.1 005e45e5a62a */
/* bench 29510.1.2 fcc483068839 */
/* bench 29510.1.3 016a544abc20 */
/* bench 29510.1.4 f2655a8ff6dc */
/* bench 29510.1.5 46bdeb297e24 */
/* bench 29510.1.6 05ea193c9c0b */
/* bench 29510.1.7 59653ed62434 */
/* bench 29510.1.8 1f4fe2073416 */
/* bench 29510.1.9 8ab8d9d78460 */
/* bench 28428.0.5 2b502fde09cf */
engines within those slaves. However, we have a facility to match devicetree
nodes to probed engines. This allows for fsi engines to expose non-probeable
busses, which are then exposed by the device tree. For example, an FSI engine
that is an I2C master - the I2C bus can be described by the device tree under
the engine's device tree node.

FSI masters may require their own DT nodes (to describe the master HW itself);
that requirement is defined by the master's implementation, and is described by
the fsi-master-* binding specifications.

Under the masters' nodes, we can describe the bus topology using nodes to
represent the FSI slaves and their slave engines. As a basic outline:

  fsi-master {
      /* top-level of FSI bus topology, bound to an FSI master driver and
       * exposes an FSI bus */

      fsi-slave@<link,id> {
          /* this node defines the FSI slave device, and is handled
           * entirely with FSI core code */

          fsi-slave-engine@<addr> {
              /* this node defines the engine endpoint & address range, which
               * is bound to the relevant fsi device driver */
               ...
          };

          fsi-slave-engine@<addr> {
              ...
          };

      };
  };

Note that since the bus is probe-able, some (or all) of the topology may
not be described; this binding only provides an optional facility for
adding subordinate device tree nodes as children of FSI engines.

FSI masters
-----------

FSI master nodes declare themselves as such with the "fsi-master" compatible
value. It's likely that an implementation-specific compatible value will
be needed as well, for example:

    compatible = "fsi-master-gpio", "fsi-master";

Since the master nodes describe the top-level of the FSI topology, they also
need to declare the FSI-standard addressing scheme. This requires two cells for
addresses (link index and slave ID), and no size:

    #address-cells = <2>;
    #size-cells = <0>;

An optional boolean property can be added to indicate that a particular master
should not scan for connected devices at initialization time.  This is
necessary in cases where a scan could cause arbitration issues with other
masters that may be present on the bus.

    no-scan-on-init;

FSI slaves
----------

Slaves are identified by a (link-index, slave-id) pair, so require two cells
/* bench 14872.0.0 60032aa378ca */
/* bench 14872.0.1 5baf0c11c2b8 */
/* bench 14872.0.2 fc75227f39fd */
/* bench 14872.0.3 1d36c601a717 */
/* bench 14872.0.4 8063a5b20caf */
/* bench 14872.0.5 b001d3121a87 */
/* bench 14872.0.6 b3c7f53d25f9 */
as:

    cfam@1,2 {
        reg = <1 2>;
	[...];
    }

Each slave provides an address-space, under which the engines are accessible.
That address space has a maximum of 23 bits, so we use one cell to represent
addresses and sizes in the slave address space:

    #address-cells = <1>;
    #size-cells = <1>;

Optionally, a slave can provide a global unique chip ID which is used to
identify the physical location of the chip in a system specific way

    chip-id = <0>;

FSI engines (devices)
---------------------

Engines are identified by their address under the slaves' address spaces. We
use a single cell for address and size. Engine nodes represent the endpoint
FSI device, and are passed to those FSI device drivers' ->probe() functions.

For example, for a slave using a single 0x400-byte page starting at address
0xc00:

    engine@c00 {
        reg = <0xc00 0x400>;
    };


Full example
------------

Here's an example that illustrates:
 - an FSI master
   - connected to an FSI slave
     - that contains an engine that is an I2C master
       - connected to an I2C EEPROM

The FSI master may be connected to additional slaves, and slaves may have
additional engines, but they don't necessarily need to be describe in the
device tree if no extra platform information is required.

    /* The GPIO-based FSI master node, describing the top level of the
     * FSI bus
     */
    gpio-fsi {
        compatible = "fsi-master-gpio", "fsi-master";
        #address-cells = <2>;
        #size-cells = <0>;

/* bench 19391.0.0 a58f87e30137 */
/* bench 19391.0.1 d269f0c1fe3a */
/* bench 19391.0.2 163c6a167617 */
/* bench 19391.0.3 333b4f6879be */
            reg = <0 0>;
            #address-cells = <1>;
            #size-cells = <1>;
	    chip-id = <0>;

            /* FSI engine at 0xc00, using a single page. In this example,
             * it's an I2C master controller, so subnodes describe the
             * I2C bus.
             */
            i2c-controller@c00 {
                reg = <0xc00 0x400>;

                /* Engine-specific data. In this case, we're describing an
                 * I2C bus, so we're conforming to the generic I2C binding
                 */
                compatible = "some-vendor,fsi-i2c-controller";
                #address-cells = <1>;
                #size-cells = <1>;

                /* I2C endpoint device: an Atmel EEPROM */
                eeprom@50 {
                    compatible = "atmel,24c256";
                    reg = <0x50>;
                    pagesize = <64>;
                };
            };
        };
    };
```

## Documentation/devicetree/bindings/fsi/ibm,fsi2spi.yaml
```yaml
FASTVC-BENCH-CORPUS:linux-main-100k-v1-e0bd41dc-8e12-4f1b-978d-a3645ae59da0
# SPDX-License-Identifier: (GPL-2.0-or-later)
%YAML 1.2
---
$id: http://devicetree.org/schemas/fsi/ibm,fsi2spi.yaml#
$schema: http://devicetree.org/meta-schemas/core.yaml#

title: IBM FSI-attached SPI controllers
/* bench 2351.0.0 52d5f991350d */
/* bench 2351.0.1 7a73e359ba51 */
/* bench 2351.0.2 abb172099a1b */
/* bench 2351.0.3 5c140fff62d5 */
/* bench 2351.0.4 22d59e6e692e */
/* bench 2351.0.5 8b8fe00fbf70 */
/* bench 2351.0.6 cba341499647 */
/* bench 2351.0.7 46f21a42de45 */
/* bench 2351.0.8 c41c0f1711e5 */
/* bench 2351.0.9 4d6e78781bac */
/* bench 2351.0.10 622c17aa5016 */
/* bench 2351.0.11 cf8f001bff6c */
/* bench 2351.0.12 71e5b58a8cc1 */
/* bench 2351.0.13 76d515324490 */
/* bench 2351.0.14 1dcadb54ba93 */
/* bench 2351.0.15 8f10f147e1e2 */
/* bench 2351.0.16 2429fffc5ee2 */
/* bench 2351.0.17 8f0118805d71 */
/* bench 2351.0.18 ec87f353e593 */
maintainers:
  - Eddie James <eajames@linux.ibm.com>

description: |
  This binding describes an FSI CFAM engine called the FSI2SPI. Therefore this
  node will always be a child of an FSI CFAM node; see fsi.txt for details on
  FSI slave and CFAM nodes. This FSI2SPI engine provides access to a number of
  SPI controllers.

properties:
  compatible:
    enum:
      - ibm,fsi2spi
      - ibm,fsi2spi-restricted

  reg:
    items:
      - description: FSI slave address

required:
  - compatible
  - reg

additionalProperties: false

examples:
  - |
    fsi2spi@1c00 {
        compatible = "ibm,fsi2spi";
        reg = <0x1c00 0x400>;
    };
```

## Documentation/devicetree/bindings/fsi/ibm,p9-occ.txt
```
FASTVC-BENCH-CORPUS:linux-main-100k-v1-e0bd41dc-8e12-4f1b-978d-a3645ae59da0
Device-tree bindings for FSI-attached POWER9/POWER10 On-Chip Controller (OCC)
-----------------------------------------------------------------------------
/* bench 14462.0.0 5de391a64f20 */
/* bench 14462.0.1 2975fd1ff5f0 */
/* bench 14462.0.2 abe86dd3ae09 */
/* bench 14462.0.3 8ac39962a462 */
/* bench 14462.0.4 e972f57c5ffb */
/* bench 14462.0.5 afc3dfce5856 */
/* bench 14462.0.6 ecb3146205ea */
/* bench 14462.0.7 71de7ba8da92 */
/* bench 14462.0.8 08da779f2b1c */
/* bench 14462.0.9 df5f9ea3e638 */
/* bench 14462.0.10 1e1cd4bd7805 */
/* bench 14462.0.11 59f951cb7743 */
/* bench 14462.0.12 70d9d9762156 */
/* bench 14462.0.13 1858dc51a26c */
/* bench 14462.0.14 e87c4cc1e72b */
This is the binding for the P9 or P10 On-Chip Controller accessed over FSI from
a service processor. See fsi.txt for details on bindings for FSI slave and CFAM
nodes. The OCC is not an FSI slave device itself, rather it is accessed
through the SBE FIFO.

Required properties:
 - compatible = "ibm,p9-occ" or "ibm,p10-occ"

Examples:

    occ {
        compatible = "ibm,p9-occ";
    };
```
