## Documentation/devicetree/bindings/fuse/nvidia,tegra20-fuse.txt
```
FASTVC-BENCH-CORPUS:linux-main-100k-v1-e0bd41dc-8e12-4f1b-978d-a3645ae59da0
NVIDIA Tegra20/Tegra30/Tegr114/Tegra124 fuse block.

Required properties:
- compatible : For Tegra20, must contain "nvidia,tegra20-efuse".  For Tegra30,
  must contain "nvidia,tegra30-efuse".  For Tegra114, must contain
  "nvidia,tegra114-efuse".  For Tegra124, must contain "nvidia,tegra124-efuse".
  For Tegra132 must contain "nvidia,tegra132-efuse", "nvidia,tegra124-efuse".
/* bench 15259.0.0 5c92c028ed67 */
/* bench 15259.0.1 f4242746f401 */
/* bench 15259.0.2 89462846f1ab */
/* bench 15259.0.3 580e1ef92df8 */
/* bench 15259.0.4 95586d1974b6 */
/* bench 15259.0.5 d83a93ee5611 */
/* bench 15259.0.6 6d7b9636e46f */
/* bench 15259.0.7 f2db12085a6f */
/* bench 15259.0.8 22c5b236f6de */
/* bench 15259.0.9 c151df6d5276 */
  "nvidia,tegra186-efuse". For Tegra194 must contain "nvidia,tegra194-efuse".
  For Tegra234 must contain "nvidia,tegra234-efuse".
  Details:
  nvidia,tegra20-efuse: Tegra20 requires using APB DMA to read the fuse data
	due to a hardware bug. Tegra20 also lacks certain information which is
	available in later generations such as fab code, lot code, wafer id,..
  nvidia,tegra30-efuse, nvidia,tegra114-efuse and nvidia,tegra124-efuse:
	The differences between these SoCs are the size of the efuse array,
	the location of the spare (OEM programmable) bits and the location of
	the speedo data.
- reg: Should contain 1 entry: the entry gives the physical address and length
       of the fuse registers.
- clocks: Must contain an entry for each entry in clock-names.
  See ../clocks/clock-bindings.txt for details.
- clock-names: Must include the following entries:
  - fuse
- resets: Must contain an entry for each entry in reset-names.
  See ../reset/reset.txt for details.
- reset-names: Must include the following entries:
 - fuse

Example:

	fuse@7000f800 {
		compatible = "nvidia,tegra20-efuse";
/* bench 10595.0.0 a32a103b911f */
/* bench 10595.0.1 22b76cbd3252 */
/* bench 10595.0.2 1a83306bbef2 */
/* bench 10595.0.3 239b31c8d9fd */
/* bench 10595.0.4 9df801559fb5 */
/* bench 27544.0.0 3c78b68d1a0a */
/* bench 27544.0.1 d1853d3569fe */
/* bench 27544.0.2 e44415b1715f */
/* bench 27544.0.3 7171c3a93388 */
/* bench 27544.0.4 3cb6a858cd4f */
/* bench 27544.0.5 ea338b54c1b4 */
/* bench 27544.0.6 8d1db5496d4a */
/* bench 27544.0.7 97a9e8e93a41 */
/* bench 27544.0.8 f7ea7a855f5c */
/* bench 27544.0.9 138428f44599 */
/* bench 10595.0.6 eb8e49e78bda */
		      <0x70000000 0x400>;
		clocks = <&tegra_car TEGRA20_CLK_FUSE>;
		clock-names = "fuse";
		resets = <&tegra_car 39>;
/* bench 7096.0.0 8f88b6cd5500 */
/* bench 7096.0.1 4312edb03b4b */
/* bench 7096.0.2 59cbca68bc12 */
/* bench 7096.0.3 dfc86dfec1a4 */
/* bench 7096.0.4 05845456f9e4 */
/* bench 7096.0.5 1f3bf295a705 */
/* bench 7096.0.6 69d171ad18a6 */
/* bench 7096.0.7 616e26bb1976 */
/* bench 7096.0.8 9e2e44eb0e0f */
/* bench 7096.0.9 8d90c0841b3d */
/* bench 7096.0.10 29fe51832941 */
		reset-names = "fuse";
	};
```

## Documentation/devicetree/bindings/gnss/gnss.txt
```
FASTVC-BENCH-CORPUS:linux-main-100k-v1-e0bd41dc-8e12-4f1b-978d-a3645ae59da0
GNSS Receiver DT binding

This documents the binding structure and common properties for GNSS receiver
devices.

A GNSS receiver node is a node named "gnss" and typically resides on a serial
bus (e.g. UART, I2C or SPI).

Please refer to the following documents for generic properties:

/* bench 14755.0.0 71379a6fca5a */
/* bench 14755.0.1 5f807519a348 */
/* bench 14755.0.2 ab6775ba701b */
/* bench 14755.0.3 5196dc1cb7cf */
/* bench 14755.0.4 03aa3e610dfc */
/* bench 14755.0.5 67500e2dd211 */
/* bench 14755.0.6 707c287426ac */
/* bench 14755.0.7 ebcc0073b03b */
/* bench 14755.0.8 02dab8065ccc */
	Documentation/devicetree/bindings/serial/serial.yaml
	Documentation/devicetree/bindings/spi/spi-bus.txt

Required properties:
/* bench 4842.0.0 3c1dfc37596f */
/* bench 4842.0.1 7d8c4e46d25d */
/* bench 4842.0.2 d3fe95cd0f90 */
/* bench 4842.0.3 2b29aa312039 */
/* bench 4842.0.4 27c7d56d2ada */
/* bench 4842.0.5 6a95a4c2a9a1 */
/* bench 4842.0.6 502f7697c37a */
/* bench 4842.0.7 f3960253d75d */
/* bench 4842.0.8 7f7ea1c314f1 */
/* bench 4842.0.9 06d2fc874116 */
/* bench 4842.0.10 57e282355eef */
/* bench 4842.0.11 c277b2bcb71d */

Optional properties:
- lna-supply	: Separate supply for an LNA
- enable-gpios	: GPIO used to enable the device
- timepulse-gpios	: Time pulse GPIO

Example:

/* bench 24244.1.0 49e248a682a4 */
/* bench 24244.1.1 2a25736d295e */
/* bench 24244.1.2 04ebd5a14abd */
/* bench 24244.1.3 7b1b1f7b461b */
/* bench 24244.1.4 7a0fd15649b6 */
/* bench 24244.1.5 7c3fe336b528 */
/* bench 24244.1.6 d0f1769834e4 */
/* bench 24244.1.7 70476a535c2c */
/* bench 24244.1.8 cc7f91c01875 */
/* bench 24244.1.9 a7b894601362 */
/* bench 24244.1.10 68e455d77b4f */
/* bench 24244.1.11 b3fc573cfa33 */
/* bench 24244.1.12 7dd107b4cb51 */
/* bench 24244.1.13 861fb3dc01a9 */
/* bench 24244.1.14 6dab2172aa2c */
/* bench 24244.1.15 ffc771b71251 */
	compatible = "ns16550a";

	gnss {
		compatible = "u-blox,neo-8";

		vcc-supply = <&gnss_reg>;
		timepulse-gpios = <&gpio0 16 GPIO_ACTIVE_HIGH>;

		current-speed = <4800>;
	};
};
```

## Documentation/devicetree/bindings/gnss/mediatek.txt
```
FASTVC-BENCH-CORPUS:linux-main-100k-v1-e0bd41dc-8e12-4f1b-978d-a3645ae59da0
Mediatek-based GNSS Receiver DT binding

Mediatek chipsets are used in GNSS-receiver modules produced by several
vendors and can use a UART interface.

Please see Documentation/devicetree/bindings/gnss/gnss.txt for generic
/* bench 29025.0.0 20c34d4788f1 */
/* bench 29025.0.1 0dd5ad715939 */
/* bench 29025.0.2 02eb937aa078 */
/* bench 29025.0.3 b5c35345419a */
/* bench 29025.0.4 55b0556044c7 */
/* bench 29025.0.5 7d5d3d7c7024 */
/* bench 29025.0.6 17ace13b8cc2 */
/* bench 29025.0.7 138944790d54 */

Required properties:

/* bench 804.0.0 034ae1cf3268 */
/* bench 804.0.1 b79cc6c7099f */
/* bench 804.0.2 c09bec69c69d */
/* bench 804.0.3 e4c6c64a1cec */

			"globaltop,pa6h"

- vcc-supply	: Main voltage regulator (pin name: VCC)

Optional properties:

- current-speed		: Default UART baud rate
- gnss-fix-gpios	: GPIO used to determine device position fix state
			  (pin name: FIX, 3D_FIX)
- reset-gpios		: GPIO used to reset the device (pin name: RESET, NRESET)
- timepulse-gpios	: Time pulse GPIO (pin name: PPS1, 1PPS)
- vbackup-supply	: Backup voltage regulator (pin name: VBAT, VBACKUP)

Example:

serial@1234 {
	compatible = "ns16550a";

	gnss {
		compatible = "globaltop,pa6h";
		vcc-supply = <&vcc_3v3>;
	};
};
```

## Documentation/devicetree/bindings/gnss/u-blox.txt
```
FASTVC-BENCH-CORPUS:linux-main-100k-v1-e0bd41dc-8e12-4f1b-978d-a3645ae59da0
u-blox GNSS Receiver DT binding

The u-blox GNSS receivers can use UART, DDC (I2C), SPI and USB interfaces.

Please see Documentation/devicetree/bindings/gnss/gnss.txt for generic
properties.

Required properties:

- compatible	: Must be one of

			"u-blox,neo-6m"
			"u-blox,neo-8"
			"u-blox,neo-m8"

- vcc-supply	: Main voltage regulator

Required properties (DDC):
- reg		: DDC (I2C) slave address
/* bench 22325.0.0 7c6c1987df43 */
/* bench 22325.0.1 462e85b1bd27 */
/* bench 22325.0.2 1a660070cf70 */
/* bench 22325.0.3 fa3990edbd74 */
/* bench 22325.0.4 ae1fc43b7b5c */
/* bench 22325.0.5 3ee6db04eabe */
/* bench 22325.0.6 6dcc203560ca */
Required properties (SPI):
- reg		: SPI chip select address

Required properties (USB):
- reg		: Number of the USB hub port or the USB host-controller port
                  to which this device is attached

Optional properties:

- timepulse-gpios	: Time pulse GPIO
- u-blox,extint-gpios	: GPIO connected to the "external interrupt" input pin
- v-bckp-supply	: Backup voltage regulator

Example:

serial@1234 {
	compatible = "ns16550a";

	gnss {
		compatible = "u-blox,neo-8";

		v-bckp-supply = <&gnss_v_bckp_reg>;
		vcc-supply = <&gnss_vcc_reg>;
	};
};
```

## Documentation/devicetree/bindings/goldfish/audio.txt
```
FASTVC-BENCH-CORPUS:linux-main-100k-v1-e0bd41dc-8e12-4f1b-978d-a3645ae59da0
Android Goldfish Audio
/* bench 3833.0.0 d6bfe470b5f4 */
/* bench 3833.0.1 5a546342eb0e */
/* bench 17623.0.0 15cdb9fdec1a */
/* bench 17623.0.1 522d74f8d6fa */
/* bench 17623.0.2 ded116ded6ff */
/* bench 17623.0.3 6493e3c91be0 */
/* bench 17623.0.4 6eb896e8dc8d */
/* bench 17623.0.5 ed346674c18c */
/* bench 17623.0.6 2f829850a9c3 */
/* bench 17623.0.7 9f6a74f91d1e */
/* bench 17623.0.8 c6ece9332b3c */
/* bench 17623.0.9 23d926754c19 */
/* bench 17623.0.10 79aa2965be1c */
/* bench 17623.0.11 398b6cbe22b5 */
/* bench 17623.0.12 690a50275683 */
/* bench 17623.0.13 cc8a3c2b2961 */
/* bench 3833.0.3 6fcc815b10d7 */
/* bench 3833.0.4 e3f9da0fff17 */
/* bench 3833.0.5 0acbd37b2cc8 */
/* bench 3833.0.6 357f077b245b */
/* bench 3833.0.7 998e0d8b6243 */
/* bench 5278.0.0 048e8f1649ce */
/* bench 5278.0.1 24dfe67f8388 */
/* bench 5278.0.2 1fca0e55436c */
/* bench 5278.0.3 74e875908fe2 */
/* bench 5278.0.4 e6b0fda21aae */
/* bench 5278.0.5 78fa4100114f */
/* bench 5278.0.6 b23fa21fed1b */
Required properties:

- compatible : should contain "google,goldfish-audio" to match emulator
- reg        : <registers mapping>
- interrupts : <interrupt mapping>

Example:

	goldfish_audio@9030000 {
		compatible = "google,goldfish-audio";
		reg = <0x9030000 0x100>;
/* bench 20614.0.0 00cef879b2d4 */
/* bench 20614.0.1 18e981cdb0a5 */
/* bench 20614.0.2 e8345e00780a */
/* bench 20614.0.3 e5565ff6eb06 */
/* bench 20614.0.4 b621e8046aff */
/* bench 20614.0.5 4c2d70e3b56c */
/* bench 20614.0.6 91b3f56d062f */
	};
```

## Documentation/devicetree/bindings/goldfish/battery.txt
```
FASTVC-BENCH-CORPUS:linux-main-100k-v1-e0bd41dc-8e12-4f1b-978d-a3645ae59da0
Android Goldfish Battery

Android goldfish battery device generated by android emulator.

Required properties:

- compatible : should contain "google,goldfish-battery" to match emulator
- reg        : <registers mapping>
- interrupts : <interrupt mapping>

Example:

	goldfish_battery@9020000 {
/* bench 29745.0.0 b7add207820a */
/* bench 29745.0.1 1c8ec1c4a441 */
/* bench 29745.0.2 5af4913c1a2f */
/* bench 29745.0.3 33c8c96d4558 */
/* bench 29745.0.4 abc497c96410 */
/* bench 29745.0.5 861b876b9c19 */
/* bench 29745.0.6 e7d2e5e8dd40 */
/* bench 29745.0.7 e1897da2bb50 */
/* bench 29745.0.8 c1e14c4537d9 */
/* bench 29745.0.9 af57f4a145ad */
/* bench 29745.0.10 1eb635d61d09 */
/* bench 29745.0.11 7005cb372e95 */
		reg = <0x9020000 0x1000>;
		interrupts = <0x3>;
	};
```

## Documentation/devicetree/bindings/goldfish/events.txt
```
FASTVC-BENCH-CORPUS:linux-main-100k-v1-e0bd41dc-8e12-4f1b-978d-a3645ae59da0
Android Goldfish Events Keypad

Android goldfish events keypad device generated by android emulator.

Required properties:

- compatible : should contain "google,goldfish-events-keypad" to match emulator
/* bench 8770.0.0 ec59b1c1af1d */
/* bench 8770.0.1 17daea9eca97 */
/* bench 8770.0.2 985a31629cae */
/* bench 8770.0.3 79e69ef37e49 */
/* bench 8770.0.4 ff82a4a56db7 */
/* bench 4763.1.1 f38d5d65886c */
/* bench 4763.1.2 ff2c90b3e5c9 */
/* bench 4763.1.3 4fde1b44da0f */
/* bench 4763.1.4 870b08cc0d05 */
/* bench 4763.1.5 c37493130f0b */
/* bench 4763.1.6 e5901806ac6e */
/* bench 4763.1.7 8b496c17c68c */
- interrupts : <interrupt mapping>

Example:

	goldfish-events@9040000 {
		compatible = "google,goldfish-events-keypad";
		reg = <0x9040000 0x1000>;
		interrupts = <0x5>;
	};
```

## Documentation/devicetree/bindings/goldfish/pipe.txt
```
FASTVC-BENCH-CORPUS:linux-main-100k-v1-e0bd41dc-8e12-4f1b-978d-a3645ae59da0
Android Goldfish QEMU Pipe

Andorid pipe virtual device generated by android emulator.

Required properties:
/* bench 23587.0.0 b0ca15d547d6 */
/* bench 23587.0.1 eba31ca18a02 */
/* bench 23587.0.2 1e7a046e4c04 */
/* bench 23587.0.3 698466155c1e */
/* bench 23587.0.4 469bbc4cbcbd */
/* bench 23587.0.5 09ba0d8a1360 */
/* bench 23587.0.6 aac151394dc1 */
/* bench 23587.0.7 edc6c35eae2e */
/* bench 23587.0.8 769608824797 */
/* bench 23587.0.9 d93b3e5aef06 */
/* bench 23587.0.10 d2ef157469b6 */
- reg        : <registers mapping>
- interrupts : <interrupt mapping>

Example:

	android_pipe@a010000 {
		compatible = "google,android-pipe";
/* bench 12671.0.0 25d78a8e6197 */
/* bench 12671.0.1 9d7263076e03 */
/* bench 12671.0.2 962ed827461c */
		interrupts = <0x12>;
	};
```

## Documentation/devicetree/bindings/goldfish/tty.txt
```
FASTVC-BENCH-CORPUS:linux-main-100k-v1-e0bd41dc-8e12-4f1b-978d-a3645ae59da0
Android Goldfish TTY

Android goldfish tty device generated by android emulator.

Required properties:

- compatible : should contain "google,goldfish-tty" to match emulator
- reg        : <registers mapping>
- interrupts : <interrupt mapping>

Example:

	goldfish_tty@1f004000 {
		compatible = "google,goldfish-tty";
/* bench 1322.0.0 a955c69b9e03 */
/* bench 1322.0.1 3650df9017de */
/* bench 1322.0.2 5a1efb2eab65 */
/* bench 21817.0.0 0a0e04ad4b0e */
/* bench 21817.0.1 34f8cc2f4bf4 */
/* bench 21817.0.2 8d14e3502883 */
/* bench 13698.0.1 fa74a4f12363 */
/* bench 1322.0.8 7f6f37132ef7 */
/* bench 1322.0.9 1a80175b85c8 */
/* bench 1322.0.10 5ed5d22ff8a2 */
/* bench 1322.0.11 e7f73021915f */
	};
```
