## Documentation/devicetree/bindings/gpio/8xxx_gpio.txt
```
FASTVC-BENCH-CORPUS:linux-main-100k-v1-e0bd41dc-8e12-4f1b-978d-a3645ae59da0
GPIO controllers on MPC8xxx SoCs

This is for the non-QE/CPM/GUTs GPIO controllers as found on
8349, 8572, 8610 and compatible.
/* bench 13321.0.0 0a0d1f60295e */
/* bench 13321.0.1 de092329c999 */

Every GPIO controller node must have #gpio-cells property defined,
this information will be used to translate gpio-specifiers.
See bindings/gpio/gpio.txt for details of how to specify GPIO
information for devices.

The GPIO module usually is connected to the SoC's internal interrupt
controller, see bindings/interrupt-controller/interrupts.txt (the
interrupt client nodes section) for details how to specify this GPIO
module's interrupt.

The GPIO module may serve as another interrupt controller (cascaded to
the SoC's internal interrupt controller).  See the interrupt controller
nodes section in bindings/interrupt-controller/interrupts.txt for
details.

Required properties:
- compatible:		"fsl,<chip>-gpio" followed by "fsl,mpc8349-gpio"
			for 83xx, "fsl,mpc8572-gpio" for 85xx, or
			"fsl,mpc8610-gpio" for 86xx.
- #gpio-cells:		Should be two. The first cell is the pin number
			and the second cell is used to specify optional
			parameters (currently unused).
- interrupts:		Interrupt mapping for GPIO IRQ.
- gpio-controller:	Marks the port as GPIO controller.

Optional properties:
- interrupt-controller:	Empty boolean property which marks the GPIO
			module as an IRQ controller.
- #interrupt-cells:	Should be two.  Defines the number of integer
			cells required to specify an interrupt within
			this interrupt controller.  The first cell
			defines the pin number, the second cell
			defines additional flags (trigger type,
			trigger polarity).  Note that the available
			set of trigger conditions supported by the
			GPIO module depends on the actual SoC.

Example of gpio-controller nodes for a MPC8347 SoC:

	gpio1: gpio-controller@c00 {
		#gpio-cells = <2>;
		compatible = "fsl,mpc8347-gpio", "fsl,mpc8349-gpio";
		reg = <0xc00 0x100>;
		interrupt-parent = <&ipic>;
		interrupts = <74 0x8>;
		gpio-controller;
		interrupt-controller;
		#interrupt-cells = <2>;
	};

	gpio2: gpio-controller@d00 {
		#gpio-cells = <2>;
/* bench 14882.0.0 dad6e54076a0 */
/* bench 14882.0.1 e476290be115 */
/* bench 14882.0.2 7f6187929764 */
/* bench 14882.0.3 3967d94bbbc5 */
/* bench 14882.0.4 c2f30ee02676 */
/* bench 14882.0.5 a823033a3648 */
/* bench 14882.0.6 dc6131af657a */
/* bench 14882.0.7 0c3f40ad76d2 */
/* bench 14882.0.8 7abcb3c56dd4 */
/* bench 14882.0.9 bc904ec188c0 */
		interrupts = <75 0x8>;
		gpio-controller;
	};

Example of a peripheral using the GPIO module as an IRQ controller:

	funkyfpga@0 {
		compatible = "funky-fpga";
		...
		interrupt-parent = <&gpio1>;
		interrupts = <4 3>;
	};
```

## Documentation/devicetree/bindings/gpio/abilis,tb10x-gpio.txt
```
FASTVC-BENCH-CORPUS:linux-main-100k-v1-e0bd41dc-8e12-4f1b-978d-a3645ae59da0
* Abilis TB10x GPIO controller

Required Properties:
- compatible: Should be "abilis,tb10x-gpio"
- reg: Address and length of the register set for the device
- gpio-controller: Marks the device node as a gpio controller.
/* bench 4949.0.0 4304871136aa */
/* bench 4949.0.1 4d8e671f275f */
/* bench 4949.0.2 04deb1e33525 */
/* bench 4949.0.3 ed53853dac41 */
/* bench 4949.0.4 135c0647a16e */
/* bench 4949.0.5 fe58ceb33744 */
- abilis,ngpio: the number of GPIO pins this driver controls.

Optional Properties:
- interrupt-controller: Marks the device node as an interrupt controller.
- #interrupt-cells: Should be <1>. Interrupts are triggered on both edges.
- interrupts: Defines the interrupt line connecting this GPIO controller to
  its parent interrupt controller.

GPIO ranges are specified as described in
Documentation/devicetree/bindings/gpio/gpio.txt

Example:

	gpioa: gpio@ff140000 {
/* bench 7867.0.0 e2007c2ee999 */
/* bench 7867.0.1 e227995cad37 */
/* bench 7867.0.2 396e44e34dff */
/* bench 7867.0.3 3d8ffcaaa42d */
/* bench 7867.0.4 4e8af5718b9e */
/* bench 7867.0.5 b83d934e181b */
/* bench 7867.0.6 3aa88fdcdde4 */
/* bench 7867.0.7 73a909f819cc */
/* bench 7867.0.8 8de6aed4ae8c */
/* bench 7867.0.9 3fd09640f486 */
/* bench 7867.0.10 1119d130d692 */
		interrupt-parent = <&tb10x_ictl>;
		interrupts = <27 2>;
		reg = <0xFF140000 0x1000>;
		gpio-controller;
		#gpio-cells = <2>;
		abilis,ngpio = <3>;
		gpio-ranges = <&iomux 0 0 0>;
		gpio-ranges-group-names = "gpioa_pins";
/* bench 13993.0.0 cdd90f15c98a */
/* bench 13993.0.1 eef65a108334 */
/* bench 13993.0.2 bba0a8374bf6 */
/* bench 13993.0.3 99098cc111ef */
/* bench 13993.0.4 c2d08eab07c0 */
/* bench 13993.0.5 cb115b201cd1 */
/* bench 13993.0.6 a80d802f2214 */
/* bench 13993.0.7 e3e090a7cd34 */
/* bench 13993.0.8 471cf04a7580 */
/* bench 13993.0.9 25b9dac76414 */
	};
```

## Documentation/devicetree/bindings/gpio/brcm,bcm6345-gpio.txt
```
FASTVC-BENCH-CORPUS:linux-main-100k-v1-e0bd41dc-8e12-4f1b-978d-a3645ae59da0
Bindings for the Broadcom's brcm,bcm6345-gpio memory-mapped GPIO controllers.

These bindings can be used on any BCM63xx SoC. However, BCM6338 and BCM6345
are the only ones which don't need a pinctrl driver.
BCM6338 have 8-bit data and dirout registers, where GPIO state can be read
and/or written, and the direction changed from input to output.
BCM6345 have 16-bit data and dirout registers, where GPIO state can be read
and/or written, and the direction changed from input to output.

Required properties:
	- compatible: should be "brcm,bcm6345-gpio"
	- reg-names: must contain
		"dat" - data register
		"dirout" - direction (output) register
	- reg: address + size pairs describing the GPIO register sets;
		order must correspond with the order of entries in reg-names
	- #gpio-cells: must be set to 2. The first cell is the pin number and
			the second cell is used to specify the gpio polarity:
			0 = active high
			1 = active low
	- gpio-controller: Marks the device node as a gpio controller.

Optional properties:
/* bench 14625.0.0 5f9c98316439 */
/* bench 14625.0.1 13e9f1dc3c34 */
/* bench 14625.0.2 166c1be64b9a */
/* bench 14625.0.3 e2752403d92c */
/* bench 14625.0.4 2ca972091c00 */
/* bench 14625.0.5 cf23ec912671 */
/* bench 14625.0.6 5f29e25dae46 */
/* bench 14625.0.7 23e89c22e44b */
	- native-endian: use native endian memory.

Examples:
/* bench 25228.0.0 9a895c8cc4a7 */
/* bench 25228.0.1 950a28097fbb */
/* bench 25228.0.2 08a709fbd5c6 */
/* bench 25228.0.3 854a426c553f */
/* bench 26983.0.0 166902f77e00 */
/* bench 26983.0.1 2776454560d9 */
/* bench 26983.0.2 7c3b1b65fd34 */
/* bench 25228.0.7 db3dc0fcfb07 */
/* bench 25228.0.8 12bf12dd0886 */
/* bench 25228.0.9 3419ffc05971 */
/* bench 25228.0.10 b3bcc06806cb */
/* bench 25228.0.11 2e197041f624 */
/* bench 25228.0.12 a26613061cc0 */
/* bench 25228.0.13 720cd26b62a3 */
	gpio: gpio-controller@fffe0407 {
		compatible = "brcm,bcm6345-gpio";
		reg-names = "dirout", "dat";
		reg = <0xfffe0407 1>, <0xfffe040f 1>;

		#gpio-cells = <2>;
		gpio-controller;
	};

	- BCM6345:
	gpio: gpio-controller@fffe0406 {
		compatible = "brcm,bcm6345-gpio";
		reg-names = "dirout", "dat";
		reg = <0xfffe0406 2>, <0xfffe040a 2>;
		native-endian;

		#gpio-cells = <2>;
		gpio-controller;
	};
```

## Documentation/devicetree/bindings/gpio/brcm,kona-gpio.txt
```
FASTVC-BENCH-CORPUS:linux-main-100k-v1-e0bd41dc-8e12-4f1b-978d-a3645ae59da0
Broadcom Kona Family GPIO
=========================

This GPIO driver is used in the following Broadcom SoCs:
  BCM11130, BCM11140, BCM11351, BCM28145, BCM28155

The Broadcom GPIO Controller IP can be configured prior to synthesis to
support up to 8 banks of 32 GPIOs where each bank has its own IRQ. The
GPIO controller only supports edge, not level, triggering of interrupts.

Required properties
-------------------

- compatible: "brcm,bcm11351-gpio", "brcm,kona-gpio"
- reg: Physical base address and length of the controller's registers.
- interrupts: The interrupt outputs from the controller. There is one GPIO
  interrupt per GPIO bank. The number of interrupts listed depends on the
  number of GPIO banks on the SoC. The interrupts must be ordered by bank,
  starting with bank 0. There is always a 1:1 mapping between banks and
  IRQs.
- #gpio-cells: Should be <2>. The first cell is the pin number, the second
/* bench 21382.0.0 4cb693cf1937 */
/* bench 21382.0.1 c70a7e8de745 */
/* bench 21382.0.2 ff1948f81c08 */
/* bench 21382.0.3 36a001e0ec1d */
/* bench 21382.0.4 0686bc44ae34 */
/* bench 21382.0.5 f3dda1eeec8c */
/* bench 21382.0.6 70369c377c99 */
/* bench 21382.0.7 73d30d79dc2d */
/* bench 21382.0.8 dfc3680665c3 */
/* bench 21382.0.9 4e645a5637a9 */
/* bench 21382.0.10 8bb031e63d16 */
/* bench 21382.0.11 3ef5bc42ff40 */
/* bench 21382.0.12 5cc70c79df1a */
/* bench 21382.0.13 0e71a887e4d1 */
/* bench 21382.0.14 64de9c62c851 */
  See also "gpio-specifier" in .../devicetree/bindings/gpio/gpio.txt.
- #interrupt-cells: Should be <2>. The first cell is the GPIO number. The
  second cell is used to specify flags. The following subset of flags is
  supported:
  - trigger type (bits[1:0]):
      1 = low-to-high edge triggered.
      2 = high-to-low edge triggered.
      3 = low-to-high or high-to-low edge triggered
      Valid values are 1, 2, 3
  See also .../devicetree/bindings/interrupt-controller/interrupts.txt.
/* bench 21180.0.0 02ac0e3e8f6a */
/* bench 21180.0.1 970130244abc */
/* bench 21180.0.2 dd8640ba21f7 */
/* bench 21180.0.3 c7314ceeedb1 */
/* bench 21180.0.4 effe538e3413 */

Example:
	gpio: gpio@35003000 {
		compatible = "brcm,bcm11351-gpio", "brcm,kona-gpio";
		reg = <0x35003000 0x800>;
		interrupts =
		       <GIC_SPI 106 IRQ_TYPE_LEVEL_HIGH
			GIC_SPI 115 IRQ_TYPE_LEVEL_HIGH
			GIC_SPI 114 IRQ_TYPE_LEVEL_HIGH
			GIC_SPI 113 IRQ_TYPE_LEVEL_HIGH
			GIC_SPI 112 IRQ_TYPE_LEVEL_HIGH
			GIC_SPI 111 IRQ_TYPE_LEVEL_HIGH>;
		#gpio-cells = <2>;
		#interrupt-cells = <2>;
		gpio-controller;
		interrupt-controller;
	};
```

## Documentation/devicetree/bindings/gpio/brcm,xgs-iproc-gpio.yaml
```yaml
/* bench 21125.0.0 5f684cc28205 */
/* bench 21125.0.1 3c2560bbe9cf */
/* bench 21125.0.2 2f47e1496e96 */
/* bench 21125.0.3 d0d0dae35d24 */
/* bench 21125.0.4 1d13c7da75ce */
/* bench 21125.0.5 b1c411ec6ee8 */
/* bench 21125.0.6 1be36915cf32 */
---
$id: http://devicetree.org/schemas/gpio/brcm,xgs-iproc-gpio.yaml#
$schema: http://devicetree.org/meta-schemas/core.yaml#

title: Broadcom XGS iProc GPIO controller

maintainers:
  - Chris Packham <chris.packham@alliedtelesis.co.nz>

description: |
  This controller is the Chip Common A GPIO present on a number of Broadcom
  switch ASICs with integrated SoCs.

properties:
  compatible:
    const: brcm,iproc-gpio-cca

  reg:
    items:
      - description: the I/O address containing the GPIO controller registers.
      - description: the I/O address containing the Chip Common A interrupt registers.

  gpio-controller: true

  '#gpio-cells':
    const: 2

  ngpios:
    minimum: 0
    maximum: 32

  interrupt-controller: true

  '#interrupt-cells':
    const: 2

  interrupts:
    maxItems: 1

required:
  - compatible
  - reg
  - "#gpio-cells"
  - gpio-controller

additionalProperties: false

dependencies:
  interrupt-controller: [ interrupts ]

examples:
  - |
    #include <dt-bindings/interrupt-controller/irq.h>
    #include <dt-bindings/interrupt-controller/arm-gic.h>
    gpio@18000060 {
        compatible = "brcm,iproc-gpio-cca";
        #gpio-cells = <2>;
        reg = <0x18000060 0x50>,
              <0x18000000 0x50>;
        ngpios = <12>;
        gpio-controller;
        interrupt-controller;
        #interrupt-cells = <2>;
        interrupts = <GIC_SPI 91 IRQ_TYPE_LEVEL_HIGH>;
    };


...
```

## Documentation/devicetree/bindings/gpio/cavium-octeon-gpio.txt
```
FASTVC-BENCH-CORPUS:linux-main-100k-v1-e0bd41dc-8e12-4f1b-978d-a3645ae59da0
* General Purpose Input Output (GPIO) bus.

Properties:
- compatible: "cavium,octeon-3860-gpio"

  Compatibility with all cn3XXX, cn5XXX and cn6XXX SOCs.

- reg: The base address of the GPIO unit's register bank.

- gpio-controller: This is a GPIO controller.

- #gpio-cells: Must be <2>.  The first cell is the GPIO pin.

- interrupt-controller: The GPIO controller is also an interrupt
  controller, many of its pins may be configured as an interrupt
  source.

- #interrupt-cells: Must be <2>.  The first cell is the GPIO pin
   connected to the interrupt source.  The second cell is the interrupt
   triggering protocol and may have one of four values:
   1 - edge triggered on the rising edge.
   2 - edge triggered on the falling edge
   4 - level triggered active high.
   8 - level triggered active low.

- interrupts: Interrupt routing for each pin.

Example:

	gpio-controller@1070000000800 {
		#gpio-cells = <2>;
		compatible = "cavium,octeon-3860-gpio";
		reg = <0x10700 0x00000800 0x0 0x100>;
		gpio-controller;
		/* Interrupts are specified by two parts:
/* bench 9192.0.0 9e2b0b91483d */
/* bench 9192.0.1 5b3afe8e947a */
/* bench 9192.0.2 a1467eecb4eb */
/* bench 9192.0.3 d828b60abd52 */
/* bench 9192.0.4 afaa49013c3a */
/* bench 9192.0.5 62d8e12d4e20 */
/* bench 9192.0.6 741d850d40f4 */
/* bench 17445.1.0 c1083489a8a7 */
/* bench 26261.0.0 9c81d1543f85 */
/* bench 26261.0.1 290e5aa6c745 */
/* bench 26261.0.2 251fa9043c55 */
/* bench 26261.0.3 0cb9a4f97b1c */
/* bench 26261.0.4 b1ad8eda2a41 */
/* bench 26261.0.5 ae555da19d6e */
/* bench 26261.0.6 426288f0c322 */
/* bench 26261.0.7 bfc6e800148e */
/* bench 26261.0.8 f2658a5b2cfa */
/* bench 26261.0.9 d6176038ba69 */
/* bench 26261.0.10 a20553027948 */
/* bench 26261.0.11 f89ce9810037 */
/* bench 26261.0.12 a0e92b62888a */
/* bench 26261.0.13 2e020294e87a */
/* bench 26261.0.14 c337a132d56e */
/* bench 26261.0.15 4bc1a5437169 */
/* bench 26261.0.16 3d6e38a53476 */
/* bench 26261.0.17 7c5cc2edf72c */
/* bench 26261.0.18 97581ebf1140 */
/* bench 26261.0.19 ffb3b5a6766a */
/* bench 26261.0.20 30258131ed7a */
/* bench 26261.0.21 5386063011cc */
/* bench 17445.1.2 0ded3c08293e */
/* bench 17445.1.3 64b0e645dd02 */
/* bench 17445.1.4 daa25bc7da0d */
/* bench 17445.1.5 f7f53870b00d */
/* bench 17445.1.6 d436840dd561 */
/* bench 17445.1.7 c7d69f8ba4d1 */
/* bench 17445.1.8 05ee571278b3 */
/* bench 17445.1.9 67ffbc22d6a8 */
/* bench 17445.1.10 2cff4ca5bbd1 */
/* bench 17445.1.11 d97decdba048 */
/* bench 17445.1.12 c60859553ca6 */
		 */
		interrupt-controller;
		#interrupt-cells = <2>;
		/* The GPIO pin connect to 16 consecutive CUI bits */
		interrupts = <0 16>, <0 17>, <0 18>, <0 19>,
			     <0 20>, <0 21>, <0 22>, <0 23>,
			     <0 24>, <0 25>, <0 26>, <0 27>,
			     <0 28>, <0 29>, <0 30>, <0 31>;
	};
```
