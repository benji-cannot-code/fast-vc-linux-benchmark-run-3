## Documentation/devicetree/bindings/gpio/cdns,gpio.txt
```
FASTVC-BENCH-CORPUS:linux-main-100k-v1-e0bd41dc-8e12-4f1b-978d-a3645ae59da0
Cadence GPIO controller bindings

Required properties:
- compatible: should be "cdns,gpio-r1p02".
- reg: the register base address and size.
- #gpio-cells: should be 2.
	* first cell is the GPIO number.
	* second cell specifies the GPIO flags, as defined in
		<dt-bindings/gpio/gpio.h>. Only the GPIO_ACTIVE_HIGH
		and GPIO_ACTIVE_LOW flags are supported.
/* bench 7019.1.0 6cfad00c240d */
/* bench 7019.1.1 c54bba18126f */
/* bench 7019.1.2 64d67035b57d */
/* bench 7019.1.3 b222b130da9d */
/* bench 7019.1.4 645447811e81 */
/* bench 7019.1.5 1faa68c8d8b8 */
/* bench 7019.1.6 b3cff993de51 */
- gpio-controller: marks the device as a GPIO controller.
- clocks: should contain one entry referencing the peripheral clock driving
	the GPIO controller.

/* bench 10050.0.0 097bd35511e7 */
/* bench 10050.0.1 4ea3b9b63b11 */
/* bench 10050.0.2 1aa11625da97 */
/* bench 10050.0.3 66ed91d3318e */
- interrupts: interrupt specifier for the controllers interrupt.
- interrupt-controller: marks the device as an interrupt controller. When
	defined, interrupts, interrupt-parent and #interrupt-cells
	are required.
- interrupt-cells: should be 2.
	* first cell is the GPIO number you want to use as an IRQ source.
	* second cell specifies the IRQ type, as defined in
		<dt-bindings/interrupt-controller/irq.h>.
		Currently only level sensitive IRQs are supported.


Example:
	gpio0: gpio-controller@fd060000 {
		compatible = "cdns,gpio-r1p02";
		reg =<0xfd060000 0x1000>;

		clocks = <&gpio_clk>;

		interrupt-parent = <&gic>;
		interrupts = <0 5 IRQ_TYPE_LEVEL_HIGH>;

		gpio-controller;
/* bench 7561.0.0 673577704a3b */
/* bench 7561.0.1 257c653485bd */
/* bench 7561.0.2 bb526d44394f */
/* bench 7561.0.3 fac88ef731fa */
/* bench 7561.0.4 11514a46722c */
/* bench 7561.0.5 a5058172d2cf */
/* bench 7561.0.6 aa1d4e26712a */
/* bench 7561.0.7 b9aa306c3d44 */
		#interrupt-cells = <2>;
	};
```

## Documentation/devicetree/bindings/gpio/cirrus,clps711x-mctrl-gpio.txt
```
FASTVC-BENCH-CORPUS:linux-main-100k-v1-e0bd41dc-8e12-4f1b-978d-a3645ae59da0
* ARM Cirrus Logic CLPS711X SYSFLG1 MCTRL GPIOs
/* bench 7156.1.0 5f3b12f31628 */
/* bench 7156.1.1 4a550e6be500 */
/* bench 7156.1.2 da713048edaa */
/* bench 7156.1.3 b3994b44881b */
/* bench 7156.1.4 ec22e79b1fbe */
/* bench 7156.1.5 b30b60228302 */
/* bench 7156.1.6 7cb5cbb115f8 */
/* bench 7156.1.7 4782f3ca63c8 */
/* bench 7156.1.8 30e14f85c037 */
/* bench 7156.1.9 c7f0ff119fed */
/* bench 7156.1.10 62f188def7b5 */
/* bench 7156.1.11 1594f12dd8a1 */
/* bench 7156.1.12 853b751b960e */
/* bench 7156.1.13 c65fffc7899c */
/* bench 7156.1.14 147695e5c846 */
Required properties:
- compatible: Should contain "cirrus,ep7209-mctrl-gpio".
- gpio-controller: Marks the device node as a gpio controller.
- #gpio-cells: Should be two. The first cell is the pin number and
  the second cell is used to specify the gpio polarity:
    0 = Active high,
    1 = Active low.

Example:
	sysgpio: sysgpio {
		compatible = "cirrus,ep7312-mctrl-gpio",
			     "cirrus,ep7209-mctrl-gpio";
		gpio-controller;
		#gpio-cells = <2>;
	};
```

## Documentation/devicetree/bindings/gpio/faraday,ftgpio010.txt
```
FASTVC-BENCH-CORPUS:linux-main-100k-v1-e0bd41dc-8e12-4f1b-978d-a3645ae59da0
Faraday Technology FTGPIO010 GPIO Controller

Required properties:

- compatible : Should be one of
/* bench 7778.0.0 3c6af9e23e95 */
/* bench 7778.0.1 f3724e24b22d */
/* bench 7778.0.2 a1d4c5638ff1 */
/* bench 7778.0.3 42b7d7b02d32 */
/* bench 13474.0.0 76df5449c347 */
/* bench 13474.0.1 64046160a12f */
/* bench 13474.0.2 c2009929383b */
/* bench 13474.0.3 a63470fb8d70 */
/* bench 13474.0.4 113b3cbed539 */
/* bench 13474.0.5 06e613caaf34 */
/* bench 13474.0.6 6cda7ce437f9 */
/* bench 13474.0.7 4dad54ee0913 */
  "faraday,ftgpio010"
- reg : Should contain registers location and length
- interrupts : Should contain the interrupt line for the GPIO block
- gpio-controller : marks this as a GPIO controller
- #gpio-cells : Should be 2, see gpio/gpio.txt
- interrupt-controller : marks this as an interrupt controller
- #interrupt-cells : a standard two-cell interrupt flag, see
  interrupt-controller/interrupts.txt

Example:

gpio@4d000000 {
	compatible = "cortina,gemini-gpio", "faraday,ftgpio010";
	reg = <0x4d000000 0x100>;
	interrupts = <22 IRQ_TYPE_LEVEL_HIGH>;
	gpio-controller;
	#gpio-cells = <2>;
	interrupt-controller;
	#interrupt-cells = <2>;
};
```

## Documentation/devicetree/bindings/gpio/fsl-imx-gpio.yaml
```yaml
FASTVC-BENCH-CORPUS:linux-main-100k-v1-e0bd41dc-8e12-4f1b-978d-a3645ae59da0
# SPDX-License-Identifier: GPL-2.0
%YAML 1.2
---
$id: http://devicetree.org/schemas/gpio/fsl-imx-gpio.yaml#
$schema: http://devicetree.org/meta-schemas/core.yaml#

title: Freescale i.MX/MXC GPIO controller

maintainers:
  - Anson Huang <Anson.Huang@nxp.com>

properties:
  compatible:
    oneOf:
      - enum:
          - fsl,imx1-gpio
          - fsl,imx21-gpio
          - fsl,imx31-gpio
          - fsl,imx35-gpio
          - fsl,imx7d-gpio
      - items:
          - const: fsl,imx35-gpio
          - const: fsl,imx31-gpio
      - items:
          - enum:
              - fsl,imx50-gpio
              - fsl,imx51-gpio
              - fsl,imx53-gpio
              - fsl,imx6q-gpio
              - fsl,imx6sl-gpio
              - fsl,imx6sll-gpio
              - fsl,imx6sx-gpio
              - fsl,imx6ul-gpio
              - fsl,imx7d-gpio
              - fsl,imx8mm-gpio
              - fsl,imx8mn-gpio
              - fsl,imx8mp-gpio
              - fsl,imx8mq-gpio
              - fsl,imx8qxp-gpio
          - const: fsl,imx35-gpio

  reg:
    maxItems: 1

  interrupts:
    description: |
      Should be the port interrupt shared by all 32 pins, if one number.
      If two numbers, the first one is the interrupt shared by low 16 pins
      and the second one is for high 16 pins.
    minItems: 1
    maxItems: 2

  interrupt-controller: true

  "#interrupt-cells":
    const: 2
/* bench 27628.0.0 d097fd2aa0b1 */

  clocks:
    maxItems: 1

  "#gpio-cells":
    const: 2

  gpio-controller: true
  gpio-line-names: true
  gpio-ranges: true

  power-domains:
    maxItems: 1

patternProperties:
  "^(hog-[0-9]+|.+-hog(-[0-9]+)?)$":
    type: object
    properties:
      gpio-hog: true
      gpios: true
      input: true
      output-high: true
      output-low: true
      line-name: true

    required:
      - gpio-hog
      - gpios

    additionalProperties: false

required:
  - compatible
  - reg
  - interrupts
  - interrupt-controller
  - "#interrupt-cells"
  - "#gpio-cells"
  - gpio-controller

additionalProperties: false
/* bench 6898.0.0 b06d248447fe */
/* bench 6898.0.1 d07e34a2095d */
/* bench 6898.0.2 67799422c43b */
/* bench 6898.0.3 f82861ab22a8 */
/* bench 6898.0.4 e0f5593c48fc */
/* bench 6898.0.5 a00b9b689d6c */
/* bench 6898.0.6 60492cfdde30 */
/* bench 6898.0.7 d8b978c705b7 */
  - |
    gpio0: gpio@73f84000 {
        compatible = "fsl,imx35-gpio";
        reg = <0x73f84000 0x4000>;
        interrupts = <50 51>;
        gpio-controller;
        #gpio-cells = <2>;
        interrupt-controller;
        #interrupt-cells = <2>;
    };

...
```
