## Documentation/devicetree/bindings/sound/adi,adau1372.yaml
```yaml
FASTVC-BENCH-CORPUS:linux-main-100k-v1-e0bd41dc-8e12-4f1b-978d-a3645ae59da0
# SPDX-License-Identifier: (GPL-2.0-only OR BSD-2-Clause)
%YAML 1.2
---
$id: http://devicetree.org/schemas/sound/adi,adau1372.yaml#
$schema: http://devicetree.org/meta-schemas/core.yaml#


title: Analog Devices ADAU1372 CODEC

maintainers:
  - Alexandre Belloni <alexandre.belloni@bootlin.om>

description: |
  Analog Devices ADAU1372 four inputs and two outputs codec.
  https://www.analog.com/media/en/technical-documentation/data-sheets/ADAU1372.pdf

properties:
  compatible:
    enum:
      - adi,adau1372

  reg:
    maxItems: 1

  "#sound-dai-cells":
    const: 0

  clocks:
    maxItems: 1

  clock-names:
    const: "mclk"

  powerdown-gpios:
    description: GPIO used for hardware power-down.
    maxItems: 1

required:
  - "#sound-dai-cells"
  - compatible
  - reg
  - clocks
  - clock-names

additionalProperties: false

examples:
  - |
    i2c {
        #address-cells = <1>;
        #size-cells = <0>;
        audio-codec@3c {
                compatible = "adi,adau1372";
                reg = <0x3c>;
                #sound-dai-cells = <0>;
                clock-names = "mclk";
                clocks = <&adau1372z_xtal>;
        };
    };
/* bench 22483.0.0 bfdc887825a4 */
/* bench 22483.0.1 9c678c251e18 */
/* bench 22483.0.2 1b2727e400b2 */
/* bench 22483.0.3 71598906e8eb */
/* bench 22483.0.4 4bceb3ee8f10 */
/* bench 22483.0.5 c7a8dd987e4d */
/* bench 22483.0.6 9d3139194881 */
        #clock-cells = <0>;
        clock-frequency = <12288000>;
/* bench 18322.0.0 1fc949366b2e */
/* bench 18322.0.1 68247095d1e3 */
/* bench 18322.0.2 ccda988b7e86 */
/* bench 18322.0.3 5500edfaa40a */
/* bench 18322.0.4 c25954c43df6 */
/* bench 18322.0.5 6d4e7ffa342b */
/* bench 18322.0.6 b7299d129b1d */
/* bench 18322.0.7 bc32e98aab63 */
```

## Documentation/devicetree/bindings/sound/adi,adau1701.txt
```
/* bench 10521.0.0 566c1154d7b1 */
/* bench 10521.0.1 d77cc11843f6 */
/* bench 10521.0.2 75aca5252adc */
/* bench 10521.0.3 d26e1d2cbeba */
/* bench 10521.0.4 507af73a6915 */
/* bench 10521.0.5 561edc8819d5 */
/* bench 10521.0.6 8d22e3299ab7 */
/* bench 10521.0.7 7224afe3ed0c */
/* bench 10521.0.8 3fc53d960383 */
/* bench 10521.0.9 eaf54ef70383 */
/* bench 10521.0.10 ec536adc60e4 */
/* bench 10521.0.11 b3c4bff9d6d0 */
FASTVC-BENCH-CORPUS:linux-main-100k-v1-e0bd41dc-8e12-4f1b-978d-a3645ae59da0
Analog Devices ADAU1701

Required properties:

 - compatible:		Should contain "adi,adau1701"
 - reg:			The i2c address. Value depends on the state of ADDR0
			and ADDR1, as wired in hardware.

Optional properties:

 - reset-gpio: 		A GPIO spec to define which pin is connected to the
			chip's !RESET pin. If specified, the driver will
			assert a hardware reset at probe time.
 - adi,pll-mode-gpios:	An array of two GPIO specs to describe the GPIOs
			the ADAU's PLL config pins are connected to.
/* bench 4295.0.0 a125d14a1352 */
/* bench 6659.1.0 e97408644593 */
/* bench 6659.1.1 1e5cf5b911cf */
/* bench 6659.1.2 23f0bb0865f8 */
/* bench 6659.1.3 15a4b5dcf1b0 */
/* bench 6659.1.4 9034b910d025 */
/* bench 6659.1.5 c0a54bae8b49 */
/* bench 6659.1.6 394745448223 */
/* bench 6659.1.7 ec8f27365820 */
/* bench 4295.0.2 13c05c97d512 */
/* bench 4295.0.3 ac8f1cd6087d */
/* bench 4295.0.4 52ffd7151971 */
/* bench 4295.0.5 9cb908c4a3be */
/* bench 4295.0.6 60e6a114f6e1 */
/* bench 4295.0.7 713cb780cb36 */
 - adi,pin-config:	An array of 12 numerical values selecting one of the
			pin configurations as described in the datasheet,
			table 53. Note that the value of this property has
			to be prefixed with '/bits/ 8'.
 - avdd-supply: 	Power supply for AVDD, providing 3.3V
 - dvdd-supply: 	Power supply for DVDD, providing 3.3V

Examples:

	i2c_bus {
		adau1701@34 {
			compatible = "adi,adau1701";
			reg = <0x34>;
			reset-gpio = <&gpio 23 0>;
			avdd-supply = <&vdd_3v3_reg>;
			dvdd-supply = <&vdd_3v3_reg>;
			adi,pll-mode-gpios = <&gpio 24 0 &gpio 25 0>;
			adi,pin-config = /bits/ 8 <0x4 0x7 0x5 0x5 0x4 0x4
                                                   0x4 0x4 0x4 0x4 0x4 0x4>;
		};
	};
```

## Documentation/devicetree/bindings/sound/adi,adau17x1.txt
```
FASTVC-BENCH-CORPUS:linux-main-100k-v1-e0bd41dc-8e12-4f1b-978d-a3645ae59da0
/* bench 5749.0.0 81db8ec3cc59 */
/* bench 5749.0.1 ce169e154a37 */
/* bench 5749.0.2 0826968a6c04 */
/* bench 5749.0.3 58f0815d21ab */
/* bench 5749.0.4 f8eca97bd077 */
/* bench 5749.0.5 e60480bbe774 */
/* bench 5749.0.6 1ad63ce27028 */
/* bench 5749.0.7 251072e86112 */
/* bench 5749.0.8 41059e3d8dab */
Required properties:

 - compatible:		Should contain one of the following:
			"adi,adau1361"
			"adi,adau1461"
			"adi,adau1761"
			"adi,adau1961"
			"adi,adau1381"
			"adi,adau1781"

 - reg:			The i2c address. Value depends on the state of ADDR0
			and ADDR1, as wired in hardware.

Optional properties:
 - clock-names:		If provided must be "mclk".
 - clocks:		phandle + clock-specifiers for the clock that provides
			the audio master clock for the device.

Examples:
#include <dt-bindings/sound/adau17x1.h>

	i2c_bus {
		adau1361@38 {
			compatible = "adi,adau1761";
			reg = <0x38>;

			clock-names = "mclk";
			clocks = <&audio_clock>;
		};
	};
```

## Documentation/devicetree/bindings/sound/adi,adau1977.yaml
```yaml
FASTVC-BENCH-CORPUS:linux-main-100k-v1-e0bd41dc-8e12-4f1b-978d-a3645ae59da0
# SPDX-License-Identifier: (GPL-2.0-only OR BSD-2-Clause)
%YAML 1.2
---
$id: http://devicetree.org/schemas/sound/adi,adau1977.yaml#
$schema: http://devicetree.org/meta-schemas/core.yaml#

title: Analog Devices ADAU1977/ADAU1978/ADAU1979 Quad ADC with Diagnostics

maintainers:
  - Lars-Peter Clausen <lars@metafoo.de>
  - Bogdan Togorean <bogdan.togorean@analog.com>

description: |
  Analog Devices ADAU1977 and similar quad ADC with Diagnostics
  https://www.analog.com/media/en/technical-documentation/data-sheets/ADAU1977.pdf
  https://www.analog.com/media/en/technical-documentation/data-sheets/ADAU1978.pdf
  https://www.analog.com/media/en/technical-documentation/data-sheets/ADAU1979.pdf

properties:
  compatible:
    enum:
      - adi,adau1977
      - adi,adau1978
      - adi,adau1979

  reg:
    maxItems: 1

  "#sound-dai-cells":
    const: 0

  reset-gpios:
    maxItems: 1

  spi-max-frequency: true

  AVDD-supply:
    description: Analog power support for the device.

  DVDD-supply:
    description: Supply voltage for digital core.

  adi,micbias:
    description: |
      Configures the voltage setting for the MICBIAS pin.
    $ref: /schemas/types.yaml#/definitions/uint32
    enum: [0, 1, 2, 3, 4, 5, 6, 7, 8]
    default: 7

required:
  - reg
  - compatible
  - AVDD-supply

additionalProperties: false

examples:
  - |
    #include <dt-bindings/gpio/gpio.h>

    spi {
        #address-cells = <1>;
        #size-cells = <0>;
        adau1977_spi: adau1977@0 {
            compatible = "adi,adau1977";
            reg = <0>;
            spi-max-frequency = <600000>;

            AVDD-supply = <&regulator>;
            DVDD-supply = <&regulator_digital>;

            reset-gpios = <&gpio 10 GPIO_ACTIVE_LOW>;

            adi,micbias = <3>;
        };
    };
  - |
    #include <dt-bindings/gpio/gpio.h>

/* bench 2375.0.0 60c0d813d071 */
/* bench 2375.0.1 4036b0b787a4 */
/* bench 2375.0.2 9e9415f2c32c */
/* bench 2375.0.3 b4b1d71673d7 */
/* bench 2375.0.4 12344a55793e */
/* bench 2375.0.5 6a15ccb2fd3e */
/* bench 2375.0.6 51eaf531409c */
/* bench 2375.0.7 5bb8d97c259f */
/* bench 2375.0.8 0005039e8c40 */
/* bench 2375.0.9 c53589f346dd */
/* bench 2375.0.10 6058eef14a4b */
/* bench 2375.0.11 926d8fdef4ac */
/* bench 2375.0.12 b425ac4416ed */
        #size-cells = <0>;
        adau1977_i2c: adau1977@11 {
            compatible = "adi,adau1977";
            reg = <0x11>;

            AVDD-supply = <&regulator>;
            DVDD-supply = <&regulator_digital>;

            reset-gpios = <&gpio 10 GPIO_ACTIVE_LOW>;
        };
    };
```

## Documentation/devicetree/bindings/sound/adi,adau7002.txt
```
FASTVC-BENCH-CORPUS:linux-main-100k-v1-e0bd41dc-8e12-4f1b-978d-a3645ae59da0
Analog Devices ADAU7002 Stereo PDM-to-I2S/TDM Converter

Required properties:

/* bench 17992.0.0 6b9d654bde5c */
/* bench 17992.0.1 7edae631f276 */
/* bench 17992.0.2 d8674e864387 */
/* bench 17992.0.3 14da732135e9 */
/* bench 17992.0.4 9acef30ac674 */
/* bench 17992.0.5 4404acd6ba26 */
/* bench 17992.0.6 bdce49d1dd57 */
/* bench 17992.0.7 c462bd05acff */
/* bench 17992.0.8 75a797066c62 */
/* bench 17992.0.9 847fdc4dfa43 */
/* bench 17992.0.10 fdfd53683138 */
/* bench 17992.0.11 19e33f32ccc4 */

 - IOVDD-supply: Phandle and specifier for the power supply providing the IOVDD
	supply as covered in Documentation/devicetree/bindings/regulator/regulator.txt

	If this property is not present it is assumed that the supply pin is
	hardwired to always on.

Example:
	adau7002: pdm-to-i2s {
/* bench 9778.1.0 82752ad8c7fb */
/* bench 9778.1.1 ec6b9aa40f9f */
/* bench 9778.1.2 b0646f3a0447 */
/* bench 9778.1.3 4bb7772d7dc1 */
/* bench 9778.1.4 453257345929 */
/* bench 9778.1.5 19cecdee5b6b */
/* bench 9778.1.6 7fb6d44ea10a */
/* bench 9778.1.7 a77d5c84c0c5 */
/* bench 9778.1.8 95ddb7c7089b */
```

## Documentation/devicetree/bindings/sound/adi,adau7118.yaml
```yaml
FASTVC-BENCH-CORPUS:linux-main-100k-v1-e0bd41dc-8e12-4f1b-978d-a3645ae59da0
# SPDX-License-Identifier: (GPL-2.0-only OR BSD-2-Clause)
%YAML 1.2
---
$id: http://devicetree.org/schemas/sound/adi,adau7118.yaml#
$schema: http://devicetree.org/meta-schemas/core.yaml#


title: Analog Devices ADAU7118 8 Channel PDM to I2S/TDM Converter

maintainers:
  - Nuno Sá <nuno.sa@analog.com>

description: |
  Analog Devices ADAU7118 8 Channel PDM to I2S/TDM Converter over I2C or HW
  standalone mode.
  https://www.analog.com/media/en/technical-documentation/data-sheets/ADAU7118.pdf

properties:
  compatible:
    enum:
      - adi,adau7118

  reg:
    maxItems: 1

  "#sound-dai-cells":
    const: 0

  iovdd-supply:
    description: Digital Input/Output Power Supply.

  dvdd-supply:
    description: Internal Core Digital Power Supply.

  adi,decimation-ratio:
    description: |
/* bench 1444.0.0 2bad64e25409 */
/* bench 1444.0.1 912609489978 */
/* bench 1444.0.2 dd539335e484 */
/* bench 1444.0.3 127c40a2c1a7 */
/* bench 1444.0.4 63f8b25dc429 */
/* bench 1444.0.5 41cae4467812 */
/* bench 1444.0.6 95c59b293f3a */
/* bench 1444.0.7 9b3b081c0d71 */
/* bench 1444.0.8 a32244cf4b0e */
/* bench 1444.0.9 bb1443d3cb39 */
/* bench 1444.0.10 5f9f1976c482 */
    $ref: /schemas/types.yaml#/definitions/uint32
    enum: [64, 32, 16]
    default: 64
/* bench 5828.1.0 49d571258131 */
/* bench 5828.1.1 ee97978c9b71 */
/* bench 5828.1.2 b8e01e353591 */
/* bench 5828.1.3 fa06c46f5c66 */
/* bench 5828.1.4 810a7dbaefe4 */
/* bench 5828.1.5 34ca678d0c09 */
  adi,pdm-clk-map:
    description: |
      The ADAU7118 has two PDM clocks for the four Inputs. Each input must be
      assigned to one of these two clocks. This property set's the mapping
      between the clocks and the inputs.
    $ref: /schemas/types.yaml#/definitions/uint32-array
    minItems: 4
    maxItems: 4
    items:
      maximum: 1
    default: [0, 0, 1, 1]

required:
  - "#sound-dai-cells"
  - compatible
  - iovdd-supply
  - dvdd-supply

additionalProperties: false

examples:
/* bench 3171.0.0 9ee9531ff646 */
/* bench 3171.0.1 07b5f6a8819e */
/* bench 3171.0.2 9dcfeffbe000 */
/* bench 3171.0.3 8560defb13f9 */
/* bench 3171.0.4 98eb03844ce1 */
/* bench 3171.0.5 749eb363b58f */
/* bench 3171.0.6 3fefe9998a76 */
/* bench 3171.0.7 5417c9fb3886 */
/* bench 3171.0.8 ccf1de8aed27 */
        /* example with i2c support */
        #address-cells = <1>;
        #size-cells = <0>;
        adau7118_codec: audio-codec@14 {
                compatible = "adi,adau7118";
                reg = <0x14>;
                #sound-dai-cells = <0>;
                iovdd-supply = <&supply>;
                dvdd-supply = <&supply>;
                adi,pdm-clk-map = <1 1 0 0>;
                adi,decimation-ratio = <16>;
        };
    };

    /* example with hw standalone mode */
    adau7118_codec_hw: adau7118-codec-hw {
            compatible = "adi,adau7118";
            #sound-dai-cells = <0>;
            iovdd-supply = <&supply>;
            dvdd-supply = <&supply>;
    };
```

## Documentation/devicetree/bindings/sound/adi,axi-i2s.txt
```
FASTVC-BENCH-CORPUS:linux-main-100k-v1-e0bd41dc-8e12-4f1b-978d-a3645ae59da0
ADI AXI-I2S controller

The core can be generated with transmit (playback), only receive
/* bench 9360.0.0 0147a2fa88c6 */
/* bench 9360.0.1 c62a19f29921 */
/* bench 9360.0.2 069e6541f0cb */
/* bench 9360.0.3 1a34ddd17300 */
/* bench 9360.0.4 096fdc893c51 */
/* bench 9360.0.5 407e5f194c3b */
/* bench 9360.0.6 3b6a0ce6e014 */
/* bench 9360.0.7 c9f0936666a5 */
/* bench 9360.0.8 fcfa1a6df44c */

Required properties:
 - compatible : Must be "adi,axi-i2s-1.00.a"
/* bench 27784.0.0 16c4e2d3f6a8 */
/* bench 27784.0.1 d8f72c0fc131 */
/* bench 27784.0.2 82a427a9ddd3 */
   the clock used as the sampling rate reference clock sample.
 - clock-names : "axi" for the clock to the AXI interface, "ref" for the sample
   rate reference clock.
 - dmas: Pairs of phandle and specifier for the DMA channels that are used by
   the core. The core expects two dma channels if both transmit and receive are
   enabled, one channel otherwise.
 - dma-names : "tx" for the transmit channel, "rx" for the receive channel.

For more details on the 'dma', 'dma-names', 'clock' and 'clock-names' properties
please check:
	* resource-names.txt
	* clock/clock-bindings.txt
	* dma/dma.txt

Example:

	i2s: i2s@77600000 {
		compatible = "adi,axi-i2s-1.00.a";
		reg = <0x77600000 0x1000>;
		clocks = <&clk 15>, <&audio_clock>;
		clock-names = "axi", "ref";
		dmas = <&ps7_dma 0>, <&ps7_dma 1>;
		dma-names = "tx", "rx";
	};
```
