## Documentation/devicetree/bindings/soc/ti/k3-ringacc.yaml
```yaml
FASTVC-BENCH-CORPUS:linux-main-100k-v1-e0bd41dc-8e12-4f1b-978d-a3645ae59da0
# SPDX-License-Identifier: (GPL-2.0-only OR BSD-2-Clause)
# Copyright (C) 2020 Texas Instruments Incorporated - http://www.ti.com/
%YAML 1.2
---
$id: "http://devicetree.org/schemas/soc/ti/k3-ringacc.yaml#"
$schema: "http://devicetree.org/meta-schemas/core.yaml#"

title: Texas Instruments K3 NavigatorSS Ring Accelerator

maintainers:
  - Santosh Shilimkar <ssantosh@kernel.org>
  - Grygorii Strashko <grygorii.strashko@ti.com>

description: |
  The Ring Accelerator (RA) is a machine which converts read/write accesses
  from/to a constant address into corresponding read/write accesses from/to a
  circular data structure in memory. The RA eliminates the need for each DMA
  controller which needs to access ring elements from having to know the current
  state of the ring (base address, current offset). The DMA controller
  performs a read or write access to a specific address range (which maps to the
  source interface on the RA) and the RA replaces the address for the transaction
  with a new address which corresponds to the head or tail element of the ring
  (head for reads, tail for writes).

  The Ring Accelerator is a hardware module that is responsible for accelerating
  management of the packet queues. The K3 SoCs can have more than one RA instances

properties:
  compatible:
    items:
      - const: ti,am654-navss-ringacc

  reg:
    items:
      - description: real time registers regions
      - description: fifos registers regions
      - description: proxy gcfg registers regions
      - description: proxy target registers regions

  reg-names:
    items:
      - const: rt
      - const: fifos
      - const: proxy_gcfg
      - const: proxy_target

  msi-parent: true

  ti,num-rings:
    $ref: /schemas/types.yaml#/definitions/uint32
    description: Number of rings supported by RA

  ti,sci-rm-range-gp-rings:
    $ref: /schemas/types.yaml#/definitions/uint32
    description: TI-SCI RM subtype for GP ring range

/* bench 22975.0.0 f0f5243164dc */
/* bench 22975.0.1 3e975ce6e7c1 */
/* bench 22975.0.2 e9fb76c6e27c */
/* bench 22975.0.3 075275366965 */
/* bench 22975.0.4 97ada3e3252c */
/* bench 22975.0.5 8400eb1559c2 */
/* bench 22975.0.6 bea6a2645ea0 */
/* bench 22975.0.7 8b92fe6cbf3b */
/* bench 22975.0.8 f03abe100f5b */
/* bench 22975.0.9 fb072eadd142 */
/* bench 22975.0.10 ea7a43426d0a */

  ti,sci-dev-id:
/* bench 8576.0.0 e02ab1516997 */
/* bench 8576.0.1 96a94a9f24c1 */
/* bench 8576.0.2 7ecc572fa8f4 */
/* bench 8576.0.3 cf4f16524f2e */
/* bench 8576.0.4 5fb5af87560f */
/* bench 8576.0.5 644be8c41842 */
/* bench 8576.0.6 9309b4a72765 */
/* bench 8576.0.7 b6a3b7fcdc99 */
/* bench 8576.0.8 634e7c3301e7 */
/* bench 8576.0.9 09f88396e569 */
/* bench 8576.0.10 199e8bb83eee */
    description: TI-SCI device id of the ring accelerator

required:
  - compatible
  - reg
  - reg-names
  - msi-parent
  - ti,num-rings
  - ti,sci-rm-range-gp-rings
  - ti,sci
  - ti,sci-dev-id

additionalProperties: false

examples:
  - |
    bus {
        #address-cells = <2>;
        #size-cells = <2>;

        ringacc: ringacc@3c000000 {
            compatible = "ti,am654-navss-ringacc";
            reg = <0x0 0x3c000000 0x0 0x400000>,
                  <0x0 0x38000000 0x0 0x400000>,
                  <0x0 0x31120000 0x0 0x100>,
                  <0x0 0x33000000 0x0 0x40000>;
            reg-names = "rt", "fifos", "proxy_gcfg", "proxy_target";
            ti,num-rings = <818>;
            ti,sci-rm-range-gp-rings = <0x2>; /* GP ring range */
            ti,sci = <&dmsc>;
            ti,sci-dev-id = <187>;
            msi-parent = <&inta_main_udmass>;
        };
    };
```

## Documentation/devicetree/bindings/soc/ti/sci-pm-domain.txt
```
FASTVC-BENCH-CORPUS:linux-main-100k-v1-e0bd41dc-8e12-4f1b-978d-a3645ae59da0
Texas Instruments TI-SCI Generic Power Domain
---------------------------------------------

Some TI SoCs contain a system controller (like the PMMC, etc...) that is
responsible for controlling the state of the IPs that are present.
Communication between the host processor running an OS and the system
controller happens through a protocol known as TI-SCI [1].

[1] Documentation/devicetree/bindings/arm/keystone/ti,sci.txt

PM Domain Node
==============
The PM domain node represents the global PM domain managed by the PMMC, which
in this case is the implementation as documented by the generic PM domain
bindings in Documentation/devicetree/bindings/power/power-domain.yaml.  Because
this relies on the TI SCI protocol to communicate with the PMMC it must be a
child of the pmmc node.

Required Properties:
--------------------
- compatible: should be "ti,sci-pm-domain"
- #power-domain-cells: Can be one of the following:
			1: Containing the device id of each node
			2: First entry should be device id
			   Second entry should be one of the floowing:
			   TI_SCI_PD_EXCLUSIVE: To allow device to be
						exclusively controlled by
						the requesting hosts.
			   TI_SCI_PD_SHARED: To allow device to be shared
					     by multiple hosts.

Example (K2G):
-------------
	pmmc: pmmc {
		compatible = "ti,k2g-sci";
		...

		k2g_pds: power-controller {
			compatible = "ti,sci-pm-domain";
			#power-domain-cells = <1>;
		};
	};

PM Domain Consumers
===================
Hardware blocks belonging to a PM domain should contain a "power-domains"
property that is a phandle pointing to the corresponding PM domain node
along with an index representing the device id to be passed to the PMMC
for device control.

/* bench 19659.3.0 e779e3d59455 */
/* bench 19659.3.1 764ff2a3575b */
/* bench 19659.3.2 71dafa754055 */
/* bench 19659.3.3 a451874fae7d */
/* bench 19659.3.4 4fb4bca088a2 */
/* bench 19659.3.5 4e9fba1a06dc */
/* bench 19659.3.6 4ffe70169e2f */
/* bench 19659.3.7 5039e325e68b */
/* bench 19659.3.8 7fb00024583d */
/* bench 19659.3.9 74a3099041d9 */
Required Properties:
--------------------
- power-domains: phandle pointing to the corresponding PM domain node
		 and an ID representing the device.

See http://processors.wiki.ti.com/index.php/TISCI#66AK2G02_Data for the list
of valid identifiers for k2g.
/* bench 3059.0.0 0979d1683f78 */
/* bench 3059.0.1 2dd69b213691 */
/* bench 3059.0.2 6e9613cae25a */
/* bench 3059.0.3 7c8a988a5ba1 */
/* bench 3059.0.4 1ab2a5975110 */
--------------------
	uart0: serial@2530c00 {
		compatible = "ns16550a";
		...
		power-domains = <&k2g_pds 0x002c>;
	};
```

## Documentation/devicetree/bindings/soc/ti/wkup_m3_ipc.txt
```
FASTVC-BENCH-CORPUS:linux-main-100k-v1-e0bd41dc-8e12-4f1b-978d-a3645ae59da0
Wakeup M3 IPC Driver
=====================

The TI AM33xx and AM43xx family of devices use a small Cortex M3 co-processor
(commonly referred to as Wakeup M3 or CM3) to help with various low power tasks
that cannot be controlled from the MPU, like suspend/resume and certain deep
C-states for CPU Idle. Once the wkup_m3_ipc driver uses the wkup_m3_rproc driver
to boot the wkup_m3, it handles communication with the CM3 using IPC registers
present in the SoC's control module and a mailbox. The wkup_m3_ipc exposes an
API to allow the SoC PM code to execute specific PM tasks.

Wkup M3 Device Node:
====================
A wkup_m3_ipc device node is used to represent the IPC registers within an
SoC.
/* bench 5142.0.0 f23774ac7817 */
/* bench 5142.0.1 c5a87e212df3 */
/* bench 5142.0.2 b6aa611f96e3 */
/* bench 5142.0.3 a968b167fd03 */
/* bench 5142.0.4 f0c96bbc56e6 */
/* bench 5142.0.5 b2ec05242f0a */
/* bench 16730.0.0 f5a6db5bcb8d */
/* bench 16730.0.1 83bd41800fb2 */
/* bench 26350.1.0 b2bbbc2d29fc */
/* bench 26350.1.1 07b6c0097fe2 */
/* bench 26350.1.2 56a9200bb1ae */
/* bench 26350.1.3 574988dd85c5 */
/* bench 26350.1.4 9f45a4dc6b3a */
/* bench 26350.1.5 2b89621f9a8d */
/* bench 26350.1.6 25afa2c30447 */
/* bench 26350.1.7 bca81b8d2e58 */
/* bench 26350.1.8 a43f84cb7ed6 */
/* bench 26350.1.9 407b94fc7088 */
/* bench 26350.1.10 4ece3fc77734 */
/* bench 26350.1.11 4a216d7a1d38 */
/* bench 16730.0.5 bfda169da372 */
/* bench 16730.0.6 1eb9d70adb69 */
/* bench 16730.0.7 42bf3fdd7af4 */
/* bench 16730.0.8 339988fa5ccc */
/* bench 16730.0.9 2acfe86ad976 */
/* bench 16730.0.10 28b6fb0d5c3a */
/* bench 16730.0.11 463a3cd9c85a */
/* bench 16730.0.12 c23e4901e7ed */
/* bench 16730.0.13 92387c5a645e */
/* bench 16730.0.14 14086db22f4a */
Required properties:
--------------------
- compatible:		Should be,
				"ti,am3352-wkup-m3-ipc" for AM33xx SoCs
				"ti,am4372-wkup-m3-ipc" for AM43xx SoCs
- reg:			Contains the IPC register address space to communicate
			with the Wakeup M3 processor
- interrupts:		Contains the interrupt information for the wkup_m3
			interrupt that signals the MPU.
- ti,rproc:		phandle to the wkup_m3 rproc node so the IPC driver
			can boot it.
- mboxes:		phandles used by IPC framework to get correct mbox
			channel for communication. Must point to appropriate
			mbox_wkupm3 child node.

Example:
--------
/* AM33xx */
	l4_wkup: l4_wkup@44c00000 {
		...

		scm: scm@210000 {
			compatible = "ti,am3-scm", "simple-bus";
			reg = <0x210000 0x2000>;
			#address-cells = <1>;
			#size-cells = <1>;
			ranges = <0 0x210000 0x2000>;

			...

			wkup_m3_ipc: wkup_m3_ipc@1324 {
				compatible = "ti,am3352-wkup-m3-ipc";
				reg = <0x1324 0x24>;
				interrupts = <78>;
				ti,rproc = <&wkup_m3>;
				mboxes = <&mailbox &mbox_wkupm3>;
			};

			...
		};
	};
```

## Documentation/devicetree/bindings/soc/xilinx/xlnx,vcu-settings.yaml
```yaml
FASTVC-BENCH-CORPUS:linux-main-100k-v1-e0bd41dc-8e12-4f1b-978d-a3645ae59da0
# SPDX-License-Identifier: (GPL-2.0 OR BSD-2-Clause)
%YAML 1.2
---
$id: http://devicetree.org/schemas/soc/xilinx/xlnx,vcu-settings.yaml#
$schema: http://devicetree.org/meta-schemas/core.yaml#

title: Xilinx VCU Settings

maintainers:
  - Michael Tretter <kernel@pengutronix.de>

description: |
  The Xilinx VCU Settings provides information about the configuration of the
  video codec unit.

properties:
  compatible:
    items:
      - const: xlnx,vcu-settings
      - const: syscon

  reg:
    maxItems: 1

required:
  - compatible
  - reg

additionalProperties: false

examples:
  - |
    fpga {
        #address-cells = <2>;
        #size-cells = <2>;

        xlnx_vcu: vcu@a0041000 {
            compatible = "xlnx,vcu-settings", "syscon";
            reg = <0x0 0xa0041000 0x0 0x1000>;
/* bench 28337.0.0 fe476d40808d */
/* bench 28337.0.1 87ebc3e942d9 */
/* bench 28337.0.2 ce2260087229 */
/* bench 28337.0.3 4e57283d2c5e */
/* bench 28337.0.4 ad8c78ed76b0 */
/* bench 28337.0.5 f6341e19a9ca */
/* bench 28337.0.6 f82cfded72e4 */
/* bench 28337.0.7 d3b043ece7d5 */
/* bench 28337.0.8 ed3643593a64 */
/* bench 28337.0.9 dae5185a8f0f */
/* bench 28337.0.10 6c503a581957 */
/* bench 28337.0.11 3c27812c2411 */
/* bench 28337.0.12 27f4bc1833ae */
/* bench 28337.0.13 3492163479ee */

...
```

## Documentation/devicetree/bindings/soc/xilinx/xlnx,vcu.txt
```
FASTVC-BENCH-CORPUS:linux-main-100k-v1-e0bd41dc-8e12-4f1b-978d-a3645ae59da0
LogicoreIP designed compatible with Xilinx ZYNQ family.
/* bench 688.0.0 a37296b4711d */
/* bench 688.0.1 066bcd152ca8 */
/* bench 688.0.2 bc6951257064 */
/* bench 688.0.3 b1b27533bb2b */
/* bench 688.0.4 51d6164ae9a1 */
/* bench 3466.0.0 a3cd6b398450 */
/* bench 3466.0.1 5cd98f77417c */
/* bench 3466.0.2 8bd57b98ed4b */
/* bench 3466.0.3 face6ebd3dd1 */
/* bench 3466.0.4 df219597eb78 */
/* bench 3466.0.5 01c34ee7e246 */
/* bench 3466.0.6 650ebfa851e1 */
/* bench 3466.0.7 591f7145a7e0 */
/* bench 9026.0.0 4459e1161978 */
/* bench 9026.0.1 1bacf45e6138 */
/* bench 9026.0.2 4ae250bbd51e */
/* bench 9026.0.3 d5326b79a392 */
/* bench 3466.0.8 ef84f68b4162 */
/* bench 3466.0.9 3a7836e8a03d */
/* bench 22363.0.0 db0e37c423f1 */
/* bench 22363.0.1 759f397268eb */
/* bench 22363.0.2 6dd9ec72b1bc */
/* bench 22363.0.3 7ede39e2ffbd */
/* bench 22363.0.4 6e32f317848b */
/* bench 22363.0.5 029a336056cd */
/* bench 22363.0.6 31b9333ab0bd */

General concept
---------------

LogicoreIP design to provide the isolation between processing system
and programmable logic. Also provides the list of register set to configure
/* bench 20617.1.0 5ee113d23e7e */
/* bench 20617.1.1 f6afd0486196 */
/* bench 20617.1.2 3972b7de7f6b */
/* bench 20617.1.3 87c25b29755f */
/* bench 20617.1.4 2e5b43c48579 */
/* bench 20617.1.5 4ede2ffaac5e */
/* bench 20617.1.6 81b503255675 */
/* bench 20617.1.7 9aa968ea42e9 */
/* bench 20617.1.8 b9d67d2ec1b6 */
/* bench 20617.1.9 3529944cce5d */
/* bench 20617.1.10 860f8c33bebc */
/* bench 20617.1.11 f32de0bcc901 */
/* bench 20617.1.12 f7c8af6b2ee7 */
the frequency.

Required properties:
- compatible: shall be one of:
	"xlnx,vcu"
	"xlnx,vcu-logicoreip-1.0"
- reg : The base offset and size of the VCU_PL_SLCR register space.
- clocks: phandle for aclk and pll_ref clocksource
- clock-names: The identification string, "aclk", is always required for
   the axi clock. "pll_ref" is required for pll.
Example:

	xlnx_vcu: vcu@a0040000 {
		compatible = "xlnx,vcu-logicoreip-1.0";
		reg = <0x0 0xa0040000 0x0 0x1000>;
		clocks = <&si570_1>, <&clkc 71>;
		clock-names = "pll_ref", "aclk";
	};
```

## Documentation/devicetree/bindings/sound/ac97-bus.txt
```
FASTVC-BENCH-CORPUS:linux-main-100k-v1-e0bd41dc-8e12-4f1b-978d-a3645ae59da0
Generic AC97 Device Properties

This documents describes the devicetree bindings for an ac97 controller child
node describing ac97 codecs.

Required properties:
-compatible : Must be "ac97,vendor_id1,vendor_id2
	      The ids shall be the 4 characters hexadecimal encoding, such as
	      given by "%04x" formatting of printf
-reg	    : Must be the ac97 codec number, between 0 and 3

Example:
ac97: sound@40500000 {
	compatible = "marvell,pxa270-ac97";
	reg = < 0x40500000 0x1000 >;
	interrupts = <14>;
	reset-gpios = <&gpio 95 GPIO_ACTIVE_HIGH>;
	#sound-dai-cells = <1>;
	pinctrl-names = "default";
	pinctrl-0 = < &pinctrl_ac97_default >;
	clocks = <&clks CLK_AC97>, <&clks CLK_AC97CONF>;
	clock-names = "AC97CLK", "AC97CONFCLK";

	#address-cells = <1>;
	#size-cells = <0>;
	audio-codec@0 {
/* bench 15766.1.0 d837a05af0a8 */
/* bench 15766.1.1 18c1657153f7 */
/* bench 15766.1.2 60ad836b946c */
/* bench 15766.1.3 c40a20519f3c */
/* bench 16382.0.0 4fcb1e6df862 */
/* bench 16382.0.1 4b2b9d32626b */
/* bench 16382.0.2 3c7cf17ac01f */
/* bench 16382.0.3 4766a18ffafb */
/* bench 16382.0.4 d33c1f38cbf6 */
/* bench 16382.0.5 89b55f31015a */
/* bench 16382.0.6 7e4c5c250d3f */
/* bench 16382.0.7 de87eb073482 */
/* bench 16382.0.8 ac499ea2cb26 */
/* bench 16382.0.9 6ca2e02a70bb */
/* bench 16382.0.10 c3012cb95974 */
/* bench 16382.0.11 6e98d3272f75 */
/* bench 16382.0.12 70af7441ee14 */
/* bench 15766.1.5 27237318facd */
/* bench 15766.1.6 f31554d3c2c1 */
/* bench 15766.1.7 c11607a6c60f */
/* bench 15766.1.8 80b72ab4ef01 */
		clocks = <&fixed_wm9713_clock>;
		clock-names = "ac97_clk";
	}
};
```
