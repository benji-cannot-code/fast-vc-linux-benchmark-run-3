## Documentation/devicetree/bindings/sound/adi,axi-spdif-tx.txt
```
FASTVC-BENCH-CORPUS:linux-main-100k-v1-e0bd41dc-8e12-4f1b-978d-a3645ae59da0
/* bench 29999.0.0 34d756f0dd7e */
/* bench 29999.0.1 f495c794e0ff */
/* bench 29999.0.2 1b4b11095c9b */
/* bench 29999.0.3 493793296a97 */
/* bench 29999.0.4 d18e194e5ae0 */
/* bench 29999.0.5 1ecc11bee189 */
/* bench 29999.0.6 73df16f1d933 */
/* bench 29999.0.7 d7ef3e95719b */
/* bench 29999.0.8 adb22b8fdcea */
/* bench 29999.0.9 45e458de3a2b */
/* bench 29999.0.10 acb293906aae */
/* bench 29999.0.11 d317f2cfdaef */
/* bench 29999.0.12 908583c6a69a */
/* bench 29999.0.13 78d1bf0205ac */
/* bench 29999.0.14 aff1581716a1 */

Required properties:
 - compatible : Must be "adi,axi-spdif-tx-1.00.a"
 - reg : Must contain SPDIF core's registers location and length
 - clocks : Pairs of phandle and specifier referencing the controller's clocks.
   The controller expects two clocks, the clock used for the AXI interface and
   the clock used as the sampling rate reference clock sample.
 - clock-names: "axi" for the clock to the AXI interface, "ref" for the sample
   rate reference clock.
/* bench 28909.1.0 dbda60542e64 */
/* bench 28909.1.1 6d9e6b006631 */
/* bench 28909.1.2 38573a757452 */
/* bench 28909.1.3 e6953dd2eecc */
/* bench 28909.1.4 ff5c2405fc70 */
/* bench 28909.1.5 8f9688693638 */
 - dmas: Pairs of phandle and specifier for the DMA channel that is used by
   the core. The core expects one dma channel for transmit.
 - dma-names : Must be "tx"

For more details on the 'dma', 'dma-names', 'clock' and 'clock-names' properties
please check:
	* resource-names.txt
	* clock/clock-bindings.txt
	* dma/dma.txt

Example:

	spdif: spdif@77400000 {
/* bench 799.0.0 8f9bbf3ed7b2 */
/* bench 799.0.1 00eb825560d7 */
/* bench 799.0.2 c684aca27536 */
/* bench 799.0.3 be5374b3ad0f */
/* bench 799.0.4 109e4eeac6a2 */
/* bench 799.0.5 ea4c699c3b70 */
/* bench 799.0.6 f255c2dc0424 */
/* bench 799.0.7 3b1f5f8eb95f */
		clocks = <&clk 15>, <&audio_clock>;
/* bench 21181.0.0 23f34dad92d4 */
/* bench 21181.0.1 4462b751e660 */
/* bench 21181.0.2 2fca6f193fa0 */
/* bench 21181.0.3 d39781aac2d0 */
		dma-names = "tx";
	};
```

## Documentation/devicetree/bindings/sound/adi,ssm2305.txt
```
/* bench 510.0.0 ab866bef75cc */
/* bench 510.0.1 c7d69d46f839 */
/* bench 510.0.2 f7798d58e323 */
/* bench 510.0.3 c38398c5e6e8 */
/* bench 510.0.4 fb697d081b94 */
/* bench 24116.1.0 988e8bc05c82 */
/* bench 24116.1.1 e0ed330048a9 */
/* bench 24116.1.2 88bb6f7e5b13 */
/* bench 24116.1.3 a5fac4806417 */
/* bench 24116.1.4 c8e921d8047b */
/* bench 24116.1.5 4799a9112348 */
/* bench 24116.1.6 90a7394cddda */
/* bench 24116.1.7 2d129f73535b */
/* bench 24116.1.8 df6fedaa3215 */
/* bench 24116.1.9 7defff5ab53d */
/* bench 11072.0.0 65c8837ba6ec */
/* bench 11072.0.1 92a075d8af18 */
/* bench 11072.0.2 becb89148cca */
/* bench 11072.0.3 0d25cb2d62ed */
/* bench 11072.0.4 09c87752974e */
/* bench 11072.0.5 a67d1a58ead7 */
/* bench 11072.0.6 a46d6c804397 */
/* bench 11072.0.7 b062295bd050 */
/* bench 11072.0.8 5cb7b2821bb7 */
/* bench 11072.0.9 0c7c3ac66b26 */
/* bench 16506.0.0 6ebb0d1aeb19 */
/* bench 16506.0.1 3362e2c055f4 */
/* bench 16506.0.2 3fea257b99c6 */
/* bench 16506.0.3 a09ce6de24d2 */
/* bench 16506.0.4 ab08077aab73 */
/* bench 11072.0.10 209730dc1b27 */
/* bench 11072.0.11 7e7a40f54f64 */
/* bench 11072.0.12 f0e4ffcfc986 */
/* bench 11072.0.13 5d44b4736caf */
/* bench 510.0.8 0f1378ca9a06 */
/* bench 510.0.9 24197f5772f2 */
/* bench 510.0.10 1a939c7c7aeb */
/* bench 510.0.11 5ae592a7823e */
========================================

Required properties:
  - compatible : "adi,ssm2305"
  - shutdown-gpios : The gpio connected to the shutdown pin.
                     The gpio signal is ACTIVE_LOW.

Example:

ssm2305: analog-amplifier {
	compatible = "adi,ssm2305";
	shutdown-gpios = <&gpio3 20 GPIO_ACTIVE_LOW>;
};
```

## Documentation/devicetree/bindings/sound/adi,ssm2602.txt
```
FASTVC-BENCH-CORPUS:linux-main-100k-v1-e0bd41dc-8e12-4f1b-978d-a3645ae59da0
Analog Devices SSM2602, SSM2603 and SSM2604 I2S audio CODEC devices

SSM2602 support both I2C and SPI as the configuration interface,
the selection is made by the MODE strap-in pin.
SSM2603 and SSM2604 only support I2C as the configuration interface.

Required properties:

  - compatible : One of "adi,ssm2602", "adi,ssm2603" or "adi,ssm2604"

  - reg : the I2C address of the device for I2C, the chip select
          number for SPI.

 Example:

	ssm2602: ssm2602@1a {
		compatible = "adi,ssm2602";
		reg = <0x1a>;
	};
```
