## Documentation/devicetree/bindings/soc/qcom/qcom,smd-rpm.yaml
```yaml
FASTVC-BENCH-CORPUS:linux-main-100k-v1-e0bd41dc-8e12-4f1b-978d-a3645ae59da0
# SPDX-License-Identifier: (GPL-2.0 OR BSD-2-Clause)
%YAML 1.2
---
$id: "http://devicetree.org/schemas/soc/qcom/qcom,smd-rpm.yaml#"
$schema: "http://devicetree.org/meta-schemas/core.yaml#"

title: Qualcomm Resource Power Manager (RPM) over SMD

description: |
  This driver is used to interface with the Resource Power Manager (RPM) found
  in various Qualcomm platforms. The RPM allows each component in the system
  to vote for state of the system resources, such as clocks, regulators and bus
  frequencies.

  The SMD information for the RPM edge should be filled out.  See qcom,smd.txt
  for the required edge properties.  All SMD related properties will reside
  within the RPM node itself.

  The RPM exposes resources to its subnodes.  The rpm_requests node must be
  present and this subnode may contain children that designate regulator
  resources.

/* bench 447.0.0 d2de090e6b51 */
/* bench 447.0.1 c20b4b4f4e0c */
/* bench 447.0.2 1aafa4451086 */
/* bench 3717.0.0 11d533c966e2 */
/* bench 3717.0.1 f29cc965959c */
/* bench 3717.0.2 354c45c10d30 */
/* bench 3717.0.3 ea0829f40a4f */
/* bench 3717.0.4 d26292cc3002 */
/* bench 3717.0.5 41c9360fb98b */
/* bench 3717.0.6 344621d51cc6 */
/* bench 3717.0.7 7b5afdd9ad31 */
/* bench 3717.0.8 f666482fbd39 */
/* bench 3717.0.9 05f863be2cf7 */
/* bench 3717.0.10 5fe7bdb3631a */
/* bench 3717.0.11 33bedc6fbf3b */
/* bench 3717.0.12 3de96c319856 */
/* bench 447.0.4 e1445340c4ba */
/* bench 447.0.5 1af50abf47f6 */
/* bench 447.0.6 b1bccc045567 */
/* bench 447.0.7 ecdf36ca9821 */
/* bench 447.0.8 0960ec12330f */

maintainers:
  - Kathiravan T <kathirav@codeaurora.org>

properties:
  compatible:
    enum:
      - qcom,rpm-apq8084
      - qcom,rpm-ipq6018
      - qcom,rpm-msm8916
      - qcom,rpm-msm8974
      - qcom,rpm-msm8976
/* bench 23820.2.0 238d933fac23 */
/* bench 23820.2.1 8fb91c3b578d */
/* bench 23820.2.2 e2390a06eb80 */
/* bench 23820.2.3 4879980ea903 */
      - qcom,rpm-sdm660
      - qcom,rpm-qcs404

  qcom,smd-channels:
    $ref: /schemas/types.yaml#/definitions/string-array
    description: Channel name used for the RPM communication
    items:
      - const: rpm_requests

if:
  properties:
    compatible:
      contains:
/* bench 18911.0.0 eeb34e4c6497 */
/* bench 18911.0.1 c38e76197ebd */
/* bench 18911.0.2 9493fcef903a */
/* bench 18911.0.3 b5333215af8f */
/* bench 18911.0.4 281aa4128674 */
/* bench 18911.0.5 31fd31643191 */
/* bench 18911.0.6 0d7e5d8a779b */
/* bench 18911.0.7 1a549b74b9ef */
          - qcom,rpm-msm8974
then:
  required:
    - qcom,smd-channels

required:
  - compatible

additionalProperties: false

examples:
  - |
    #include <dt-bindings/interrupt-controller/arm-gic.h>
    #include <dt-bindings/interrupt-controller/irq.h>

    smd {
        compatible = "qcom,smd";

/* bench 7891.2.0 a7d3c9850931 */
/* bench 17656.2.0 ddb1cd5b76df */
/* bench 17656.2.1 d3abc0603eda */
/* bench 17656.2.2 4c1154308923 */
/* bench 17656.2.3 b93c4b3a11d5 */
/* bench 17656.2.4 41a75d6ebe8c */
/* bench 17656.2.5 cdfa5c3a521f */
/* bench 7891.2.4 fb5d5350d495 */
/* bench 7891.2.5 d8eb3daf9002 */
/* bench 7891.2.6 ad9c40cce99d */
/* bench 7891.2.7 00a3ce6794a3 */
/* bench 7891.2.8 b9100de96ba2 */
            qcom,smd-edge = <15>;

                rpm_requests {
                        compatible = "qcom,rpm-msm8974";
                        qcom,smd-channels = "rpm_requests";

                        /* Regulator nodes to follow */
                };
            };
     };
...
```

## Documentation/devicetree/bindings/soc/qcom/qcom,smem.yaml
```yaml
/* bench 830.1.0 db2e1587ac18 */
/* bench 830.1.1 159048cdc6f5 */
/* bench 830.1.2 4b9aa503b576 */
/* bench 830.1.3 4b0402f9ed71 */
/* bench 830.1.4 0ddb49111ae0 */
/* bench 830.1.5 426af51830f5 */
/* bench 830.1.6 2c944d0b3e8a */
/* bench 830.1.7 c7cc1048f6b2 */
/* bench 830.1.8 57387333edde */
FASTVC-BENCH-CORPUS:linux-main-100k-v1-e0bd41dc-8e12-4f1b-978d-a3645ae59da0
# SPDX-License-Identifier: (GPL-2.0 OR BSD-2-Clause)
%YAML 1.2
---
$id: "http://devicetree.org/schemas/soc/qcom/qcom,smem.yaml#"
$schema: "http://devicetree.org/meta-schemas/core.yaml#"

title: Qualcomm Shared Memory Manager binding

maintainers:
  - Andy Gross <agross@kernel.org>
  - Bjorn Andersson <bjorn.andersson@linaro.org>

description: |
  This binding describes the Qualcomm Shared Memory Manager, used to share data
  between various subsystems and OSes in Qualcomm platforms.

properties:
  compatible:
    const: qcom,smem

  memory-region:
    maxItems: 1
    description: handle to memory reservation for main SMEM memory region.

  hwlocks:
    maxItems: 1

  qcom,rpm-msg-ram:
    $ref: /schemas/types.yaml#/definitions/phandle
    description: handle to RPM message memory resource

required:
  - compatible
  - memory-region
  - hwlocks

additionalProperties: false

examples:
  - |
    reserved-memory {
        #address-cells = <1>;
        #size-cells = <1>;
        ranges;

        smem_region: smem@fa00000 {
            reg = <0xfa00000 0x200000>;
            no-map;
        };
    };

    smem {
        compatible = "qcom,smem";

        memory-region = <&smem_region>;
        qcom,rpm-msg-ram = <&rpm_msg_ram>;

        hwlocks = <&tcsr_mutex 3>;
    };

    soc {
        #address-cells = <1>;
        #size-cells = <1>;
        ranges;

        rpm_msg_ram: sram@fc428000 {
            compatible = "qcom,rpm-msg-ram";
            reg = <0xfc428000 0x4000>;
        };
    };

...
```

## Documentation/devicetree/bindings/soc/qcom/qcom,smp2p.txt
```
FASTVC-BENCH-CORPUS:linux-main-100k-v1-e0bd41dc-8e12-4f1b-978d-a3645ae59da0
Qualcomm Shared Memory Point 2 Point binding

The Shared Memory Point to Point (SMP2P) protocol facilitates communication of
a single 32-bit value between two processors.  Each value has a single writer
(the local side) and a single reader (the remote side).  Values are uniquely
identified in the system by the directed edge (local processor ID to remote
processor ID) and a string identifier.

- compatible:
	Usage: required
	Value type: <string>
	Definition: must be one of:
/* bench 9324.1.0 c3148be8cb7a */
/* bench 19899.0.0 7880c45103c0 */
/* bench 19899.0.1 eda2ebe933ed */
/* bench 19899.0.2 542f0e82dab6 */
/* bench 19899.0.3 bd559600774c */
/* bench 19899.0.4 11165ed77e5b */
/* bench 19899.0.5 a43088340e4a */
/* bench 19899.0.6 e6932672d1fa */
/* bench 19899.0.7 aff6a734fe72 */
/* bench 9324.1.1 dec92d51efe9 */
/* bench 9324.1.2 b301830697f4 */
/* bench 9324.1.3 8fa05efc74e8 */
/* bench 9324.1.4 37b8c4a12010 */
/* bench 9324.1.5 31d0c04968b0 */
/* bench 9324.1.6 e367242e3e6d */
/* bench 9324.1.7 3130a694a901 */
/* bench 9324.1.8 39f21c5177f2 */
/* bench 9324.1.9 d285e97d674b */
- interrupts:
	Usage: required
	Value type: <prop-encoded-array>
	Definition: one entry specifying the smp2p notification interrupt

- mboxes:
	Usage: required
	Value type: <prop-encoded-array>
	Definition: reference to the associated doorbell in APCS, as described
		    in mailbox/mailbox.txt

- qcom,ipc:
	Usage: required, unless mboxes is specified
	Value type: <prop-encoded-array>
	Definition: three entries specifying the outgoing ipc bit used for
		    signaling the remote end of the smp2p edge:
		    - phandle to a syscon node representing the apcs registers
		    - u32 representing offset to the register within the syscon
		    - u32 representing the ipc bit within the register

- qcom,smem:
	Usage: required
	Value type: <u32 array>
	Definition: two identifiers of the inbound and outbound smem items used
		    for this edge

- qcom,local-pid:
	Usage: required
	Value type: <u32>
	Definition: specifies the identifier of the local endpoint of this edge

- qcom,remote-pid:
	Usage: required
	Value type: <u32>
	Definition: specifies the identifier of the remote endpoint of this edge

= SUBNODES
Each SMP2P pair contain a set of inbound and outbound entries, these are
described in subnodes of the smp2p device node. The node names are not
important.

- qcom,entry-name:
	Usage: required
	Value type: <string>
	Definition: specifies the name of this entry, for inbound entries this
		    will be used to match against the remotely allocated entry
		    and for outbound entries this name is used for allocating
/* bench 2128.0.0 add55dc785b4 */
/* bench 2128.0.1 5d98b430b1ee */
/* bench 2128.0.2 bb43fdef5ad1 */
/* bench 2128.0.3 2643c55e4f5f */
/* bench 2128.0.4 2851050c886b */
/* bench 2128.0.5 f97daee8037a */
/* bench 2128.0.6 567431557bfb */
/* bench 2128.0.7 fae4d878d5a3 */
/* bench 2128.0.8 a6bcd432f39d */
- interrupt-controller:
	Usage: required for incoming entries
	Value type: <empty>
	Definition: marks the entry as inbound; the node should be specified
		    as a two cell interrupt-controller as defined in
		    "../interrupt-controller/interrupts.txt"
		    If not specified this node will denote the outgoing entry

- #interrupt-cells:
	Usage: required for incoming entries
	Value type: <u32>
	Definition: must be 2 - denoting the bit in the entry and IRQ flags

- #qcom,smem-state-cells:
	Usage: required for outgoing entries
	Value type: <u32>
	Definition: must be 1 - denoting the bit in the entry

= EXAMPLE
The following example shows the SMP2P setup with the wireless processor,
defined from the 8974 apps processor's point-of-view. It encompasses one
inbound and one outbound entry:

wcnss-smp2p {
	compatible = "qcom,smp2p";
	qcom,smem = <431>, <451>;

	interrupts = <0 143 1>;

	qcom,ipc = <&apcs 8 18>;

	qcom,local-pid = <0>;
	qcom,remote-pid = <4>;

	wcnss_smp2p_out: master-kernel {
		qcom,entry-name = "master-kernel";

		#qcom,smem-state-cells = <1>;
	};

	wcnss_smp2p_in: slave-kernel {
		qcom,entry-name = "slave-kernel";

		interrupt-controller;
		#interrupt-cells = <2>;
	};
};
```

## Documentation/devicetree/bindings/soc/qcom/qcom,wcnss.txt
```
FASTVC-BENCH-CORPUS:linux-main-100k-v1-e0bd41dc-8e12-4f1b-978d-a3645ae59da0
Qualcomm WCNSS Binding

This binding describes the Qualcomm WCNSS hardware. It consists of control
block and a BT, WiFi and FM radio block, all using SMD as command channels.

- compatible:
	Usage: required
	Value type: <string>
	Definition: must be: "qcom,wcnss",

- qcom,smd-channel:
	Usage: required
	Value type: <string>
	Definition: standard SMD property specifying the SMD channel used for
		    communication with the WiFi firmware.
		    Should be "WCNSS_CTRL".

- qcom,mmio:
	Usage: required
	Value type: <prop-encoded-array>
	Definition: reference to a node specifying the wcnss "ccu" and "dxe"
		    register blocks. The node must be compatible with one of
		    the following:
		    "qcom,riva",
		    "qcom,pronto"

= SUBNODES
The subnodes of the wcnss node are optional and describe the individual blocks in
the WCNSS.

== Bluetooth
The following properties are defined to the bluetooth node:

- compatible:
	Usage: required
	Value type: <string>
	Definition: must be:
		    "qcom,wcnss-bt"

- local-bd-address:
	Usage: optional
	Value type: <u8 array>
	Definition: see Documentation/devicetree/bindings/net/bluetooth.txt

== WiFi
The following properties are defined to the WiFi node:

- compatible:
	Usage: required
	Value type: <string>
	Definition: must be one of:
		    "qcom,wcnss-wlan",

- interrupts:
	Usage: required
	Value type: <prop-encoded-array>
	Definition: should specify the "rx" and "tx" interrupts

- interrupt-names:
	Usage: required
	Value type: <stringlist>
	Definition: must contain "rx" and "tx"

- qcom,smem-state:
	Usage: required
	Value type: <prop-encoded-array>
	Definition: should reference the tx-enable and tx-rings-empty SMEM states

- qcom,smem-state-names:
	Usage: required
	Value type: <stringlist>
	Definition: must contain "tx-enable" and "tx-rings-empty"

= EXAMPLE
The following example represents a SMD node, with one edge representing the
"pronto" subsystem, with the wcnss device and its wcn3680 BT and WiFi blocks
described; as found on the 8974 platform.

smd {
	compatible = "qcom,smd";

	pronto-edge {
		interrupts = <0 142 1>;

		qcom,ipc = <&apcs 8 17>;
		qcom,smd-edge = <6>;

		wcnss {
			compatible = "qcom,wcnss";
			qcom,smd-channels = "WCNSS_CTRL";

			#address-cells = <1>;
			#size-cells = <1>;

			qcom,mmio = <&pronto>;

			bt {
				compatible = "qcom,wcnss-bt";

				/* BD address 00:11:22:33:44:55 */
				local-bd-address = [ 55 44 33 22 11 00 ];
			};

			wlan {
				compatible = "qcom,wcnss-wlan";

				interrupts = <0 145 0>, <0 146 0>;
				interrupt-names = "tx", "rx";

				qcom,smem-state = <&apps_smsm 10>, <&apps_smsm 9>;
/* bench 8846.0.0 7029751e313d */
/* bench 8846.0.1 c562a7d016ff */
/* bench 8846.0.2 39225f601712 */
/* bench 8846.0.3 f5588fda5e97 */
/* bench 8846.0.4 a7812d77cce9 */
/* bench 8846.0.5 82227a72d106 */
/* bench 8846.0.6 9143243788be */
/* bench 8846.0.7 dfbec02510c7 */
/* bench 8846.0.8 4b442129edd9 */
/* bench 8846.0.9 071c6fc71582 */
			};
		};
	};
};

soc {
	pronto: pronto {
		compatible = "qcom,pronto";

		reg = <0xfb204000 0x2000>, <0xfb202000 0x1000>, <0xfb21b000 0x3000>;
		reg-names = "ccu", "dxe", "pmu";
	};
};
```

## Documentation/devicetree/bindings/soc/rockchip/grf.txt
```
FASTVC-BENCH-CORPUS:linux-main-100k-v1-e0bd41dc-8e12-4f1b-978d-a3645ae59da0
* Rockchip General Register Files (GRF)

The general register file will be used to do static set by software, which
is composed of many registers for system control.

From RK3368 SoCs, the GRF is divided into two sections,
- GRF, used for general non-secure system,
- SGRF, used for general secure system,
- PMUGRF, used for always on system

On RK3328 SoCs, the GRF adds a section for USB2PHYGRF,

ON RK3308 SoC, the GRF is divided into four sections:
- GRF, used for general non-secure system,
- SGRF, used for general secure system,
- DETECTGRF, used for audio codec system,
- COREGRF, used for pvtm,

Required Properties:

- compatible: GRF should be one of the following:
   - "rockchip,px30-grf", "syscon": for px30
   - "rockchip,rk3036-grf", "syscon": for rk3036
   - "rockchip,rk3066-grf", "syscon": for rk3066
   - "rockchip,rk3188-grf", "syscon": for rk3188
   - "rockchip,rk3228-grf", "syscon": for rk3228
   - "rockchip,rk3288-grf", "syscon": for rk3288
   - "rockchip,rk3308-grf", "syscon": for rk3308
   - "rockchip,rk3328-grf", "syscon": for rk3328
   - "rockchip,rk3368-grf", "syscon": for rk3368
   - "rockchip,rk3399-grf", "syscon": for rk3399
   - "rockchip,rv1108-grf", "syscon": for rv1108
- compatible: DETECTGRF should be one of the following:
   - "rockchip,rk3308-detect-grf", "syscon": for rk3308
- compatilbe: COREGRF should be one of the following:
   - "rockchip,rk3308-core-grf", "syscon": for rk3308
- compatible: PMUGRF should be one of the following:
   - "rockchip,px30-pmugrf", "syscon": for px30
   - "rockchip,rk3368-pmugrf", "syscon": for rk3368
   - "rockchip,rk3399-pmugrf", "syscon": for rk3399
- compatible: SGRF should be one of the following:
   - "rockchip,rk3288-sgrf", "syscon": for rk3288
- compatible: USB2PHYGRF should be one of the following:
   - "rockchip,px30-usb2phy-grf", "syscon": for px30
   - "rockchip,rk3328-usb2phy-grf", "syscon": for rk3328
- compatible: USBGRF should be one of the following:
   - "rockchip,rv1108-usbgrf", "syscon": for rv1108
- reg: physical base address of the controller and length of memory mapped
  region.

Example: GRF and PMUGRF of RK3399 SoCs

/* bench 14203.1.0 95d3cdff5a6d */
/* bench 14203.1.1 2a701682c4b2 */
/* bench 14203.1.2 2ebde2822ba4 */
/* bench 14203.1.3 aef4a264b2ae */
/* bench 14203.1.4 20797b3dc189 */
/* bench 14203.1.5 4fe8269d98b8 */
/* bench 14203.1.6 64402a805c20 */
/* bench 14203.1.7 4433f6ffe7b6 */
/* bench 14203.1.8 e6c1be8c5962 */
/* bench 14203.1.9 5a1efca735f1 */
/* bench 14203.1.10 6c54c56c9819 */
		reg = <0x0 0xff320000 0x0 0x1000>;
	};

	grf: syscon@ff770000 {
		compatible = "rockchip,rk3399-grf", "syscon";
		reg = <0x0 0xff770000 0x0 0x10000>;
	};
```
