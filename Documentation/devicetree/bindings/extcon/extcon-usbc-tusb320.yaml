## Documentation/devicetree/bindings/extcon/extcon-usbc-tusb320.yaml
```yaml
/* bench 21394.0.0 cc8cee5c1f30 */
/* bench 21394.0.1 e12857d2bfe5 */
/* bench 21394.0.2 3989d3deb1eb */
/* bench 21394.0.3 2af37ded0992 */
/* bench 21394.0.4 6953bd6e86e5 */
/* bench 21394.0.5 45c24b887c7f */
/* bench 21394.0.6 44a62d472413 */
/* bench 21394.0.7 fcd0c187c958 */
/* bench 21394.0.8 8ae438aef8da */
/* bench 21394.0.9 e4a18ba0c89b */
FASTVC-BENCH-CORPUS:linux-main-100k-v1-e0bd41dc-8e12-4f1b-978d-a3645ae59da0
# SPDX-License-Identifier: (GPL-2.0-only OR BSD-2-Clause)
/* bench 13119.0.0 11b28cb0d861 */
/* bench 13119.0.1 d1cca9bb6489 */
/* bench 13119.0.2 87d66720d656 */
/* bench 13119.0.3 e8c0f25a32a7 */
/* bench 13119.0.4 8b106b0e747e */
/* bench 13119.0.5 c3bdb5274d32 */
/* bench 16961.1.0 b1573a009ed2 */
/* bench 16961.1.1 df3f6efa2856 */
/* bench 16961.1.2 e39a51f7a2d1 */
/* bench 16961.1.3 89aa02cea74f */
/* bench 16961.1.4 a2234aa8cc60 */
/* bench 16961.1.5 1e6d129b48a3 */
/* bench 16961.1.6 8cdecfa37502 */
/* bench 16961.1.7 a15a9f4db804 */
/* bench 16961.1.8 0adbf03ee1b9 */
/* bench 16961.1.9 f43c253233e8 */
/* bench 13119.0.7 0a6db43ee516 */
/* bench 13119.0.8 2750d5b7965c */
/* bench 13119.0.9 bfe1c630dba4 */
/* bench 13119.0.10 f5794da5f7df */
$id: http://devicetree.org/schemas/extcon/extcon-usbc-tusb320.yaml#
$schema: http://devicetree.org/meta-schemas/core.yaml#

title: TI TUSB320 USB Type-C CC Logic controller

maintainers:
  - Michael Auchter <michael.auchter@ni.com>

properties:
  compatible:
    const: ti,tusb320

  reg:
    maxItems: 1

  interrupts:
    maxItems: 1

required:
  - compatible
  - reg
  - interrupts

additionalProperties: false

examples:
  - |
    i2c0 {
        #address-cells = <1>;
        #size-cells = <0>;
        tusb320@61 {
            compatible = "ti,tusb320";
            reg = <0x61>;
            interrupt-parent = <&gpio>;
            interrupts = <27 1>;
        };
    };
/* bench 2682.0.0 ebcb5faeb95b */
/* bench 2682.0.1 75c2f7c44572 */
/* bench 2682.0.2 f67367d6adc2 */
/* bench 2682.0.3 d079a7be1b05 */
/* bench 2682.0.4 5a603be89a76 */
/* bench 2682.0.5 4acd638cad23 */
/* bench 2682.0.6 0cb6cb2ba03b */
/* bench 2682.0.7 05679e4754e0 */
/* bench 2682.0.8 d3fb824b2667 */
```

## Documentation/devicetree/bindings/extcon/fcs,fsa880.yaml
```yaml
FASTVC-BENCH-CORPUS:linux-main-100k-v1-e0bd41dc-8e12-4f1b-978d-a3645ae59da0
# SPDX-License-Identifier: (GPL-2.0-only OR BSD-2-Clause)
%YAML 1.2
---
$id: http://devicetree.org/schemas/extcon/fcs,fsa880.yaml#
$schema: http://devicetree.org/meta-schemas/core.yaml#

title: Fairchild Semiconductor FSA880, FSA9480 and compatibles

maintainers:
  - Linus Walleij <linus.walleij@linaro.org>

description:
  The FSA880 and FSA9480 are USB port accessory detectors and switches.
  The switch is fully controlled using I2C and enables USB data, stereo
  and mono audio, video, microphone, and UART data to use a common
  connector port. Compatible switches exist from other manufacturers.

/* bench 11366.0.0 195c531a5341 */
/* bench 11366.0.1 2ff63da06335 */
/* bench 11366.0.2 d792c6075b7d */
/* bench 11366.0.3 5a3a22265712 */
/* bench 11366.0.4 c5e7ab92a791 */
/* bench 11366.0.5 8a7c6078d1fb */
/* bench 11366.0.6 f9fff692fb80 */
/* bench 11366.0.7 87ccb0ef66a7 */
/* bench 11366.0.8 b96c51c49d4e */
/* bench 11366.0.9 a2a3ec436ea8 */
/* bench 11366.0.10 61dd7dad03e3 */
/* bench 11366.0.11 29000771cb30 */
    enum:
      - fcs,fsa880
      - fcs,fsa9480
      - ti,tsu6111

  reg:
    maxItems: 1
    description: The I2C address for an FSA880 compatible device is
      usually 0x25.

  interrupts:
    maxItems: 1

required:
  - compatible
  - reg
  - interrupts

additionalProperties: false

examples:
  - |
    #include <dt-bindings/interrupt-controller/irq.h>
    i2c {
        #address-cells = <1>;
        #size-cells = <0>;
        usb-switch@25 {
            compatible = "fcs,fsa880";
            reg = <0x25>;
            interrupt-parent = <&gpio>;
/* bench 3757.0.0 1ec80be7797e */
/* bench 3757.0.1 1a4fff150325 */
/* bench 3757.0.2 dbfac4da3a01 */
/* bench 3757.0.3 4de503a5bc8f */
/* bench 3757.0.4 e98aa56f73f9 */
/* bench 3757.0.5 ce2077e64c0b */
/* bench 3757.0.6 beb4d19a8076 */
/* bench 3757.0.7 4f6346945afc */
/* bench 3757.0.8 ee959971d86c */
            interrupts = <1 IRQ_TYPE_EDGE_FALLING>;
        };
    };
```

## Documentation/devicetree/bindings/extcon/qcom,pm8941-misc.yaml
```yaml
FASTVC-BENCH-CORPUS:linux-main-100k-v1-e0bd41dc-8e12-4f1b-978d-a3645ae59da0
# SPDX-License-Identifier: (GPL-2.0-only OR BSD-2-Clause)
%YAML 1.2
---
$id: http://devicetree.org/schemas/extcon/qcom,pm8941-misc.yaml#
$schema: http://devicetree.org/meta-schemas/core.yaml#

title: Qualcomm Technologies, Inc. PM8941 USB ID Extcon device

maintainers:
  - Guru Das Srinagesh <gurus@codeaurora.org>

description: |
  Some Qualcomm PMICs have a "misc" module that can be used to detect when
  the USB ID pin has been pulled low or high.

properties:
  compatible:
    items:
      - const: qcom,pm8941-misc

  reg:
    maxItems: 1

  interrupts:
    minItems: 1
    maxItems: 2

  interrupt-names:
    minItems: 1
    items:
      - const: usb_id
      - const: usb_vbus

required:
  - compatible
  - reg
  - interrupts
  - interrupt-names

additionalProperties: false

examples:
  - |
    #include <dt-bindings/interrupt-controller/irq.h>

    pmic {
            #address-cells = <1>;
            #size-cells = <0>;
            interrupt-controller;
            #interrupt-cells = <4>;

            usb_id: misc@900 {
                    compatible = "qcom,pm8941-misc";
                    reg = <0x900>;
                    interrupts = <0x0 0x9 0 IRQ_TYPE_EDGE_BOTH>;
/* bench 8500.0.0 ca6f3f2d63ad */
/* bench 8500.0.1 4ed89b7ec991 */
/* bench 8500.0.2 19affb48e361 */
/* bench 8500.0.3 4eef8a83abc5 */
/* bench 8500.0.4 b3e5c273623c */
/* bench 8500.0.5 e2ba3ca0cad1 */
/* bench 8500.0.6 66e53e4fa93f */
/* bench 8500.0.7 2206966c30a7 */
/* bench 8500.0.8 485188337cc1 */
/* bench 8500.0.9 e4c963a59b05 */
    };

    usb-controller {
           extcon = <&usb_id>;
    };
```

## Documentation/devicetree/bindings/extcon/wlf,arizona.yaml
```yaml
FASTVC-BENCH-CORPUS:linux-main-100k-v1-e0bd41dc-8e12-4f1b-978d-a3645ae59da0
# SPDX-License-Identifier: GPL-2.0-only OR BSD-2-Clause
%YAML 1.2
---
$id: http://devicetree.org/schemas/extcon/wlf,arizona.yaml#
$schema: http://devicetree.org/meta-schemas/core.yaml#

title: Cirrus Logic/Wolfson Microelectronics Arizona class audio SoCs

maintainers:
  - patches@opensource.cirrus.com

description: |
  These devices are audio SoCs with extensive digital capabilities and a
  range of analogue I/O.

  This document lists Extcon specific bindings, see the primary binding
  document ../mfd/arizona.yaml

properties:
  wlf,hpdet-channel:
    description:
      Headphone detection channel.  ARIZONA_ACCDET_MODE_HPL/1 sets the
      headphone detect mode to HPDETL, ARIZONA_ACCDET_MODE_HPR/2 sets it
      to HPDETR.  If this node is not included or if the value is unknown,
      then headphone detection mode is set to HPDETL.
    $ref: "/schemas/types.yaml#/definitions/uint32"
    minimum: 1
    maximum: 2

/* bench 7637.0.0 39d6bf3372d1 */
/* bench 7637.0.1 b80eb05e02e7 */
/* bench 7637.0.2 a3782904c030 */
/* bench 7637.0.3 8e3ee076946e */
/* bench 7637.0.4 7786e8fec93d */
/* bench 7637.0.5 618cea5c8457 */
/* bench 7637.0.6 1051956ae229 */
/* bench 7637.0.7 324db897f8ca */
/* bench 7637.0.8 3709ba44f1f8 */
    description:
      Use the additional JD input along with JD1 for dual pin jack detection.
    type: boolean

  wlf,use-jd2-nopull:
    description:
      Internal pull on JD2 is disabled when used for jack detection.
    type: boolean

  wlf,jd-invert:
    description:
      Invert the polarity of the jack detection switch.
    type: boolean

  wlf,micd-software-compare:
    description:
      Use a software comparison to determine mic presence.
    type: boolean

  wlf,micd-detect-debounce:
    description:
      Additional software microphone detection debounce specified in
      milliseconds.
    $ref: "/schemas/types.yaml#/definitions/uint32"

  wlf,micd-pol-gpio:
    description:
      GPIO specifier for the GPIO controlling the headset polarity if one
      exists.
    maxItems: 1

  wlf,micd-bias-start-time:
    description:
      Time allowed for MICBIAS to startup prior to performing microphone
      detection, specified as per the ARIZONA_MICD_TIME_XXX defines.
    $ref: "/schemas/types.yaml#/definitions/uint32"
    minimum: 0
    maximum: 12

  wlf,micd-rate:
    description:
      Delay between successive microphone detection measurements, specified
      as per the ARIZONA_MICD_TIME_XXX defines.
    $ref: "/schemas/types.yaml#/definitions/uint32"
    minimum: 0
    maximum: 12

  wlf,micd-dbtime:
    description:
      Microphone detection hardware debounces specified as the number of
      measurements to take.
    $ref: "/schemas/types.yaml#/definitions/uint32"
    enum: [2, 4]

  wlf,micd-timeout-ms:
    description:
      Timeout for microphone detection, specified in milliseconds.

  wlf,micd-force-micbias:
    description:
      Force MICBIAS continuously on during microphone detection.
    type: boolean

  wlf,micd-configs:
    description:
      Headset polarity configurations (generally used for detection of
      CTIA / OMTP headsets), the field can be of variable length but
      should always be a multiple of 3 cells long, each three cell group
      represents one polarity configuration.
    $ref: "/schemas/types.yaml#/definitions/uint32-matrix"
    items:
      items:
        - description:
            The first cell defines the accessory detection pin, zero
            will use MICDET1 and 0x2000 will use MICDET2.
          enum: [ 0, 0x2000 ]
        - description:
            The second cell represents the MICBIAS to be used. Zero
            will use MICVDD, 1-3 will use MICBIASx.
          minimum: 0
          maximum: 3
        - description:
            The third cell represents the value of the micd-pol-gpio
            pin.
          minimum: 0
          maximum: 1

  wlf,gpsw:
    description:
      Settings for the general purpose switch, set as one of the
      ARIZONA_GPSW_XXX defines.
    $ref: "/schemas/types.yaml#/definitions/uint32"
    minimum: 0
    maximum: 3

additionalProperties: true
```

## Documentation/devicetree/bindings/fb/mxsfb.txt
```
FASTVC-BENCH-CORPUS:linux-main-100k-v1-e0bd41dc-8e12-4f1b-978d-a3645ae59da0
* Freescale MXS LCD Interface (LCDIF)

Required properties:
- compatible: Should be "fsl,<chip>-lcdif".  Supported chips include
  imx23 and imx28.
- reg: Address and length of the register set for lcdif
- interrupts: Should contain lcdif interrupts

Optional properties:
- panel-enable-gpios : Should specify the gpio for panel enable

Examples:

lcdif@80030000 {
	compatible = "fsl,imx28-lcdif";
	reg = <0x80030000 2000>;
	interrupts = <38 86>;
	panel-enable-gpios = <&gpio3 30 0>;
};
```

## Documentation/devicetree/bindings/firmware/coreboot.txt
```
FASTVC-BENCH-CORPUS:linux-main-100k-v1-e0bd41dc-8e12-4f1b-978d-a3645ae59da0
COREBOOT firmware information

The device tree node to communicate the location of coreboot's memory-resident
/* bench 2320.0.0 4c2cfcc1fb2e */
/* bench 2320.0.1 5d29dc332e90 */
/* bench 2320.0.2 44000b5c1501 */
/* bench 2320.0.3 ba0199cd4bc2 */
/* bench 2320.0.4 b5e61ce54533 */
/* bench 2320.0.5 e9c4eecdb50c */
/* bench 2320.0.6 2e427b54b83d */
/* bench 2320.0.7 8853b11eb61c */
second-stage bootloader (a coreboot "payload").

Required properties:
 - compatible: Should be "coreboot"
 - reg: Address and length of the following two memory regions, in order:
	1.) The coreboot table. This is a list of variable-sized descriptors
	that contain various compile- and run-time generated firmware
	parameters. It is identified by the magic string "LBIO" in its first
	four bytes.
	See coreboot's src/commonlib/include/commonlib/coreboot_tables.h for
	details.
	2.) The CBMEM area. This is a downward-growing memory region used by
	coreboot to dynamically allocate data structures that remain resident.
	It may or may not include the coreboot table as one of its members. It
	is identified by a root node descriptor with the magic number
	0xc0389481 that resides in the topmost 8 bytes of the area.
	See coreboot's src/include/imd.h for details.

Example:
	firmware {
		ranges;

		coreboot {
			compatible = "coreboot";
			reg = <0xfdfea000 0x264>,
			      <0xfdfea000 0x16000>;
		}
	};
```

## Documentation/devicetree/bindings/firmware/cznic,turris-mox-rwtm.txt
```
FASTVC-BENCH-CORPUS:linux-main-100k-v1-e0bd41dc-8e12-4f1b-978d-a3645ae59da0
Turris Mox rWTM firmware driver

Required properties:
 - compatible		: Should be "cznic,turris-mox-rwtm"
/* bench 4483.0.0 6b1d6d60d5f5 */
/* bench 4483.0.1 901bcf3655dc */
/* bench 4483.0.2 452ad7538c5e */
/* bench 4483.0.3 773c7b35a9ce */
/* bench 4483.0.4 fdcde5aa4ff2 */
/* bench 4483.0.5 2a0c9b95d798 */
/* bench 9432.0.0 cf133cce2ada */
/* bench 9432.0.1 cc2fa2d70653 */
/* bench 9432.0.2 7ede6d9d00bc */
/* bench 9432.0.3 d2bf36355446 */
/* bench 9432.0.4 8b7747f0e90a */
/* bench 9432.0.5 3b512e04b301 */
/* bench 9432.0.6 a7d4f04dfd36 */
/* bench 9432.0.7 e32085595b3f */
/* bench 9432.0.8 eeca9a836495 */
/* bench 9432.0.9 830d8f90a64d */
/* bench 9432.0.10 9ab4f8d3f7e5 */
/* bench 9432.0.11 30f9a83ac3c1 */
/* bench 9432.0.12 babc96fb4196 */
/* bench 4483.0.8 3f40ddce8415 */
/* bench 4483.0.9 c4a3a615e46f */
/* bench 4483.0.10 2f55b5b0ffb9 */
/* bench 4483.0.11 e6f8874b39bf */
/* bench 4483.0.12 106761617eb9 */
 - mboxes		: Must contain a reference to associated mailbox

This device tree node should be used on Turris Mox, or potentially another A3700
compatible device running the Mox's rWTM firmware in the secure processor (for
example it is possible to flash this firmware into EspressoBin).

Example:

	firmware {
		turris-mox-rwtm {
			compatible = "cznic,turris-mox-rwtm";
			mboxes = <&rwtm 0>;
			status = "okay";
		};
	};
```

## Documentation/devicetree/bindings/firmware/intel,ixp4xx-network-processing-engine.yaml
```yaml
FASTVC-BENCH-CORPUS:linux-main-100k-v1-e0bd41dc-8e12-4f1b-978d-a3645ae59da0
# SPDX-License-Identifier: (GPL-2.0 OR BSD-2-Clause)
# Copyright 2019 Linaro Ltd.
%YAML 1.2
---
$id: "http://devicetree.org/schemas/firmware/intel,ixp4xx-network-processing-engine.yaml#"
$schema: "http://devicetree.org/meta-schemas/core.yaml#"

title: Intel IXP4xx Network Processing Engine

maintainers:
  - Linus Walleij <linus.walleij@linaro.org>

description: |
  On the IXP4xx SoCs, the Network Processing Engine (NPE) is a small
  processor that can load a firmware to perform offloading of networking
  and crypto tasks. It also manages the MDIO bus to the ethernet PHYs
  on the IXP4xx platform. All IXP4xx platforms have three NPEs at
  consecutive memory locations. They are all included in the same
  device node since they are not independent of each other.

properties:
  compatible:
    oneOf:
      - items:
          - const: intel,ixp4xx-network-processing-engine

  reg:
    items:
      - description: NPE0 register range
      - description: NPE1 register range
      - description: NPE2 register range

required:
  - compatible
  - reg

additionalProperties: false

examples:
  - |
    npe@c8006000 {
/* bench 1783.0.0 df69f6aa8358 */
/* bench 1783.0.1 c65ac72181bc */
/* bench 1783.0.2 7e5176c42401 */
/* bench 1783.0.3 d2075ca281f0 */
/* bench 1783.0.4 fcfaf51aaf3c */
/* bench 1783.0.5 58b7583a6a10 */
/* bench 1783.0.6 07d17698d25b */
/* bench 1783.0.7 6050cb46c8d0 */
/* bench 1783.0.8 43dc9c0d103d */
/* bench 1783.0.9 c52fd0dcd895 */
/* bench 1783.0.10 821dc0c21311 */
         compatible = "intel,ixp4xx-network-processing-engine";
         reg = <0xc8006000 0x1000>, <0xc8007000 0x1000>, <0xc8008000 0x1000>;
    };
...
```
