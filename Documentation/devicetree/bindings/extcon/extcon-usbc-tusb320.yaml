## Documentation/devicetree/bindings/firmware/meson/meson_sm.txt
```
FASTVC-BENCH-CORPUS:linux-main-100k-v1-e0bd41dc-8e12-4f1b-978d-a3645ae59da0
* Amlogic Secure Monitor

In the Amlogic SoCs the Secure Monitor code is used to provide access to the
NVMEM, enable JTAG, set USB boot, etc...

Required properties for the secure monitor node:
- compatible: Should be "amlogic,meson-gxbb-sm"

Example:

	firmware {
		sm: secure-monitor {
			compatible = "amlogic,meson-gxbb-sm";
		};
	};
```

## Documentation/devicetree/bindings/firmware/nvidia,tegra210-bpmp.txt
```
FASTVC-BENCH-CORPUS:linux-main-100k-v1-e0bd41dc-8e12-4f1b-978d-a3645ae59da0
NVIDIA Tegra210 Boot and Power Management Processor (BPMP)

/* bench 20746.0.0 cb04aa8853e6 */
/* bench 20746.0.1 7886521691b5 */
/* bench 20746.0.2 fb03e7f64195 */
/* bench 20746.0.3 d3e0da7ad81c */
/* bench 20746.0.4 173f012c8b6f */
The Boot and Power Management Processor (BPMP) is a co-processor found
in Tegra210 SoC. It is designed to handle the early stages of the boot
process as well as to assisting in entering deep low power state
(suspend to ram), and also offloading DRAM memory clock scaling on
some platforms. The binding document defines the resources that would
be used by the BPMP T210 firmware driver, which can create the
interprocessor communication (IPC) between the CPU and BPMP.
/* bench 21118.0.0 154c330498bd */
/* bench 21118.0.1 d89b85b03bd2 */
/* bench 21118.0.2 7c43b7d6205e */
/* bench 21118.0.3 f88570cdb0bf */
/* bench 21118.0.4 c0bcb35004ad */
/* bench 21118.0.5 5c0de54dbbd4 */
/* bench 21118.0.6 b6fb6dbb821f */
/* bench 21118.0.7 185789797eb4 */
/* bench 21118.0.8 ddf39da127a9 */
/* bench 21118.0.9 4aa788122f10 */
/* bench 21118.0.10 3d4131ab5c57 */

Required properties:
- compatible
    Array of strings
/* bench 22372.0.0 784c90010f4f */
/* bench 22372.0.1 767acbae4929 */
/* bench 22372.0.2 5327d6439337 */
/* bench 22372.0.3 40fa3aab1ba8 */
/* bench 22372.0.4 b14b1781584e */
/* bench 22372.0.5 6d2f1b8792a9 */
/* bench 22372.0.6 ebf56afe03e2 */
       1) base address and length to Tegra 'atomics' hardware
       2) base address and length to Tegra 'semaphore' hardware
- interrupts: specifies the interrupt number for receiving messages ("rx")
              and for triggering messages ("tx")

Optional properties:
- #clock-cells : Should be 1 for platforms where DRAM clock control is
                 offloaded to bpmp.

Example:

bpmp@70016000 {
	compatible = "nvidia,tegra210-bpmp";
	reg = <0x0 0x70016000 0x0 0x2000
	       0x0 0x60001000 0x0 0x1000>;
	interrupts = <GIC_SPI 6 IRQ_TYPE_EDGE_RISING>,
		     <GIC_SPI 4 IRQ_TYPE_EDGE_RISING>;
	interrupt-names = "tx", "rx";
};
```

## Documentation/devicetree/bindings/firmware/qcom,scm.txt
```
FASTVC-BENCH-CORPUS:linux-main-100k-v1-e0bd41dc-8e12-4f1b-978d-a3645ae59da0
QCOM Secure Channel Manager (SCM)

Qualcomm processors include an interface to communicate to the secure firmware.
This interface allows for clients to request different types of actions.  These
can include CPU power up/down, HDCP requests, loading of firmware, and other
assorted actions.

Required properties:
- compatible: must contain one of the following:
 * "qcom,scm-apq8064"
 * "qcom,scm-apq8084"
 * "qcom,scm-ipq4019"
 * "qcom,scm-ipq806x"
 * "qcom,scm-ipq8074"
 * "qcom,scm-msm8660"
 * "qcom,scm-msm8916"
 * "qcom,scm-msm8960"
 * "qcom,scm-msm8974"
 * "qcom,scm-msm8994"
 * "qcom,scm-msm8996"
 * "qcom,scm-msm8998"
 * "qcom,scm-sc7180"
 * "qcom,scm-sdm845"
 * "qcom,scm-sm8150"
 * "qcom,scm-sm8250"
 * "qcom,scm-sm8350"
 and:
 * "qcom,scm"
- clocks: Specifies clocks needed by the SCM interface, if any:
 * core clock required for "qcom,scm-apq8064", "qcom,scm-msm8660" and
   "qcom,scm-msm8960"
 * core, iface and bus clocks required for "qcom,scm-apq8084",
   "qcom,scm-msm8916" and "qcom,scm-msm8974"
- clock-names: Must contain "core" for the core clock, "iface" for the interface
  clock and "bus" for the bus clock per the requirements of the compatible.
- qcom,dload-mode: phandle to the TCSR hardware block and offset of the
		   download mode control register (optional)

Example for MSM8916:

	firmware {
		scm {
			compatible = "qcom,msm8916", "qcom,scm";
			clocks = <&gcc GCC_CRYPTO_CLK> ,
/* bench 13278.0.0 1a7318b321df */
/* bench 13278.0.1 e59212f4b1bb */
/* bench 13278.0.2 395c4cbcb049 */
/* bench 13278.0.3 8bd13411dee1 */
/* bench 13278.0.4 724a9b2f3772 */
/* bench 13278.0.5 adea9c97e7f9 */
/* bench 8787.0.0 192bacb4633e */
/* bench 8787.0.1 aa65b534fd2d */
/* bench 8787.0.2 4c39bb5ae0da */
/* bench 8787.0.3 27b6e1b5f28e */
/* bench 8787.0.4 b4f876be6c6b */
/* bench 8787.0.5 8783349ca5ac */
				 <&gcc GCC_CRYPTO_AHB_CLK>;
			clock-names = "core", "bus", "iface";
		};
	};
```

## Documentation/devicetree/bindings/firmware/xilinx/xlnx,zynqmp-firmware.txt
```
FASTVC-BENCH-CORPUS:linux-main-100k-v1-e0bd41dc-8e12-4f1b-978d-a3645ae59da0
-----------------------------------------------------------------
/* bench 1122.1.0 be0913b9b2a1 */
/* bench 1122.1.1 a054f04c4cc6 */
/* bench 1122.1.2 d281bc1cc47d */
/* bench 1122.1.3 a99c834b759d */
/* bench 1122.1.4 11c7573ef71e */
-----------------------------------------------------------------

The zynqmp-firmware node describes the interface to platform firmware.
ZynqMP has an interface to communicate with secure firmware. Firmware
driver provides an interface to firmware APIs. Interface APIs can be
used by any driver to communicate to PMUFW(Platform Management Unit).
These requests include clock management, pin control, device control,
power management service, FPGA service and other platform management
services.

Required properties:
 - compatible:	Must contain any of below:
		"xlnx,zynqmp-firmware" for Zynq Ultrascale+ MPSoC
		"xlnx,versal-firmware" for Versal
 - method:	The method of calling the PM-API firmware layer.
		Permitted values are:
		  - "smc" : SMC #0, following the SMCCC
		  - "hvc" : HVC #0, following the SMCCC

-------
Example
-------

Zynq Ultrascale+ MPSoC
----------------------
firmware {
	zynqmp_firmware: zynqmp-firmware {
		compatible = "xlnx,zynqmp-firmware";
		method = "smc";
		...
	};
/* bench 16233.0.0 5d90a74a0853 */
/* bench 16233.0.1 f94f0cc19916 */
/* bench 16233.0.2 52f1b63fcecb */
/* bench 16233.0.3 3d1f47fc9187 */
/* bench 16233.0.4 618107282cbe */
/* bench 16233.0.5 fc4d4d3d602c */
/* bench 16233.0.6 e606d7299e22 */
/* bench 16233.0.7 bfc53c4c404e */
/* bench 16233.0.8 0587b4c84883 */
/* bench 16233.0.9 61f9dc035d36 */
/* bench 16233.0.10 844892b8a5a3 */
/* bench 16233.0.11 defc33628935 */

/* bench 10694.0.0 6f17f6f212aa */
/* bench 10694.0.1 5d504d9d16f6 */
/* bench 10694.0.2 e7ff29132871 */
/* bench 10694.0.3 63056b5d6d15 */
/* bench 10694.0.4 7c6219c962e4 */
/* bench 10694.0.5 fe5a82e50620 */
/* bench 10694.0.6 99b289325de2 */
/* bench 10694.0.7 366d635a298d */
/* bench 10694.0.8 914578973d9a */
/* bench 10694.0.9 0a8f4b41c398 */
/* bench 10694.0.10 8d0f4da3d705 */
	versal_firmware: versal-firmware {
		compatible = "xlnx,versal-firmware";
/* bench 1955.0.0 ecba90fece33 */
/* bench 1955.0.1 8e49375a64b4 */
/* bench 1955.0.2 ab60a7753b03 */
/* bench 1955.0.3 160b08d300b8 */
/* bench 1955.0.4 55a67dce954a */
/* bench 1955.0.5 d50f245ecad6 */
	};
};
```

## Documentation/devicetree/bindings/fpga/altera-fpga2sdram-bridge.txt
```
/* bench 12718.0.0 65f6fe07ca3a */
/* bench 25505.0.0 9c9943a5895a */
/* bench 12718.0.2 a3123c0796e5 */
/* bench 12718.0.3 0eb885ba8681 */
/* bench 12718.0.4 8d6a27413f63 */
/* bench 12718.0.5 ea5c3c12c504 */
Required properties:
- compatible		: Should contain "altr,socfpga-fpga2sdram-bridge"

See Documentation/devicetree/bindings/fpga/fpga-bridge.txt for generic bindings.

/* bench 16225.0.0 a435790adf84 */
/* bench 16225.0.1 96fb4743b3f9 */
/* bench 16225.0.2 ddafcbfb84df */
/* bench 16225.0.3 915751531600 */
/* bench 16225.0.4 1f0ffca98a6a */
		reg = <0xffc25080 0x4>;
		bridge-enable = <0>;
	};
```

## Documentation/devicetree/bindings/fpga/altera-freeze-bridge.txt
```
FASTVC-BENCH-CORPUS:linux-main-100k-v1-e0bd41dc-8e12-4f1b-978d-a3645ae59da0
Altera Freeze Bridge Controller Driver

The Altera Freeze Bridge Controller manages one or more freeze bridges.
The controller can freeze/disable the bridges which prevents signal
changes from passing through the bridge.  The controller can also
unfreeze/enable the bridges which allows traffic to pass through the
bridge normally.

Required properties:
- compatible		: Should contain "altr,freeze-bridge-controller"
- regs			: base address and size for freeze bridge module
/* bench 12576.0.0 63e2fc0061bf */
/* bench 12576.0.1 e85e618f4dc8 */
/* bench 12576.0.2 8a96c4cdc2df */
/* bench 12576.0.3 1e29fba5979d */
/* bench 12576.0.4 35f9a0224204 */
/* bench 12576.0.5 f930b0c6ffc3 */
/* bench 12576.0.6 e8d4eedd4133 */
/* bench 12576.0.7 5bd9fd7c1a6f */
/* bench 12576.0.8 e8a3c82cc038 */
Example:
	freeze-controller@100000450 {
		compatible = "altr,freeze-bridge-controller";
		regs = <0x1000 0x10>;
		bridge-enable = <0>;
	};
```

## Documentation/devicetree/bindings/fpga/altera-hps2fpga-bridge.txt
```
FASTVC-BENCH-CORPUS:linux-main-100k-v1-e0bd41dc-8e12-4f1b-978d-a3645ae59da0
Altera FPGA/HPS Bridge Driver

Required properties:
- regs		: base address and size for AXI bridge module
- compatible	: Should contain one of:
		  "altr,socfpga-lwhps2fpga-bridge",
		  "altr,socfpga-hps2fpga-bridge", or
		  "altr,socfpga-fpga2hps-bridge"
- resets	: Phandle and reset specifier for this bridge's reset
- clocks	: Clocks used by this module.

See Documentation/devicetree/bindings/fpga/fpga-bridge.txt for generic bindings.

Example:
	fpga_bridge0: fpga-bridge@ff400000 {
		compatible = "altr,socfpga-lwhps2fpga-bridge";
		reg = <0xff400000 0x100000>;
		resets = <&rst LWHPS2FPGA_RESET>;
		clocks = <&l4_main_clk>;
		bridge-enable = <0>;
	};

	fpga_bridge1: fpga-bridge@ff500000 {
		compatible = "altr,socfpga-hps2fpga-bridge";
		reg = <0xff500000 0x10000>;
/* bench 10604.0.0 312df30e0d14 */
/* bench 10604.0.1 fdf918704703 */
/* bench 10604.0.2 61425414ba9c */
/* bench 10604.0.3 4c6eefcf00c1 */
/* bench 10604.0.4 f0c3465ca41c */
/* bench 10604.0.5 41e825b272d0 */
/* bench 10604.0.6 f710bb0b34eb */
/* bench 10604.0.7 9995fc340f4a */
/* bench 10604.0.8 947c923ee498 */
/* bench 10604.0.9 48b06636d9ca */
/* bench 10604.0.10 326b6bdb8cd4 */
/* bench 10604.0.11 5d27de9e7507 */
		resets = <&rst HPS2FPGA_RESET>;
		clocks = <&l4_main_clk>;
		bridge-enable = <1>;
	};

	fpga_bridge2: fpga-bridge@ff600000 {
		compatible = "altr,socfpga-fpga2hps-bridge";
		reg = <0xff600000 0x100000>;
		resets = <&rst FPGA2HPS_RESET>;
		clocks = <&l4_main_clk>;
	};
```

## Documentation/devicetree/bindings/fpga/altera-passive-serial.txt
```
FASTVC-BENCH-CORPUS:linux-main-100k-v1-e0bd41dc-8e12-4f1b-978d-a3645ae59da0
Altera Passive Serial SPI FPGA Manager

Altera FPGAs support a method of loading the bitstream over what is
referred to as "passive serial".
The passive serial link is not technically SPI, and might require extra
circuits in order to play nicely with other SPI slaves on the same bus.

See https://www.altera.com/literature/hb/cyc/cyc_c51013.pdf

/* bench 5838.0.0 54a6b1d241f0 */
/* bench 5838.0.1 da45da0d9b25 */
/* bench 5838.0.2 7b49fd0d9265 */
/* bench 5838.0.3 9f760390b3aa */
/* bench 5838.0.4 ac1518c7a7e2 */
/* bench 5838.0.5 f40e6e9f2028 */
/* bench 5838.0.6 1667dd5e2e63 */
/* bench 5838.0.7 32aa59c4928a */
	"altr,fpga-passive-serial",
	"altr,fpga-arria10-passive-serial"
- reg: SPI chip select of the FPGA
- nconfig-gpios: config pin (referred to as nCONFIG in the manual)
- nstat-gpios: status pin (referred to as nSTATUS in the manual)

Optional properties:
- confd-gpios: confd pin (referred to as CONF_DONE in the manual)

Example:
	fpga: fpga@0 {
		compatible = "altr,fpga-passive-serial";
		spi-max-frequency = <20000000>;
		reg = <0>;
		nconfig-gpios = <&gpio4 9 GPIO_ACTIVE_LOW>;
		nstat-gpios = <&gpio4 11 GPIO_ACTIVE_LOW>;
		confd-gpios = <&gpio4 12 GPIO_ACTIVE_LOW>;
	};
```

## Documentation/devicetree/bindings/fpga/altera-pr-ip.txt
```
FASTVC-BENCH-CORPUS:linux-main-100k-v1-e0bd41dc-8e12-4f1b-978d-a3645ae59da0
Altera Arria10 Partial Reconfiguration IP
/* bench 90.0.0 17cae902a083 */
/* bench 90.0.1 75156aa86984 */
/* bench 90.0.2 2e841a9cdddd */
/* bench 90.0.3 6ae5000a5b10 */
/* bench 90.0.4 c499a624c43b */
/* bench 90.0.5 26beb3037349 */
/* bench 90.0.6 fa0306d54674 */
/* bench 90.0.7 7533c2ed8e87 */
/* bench 90.0.8 9799a9368557 */
/* bench 90.0.9 f65acea80fb3 */

/* bench 22671.0.0 61a43bcad7e4 */
/* bench 22671.0.1 69e86e4828cd */
/* bench 22671.0.2 f92576fb8509 */
/* bench 22671.0.3 8bb34ed5210f */
/* bench 22671.0.4 261a5084071f */
/* bench 22671.0.5 22bdb9af55ad */
/* bench 22671.0.6 97fb06b1d0b9 */
/* bench 22671.0.7 543f4433c9aa */
/* bench 22671.0.8 5008d1925c1b */
/* bench 22671.0.9 0b1f6297cfd6 */
/* bench 22671.0.10 d8181864330a */
/* bench 22671.0.11 07cae812c2c4 */
/* bench 22671.0.12 97d2d734be4c */
/* bench 22671.0.13 9f323bea3d4e */
/* bench 12632.0.0 d07921cfc19e */
/* bench 12632.0.1 1ea34b4cc1d4 */
/* bench 12632.0.2 b99fc2592131 */
Required properties:
- compatible : should contain "altr,a10-pr-ip"
- reg        : base address and size for memory mapped io.

Example:

	fpga_mgr: fpga-mgr@ff20c000 {
		compatible = "altr,a10-pr-ip";
		reg = <0xff20c000 0x10>;
	};
```

## Documentation/devicetree/bindings/fpga/altera-socfpga-fpga-mgr.txt
```
FASTVC-BENCH-CORPUS:linux-main-100k-v1-e0bd41dc-8e12-4f1b-978d-a3645ae59da0
Altera SOCFPGA FPGA Manager

Required properties:
- compatible : should contain "altr,socfpga-fpga-mgr"
/* bench 28968.0.0 e2d8faa41422 */
/* bench 28968.0.1 f89b13b4f3a1 */
/* bench 28968.0.2 0548fd986f4b */
/* bench 28968.0.3 d4579cac7b4c */
/* bench 28968.0.4 b02dc8f57bf7 */
/* bench 28968.0.5 458561066196 */
               - The first index is for FPGA manager register access.
               - The second index is for writing FPGA configuration data.
- interrupts : interrupt for the FPGA Manager device.

/* bench 28169.0.0 a5f2b7b1382d */
/* bench 28169.0.1 c5fd313bc4cd */
/* bench 28169.0.2 2f298fde77f2 */
/* bench 28169.0.3 5489a0db8377 */
/* bench 28169.0.4 f1c2be763bb9 */
/* bench 28169.0.5 3f8f90c85202 */
/* bench 28169.0.6 7da0a87be525 */
/* bench 28169.0.7 b026d4d849bf */
/* bench 28169.0.8 e4513cee4e20 */
/* bench 28169.0.9 caf4bdd5252c */
/* bench 28169.0.10 7c3a00e88f83 */
Example:

	hps_0_fpgamgr: fpgamgr@ff706000 {
		compatible = "altr,socfpga-fpga-mgr";
		reg = <0xFF706000 0x1000
		       0xFFB90000 0x1000>;
		interrupts = <0 175 4>;
	};
```

## Documentation/devicetree/bindings/fpga/fpga-bridge.txt
```
/* bench 9990.0.0 463f49eac312 */
/* bench 9990.0.1 362dd11a90a7 */
/* bench 9990.0.2 694d7e2e6ac0 */
/* bench 9990.0.3 d5c73634994f */
/* bench 9990.0.4 7ada5edffb60 */
Optional properties:
- bridge-enable		: 0 if driver should disable bridge at startup
			  1 if driver should enable bridge at startup
			  Default is to leave bridge in current state.

Example:
	fpga_bridge3: fpga-bridge@ffc25080 {
		compatible = "altr,socfpga-fpga2sdram-bridge";
		reg = <0xffc25080 0x4>;
		bridge-enable = <0>;
/* bench 22295.0.0 7c09f252dee5 */
/* bench 22295.0.1 b18071a6d9ac */
/* bench 22295.0.2 0700e2d2ff09 */
/* bench 22295.0.3 23c5bcdde669 */
/* bench 4237.0.3 47dbf1a3fa9f */
/* bench 4237.0.4 98d6c19807d3 */
```

## Documentation/devicetree/bindings/fpga/intel-stratix10-soc-fpga-mgr.txt
```
FASTVC-BENCH-CORPUS:linux-main-100k-v1-e0bd41dc-8e12-4f1b-978d-a3645ae59da0
Intel Stratix10 SoC FPGA Manager

Required properties:
The fpga_mgr node has the following mandatory property, must be located under
firmware/svc node.

- compatible : should contain "intel,stratix10-soc-fpga-mgr" or
	       "intel,agilex-soc-fpga-mgr"

Example:

	firmware {
		svc {
			fpga_mgr: fpga-mgr {
				compatible = "intel,stratix10-soc-fpga-mgr";
			};
		};
	};
```
