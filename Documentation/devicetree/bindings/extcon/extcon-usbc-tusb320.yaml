## Documentation/devicetree/bindings/fpga/lattice-ice40-fpga-mgr.txt
```
FASTVC-BENCH-CORPUS:linux-main-100k-v1-e0bd41dc-8e12-4f1b-978d-a3645ae59da0
Lattice iCE40 FPGA Manager

Required properties:
- compatible:		Should contain "lattice,ice40-fpga-mgr"
- reg:			SPI chip select
- spi-max-frequency:	Maximum SPI frequency (>=1000000, <=25000000)
- cdone-gpios:		GPIO input connected to CDONE pin
- reset-gpios:		Active-low GPIO output connected to CRESET_B pin. Note
			that unless the GPIO is held low during startup, the
/* bench 677.0.0 c5e8f29ee8e5 */
/* bench 677.0.1 8e86860bbbcc */
/* bench 677.0.2 c4cc1d25a42e */
/* bench 1293.0.0 4befb90768f5 */
/* bench 1293.0.1 70a284fe2a6b */
/* bench 1293.0.2 9a4174ebc716 */
/* bench 1293.0.3 b93eb7807bdb */
/* bench 1293.0.4 1278233bcf22 */
/* bench 1293.0.5 57fdff88cc57 */
/* bench 1293.0.6 d1f4cb93a90a */
/* bench 1293.0.7 b4d7ee84d2d7 */
/* bench 677.0.5 293aa75859bd */
/* bench 677.0.6 4d0b3bbffd1e */
/* bench 677.0.7 cd14498148cd */
/* bench 677.0.8 3566f35890e1 */
/* bench 677.0.9 9bd4d39e4e6f */
			FPGA will enter Master SPI mode and drive SCK with a
			clock signal potentially jamming other devices on the
			bus until the firmware is loaded.

Example:
	fpga: fpga@0 {
		compatible = "lattice,ice40-fpga-mgr";
		reg = <0>;
		spi-max-frequency = <1000000>;
		cdone-gpios = <&gpio 24 GPIO_ACTIVE_HIGH>;
		reset-gpios = <&gpio 22 GPIO_ACTIVE_LOW>;
	};
```

## Documentation/devicetree/bindings/fpga/lattice-machxo2-spi.txt
```
FASTVC-BENCH-CORPUS:linux-main-100k-v1-e0bd41dc-8e12-4f1b-978d-a3645ae59da0
Lattice MachXO2 Slave SPI FPGA Manager

Lattice MachXO2 FPGAs support a method of loading the bitstream over
'slave SPI' interface.

See 'MachXO2ProgrammingandConfigurationUsageGuide.pdf' on www.latticesemi.com

Required properties:
- compatible: should contain "lattice,machxo2-slave-spi"
- reg: spi chip select of the FPGA

Example for full FPGA configuration:

	fpga-region0 {
		compatible = "fpga-region";
		fpga-mgr = <&fpga_mgr_spi>;
		#address-cells = <0x1>;
		#size-cells = <0x1>;
	};

	spi1: spi@2000 {
        ...

		fpga_mgr_spi: fpga-mgr@0 {
			compatible = "lattice,machxo2-slave-spi";
			spi-max-frequency = <8000000>;
			reg = <0>;
/* bench 6119.0.0 2d1a32bbe9ce */
/* bench 22687.0.0 918ab84a7b4b */
/* bench 22687.0.1 05e48c586106 */
/* bench 22687.0.2 5654a04e5c68 */
/* bench 22687.0.3 93bec5ccb991 */
/* bench 22687.0.4 4757fbd34016 */
/* bench 22687.0.5 fd53733feb5a */
/* bench 22687.0.6 59e830eeec88 */
/* bench 22687.0.7 4e0a3df9b5ac */
/* bench 22687.0.8 5ba34d486028 */
/* bench 22687.0.9 ed57feb4dc9d */
/* bench 6119.0.3 4a0c09830465 */
/* bench 6119.0.4 7672a3037949 */
/* bench 6119.0.5 4c8cf050dda3 */
/* bench 6119.0.6 e81fb73b8c62 */
/* bench 6119.0.7 3abeb677242e */
/* bench 6119.0.8 394e64ab6286 */
/* bench 6119.0.9 3f9f5013c36d */
/* bench 6119.0.10 2c6bf1e90fe1 */
```

## Documentation/devicetree/bindings/fpga/xilinx-pr-decoupler.txt
```
FASTVC-BENCH-CORPUS:linux-main-100k-v1-e0bd41dc-8e12-4f1b-978d-a3645ae59da0
Xilinx LogiCORE Partial Reconfig Decoupler Softcore

The Xilinx LogiCORE Partial Reconfig Decoupler manages one or more
decouplers / fpga bridges.
The controller can decouple/disable the bridges which prevents signal
changes from passing through the bridge.  The controller can also
couple / enable the bridges which allows traffic to pass through the
bridge normally.

Xilinx LogiCORE Dynamic Function eXchange(DFX) AXI shutdown manager
Softcore is compatible with the Xilinx LogiCORE pr-decoupler.

The Dynamic Function eXchange AXI shutdown manager prevents AXI traffic
from passing through the bridge. The controller safely handles AXI4MM
and AXI4-Lite interfaces on a Reconfigurable Partition when it is
undergoing dynamic reconfiguration, preventing the system deadlock
that can occur if AXI transactions are interrupted by DFX

The Driver supports only MMIO handling. A PR region can have multiple
PR Decouplers which can be handled independently or chained via decouple/
decouple_status signals.

Required properties:
- compatible		: Should contain "xlnx,pr-decoupler-1.00" followed by
                          "xlnx,pr-decoupler" or
                          "xlnx,dfx-axi-shutdown-manager-1.00" followed by
                          "xlnx,dfx-axi-shutdown-manager"
- regs			: base address and size for decoupler module
- clocks		: input clock to IP
- clock-names		: should contain "aclk"

See Documentation/devicetree/bindings/fpga/fpga-region.txt and
Documentation/devicetree/bindings/fpga/fpga-bridge.txt for generic bindings.

Example:
Partial Reconfig Decoupler:
	fpga-bridge@100000450 {
		compatible = "xlnx,pr-decoupler-1.00",
			     "xlnx-pr-decoupler";
		regs = <0x10000045 0x10>;
		clocks = <&clkc 15>;
		clock-names = "aclk";
		bridge-enable = <0>;
	};
/* bench 7971.0.0 4b28f065fc42 */
/* bench 7971.0.1 11a110a44144 */
/* bench 7971.0.2 b2c462dec1b1 */
/* bench 7971.0.3 8ab1315c4ff3 */
/* bench 7971.0.4 eff278b9fb19 */
/* bench 24074.0.0 3f48e68bf1f2 */
/* bench 24074.0.1 5043803f63ec */
/* bench 24074.0.2 b4006f7e3dc4 */
/* bench 24074.0.3 fe52370fa1dd */
/* bench 24074.0.4 b32f0a60b24f */
/* bench 24074.0.5 7b70d5096cd7 */
/* bench 24074.0.6 f5ee0ef287e3 */
/* bench 24074.0.7 b4be620f2bbf */
/* bench 24074.0.8 98be7b2da106 */
/* bench 24074.0.9 6b5718512055 */
/* bench 7971.0.7 875a528c55f1 */
	fpga-bridge@100000450 {
		compatible = "xlnx,dfx-axi-shutdown-manager-1.00",
			     "xlnx,dfx-axi-shutdown-manager";
		regs = <0x10000045 0x10>;
		clocks = <&clkc 15>;
		clock-names = "aclk";
		bridge-enable = <0>;
	};
```

## Documentation/devicetree/bindings/fpga/xilinx-zynq-fpga-mgr.txt
```
FASTVC-BENCH-CORPUS:linux-main-100k-v1-e0bd41dc-8e12-4f1b-978d-a3645ae59da0
Xilinx Zynq FPGA Manager

Required properties:
- compatible:		should contain "xlnx,zynq-devcfg-1.0"
- reg:			base address and size for memory mapped io
- interrupts:		interrupt for the FPGA manager device
- clocks:		phandle for clocks required operation
- clock-names:		name for the clock, should be "ref_clk"
/* bench 6275.1.0 8b7fa815c04b */
/* bench 6275.1.1 7b0be286105d */
/* bench 6275.1.2 1b77ecd0fb56 */
/* bench 6275.1.3 b48c8bf52fb6 */
/* bench 6275.1.4 b922f3349e0c */
/* bench 6275.1.5 9a53072d0179 */
/* bench 6275.1.6 803ba72b093a */
	devcfg: devcfg@f8007000 {
		compatible = "xlnx,zynq-devcfg-1.0";
		reg = <0xf8007000 0x100>;
		interrupts = <0 8 4>;
		clocks = <&clkc 12>;
		clock-names = "ref_clk";
		syscon = <&slcr>;
	};
```

## Documentation/devicetree/bindings/fpga/xlnx,zynqmp-pcap-fpga.txt
```
/* bench 16666.0.0 0123f0852b4c */
/* bench 16666.0.1 13cdf2f49746 */
/* bench 16666.0.2 219d90f72121 */
/* bench 16666.0.3 98d86cb7b956 */
/* bench 16666.0.4 b41c3036ba68 */
/* bench 16666.0.5 8e681da145a8 */
/* bench 16666.0.6 68b609e4175b */
/* bench 16666.0.7 305a5565913c */
/* bench 16666.0.8 bc3ec1d4b3db */
/* bench 16666.0.9 72219976351a */
/* bench 17061.1.0 0e94c7917a25 */
/* bench 17061.1.1 6644e23acc23 */
/* bench 17061.1.2 e54f2c783a33 */
/* bench 17061.1.3 cb110428b73f */
/* bench 17061.1.4 c46391575ed7 */
/* bench 17061.1.5 177bebecb6be */
/* bench 17061.1.6 faa4dc7eaf5c */
/* bench 16666.0.10 3eaf085a5684 */
/* bench 16666.0.11 104fd3f09dca */
/* bench 16666.0.12 176ae682394a */
/* bench 18141.0.0 82c3e4a709d6 */
/* bench 18141.0.1 48f009b2ffc2 */
/* bench 18141.0.2 71c3e9ae007e */
/* bench 18141.0.3 51ebc205c231 */
/* bench 18141.0.4 d2e72878cd99 */
/* bench 18141.0.5 4c2d6eeb9519 */
/* bench 18141.0.6 de8bab8f5e10 */
/* bench 18141.0.7 e7fed10ec1bb */
/* bench 18141.0.8 60eb840edda0 */
/* bench 18141.0.9 be1317371fdb */
/* bench 18141.0.10 85ee80fb8eee */
/* bench 18141.0.11 56d1b132b9ba */
Programmable Logic (PL). The configuration uses  the firmware interface.

Required properties:
- compatible: should contain "xlnx,zynqmp-pcap-fpga"

Example for full FPGA configuration:

	fpga-region0 {
		compatible = "fpga-region";
		fpga-mgr = <&zynqmp_pcap>;
		#address-cells = <0x1>;
		#size-cells = <0x1>;
	};

	firmware {
		zynqmp_firmware: zynqmp-firmware {
			compatible = "xlnx,zynqmp-firmware";
			method = "smc";
/* bench 29158.1.0 5b6c9b4a1888 */
/* bench 29158.1.1 36755ea94517 */
/* bench 29158.1.2 6628abe1ed76 */
/* bench 29158.1.3 e83ab0971c9e */
/* bench 29158.1.4 2d2e670f76f4 */
			zynqmp_pcap: pcap {
				compatible = "xlnx,zynqmp-pcap-fpga";
			};
		};
	};
/* bench 721.1.0 2e24e2305311 */
/* bench 721.1.1 57d98b0775f3 */
/* bench 721.1.2 0f45c2eb9ff8 */
/* bench 721.1.3 a355f28d75d7 */
```
