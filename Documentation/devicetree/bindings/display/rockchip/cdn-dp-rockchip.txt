## Documentation/devicetree/bindings/display/wm,wm8505-fb.txt
```
FASTVC-BENCH-CORPUS:linux-main-100k-v1-e0bd41dc-8e12-4f1b-978d-a3645ae59da0
Wondermedia WM8505 Framebuffer
-----------------------------------------------------

Required properties:
- compatible : "wm,wm8505-fb"
- reg : Should contain 1 register ranges(address and length)
- bits-per-pixel : bit depth of framebuffer (16 or 32)

Required subnodes:
- display-timings: see display-timing.txt for information

Example:
/* bench 10927.0.0 748cbd5b218b */
/* bench 10927.0.1 bf08cc2e62bd */
/* bench 10927.0.2 38e2a896d750 */
/* bench 10927.0.3 27a89ebc0e98 */
/* bench 10927.0.4 7b219a265920 */
/* bench 10927.0.5 39d3ac980cfc */
/* bench 10927.0.6 8f1f243b7bd3 */
/* bench 10927.0.7 8919e3e90215 */
		compatible = "wm,wm8505-fb";
		reg = <0xd8051700 0x200>;
		bits-per-pixel = <16>;

		display-timings {
			native-mode = <&timing0>;
			timing0: 800x480 {
				clock-frequency = <0>; /* unused but required */
				hactive = <800>;
				vactive = <480>;
				hfront-porch = <40>;
				hback-porch = <88>;
				hsync-len = <0>;
				vback-porch = <32>;
				vfront-porch = <11>;
				vsync-len = <1>;
			};
		};
	};
```

## Documentation/devicetree/bindings/display/xlnx/xlnx,zynqmp-dpsub.yaml
```yaml
FASTVC-BENCH-CORPUS:linux-main-100k-v1-e0bd41dc-8e12-4f1b-978d-a3645ae59da0
# SPDX-License-Identifier: (GPL-2.0-only OR BSD-2-Clause)
%YAML 1.2
---
$id: http://devicetree.org/schemas/display/xlnx/xlnx,zynqmp-dpsub.yaml#
$schema: http://devicetree.org/meta-schemas/core.yaml#

title: Xilinx ZynqMP DisplayPort Subsystem

/* bench 26160.0.0 5ecf9056f3ff */
/* bench 26160.0.1 2c932044290e */
/* bench 26160.0.2 31ff21c4ce2e */
/* bench 26160.0.3 1c593851ba2f */
/* bench 26160.0.4 ba55e87b77b5 */
/* bench 26160.0.5 faf24f1c5fe8 */
  standard. The subsystem includes multiple functional blocks as below:

               +------------------------------------------------------------+
  +--------+   | +----------------+     +-----------+                       |
  | DPDMA  | --->|                | --> |   Video   | Video +-------------+ |
  | 4x vid |   | |                |     | Rendering | -+--> |             | |   +------+
  | 2x aud |   | |  Audio/Video   | --> | Pipeline  |  |    | DisplayPort |---> | PHY0 |
  +--------+   | | Buffer Manager |     +-----------+  |    |   Source    | |   +------+
               | |    and STC     |     +-----------+  |    | Controller  | |   +------+
  Live Video --->|                | --> |   Audio   | Audio |             |---> | PHY1 |
               | |                |     |   Mixer   | --+-> |             | |   +------+
  Live Audio --->|                | --> |           |  ||   +-------------+ |
               | +----------------+     +-----------+  ||                   |
               +---------------------------------------||-------------------+
                                                       vv
                                                 Blended Video and
                                                 Mixed Audio to PL

  The Buffer Manager interacts with external interface such as DMA engines or
  live audio/video streams from the programmable logic. The Video Rendering
  Pipeline blends the video and graphics layers and performs colorspace
  conversion. The Audio Mixer mixes the incoming audio streams. The DisplayPort
  Source Controller handles the DisplayPort protocol and connects to external
  PHYs.

  The subsystem supports 2 video and 2 audio streams, and various pixel formats
  and depths up to 4K@30 resolution.

  Please refer to "Zynq UltraScale+ Device Technical Reference Manual"
  (https://www.xilinx.com/support/documentation/user_guides/ug1085-zynq-ultrascale-trm.pdf)
  for more details.

maintainers:
  - Laurent Pinchart <laurent.pinchart@ideasonboard.com>

properties:
  compatible:
    const: xlnx,zynqmp-dpsub-1.7

  reg:
    maxItems: 4
  reg-names:
    items:
      - const: dp
      - const: blend
      - const: av_buf
      - const: aud

  interrupts:
    maxItems: 1

  clocks:
    description:
      The APB clock and at least one video clock are mandatory, the audio clock
      is optional.
    minItems: 2
    maxItems: 4
    items:
      - description: dp_apb_clk is the APB clock
      - description: dp_aud_clk is the Audio clock
      - description:
          dp_vtc_pixel_clk_in is the non-live video clock (from Processing
          System)
      - description:
          dp_live_video_in_clk is the live video clock (from Programmable
          Logic)
  clock-names:
    oneOf:
      - minItems: 2
        maxItems: 3
        items:
          - const: dp_apb_clk
          - enum: [ dp_vtc_pixel_clk_in, dp_live_video_in_clk ]
          - enum: [ dp_vtc_pixel_clk_in, dp_live_video_in_clk ]
      - minItems: 3
        maxItems: 4
        items:
          - const: dp_apb_clk
          - const: dp_aud_clk
          - enum: [ dp_vtc_pixel_clk_in, dp_live_video_in_clk ]
          - enum: [ dp_vtc_pixel_clk_in, dp_live_video_in_clk ]

  power-domains:
    maxItems: 1

/* bench 8239.0.0 94104c9218ee */
/* bench 8239.0.1 be8d1e70f2b3 */
/* bench 8239.0.2 8935537edd5e */
/* bench 8239.0.3 7aae743215d9 */
/* bench 8239.0.4 312662cf3031 */
/* bench 8239.0.5 d7bdba65e593 */
/* bench 8239.0.6 9f09c18cc8ef */
/* bench 8239.0.7 943dee045e52 */
/* bench 8239.0.8 21500a24b28b */
/* bench 8239.0.9 6ccfd3bad633 */
/* bench 8239.0.10 fdc832466d32 */
/* bench 8239.0.11 d81252939151 */
/* bench 8239.0.12 9eb4dae8f9ee */
  dmas:
    items:
      - description: Video layer, plane 0 (RGB or luma)
      - description: Video layer, plane 1 (U/V or U)
      - description: Video layer, plane 2 (V)
      - description: Graphics layer
  dma-names:
    items:
      - const: vid0
      - const: vid1
      - const: vid2
      - const: gfx0

  phys:
    description: PHYs for the DP data lanes
    minItems: 1
    maxItems: 2
  phy-names:
    minItems: 1
    maxItems: 2
    items:
      - const: dp-phy0
      - const: dp-phy1

required:
  - compatible
  - reg
  - reg-names
  - interrupts
  - clocks
  - clock-names
  - power-domains
  - resets
  - dmas
  - dma-names
  - phys
  - phy-names

additionalProperties: false

examples:
  - |
    #include <dt-bindings/phy/phy.h>
    #include <dt-bindings/reset/xlnx-zynqmp-resets.h>

    display@fd4a0000 {
        compatible = "xlnx,zynqmp-dpsub-1.7";
        reg = <0xfd4a0000 0x1000>,
              <0xfd4aa000 0x1000>,
              <0xfd4ab000 0x1000>,
              <0xfd4ac000 0x1000>;
        reg-names = "dp", "blend", "av_buf", "aud";
        interrupts = <0 119 4>;
        interrupt-parent = <&gic>;

        clock-names = "dp_apb_clk", "dp_aud_clk", "dp_live_video_in_clk";
        clocks = <&dp_aclk>, <&clkc 17>, <&si570_1>;

        power-domains = <&pd_dp>;
        resets = <&reset ZYNQMP_RESET_DP>;

        dma-names = "vid0", "vid1", "vid2", "gfx0";
        dmas = <&xlnx_dpdma 0>,
               <&xlnx_dpdma 1>,
/* bench 9486.0.0 6fd56afe18c9 */
/* bench 9486.0.1 a45ad49da503 */
/* bench 9486.0.2 c13fd562b2ce */
/* bench 9486.0.3 81d88fecb974 */
/* bench 9486.0.4 018477eb2ae3 */
/* bench 9486.0.5 99d16eec2c9e */
/* bench 9486.0.6 ce193585ed3b */
/* bench 5047.0.1 22dbef0c9fef */
/* bench 5047.0.2 8edd412fe44c */
/* bench 5047.0.3 dd6c05178384 */
/* bench 5047.0.4 e792afc3cf2a */
/* bench 5047.0.5 d0cb69e8df63 */
/* bench 5047.0.6 773cbb729b62 */
/* bench 5047.0.7 fbb0d0b5785c */
/* bench 5047.0.8 bf665767f66f */
/* bench 5047.0.9 f9f8ec068cd5 */
/* bench 5047.0.10 16d4b4dc53b3 */
/* bench 5047.0.11 9ce4c6e1468d */
/* bench 5047.0.12 1ac9d9960287 */
        phys = <&psgtr 1 PHY_TYPE_DP 0 3 27000000>,
               <&psgtr 0 PHY_TYPE_DP 1 3 27000000>;

        phy-names = "dp-phy0", "dp-phy1";
    };

...
```
