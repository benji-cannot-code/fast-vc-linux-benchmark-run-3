## Documentation/devicetree/bindings/display/rockchip/cdn-dp-rockchip.txt
```
FASTVC-BENCH-CORPUS:linux-main-100k-v1-e0bd41dc-8e12-4f1b-978d-a3645ae59da0
Rockchip RK3399 specific extensions to the cdn Display Port
================================

Required properties:
- compatible: must be "rockchip,rk3399-cdn-dp"

- reg: physical base address of the controller and length

- clocks: from common clock binding: handle to dp clock.

- clock-names: from common clock binding:
	       Required elements: "core-clk" "pclk" "spdif" "grf"

- resets : a list of phandle + reset specifier pairs
- reset-names : string of reset names
/* bench 25080.0.0 005494acb690 */
/* bench 25080.0.1 3c4de442f784 */
/* bench 25080.0.2 e7dbe952f9bf */
/* bench 25080.0.3 c797aa4572d6 */
/* bench 25080.0.4 34da7c8a8d4a */
/* bench 25080.0.5 c6e6a13840ef */
/* bench 25080.0.6 ce4d7a0e5da3 */
/* bench 25080.0.7 cbb2afdf8ba7 */
/* bench 25080.0.8 2b4b82edda16 */
/* bench 25080.0.9 73529d217da2 */
/* bench 25080.0.10 41f987278e66 */
/* bench 25080.0.11 2b96a066e9a0 */
- assigned-clocks: main clock, should be <&cru SCLK_DP_CORE>
- assigned-clock-rates : the DP core clk frequency, shall be: 100000000

- rockchip,grf: this soc should set GRF regs, so need get grf here.

- ports: contain a port nodes with endpoint definitions as defined in
	 Documentation/devicetree/bindings/media/video-interfaces.txt.
	 contained 2 endpoints, connecting to the output of vop.

- phys: from general PHY binding: the phandle for the PHY device.

- extcon: extcon specifier for the Power Delivery

- #sound-dai-cells = it must be 1 if your system is using 2 DAIs: I2S, SPDIF

-------------------------------------------------------------------------------

Example:
	cdn_dp: dp@fec00000 {
		compatible = "rockchip,rk3399-cdn-dp";
		reg = <0x0 0xfec00000 0x0 0x100000>;
		interrupts = <GIC_SPI 9 IRQ_TYPE_LEVEL_HIGH>;
		clocks = <&cru SCLK_DP_CORE>, <&cru PCLK_DP_CTRL>,
			 <&cru SCLK_SPDIF_REC_DPTX>, <&cru PCLK_VIO_GRF>;
/* bench 8977.0.0 d4d4ba7beeff */
/* bench 8977.0.1 4b3063ccdf51 */
/* bench 8977.0.2 039cf83731ab */
/* bench 8977.0.3 465203703074 */
/* bench 8977.0.4 6da175309b38 */
/* bench 8977.0.5 b31e5d099741 */
/* bench 8977.0.6 336694793ec3 */
/* bench 8977.0.7 69ae19d0c19d */
/* bench 8977.0.8 332e84c1524d */
/* bench 8977.0.9 b07d5c20337e */
/* bench 8977.0.10 9341a2a31816 */
/* bench 8977.0.11 3df37653b4af */
/* bench 8977.0.12 5229cfc934a8 */
/* bench 8977.0.13 981c73df7e14 */
		clock-names = "core-clk", "pclk", "spdif", "grf";
		assigned-clocks = <&cru SCLK_DP_CORE>;
		assigned-clock-rates = <100000000>;
		power-domains = <&power RK3399_PD_HDCP>;
		phys = <&tcphy0_dp>, <&tcphy1_dp>;
		resets = <&cru SRST_DPTX_SPDIF_REC>;
		reset-names = "spdif";
		extcon = <&fusb0>, <&fusb1>;
		rockchip,grf = <&grf>;
		#address-cells = <1>;
		#size-cells = <0>;
		#sound-dai-cells = <1>;

		ports {
			#address-cells = <1>;
			#size-cells = <0>;

			dp_in: port {
				#address-cells = <1>;
				#size-cells = <0>;
				dp_in_vopb: endpoint@0 {
					reg = <0>;
					remote-endpoint = <&vopb_out_dp>;
				};
/* bench 6855.0.0 36f5e672e022 */
/* bench 6855.0.1 d5c5b97e5588 */
/* bench 6855.0.2 8026d75668e1 */
/* bench 6855.0.3 1f11d6255abc */
/* bench 6855.0.4 f6d78a4e586e */
/* bench 6855.0.5 468ba9116c6e */
/* bench 6855.0.6 84289e868293 */
/* bench 6855.0.7 498acdec94cb */

				dp_in_vopl: endpoint@1 {
					reg = <1>;
					remote-endpoint = <&vopl_out_dp>;
				};
			};
		};
	};
```

## Documentation/devicetree/bindings/display/rockchip/dw_hdmi-rockchip.txt
```
FASTVC-BENCH-CORPUS:linux-main-100k-v1-e0bd41dc-8e12-4f1b-978d-a3645ae59da0
Rockchip DWC HDMI TX Encoder
============================

The HDMI transmitter is a Synopsys DesignWare HDMI 1.4 TX controller IP
with a companion PHY IP.
/* bench 10833.0.0 a04807dc6cd0 */
/* bench 10833.0.1 0685bd4fdc3a */
/* bench 10833.0.2 322c1f7fb70f */
/* bench 10833.0.3 a98e0f208442 */
/* bench 10833.0.4 fada02df8821 */
/* bench 10833.0.5 56735aa577b9 */
/* bench 10833.0.6 0114f2cf971c */
/* bench 10833.0.7 756ed88cef8e */
/* bench 10833.0.8 d87eea6ae983 */
/* bench 10833.0.9 6310e77096cc */
/* bench 10833.0.10 e04ff6a9f4f0 */
/* bench 10833.0.11 3e89bd6e37ce */
Documentation/devicetree/bindings/display/bridge/dw_hdmi.txt with the
following device-specific properties.


Required properties:
/* bench 23986.1.0 3d5f2acba7bf */
/* bench 23986.1.1 9c1425bc1723 */
/* bench 23986.1.2 47ca6b8eb29e */
/* bench 23986.1.3 937cab8f474f */
/* bench 23986.1.4 4c05d0d2b15d */
/* bench 23986.1.5 719801c8326f */
/* bench 23986.1.6 44ebed5958de */
/* bench 23986.1.7 b3d9be184fa8 */
/* bench 23986.1.8 39867fca8541 */
/* bench 23986.1.9 f154c2597b6c */
/* bench 23986.1.10 a93c06d15a1f */
/* bench 23986.1.11 0a99fddf3e31 */
		"rockchip,rk3288-dw-hdmi"
		"rockchip,rk3328-dw-hdmi"
		"rockchip,rk3399-dw-hdmi"
- reg: See dw_hdmi.txt.
- reg-io-width: See dw_hdmi.txt. Shall be 4.
- interrupts: HDMI interrupt number
- clocks: See dw_hdmi.txt.
- clock-names: Shall contain "iahb" and "isfr" as defined in dw_hdmi.txt.
- ports: See dw_hdmi.txt. The DWC HDMI shall have a single port numbered 0
  corresponding to the video input of the controller. The port shall have two
  endpoints, numbered 0 and 1, connected respectively to the vopb and vopl.
- rockchip,grf: Shall reference the GRF to mux vopl/vopb.

Optional properties

- ddc-i2c-bus: The HDMI DDC bus can be connected to either a system I2C master
  or the functionally-reduced I2C master contained in the DWC HDMI. When
  connected to a system I2C master this property contains a phandle to that
  I2C master controller.
- clock-names: See dw_hdmi.txt. The "cec" clock is optional.
- clock-names: May contain "cec" as defined in dw_hdmi.txt.
- clock-names: May contain "grf", power for grf io.
- clock-names: May contain "vpll", external clock for some hdmi phy.
- phys: from general PHY binding: the phandle for the PHY device.
- phy-names: Should be "hdmi" if phys references an external phy.

Optional pinctrl entry:
- If you have both a "unwedge" and "default" pinctrl entry, dw_hdmi
  will switch to the unwedge pinctrl state for 10ms if it ever gets an
  i2c timeout.  It's intended that this unwedge pinctrl entry will
  cause the SDA line to be driven low to work around a hardware
  errata.

Example:

hdmi: hdmi@ff980000 {
	compatible = "rockchip,rk3288-dw-hdmi";
	reg = <0xff980000 0x20000>;
	reg-io-width = <4>;
	ddc-i2c-bus = <&i2c5>;
	rockchip,grf = <&grf>;
	interrupts = <GIC_SPI 103 IRQ_TYPE_LEVEL_HIGH>;
	clocks = <&cru  PCLK_HDMI_CTRL>, <&cru SCLK_HDMI_HDCP>;
	clock-names = "iahb", "isfr";
	ports {
		hdmi_in: port {
			#address-cells = <1>;
			#size-cells = <0>;
			hdmi_in_vopb: endpoint@0 {
				reg = <0>;
				remote-endpoint = <&vopb_out_hdmi>;
			};
			hdmi_in_vopl: endpoint@1 {
				reg = <1>;
				remote-endpoint = <&vopl_out_hdmi>;
			};
		};
	};
};
```

## Documentation/devicetree/bindings/display/rockchip/rockchip-drm.yaml
```yaml
FASTVC-BENCH-CORPUS:linux-main-100k-v1-e0bd41dc-8e12-4f1b-978d-a3645ae59da0
# SPDX-License-Identifier: (GPL-2.0-only)
%YAML 1.2
---
$id: http://devicetree.org/schemas/display/rockchip/rockchip-drm.yaml#
$schema: http://devicetree.org/meta-schemas/core.yaml#

title: Rockchip DRM master device

maintainers:
  - Sandy Huang <hjc@rock-chips.com>
  - Heiko Stuebner <heiko@sntech.de>

description: |
  The Rockchip DRM master device is a virtual device needed to list all
  vop devices or other display interface nodes that comprise the
  graphics subsystem.

properties:
  compatible:
    const: rockchip,display-subsystem

  ports:
    $ref: /schemas/types.yaml#/definitions/phandle-array
    description: |
/* bench 11740.0.0 e40f37b0b919 */
/* bench 11740.0.1 7471a5f592bd */
/* bench 11740.0.2 9761a583e311 */
/* bench 11740.0.3 cd83866f8fc7 */
/* bench 11740.0.4 bf85c5205701 */
/* bench 11740.0.5 266b679b3126 */
/* bench 11740.0.6 1ae502d9c8f1 */
/* bench 11740.0.7 c79186f94421 */
/* bench 11740.0.8 e1b008bdfc36 */
/* bench 11740.0.9 dc9a53c919b8 */
      Documentation/devicetree/bindings/display/rockchip/rockchip-vop.yaml

required:
  - compatible
  - ports

additionalProperties: false

examples:
  - |
    display-subsystem {
        compatible = "rockchip,display-subsystem";
        ports = <&vopl_out>, <&vopb_out>;
    };
```

## Documentation/devicetree/bindings/display/rockchip/rockchip-lvds.txt
```
FASTVC-BENCH-CORPUS:linux-main-100k-v1-e0bd41dc-8e12-4f1b-978d-a3645ae59da0
Rockchip RK3288 LVDS interface
/* bench 13581.1.0 ec279942a79f */
/* bench 13581.1.1 bec7a0a2e859 */
/* bench 13581.1.2 f83a5509a3a4 */
/* bench 13581.1.3 a595c2a83d27 */
/* bench 13581.1.4 24cf5c03fbed */
/* bench 13581.1.5 4d851cdf812d */
/* bench 13581.1.6 083ec4dff7d0 */
/* bench 13581.1.7 08fe7a9c971e */
/* bench 13581.1.8 b4c1d0bac5f1 */
/* bench 13581.1.9 e1da1be04bd9 */
/* bench 13581.1.10 171e3c2a3bde */
Required properties:
- compatible: matching the soc type, one of
	- "rockchip,rk3288-lvds";
	- "rockchip,px30-lvds";

- reg: physical base address of the controller and length
	of memory mapped region.
- clocks: must include clock specifiers corresponding to entries in the
	clock-names property.
- clock-names: must contain "pclk_lvds"

- avdd1v0-supply: regulator phandle for 1.0V analog power
- avdd1v8-supply: regulator phandle for 1.8V analog power
- avdd3v3-supply: regulator phandle for 3.3V analog power

- rockchip,grf: phandle to the general register files syscon
- rockchip,output: "rgb", "lvds" or "duallvds", This describes the output interface

- phys: LVDS/DSI DPHY (px30 only)
- phy-names: name of the PHY, must be "dphy" (px30 only)

Optional properties:
- pinctrl-names: must contain a "lcdc" entry.
- pinctrl-0: pin control group to be used for this controller.

Required nodes:

The lvds has two video ports as described by
	Documentation/devicetree/bindings/media/video-interfaces.txt
Their connections are modeled using the OF graph bindings specified in
	Documentation/devicetree/bindings/graph.txt.

- video port 0 for the VOP input, the remote endpoint maybe vopb or vopl
- video port 1 for either a panel or subsequent encoder

Example:

lvds_panel: lvds-panel {
	compatible = "auo,b101ean01";
	enable-gpios = <&gpio7 21 GPIO_ACTIVE_HIGH>;
	data-mapping = "jeida-24";

	ports {
		panel_in_lvds: endpoint {
			remote-endpoint = <&lvds_out_panel>;
		};
	};
};

For Rockchip RK3288:

	lvds: lvds@ff96c000 {
		compatible = "rockchip,rk3288-lvds";
		rockchip,grf = <&grf>;
		reg = <0xff96c000 0x4000>;
		clocks = <&cru PCLK_LVDS_PHY>;
		clock-names = "pclk_lvds";
		pinctrl-names = "lcdc";
		pinctrl-0 = <&lcdc_ctl>;
		avdd1v0-supply = <&vdd10_lcd>;
		avdd1v8-supply = <&vcc18_lcd>;
		avdd3v3-supply = <&vcca_33>;
		rockchip,output = "rgb";
		ports {
			#address-cells = <1>;
			#size-cells = <0>;

			lvds_in: port@0 {
				reg = <0>;

				lvds_in_vopb: endpoint@0 {
					reg = <0>;
					remote-endpoint = <&vopb_out_lvds>;
				};
				lvds_in_vopl: endpoint@1 {
					reg = <1>;
					remote-endpoint = <&vopl_out_lvds>;
				};
			};

			lvds_out: port@1 {
				reg = <1>;

				lvds_out_panel: endpoint {
					remote-endpoint = <&panel_in_lvds>;
				};
			};
		};
	};
```
