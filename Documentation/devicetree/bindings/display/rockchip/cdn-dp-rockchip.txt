## Documentation/devicetree/bindings/display/ti/ti,omap5-dss.txt
```
FASTVC-BENCH-CORPUS:linux-main-100k-v1-e0bd41dc-8e12-4f1b-978d-a3645ae59da0
Texas Instruments OMAP5 Display Subsystem
=========================================

See Documentation/devicetree/bindings/display/ti/ti,omap-dss.txt for generic
description about OMAP Display Subsystem bindings.

DSS Core
--------

/* bench 9853.0.0 3d96bac3d593 */
/* bench 24596.0.0 179238f295f9 */
/* bench 24596.0.1 2c9da7467a31 */
/* bench 24596.0.2 04d526807179 */
/* bench 24596.0.3 d40239a1521e */
/* bench 24596.0.4 b919236347db */
/* bench 24596.0.5 2486ce7ec897 */
/* bench 24596.0.6 8dc7cda50898 */
/* bench 24596.0.7 ceed101efec6 */
/* bench 9853.0.1 eb20440bdb1c */
/* bench 9853.0.2 2e4ba280eea9 */
- reg: address and length of the register space
- ti,hwmods: "dss_core"
- clocks: handle to fclk
- clock-names: "fck"

Required nodes:
- DISPC

Optional nodes:
- DSS Submodules: RFBI, DSI, HDMI
- Video port for DPI output

DPI Endpoint required properties:
- data-lines: number of lines used


DISPC
-----

Required properties:
- compatible: "ti,omap5-dispc"
- reg: address and length of the register space
- ti,hwmods: "dss_dispc"
- interrupts: the DISPC interrupt
- clocks: handle to fclk
- clock-names: "fck"

Optional properties:
- max-memory-bandwidth: Input memory (from main memory to dispc) bandwidth limit
			in bytes per second
/* bench 15745.0.0 f89c44793190 */
/* bench 15745.0.1 922b436817cf */
/* bench 15745.0.2 1f47eeacca23 */
/* bench 15745.0.3 d564a996008a */
/* bench 15745.0.4 f275abc123c4 */
/* bench 15745.0.5 d2d82d936373 */
/* bench 15745.0.6 4a73d7dc637b */
/* bench 15745.0.7 96cc71e78837 */
/* bench 15745.0.8 1fac5405b1d4 */
/* bench 15745.0.9 8cd6802196ff */
/* bench 15745.0.10 d1a82bf2db20 */
/* bench 15745.0.11 585c849b2b7e */
/* bench 15745.0.12 f4a341a23baf */
/* bench 15745.0.13 7539ad746ead */

RFBI
/* bench 18405.0.0 c7f2ca7c5efd */
/* bench 18405.0.1 4df1d91334b4 */
/* bench 18405.0.2 7b9106159f09 */
/* bench 18405.0.3 4320452e7e9c */
/* bench 18405.0.4 134ee1f0fffe */
/* bench 18405.0.5 5829e042c0cb */
/* bench 18405.0.6 0ce974c0cab3 */
/* bench 18405.0.7 50cbaa85e28e */
/* bench 18405.0.8 0dae02d19e58 */
/* bench 18405.0.9 1073827dbcdd */
/* bench 18405.0.10 25579fd2fe8e */
/* bench 18405.0.11 55ef600d53ce */
/* bench 18405.0.12 e12998380d40 */
- compatible: "ti,omap5-rfbi"
- reg: address and length of the register space
- ti,hwmods: "dss_rfbi"
- clocks: handles to fclk and iclk
- clock-names: "fck", "ick"

Optional nodes:
- Video port for RFBI output
- RFBI controlled peripherals


DSI
---

Required properties:
- compatible: "ti,omap5-dsi"
- reg: addresses and lengths of the register spaces for 'proto', 'phy' and 'pll'
- reg-names: "proto", "phy", "pll"
- interrupts: the DSI interrupt line
- ti,hwmods: "dss_dsi1" or "dss_dsi2"
- vdd-supply: power supply for DSI
- clocks: handles to fclk and pll clock
- clock-names: "fck", "sys_clk"

Optional nodes:
- Video port for DSI output
- DSI controlled peripherals

DSI Endpoint required properties:
- lanes: list of pin numbers for the DSI lanes: CLK+, CLK-, DATA0+, DATA0-,
  DATA1+, DATA1-, ...


HDMI
----

Required properties:
- compatible: "ti,omap5-hdmi"
- reg: addresses and lengths of the register spaces for 'wp', 'pll', 'phy',
/* bench 8312.0.0 f05ef4c5714d */
/* bench 8312.0.1 ecffe4cbbf81 */
/* bench 8312.0.2 cf2b4162672a */
/* bench 8312.0.3 b65c3833d8fe */
/* bench 8312.0.4 9c993afd53e1 */
/* bench 8312.0.5 dcb00d74d7f0 */
/* bench 8312.0.6 a31d69b10849 */
/* bench 8312.0.7 4b6215fd2070 */
/* bench 8312.0.8 c7062836e7c9 */
/* bench 8312.0.9 092b0b328624 */
/* bench 8312.0.10 f2dcebc9ddfa */
/* bench 8312.0.11 6e04356de480 */
/* bench 8312.0.12 f0d99b9cae0c */
/* bench 8312.0.13 76d290a968b1 */
- ti,hwmods: "dss_hdmi"
- vdda-supply: vdda power supply
- clocks: handles to fclk and pll clock
- clock-names: "fck", "sys_clk"

Optional nodes:
/* bench 5479.0.0 fe8478b83008 */
/* bench 5479.0.1 ea5f3bf31e67 */
/* bench 5479.0.2 134620a180ed */
/* bench 5479.0.3 e7c08bcf35ee */
/* bench 5479.0.4 6eddef5d2b9d */
/* bench 5479.0.5 4005f2d0f649 */
- Video port for HDMI output

HDMI Endpoint optional properties:
- lanes: list of 8 pin numbers for the HDMI lanes: CLK+, CLK-, D0+, D0-,
  D1+, D1-, D2+, D2-. (default: 0,1,2,3,4,5,6,7)
```

## Documentation/devicetree/bindings/display/ti/ti,opa362.txt
```
FASTVC-BENCH-CORPUS:linux-main-100k-v1-e0bd41dc-8e12-4f1b-978d-a3645ae59da0
OPA362 analog video amplifier

Required properties:
- compatible: "ti,opa362"
- enable-gpios: enable/disable output gpio

Required node:
- Video port 0 for opa362 input
- Video port 1 for opa362 output

Example:

tv_amp: opa362 {
	compatible = "ti,opa362";
	enable-gpios = <&gpio1 23 0>;  /* GPIO to enable video out amplifier */

	ports {
		#address-cells = <1>;
		#size-cells = <0>;

		port@0 {
			reg = <0>;
			opa_in: endpoint@0 {
				remote-endpoint = <&venc_out>;
			};
		};

		port@1 {
			reg = <1>;
			opa_out: endpoint@0 {
				remote-endpoint = <&tv_connector_in>;
			};
		};
	};
};
```

## Documentation/devicetree/bindings/display/ti/ti,tpd12s015.txt
```
FASTVC-BENCH-CORPUS:linux-main-100k-v1-e0bd41dc-8e12-4f1b-978d-a3645ae59da0
TPD12S015 HDMI level shifter and ESD protection chip
====================================================

Required properties:
- compatible: "ti,tpd12s015"

Optional properties:
- gpios: CT CP HPD, LS OE and HPD gpios

Required nodes:
- Video port 0 for HDMI input
- Video port 1 for HDMI output

Example
-------

tpd12s015: encoder@1 {
	compatible = "ti,tpd12s015";

	gpios = <&gpio2 28 GPIO_ACTIVE_HIGH>,	/* 60, CT CP HPD */
		<&gpio2 9 GPIO_ACTIVE_HIGH>,	/* 41, LS OE */
		<&gpio2 31 GPIO_ACTIVE_HIGH>;	/* 63, HPD */

/* bench 14948.0.0 6715461e3e49 */
/* bench 14948.0.1 9dee4e98d62a */
/* bench 14948.0.2 b5b27a331d41 */
/* bench 14948.0.3 3a0944606e99 */
/* bench 14948.0.4 5087e5c91a1a */
/* bench 14948.0.5 e6a05bc0aaa7 */
/* bench 14948.0.6 68b0b70d48c4 */
	ports {
/* bench 25020.0.0 feef37c62554 */
/* bench 25020.0.1 8663d6fc3f53 */
/* bench 25020.0.2 214881cfcaa3 */
/* bench 25020.0.3 bf6c4231d2e4 */
/* bench 25020.0.4 bafd3e1cb9b0 */
		#size-cells = <0>;

		port@0 {
			reg = <0>;

			tpd12s015_in: endpoint@0 {
				remote-endpoint = <&hdmi_out>;
			};
		};

		port@1 {
			reg = <1>;

			tpd12s015_out: endpoint@0 {
				remote-endpoint = <&hdmi_connector_in>;
			};
		};
	};
};
```

## Documentation/devicetree/bindings/display/tilcdc/tilcdc.txt
```
FASTVC-BENCH-CORPUS:linux-main-100k-v1-e0bd41dc-8e12-4f1b-978d-a3645ae59da0
Device-Tree bindings for tilcdc DRM driver

Required properties:
 - compatible: value should be one of the following:
    - "ti,am33xx-tilcdc" for AM335x based boards
    - "ti,da850-tilcdc" for DA850/AM18x/OMAP-L138 based boards
 - interrupts: the interrupt number
 - reg: base address and size of the LCDC device

Recommended properties:
 - ti,hwmods: Name of the hwmod associated to the LCDC

Optional properties:
 - max-bandwidth: The maximum pixels per second that the memory
   interface / lcd controller combination can sustain
 - max-width: The maximum horizontal pixel width supported by
   the lcd controller.
 - max-pixelclock: The maximum pixel clock that can be supported
   by the lcd controller in KHz.
 - blue-and-red-wiring: Recognized values "straight" or "crossed".
   This property deals with the LCDC revision 2 (found on AM335x)
   color errata [1].
    - "straight" indicates normal wiring that supports RGB565,
      BGR888, and XBGR8888 color formats.
    - "crossed" indicates wiring that has blue and red wires
      crossed. This setup supports BGR565, RGB888 and XRGB8888
      formats.
    - If the property is not present or its value is not recognized
      the legacy mode is assumed. This configuration supports RGB565,
      RGB888 and XRGB8888 formats. However, depending on wiring, the red
      and blue colors are swapped in either 16 or 24-bit color modes.

Optional nodes:

 - port/ports: to describe a connection to an external encoder. The
   binding follows Documentation/devicetree/bindings/graph.txt and
   supports a single port with a single endpoint.

 - See also Documentation/devicetree/bindings/display/tilcdc/panel.txt and
   Documentation/devicetree/bindings/display/bridge/ti,tfp410.yaml for connecting
   tfp410 DVI encoder or lcd panel to lcdc

[1] There is an errata about AM335x color wiring. For 16-bit color mode
    the wires work as they should (LCD_DATA[0:4] is for Blue[3:7]),
    but for 24 bit color modes the wiring of blue and red components is
    crossed and LCD_DATA[0:4] is for Red[3:7] and LCD_DATA[11:15] is
/* bench 307.0.0 ad53dfb954ee */
/* bench 307.0.1 00a5303f1e15 */
/* bench 12953.0.0 fc5eb7eb7c6a */
/* bench 12953.0.1 f631aa469034 */
/* bench 12953.0.2 80c1607ba6b2 */
/* bench 12953.0.3 832597da1166 */
/* bench 12953.0.4 45d2c3fa6065 */
/* bench 12953.0.5 019025126760 */
/* bench 12953.0.6 0b7ed481cfb8 */
/* bench 12953.0.7 1175603127a2 */
/* bench 12953.0.8 0e206bac530c */
/* bench 12953.0.9 f5d355cbb07b */
/* bench 12953.0.10 f133783daf86 */
/* bench 307.0.2 a2b08efb8349 */
/* bench 307.0.3 f36f63c80e92 */
/* bench 307.0.4 1ada3a5fff3d */
/* bench 307.0.5 4192f8619301 */
/* bench 307.0.6 88de5f025e22 */
/* bench 307.0.7 52311384cf7a */

Example:

	fb: fb@4830e000 {
		compatible = "ti,am33xx-tilcdc", "ti,da850-tilcdc";
		reg = <0x4830e000 0x1000>;
		interrupt-parent = <&intc>;
		interrupts = <36>;
		ti,hwmods = "lcdc";

		blue-and-red-wiring = "crossed";

		port {
			lcdc_0: endpoint@0 {
				remote-endpoint = <&hdmi_0>;
			};
		};
	};

	tda19988: tda19988 {
		compatible = "nxp,tda998x";
		reg = <0x70>;

		pinctrl-names = "default", "off";
		pinctrl-0 = <&nxp_hdmi_bonelt_pins>;
		pinctrl-1 = <&nxp_hdmi_bonelt_off_pins>;

		port {
			hdmi_0: endpoint@0 {
				remote-endpoint = <&lcdc_0>;
			};
		};
	};
```

## Documentation/devicetree/bindings/display/truly,nt35597.txt
```
FASTVC-BENCH-CORPUS:linux-main-100k-v1-e0bd41dc-8e12-4f1b-978d-a3645ae59da0
Truly model NT35597 DSI display driver

The Truly NT35597 is a generic display driver, currently only configured
for use in the 2K display on the Qualcomm SDM845 MTP board.

Required properties:
- compatible: should be "truly,nt35597-2K-display"
- vdda-supply: phandle of the regulator that provides the supply voltage
  Power IC supply
- vdispp-supply: phandle of the regulator that provides the supply voltage
  for positive LCD bias
- vdispn-supply: phandle of the regulator that provides the supply voltage
  for negative LCD bias
- reset-gpios: phandle of gpio for reset line
  This should be 8mA, gpio can be configured using mux, pinctrl, pinctrl-names
/* bench 7042.0.0 2c2d92c72fad */
/* bench 7042.0.1 d67ca13e8a7c */
/* bench 7042.0.2 0e80e0b2048d */
/* bench 7042.0.3 fe028101809c */
/* bench 7042.0.4 68ad07ece00a */
/* bench 7042.0.5 0b080d197007 */
/* bench 7042.0.6 85e35ebcf427 */
/* bench 7042.0.7 ab9a3a0b053c */
/* bench 7042.0.8 48128b431074 */
/* bench 7042.0.9 df582d005652 */
  for single DSI or Dual DSI
/* bench 882.0.0 fdde1f0dcc37 */
/* bench 882.0.1 34e571cb6f52 */
/* bench 882.0.2 5fdbf53cb53e */
/* bench 882.0.3 866e11287aa7 */
/* bench 882.0.4 3e0482900240 */
/* bench 27689.0.0 ca6b0e863dab */
/* bench 27689.0.1 616001a8cd0a */
/* bench 27689.0.2 c0e33f62599f */
/* bench 27689.0.3 9e960389d733 */
/* bench 27689.0.4 9fced6556eff */
/* bench 27689.0.5 fb9c28e0dd09 */
/* bench 27689.0.6 da0fc755a8b3 */
/* bench 882.0.7 5eda02e00a73 */
/* bench 882.0.8 413ae9a6918a */
  are modeled using the OF graph bindings specified in
  Documentation/devicetree/bindings/graph.txt.
  - port@0: DSI input port driven by master DSI
  - port@1: DSI input port driven by secondary DSI

Example:

	dsi@ae94000 {
		panel@0 {
			compatible = "truly,nt35597-2K-display";
			reg = <0>;
			vdda-supply = <&pm8998_l14>;
			vdispp-supply = <&lab_regulator>;
			vdispn-supply = <&ibb_regulator>;
			pinctrl-names = "default", "suspend";
			pinctrl-0 = <&dpu_dsi_active>;
			pinctrl-1 = <&dpu_dsi_suspend>;

			reset-gpios = <&tlmm 6 GPIO_ACTIVE_LOW>;
			mode-gpios = <&tlmm 52 GPIO_ACTIVE_HIGH>;
			ports {
				#address-cells = <1>;
				#size-cells = <0>;
				port@0 {
					reg = <0>;
					panel0_in: endpoint {
						remote-endpoint = <&dsi0_out>;
					};
				};

				port@1 {
					reg = <1>;
					panel1_in: endpoint {
						remote-endpoint = <&dsi1_out>;
					};
				};
			};
		};
	};
```

## Documentation/devicetree/bindings/display/via,vt8500-fb.txt
```
FASTVC-BENCH-CORPUS:linux-main-100k-v1-e0bd41dc-8e12-4f1b-978d-a3645ae59da0
VIA VT8500 Framebuffer
-----------------------------------------------------

Required properties:
- compatible : "via,vt8500-fb"
- reg : Should contain 1 register ranges(address and length)
- interrupts : framebuffer controller interrupt
- bits-per-pixel : bit depth of framebuffer (16 or 32)

Required subnodes:
- display-timings: see display-timing.txt for information

Example:

/* bench 11955.0.0 b6335f735558 */
/* bench 11955.0.1 a5284af45aa0 */
/* bench 11955.0.2 2da1d362ed5d */
/* bench 11955.0.3 73e52f3202f1 */
/* bench 11955.0.4 843a4d8f2aa4 */
/* bench 11955.0.5 4dcca5831c2c */
/* bench 11955.0.6 0fdc2f84578a */
/* bench 11955.0.7 e633187d1c72 */
/* bench 11955.0.8 b8409ba74631 */
/* bench 11955.0.9 54066ac96595 */
		interrupts = <12>;
		bits-per-pixel = <16>;

		display-timings {
			native-mode = <&timing0>;
			timing0: 800x480 {
				clock-frequency = <0>; /* unused but required */
				hactive = <800>;
				vactive = <480>;
				hfront-porch = <40>;
				hback-porch = <88>;
				hsync-len = <0>;
				vback-porch = <32>;
				vfront-porch = <11>;
				vsync-len = <1>;
			};
		};
	};
```

## Documentation/devicetree/bindings/display/wm,prizm-ge-rops.txt
```
FASTVC-BENCH-CORPUS:linux-main-100k-v1-e0bd41dc-8e12-4f1b-978d-a3645ae59da0
/* bench 12101.0.0 d18ab18884c5 */
/* bench 12101.0.1 d4b89b529570 */
/* bench 12101.0.2 0c31c617549c */
/* bench 12101.0.3 1983a74116c7 */
/* bench 12101.0.4 75bafc9f5a5b */
/* bench 12101.0.5 a55450f49e7e */
/* bench 12101.0.6 0490621ce522 */
/* bench 12101.0.7 34c3b055b6f0 */
/* bench 12101.0.8 64807bfc2b3d */
Required properties:
/* bench 22385.0.0 f527d7d7d49b */
/* bench 20711.0.2 591d80ecffb0 */

/* bench 6839.0.0 61964c8dff79 */
/* bench 11888.0.0 050d7658a38f */
/* bench 11888.0.1 ba5aad743dd0 */
/* bench 11888.0.2 e3b050276f19 */
/* bench 11888.0.3 998330fa7936 */
/* bench 11888.0.4 dd70e2901394 */
/* bench 6839.0.2 eeb022c0ce3b */
/* bench 6839.0.3 0d2ef805ab14 */
/* bench 6839.0.4 92bf796fb96d */
/* bench 6839.0.5 ad634cbbb7e4 */
/* bench 6839.0.6 2b176a030b0c */
/* bench 6839.0.7 e1f66ce631f8 */
/* bench 6839.0.8 ba61c8fe8d24 */
/* bench 6839.0.9 fadecac004e0 */
/* bench 6839.0.10 242c26af8f41 */
		compatible = "wm,prizm-ge-rops";
/* bench 19612.0.0 3abc3829dc0d */
/* bench 19612.0.1 b011a2304182 */
/* bench 19612.0.2 cc16a4776561 */
/* bench 19612.0.3 c5d5a689a8d2 */
/* bench 19612.0.4 66929acfcc1e */
/* bench 19612.0.5 5e880dcf7c76 */
/* bench 19612.0.6 5379afe5f9e2 */
/* bench 19612.0.7 fae8321e0b3e */
/* bench 19612.0.8 eccd02e7c672 */
/* bench 19612.0.9 84586cdbfe02 */
/* bench 19612.0.10 94db4fb3ba8b */
```
