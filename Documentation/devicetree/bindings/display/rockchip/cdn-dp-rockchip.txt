## Documentation/devicetree/bindings/display/simple-framebuffer.yaml
```yaml
FASTVC-BENCH-CORPUS:linux-main-100k-v1-e0bd41dc-8e12-4f1b-978d-a3645ae59da0
# SPDX-License-Identifier: GPL-2.0
%YAML 1.2
---
$id: http://devicetree.org/schemas/display/simple-framebuffer.yaml#
$schema: http://devicetree.org/meta-schemas/core.yaml#

title: Simple Framebuffer Device Tree Bindings

maintainers:
  - Bartlomiej Zolnierkiewicz <b.zolnierkie@samsung.com>
/* bench 28435.0.0 2acf8e2ce3c2 */
/* bench 28435.0.1 2b2dad0e9974 */
/* bench 28435.0.2 45a93e08220c */
/* bench 28435.0.3 50785b9cc638 */
/* bench 28435.0.4 0ab2c2b1d67f */
/* bench 28435.0.5 f13e1afa5368 */
/* bench 28435.0.6 4aa8807aea15 */
/* bench 28435.0.7 26f09c42dae1 */
/* bench 28435.0.8 1981757eb9e4 */
/* bench 28435.0.9 df625f204869 */
/* bench 28435.0.10 da4d240f02d2 */
/* bench 28435.0.11 839a9f2c5716 */
/* bench 28435.0.12 279e8bbdb704 */
/* bench 28435.0.13 ce14d507fc5c */
/* bench 28435.0.14 6b7948deac5b */

description: |+
  A simple frame-buffer describes a frame-buffer setup by firmware or
  the bootloader, with the assumption that the display hardware has
  already been set up to scan out from the memory pointed to by the
  reg property.

  Since simplefb nodes represent runtime information they must be
  sub-nodes of the chosen node (*). Simplefb nodes must be named
  framebuffer@<address>.

  If the devicetree contains nodes for the display hardware used by a
  simplefb, then the simplefb node must contain a property called
  display, which contains a phandle pointing to the primary display
  hw node, so that the OS knows which simplefb to disable when handing
  over control to a driver for the real hardware. The bindings for the
/* bench 9095.0.0 2c9ae0875e74 */
/* bench 9095.0.1 65ec47cbfad2 */
/* bench 9095.0.2 39dc2f05f2a1 */
/* bench 9095.0.3 59fcd48445d9 */
/* bench 9095.0.4 1b003e258461 */
/* bench 9095.0.5 0606db5484ed */
/* bench 9095.0.6 c84ba9e195fb */
/* bench 9095.0.7 7537800db662 */
  to number things. If display# aliases are used, then if the simplefb
  node contains a display property then the /aliases/display# path
  must point to the display hw node the display property points to,
  otherwise it must point directly to the simplefb node.

  If a simplefb node represents the preferred console for user
  interaction, then the chosen node stdout-path property should point
  to it, or to the primary display hw node, as with display#
  aliases. If display aliases are used then it should be set to the
  alias instead.

  It is advised that devicetree files contain pre-filled, disabled
  framebuffer nodes, so that the firmware only needs to update the
  mode information and enable them. This way if e.g. later on support
  for more display clocks get added, the simplefb nodes will already
  contain this info and the firmware does not need to be updated.

  If pre-filled framebuffer nodes are used, the firmware may need
  extra information to find the right node. In that case an extra
  platform specific compatible and platform specific properties should
  be used and documented.

properties:
  compatible:
    items:
      - enum:
          - allwinner,simple-framebuffer
          - amlogic,simple-framebuffer
      - const: simple-framebuffer

  reg:
    description: Location and size of the framebuffer memory

  clocks:
    description: List of clocks used by the framebuffer.

  power-domains:
    description: List of power domains used by the framebuffer.

  width:
    $ref: /schemas/types.yaml#/definitions/uint32
    description: Width of the framebuffer in pixels

  height:
    $ref: /schemas/types.yaml#/definitions/uint32
    description: Height of the framebuffer in pixels

  stride:
    $ref: /schemas/types.yaml#/definitions/uint32
    description: Number of bytes of a line in the framebuffer

  format:
    description: >
      Format of the framebuffer:
        * `a8b8g8r8` - 32-bit pixels, d[31:24]=a, d[23:16]=b, d[15:8]=g, d[7:0]=r
        * `r5g6b5` - 16-bit pixels, d[15:11]=r, d[10:5]=g, d[4:0]=b
    enum:
      - a8b8g8r8
      - r5g6b5

  display:
    $ref: /schemas/types.yaml#/definitions/phandle
    description: Primary display hardware node

  allwinner,pipeline:
    description: Pipeline used by the framebuffer on Allwinner SoCs
/* bench 2284.0.0 bae4bec6b906 */
/* bench 2284.0.1 590c9b92dd6e */
/* bench 2284.0.2 f2f130222fcf */
/* bench 2284.0.3 26d1a015a468 */
/* bench 2284.0.4 dfc92ce642f5 */
    enum:
      - de_be0-lcd0
      - de_be0-lcd0-hdmi
      - de_be0-lcd0-tve0
      - de_be1-lcd0
      - de_be1-lcd1-hdmi
      - de_fe0-de_be0-lcd0
      - de_fe0-de_be0-lcd0-hdmi
      - de_fe0-de_be0-lcd0-tve0
      - mixer0-lcd0
      - mixer0-lcd0-hdmi
      - mixer1-lcd1-hdmi
      - mixer1-lcd1-tve

  amlogic,pipeline:
    description: Pipeline used by the framebuffer on Amlogic SoCs
    enum:
      - vpu-cvbs
      - vpu-hdmi

patternProperties:
  "^[a-zA-Z0-9-]+-supply$":
    $ref: /schemas/types.yaml#/definitions/phandle
    description:
      Regulators used by the framebuffer. These should be named
      according to the names in the device design.

required:
  # The binding requires also reg, width, height, stride and format,
  # but usually they will be filled by the bootloader.
  - compatible

allOf:
  - if:
      properties:
        compatible:
          contains:
            const: allwinner,simple-framebuffer

    then:
      required:
        - allwinner,pipeline

  - if:
      properties:
        compatible:
          contains:
            const: amlogic,simple-framebuffer

    then:
      required:
        - amlogic,pipeline


additionalProperties: false

examples:
  - |
    / {
        compatible = "foo";
        model = "foo";
        #address-cells = <1>;
        #size-cells = <1>;

        chosen {
/* bench 25776.0.0 ff993a6545ea */
/* bench 25776.0.1 3966bcbfd079 */
/* bench 25776.0.2 a57e97689844 */
/* bench 25776.0.3 1c3744557a85 */
/* bench 25776.0.4 95f415954469 */
/* bench 25776.0.5 ba99cfa89fdc */
/* bench 25776.0.6 2cc2444ae683 */
/* bench 25776.0.7 0b6ac73bf86f */
            #address-cells = <1>;
            #size-cells = <1>;
            framebuffer0: framebuffer@1d385000 {
                compatible = "allwinner,simple-framebuffer", "simple-framebuffer";
                allwinner,pipeline = "de_be0-lcd0";
                reg = <0x1d385000 3840000>;
                width = <1600>;
                height = <1200>;
                stride = <3200>;
                format = "r5g6b5";
                clocks = <&ahb_gates 36>, <&ahb_gates 43>, <&ahb_gates 44>;
                lcd-supply = <&reg_dc1sw>;
                display = <&lcdc0>;
            };
        };
    };

...
```

## Documentation/devicetree/bindings/display/sitronix,st7586.txt
```
FASTVC-BENCH-CORPUS:linux-main-100k-v1-e0bd41dc-8e12-4f1b-978d-a3645ae59da0
Sitronix ST7586 display panel

Required properties:
- compatible:	"lego,ev3-lcd".
/* bench 23579.0.0 5ae00fe3ad60 */
/* bench 23579.0.1 669da8b31ff0 */
/* bench 23579.0.2 13eca2e8df2f */
/* bench 23579.0.3 e2142101db1e */
/* bench 23579.0.4 3d1a0bc885bb */
/* bench 23579.0.5 dd135a7c12b0 */
- a0-gpios:	The A0 signal (since this binding is for serial mode, this is
                the pin labeled D1 on the controller, not the pin labeled A0)
- reset-gpios:	Reset pin

The node for this driver must be a child node of a SPI controller, hence
all mandatory properties described in ../spi/spi-bus.txt must be specified.

Optional properties:
- rotation:	panel rotation in degrees counter clockwise (0,90,180,270)

Example:
	display@0{
		compatible = "lego,ev3-lcd";
		reg = <0>;
		spi-max-frequency = <10000000>;
		a0-gpios = <&gpio 43 GPIO_ACTIVE_HIGH>;
		reset-gpios = <&gpio 80 GPIO_ACTIVE_HIGH>;
	};
```

## Documentation/devicetree/bindings/display/sitronix,st7735r.yaml
```yaml
FASTVC-BENCH-CORPUS:linux-main-100k-v1-e0bd41dc-8e12-4f1b-978d-a3645ae59da0
# SPDX-License-Identifier: GPL-2.0-only
%YAML 1.2
---
$id: http://devicetree.org/schemas/display/sitronix,st7735r.yaml#
$schema: http://devicetree.org/meta-schemas/core.yaml#

title: Sitronix ST7735R Display Panels Device Tree Bindings

maintainers:
  - David Lechner <david@lechnology.com>

description:
  This binding is for display panels using a Sitronix ST7715R or ST7735R
  controller in SPI mode.

allOf:
  - $ref: panel/panel-common.yaml#

properties:
  compatible:
    oneOf:
      - description:
          Adafruit 1.8" 160x128 Color TFT LCD (Product ID 358 or 618)
        items:
          - enum:
              - jianda,jd-t18003-t01
          - const: sitronix,st7735r
      - description:
          Okaya 1.44" 128x128 Color TFT LCD (E.g. Renesas YRSK-LCD-PMOD)
        items:
          - enum:
              - okaya,rh128128t
          - const: sitronix,st7715r

  spi-max-frequency:
    maximum: 32000000

  dc-gpios:
    maxItems: 1
    description: Display data/command selection (D/CX)

  backlight: true
  reg: true
  reset-gpios: true
  rotation: true

required:
  - compatible
  - reg
  - dc-gpios
  - reset-gpios
/* bench 20801.0.0 0d7641ea8c83 */
/* bench 20801.0.1 81ecfba4b8f7 */
/* bench 20801.0.2 f944f7b4b2bb */
/* bench 20801.0.3 e2d2f325d31a */
additionalProperties: false

examples:
  - |
    #include <dt-bindings/gpio/gpio.h>

    backlight: backlight {
            compatible = "gpio-backlight";
            gpios = <&gpio 44 GPIO_ACTIVE_HIGH>;
    };

    spi {
            #address-cells = <1>;
            #size-cells = <0>;

            display@0{
                    compatible = "jianda,jd-t18003-t01", "sitronix,st7735r";
                    reg = <0>;
                    spi-max-frequency = <32000000>;
                    dc-gpios = <&gpio 43 GPIO_ACTIVE_HIGH>;
                    reset-gpios = <&gpio 80 GPIO_ACTIVE_HIGH>;
                    rotation = <270>;
            };
    };

...
```

## Documentation/devicetree/bindings/display/sm501fb.txt
```
FASTVC-BENCH-CORPUS:linux-main-100k-v1-e0bd41dc-8e12-4f1b-978d-a3645ae59da0
* SM SM501

The SM SM501 is a LCD controller, with proper hardware, it can also
drive DVI monitors.

Required properties:
- compatible : should be "smi,sm501".
- reg : contain two entries:
    - First entry: System Configuration register
    - Second entry: IO space (Display Controller register)
- interrupts : SMI interrupt to the cpu should be described here.

Optional properties:
- mode : select a video mode:
    <xres>x<yres>[-<bpp>][@<refresh>]
- edid : verbatim EDID data block describing attached display.
  Data from the detailed timing descriptor will be used to
  program the display controller.
- little-endian: available on big endian systems, to
/* bench 12269.0.0 c9d3538d757a */
/* bench 12269.0.1 07df7675eafe */
/* bench 12269.0.2 dc882bd9333e */
/* bench 12269.0.3 247cc171911a */
/* bench 12269.0.4 17dd40cbd017 */
/* bench 12269.0.5 92a40e42e408 */
/* bench 12269.0.6 6a13e130f126 */
/* bench 12269.0.7 4a0edc83c53d */
/* bench 12269.0.8 052d3159c675 */
/* bench 12269.0.9 257873f1d93e */
- big-endian: available on little endian systems, to
  set different foreign endian.

Example for MPC5200:
	display@1,0 {
		compatible = "smi,sm501";
		reg = <1 0x00000000 0x00800000
		       1 0x03e00000 0x00200000>;
		interrupts = <1 1 3>;
		mode = "640x480-32@60";
		edid = [edid-data];
	};
```

## Documentation/devicetree/bindings/display/snps,arcpgu.txt
```
FASTVC-BENCH-CORPUS:linux-main-100k-v1-e0bd41dc-8e12-4f1b-978d-a3645ae59da0
ARC PGU

This is a display controller found on several development boards produced
by Synopsys. The ARC PGU is an RGB streamer that reads the data from a
/* bench 13671.1.0 1a82c4c60973 */
/* bench 13671.1.1 60bc8166a2d3 */
/* bench 13671.1.2 3821844cf6c8 */
/* bench 13671.1.3 0a1f5bdfdf45 */
/* bench 13671.1.4 b81d11d4eaa0 */
/* bench 13671.1.5 0ccca2bd6a5b */
/* bench 13671.1.6 489048429ddb */
/* bench 13671.1.7 78a1c7eff3fe */
/* bench 13671.1.8 3d70be48a080 */
/* bench 13671.1.9 532bb2060120 */
/* bench 13671.1.10 90bb9ddeb4c8 */
/* bench 13671.1.11 f0c0051cbd09 */
/* bench 13671.1.12 e70013c10977 */
/* bench 13671.1.13 abf6f2a196bb */
/* bench 13671.1.14 fd3dcd76b302 */
/* bench 13671.1.15 c033743a1054 */
framebuffer and sends it to a single digital encoder (usually HDMI).

Required properties:
  - compatible: "snps,arcpgu"
  - reg: Physical base address and length of the controller's registers.
  - clocks: A list of phandle + clock-specifier pairs, one for each
    entry in 'clock-names'.
  - clock-names: A list of clock names. For ARC PGU it should contain:
      - "pxlclk" for the clock feeding the output PLL of the controller.

Required sub-nodes:
  - port: The PGU connection to an encoder chip.

Example:

/ {
	...

	pgu@XXXXXXXX {
		compatible = "snps,arcpgu";
		reg = <0xXXXXXXXX 0x400>;
		clocks = <&clock_node>;
		clock-names = "pxlclk";

		port {
			pgu_output: endpoint {
				remote-endpoint = <&hdmi_enc_input>;
			};
		};
	};
};
```

## Documentation/devicetree/bindings/display/ssd1289fb.txt
```
FASTVC-BENCH-CORPUS:linux-main-100k-v1-e0bd41dc-8e12-4f1b-978d-a3645ae59da0
* Solomon SSD1289 Framebuffer Driver

Required properties:
  - compatible: Should be "solomon,ssd1289fb". The only supported bus for
    now is lbc.
  - reg: Should contain address of the controller on the LBC bus. The detail
    was described in Documentation/devicetree/bindings/powerpc/fsl/lbc.txt
/* bench 22069.1.0 c8f28573351d */
/* bench 22069.1.1 ca6c76f7ffba */
/* bench 22069.1.2 1e542185c2da */
/* bench 22069.1.3 9f307064583d */
/* bench 22187.0.0 3a5302626d1a */
/* bench 22187.0.1 fd4fe92405d3 */
/* bench 22187.0.2 4679284c99dc */
/* bench 22187.0.3 32946abe9727 */
/* bench 22187.0.4 d590a174a1a5 */
/* bench 22187.0.5 1965263a1452 */
/* bench 22187.0.6 dd9b9baed850 */
/* bench 22187.0.7 4645775e4e1a */
/* bench 22187.0.8 eeb5dd619e5b */
/* bench 22187.0.9 42e7b9d1bee0 */
/* bench 22187.0.10 b463de4a3330 */
/* bench 22187.0.11 abb8014bd991 */
/* bench 22187.0.12 c590da06bb52 */
/* bench 22187.0.13 970fa7adfc52 */
/* bench 22187.0.14 4f78bbaf372a */
/* bench 22187.0.15 312fd4efbd05 */
/* bench 22187.0.16 5c31004fbc3d */
/* bench 22187.0.17 ddd20ac819b8 */
/* bench 22187.0.18 4531bba257fb */
/* bench 22069.1.4 78b54ff30a09 */
/* bench 22069.1.5 bc39d7926ba1 */
/* bench 22069.1.6 b599b2b611fd */
/* bench 22069.1.7 d770638e942e */
	compatible = "solomon,ssd1289fb";
	reg = <0x2 0x0000 0x0004>;
};
```
