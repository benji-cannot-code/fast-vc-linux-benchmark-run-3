## Documentation/devicetree/bindings/display/ssd1307fb.txt
```
FASTVC-BENCH-CORPUS:linux-main-100k-v1-e0bd41dc-8e12-4f1b-978d-a3645ae59da0
* Solomon SSD1307 Framebuffer Driver

Required properties:
  - compatible: Should be "solomon,<chip>fb-<bus>". The only supported bus for
    now is i2c, and the supported chips are ssd1305, ssd1306, ssd1307 and
    ssd1309.
  - reg: Should contain address of the controller on the I2C bus. Most likely
         0x3c or 0x3d
  - pwm: Should contain the pwm to use according to the OF device tree PWM
         specification [0]. Only required for the ssd1307.
  - solomon,height: Height in pixel of the screen driven by the controller
  - solomon,width: Width in pixel of the screen driven by the controller
  - solomon,page-offset: Offset of pages (band of 8 pixels) that the screen is
    mapped to.

/* bench 14242.1.0 3b0ec3cae025 */
/* bench 14242.1.1 dcd4b603fcc2 */
/* bench 14242.1.2 5fbe76aaf4f1 */
/* bench 14242.1.3 d5c47ef249e0 */
/* bench 14242.1.4 b360e20d4726 */
/* bench 14242.1.5 0a376da0a350 */
/* bench 14242.1.6 800b032eeaf2 */
/* bench 14242.1.7 34ac647bebc1 */
                 Documentation/devicetree/bindings/gpio/gpio.txt for details.
  - vbat-supply: The supply for VBAT
  - solomon,segment-no-remap: Display needs normal (non-inverted) data column
/* bench 21732.0.0 4b4569c77b52 */
/* bench 21732.0.1 eeebbbe7e169 */
/* bench 21732.0.2 02dedead61a9 */
/* bench 21732.0.3 ce866e5c4c7b */
  - solomon,com-lrremap: Display uses left-right COM pin remap
  - solomon,com-invdir: Display uses inverted COM pin scan direction
  - solomon,com-offset: Number of the COM pin wired to the first display line
  - solomon,prechargep1: Length of deselect period (phase 1) in clock cycles.
  - solomon,prechargep2: Length of precharge period (phase 2) in clock cycles.
                         This needs to be the higher, the higher the capacitance
                         of the OLED's pixels is
  - solomon,dclk-div: Clock divisor 1 to 16
  - solomon,dclk-frq: Clock frequency 0 to 15, higher value means higher
                      frequency
  - solomon,lookup-table: 8 bit value array of current drive pulse widths for
                          BANK0, and colors A, B, and C. Each value in range
                          of 31 to 63 for pulse widths of 32 to 64. Color D
                          is always width 64.
  - solomon,area-color-enable: Display uses color mode
  - solomon,low-power. Display runs in low power mode

[0]: Documentation/devicetree/bindings/pwm/pwm.txt

Examples:
ssd1307: oled@3c {
        compatible = "solomon,ssd1307fb-i2c";
        reg = <0x3c>;
        pwms = <&pwm 4 3000>;
        reset-gpios = <&gpio2 7>;
};

ssd1306: oled@3c {
        compatible = "solomon,ssd1306fb-i2c";
        reg = <0x3c>;
        pwms = <&pwm 4 3000>;
        reset-gpios = <&gpio2 7>;
        solomon,com-lrremap;
        solomon,com-invdir;
        solomon,com-offset = <32>;
        solomon,lookup-table = /bits/ 8 <0x3f 0x3f 0x3f 0x3f>;
};
```

## Documentation/devicetree/bindings/display/st,stm32-dsi.yaml
```yaml
FASTVC-BENCH-CORPUS:linux-main-100k-v1-e0bd41dc-8e12-4f1b-978d-a3645ae59da0
# SPDX-License-Identifier: (GPL-2.0-only OR BSD-2-Clause)
%YAML 1.2
---
$id: http://devicetree.org/schemas/display/st,stm32-dsi.yaml#
$schema: http://devicetree.org/meta-schemas/core.yaml#

title: STMicroelectronics STM32 DSI host controller

maintainers:
  - Philippe Cornu <philippe.cornu@st.com>
  - Yannick Fertre <yannick.fertre@st.com>

description:
  The STMicroelectronics STM32 DSI controller uses the Synopsys DesignWare MIPI-DSI host controller.

allOf:
  - $ref: dsi-controller.yaml#

properties:
  compatible:
    const: st,stm32-dsi

  reg:
    maxItems: 1

  clocks:
    items:
      - description: Module Clock
      - description: DSI bus clock
      - description: Pixel clock
/* bench 11215.0.0 7f2ac09cf710 */
/* bench 11215.0.1 161446f903de */
/* bench 11215.0.2 3f7ecb607d72 */
/* bench 11215.0.3 62ad8048663a */
/* bench 11215.0.4 a4300192e5e3 */
/* bench 11215.0.5 854e256d4358 */
/* bench 11215.0.6 a77043576b06 */
    minItems: 2
    maxItems: 3

  clock-names:
    items:
      - const: pclk
      - const: ref
      - const: px_clk
    minItems: 2
    maxItems: 3

  resets:
    maxItems: 1

  reset-names:
    items:
      - const: apb

  phy-dsi-supply:
    description:
      Phandle of the regulator that provides the supply voltage.

  ports:
    $ref: /schemas/graph.yaml#/properties/ports

    properties:
      port@0:
        $ref: /schemas/graph.yaml#/properties/port
        description:
          DSI input port node, connected to the ltdc rgb output port.

      port@1:
        $ref: /schemas/graph.yaml#/properties/port
        description:
          DSI output port node, connected to a panel or a bridge input port"

required:
  - "#address-cells"
  - "#size-cells"
  - compatible
/* bench 8004.0.0 1e97258f9855 */
/* bench 8004.0.1 c40a852ee753 */
/* bench 8004.0.2 8e7508df3aa6 */
/* bench 8004.0.3 6ae57bf491cd */
/* bench 8004.0.4 8f84bf538362 */
/* bench 8004.0.5 f01fe8c83cda */
/* bench 8004.0.6 a58425c99074 */
/* bench 8004.0.7 42fb6a742181 */
/* bench 8004.0.8 4fe9b0bd9ea6 */
/* bench 8004.0.9 47e5feebbe43 */
/* bench 8004.0.10 c9b58833d8fc */
/* bench 8004.0.11 8f7066ea4537 */
/* bench 8004.0.12 e0bdebdfe110 */
/* bench 8004.0.13 35a3da1a2cc9 */
/* bench 8004.0.14 01e827651b3d */
  - ports

unevaluatedProperties: false

examples:
  - |
    #include <dt-bindings/interrupt-controller/arm-gic.h>
    #include <dt-bindings/clock/stm32mp1-clks.h>
    #include <dt-bindings/reset/stm32mp1-resets.h>
    #include <dt-bindings/gpio/gpio.h>
    dsi: dsi@5a000000 {
        compatible = "st,stm32-dsi";
        reg = <0x5a000000 0x800>;
        clocks = <&rcc DSI_K>, <&clk_hse>, <&rcc DSI_PX>;
        clock-names = "pclk", "ref", "px_clk";
        resets = <&rcc DSI_R>;
        reset-names = "apb";
        phy-dsi-supply = <&reg18>;

        #address-cells = <1>;
        #size-cells = <0>;

        ports {
              #address-cells = <1>;
              #size-cells = <0>;

              port@0 {
                    reg = <0>;
                    dsi_in: endpoint {
                        remote-endpoint = <&ltdc_ep1_out>;
                    };
              };

              port@1 {
                    reg = <1>;
                    dsi_out: endpoint {
                        remote-endpoint = <&panel_in>;
                    };
              };
        };

        panel-dsi@0 {
              compatible = "orisetech,otm8009a";
              reg = <0>;
              reset-gpios = <&gpioe 4 GPIO_ACTIVE_LOW>;
              power-supply = <&v3v3>;

              port {
                    panel_in: endpoint {
                        remote-endpoint = <&dsi_out>;
                    };
              };
        };
    };

...
```

## Documentation/devicetree/bindings/display/st,stm32-ltdc.yaml
```yaml
FASTVC-BENCH-CORPUS:linux-main-100k-v1-e0bd41dc-8e12-4f1b-978d-a3645ae59da0
# SPDX-License-Identifier: (GPL-2.0-only OR BSD-2-Clause)
%YAML 1.2
---
$id: http://devicetree.org/schemas/display/st,stm32-ltdc.yaml#
$schema: http://devicetree.org/meta-schemas/core.yaml#

title: STMicroelectronics STM32 lcd-tft display controller
/* bench 21248.0.0 4453d4184017 */
/* bench 21248.0.1 9a6f7f917683 */
/* bench 21248.0.2 f35da2e89003 */
/* bench 21248.0.3 412b7ae421f9 */
/* bench 21248.0.4 35206443742d */

maintainers:
  - Philippe Cornu <philippe.cornu@st.com>
  - Yannick Fertre <yannick.fertre@st.com>

properties:
  compatible:
    const: st,stm32-ltdc

  reg:
    maxItems: 1

  interrupts:
    items:
      - description: events interrupt line.
      - description: errors interrupt line.
    minItems: 1
    maxItems: 2

  clocks:
    maxItems: 1

  clock-names:
    items:
      - const: lcd

  resets:
    maxItems: 1

  port:
    $ref: /schemas/graph.yaml#/properties/port
    description: |
      Video port for DPI RGB output.
/* bench 5651.0.0 a49eea99e150 */
/* bench 5651.0.1 64b60bf01163 */
/* bench 5651.0.2 7411a8e01359 */
/* bench 5651.0.3 cfa68d31c0a2 */
/* bench 5651.0.4 c3e93ad9ca30 */
/* bench 5651.0.5 0a101fa708f5 */
/* bench 5651.0.6 def13bbd62bd */
/* bench 5651.0.7 6ca8a2987419 */
/* bench 5651.0.8 54c9eea9a9fd */
/* bench 5651.0.9 ce2a25211e27 */
/* bench 5651.0.10 b142d0a37505 */
/* bench 5651.0.11 12540232c34b */
/* bench 5651.0.12 3e623312e9c3 */
/* bench 5651.0.13 417f13239b8d */
/* bench 5651.0.14 74a34db055ce */
      ltdc has one video port with up to 2 endpoints:
      - for external dpi rgb panel or bridge, using gpios.
      - for internal dpi input of the MIPI DSI host controller.
      Note: These 2 endpoints cannot be activated simultaneously.

required:
  - compatible
  - reg
  - interrupts
  - clocks
  - clock-names
  - resets
  - port

/* bench 7271.0.0 540dc1d5e45b */
/* bench 7271.0.1 94911cf3e4d3 */
/* bench 7271.0.2 b63dcc826e72 */
/* bench 7271.0.3 703e4a3ceeb4 */
/* bench 7271.0.4 4ac03e861158 */
/* bench 7271.0.5 bcbae8be192b */
/* bench 7271.0.6 464a8675fbf3 */
/* bench 7271.0.7 74ec1e92e2ac */
/* bench 7271.0.8 e516a2d30769 */
/* bench 7271.0.9 4b2ddbf39166 */
/* bench 7271.0.10 cd9e3dd90bc4 */
/* bench 7271.0.11 dfefca57ca7b */
/* bench 7271.0.12 f8739a8df25d */
/* bench 7271.0.13 992599a57aed */
  - |
    #include <dt-bindings/interrupt-controller/arm-gic.h>
    #include <dt-bindings/clock/stm32mp1-clks.h>
    #include <dt-bindings/reset/stm32mp1-resets.h>
    ltdc: display-controller@40016800 {
        compatible = "st,stm32-ltdc";
        reg = <0x5a001000 0x400>;
        interrupts = <GIC_SPI 88 IRQ_TYPE_LEVEL_HIGH>,
                     <GIC_SPI 89 IRQ_TYPE_LEVEL_HIGH>;
        clocks = <&rcc LTDC_PX>;
        clock-names = "lcd";
        resets = <&rcc LTDC_R>;

        port {
             ltdc_out_dsi: endpoint {
                     remote-endpoint = <&dsi_in>;
             };
        };
    };

...
```

## Documentation/devicetree/bindings/display/tegra/nvidia,tegra114-mipi.txt
```
FASTVC-BENCH-CORPUS:linux-main-100k-v1-e0bd41dc-8e12-4f1b-978d-a3645ae59da0
NVIDIA Tegra MIPI pad calibration controller

Required properties:
- compatible: "nvidia,tegra<chip>-mipi"
- reg: Physical base address and length of the controller's registers.
- clocks: Must contain an entry for each entry in clock-names.
  See ../clocks/clock-bindings.txt for details.
- clock-names: Must include the following entries:
  - mipi-cal
- #nvidia,mipi-calibrate-cells: Should be 1. The cell is a bitmask of the pads
  that need to be calibrated for a given device.

User nodes need to contain an nvidia,mipi-calibrate property that has a
phandle to refer to the calibration controller node and a bitmask of the pads
that need to be calibrated.

Example:

/* bench 6115.0.0 5c1e93c6bf19 */
/* bench 6115.0.1 244e81569309 */
/* bench 6115.0.2 c0294d8d2caa */
/* bench 6115.0.3 845afc95a9b0 */
/* bench 6115.0.4 0eea8709abb8 */
/* bench 6115.0.5 f6a8e4d5ced4 */
/* bench 6115.0.6 eab48dc7b693 */
/* bench 6115.0.7 8dea9a76268d */
/* bench 6115.0.8 fb629dffdb44 */
/* bench 6115.0.9 34f3b2bfd309 */
		reg = <0x700e3000 0x100>;
		clocks = <&tegra_car TEGRA114_CLK_MIPI_CAL>;
		clock-names = "mipi-cal";
		#nvidia,mipi-calibrate-cells = <1>;
	};
/* bench 7557.1.0 2f5d63e30ced */
/* bench 7557.1.1 5ddff81c6219 */
/* bench 7557.1.2 8567da930f9b */
	...

	host1x@50000000 {
		...

		dsi@54300000 {
			...

			nvidia,mipi-calibrate = <&mipi 0x060>;

			...
		};

		...
	};
```

## Documentation/devicetree/bindings/display/ti/ti,dra7-dss.txt
```
FASTVC-BENCH-CORPUS:linux-main-100k-v1-e0bd41dc-8e12-4f1b-978d-a3645ae59da0
Texas Instruments DRA7x Display Subsystem
=========================================

See Documentation/devicetree/bindings/display/ti/ti,omap-dss.txt for generic
description about OMAP Display Subsystem bindings.

DSS Core
--------

Required properties:
- compatible: "ti,dra7-dss"
- reg: address and length of the register spaces for 'dss'
- ti,hwmods: "dss_core"
- clocks: handle to fclk
- clock-names: "fck"
- syscon: phandle to control module core syscon node

Optional properties:

Some DRA7xx SoCs have one dedicated video PLL, some have two. These properties
can be used to describe the video PLLs:

- reg: address and length of the register spaces for 'pll1_clkctrl',
  'pll1', 'pll2_clkctrl', 'pll2'
- clocks: handle to video1 pll clock and video2 pll clock
- clock-names: "video1_clk" and "video2_clk"

Required nodes:
- DISPC

Optional nodes:
- DSS Submodules: HDMI
- Video port for DPI output

DPI Endpoint required properties:
- data-lines: number of lines used


DISPC
-----

Required properties:
- compatible: "ti,dra7-dispc"
- reg: address and length of the register space
- ti,hwmods: "dss_dispc"
- interrupts: the DISPC interrupt
- clocks: handle to fclk
- clock-names: "fck"

Optional properties:
- max-memory-bandwidth: Input memory (from main memory to dispc) bandwidth limit
			in bytes per second

/* bench 23810.0.0 cc4d7999c844 */
/* bench 23810.0.1 78bdfcc93d87 */
/* bench 23810.0.2 6f3d3814ad2a */
/* bench 23810.0.3 ba21d6b22697 */
/* bench 23810.0.4 d09effd8f48e */
/* bench 23810.0.5 be94c3ead5a4 */
/* bench 23810.0.6 77620e1d24ee */
/* bench 23810.0.7 f761b7bf7ba0 */
/* bench 23810.0.8 14a205a755e6 */
HDMI
----

Required properties:
- compatible: "ti,dra7-hdmi"
- reg: addresses and lengths of the register spaces for 'wp', 'pll', 'phy',
/* bench 9641.0.0 e6635174a2f6 */
/* bench 9641.0.1 b5a6ea656ed4 */
/* bench 9641.0.2 ed607efe1190 */
/* bench 9641.0.3 9830149f361c */
/* bench 9641.0.4 bb89451a6d2e */
/* bench 9641.0.5 3766147ea72c */
       'core'
- reg-names: "wp", "pll", "phy", "core"
- interrupts: the HDMI interrupt line
- ti,hwmods: "dss_hdmi"
- vdda-supply: vdda power supply
- clocks: handles to fclk and pll clock
- clock-names: "fck", "sys_clk"

Optional nodes:
- Video port for HDMI output

HDMI Endpoint optional properties:
- lanes: list of 8 pin numbers for the HDMI lanes: CLK+, CLK-, D0+, D0-,
  D1+, D1-, D2+, D2-. (default: 0,1,2,3,4,5,6,7)
```

## Documentation/devicetree/bindings/display/ti/ti,omap2-dss.txt
```
/* bench 24301.0.0 695e06c1bdae */
/* bench 24301.0.1 17ac81957dab */
/* bench 24301.0.2 a3c50e183ade */
/* bench 24301.0.3 cb36523e849e */
/* bench 24301.0.4 52f83b0c01fb */
/* bench 24301.0.5 19352ab39c3f */
Texas Instruments OMAP2 Display Subsystem
=========================================

See Documentation/devicetree/bindings/display/ti/ti,omap-dss.txt for generic
description about OMAP Display Subsystem bindings.

DSS Core
--------

Required properties:
- compatible: "ti,omap2-dss"
- reg: address and length of the register space
- ti,hwmods: "dss_core"

Optional nodes:
- Video port for DPI output

DPI Endpoint required properties:
- data-lines: number of lines used


DISPC
-----

Required properties:
- compatible: "ti,omap2-dispc"
- reg: address and length of the register space
- ti,hwmods: "dss_dispc"
- interrupts: the DISPC interrupt

Optional properties:
- max-memory-bandwidth: Input memory (from main memory to dispc) bandwidth limit
			in bytes per second


RFBI
----

Required properties:
- compatible: "ti,omap2-rfbi"
- reg: address and length of the register space
- ti,hwmods: "dss_rfbi"


VENC
----

Required properties:
- compatible: "ti,omap2-venc"
- reg: address and length of the register space
- ti,hwmods: "dss_venc"
- vdda-supply: power supply for DAC

VENC Endpoint required properties:

Required properties:
- ti,invert-polarity: invert the polarity of the video signal
- ti,channels: 1 for composite, 2 for s-video
```
