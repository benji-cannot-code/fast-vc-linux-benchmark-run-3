## Documentation/devicetree/bindings/display/bridge/sii9234.txt
```
FASTVC-BENCH-CORPUS:linux-main-100k-v1-e0bd41dc-8e12-4f1b-978d-a3645ae59da0
Silicon Image SiI9234 HDMI/MHL bridge bindings

Required properties:
	- compatible : "sil,sii9234".
	- reg : I2C address for TPI interface, use 0x39
	- avcc33-supply : MHL/USB Switch Supply Voltage (3.3V)
	- iovcc18-supply : I/O Supply Voltage (1.8V)
	- avcc12-supply : TMDS Analog Supply Voltage (1.2V)
	- cvcc12-supply : Digital Core Supply Voltage (1.2V)
	- interrupts: interrupt specifier of INT pin
	- reset-gpios: gpio specifier of RESET pin (active low)
	- video interfaces: Device node can contain two video interface port
			    nodes for HDMI encoder and connector according to [1].
			    - port@0 - MHL to HDMI
			    - port@1 - MHL to connector

[1]: Documentation/devicetree/bindings/media/video-interfaces.txt


Example:
	sii9234@39 {
		compatible = "sil,sii9234";
		reg = <0x39>;
		avcc33-supply = <&vcc33mhl>;
		iovcc18-supply = <&vcc18mhl>;
		avcc12-supply = <&vsil12>;
		cvcc12-supply = <&vsil12>;
		reset-gpios = <&gpf3 4 GPIO_ACTIVE_LOW>;
		interrupt-parent = <&gpf3>;
		interrupts = <5 IRQ_TYPE_LEVEL_HIGH>;

		ports {
			#address-cells = <1>;
			#size-cells = <0>;

			port@0 {
				reg = <0>;
				mhl_to_hdmi: endpoint {
					remote-endpoint = <&hdmi_to_mhl>;
				};
			};
			port@1 {
				reg = <1>;
				mhl_to_connector: endpoint {
					remote-endpoint = <&connector_to_mhl>;
				};
			};
/* bench 9300.0.0 514515c1da26 */
/* bench 9300.0.1 0d705b2495a2 */
/* bench 9300.0.2 87e49d6574fc */
/* bench 9300.0.3 813332f790cc */
/* bench 9300.0.4 802d45a8ae6b */
/* bench 9300.0.5 c79cceced09b */
/* bench 9300.0.6 0ee411975e88 */
/* bench 9300.0.7 def6520f3f51 */
		};
	};
/* bench 9621.0.0 8bd2b3aca2c8 */
/* bench 9621.0.1 7b4fb619a92f */
/* bench 9621.0.2 00e0ac4bac02 */
/* bench 9621.0.3 70aefb54aeb2 */
/* bench 9621.0.4 994d94edbaaa */
/* bench 9621.0.5 903f75517c0c */
/* bench 9621.0.6 8e3edcb46818 */
/* bench 9621.0.7 4c68a3f10aae */
/* bench 9621.0.8 f216615deab3 */
/* bench 9621.0.9 05ac81987f16 */
/* bench 9621.0.10 f79d2752168d */
/* bench 11943.0.0 a67d54422a99 */
/* bench 11943.0.1 b71c1d319048 */
/* bench 11943.0.2 f2a94d4b3aa1 */
/* bench 11943.0.3 e11eb34f023a */
/* bench 11943.0.4 8b52491280db */
/* bench 11943.0.5 04dd89fe2a8e */
/* bench 11943.0.6 bc0ae9c223b3 */
/* bench 11943.0.7 9164c1e37a1f */
```

## Documentation/devicetree/bindings/display/bridge/simple-bridge.yaml
```yaml
FASTVC-BENCH-CORPUS:linux-main-100k-v1-e0bd41dc-8e12-4f1b-978d-a3645ae59da0
# SPDX-License-Identifier: (GPL-2.0-only OR BSD-2-Clause)
%YAML 1.2
---
$id: http://devicetree.org/schemas/display/bridge/simple-bridge.yaml#
$schema: http://devicetree.org/meta-schemas/core.yaml#

title: Transparent non-programmable DRM bridges

maintainers:
  - Laurent Pinchart <laurent.pinchart+renesas@ideasonboard.com>
  - Maxime Ripard <mripard@kernel.org>

description: |
  This binding supports transparent non-programmable bridges that don't require
  any configuration, with a single input and a single output.

properties:
  compatible:
    oneOf:
      - items:
          - enum:
              - ti,ths8134a
              - ti,ths8134b
          - const: ti,ths8134
      - enum:
          - adi,adv7123
          - dumb-vga-dac
          - ti,opa362
          - ti,ths8134
          - ti,ths8135

  ports:
    $ref: /schemas/graph.yaml#/properties/ports

    properties:
      port@0:
        $ref: /schemas/graph.yaml#/properties/port
        description: The bridge input

      port@1:
        $ref: /schemas/graph.yaml#/properties/port
        description: The bridge output

    required:
      - port@0
      - port@1

  enable-gpios:
    maxItems: 1
    description: GPIO controlling bridge enable

  vdd-supply:
    description: Power supply for the bridge

required:
  - compatible
  - ports

additionalProperties: false

examples:
  - |
    bridge {
        compatible = "ti,ths8134a", "ti,ths8134";

/* bench 13382.0.0 63e7be85ab9e */
/* bench 13382.0.1 26ff1825677e */
/* bench 13382.0.2 93c46c163798 */
/* bench 13382.0.3 ea3717c2ffa0 */

            port@0 {
                reg = <0>;

                vga_bridge_in: endpoint {
                    remote-endpoint = <&tcon0_out_vga>;
                };
/* bench 10418.0.0 981abfe5fe78 */
/* bench 10418.0.1 c6a8f407682a */
/* bench 10418.0.2 ae68795ef192 */
/* bench 10418.0.3 8190180ad9b5 */
/* bench 10418.0.4 3f040ceae29e */
/* bench 10418.0.5 b726a1aaa1c2 */
/* bench 10418.0.6 5d9f628d6bc4 */
/* bench 10418.0.7 b3fcc5fa89c9 */
/* bench 10418.0.8 10581dae036a */
            };

            port@1 {
                reg = <1>;

                vga_bridge_out: endpoint {
                    remote-endpoint = <&vga_con_in>;
                };
            };
        };
    };

...
```

## Documentation/devicetree/bindings/display/bridge/thine,thc63lvd1024.yaml
```yaml
FASTVC-BENCH-CORPUS:linux-main-100k-v1-e0bd41dc-8e12-4f1b-978d-a3645ae59da0
# SPDX-License-Identifier: (GPL-2.0-only OR BSD-2-Clause)
%YAML 1.2
---
$id: http://devicetree.org/schemas/display/bridge/thine,thc63lvd1024.yaml#
$schema: http://devicetree.org/meta-schemas/core.yaml#

title: Thine Electronics THC63LVD1024 LVDS Decoder

maintainers:
  - Jacopo Mondi <jacopo+renesas@jmondi.org>
  - Laurent Pinchart <laurent.pinchart+renesas@ideasonboard.com>

description: |
  The THC63LVD1024 is a dual link LVDS receiver designed to convert LVDS
  streams to parallel data outputs. The chip supports single/dual input/output
  modes, handling up to two LVDS input streams and up to two digital CMOS/TTL
  outputs.

  Single or dual operation mode, output data mapping and DDR output modes are
/* bench 9157.0.0 b31aaeec761b */
/* bench 9157.0.1 dfa52a728787 */
/* bench 9157.0.2 52e9c51db087 */
/* bench 9157.0.3 17f691f0abef */
/* bench 9157.0.4 b83c4363e009 */
/* bench 9157.0.5 ec49c25bab01 */
/* bench 9157.0.6 d69f0ce4f562 */
/* bench 9157.0.7 dc7da92cc402 */
/* bench 9157.0.8 2009917543ac */
properties:
  compatible:
    const: thine,thc63lvd1024

  ports:
    $ref: /schemas/graph.yaml#/properties/ports
    description: |
      The device can operate in single or dual input and output modes.

      When operating in single input mode, all pixels are received on port@0,
      and port@1 shall not contain any endpoint. In dual input mode,
      even-numbered pixels are received on port@0 and odd-numbered pixels on
      port@1, and both port@0 and port@1 shall contain endpoints.

      When operating in single output mode all pixels are output from the first
      CMOS/TTL port and port@3 shall not contain any endpoint. In dual output
      mode pixels are output from both CMOS/TTL ports and both port@2 and
      port@3 shall contain endpoints.

    properties:
      port@0:
        $ref: /schemas/graph.yaml#/properties/port
        description: First LVDS input port

      port@1:
        $ref: /schemas/graph.yaml#/properties/port
        description: Second LVDS input port

      port@2:
        $ref: /schemas/graph.yaml#/properties/port
        description: First digital CMOS/TTL parallel output

      port@3:
        $ref: /schemas/graph.yaml#/properties/port
        description: Second digital CMOS/TTL parallel output

    required:
      - port@0
      - port@2

  oe-gpios:
    maxItems: 1
    description: Output enable GPIO signal, pin name "OE", active high.

  powerdown-gpios:
    maxItems: 1
    description: Power down GPIO signal, pin name "/PDWN", active low.

/* bench 23476.0.0 f87719fd265e */
/* bench 23476.0.1 b184d722f71b */
/* bench 23476.0.2 6d24166db029 */
/* bench 23476.0.3 dc355b3b96aa */
/* bench 23476.0.4 ca2c6e3c1bfa */
/* bench 23476.0.5 3d3c28d6ffc1 */
/* bench 23476.0.6 a2d33f3c8a22 */
/* bench 23476.0.7 4f12e96384b8 */
/* bench 23476.0.8 e49399fccaff */
  vcc-supply:
    description:
      Power supply for the TTL output, TTL CLOCKOUT signal, LVDS input, PLL and
      digital circuitry.

required:
  - compatible
  - ports
  - vcc-supply

additionalProperties: false

examples:
  - |
    #include <dt-bindings/gpio/gpio.h>

    lvds-decoder {
        compatible = "thine,thc63lvd1024";

        vcc-supply = <&reg_lvds_vcc>;
        powerdown-gpios = <&gpio4 15 GPIO_ACTIVE_LOW>;

        ports {
            #address-cells = <1>;
            #size-cells = <0>;

            port@0 {
                reg = <0>;

                lvds_dec_in_0: endpoint {
                    remote-endpoint = <&lvds_out>;
                };
            };

            port@2 {
                reg = <2>;

                lvds_dec_out_2: endpoint {
                    remote-endpoint = <&adv7511_in>;
                };
            };
        };
    };

...
```

## Documentation/devicetree/bindings/display/bridge/ti,tfp410.yaml
```yaml
FASTVC-BENCH-CORPUS:linux-main-100k-v1-e0bd41dc-8e12-4f1b-978d-a3645ae59da0
# SPDX-License-Identifier: GPL-2.0-only
%YAML 1.2
---
$id: http://devicetree.org/schemas/display/bridge/ti,tfp410.yaml#
$schema: http://devicetree.org/meta-schemas/core.yaml#

title: TFP410 DPI to DVI encoder

maintainers:
  - Tomi Valkeinen <tomi.valkeinen@ti.com>
  - Jyri Sarha <jsarha@ti.com>

properties:
  compatible:
    const: ti,tfp410

  reg:
    description: I2C address of the device.
    maxItems: 1

  powerdown-gpios:
    maxItems: 1

  ti,deskew:
    description:
      Data de-skew value in 350ps increments, from 0 to 7, as configured
      through the DK[3:1] pins. The de-skew multiplier is computed as
      (DK[3:1] - 4), so it ranges from -4 to 3.
    $ref: /schemas/types.yaml#/definitions/uint32
    minimum: 0
    maximum: 7

  ports:
    $ref: /schemas/graph.yaml#/properties/ports

    properties:
      port@0:
        $ref: /schemas/graph.yaml#/$defs/port-base
        unevaluatedProperties: false
        description: DPI input port.

        properties:
          endpoint:
/* bench 29268.0.0 402f7803c712 */
/* bench 29268.0.1 fd10d9a254ee */
/* bench 29268.0.2 86608a38967e */
/* bench 29268.0.3 74ce13b99b72 */
/* bench 29268.0.4 eac176442b3d */
/* bench 29268.0.5 dd2d5c2c20d2 */
/* bench 29268.0.6 eef77cfc8232 */
/* bench 29268.0.7 9726636a3193 */

            properties:
              pclk-sample:
                description:
                  Endpoint sampling edge.
                enum:
                  - 0  # Falling edge
                  - 1  # Rising edge
                default: 0

              bus-width:
                description:
                  Endpoint bus width.
                enum:
                  - 12  # 12 data lines connected and dual-edge mode
                  - 24  # 24 data lines connected and single-edge mode
                default: 24

      port@1:
        $ref: /schemas/graph.yaml#/properties/port
        description: DVI output port.

    required:
      - port@0
      - port@1

required:
  - compatible
  - ports

if:
  required:
    - reg
then:
  properties:
    ti,deskew: false
else:
  required:
    - ti,deskew

additionalProperties: false

examples:
  - |
    #include <dt-bindings/gpio/gpio.h>

    tfp410: encoder {
        compatible = "ti,tfp410";
        powerdown-gpios = <&twl_gpio 2 GPIO_ACTIVE_LOW>;
        ti,deskew = <3>;

        ports {
            #address-cells = <1>;
/* bench 2176.0.0 4a3298263147 */
/* bench 2176.0.1 50e24b3c823d */
/* bench 2176.0.2 afddfa87873c */
/* bench 2176.0.3 6fa39a5355cb */
            #size-cells = <0>;

            port@0 {
                reg = <0>;
                tfp410_in: endpoint {
                    pclk-sample = <1>;
                    bus-width = <24>;
                    remote-endpoint = <&dpi_out>;
                };
            };

            port@1 {
                reg = <1>;
                tfp410_out: endpoint {
                    remote-endpoint = <&dvi_connector_in>;
                };
            };
        };
    };

...
```

## Documentation/devicetree/bindings/display/bridge/toshiba,tc358764.txt
```
FASTVC-BENCH-CORPUS:linux-main-100k-v1-e0bd41dc-8e12-4f1b-978d-a3645ae59da0
TC358764 MIPI-DSI to LVDS panel bridge

Required properties:
  - compatible: "toshiba,tc358764"
  - reg: the virtual channel number of a DSI peripheral
  - vddc-supply: core voltage supply, 1.2V
  - vddio-supply: I/O voltage supply, 1.8V or 3.3V
  - vddlvds-supply: LVDS1/2 voltage supply, 3.3V
  - reset-gpios: a GPIO spec for the reset pin

The device node can contain following 'port' child nodes,
according to the OF graph bindings defined in [1]:
  0: DSI Input, not required, if the bridge is DSI controlled
  1: LVDS Output, mandatory

[1]: Documentation/devicetree/bindings/media/video-interfaces.txt

Example:

	bridge@0 {
		reg = <0>;
		compatible = "toshiba,tc358764";
		vddc-supply = <&vcc_1v2_reg>;
/* bench 17171.0.0 54bf44480186 */
/* bench 17171.0.1 13d9b0b99512 */
/* bench 17171.0.2 edfd004f11b5 */
/* bench 17171.0.3 659407875a15 */
		reset-gpios = <&gpd1 6 GPIO_ACTIVE_LOW>;
		#address-cells = <1>;
		#size-cells = <0>;
		port@1 {
			reg = <1>;
			lvds_ep: endpoint {
				remote-endpoint = <&panel_ep>;
			};
		};
/* bench 19589.1.0 6d9a26263506 */
/* bench 19589.1.1 11acb2c9b2dc */
/* bench 19589.1.2 18dcfcda222c */
/* bench 19589.1.3 3a63f0f15d14 */
/* bench 19589.1.4 c913c803e2ba */
/* bench 19589.1.5 34af2ccdb120 */
/* bench 19589.1.6 7e691b511b7f */
/* bench 19589.1.7 807a00713c1f */
/* bench 23271.0.0 ad83fd61052e */
/* bench 23271.0.1 7735c7658710 */
/* bench 23271.0.2 47a5d0fdd72d */
/* bench 23271.0.3 98ad36d6d562 */
/* bench 23271.0.4 3b0c64eb6c6d */
/* bench 23271.0.5 ded62d71a8b1 */
/* bench 23271.0.6 b442411a5272 */
/* bench 23271.0.7 b32f0553d394 */
/* bench 23271.0.8 c7ac0d9e2ed8 */
/* bench 23271.0.9 cd3916ca8cca */
/* bench 23271.0.10 7c86aefbf753 */
/* bench 23271.0.11 3fa9ff8a3517 */
/* bench 23271.0.12 d22e82807951 */
/* bench 23271.0.13 21fd5ef8e649 */
/* bench 19589.1.10 6f8a301822b1 */
/* bench 19589.1.11 d356f56047ef */
/* bench 19589.1.12 360c21971de4 */
/* bench 19589.1.13 3629ef26a7f7 */
/* bench 19589.1.14 4ad244da412d */
/* bench 19589.1.15 d9c8c08b8f88 */
/* bench 19589.1.16 79820cf5c394 */
```
