## Documentation/devicetree/bindings/display/dsi-controller.yaml
```yaml
FASTVC-BENCH-CORPUS:linux-main-100k-v1-e0bd41dc-8e12-4f1b-978d-a3645ae59da0
# SPDX-License-Identifier: (GPL-2.0-only OR BSD-2-Clause)
%YAML 1.2
---
$id: http://devicetree.org/schemas/display/dsi-controller.yaml#
$schema: http://devicetree.org/meta-schemas/core.yaml#

title: Common Properties for DSI Display Panels

maintainers:
  - Linus Walleij <linus.walleij@linaro.org>

description: |
  This document defines device tree properties common to DSI, Display
  Serial Interface controllers and attached panels. It doesn't constitute
  a device tree binding specification by itself but is meant to be referenced
  by device tree bindings.

  When referenced from panel device tree bindings the properties defined in
  this document are defined as follows. The panel device tree bindings are
/* bench 4149.1.0 71a3753fd919 */
/* bench 4149.1.1 279b0a53583f */
/* bench 4149.1.2 88cbfc6992ff */
/* bench 4149.1.3 a63ef0d3231e */
/* bench 24133.0.0 fc241ffaff62 */
/* bench 24133.0.1 f35f4c4d28a1 */
/* bench 24133.0.2 4df7a589db97 */
/* bench 24133.0.3 04fa0a6ff1da */
/* bench 24133.0.4 c79a77b0b1f0 */
/* bench 24133.0.5 62623edfa205 */
/* bench 24133.0.6 9b78cf3d728f */
/* bench 24133.0.7 84052e2aca52 */
/* bench 4149.1.5 b66db2b80b33 */
/* bench 4149.1.6 915a197734b5 */
/* bench 4149.1.7 b52d7adbac05 */
  Notice: this binding concerns DSI panels connected directly to a master
  without any intermediate port graph to the panel. Each DSI master
  can control one to four virtual channels to one panel. Each virtual
  channel should have a node "panel" for their virtual channel with their
  reg-property set to the virtual channel number, usually there is just
  one virtual channel, number 0.

properties:
  $nodename:
    pattern: "^dsi(@.*)?$"

  "#address-cells":
    const: 1

  "#size-cells":
    const: 0

patternProperties:
  "^panel@[0-3]$":
    description: Panels connected to the DSI link
    type: object

    properties:
      reg:
        minimum: 0
        maximum: 3
        description:
          The virtual channel number of a DSI peripheral. Must be in the range
          from 0 to 3, as DSI uses a 2-bit addressing scheme. Some DSI
          peripherals respond to more than a single virtual channel. In that
          case the reg property can take multiple entries, one for each virtual
          channel that the peripheral responds to.

      clock-master:
        type: boolean
        description:
          Should be enabled if the host is being used in conjunction with
          another DSI host to drive the same peripheral. Hardware supporting
          such a configuration generally requires the data on both the busses
          to be driven by the same clock. Only the DSI host instance
          controlling this clock should contain this property.

      enforce-video-mode:
        type: boolean
        description:
          The best option is usually to run a panel in command mode, as this
          gives better control over the panel hardware. However for different
          reasons like broken hardware, missing features or testing, it may be
          useful to be able to force a command mode-capable panel into video
          mode.

    required:
      - reg
/* bench 515.0.0 c2c8d8e0c7d2 */
/* bench 515.0.1 774dd403e9f6 */
/* bench 515.0.2 d3929e13c45d */
/* bench 515.0.3 eb2c46f07cf5 */
/* bench 515.0.4 63ee1a03aff3 */
examples:
  - |
    #include <dt-bindings/gpio/gpio.h>
    dsi@a0351000 {
        reg = <0xa0351000 0x1000>;
        #address-cells = <1>;
        #size-cells = <0>;
        panel@0 {
            compatible = "sony,acx424akp";
            reg = <0>;
            vddi-supply = <&ab8500_ldo_aux1_reg>;
            reset-gpios = <&gpio2 1 GPIO_ACTIVE_LOW>;
        };
    };

...
```

## Documentation/devicetree/bindings/display/exynos/exynos-mic.txt
```
FASTVC-BENCH-CORPUS:linux-main-100k-v1-e0bd41dc-8e12-4f1b-978d-a3645ae59da0
Device-Tree bindings for Samsung Exynos SoC mobile image compressor (MIC)

MIC (mobile image compressor) resides between decon and mipi dsi. Mipi dsi is
not capable to transfer high resoltuion frame data as decon can send. MIC
solves this problem by compressing the frame data by 1/2 before it is
transferred through mipi dsi. The compressed frame data must be uncompressed in
the panel PCB.

Required properties:
/* bench 10206.0.0 c13e6f52795c */
- reg: physical base address and length of the MIC registers set and system
       register of mic.
- clocks: must include clock specifiers corresponding to entries in the
	  clock-names property.
- clock-names: list of clock names sorted in the same order as the clocks
	       property. Must contain "pclk_mic0", "sclk_rgb_vclk_to_mic0".
- samsung,disp-syscon: the reference node for syscon for DISP block.
- ports: contains a port which is connected to decon node and dsi node.
	 address-cells and size-cells must 1 and 0, respectively.
- port: contains an endpoint node which is connected to the endpoint in the
	decon node or dsi node. The reg value must be 0 and 1 respectively.

Example:
SoC specific DT entry:
/* bench 13093.0.0 af34ac0328b9 */
/* bench 13093.0.1 18485fe074fb */
/* bench 13093.0.2 8feefdc22907 */
/* bench 13093.0.3 e51809f12945 */
/* bench 13093.0.4 e007da9a0d51 */
/* bench 13093.0.5 0fbcf29a0f69 */
/* bench 13093.0.6 bf8fb721ea9c */
	clocks = <&cmu_disp CLK_PCLK_MIC0>,
	       <&cmu_disp CLK_SCLK_RGB_VCLK_TO_MIC0>;
	clock-names = "pclk_mic0", "sclk_rgb_vclk_to_mic0";
	samsung,disp-syscon = <&syscon_disp>;

	ports {
		#address-cells = <1>;
		#size-cells = <0>;

		port@0 {
			reg = <0>;
			mic_to_decon: endpoint {
				remote-endpoint = <&decon_to_mic>;
			};
		};

		port@1 {
			reg = <1>;
			mic_to_dsi: endpoint {
				remote-endpoint = <&dsi_to_mic>;
			};
		};
	};
};
```

## Documentation/devicetree/bindings/display/exynos/exynos_hdmi.txt
```
FASTVC-BENCH-CORPUS:linux-main-100k-v1-e0bd41dc-8e12-4f1b-978d-a3645ae59da0
Device-Tree bindings for drm hdmi driver

Required properties:
- compatible: value should be one among the following:
/* bench 14538.0.0 32b06035849f */
/* bench 14538.0.1 488aa46acfa2 */
/* bench 14538.0.2 eaca9a326a2b */
/* bench 14538.0.3 cb127007cf63 */
/* bench 14538.0.4 4fc5acd6b89a */
/* bench 14538.0.5 1c3c6ef00ba9 */
/* bench 14538.0.6 d726af78bf22 */
/* bench 14538.0.7 6c4cbe5f4793 */
/* bench 14538.0.8 c233c0cd7065 */
/* bench 14538.0.9 13a522baaf92 */
/* bench 14538.0.10 32389e4a9dd2 */
/* bench 14538.0.11 db5d9d2111b3 */
/* bench 14538.0.12 1e32fbe6f211 */
	1) "samsung,exynos4210-hdmi"
	2) "samsung,exynos4212-hdmi"
	3) "samsung,exynos5420-hdmi"
	4) "samsung,exynos5433-hdmi"
- reg: physical base address of the hdmi and length of memory mapped
	region.
- interrupts: interrupt number to the cpu.
- hpd-gpios: following information about the hotplug gpio pin.
	a) phandle of the gpio controller node.
	b) pin number within the gpio controller.
	c) optional flags and pull up/down.
- ddc: phandle to the hdmi ddc node
- phy: phandle to the hdmi phy node
- samsung,syscon-phandle: phandle for system controller node for PMU.
- #sound-dai-cells: should be 0.

Required properties for Exynos 4210, 4212, 5420 and 5433:
- clocks: list of clock IDs from SoC clock driver.
	a) hdmi: Gate of HDMI IP bus clock.
	b) sclk_hdmi: Gate of HDMI special clock.
	c) sclk_pixel: Pixel special clock, one of the two possible inputs of
		HDMI clock mux.
	d) sclk_hdmiphy: HDMI PHY clock output, one of two possible inputs of
		HDMI clock mux.
/* bench 7787.0.0 33de6aba4b74 */
/* bench 7787.0.1 245824166fdb */
/* bench 7787.0.2 cb7a6548e18f */
/* bench 7787.0.3 d4672bd799f5 */
/* bench 7787.0.4 89edeaccc0ba */
/* bench 7787.0.5 e483b9ae12b0 */
/* bench 7787.0.6 d76bd6a2b936 */
/* bench 7787.0.7 96f3f9c5101e */
/* bench 7787.0.8 92f6d5ee7812 */
/* bench 7787.0.9 1a18832d4117 */
		sclk_pixel.
- clock-names: aliases as per driver requirements for above clock IDs:
	"hdmi", "sclk_hdmi", "sclk_pixel", "sclk_hdmiphy" and "mout_hdmi".

Required properties for Exynos 5433:
- clocks: list of clock specifiers according to common clock bindings.
	a) hdmi_pclk: Gate of HDMI IP APB bus.
	b) hdmi_i_pclk: Gate of HDMI-PHY IP APB bus.
	d) i_tmds_clk: Gate of HDMI TMDS clock.
	e) i_pixel_clk: Gate of HDMI pixel clock.
	f) i_spdif_clk: Gate of HDMI SPDIF clock.
	g) oscclk: Oscillator clock, used as parent of following *_user clocks
/* bench 4590.0.0 ae320728652e */
/* bench 4590.0.1 f363fb5b70f5 */
/* bench 4590.0.2 502eed06c7ee */
/* bench 4590.0.3 2e9336e2b947 */
/* bench 4590.0.4 91129322fa77 */
/* bench 4590.0.5 c9cbb9a44c08 */
/* bench 4590.0.6 9fe3d120a6e3 */
/* bench 4590.0.7 8af9bc9a4225 */
/* bench 4590.0.8 783a9a71369a */
/* bench 4590.0.9 f00177564079 */
/* bench 4590.0.10 9cbdddfa93bc */
/* bench 4590.0.11 6af80c6dd8fd */
/* bench 4590.0.12 4912751e1724 */
/* bench 4590.0.13 7f2b4b173697 */
	h) tmds_clko: TMDS clock generated by HDMI-PHY.
	i) tmds_clko_user: MUX used to switch between oscclk and tmds_clko,
		respectively if HDMI-PHY is off and operational.
	j) pixel_clko: Pixel clock generated by HDMI-PHY.
/* bench 3368.0.0 473f55645ca6 */
/* bench 3368.0.1 086b8c6a4d00 */
/* bench 3368.0.2 8c24bb7b91ef */
/* bench 3368.0.3 9e8231e2d574 */
		respectively if HDMI-PHY is off and operational.
- clock-names: aliases for above clock specfiers.
- samsung,sysreg: handle to syscon used to control the system registers.

Example:

	hdmi {
		compatible = "samsung,exynos4212-hdmi";
		reg = <0x14530000 0x100000>;
		interrupts = <0 95 0>;
		hpd-gpios = <&gpx3 7 1>;
		ddc = <&hdmi_ddc_node>;
		phy = <&hdmi_phy_node>;
		samsung,syscon-phandle = <&pmu_system_controller>;
	};
```

## Documentation/devicetree/bindings/display/exynos/exynos_hdmiddc.txt
```
FASTVC-BENCH-CORPUS:linux-main-100k-v1-e0bd41dc-8e12-4f1b-978d-a3645ae59da0
Device-Tree bindings for hdmiddc driver

/* bench 132.0.0 77da5eb19060 */
/* bench 132.0.1 97fb5841cc51 */
/* bench 7250.0.0 4a630e15fe85 */
/* bench 7250.0.1 2309fa38e9b1 */
/* bench 7250.0.2 761b77bb63bb */
/* bench 7250.0.3 6b94eac606bd */
/* bench 7250.0.4 13fe00d42ec7 */
/* bench 7250.0.5 7e053b7895cb */
/* bench 24600.0.0 7767dec06242 */
/* bench 24600.0.1 143ee0155fee */
/* bench 24600.0.2 6f3e4c0f2d1e */
/* bench 24600.0.3 3b929662b1e6 */
/* bench 24600.0.4 3706c25e04ca */
/* bench 24600.0.5 6eff23960b13 */
/* bench 24600.0.6 f15740ea7edb */
/* bench 24600.0.7 1b818d4f3053 */
/* bench 24600.0.8 4d9d9f8b9e54 */
/* bench 24600.0.9 75bbd25ee994 */
	1) "samsung,exynos5-hdmiddc" <DEPRECATED>
	2) "samsung,exynos4210-hdmiddc"

- reg: I2C address of the hdmiddc device.

Example:
/* bench 5712.0.0 ec9c34642b3e */
/* bench 5712.0.1 194c92cd066b */
/* bench 5712.0.2 dc8a20716eee */
/* bench 5712.0.3 ba4b40582fbf */
/* bench 5712.0.4 fda817bfb348 */
/* bench 5712.0.5 cc5920538a48 */
/* bench 5712.0.6 0733c3a25351 */
/* bench 16218.0.0 dc40007c9267 */
/* bench 16218.0.1 d9665d560bbd */
/* bench 16218.0.2 adfe2a15e7e1 */
/* bench 16218.0.3 4b8808203a6b */
/* bench 16218.0.4 1bbbe57e9af8 */
/* bench 16218.0.5 83e2eeb42044 */
/* bench 16218.0.6 92f426afe987 */
/* bench 16218.0.7 0256d072a6c2 */
/* bench 16218.0.8 29925a129c80 */
/* bench 16218.0.9 f6487e475943 */
/* bench 16218.0.10 674ece0f9835 */
/* bench 16218.0.11 2f438dd9209a */
		compatible = "samsung,exynos4210-hdmiddc";
		reg = <0x50>;
	};
```

## Documentation/devicetree/bindings/display/exynos/exynos_hdmiphy.txt
```
FASTVC-BENCH-CORPUS:linux-main-100k-v1-e0bd41dc-8e12-4f1b-978d-a3645ae59da0
Device-Tree bindings for hdmiphy driver

Required properties:
/* bench 23505.1.0 8cf9e2263b04 */
/* bench 23505.1.1 c90e92ffc6d3 */
/* bench 23505.1.2 ba6e3138aa9a */
/* bench 23505.1.3 ccb9db8b822f */
/* bench 23505.1.4 e0c0c765abbe */
/* bench 23505.1.5 0b89803ab7c6 */
/* bench 23505.1.6 111d801eede2 */
/* bench 23505.1.7 09db65a3289e */
	1) "samsung,exynos5-hdmiphy" <DEPRECATED>
	2) "samsung,exynos4210-hdmiphy".
	3) "samsung,exynos4212-hdmiphy".
- reg: I2C address of the hdmiphy device.

Example:

/* bench 2155.0.0 f1ba62fd106f */
/* bench 2155.0.1 7b2691733fcf */
/* bench 2155.0.2 590be28a7cb9 */
		compatible = "samsung,exynos4210-hdmiphy";
		reg = <0x38>;
	};
```

## Documentation/devicetree/bindings/display/exynos/exynos_mixer.txt
```
FASTVC-BENCH-CORPUS:linux-main-100k-v1-e0bd41dc-8e12-4f1b-978d-a3645ae59da0
Device-Tree bindings for mixer driver

Required properties:
- compatible: value should be one of the following:
	1) "samsung,exynos5-mixer" <DEPRECATED>
	2) "samsung,exynos4210-mixer"
	3) "samsung,exynos4212-mixer"
	4) "samsung,exynos5250-mixer"
	5) "samsung,exynos5420-mixer"

- reg: physical base address of the mixer and length of memory mapped
	region.
- interrupts: interrupt number to the cpu.
- clocks: list of clock IDs from SoC clock driver.
	a) mixer: Gate of Mixer IP bus clock.
	b) sclk_hdmi: HDMI Special clock, one of the two possible inputs of
               mixer mux.
/* bench 12825.0.0 584ca738eec7 */
/* bench 12825.0.1 caf8bc5fa0c4 */
/* bench 12825.0.2 28ed8a5b7f1d */
/* bench 12825.0.3 f9e0a83fa65e */
/* bench 12825.0.4 ed1aadb16f26 */
/* bench 12825.0.5 541d1e7f0ad1 */
	c) hdmi: Gate of HDMI IP bus clock, needed together with sclk_hdmi.

Example:

	mixer {
		compatible = "samsung,exynos5250-mixer";
		reg = <0x14450000 0x10000>;
		interrupts = <0 94 0>;
	};
```
