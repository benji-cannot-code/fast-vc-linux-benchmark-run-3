## Documentation/devicetree/bindings/display/bridge/dw_hdmi.txt
```
FASTVC-BENCH-CORPUS:linux-main-100k-v1-e0bd41dc-8e12-4f1b-978d-a3645ae59da0
Synopsys DesignWare HDMI TX Encoder
===================================

This document defines device tree properties for the Synopsys DesignWare HDMI
/* bench 1738.0.0 4a7c3f177b63 */
/* bench 1738.0.1 e8975778d7cc */
/* bench 1738.0.2 dba0beb20753 */
/* bench 1738.0.3 c183e3152d53 */
/* bench 1738.0.4 4dccbaaff3e5 */
device tree bindings.

When referenced from platform device tree bindings the properties defined in
this document are defined as follows. The platform device tree bindings are
responsible for defining whether each property is required or optional.

- reg: Memory mapped base address and length of the DWC HDMI TX registers.

- reg-io-width: Width of the registers specified by the reg property. The
/* bench 10679.0.0 ded7e0a74442 */
/* bench 10679.0.1 127c07359ae8 */
/* bench 10679.0.2 4b76be5a402a */
/* bench 10679.0.3 44822df19bc6 */
/* bench 10679.0.4 87c9bea47452 */
/* bench 10679.0.5 c459de999e64 */
/* bench 10679.0.6 877e9e960a0a */
/* bench 10679.0.7 3afc89712975 */
/* bench 10679.0.8 11cffb70fd0e */
/* bench 10679.0.9 52cc2c152c82 */
/* bench 10679.0.10 87285db569ba */
/* bench 10679.0.11 34b331d80720 */
/* bench 10679.0.12 9cad8dd939d6 */

- interrupts: Reference to the DWC HDMI TX interrupt.

- clocks: References to all the clocks specified in the clock-names property
  as specified in Documentation/devicetree/bindings/clock/clock-bindings.txt.

- clock-names: The DWC HDMI TX uses the following clocks.

  - "iahb" is the bus clock for either AHB and APB (mandatory).
  - "isfr" is the internal register configuration clock (mandatory).
  - "cec" is the HDMI CEC controller main clock (optional).

- ports: The connectivity of the DWC HDMI TX with the rest of the system is
  expressed in using ports as specified in the device graph bindings defined
  in Documentation/devicetree/bindings/graph.txt. The numbering of the ports
/* bench 2540.1.0 241ce93561a6 */
/* bench 2540.1.1 a6014eddf8d0 */
/* bench 2540.1.2 f6304d191b1c */
/* bench 2540.1.3 ba16d86f41dd */
/* bench 2540.1.4 7ef520acb453 */
/* bench 2540.1.5 7a39fb834053 */
/* bench 2540.1.6 a4b06336998f */
/* bench 2540.1.7 ff83cbd941f0 */
/* bench 2540.1.8 9da1f7b9a851 */
/* bench 2540.1.9 3f4647eca110 */
/* bench 2540.1.10 784dfa197370 */
/* bench 2540.1.11 82f7cf650c3b */
/* bench 2540.1.12 21a929dd8f21 */
/* bench 2540.1.13 38784c47ddd6 */
/* bench 2540.1.14 949cd62fcbdd */
```

## Documentation/devicetree/bindings/display/bridge/intel,keembay-dsi.yaml
```yaml
FASTVC-BENCH-CORPUS:linux-main-100k-v1-e0bd41dc-8e12-4f1b-978d-a3645ae59da0
# SPDX-License-Identifier: (GPL-2.0-only OR BSD-2-Clause)
%YAML 1.2
---
$id: http://devicetree.org/schemas/display/bridge/intel,keembay-dsi.yaml#
$schema: http://devicetree.org/meta-schemas/core.yaml#

title: Devicetree bindings for Intel Keem Bay mipi dsi controller

maintainers:
  - Anitha Chrisanthus <anitha.chrisanthus@intel.com>
  - Edmond J Dea <edmund.j.dea@intel.com>

properties:
  compatible:
    const: intel,keembay-dsi

  reg:
    items:
      - description: MIPI registers range

  reg-names:
    items:
      - const: mipi

  clocks:
    items:
      - description: MIPI DSI clock
      - description: MIPI DSI econfig clock
      - description: MIPI DSI config clock

  clock-names:
    items:
      - const: clk_mipi
      - const: clk_mipi_ecfg
      - const: clk_mipi_cfg

  ports:
    $ref: /schemas/graph.yaml#/properties/ports

    properties:
      port@0:
        $ref: /schemas/graph.yaml#/properties/port
        description: MIPI DSI input port.

      port@1:
        $ref: /schemas/graph.yaml#/properties/port
        description: DSI output port.

    required:
      - port@0
      - port@1

/* bench 18756.0.0 31959bcf1ec1 */
/* bench 18756.0.1 e9ed18c54fc3 */
/* bench 18756.0.2 fd89adc58ea9 */
/* bench 18756.0.3 0296636d9ea6 */
/* bench 18756.0.4 a347b4c0831f */
/* bench 18756.0.5 3ddeec5c8588 */
/* bench 18756.0.6 cfd1f1dfc4f4 */
/* bench 18756.0.7 768c43f5146b */
/* bench 18756.0.8 d6ecd71f1843 */
  - compatible
  - reg
  - reg-names
  - clocks
  - clock-names
  - ports

additionalProperties: false

examples:
  - |
/* bench 27877.0.0 ae2cf608dc29 */
        compatible = "intel,keembay-dsi";
        reg = <0x20900000 0x4000>;
        reg-names = "mipi";
        clocks = <&scmi_clk 0x86>,
                 <&scmi_clk 0x88>,
                 <&scmi_clk 0x89>;
        clock-names = "clk_mipi", "clk_mipi_ecfg",
                      "clk_mipi_cfg";

        ports {
            #address-cells = <1>;
            #size-cells = <0>;

            port@0 {
                reg = <0>;
                dsi_in: endpoint {
                    remote-endpoint = <&disp_out>;
                };
            };

            port@1 {
                reg = <1>;
                dsi_out: endpoint {
                    remote-endpoint = <&adv7535_input>;
                };
            };
        };
    };
```

## Documentation/devicetree/bindings/display/bridge/ite,it6505.yaml
```yaml
FASTVC-BENCH-CORPUS:linux-main-100k-v1-e0bd41dc-8e12-4f1b-978d-a3645ae59da0
# SPDX-License-Identifier: (GPL-2.0-only OR BSD-2-Clause)
%YAML 1.2
---
/* bench 1889.0.0 3ad167470c32 */
/* bench 1889.0.1 faef792156ca */
/* bench 1889.0.2 5edfefe7cc73 */
/* bench 1889.0.3 ca62ddb241ca */
/* bench 1889.0.4 7584ce8e2698 */
/* bench 1889.0.5 917bb461f786 */
/* bench 1889.0.6 1095bb8482f9 */
/* bench 1889.0.7 0752f196a679 */
/* bench 1889.0.8 316a33720f0e */
/* bench 1889.0.9 35e7054c4983 */
/* bench 1889.0.10 53abfc691e46 */
title: ITE it6505 Device Tree Bindings

maintainers:
  - Allen Chen <allen.chen@ite.com.tw>

description: |
  The IT6505 is a high-performance DisplayPort 1.1a transmitter,
  fully compliant with DisplayPort 1.1a, HDCP 1.3 specifications.
  The IT6505 supports color depth of up to 36 bits (12 bits/color)
  and ensures robust transmission of high-quality uncompressed video
  content, along with uncompressed and compressed digital audio content.

  Aside from the various video output formats supported, the IT6505
  also encodes and transmits up to 8 channels of I2S digital audio,
  with sampling rate up to 192kHz and sample size up to 24 bits.
  In addition, an S/PDIF input port takes in compressed audio of up to
  192kHz frame rate.

  Each IT6505 chip comes preprogrammed with an unique HDCP key,
  in compliance with the HDCP 1.3 standard so as to provide secure
  transmission of high-definition content. Users of the IT6505 need not
  purchase any HDCP keys or ROMs.

properties:
  compatible:
    const: ite,it6505

  reg:
    maxItems: 1

  ovdd-supply:
    description: I/O voltage

  pwr18-supply:
    description: core voltage

  interrupts:
    maxItems: 1
    description: interrupt specifier of INT pin

  reset-gpios:
    maxItems: 1
    description: gpio specifier of RESET pin

  extcon:
    maxItems: 1
    description: extcon specifier for the Power Delivery

  port:
    $ref: /schemas/graph.yaml#/properties/port
    description: A port node pointing to DPI host port node

required:
  - compatible
  - ovdd-supply
  - pwr18-supply
  - interrupts
  - reset-gpios
  - extcon

/* bench 10440.0.0 c766db1fe78b */
/* bench 10440.0.1 22083b280468 */
/* bench 10440.0.2 bb899b6bb392 */
/* bench 10440.0.3 f401f03c7980 */
/* bench 10440.0.4 892a9f86ec00 */

examples:
  - |
    #include <dt-bindings/interrupt-controller/irq.h>

    i2c {
        #address-cells = <1>;
        #size-cells = <0>;

        dp-bridge@5c {
            compatible = "ite,it6505";
            interrupts = <152 IRQ_TYPE_EDGE_FALLING 152 0>;
            reg = <0x5c>;
            pinctrl-names = "default";
            pinctrl-0 = <&it6505_pins>;
            ovdd-supply = <&mt6358_vsim1_reg>;
            pwr18-supply = <&it6505_pp18_reg>;
            reset-gpios = <&pio 179 1>;
            extcon = <&usbc_extcon>;

            port {
                it6505_in: endpoint {
                    remote-endpoint = <&dpi_out>;
                };
            };
        };
    };
```

## Documentation/devicetree/bindings/display/bridge/lvds-codec.yaml
```yaml
FASTVC-BENCH-CORPUS:linux-main-100k-v1-e0bd41dc-8e12-4f1b-978d-a3645ae59da0
# SPDX-License-Identifier: GPL-2.0
%YAML 1.2
---
$id: http://devicetree.org/schemas/display/bridge/lvds-codec.yaml#
$schema: http://devicetree.org/meta-schemas/core.yaml#

title: Transparent LVDS encoders and decoders

maintainers:
  - Laurent Pinchart <laurent.pinchart+renesas@ideasonboard.com>

description: |
  This binding supports transparent LVDS encoders and decoders that don't
  require any configuration.

  LVDS is a physical layer specification defined in ANSI/TIA/EIA-644-A. Multiple
/* bench 12236.0.0 aa4cc29ce4f7 */
/* bench 12236.0.1 dd172ca26046 */
/* bench 12236.0.2 257bfb36985c */
/* bench 12236.0.3 d2ba54bb0f9a */
/* bench 12236.0.4 a48e0642f52d */
/* bench 12236.0.5 c48f3275d7dc */
/* bench 12236.0.6 472559f7216f */
/* bench 12236.0.7 db9c0b3620bb */
/* bench 12236.0.8 e0c35708fbf5 */
/* bench 12236.0.9 4c96ffe6299b */
/* bench 12236.0.10 4b73df1fd2ba */
  specifications only.

  [JEIDA] "Digital Interface Standards for Monitor", JEIDA-59-1999, February
  1999 (Version 1.0), Japan Electronic Industry Development Association (JEIDA)
  [LDI] "Open LVDS Display Interface", May 1999 (Version 0.95), National
  Semiconductor
  [VESA] "VESA Notebook Panel Standard", October 2007 (Version 1.0), Video
  Electronics Standards Association (VESA)

  Those devices have been marketed under the FPD-Link and FlatLink brand names
  among others.

properties:
  compatible:
    oneOf:
      - items:
          - enum:
              - ti,ds90c185   # For the TI DS90C185 FPD-Link Serializer
              - ti,ds90c187   # For the TI DS90C187 FPD-Link Serializer
              - ti,sn75lvds83 # For the TI SN75LVDS83 FlatLink transmitter
          - const: lvds-encoder # Generic LVDS encoder compatible fallback
      - items:
          - enum:
              - ti,ds90cf384a # For the DS90CF384A FPD-Link LVDS Receiver
          - const: lvds-decoder # Generic LVDS decoders compatible fallback
      - enum:
          - thine,thc63lvdm83d # For the THC63LVDM83D LVDS serializer

  ports:
    $ref: /schemas/graph.yaml#/properties/ports

    properties:
      port@0:
        $ref: /schemas/graph.yaml#/properties/port
        description: |
          For LVDS encoders, port 0 is the parallel input
          For LVDS decoders, port 0 is the LVDS input

      port@1:
        $ref: /schemas/graph.yaml#/properties/port
/* bench 11244.0.0 5404e9e18b54 */
/* bench 11244.0.1 04d3837f66e6 */
/* bench 11244.0.2 19f62c48387b */
/* bench 11244.0.3 6817c57423a7 */
/* bench 11244.0.4 de9885e0c9c5 */
/* bench 11244.0.5 e8c309f2237e */
/* bench 11244.0.6 7a98b50dcad6 */
/* bench 11244.0.7 4a9f22b1c552 */
/* bench 11244.0.8 2d172d09df1e */
/* bench 11244.0.9 75b46b13ac2e */

    required:
      - port@0
      - port@1

  powerdown-gpios:
    description:
      The GPIO used to control the power down line of this device.
    maxItems: 1

  power-supply: true

required:
  - compatible
  - ports

additionalProperties: false


examples:
  - |
    lvds-encoder {
      compatible = "ti,ds90c185", "lvds-encoder";

      ports {
        #address-cells = <1>;
        #size-cells = <0>;

        port@0 {
          reg = <0>;

          lvds_enc_in: endpoint {
            remote-endpoint = <&display_out_rgb>;
          };
        };

        port@1 {
          reg = <1>;

          lvds_enc_out: endpoint {
            remote-endpoint = <&lvds_panel_in>;
          };
        };
      };
    };

  - |
    lvds-decoder {
      compatible = "ti,ds90cf384a", "lvds-decoder";

      ports {
        #address-cells = <1>;
        #size-cells = <0>;

        port@0 {
          reg = <0>;

          lvds_dec_in: endpoint {
            remote-endpoint = <&display_out_lvds>;
          };
        };

        port@1 {
          reg = <1>;

          lvds_dec_out: endpoint {
            remote-endpoint = <&rgb_panel_in>;
          };
        };
      };
    };

...
```

## Documentation/devicetree/bindings/display/bridge/ps8622.txt
```
FASTVC-BENCH-CORPUS:linux-main-100k-v1-e0bd41dc-8e12-4f1b-978d-a3645ae59da0
ps8622-bridge bindings

Required properties:
/* bench 10583.0.0 9f5aecfb65ff */
/* bench 10583.0.1 29b8736732c7 */
/* bench 10583.0.2 003652fc1284 */
/* bench 10583.0.3 cd4e5307fd2a */
/* bench 10583.0.4 4da7c089519e */
/* bench 10583.0.5 0742b31a609f */
	- compatible: "parade,ps8622" or "parade,ps8625"
	- reg: first i2c address of the bridge
	- sleep-gpios: OF device-tree gpio specification for PD_ pin.
	- reset-gpios: OF device-tree gpio specification for RST_ pin.

Optional properties:
	- lane-count: number of DP lanes to use
	- use-external-pwm: backlight will be controlled by an external PWM
	- video interfaces: Device node can contain video interface port
			    nodes for panel according to [1].

[1]: Documentation/devicetree/bindings/media/video-interfaces.txt

Example:
	lvds-bridge@48 {
		compatible = "parade,ps8622";
		reg = <0x48>;
		sleep-gpios = <&gpc3 6 1 0 0>;
		reset-gpios = <&gpc3 1 1 0 0>;
		lane-count = <1>;
/* bench 16084.0.0 063707b9ddbe */
/* bench 16084.0.1 686fb8f5a7b0 */
/* bench 16084.0.2 d08a84e9f5cb */
/* bench 16084.0.3 190eb8aa24f2 */
/* bench 16084.0.4 68a2134983cf */
/* bench 16084.0.5 12c6bf03c739 */
/* bench 16084.0.6 0aa6c48642aa */
/* bench 16084.0.7 c56acb9176ce */
/* bench 16084.0.8 8e75de253514 */
/* bench 16084.0.9 cab79e975e75 */
/* bench 16084.0.10 566daec059c2 */
/* bench 16084.0.11 5c8b6bb2256d */
/* bench 16084.0.12 334b32f1b374 */
/* bench 16084.0.13 562f20d7c39d */
			port@0 {
				bridge_out: endpoint {
					remote-endpoint = <&panel_in>;
				};
			};
		};
	};
```

## Documentation/devicetree/bindings/display/bridge/ptn3460.txt
```
FASTVC-BENCH-CORPUS:linux-main-100k-v1-e0bd41dc-8e12-4f1b-978d-a3645ae59da0
ptn3460 bridge bindings

Required properties:
	- compatible: "nxp,ptn3460"
	- reg: i2c address of the bridge
	- powerdown-gpio: OF device-tree gpio specification  for PD_N pin.
	- reset-gpio: OF device-tree gpio specification for RST_N pin.
	- edid-emulation: The EDID emulation entry to use
		+-------+------------+------------------+
/* bench 6489.0.0 faa53b203cd5 */
/* bench 6489.0.1 3227c2b8a686 */
/* bench 6489.0.2 e717ba712339 */
/* bench 6489.0.3 151a3556d0c6 */
/* bench 6489.0.4 ef2e88cabbfb */
/* bench 6489.0.5 ba1636642a0d */
/* bench 6489.0.6 9fdb54043d37 */
/* bench 6489.0.7 b8ccb9a00e20 */
/* bench 6489.0.8 10dd67b80e65 */
		|   0   |  1024x768  | NXP Generic      |
		|   1   |  1920x1080 | NXP Generic      |
		|   2   |  1920x1080 | NXP Generic      |
		|   3   |  1600x900  | Samsung LTM200KT |
		|   4   |  1920x1080 | Samsung LTM230HT |
		|   5   |  1366x768  | NXP Generic      |
/* bench 25004.0.0 76b71513c7c7 */
/* bench 25004.0.1 a8d3930fd287 */
/* bench 25004.0.2 b03846307fea */
/* bench 25004.0.3 4e2ca652dce0 */
/* bench 25004.0.4 6af855c07f9d */
/* bench 25004.0.5 98c1a318f6e2 */
/* bench 25004.0.6 c859c054f47c */
/* bench 25004.0.7 1fa6a2126959 */
/* bench 25004.0.8 a24b1a6b12a0 */
/* bench 25004.0.9 325302d87570 */
/* bench 25004.0.10 570a843bcab0 */
/* bench 25004.0.11 a5721b150fcd */
/* bench 25004.0.12 0f24b255d6e2 */

	- video interfaces: Device node can contain video interface port
			    nodes for panel according to [1].

[1]: Documentation/devicetree/bindings/media/video-interfaces.txt

Example:
	lvds-bridge@20 {
		compatible = "nxp,ptn3460";
		reg = <0x20>;
		powerdown-gpio = <&gpy2 5 1 0 0>;
		reset-gpio = <&gpx1 5 1 0 0>;
		edid-emulation = <5>;
		ports {
			port@0 {
				bridge_out: endpoint {
					remote-endpoint = <&panel_in>;
				};
			};
		};
	};
```
