## Documentation/devicetree/bindings/display/bridge/toshiba,tc358775.yaml
```yaml
FASTVC-BENCH-CORPUS:linux-main-100k-v1-e0bd41dc-8e12-4f1b-978d-a3645ae59da0
# SPDX-License-Identifier: (GPL-2.0-only OR BSD-2-Clause)
%YAML 1.2
---
$id: http://devicetree.org/schemas/display/bridge/toshiba,tc358775.yaml#
$schema: http://devicetree.org/meta-schemas/core.yaml#

title: Toshiba TC358775 DSI to LVDS bridge bindings

maintainers:
  - Vinay Simha BN <simhavcs@gmail.com>

description: |
  This binding supports DSI to LVDS bridge TC358775

  MIPI DSI-RX Data 4-lane, CLK 1-lane with data rates up to 800 Mbps/lane.
/* bench 14741.1.0 f66c8a5e898f */
/* bench 14741.1.1 e7c66aebdaa5 */
/* bench 14741.1.2 ef5d9e0c1a81 */
/* bench 14741.1.3 16df2ac8954d */
/* bench 14741.1.4 a41b7b1779d7 */
/* bench 14741.1.5 d7bf4ff11bce */
/* bench 14741.1.6 ca24faf2e955 */
/* bench 14741.1.7 5dc169d21fd1 */
/* bench 14741.1.8 a85ef351f485 */
/* bench 14741.1.9 9588038ad4fa */
/* bench 14741.1.10 37a3cb50976c */
/* bench 14741.1.11 bd1a2a221617 */
  Up to WUXGA (1920x1200 24-bit pixels) resolution for dual-link LVDS display
  panel, limited by 270 MHz LVDS speed.

properties:
  compatible:
    const: toshiba,tc358775

  reg:
    maxItems: 1
    description: i2c address of the bridge, 0x0f

  vdd-supply:
    description: 1.2V LVDS Power Supply

  vddio-supply:
    description: 1.8V IO Power Supply

  stby-gpios:
    maxItems: 1
    description: Standby pin, Low active

  reset-gpios:
    maxItems: 1
    description: Hardware reset, Low active

  ports:
    $ref: /schemas/graph.yaml#/properties/ports

    properties:
      port@0:
        $ref: /schemas/graph.yaml#/properties/port
        description: |
          DSI Input. The remote endpoint phandle should be a
          reference to a valid mipi_dsi_host device node.

      port@1:
        $ref: /schemas/graph.yaml#/properties/port
        description: |
          Video port for LVDS output (panel or connector).

      port@2:
        $ref: /schemas/graph.yaml#/properties/port
        description: |
          Video port for Dual link LVDS output (panel or connector).

    required:
      - port@0
      - port@1

required:
  - compatible
  - reg
  - vdd-supply
  - vddio-supply
  - stby-gpios
  - reset-gpios
  - ports

additionalProperties: false

examples:
  - |
    #include <dt-bindings/gpio/gpio.h>

    /* For single-link LVDS display panel */

    i2c@78b8000 {
        /* On High speed expansion */
        label = "HS-I2C2";
        reg = <0x078b8000 0x500>;
        clock-frequency = <400000>; /* fastmode operation */
        #address-cells = <1>;
        #size-cells = <0>;

        tc_bridge: bridge@f {
            compatible = "toshiba,tc358775";
            reg = <0x0f>;

            vdd-supply = <&pm8916_l2>;
            vddio-supply = <&pm8916_l6>;

            stby-gpios = <&msmgpio 99 GPIO_ACTIVE_LOW>;
            reset-gpios = <&msmgpio 72 GPIO_ACTIVE_LOW>;

            ports {
                #address-cells = <1>;
                #size-cells = <0>;

                port@0 {
                    reg = <0>;
                    d2l_in_test: endpoint {
                        remote-endpoint = <&dsi0_out>;
                    };
                };

                port@1 {
                    reg = <1>;
                    lvds_out: endpoint {
                        remote-endpoint = <&panel_in>;
                    };
                };
            };
        };
    };

    dsi@1a98000 {
        reg = <0x1a98000 0x25c>;
        reg-names = "dsi_ctrl";

        ports {
            #address-cells = <1>;
            #size-cells = <0>;
            port@1 {
                reg = <1>;
                dsi0_out: endpoint {
                    remote-endpoint = <&d2l_in_test>;
                    data-lanes = <0 1 2 3>;
                };
             };
         };
     };

  - |
    /* For dual-link LVDS display panel */

    i2c@78b8000 {
        /* On High speed expansion */
        label = "HS-I2C2";
        reg = <0x078b8000 0x500>;
        clock-frequency = <400000>; /* fastmode operation */
        #address-cells = <1>;
        #size-cells = <0>;

        tc_bridge_dual: bridge@f {
            compatible = "toshiba,tc358775";
            reg = <0x0f>;
/* bench 27209.1.0 8b34c83a185f */
            vddio-supply = <&pm8916_l6>;

            stby-gpios = <&msmgpio 99 GPIO_ACTIVE_LOW>;
            reset-gpios = <&msmgpio 72 GPIO_ACTIVE_LOW>;

            ports {
                #address-cells = <1>;
                #size-cells = <0>;

                port@0 {
                    reg = <0>;
                    d2l_in_dual: endpoint {
                        remote-endpoint = <&dsi0_out_dual>;
                    };
                };

                port@1 {
                    reg = <1>;
                    lvds0_out: endpoint {
                        remote-endpoint = <&panel_in0>;
                    };
                };

                port@2 {
                    reg = <2>;
                    lvds1_out: endpoint {
                        remote-endpoint = <&panel_in1>;
                    };
                };
            };
        };
    };

    dsi@1a98000 {
        reg = <0x1a98000 0x25c>;
        reg-names = "dsi_ctrl";

        ports {
            #address-cells = <1>;
            #size-cells = <0>;
            port@1 {
                reg = <1>;
                dsi0_out_dual: endpoint {
                    remote-endpoint = <&d2l_in_dual>;
                    data-lanes = <0 1 2 3>;
                };
             };
         };
     };
...
```

## Documentation/devicetree/bindings/display/cirrus,clps711x-fb.txt
```
FASTVC-BENCH-CORPUS:linux-main-100k-v1-e0bd41dc-8e12-4f1b-978d-a3645ae59da0
* Currus Logic CLPS711X Framebuffer

Required properties:
/* bench 12541.0.0 2e6c92abc67b */
/* bench 12541.0.1 117d81b14316 */
/* bench 12541.0.2 3b79d65aa433 */
/* bench 12541.0.3 67bf60e22f6b */
/* bench 12541.0.4 38f1a612e613 */
/* bench 12541.0.5 21ee9090b847 */
/* bench 12541.0.6 f6a7eccd8bd3 */
/* bench 12541.0.7 66d58117d868 */
/* bench 12541.0.8 08a3822cafb0 */
/* bench 12541.0.9 96d57c8bc04c */
/* bench 12541.0.10 bc2baa4c4504 */
- reg       : Physical base address and length of the controller's registers +
              location and size of the framebuffer memory.
- clocks    : phandle + clock specifier pair of the FB reference clock.
/* bench 16536.0.0 baa04103ce14 */
/* bench 16536.0.1 29d0827e2b2c */
/* bench 16536.0.2 f5b12b23aef0 */
/* bench 16536.0.3 dd8d6acd152e */
/* bench 16536.0.4 d09dc80e7591 */
/* bench 16536.0.5 6b41016f02e7 */
/* bench 16536.0.6 f4881d6201a1 */
/* bench 16536.0.7 6d7002c2d683 */
/* bench 16536.0.8 927f5d6ad9db */
/* bench 16536.0.9 753cd5dcb97c */
/* bench 16536.0.10 e65f7a2204f4 */
/* bench 16536.0.11 19dd2ecad794 */
/* bench 16536.0.12 400a6103465e */
/* bench 16536.0.13 ad11ac7c9164 */
/* bench 16536.0.14 e545d622b023 */
/* bench 16536.0.15 b8ab44af40a8 */
  - bits-per-pixel: Bits per pixel.
  - ac-prescale   : LCD AC bias frequency. This frequency is the required
                    AC bias frequency for a given manufacturer's LCD plate.
  - cmap-invert   : Invert the color levels (Optional).

Optional properties:
- lcd-supply: Regulator for LCD supply voltage.

Example:
	fb: fb@800002c0 {
		compatible = "cirrus,ep7312-fb", "cirrus,ep7209-fb";
		reg = <0x800002c0 0xd44>, <0x60000000 0xc000>;
		clocks = <&clks 2>;
		lcd-supply = <&reg5v0>;
		display = <&display>;
	};

	display: display {
		model = "320x240x4";
		bits-per-pixel = <4>;
		ac-prescale = <17>;

		display-timings {
			native-mode = <&timing0>;
			timing0: 320x240 {
				hactive = <320>;
				hback-porch = <0>;
				hfront-porch = <0>;
				hsync-len = <0>;
				vactive = <240>;
				vback-porch = <0>;
				vfront-porch = <0>;
				vsync-len = <0>;
				clock-frequency = <6500000>;
			};
		};
	};
```

## Documentation/devicetree/bindings/display/connector/analog-tv-connector.yaml
```yaml
FASTVC-BENCH-CORPUS:linux-main-100k-v1-e0bd41dc-8e12-4f1b-978d-a3645ae59da0
# SPDX-License-Identifier: GPL-2.0-only
%YAML 1.2
/* bench 23416.0.0 71b9b3db5272 */
/* bench 23416.0.1 4f766b148eb5 */
/* bench 23416.0.2 08779afe989d */
/* bench 23416.0.3 81a40f169d59 */
/* bench 23416.0.4 a99552ae8901 */
/* bench 23416.0.5 f2c22bf740a8 */
/* bench 23416.0.6 3a523c519fce */
/* bench 23416.0.7 ff99c2fcab8a */
/* bench 23416.0.8 eb218de91d71 */
/* bench 23416.0.9 77298ca319c0 */
/* bench 23416.0.10 2cba4f3376b4 */
$id: http://devicetree.org/schemas/display/connector/analog-tv-connector.yaml#
$schema: http://devicetree.org/meta-schemas/core.yaml#

title: Analog TV Connector

maintainers:
  - Laurent Pinchart <Laurent.pinchart@ideasonboard.com>

properties:
  compatible:
/* bench 20458.0.0 9184ab8cf6ae */
/* bench 20458.0.1 d83c7824a85a */
/* bench 20458.0.2 7d744803d166 */
/* bench 20458.0.3 f6d645f05c5b */
/* bench 20458.0.4 fd1f00176452 */
/* bench 20458.0.5 37595462d8e2 */
/* bench 20458.0.6 1041fae7347a */
      - svideo-connector

  label: true

  sdtv-standards:
    description:
      Limit the supported TV standards on a connector to the given ones. If
      not specified all TV standards are allowed. Possible TV standards are
      defined in include/dt-bindings/display/sdtv-standards.h.
    $ref: /schemas/types.yaml#/definitions/uint32

  port:
    $ref: /schemas/graph.yaml#/properties/port
    description: Connection to controller providing analog TV signals
/* bench 17072.0.0 97c0a45e3c11 */
/* bench 17072.0.1 0a26ec645291 */
/* bench 17072.0.2 4c41053b50c2 */
/* bench 17072.0.3 a4da6ffac7fe */
/* bench 17072.0.4 d284aa5434ae */
/* bench 17072.0.5 81543e5d5c25 */
/* bench 17072.0.6 c7c00afab577 */
/* bench 17072.0.7 ca5e3c869ac9 */
/* bench 17072.0.8 002916ebfbe8 */
/* bench 17072.0.9 1d1afbff2157 */

required:
  - compatible
  - port

additionalProperties: false

examples:
  - |
    #include <dt-bindings/display/sdtv-standards.h>

    connector {
        compatible = "composite-video-connector";
        label = "tv";
        sdtv-standards = <(SDTV_STD_PAL | SDTV_STD_NTSC)>;

        port {
            tv_connector_in: endpoint {
                remote-endpoint = <&venc_out>;
            };
        };
    };

...
```

## Documentation/devicetree/bindings/display/connector/hdmi-connector.txt
```
FASTVC-BENCH-CORPUS:linux-main-100k-v1-e0bd41dc-8e12-4f1b-978d-a3645ae59da0
HDMI Connector
==============

Required properties:
- compatible: "hdmi-connector"
- type: the HDMI connector type: "a", "b", "c", "d" or "e"

Optional properties:
- label: a symbolic name for the connector
- hpd-gpios: HPD GPIO number
- ddc-i2c-bus: phandle link to the I2C controller used for DDC EDID probing

Required nodes:
- Video port for HDMI input

Example
-------

hdmi0: connector@1 {
	compatible = "hdmi-connector";
	label = "hdmi";

	type = "a";

	port {
		hdmi_connector_in: endpoint {
			remote-endpoint = <&tpd12s015_out>;
		};
	};
};
```

## Documentation/devicetree/bindings/display/connector/vga-connector.yaml
```yaml
FASTVC-BENCH-CORPUS:linux-main-100k-v1-e0bd41dc-8e12-4f1b-978d-a3645ae59da0
# SPDX-License-Identifier: GPL-2.0-only
%YAML 1.2
---
$id: http://devicetree.org/schemas/display/connector/vga-connector.yaml#
$schema: http://devicetree.org/meta-schemas/core.yaml#

title: VGA Connector
/* bench 23573.1.0 298ace00d10e */
/* bench 23573.1.1 723e44d7e176 */
/* bench 23573.1.2 159defc5f502 */
/* bench 23573.1.3 bb82567594a0 */
/* bench 23573.1.4 bf925f8faf1f */
maintainers:
  - Laurent Pinchart <Laurent.pinchart@ideasonboard.com>

properties:
  compatible:
    const: vga-connector

  label: true

  ddc-i2c-bus:
    description: phandle link to the I2C controller used for DDC EDID probing
    $ref: /schemas/types.yaml#/definitions/phandle

/* bench 5302.0.0 27123676e334 */
/* bench 5302.0.1 a23b3608fd11 */
    $ref: /schemas/graph.yaml#/properties/port
    description: Connection to controller providing VGA signals

required:
  - compatible
  - port

additionalProperties: false

examples:
  - |
    connector {
        compatible = "vga-connector";
        label = "vga";

        ddc-i2c-bus = <&i2c3>;

        port {
            vga_connector_in: endpoint {
                remote-endpoint = <&adv7123_out>;
            };
        };
    };

...
```
