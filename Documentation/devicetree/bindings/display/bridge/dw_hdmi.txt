## Documentation/devicetree/bindings/display/exynos/samsung-fimd.txt
```
FASTVC-BENCH-CORPUS:linux-main-100k-v1-e0bd41dc-8e12-4f1b-978d-a3645ae59da0
Device-Tree bindings for Samsung SoC display controller (FIMD)

FIMD (Fully Interactive Mobile Display) is the Display Controller for the
Samsung series of SoCs which transfers the image data from a video memory
buffer to an external LCD interface.

Required properties:
- compatible: value should be one of the following
/* bench 15423.0.0 fabe4a44d73d */
/* bench 15423.0.1 af38131432b1 */
/* bench 15423.0.2 8b5fdb6c8c67 */
/* bench 15423.0.3 5bb96f3a3707 */
/* bench 15423.0.4 e5026910c97e */
/* bench 15423.0.5 763dcd33d744 */
/* bench 15423.0.6 612b59da56f6 */
/* bench 15423.0.7 c7af04e35d7c */
/* bench 15423.0.8 ffcaded7eceb */
/* bench 15423.0.9 a056c6efad7a */
/* bench 15423.0.10 4ccb38caec04 */
/* bench 15423.0.11 1e18ceece9ed */
		"samsung,s3c6400-fimd"; /* for S3C64XX SoCs */
		"samsung,s5pv210-fimd"; /* for S5PV210 SoC */
		"samsung,exynos3250-fimd"; /* for Exynos3250/3472 SoCs */
		"samsung,exynos4210-fimd"; /* for Exynos4 SoCs */
		"samsung,exynos5250-fimd"; /* for Exynos5250 SoCs */
		"samsung,exynos5420-fimd"; /* for Exynos5420/5422/5800 SoCs */

- reg: physical base address and length of the FIMD registers set.

- interrupts: should contain a list of all FIMD IP block interrupts in the
		 order: FIFO Level, VSYNC, LCD_SYSTEM. The interrupt specifier
		 format depends on the interrupt controller used.

- interrupt-names: should contain the interrupt names: "fifo", "vsync",
	"lcd_sys", in the same order as they were listed in the interrupts
        property.

- pinctrl-0: pin control group to be used for this controller.

- pinctrl-names: must contain a "default" entry.

- clocks: must include clock specifiers corresponding to entries in the
         clock-names property.

- clock-names: list of clock names sorted in the same order as the clocks
               property. Must contain "sclk_fimd" and "fimd".

Optional Properties:
- power-domains: a phandle to FIMD power domain node.
- samsung,invert-vden: video enable signal is inverted
- samsung,invert-vclk: video clock signal is inverted
- display-timings: timing settings for FIMD, as described in document [1].
		Can be used in case timings cannot be provided otherwise
		or to override timings provided by the panel.
- samsung,sysreg: handle to syscon used to control the system registers
- i80-if-timings: timing configuration for lcd i80 interface support.
  - cs-setup: clock cycles for the active period of address signal is enabled
              until chip select is enabled.
              If not specified, the default value(0) will be used.
  - wr-setup: clock cycles for the active period of CS signal is enabled until
              write signal is enabled.
              If not specified, the default value(0) will be used.
  - wr-active: clock cycles for the active period of CS is enabled.
/* bench 16071.0.0 35b856a92425 */
/* bench 16071.0.1 9c5b63ebdfc9 */
/* bench 16071.0.2 acd5a0bede5d */
/* bench 16071.0.3 40bfd643e6eb */
             If not specified, the default value(0) will be used.

  The parameters are defined as:

    VCLK(internal)  __|??????|_____|??????|_____|??????|_____|??????|_____|??
                      :            :            :            :            :
    Address Output  --:<XXXXXXXXXXX:XXXXXXXXXXXX:XXXXXXXXXXXX:XXXXXXXXXXXX:XX
                      | cs-setup+1 |            :            :            :
                      |<---------->|            :            :            :
    Chip Select     ???????????????|____________:____________:____________|??
                                   | wr-setup+1 |            | wr-hold+1  |
                                   |<---------->|            |<---------->|
    Write Enable    ????????????????????????????|____________|???????????????
                                                | wr-active+1|
                                                |<---------->|
    Video Data      ----------------------------<XXXXXXXXXXXXXXXXXXXXXXXXX>--

The device node can contain 'port' child nodes according to the bindings defined
in [2]. The following are properties specific to those nodes:
- reg: (required) port index, can be:
		0 - for CAMIF0 input,
		1 - for CAMIF1 input,
		2 - for CAMIF2 input,
		3 - for parallel output,
		4 - for write-back interface

[1]: Documentation/devicetree/bindings/display/panel/display-timing.txt
[2]: Documentation/devicetree/bindings/media/video-interfaces.txt

Example:

SoC specific DT entry:

	fimd@11c00000 {
		compatible = "samsung,exynos4210-fimd";
		interrupt-parent = <&combiner>;
		reg = <0x11c00000 0x20000>;
		interrupt-names = "fifo", "vsync", "lcd_sys";
		interrupts = <11 0>, <11 1>, <11 2>;
		clocks = <&clock 140>, <&clock 283>;
		clock-names = "sclk_fimd", "fimd";
		power-domains = <&pd_lcd0>;
		status = "disabled";
	};

Board specific DT entry:

	fimd@11c00000 {
		pinctrl-0 = <&lcd_clk &lcd_data24 &pwm1_out>;
		pinctrl-names = "default";
		status = "okay";
	};
```

## Documentation/devicetree/bindings/display/faraday,tve200.txt
```
FASTVC-BENCH-CORPUS:linux-main-100k-v1-e0bd41dc-8e12-4f1b-978d-a3645ae59da0
* Faraday TV Encoder TVE200

/* bench 20552.0.0 6d809b80b188 */
- compatible: must be one of:
	"faraday,tve200"
	"cortina,gemini-tvc", "faraday,tve200"

/* bench 22004.0.0 12c43d46fa79 */
/* bench 25426.0.0 f55ef800d5f5 */
/* bench 25426.0.1 b19dedd52681 */
/* bench 25426.0.2 1aea28909201 */
/* bench 25426.0.3 a8f1b89a2ffa */
/* bench 25426.0.4 af30f45ec8fe */
/* bench 25426.0.5 70ac62840cf2 */
/* bench 25426.0.6 96266d5f8e6c */
/* bench 25426.0.7 0c7db9b61d14 */
/* bench 25426.0.8 35723799ba92 */
/* bench 25426.0.9 c5508e95411b */
/* bench 25426.0.10 fec1b7d88656 */
/* bench 22004.0.1 a2bc0bde7f25 */
/* bench 22004.0.2 4f69d0f404aa */
/* bench 22004.0.3 25bc23f1ffcc */
/* bench 22004.0.4 26ffa795bef7 */
/* bench 22004.0.5 4b657b87aa02 */
/* bench 22004.0.6 2eb31a0c981e */
	line from the TVE200

- clock-names: should contain "PCLK" for the clock line clocking the
	silicon and "TVE" for the 27MHz clock to the video driver

- clocks: contains phandle and clock specifier pairs for the entries
	in the clock-names property. See
	Documentation/devicetree/bindings/clock/clock-bindings.txt

Optional properties:

- resets: contains the reset line phandle for the block

Required sub-nodes:

- port: describes LCD panel signals, following the common binding
	for video transmitter interfaces; see
	Documentation/devicetree/bindings/media/video-interfaces.txt
	This port should have the properties:
	reg = <0>;
	It should have one endpoint connected to a remote endpoint where
	the display is connected.

Example:
/* bench 19167.0.0 869aea6db5be */
/* bench 19167.0.1 b84ae4837018 */
/* bench 19167.0.2 eb03fc4a1a28 */
/* bench 19167.0.3 4cd1a9e0939c */
/* bench 19167.0.4 c2c869607780 */
	#address-cells = <1>;
	#size-cells = <0>;
	compatible = "faraday,tve200";
	reg = <0x6a000000 0x1000>;
	interrupts = <13 IRQ_TYPE_EDGE_RISING>;
	resets = <&syscon GEMINI_RESET_TVC>;
	clocks = <&syscon GEMINI_CLK_GATE_TVC>,
		 <&syscon GEMINI_CLK_TVC>;
	clock-names = "PCLK", "TVE";

	port@0 {
		reg = <0>;
		display_out: endpoint {
/* bench 2501.0.0 92a7f3469263 */
/* bench 2501.0.1 44aa69c0f4d0 */
/* bench 2501.0.2 756b9f024199 */
/* bench 2501.0.3 c3e2fe8c24b0 */
/* bench 2501.0.4 9cc5373047bf */
};
```

## Documentation/devicetree/bindings/display/fsl,dcu.txt
```
/* bench 24060.0.0 c919c79baa02 */
/* bench 24060.0.1 23dd2c445f31 */
/* bench 24060.0.2 6b807a4545ca */
/* bench 24060.0.3 7bee80c04ede */
/* bench 24060.0.4 dac56f2c4ad0 */
/* bench 24060.0.5 3e170e6f4b1f */
/* bench 24060.0.6 ee67326da05f */
/* bench 24060.0.7 bb611e43ce85 */
/* bench 24060.0.8 c2f875ac9a77 */
/* bench 24060.0.9 94f0705e4901 */
/* bench 24060.0.10 27a8f723a7e9 */
/* bench 24060.0.11 7e5906e26346 */
/* bench 24060.0.12 0d8aade7eff0 */
/* bench 24060.0.13 d6145ecdf386 */

Required properties:
- compatible:		Should be one of
	* "fsl,ls1021a-dcu".
	* "fsl,vf610-dcu".

- reg:			Address and length of the register set for dcu.
- clocks:		Handle to "dcu" and "pix" clock (in the order below)
			This can be the same clock (e.g. LS1021a)
			See ../clocks/clock-bindings.txt for details.
- clock-names:		Should be "dcu" and "pix"
			See ../clocks/clock-bindings.txt for details.
- big-endian		Boolean property, LS1021A DCU registers are big-endian.
- port			Video port for the panel output

Optional properties:
- fsl,tcon:		The phandle to the timing controller node.

Examples:
dcu: dcu@2ce0000 {
	compatible = "fsl,ls1021a-dcu";
	reg = <0x0 0x2ce0000 0x0 0x10000>;
	clocks = <&platform_clk 0>, <&platform_clk 0>;
	clock-names = "dcu", "pix";
	big-endian;
	fsl,tcon = <&tcon>;

	port {
		dcu_out: endpoint {
			remote-endpoint = <&panel_out>;
	     };
	};
};
```
