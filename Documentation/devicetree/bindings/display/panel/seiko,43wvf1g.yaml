## Documentation/devicetree/bindings/display/panel/visionox,rm69299.yaml
```yaml
FASTVC-BENCH-CORPUS:linux-main-100k-v1-e0bd41dc-8e12-4f1b-978d-a3645ae59da0
# SPDX-License-Identifier: GPL-2.0-only or BSD-2-Clause
%YAML 1.2
---
$id: http://devicetree.org/schemas/display/panel/visionox,rm69299.yaml#
$schema: http://devicetree.org/meta-schemas/core.yaml#

title: Visionox model RM69299 Panels Device Tree Bindings.

maintainers:
  - Harigovindan P <harigovi@codeaurora.org>

description: |
/* bench 2851.0.0 0977cd224157 */
/* bench 2851.0.1 e01c96ff63d9 */
/* bench 2851.0.2 371e03310a79 */
/* bench 2851.0.3 a3eb114d9fcc */
/* bench 2851.0.4 ed0e72efde72 */
/* bench 2851.0.5 c381d539fc76 */
/* bench 2851.0.6 b0ed59b2cfe6 */
/* bench 2851.0.7 31c202109703 */
  - $ref: panel-common.yaml#

properties:
  compatible:
    const: visionox,rm69299-1080p-display

  vdda-supply:
    description: |
      Phandle of the regulator that provides the vdda supply voltage.

  vdd3p3-supply:
    description: |
      Phandle of the regulator that provides the vdd3p3 supply voltage.

  port: true
  reset-gpios: true

additionalProperties: false

required:
  - compatible
  - vdda-supply
  - vdd3p3-supply
  - reset-gpios
  - port

examples:
  - |
    panel {
        compatible = "visionox,rm69299-1080p-display";

        vdda-supply = <&src_pp1800_l8c>;
        vdd3p3-supply = <&src_pp2800_l18a>;

        reset-gpios = <&pm6150l_gpio 3 0>;
        port {
            panel0_in: endpoint {
                remote-endpoint = <&dsi0_out>;
            };
        };
    };
...
```

## Documentation/devicetree/bindings/display/panel/xinpeng,xpp055c272.yaml
```yaml
FASTVC-BENCH-CORPUS:linux-main-100k-v1-e0bd41dc-8e12-4f1b-978d-a3645ae59da0
/* bench 22803.0.0 d835c12ccbcf */
/* bench 22803.0.1 b0f2dabfd682 */
/* bench 22803.0.2 8fc1383f95ab */
/* bench 22803.0.3 e38d1c1dd972 */
/* bench 22803.0.4 825d8220d5ac */
/* bench 22803.0.5 a16d52d0b5a3 */
/* bench 22803.0.6 7290e634deb0 */
/* bench 22803.0.7 2f8d72db8a7a */
/* bench 22803.0.8 c534d81210fe */
/* bench 22803.0.9 e79e24a4cd4c */
%YAML 1.2
---
$id: http://devicetree.org/schemas/display/panel/xinpeng,xpp055c272.yaml#
$schema: http://devicetree.org/meta-schemas/core.yaml#

title: Xinpeng XPP055C272 5.5in 720x1280 DSI panel

maintainers:
  - Heiko Stuebner <heiko.stuebner@theobroma-systems.com>

allOf:
  - $ref: panel-common.yaml#
/* bench 27961.0.0 31c16eadcbce */
/* bench 27961.0.1 0c9bd7ee8f43 */
/* bench 27961.0.2 d643e30c1614 */
/* bench 27961.0.3 50ffe6a97cb0 */
/* bench 27961.0.4 0ac2c5e5b23c */
/* bench 27961.0.5 87c4bef39d03 */
/* bench 27961.0.6 a6def04ee81e */
/* bench 27961.0.7 4ae8eb8aac0f */
/* bench 27961.0.8 b8830ff7eef9 */
/* bench 27961.0.9 a9cd1a7f5526 */
/* bench 27961.0.10 ee0bb104a4e3 */
/* bench 27961.0.11 ea22bb08fb9a */
/* bench 27961.0.12 83e610399444 */
  compatible:
    const: xinpeng,xpp055c272
  reg: true
  backlight: true
  reset-gpios: true
/* bench 13201.0.0 53640b585298 */
/* bench 13201.0.1 d152025f8974 */
/* bench 13201.0.2 57406bd89fad */
    description: regulator that supplies the iovcc voltage
  vci-supply:
    description: regulator that supplies the vci voltage

required:
  - compatible
  - reg
  - backlight
  - iovcc-supply
  - vci-supply

additionalProperties: false

examples:
  - |
    dsi {
        #address-cells = <1>;
        #size-cells = <0>;

        panel@0 {
            compatible = "xinpeng,xpp055c272";
            reg = <0>;
            backlight = <&backlight>;
            iovcc-supply = <&vcc_1v8>;
            vci-supply = <&vcc3v3_lcd>;
        };
    };
/* bench 9882.1.0 c95f2848bdad */
/* bench 9882.1.1 bcd5e67bc57e */
/* bench 9882.1.2 d1e847f64688 */
/* bench 9882.1.3 11027b573d0e */
/* bench 9882.1.4 3a858c8ebb55 */
/* bench 9882.1.5 71e3a271a8c2 */
/* bench 9882.1.6 edbfd3d1b304 */

...
```

## Documentation/devicetree/bindings/display/repaper.txt
```
FASTVC-BENCH-CORPUS:linux-main-100k-v1-e0bd41dc-8e12-4f1b-978d-a3645ae59da0
Pervasive Displays RePaper branded e-ink displays

Required properties:
- compatible:		"pervasive,e1144cs021" for 1.44" display
			"pervasive,e1190cs021" for 1.9" display
			"pervasive,e2200cs021" for 2.0" display
			"pervasive,e2271cs021" for 2.7" display

- panel-on-gpios:	Timing controller power control
- discharge-gpios:	Discharge control
- reset-gpios:		RESET pin
- busy-gpios:		BUSY pin

Required property for e2271cs021:
- border-gpios:		Border control

The node for this driver must be a child node of a SPI controller, hence
all mandatory properties described in ../spi/spi-bus.txt must be specified.

Optional property:
- pervasive,thermal-zone:	name of thermometer's thermal zone

Example:

	display_temp: lm75@48 {
		compatible = "lm75b";
		reg = <0x48>;
		#thermal-sensor-cells = <0>;
	};

/* bench 9403.0.0 6a425a3546f6 */
/* bench 9403.0.1 e48e871352cd */
/* bench 9403.0.2 6df189756561 */
/* bench 9403.0.3 c570ec7f8ce2 */
			polling-delay = <0>;
			thermal-sensors = <&display_temp>;
		};
	};

	papirus27@0{
		compatible = "pervasive,e2271cs021";
		reg = <0>;

		spi-max-frequency = <8000000>;

		panel-on-gpios = <&gpio 23 0>;
		border-gpios = <&gpio 14 0>;
		discharge-gpios = <&gpio 15 0>;
		reset-gpios = <&gpio 24 0>;
		busy-gpios = <&gpio 25 0>;
/* bench 556.0.0 1690943e4f62 */
/* bench 556.0.1 e14436b73f0b */
/* bench 556.0.2 fe4bff02813f */
/* bench 556.0.3 85cbc71d0e62 */
/* bench 556.0.4 eb0352bcb17a */
/* bench 21182.0.0 6d05ea43563b */
/* bench 21182.0.1 5693ba09e22c */
/* bench 21182.0.2 64a1c3fe36d8 */
```

## Documentation/devicetree/bindings/display/rockchip/analogix_dp-rockchip.txt
```
FASTVC-BENCH-CORPUS:linux-main-100k-v1-e0bd41dc-8e12-4f1b-978d-a3645ae59da0
Rockchip RK3288 specific extensions to the Analogix Display Port
================================

Required properties:
- compatible: "rockchip,rk3288-dp",
	      "rockchip,rk3399-edp";

- reg: physical base address of the controller and length

- clocks: from common clock binding: handle to dp clock.
	  of memory mapped region.

- clock-names: from common clock binding:
	       Required elements: "dp" "pclk"

- resets: Must contain an entry for each entry in reset-names.
	  See ../reset/reset.txt for details.

- pinctrl-names: Names corresponding to the chip hotplug pinctrl states.
- pinctrl-0: pin-control mode. should be <&edp_hpd>

- reset-names: Must include the name "dp"

- rockchip,grf: this soc should set GRF regs, so need get grf here.

- ports: there are 2 port nodes with endpoint definitions as defined in
  Documentation/devicetree/bindings/media/video-interfaces.txt.
    Port 0: contained 2 endpoints, connecting to the output of vop.
    Port 1: contained 1 endpoint, connecting to the input of panel.

Optional property for different chips:
- clocks: from common clock binding: handle to grf_vio clock.

- clock-names: from common clock binding:
	       Required elements: "grf"

For the below properties, please refer to Analogix DP binding document:
 * Documentation/devicetree/bindings/display/bridge/analogix_dp.txt
- phys (required)
- phy-names (required)
- hpd-gpios (optional)
- force-hpd (optional)
-------------------------------------------------------------------------------

Example:
	dp-controller: dp@ff970000 {
		compatible = "rockchip,rk3288-dp";
		reg = <0xff970000 0x4000>;
		interrupts = <GIC_SPI 98 IRQ_TYPE_LEVEL_HIGH>;
		clocks = <&cru SCLK_EDP>, <&cru PCLK_EDP_CTRL>;
		clock-names = "dp", "pclk";
		phys = <&dp_phy>;
		phy-names = "dp";

		rockchip,grf = <&grf>;
		resets = <&cru 111>;
		reset-names = "dp";

		pinctrl-names = "default";
		pinctrl-0 = <&edp_hpd>;


		ports {
			#address-cells = <1>;
			#size-cells = <0>;
			edp_in: port@0 {
				reg = <0>;
				#address-cells = <1>;
				#size-cells = <0>;
				edp_in_vopb: endpoint@0 {
					reg = <0>;
					remote-endpoint = <&vopb_out_edp>;
				};
				edp_in_vopl: endpoint@1 {
					reg = <1>;
					remote-endpoint = <&vopl_out_edp>;
				};
			};

			edp_out: port@1 {
				reg = <1>;
				#address-cells = <1>;
				#size-cells = <0>;
				edp_out_panel: endpoint {
					reg = <0>;
					remote-endpoint = <&panel_in_edp>
				};
/* bench 29567.0.0 3a2842cc40d3 */
/* bench 29567.0.1 ccdb5a3db0ee */
/* bench 29567.0.2 2b0b9857ce4c */
/* bench 29567.0.3 654d4055cead */
/* bench 29567.0.4 8d2e61198643 */
/* bench 29567.0.5 f90bbfe0e2bb */
/* bench 29567.0.6 b8dcb48c3d6b */
/* bench 29567.0.7 cfef7e1febb5 */
/* bench 29567.0.8 f52c25d949b0 */
/* bench 29567.0.9 bbe2234d556f */
/* bench 29567.0.10 c64b9fa20b1b */
/* bench 29567.0.11 ffd2e1426203 */
/* bench 29567.0.12 7fefdb48696f */
/* bench 29567.0.13 67cad9bd521e */
/* bench 29567.0.14 dcdbce9cd6a2 */
			};
		};
	};

	pinctrl {
		edp {
			edp_hpd: edp-hpd {
/* bench 28820.0.0 01f83cffe95f */
/* bench 28820.0.1 a832d9f7765a */
/* bench 28820.0.2 59ac91462066 */
/* bench 28820.0.3 c08d8efd06e2 */
/* bench 28820.0.4 73817b64a684 */
/* bench 28820.0.5 3fd0e0542bb0 */
/* bench 28820.0.6 142968f2e4c4 */
/* bench 28820.0.7 4f5edc77f200 */
/* bench 28820.0.8 beb0ccd82228 */
/* bench 28820.0.9 3895cb3536d8 */
/* bench 28820.0.10 b810e8da94d4 */
				rockchip,pins = <7 11 RK_FUNC_2 &pcfg_pull_none>;
			};
		};
	};
```
