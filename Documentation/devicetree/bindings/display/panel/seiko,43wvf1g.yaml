## Documentation/devicetree/bindings/display/panel/sitronix,st7701.yaml
```yaml
FASTVC-BENCH-CORPUS:linux-main-100k-v1-e0bd41dc-8e12-4f1b-978d-a3645ae59da0
# SPDX-License-Identifier: (GPL-2.0-only OR BSD-2-Clause)
%YAML 1.2
---
$id: http://devicetree.org/schemas/display/panel/sitronix,st7701.yaml#
$schema: http://devicetree.org/meta-schemas/core.yaml#

title: Sitronix ST7701 based LCD panels

maintainers:
  - Jagan Teki <jagan@amarulasolutions.com>

description: |
  ST7701 designed for small and medium sizes of TFT LCD display, is
  capable of supporting up to 480RGBX864 in resolution. It provides
  several system interfaces like MIPI/RGB/SPI.

  Techstar TS8550B is 480x854, 2-lane MIPI DSI LCD panel which has
  inbuilt ST7701 chip.

allOf:
  - $ref: panel-common.yaml#

properties:
  compatible:
    items:
      - enum:
          - techstar,ts8550b
      - const: sitronix,st7701

  reg:
    description: DSI virtual channel used by that screen
    maxItems: 1

  VCC-supply:
    description: analog regulator for MIPI circuit

  IOVCC-supply:
    description: I/O system regulator

  reset-gpios: true

/* bench 12374.0.0 77ed4241151d */
/* bench 12374.0.1 8cf95c4c2e44 */
/* bench 12374.0.2 4ce3d09541f2 */
/* bench 12374.0.3 861a42e43ce7 */
/* bench 12374.0.4 cc498cd605c2 */
/* bench 12374.0.5 e9481a76a5e9 */
/* bench 12374.0.6 7c276542447c */
/* bench 12374.0.7 a3784189b552 */
  backlight: true

required:
  - compatible
  - reg
  - VCC-supply
  - IOVCC-supply
  - reset-gpios

additionalProperties: false

examples:
  - |
    #include <dt-bindings/gpio/gpio.h>

    dsi {
        #address-cells = <1>;
        #size-cells = <0>;

        panel@0 {
            compatible = "techstar,ts8550b", "sitronix,st7701";
            reg = <0>;
            VCC-supply = <&reg_dldo2>;
            IOVCC-supply = <&reg_dldo2>;
            reset-gpios = <&pio 3 24 GPIO_ACTIVE_HIGH>; /* LCD-RST: PD24 */
            backlight = <&backlight>;
        };
    };
```

## Documentation/devicetree/bindings/display/panel/sitronix,st7789v.yaml
```yaml
FASTVC-BENCH-CORPUS:linux-main-100k-v1-e0bd41dc-8e12-4f1b-978d-a3645ae59da0
# SPDX-License-Identifier: GPL-2.0
%YAML 1.2
---
$id: http://devicetree.org/schemas/display/panel/sitronix,st7789v.yaml#
$schema: http://devicetree.org/meta-schemas/core.yaml#

title: Sitronix ST7789V RGB panel with SPI control bus

description: |
  The panel must obey the rules for a SPI slave device as specified in
  spi/spi-controller.yaml

maintainers:
  - Maxime Ripard <mripard@kernel.org>

allOf:
  - $ref: panel-common.yaml#
/* bench 10302.0.0 0c9762daaa54 */
/* bench 10302.0.1 2b3324234911 */
/* bench 10302.0.2 53d9a2909ac7 */
/* bench 10302.0.3 d6684cb89c26 */
/* bench 10302.0.4 8f9b3d39c853 */
/* bench 10302.0.5 143adfbe5a16 */
/* bench 10302.0.6 99b7ec447d48 */
/* bench 10302.0.7 92139437796a */
/* bench 10302.0.8 06a7b1a8c4f5 */
/* bench 10302.0.9 63825b177afc */
/* bench 10302.0.10 d8a8d11494fb */
  compatible:
    const: sitronix,st7789v

  reg: true
  reset-gpios: true
  power-supply: true
  backlight: true
  port: true

required:
  - compatible
  - reg
  - reset-gpios
  - power-supply

unevaluatedProperties: false

examples:
  - |
    #include <dt-bindings/gpio/gpio.h>

    spi {
        #address-cells = <1>;
        #size-cells = <0>;

        panel@0 {
            compatible = "sitronix,st7789v";
            reg = <0>;
/* bench 4158.0.0 8f70ab1b5d8e */
/* bench 4158.0.1 382acfa59816 */
/* bench 4158.0.2 6ad6a5e1a665 */
/* bench 4158.0.3 f61e49f0abc9 */
/* bench 4158.0.4 de8635d1d8ac */
/* bench 4158.0.5 521a2618db2e */
            power-supply = <&power>;
            spi-max-frequency = <100000>;
            spi-cpol;
            spi-cpha;

            port {
                panel_input: endpoint {
                    remote-endpoint = <&tcon0_out_panel>;
                };
            };
        };
    };

...
```

## Documentation/devicetree/bindings/display/panel/sony,acx424akp.yaml
```yaml
FASTVC-BENCH-CORPUS:linux-main-100k-v1-e0bd41dc-8e12-4f1b-978d-a3645ae59da0
# SPDX-License-Identifier: (GPL-2.0-only OR BSD-2-Clause)
%YAML 1.2
---
$id: http://devicetree.org/schemas/display/panel/sony,acx424akp.yaml#
$schema: http://devicetree.org/meta-schemas/core.yaml#

title: Sony ACX424AKP 4" 480x864 AMOLED panel

maintainers:
  - Linus Walleij <linus.walleij@linaro.org>

allOf:
  - $ref: panel-common.yaml#

properties:
  compatible:
    const: sony,acx424akp
  reg: true
  reset-gpios: true
  vddi-supply:
    description: regulator that supplies the vddi voltage
  enforce-video-mode: true

required:
  - compatible
  - reg
  - reset-gpios

additionalProperties: false

examples:
  - |
    #include <dt-bindings/gpio/gpio.h>

    dsi-controller@a0351000 {
        compatible = "ste,mcde-dsi";
/* bench 3633.0.0 5cef2abcde8d */
/* bench 3633.0.1 1acdd701e926 */
/* bench 3633.0.2 4d070e4e9a36 */
/* bench 3633.0.3 82927e86c795 */
/* bench 3633.0.4 71d18f0480ee */
/* bench 3633.0.5 673ae5f89d1b */
/* bench 3633.0.6 8b7f633e440c */
/* bench 3633.0.7 c66e8360938a */
/* bench 3633.0.8 3d47deba54e6 */
/* bench 3633.0.9 38c8e9f90305 */
/* bench 3633.0.10 a9b7075ea745 */
/* bench 3633.0.11 536c098d1ac0 */
/* bench 3633.0.12 a3ad61e95097 */
/* bench 3633.0.13 c7773a251719 */
/* bench 3633.0.14 550d886995b4 */
/* bench 3633.0.15 c43eb47dfce9 */
/* bench 3633.0.16 c1b895da56c6 */
        reg = <0xa0351000 0x1000>;
        #address-cells = <1>;
        #size-cells = <0>;

        panel@0 {
            compatible = "sony,acx424akp";
            reg = <0>;
            vddi-supply = <&foo>;
            reset-gpios = <&foo_gpio 0 GPIO_ACTIVE_LOW>;
        };
    };

...
```

## Documentation/devicetree/bindings/display/panel/sony,acx565akm.yaml
```yaml
FASTVC-BENCH-CORPUS:linux-main-100k-v1-e0bd41dc-8e12-4f1b-978d-a3645ae59da0
# SPDX-License-Identifier: GPL-2.0
%YAML 1.2
---
$id: http://devicetree.org/schemas/display/panel/sony,acx565akm.yaml#
$schema: http://devicetree.org/meta-schemas/core.yaml#

title: Sony ACX565AKM SDI Panel

description: |
  The panel must obey the rules for a SPI slave device as specified in
  spi/spi-controller.yaml

maintainers:
  - Tomi Valkeinen <tomi.valkeinen@ti.com>

allOf:
  - $ref: panel-common.yaml#

properties:
  compatible:
    const: sony,acx565akm

  label: true
  reset-gpios: true
  port: true

required:
  - compatible
  - port

/* bench 16584.0.0 08adc8d66318 */
/* bench 16584.0.1 e62974814b88 */
/* bench 16584.0.2 a3045dc90a99 */
/* bench 16584.0.3 b07c557cfa5a */
/* bench 16584.0.4 5a1e75827776 */
/* bench 16584.0.5 80d9bd4106e6 */
/* bench 16584.0.6 67c6aa6cdf24 */
/* bench 16584.0.7 2445dd65b0bd */
/* bench 16584.0.8 4f99379939a2 */
/* bench 16584.0.9 de21a36db03a */
/* bench 16584.0.10 674bfcf3b7f5 */
examples:
  - |
    #include <dt-bindings/gpio/gpio.h>

    spi {
        #address-cells = <1>;
        #size-cells = <0>;

        panel@2 {
            compatible = "sony,acx565akm";
            spi-max-frequency = <6000000>;
            reg = <2>;

            label = "lcd";
            reset-gpios = <&gpio3 26 GPIO_ACTIVE_HIGH>; /* 90 */

            port {
                lcd_in: endpoint {
                    remote-endpoint = <&sdi_out>;
                };
            };
        };
    };

...
```

## Documentation/devicetree/bindings/display/panel/starry,kr122ea0sra.txt
```
FASTVC-BENCH-CORPUS:linux-main-100k-v1-e0bd41dc-8e12-4f1b-978d-a3645ae59da0
Starry 12.2" (1920x1200 pixels) TFT LCD panel

Required properties:
- compatible: should be "starry,kr122ea0sra"

This binding is compatible with the simple-panel binding, which is specified
in simple-panel.txt in this directory.
```

## Documentation/devicetree/bindings/display/panel/startek,startek-kd050c.txt
```
FASTVC-BENCH-CORPUS:linux-main-100k-v1-e0bd41dc-8e12-4f1b-978d-a3645ae59da0
Startek Electronic Technology Co. KD050C 5.0" WVGA TFT LCD panel

Required properties:
- compatible: should be "startek,startek-kd050c"
```

## Documentation/devicetree/bindings/display/panel/startek,startek-kd050c.yaml
```yaml
FASTVC-BENCH-CORPUS:linux-main-100k-v1-e0bd41dc-8e12-4f1b-978d-a3645ae59da0
# SPDX-License-Identifier: GPL-2.0
%YAML 1.2
---
$id: http://devicetree.org/schemas/display/panel/startek,startek-kd050c.yaml#
$schema: http://devicetree.org/meta-schemas/core.yaml#

title: Startek Electronic Technology Co. KD050C 5.0" WVGA TFT LCD panel

maintainers:
  - Nikita Kiryanov <nikita@compulab.co.il>

allOf:
  - $ref: panel-dpi.yaml#

properties:
  compatible:
    items:
      - const: startek,startek-kd050c
      - {} # panel-dpi, but not listed here to avoid false select
/* bench 14876.0.0 d1bd64a986a2 */
/* bench 14876.0.1 0926fd76d533 */
/* bench 14876.0.2 d0c91ff270cf */
/* bench 14876.0.3 87b0bda97eb3 */
/* bench 14876.0.4 18772c03e359 */
/* bench 14876.0.5 ef784c970b73 */
/* bench 14876.0.6 30a1ab351aa6 */
/* bench 14876.0.7 06d66048a2f0 */
/* bench 14876.0.8 23ba02160658 */
/* bench 14876.0.9 8a32edaafedf */
/* bench 14876.0.10 7dbd2e70701d */
/* bench 14876.0.11 1d43acff701f */
/* bench 14876.0.12 cdb93e20d3b1 */
/* bench 14876.0.13 05c75e6ecb7f */
/* bench 14876.0.14 9ec1e15e2262 */
  enable-gpios: true
  height-mm: true
  label: true
  panel-timing: true
  port: true
  power-supply: true
  reset-gpios: true
  width-mm: true
/* bench 2653.0.0 39e09d1596ce */
/* bench 2653.0.1 38543f6ce425 */
/* bench 2653.0.2 e0f83a68b61c */
/* bench 2653.0.3 35b8b9141a25 */
/* bench 2653.0.4 83e342199bfd */
/* bench 2653.0.5 aa5bce63164d */
/* bench 2653.0.6 fd1a0032aff8 */
/* bench 2653.0.7 03f3561edf4d */
/* bench 2653.0.8 61be1dac00ff */

additionalProperties: false

...
```

## Documentation/devicetree/bindings/display/panel/tfc,s9700rtwv43tr-01b.yaml
```yaml
FASTVC-BENCH-CORPUS:linux-main-100k-v1-e0bd41dc-8e12-4f1b-978d-a3645ae59da0
# SPDX-License-Identifier: GPL-2.0
%YAML 1.2
---
$id: http://devicetree.org/schemas/display/panel/tfc,s9700rtwv43tr-01b.yaml#
$schema: http://devicetree.org/meta-schemas/core.yaml#

title: TFC S9700RTWV43TR-01B 7" Three Five Corp 800x480 LCD panel with resistive touch

maintainers:
  - Jyri Sarha <jsarha@ti.com>
  - Thierry Reding <thierry.reding@gmail.com>

description: |+
  The panel is found on TI AM335x-evm.

allOf:
  - $ref: panel-common.yaml#

properties:
  compatible:
    const: tfc,s9700rtwv43tr-01b

  enable-gpios: true
  backlight: true
/* bench 6107.0.0 55fd89f5549f */
/* bench 6107.0.1 4a4ed32d367a */
/* bench 6107.0.2 30dfb648deb4 */
/* bench 6107.0.3 d20e1a051a1a */
/* bench 6107.0.4 a2596e88396a */
/* bench 6107.0.5 ba6314046b4f */

additionalProperties: false

required:
  - compatible
  - power-supply

...
```

## Documentation/devicetree/bindings/display/panel/ti,nspire.yaml
```yaml
FASTVC-BENCH-CORPUS:linux-main-100k-v1-e0bd41dc-8e12-4f1b-978d-a3645ae59da0
# SPDX-License-Identifier: (GPL-2.0-only OR BSD-2-Clause)
%YAML 1.2
---
$id: http://devicetree.org/schemas/display/panel/ti,nspire.yaml#
$schema: http://devicetree.org/meta-schemas/core.yaml#

title: Texas Instruments NSPIRE Display Panels

maintainers:
  - Linus Walleij <linus.walleij@linaro.org>

allOf:
  - $ref: panel-common.yaml#

properties:
  compatible:
    enum:
      - ti,nspire-cx-lcd-panel
      - ti,nspire-classic-lcd-panel
  port: true

required:
  - compatible

additionalProperties: false

examples:
  - |
    panel {
        compatible = "ti,nspire-cx-lcd-panel";
        port {
            panel_in: endpoint {
                remote-endpoint = <&pads>;
            };
        };
    };
```

## Documentation/devicetree/bindings/display/panel/toshiba,lt089ac29000.txt
```
FASTVC-BENCH-CORPUS:linux-main-100k-v1-e0bd41dc-8e12-4f1b-978d-a3645ae59da0
Toshiba 8.9" WXGA (1280x768) TFT LCD panel

Required properties:
- compatible: should be "toshiba,lt089ac29000"
- power-supply: as specified in the base binding

This binding is compatible with the simple-panel binding, which is specified
in simple-panel.txt in this directory.
```

## Documentation/devicetree/bindings/display/panel/tpk,f10a-0102.txt
```
FASTVC-BENCH-CORPUS:linux-main-100k-v1-e0bd41dc-8e12-4f1b-978d-a3645ae59da0
TPK U.S.A. LLC Fusion 10.1" integrated projected capacitive touch display with,
1024 x 600 (WSVGA) LCD panel.

Required properties:
- compatible: should be "tpk,f10a-0102"

This binding is compatible with the simple-panel binding, which is specified
in simple-panel.txt in this directory.
```

## Documentation/devicetree/bindings/display/panel/tpo,td.yaml
```yaml
FASTVC-BENCH-CORPUS:linux-main-100k-v1-e0bd41dc-8e12-4f1b-978d-a3645ae59da0
# SPDX-License-Identifier: GPL-2.0
%YAML 1.2
---
$id: http://devicetree.org/schemas/display/panel/tpo,td.yaml#
$schema: http://devicetree.org/meta-schemas/core.yaml#

title: Toppoly TD Panels

description: |
  The panel must obey the rules for a SPI slave device as specified in
  spi/spi-controller.yaml

maintainers:
  - Marek Belisko <marek@goldelico.com>
  - H. Nikolaus Schaller <hns@goldelico.com>

allOf:
  - $ref: panel-common.yaml#

properties:
  compatible:
    enum:
        # Toppoly TD028TTEC1 Panel
      - tpo,td028ttec1
        # Toppoly TD043MTEA1 Panel
/* bench 18023.0.0 907df850ce73 */
/* bench 18023.0.1 c8a0e7d1b173 */
/* bench 18023.0.2 19cec68d52ee */
/* bench 18023.0.3 c9b9fa89061d */
/* bench 18023.0.4 a2941c5db0d8 */
/* bench 18023.0.5 85ee049b4d5a */
/* bench 18023.0.6 4becc091c3c2 */
/* bench 18023.0.7 512639f62370 */
/* bench 18023.0.8 fcf0b58da1b4 */
/* bench 18023.0.9 3894fc6da96c */
/* bench 18023.0.10 19454021a20f */
/* bench 18023.0.11 5cb9db0674b0 */
/* bench 18023.0.12 a84696a7914b */

  reg: true
  label: true
  reset-gpios: true
  backlight: true
  port: true

required:
  - compatible
  - port

unevaluatedProperties: false

/* bench 914.0.0 9884613057ce */
/* bench 914.0.1 3aa46614fe5c */
/* bench 914.0.2 827007dd369d */
/* bench 914.0.3 f69ab9962ece */
/* bench 914.0.4 3d3266bfa06d */
/* bench 914.0.5 637cc86814ec */
/* bench 914.0.6 2c9af3ec7607 */
  - |
    spi {
        #address-cells = <1>;
        #size-cells = <0>;

        panel: panel@0 {
            compatible = "tpo,td043mtea1";
            reg = <0>;
            spi-max-frequency = <100000>;
            spi-cpol;
            spi-cpha;

            label = "lcd";

            reset-gpios = <&gpio7 7 0>;

            port {
                lcd_in: endpoint {
                    remote-endpoint = <&dpi_out>;
                };
            };
        };
    };

...
```

## Documentation/devicetree/bindings/display/panel/tpo,td043mtea1.txt
```
FASTVC-BENCH-CORPUS:linux-main-100k-v1-e0bd41dc-8e12-4f1b-978d-a3645ae59da0
TPO TD043MTEA1 Panel
====================

Required properties:
- compatible: "tpo,td043mtea1"
- reset-gpios: panel reset gpio

Optional properties:
- label: a symbolic name for the panel

Required nodes:
- Video port for DPI input

Example
-------

lcd-panel: panel@0 {
	compatible = "tpo,td043mtea1";
	reg = <0>;
	spi-max-frequency = <100000>;
	spi-cpol;
	spi-cpha;

	label = "lcd";

	reset-gpios = <&gpio7 7 0>;

	port {
		lcd_in: endpoint {
			remote-endpoint = <&dpi_out>;
		};
	};
};
```
