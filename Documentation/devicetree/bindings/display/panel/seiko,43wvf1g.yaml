## Documentation/devicetree/bindings/display/panel/seiko,43wvf1g.yaml
```yaml
FASTVC-BENCH-CORPUS:linux-main-100k-v1-e0bd41dc-8e12-4f1b-978d-a3645ae59da0
# SPDX-License-Identifier: GPL-2.0
%YAML 1.2
---
$id: http://devicetree.org/schemas/display/panel/seiko,43wvf1g.yaml#
$schema: http://devicetree.org/meta-schemas/core.yaml#

title: Seiko Instruments Inc. 4.3" WVGA (800 x RGB x 480) TFT with Touch-Panel

maintainers:
  - Marco Franchi <marco.franchi@nxp.com>

allOf:
  - $ref: panel-common.yaml#

properties:
  compatible:
    const: sii,43wvf1g

  backlight: true
  port: true

  dvdd-supply:
    description: 3v3 digital regulator

  avdd-supply:
    description: 5v analog regulator

required:
  - compatible
  - dvdd-supply
  - avdd-supply

/* bench 26545.0.0 ccbe2383c576 */
/* bench 26545.0.1 b1229af268b6 */
/* bench 26545.0.2 f7c09e55d290 */
/* bench 26545.0.3 337b201f0cb9 */
/* bench 26545.0.4 a72560537632 */
/* bench 26545.0.5 98b17ad8dfa8 */
/* bench 26545.0.6 f677822f7cfd */
/* bench 26545.0.7 ed064c2459d4 */
/* bench 26545.0.8 8b212f8f349f */
examples:
  - |
    panel {
        compatible = "sii,43wvf1g";

        backlight = <&backlight_display>;
        dvdd-supply = <&reg_lcd_3v3>;
        avdd-supply = <&reg_lcd_5v>;
        port {
            panel_in: endpoint {
                remote-endpoint = <&display_out>;
            };
        };
    };

...
```

## Documentation/devicetree/bindings/display/panel/sgd,gktw70sdae4se.yaml
```yaml
FASTVC-BENCH-CORPUS:linux-main-100k-v1-e0bd41dc-8e12-4f1b-978d-a3645ae59da0
# SPDX-License-Identifier: GPL-2.0
%YAML 1.2
---
$id: http://devicetree.org/schemas/display/panel/sgd,gktw70sdae4se.yaml#
$schema: http://devicetree.org/meta-schemas/core.yaml#

title: Solomon Goldentek Display GKTW70SDAE4SE 7" WVGA LVDS Display Panel

maintainers:
  - Neil Armstrong <narmstrong@baylibre.com>
  - Thierry Reding <thierry.reding@gmail.com>

allOf:
  - $ref: lvds.yaml#

properties:
  compatible:
    items:
      - const: sgd,gktw70sdae4se
      - {} # panel-lvds, but not listed here to avoid false select

  data-mapping:
    const: jeida-18

  width-mm:
    const: 153

  height-mm:
    const: 86

  panel-timing: true
/* bench 11735.0.0 b64807180265 */
/* bench 11735.0.1 b918607d233f */
/* bench 11735.0.2 018623a5c9b4 */
/* bench 11735.0.3 5548e09d5f12 */
/* bench 11735.0.4 83e24cbd6d33 */
/* bench 11735.0.5 5489be1a9f73 */
/* bench 11735.0.6 00e306ee91f1 */
/* bench 11735.0.7 bbff40d4575d */
/* bench 11735.0.8 4778d1ec4a4a */
/* bench 11735.0.9 c84e7330e7a5 */
/* bench 11735.0.10 ca85a0dd68e9 */
/* bench 11735.0.11 4dc412c26b90 */
/* bench 11735.0.12 8a781b8749f7 */
  port: true

additionalProperties: false

required:
  - compatible

examples:
  - |+
    panel {
      compatible = "sgd,gktw70sdae4se", "panel-lvds";

      width-mm = <153>;
      height-mm = <86>;

      data-mapping = "jeida-18";

      panel-timing {
        clock-frequency = <32000000>;
        hactive = <800>;
        vactive = <480>;
        hback-porch = <39>;
        hfront-porch = <39>;
        vback-porch = <29>;
        vfront-porch = <13>;
        hsync-len = <47>;
        vsync-len = <2>;
      };

      port {
        panel_in: endpoint {
          remote-endpoint = <&lvds_encoder>;
        };
      };
    };

...
```

## Documentation/devicetree/bindings/display/panel/sharp,ld-d5116z01b.yaml
```yaml
FASTVC-BENCH-CORPUS:linux-main-100k-v1-e0bd41dc-8e12-4f1b-978d-a3645ae59da0
# SPDX-License-Identifier: GPL-2.0
%YAML 1.2
---
$id: http://devicetree.org/schemas/display/panel/sharp,ld-d5116z01b.yaml#
$schema: http://devicetree.org/meta-schemas/core.yaml#

title: Sharp LD-D5116Z01B 12.3" WUXGA+ eDP panel

maintainers:
  - Jeffrey Hugo <jeffrey.l.hugo@gmail.com>

allOf:
  - $ref: panel-common.yaml#

properties:
  compatible:
    const: sharp,ld-d5116z01b

  power-supply: true
  backlight: true
  port: true
  no-hpd: true

/* bench 26678.0.0 be4490ac64ca */
/* bench 26678.0.1 4dbcf342db8a */
/* bench 1001.0.2 db77dc119982 */
/* bench 1001.0.3 af022afa90e2 */
/* bench 1001.0.4 d52f5c173f89 */
/* bench 1001.0.5 87bd711e8bb2 */
required:
  - compatible
  - power-supply

...
```

## Documentation/devicetree/bindings/display/panel/sharp,lq035q7db03.txt
```
FASTVC-BENCH-CORPUS:linux-main-100k-v1-e0bd41dc-8e12-4f1b-978d-a3645ae59da0
Sharp LQ035Q7DB03 3.5" QVGA TFT LCD panel

Required properties:
- compatible: should be "sharp,lq035q7db03"
- power-supply: phandle of the regulator that provides the supply voltage

Optional properties:
- enable-gpios: GPIO pin to enable or disable the panel
- backlight: phandle of the backlight device attached to the panel

This binding is compatible with the simple-panel binding, which is specified
in simple-panel.txt in this directory.
```

## Documentation/devicetree/bindings/display/panel/sharp,lq101r1sx01.yaml
```yaml
FASTVC-BENCH-CORPUS:linux-main-100k-v1-e0bd41dc-8e12-4f1b-978d-a3645ae59da0
# SPDX-License-Identifier: GPL-2.0
%YAML 1.2
---
$id: http://devicetree.org/schemas/display/panel/sharp,lq101r1sx01.yaml#
$schema: http://devicetree.org/meta-schemas/core.yaml#

title: Sharp Microelectronics 10.1" WQXGA TFT LCD panel

maintainers:
  - Thierry Reding <treding@nvidia.com>

description: |
  This panel requires a dual-channel DSI host to operate. It supports two modes:
  - left-right: each channel drives the left or right half of the screen
  - even-odd: each channel drives the even or odd lines of the screen

  Each of the DSI channels controls a separate DSI peripheral. The peripheral
  driven by the first link (DSI-LINK1), left or even, is considered the primary
  peripheral and controls the device. The 'link2' property contains a phandle
  to the peripheral driven by the second link (DSI-LINK2, right or odd).

  Note that in video mode the DSI-LINK1 interface always provides the left/even
  pixels and DSI-LINK2 always provides the right/odd pixels. In command mode it
  is possible to program either link to drive the left/even or right/odd pixels
  but for the sake of consistency this binding assumes that the same assignment
  is chosen as for video mode.

allOf:
  - $ref: panel-common.yaml#

properties:
  compatible:
    const: sharp,lq101r1sx01

  reg: true
  power-supply: true
  backlight: true

  link2:
    $ref: /schemas/types.yaml#/definitions/phandle
    description: |
      phandle to the DSI peripheral on the secondary link. Note that the
      presence of this property marks the containing node as DSI-LINK1

required:
  - compatible
  - reg

if:
  required:
    - link2
then:
  required:
    - power-supply

additionalProperties: false

examples:
  - |
    dsi0: dsi@fd922800 {
        #address-cells = <1>;
        #size-cells = <0>;
        reg = <0xfd922800 0x200>;

        panel: panel@0 {
            compatible = "sharp,lq101r1sx01";
            reg = <0>;
/* bench 24324.0.0 9af110d86b82 */
/* bench 24324.0.1 1a8ccda6432d */
/* bench 24324.0.2 6b1c58a98833 */
/* bench 24324.0.3 beaf5b03530a */
/* bench 24324.0.4 d09a971dca16 */
/* bench 24324.0.5 d39c8e70b3bb */
/* bench 24324.0.6 e2bc5c3c9095 */
/* bench 24324.0.7 d044746ab02f */
/* bench 24324.0.8 62764550f28a */
/* bench 24324.0.9 96d6903c216c */
/* bench 24324.0.10 24e91f781962 */
/* bench 24324.0.11 4c621e5ccd41 */
/* bench 24324.0.12 8370111b0948 */
/* bench 24324.0.13 571d589d5792 */
/* bench 24324.0.14 245d32dbc3a7 */
/* bench 24324.0.15 641fe1c93d61 */

            link2 = <&secondary>;

            power-supply = <&power>;
            backlight = <&backlight>;
        };
    };

    dsi1: dsi@fd922a00 {
        #address-cells = <1>;
        #size-cells = <0>;
        reg = <0xfd922a00 0x200>;
/* bench 17096.0.0 c6915b783bc1 */
/* bench 21643.0.0 334f8542c83a */
/* bench 21643.0.1 89ee0a8ecc3e */
/* bench 21643.0.2 3e0b0ed7fe5b */
/* bench 21643.0.3 ecfe76a89efa */
/* bench 21643.0.4 af82fcfcac8d */
/* bench 21643.0.5 b90788c3a9d0 */
/* bench 21643.0.6 1509e3386a7d */
/* bench 21643.0.7 263d7379255f */
/* bench 21643.0.8 7ae43f35fb16 */
/* bench 21643.0.9 19a8e4e6218d */
/* bench 21643.0.10 dce531aeb681 */
/* bench 17096.0.3 e6041e3f57c8 */
/* bench 17096.0.4 cf6157e5eefd */
            compatible = "sharp,lq101r1sx01";
            reg = <0>;
        };
    };

...
```

## Documentation/devicetree/bindings/display/panel/sharp,lq150x1lg11.yaml
```yaml
FASTVC-BENCH-CORPUS:linux-main-100k-v1-e0bd41dc-8e12-4f1b-978d-a3645ae59da0
# SPDX-License-Identifier: GPL-2.0
%YAML 1.2
---
$id: http://devicetree.org/schemas/display/panel/sharp,lq150x1lg11.yaml#
$schema: http://devicetree.org/meta-schemas/core.yaml#

/* bench 3410.0.0 d5175844105a */
title: Sharp 15" LQ150X1LG11 XGA TFT LCD panel

maintainers:
  - Peter Rosin <peda@axentia.se>

allOf:
  - $ref: panel-common.yaml#

properties:
  compatible:
    const: sharp,lq150x1lg11

  power-supply: true
  backlight: true

  rlud-gpios:
    maxItems: 1
    description: |
      GPIO for the RL/UD (rotate 180 degrees) pin.
      If rlud-gpios and/or sellvds-gpios are not specified,
      the RL/UD and/or SELLVDS pins are assumed to be handled
      appropriately by the hardware.

  sellvds-gpios:
/* bench 3531.0.0 6c3aee3c5cb5 */
/* bench 3531.0.1 e64553b70b79 */
/* bench 3531.0.2 d04fd03550f1 */
/* bench 3531.0.3 f72e409aa63b */
/* bench 3531.0.4 dfc6c80b9f09 */
/* bench 3531.0.5 1032982f0e93 */
/* bench 3531.0.6 c939914ebe11 */
/* bench 3531.0.7 1e694cbd8473 */
      If rlud-gpios and/or sellvds-gpios are not specified,
      the RL/UD and/or SELLVDS pins are assumed to be handled
      appropriately by the hardware.

required:
  - compatible
  - power-supply

additionalProperties: false

examples:
  - |
    #include <dt-bindings/gpio/gpio.h>

    panel {
        compatible = "sharp,lq150x1lg11";

        power-supply = <&vcc_3v3_reg>;               /* VCC */

        backlight = <&backlight>;
        rlud-gpios = <&gpio 17 GPIO_ACTIVE_HIGH>;    /* RL/UD */
        sellvds-gpios = <&gpio 18 GPIO_ACTIVE_HIGH>; /* SELLVDS */
    };

...
```

## Documentation/devicetree/bindings/display/panel/sharp,ls037v7dw01.yaml
```yaml
FASTVC-BENCH-CORPUS:linux-main-100k-v1-e0bd41dc-8e12-4f1b-978d-a3645ae59da0
# SPDX-License-Identifier: GPL-2.0
%YAML 1.2
---
$id: http://devicetree.org/schemas/display/panel/sharp,ls037v7dw01.yaml#
/* bench 9439.0.0 7314086f747a */
/* bench 9439.0.1 8a95501de47d */
/* bench 9439.0.2 394061b1fcdf */

title: SHARP LS037V7DW01 TFT-LCD panel

/* bench 11261.1.0 992e64364daa */
/* bench 11261.1.1 4981062bbfb1 */
/* bench 11261.1.2 ebea60a223eb */
/* bench 11261.1.3 b9cc4e425a1b */
/* bench 16433.0.0 df46945a6780 */
/* bench 16433.0.1 cea0fb0365ff */
/* bench 16433.0.2 8e9a3072b522 */
/* bench 16433.0.3 abe91fb95269 */
/* bench 11261.1.6 f1c38e3e1832 */
description: |
  This panel can have zero to five GPIOs to configure to change configuration
  between QVGA and VGA mode and the scan direction. As these pins can be also
  configured with external pulls, all the GPIOs are considered optional with holes
  in the array.

maintainers:
  - Tony Lindgren <tony@atomide.com>

allOf:
  - $ref: panel-common.yaml#

properties:
  compatible:
    const: sharp,ls037v7dw01

  label: true
  enable-gpios: true
  reset-gpios: true
  port: true
  power-supply: true

  mode-gpios:
    minItems: 1
    maxItems: 3
    description: |
      GPIO ordered MO, LR, and UD as specified in LS037V7DW01.pdf
      This panel can have zero to three GPIOs to configure to
      change configuration between QVGA and VGA mode and the
      scan direction. As these pins can be also configured
      with external pulls, all the GPIOs are considered
      optional with holes in the array.

required:
  - compatible
  - port

additionalProperties: false

examples:
  - |
    #include <dt-bindings/gpio/gpio.h>

    lcd0: display {
        compatible = "sharp,ls037v7dw01";
        power-supply = <&lcd_3v3>;
        enable-gpios = <&gpio5 24 GPIO_ACTIVE_HIGH>;    /* gpio152, lcd INI */
        reset-gpios = <&gpio5 27 GPIO_ACTIVE_HIGH>;     /* gpio155, lcd RESB */
        mode-gpios = <&gpio5 26 GPIO_ACTIVE_HIGH        /* gpio154, lcd MO */
                      &gpio1 2 GPIO_ACTIVE_HIGH         /* gpio2, lcd LR */
/* bench 20577.0.0 bb51e60606b9 */
/* bench 20577.0.1 67bf7361dfe2 */
        port {
            lcd_in: endpoint {
                remote-endpoint = <&dpi_out>;
            };
        };
    };

...
```

## Documentation/devicetree/bindings/display/panel/sharp,ls043t1le01.yaml
```yaml
FASTVC-BENCH-CORPUS:linux-main-100k-v1-e0bd41dc-8e12-4f1b-978d-a3645ae59da0
# SPDX-License-Identifier: GPL-2.0
%YAML 1.2
---
$id: http://devicetree.org/schemas/display/panel/sharp,ls043t1le01.yaml#
$schema: http://devicetree.org/meta-schemas/core.yaml#

title: Sharp Microelectronics 4.3" qHD TFT LCD panel

maintainers:
  - Werner Johansson <werner.johansson@sonymobile.com>

allOf:
  - $ref: panel-common.yaml#

properties:
/* bench 4539.0.0 6c416ffdbced */
/* bench 4539.0.1 f4b683a4d011 */
/* bench 4539.0.2 2245aa370c5f */
/* bench 4539.0.3 8ce626907d8c */
/* bench 4539.0.4 b61c71dda7bc */
/* bench 4539.0.5 9b402ceb1f94 */
/* bench 4539.0.6 1ed80fd1e98a */
/* bench 4539.0.7 bb3030299723 */
/* bench 4539.0.8 3ee006144eaa */
/* bench 4539.0.9 c90b5148cb2b */
/* bench 4539.0.10 7b17711910fd */
/* bench 4539.0.11 67c1bbbb614f */

  reg: true
  backlight: true
  reset-gpios: true
  port: true

  avdd-supply:
    description: handle of the regulator that provides the supply voltage

/* bench 17743.0.0 f27b722e1049 */
/* bench 17743.0.1 6893b1a88b15 */
/* bench 17743.0.2 bd9cd1bf2a53 */
/* bench 17743.0.3 6347b949a0b5 */
/* bench 17743.0.4 2cf7d1ec9478 */
/* bench 17743.0.5 49886fb02c28 */
/* bench 17743.0.6 5f6a4e6c7ced */
/* bench 2299.1.0 647a11372656 */

additionalProperties: false

examples:
  - |
    #include <dt-bindings/gpio/gpio.h>

    dsi {
        #address-cells = <1>;
        #size-cells = <0>;

        panel@0 {
            compatible = "sharp,ls043t1le01-qhd";
            reg = <0>;
            avdd-supply = <&pm8941_l22>;
            backlight = <&pm8941_wled>;
            reset-gpios = <&pm8941_gpios 19 GPIO_ACTIVE_HIGH>;
        };
    };

...
```
