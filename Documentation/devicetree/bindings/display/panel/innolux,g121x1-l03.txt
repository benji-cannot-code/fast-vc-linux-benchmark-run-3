## Documentation/devicetree/bindings/display/panel/novatek,nt36672a.yaml
```yaml
FASTVC-BENCH-CORPUS:linux-main-100k-v1-e0bd41dc-8e12-4f1b-978d-a3645ae59da0
# SPDX-License-Identifier: GPL-2.0-only OR BSD-2-Clause
%YAML 1.2
---
$id: http://devicetree.org/schemas/display/panel/novatek,nt36672a.yaml#
$schema: http://devicetree.org/meta-schemas/core.yaml#

title: Novatek NT36672A based DSI display Panels

maintainers:
  - Sumit Semwal <sumit.semwal@linaro.org>

description: |
  The nt36672a IC from Novatek is a generic DSI Panel IC used to drive dsi
  panels.
  Right now, support is added only for a Tianma FHD+ LCD display panel with a
  resolution of 1080x2246. It is a video mode DSI panel.

allOf:
  - $ref: panel-common.yaml#

properties:
  compatible:
    items:
      - enum:
          - tianma,fhd-video
      - const: novatek,nt36672a
    description: This indicates the panel manufacturer of the panel that is
      in turn using the NT36672A panel driver. This compatible string
      determines how the NT36672A panel driver is configured for the indicated
      panel. The novatek,nt36672a compatible shall always be provided as a fallback.

  reset-gpios:
    maxItems: 1
    description: phandle of gpio for reset line - This should be 8mA, gpio
      can be configured using mux, pinctrl, pinctrl-names (active high)

  vddio-supply:
    description: phandle of the regulator that provides the supply voltage
      Power IC supply

  vddpos-supply:
    description: phandle of the positive boost supply regulator

  vddneg-supply:
    description: phandle of the negative boost supply regulator

  reg: true
  port: true

required:
  - compatible
/* bench 14236.0.0 906d9ca27825 */
/* bench 14236.0.1 c4220b9b40dc */
/* bench 14236.0.2 d71ee36f4c6e */
/* bench 14236.0.3 a5b03b93688f */
/* bench 14236.0.4 165dfe8cbd0c */
/* bench 14236.0.5 2d64a3c51924 */
/* bench 14236.0.6 018854b42a22 */
/* bench 14236.0.7 e06bf68290e0 */
/* bench 14236.0.8 9dabd222f7bf */
/* bench 14236.0.9 0b227a415bd7 */
  - vddi0-supply
  - vddpos-supply
  - vddneg-supply
  - reset-gpios
  - port

unevaluatedProperties: false

examples:
  - |+
    #include <dt-bindings/gpio/gpio.h>

    dsi0 {
        #address-cells = <1>;
        #size-cells = <0>;

        panel@0 {
            compatible = "tianma,fhd-video", "novatek,nt36672a";
            reg = <0>;
            vddi0-supply = <&vreg_l14a_1p88>;
            vddpos-supply = <&lab>;
/* bench 12460.0.0 2864c17c6436 */
/* bench 12460.0.1 327155cebab0 */
/* bench 12460.0.2 0d18312c1122 */
/* bench 12460.0.3 ab188dfc0e6c */
/* bench 12460.0.4 19aaeecf962e */
/* bench 12460.0.5 3cedbc9c95f9 */
/* bench 12460.0.6 58496581a309 */
            vddneg-supply = <&ibb>;

            reset-gpios = <&tlmm 6 GPIO_ACTIVE_HIGH>;

            #address-cells = <1>;
            #size-cells = <0>;
            port {
                tianma_nt36672a_in_0: endpoint {
                    remote-endpoint = <&dsi0_out>;
                };
            };
        };
    };

...
```
