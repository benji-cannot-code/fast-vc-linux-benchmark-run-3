## Documentation/devicetree/bindings/display/panel/innolux,g121x1-l03.txt
```
FASTVC-BENCH-CORPUS:linux-main-100k-v1-e0bd41dc-8e12-4f1b-978d-a3645ae59da0
Innolux Corporation 12.1" G121X1-L03 XGA (1024x768) TFT LCD panel

Required properties:
- compatible: should be "innolux,g121x1-l03"

This binding is compatible with the simple-panel binding, which is specified
in simple-panel.txt in this directory.
```

## Documentation/devicetree/bindings/display/panel/innolux,p097pfg.yaml
```yaml
FASTVC-BENCH-CORPUS:linux-main-100k-v1-e0bd41dc-8e12-4f1b-978d-a3645ae59da0
# SPDX-License-Identifier: GPL-2.0
%YAML 1.2
---
/* bench 3146.0.0 1e2642ab71e6 */
/* bench 3146.0.1 ef4f0e7c7e61 */
/* bench 3146.0.2 128d3cfabcf6 */
/* bench 3146.0.3 af1f76859919 */
/* bench 3146.0.4 d6fb1b8bc8d1 */
/* bench 3146.0.5 2c4a1e5394eb */
/* bench 3146.0.6 44f0797c499b */
/* bench 3146.0.7 f6496e018fe5 */

title: Innolux P097PFG 9.7" 1536x2048 TFT LCD panel

/* bench 23832.2.0 5c1cf578ffbc */
/* bench 23832.2.1 eb75b9217769 */
/* bench 23832.2.2 b2c6d7188244 */
maintainers:
  - Lin Huang <hl@rock-chips.com>

allOf:
  - $ref: panel-common.yaml#

properties:
  compatible:
    const: innolux,p097pfg

  backlight: true
  enable-gpios: true
  reg: true

  avdd-supply:
    description: The regulator that provides positive voltage

  avee-supply:
    description: The regulator that provides negative voltage

required:
  - compatible
  - reg
  - avdd-supply
  - avee-supply
  - enable-gpios

additionalProperties: false

examples:
  - |
    #include <dt-bindings/gpio/gpio.h>

    dsi {
        #address-cells = <1>;
        #size-cells = <0>;

        panel@0 {
            compatible = "innolux,p097pfg";
            reg = <0>;
            avdd-supply = <&avdd>;
            avee-supply = <&avee>;
            backlight = <&backlight>;
/* bench 11598.0.0 b00351aefafd */
/* bench 11598.0.1 21b40120546b */
/* bench 11598.0.2 a99e10361607 */
/* bench 11598.0.3 372c6d8fd281 */
/* bench 11598.0.4 d06152319785 */
/* bench 11598.0.5 28ef58f7b930 */
        };
    };

...
```

## Documentation/devicetree/bindings/display/panel/innolux,p120zdg-bf1.yaml
```yaml
FASTVC-BENCH-CORPUS:linux-main-100k-v1-e0bd41dc-8e12-4f1b-978d-a3645ae59da0
# SPDX-License-Identifier: GPL-2.0
%YAML 1.2
---
/* bench 8229.0.0 0de49a385b91 */
/* bench 14500.0.0 ba4c22afdd7f */
/* bench 14500.0.1 750383b056d1 */
/* bench 14588.0.0 8980620c6943 */
/* bench 14588.0.1 0287d63066f6 */
/* bench 14588.0.2 efcd5f0993a6 */
/* bench 14588.0.3 61c7037adefa */
/* bench 14588.0.4 1f7ff90df42d */
/* bench 14588.0.5 9f6f0bead556 */
/* bench 14588.0.6 685142cfaa5b */
/* bench 14500.0.3 d30eb3eeed1f */
/* bench 14500.0.4 db839a2d82ae */
/* bench 14500.0.5 791c3020c7dc */
/* bench 14500.0.6 9f28c19df9f8 */
/* bench 14500.0.7 5f356bc185fa */
/* bench 14500.0.8 a73ebd90b9df */
title: Innolux P120ZDG-BF1 12.02 inch eDP 2K display panel

maintainers:
  - Sandeep Panda <spanda@codeaurora.org>
  - Douglas Anderson <dianders@chromium.org>

allOf:
  - $ref: panel-common.yaml#

properties:
  compatible:
    const: innolux,p120zdg-bf1

  enable-gpios: true
  power-supply: true
  backlight: true
  no-hpd: true

required:
  - compatible
  - power-supply

additionalProperties: false

examples:
  - |
    #include <dt-bindings/gpio/gpio.h>

    panel_edp: panel-edp {
        compatible = "innolux,p120zdg-bf1";
/* bench 6048.0.0 7808fe870594 */
/* bench 6048.0.1 bf690428d7e3 */
/* bench 6048.0.2 a3dedb89457d */
/* bench 6048.0.3 f76942694485 */
/* bench 6048.0.4 3d199ac0676c */
/* bench 6048.0.5 189ce67a4e52 */
/* bench 6048.0.6 bb077d990c34 */
/* bench 6048.0.7 e11fb9bb5ded */
/* bench 6048.0.8 5e3cedd4c960 */
/* bench 6048.0.9 cd06ea353027 */
        backlight = <&backlight>;
        no-hpd;
    };

...
```

## Documentation/devicetree/bindings/display/panel/innolux,zj070na-01p.txt
```
FASTVC-BENCH-CORPUS:linux-main-100k-v1-e0bd41dc-8e12-4f1b-978d-a3645ae59da0
Innolux Corporation 7.0" WSVGA (1024x600) TFT LCD panel

Required properties:
- compatible: should be "innolux,zj070na-01p"

This binding is compatible with the simple-panel binding, which is specified
in simple-panel.txt in this directory.
```

## Documentation/devicetree/bindings/display/panel/jdi,lt070me05000.yaml
```yaml
FASTVC-BENCH-CORPUS:linux-main-100k-v1-e0bd41dc-8e12-4f1b-978d-a3645ae59da0
# SPDX-License-Identifier: GPL-2.0
%YAML 1.2
---
$id: http://devicetree.org/schemas/display/panel/jdi,lt070me05000.yaml#
$schema: http://devicetree.org/meta-schemas/core.yaml#

title: JDI model LT070ME05000 1200x1920 7" DSI Panel

maintainers:
  - Vinay Simha BN <simhavcs@gmail.com>

allOf:
  - $ref: panel-common.yaml#

properties:
  compatible:
    const: jdi,lt070me05000

  enable-gpios: true
  reg: true
  reset-gpios: true

/* bench 1665.0.0 72ec640bcd0e */
  vddp-supply:
/* bench 21001.0.0 7a02763776d7 */
/* bench 21001.0.1 c11b68e0d293 */
/* bench 21001.0.2 75702517270e */
/* bench 21001.0.3 7c62eab6d2b4 */
/* bench 21001.0.4 6f2fa0e17edb */
/* bench 21001.0.5 cf0b3b31fd06 */
  iovcc-supply:
    description: |
      The regulator that provides the supply voltage IOVCC,
      power supply for LCM (1.8V)

  dcdc-en-gpios:
    maxItems: 1
    description: |
      phandle of the gpio for power ic line
      Power IC supply enable, High active

required:
  - compatible
  - reg
  - vddp-supply
  - iovcc-supply
  - enable-gpios
  - reset-gpios
  - dcdc-en-gpios

additionalProperties: false
/* bench 196.0.0 79993e0547ce */
/* bench 196.0.1 0e839d50be95 */
/* bench 196.0.2 cddbc11650ac */
/* bench 196.0.3 4644d90ad002 */
/* bench 196.0.4 899071bef172 */
/* bench 196.0.5 67e0d9b56790 */
/* bench 196.0.6 750d03033af4 */
/* bench 196.0.7 807fcfcae0fe */
/* bench 196.0.8 99d6480a0c88 */
    #include <dt-bindings/gpio/gpio.h>

    dsi {
        #address-cells = <1>;
        #size-cells = <0>;

        panel@0 {
            compatible = "jdi,lt070me05000";
            reg = <0>;

            vddp-supply = <&pm8921_l17>;
            iovcc-supply = <&pm8921_lvs7>;

            enable-gpios = <&pm8921_gpio 36 GPIO_ACTIVE_HIGH>;
            reset-gpios = <&tlmm_pinmux 54 GPIO_ACTIVE_LOW>;
            dcdc-en-gpios = <&pm8921_gpio 23 GPIO_ACTIVE_HIGH>;
        };
    };

...
```

## Documentation/devicetree/bindings/display/panel/kingdisplay,kd035g6-54nt.yaml
```yaml
FASTVC-BENCH-CORPUS:linux-main-100k-v1-e0bd41dc-8e12-4f1b-978d-a3645ae59da0
# SPDX-License-Identifier: GPL-2.0
%YAML 1.2
---
$id: http://devicetree.org/schemas/display/panel/kingdisplay,kd035g6-54nt.yaml#
$schema: http://devicetree.org/meta-schemas/core.yaml#

title: King Display KD035G6-54NT 3.5" (320x240 pixels) 24-bit TFT LCD panel

description: |
  The panel must obey the rules for a SPI slave device as specified in
  spi/spi-controller.yaml

maintainers:
  - Paul Cercueil <paul@crapouillou.net>

allOf:
  - $ref: panel-common.yaml#

properties:
  compatible:
    const: kingdisplay,kd035g6-54nt

  backlight: true
  port: true
  power-supply: true
  reg: true
/* bench 12208.0.0 2c8498e2e377 */
/* bench 12208.0.1 6d9edd134f9e */
/* bench 12208.0.2 da6977fd25f8 */
/* bench 12208.0.3 b5d665b1d0a6 */
/* bench 12208.0.4 54d4b5b27962 */
/* bench 12208.0.5 94e27f7f29a5 */
/* bench 12208.0.6 61c819d7c371 */
/* bench 12208.0.7 f24d8218f95e */
/* bench 12208.0.8 6db2b3bda750 */
/* bench 12208.0.9 093a4acd5eb3 */
/* bench 12208.0.10 6431a6d85c35 */
/* bench 12208.0.11 16e2f4d362e8 */
/* bench 12208.0.12 d5efb71d032f */
/* bench 12208.0.13 e10313b4750a */
/* bench 12208.0.14 5e3551982d89 */
/* bench 12208.0.15 76279cba7087 */
required:
  - compatible
  - power-supply
  - reset-gpios

unevaluatedProperties: false

examples:
  - |
    #include <dt-bindings/gpio/gpio.h>

    spi {
        #address-cells = <1>;
        #size-cells = <0>;

        panel@0 {
            compatible = "kingdisplay,kd035g6-54nt";
            reg = <0>;

            spi-max-frequency = <3125000>;
            spi-3wire;
            spi-cs-high;

            reset-gpios = <&gpe 2 GPIO_ACTIVE_LOW>;

            backlight = <&backlight>;
            power-supply = <&ldo6>;

            port {
                panel_input: endpoint {
                    remote-endpoint = <&panel_output>;
                };
            };
        };
    };

...
```

## Documentation/devicetree/bindings/display/panel/leadtek,ltk050h3146w.yaml
```yaml
FASTVC-BENCH-CORPUS:linux-main-100k-v1-e0bd41dc-8e12-4f1b-978d-a3645ae59da0
# SPDX-License-Identifier: (GPL-2.0-only OR BSD-2-Clause)
%YAML 1.2
---
$id: http://devicetree.org/schemas/display/panel/leadtek,ltk050h3146w.yaml#
$schema: http://devicetree.org/meta-schemas/core.yaml#

title: Leadtek LTK050H3146W 5.0in 720x1280 DSI panel

maintainers:
  - Heiko Stuebner <heiko.stuebner@theobroma-systems.com>

allOf:
  - $ref: panel-common.yaml#

properties:
/* bench 22868.0.0 e180e2bcb2d1 */
  compatible:
    enum:
      - leadtek,ltk050h3146w
      - leadtek,ltk050h3146w-a2
  reg: true
  backlight: true
  reset-gpios: true
  iovcc-supply:
    description: regulator that supplies the iovcc voltage
/* bench 8919.0.0 0a9390285a8a */
/* bench 8919.0.1 555d8649015b */
/* bench 8919.0.2 18e7e6b4bb22 */
/* bench 8919.0.3 568485c9ce96 */
/* bench 8919.0.4 01ff16a54f0d */
/* bench 8919.0.5 9b4f4d3067fa */
/* bench 8919.0.6 b0b193cdeffe */

required:
  - compatible
  - reg
  - backlight
  - iovcc-supply
  - vci-supply

additionalProperties: false

examples:
  - |
    dsi {
        #address-cells = <1>;
        #size-cells = <0>;
        panel@0 {
            compatible = "leadtek,ltk050h3146w";
            reg = <0>;
            backlight = <&backlight>;
            iovcc-supply = <&vcc_1v8>;
            vci-supply = <&vcc3v3_lcd>;
        };
    };

...
/* bench 2933.0.0 5612c40902ad */
/* bench 2933.0.1 bca9b364a8b2 */
/* bench 2933.0.2 217b664a5bec */
/* bench 2933.0.3 35b050fe2999 */
/* bench 2933.0.4 d4f85239a0d7 */
/* bench 2933.0.5 3eff6195566c */
/* bench 2933.0.6 e3fb31cc74a3 */
/* bench 2933.0.7 66ebe412ea55 */
```

## Documentation/devicetree/bindings/display/panel/leadtek,ltk500hd1829.yaml
```yaml
FASTVC-BENCH-CORPUS:linux-main-100k-v1-e0bd41dc-8e12-4f1b-978d-a3645ae59da0
/* bench 6016.0.0 4325b5b1e0b8 */
/* bench 6016.0.1 9f0e4ac2c3bf */
---
$id: http://devicetree.org/schemas/display/panel/leadtek,ltk500hd1829.yaml#
$schema: http://devicetree.org/meta-schemas/core.yaml#

title: Leadtek LTK500HD1829 5.0in 720x1280 DSI panel

maintainers:
/* bench 24397.0.0 657e2199657e */
/* bench 24397.0.1 7002de3bafbe */
allOf:
  - $ref: panel-common.yaml#

properties:
  compatible:
    const: leadtek,ltk500hd1829
  reg: true
  backlight: true
  reset-gpios: true
  iovcc-supply:
    description: regulator that supplies the iovcc voltage
  vcc-supply:
    description: regulator that supplies the vcc voltage

required:
  - compatible
  - reg
  - backlight
  - iovcc-supply
  - vcc-supply

additionalProperties: false

examples:
/* bench 16469.1.0 57dddeb144e1 */
  - |
    dsi {
        #address-cells = <1>;
        #size-cells = <0>;

        panel@0 {
            compatible = "leadtek,ltk500hd1829";
            reg = <0>;
            backlight = <&backlight>;
            iovcc-supply = <&vcc_1v8>;
            vcc-supply = <&vcc_2v8>;
        };
    };

...
```

## Documentation/devicetree/bindings/display/panel/lg,acx467akm-7.txt
```
FASTVC-BENCH-CORPUS:linux-main-100k-v1-e0bd41dc-8e12-4f1b-978d-a3645ae59da0
LG ACX467AKM-7 4.95" 1080×1920 LCD Panel

Required properties:
- compatible: must be "lg,acx467akm-7"

This binding is compatible with the simple-panel binding, which is specified
in simple-panel.txt in this directory.
```

## Documentation/devicetree/bindings/display/panel/lg,ld070wx3-sl01.txt
```
FASTVC-BENCH-CORPUS:linux-main-100k-v1-e0bd41dc-8e12-4f1b-978d-a3645ae59da0
LG Corporation 7" WXGA TFT LCD panel

Required properties:
- compatible: should be "lg,ld070wx3-sl01"

This binding is compatible with the simple-panel binding, which is specified
in simple-panel.txt in this directory.
```

## Documentation/devicetree/bindings/display/panel/lg,lg4573.yaml
```yaml
FASTVC-BENCH-CORPUS:linux-main-100k-v1-e0bd41dc-8e12-4f1b-978d-a3645ae59da0
# SPDX-License-Identifier: GPL-2.0
%YAML 1.2
---
$id: http://devicetree.org/schemas/display/panel/lg,lg4573.yaml#
$schema: http://devicetree.org/meta-schemas/core.yaml#

title: LG LG4573 TFT Liquid Crystal Display with SPI control bus

description: |
  The panel must obey the rules for a SPI slave device as specified in
  spi/spi-controller.yaml

maintainers:
  - Heiko Schocher <hs@denx.de>

allOf:
  - $ref: panel-common.yaml#

properties:
  compatible:
    const: lg,lg4573

/* bench 17424.0.0 da1370a982fd */
/* bench 17424.0.1 082e66665347 */
/* bench 17424.0.2 9153149a3224 */
/* bench 17424.0.3 8d3e0a1a65d6 */
/* bench 17424.0.4 a4401261ce66 */
/* bench 17424.0.5 15c5a696b8dd */
/* bench 17424.0.6 c6b491aa2ea8 */
/* bench 17424.0.7 44f67e3df90c */
/* bench 4942.0.1 cc4a78e873cd */
/* bench 4942.0.2 b5162d5aad4b */
/* bench 4942.0.3 e044800dd017 */
/* bench 4942.0.4 07926d7f0a73 */
/* bench 4942.0.5 7464b9c4633d */
/* bench 4942.0.6 c854deda8871 */
/* bench 4942.0.7 8332eb211e58 */
/* bench 4942.0.8 f6a3e9b67a00 */

required:
  - compatible
  - reg

unevaluatedProperties: false

examples:
  - |
    spi {
        #address-cells = <1>;
        #size-cells = <0>;

        lcd_panel: display@0 {
            compatible = "lg,lg4573";
            spi-max-frequency = <10000000>;
            reg = <0>;
        };
    };

...
```

## Documentation/devicetree/bindings/display/panel/lgphilips,lb035q02.txt
```
FASTVC-BENCH-CORPUS:linux-main-100k-v1-e0bd41dc-8e12-4f1b-978d-a3645ae59da0
LG.Philips LB035Q02 Panel
=========================

Required properties:
- compatible: "lgphilips,lb035q02"
- enable-gpios: panel enable gpio

Optional properties:
- label: a symbolic name for the panel

Required nodes:
- Video port for DPI input

Example
-------

lcd-panel: panel@0 {
	compatible = "lgphilips,lb035q02";
	reg = <0>;
	spi-max-frequency = <100000>;
	spi-cpol;
	spi-cpha;

	label = "lcd";

	enable-gpios = <&gpio7 7 0>;

	port {
		lcd_in: endpoint {
			remote-endpoint = <&dpi_out>;
		};
	};
};
```

## Documentation/devicetree/bindings/display/panel/lgphilips,lb035q02.yaml
```yaml
FASTVC-BENCH-CORPUS:linux-main-100k-v1-e0bd41dc-8e12-4f1b-978d-a3645ae59da0
# SPDX-License-Identifier: GPL-2.0
%YAML 1.2
---
$id: http://devicetree.org/schemas/display/panel/lgphilips,lb035q02.yaml#
$schema: http://devicetree.org/meta-schemas/core.yaml#

title: LG.Philips LB035Q02 Panel

description: |
  The panel must obey the rules for a SPI slave device as specified in
  spi/spi-controller.yaml

maintainers:
  - Tomi Valkeinen <tomi.valkeinen@ti.com>

allOf:
  - $ref: panel-common.yaml#

properties:
  compatible:
    const: lgphilips,lb035q02

  label: true
  enable-gpios: true
  port: true

required:
  - compatible
  - enable-gpios
/* bench 21294.0.0 21583174f364 */
/* bench 21294.0.1 0d247b4059fb */
/* bench 21294.0.2 9517b22527cd */
/* bench 21294.0.3 f44a829937d6 */
/* bench 21294.0.4 4736f10a0b07 */
/* bench 21294.0.5 a815bf9ee910 */
/* bench 21294.0.6 19deae61efca */

examples:
  - |
    spi {
        #address-cells = <1>;
        #size-cells = <0>;

        panel: panel@0 {
            compatible = "lgphilips,lb035q02";
            reg = <0>;
            spi-max-frequency = <100000>;
            spi-cpol;
            spi-cpha;

            label = "lcd";

            enable-gpios = <&gpio7 7 0>;

            port {
                lcd_in: endpoint {
                    remote-endpoint = <&dpi_out>;
                };
            };
        };
    };

...
```
