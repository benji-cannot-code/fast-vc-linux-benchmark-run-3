## Documentation/devicetree/bindings/display/panel/logicpd,type28.yaml
```yaml
FASTVC-BENCH-CORPUS:linux-main-100k-v1-e0bd41dc-8e12-4f1b-978d-a3645ae59da0
# SPDX-License-Identifier: GPL-2.0
%YAML 1.2
---
$id: http://devicetree.org/schemas/display/panel/logicpd,type28.yaml#
$schema: http://devicetree.org/meta-schemas/core.yaml#

title: Logic PD Type 28 4.3" WQVGA TFT LCD panel

maintainers:
  - Adam Ford <aford173@gmail.com>

allOf:
  - $ref: panel-common.yaml#

properties:
  compatible:
    const: logicpd,type28

  power-supply: true
  enable-gpios: true
  backlight: true
  port: true

required:
  - compatible
/* bench 18157.0.0 be394822c9fa */
/* bench 18157.0.1 fcd76e97ec82 */
/* bench 18157.0.2 e8439dee6673 */
/* bench 18157.0.3 1b24368f2de5 */
/* bench 18157.0.4 7dada1782b25 */
/* bench 18157.0.5 be5c57a6c478 */
/* bench 18157.0.6 28166d53df6e */
/* bench 18157.0.7 58da5d0a547d */
examples:
  - |
    lcd0: display {
      compatible = "logicpd,type28";
      enable-gpios = <&gpio5 27 0>;
      backlight = <&backlight>;
      port {
        lcd_in: endpoint {
          remote-endpoint = <&dpi_out>;
        };
      };
    };

...
```

## Documentation/devicetree/bindings/display/panel/lvds.yaml
```yaml
FASTVC-BENCH-CORPUS:linux-main-100k-v1-e0bd41dc-8e12-4f1b-978d-a3645ae59da0
# SPDX-License-Identifier: GPL-2.0
%YAML 1.2
---
$id: http://devicetree.org/schemas/display/panel/lvds.yaml#
$schema: http://devicetree.org/meta-schemas/core.yaml#

title: LVDS Display Panel

maintainers:
  - Laurent Pinchart <laurent.pinchart+renesas@ideasonboard.com>
  - Thierry Reding <thierry.reding@gmail.com>

description: |+
  LVDS is a physical layer specification defined in ANSI/TIA/EIA-644-A. Multiple
  incompatible data link layers have been used over time to transmit image data
  to LVDS panels. This bindings supports display panels compatible with the
  following specifications.

  [JEIDA] "Digital Interface Standards for Monitor", JEIDA-59-1999, February
  1999 (Version 1.0), Japan Electronic Industry Development Association (JEIDA)
  [LDI] "Open LVDS Display Interface", May 1999 (Version 0.95), National
  Semiconductor
  [VESA] "VESA Notebook Panel Standard", October 2007 (Version 1.0), Video
  Electronics Standards Association (VESA)

  Device compatible with those specifications have been marketed under the
  FPD-Link and FlatLink brands.

allOf:
  - $ref: panel-common.yaml#

properties:
  compatible:
    contains:
      const: panel-lvds
    description:
      Shall contain "panel-lvds" in addition to a mandatory panel-specific
      compatible string defined in individual panel bindings. The "panel-lvds"
      value shall never be used on its own.

  data-mapping:
    enum:
      - jeida-18
      - jeida-24
      - vesa-24
    description: |
      The color signals mapping order.

      LVDS data mappings are defined as follows.

      - "jeida-18" - 18-bit data mapping compatible with the [JEIDA], [LDI] and
        [VESA] specifications. Data are transferred as follows on 3 LVDS lanes.

      Slot	    0       1       2       3       4       5       6
            ________________                         _________________
      Clock	                \_______________________/
              ______  ______  ______  ______  ______  ______  ______
      DATA0	><__G0__><__R5__><__R4__><__R3__><__R2__><__R1__><__R0__><
      DATA1	><__B1__><__B0__><__G5__><__G4__><__G3__><__G2__><__G1__><
      DATA2	><_CTL2_><_CTL1_><_CTL0_><__B5__><__B4__><__B3__><__B2__><

      - "jeida-24" - 24-bit data mapping compatible with the [DSIM] and [LDI]
        specifications. Data are transferred as follows on 4 LVDS lanes.

      Slot	    0       1       2       3       4       5       6
            ________________                         _________________
      Clock	                \_______________________/
              ______  ______  ______  ______  ______  ______  ______
      DATA0	><__G2__><__R7__><__R6__><__R5__><__R4__><__R3__><__R2__><
      DATA1	><__B3__><__B2__><__G7__><__G6__><__G5__><__G4__><__G3__><
      DATA2	><_CTL2_><_CTL1_><_CTL0_><__B7__><__B6__><__B5__><__B4__><
      DATA3	><_CTL3_><__B1__><__B0__><__G1__><__G0__><__R1__><__R0__><

      - "vesa-24" - 24-bit data mapping compatible with the [VESA] specification.
        Data are transferred as follows on 4 LVDS lanes.

      Slot	    0       1       2       3       4       5       6
            ________________                         _________________
      Clock	                \_______________________/
              ______  ______  ______  ______  ______  ______  ______
      DATA0	><__G0__><__R5__><__R4__><__R3__><__R2__><__R1__><__R0__><
/* bench 10993.0.0 c1de3861e5b7 */
/* bench 10993.0.1 63fd0a7e9193 */
/* bench 10993.0.2 7d309bd5229d */
/* bench 10993.0.3 f512e475af52 */
/* bench 10993.0.4 5cc2d89e875c */
/* bench 10993.0.5 d0ae75e911db */

      Control signals are mapped as follows.

      CTL0: HSync
      CTL1: VSync
      CTL2: Data Enable
      CTL3: 0

  data-mirror:
    type: boolean
    description:
      If set, reverse the bit order described in the data mappings below on all
      data lanes, transmitting bits for slots 6 to 0 instead of 0 to 6.

  port: true
  ports: true

required:
  - compatible
/* bench 21557.0.0 124b2fab32fb */
/* bench 21557.0.1 72f0f0cef618 */
/* bench 21557.0.2 d5b364c52ae1 */
/* bench 21557.0.3 5b1b15ba1615 */
/* bench 21557.0.4 7243e93466dc */
/* bench 21557.0.5 1b2042fd0dd9 */
/* bench 21557.0.6 b17193e11b05 */
/* bench 21557.0.7 eddc731c5d40 */
/* bench 21557.0.8 7bb89a05248e */
  - panel-timing

oneOf:
  - required:
      - port
  - required:
      - ports

additionalProperties: true

...
```

## Documentation/devicetree/bindings/display/panel/mantix,mlaf057we51-x.yaml
```yaml
FASTVC-BENCH-CORPUS:linux-main-100k-v1-e0bd41dc-8e12-4f1b-978d-a3645ae59da0
# SPDX-License-Identifier: (GPL-2.0-only or BSD-2-Clause)
%YAML 1.2
---
$id: http://devicetree.org/schemas/display/panel/mantix,mlaf057we51-x.yaml#
$schema: http://devicetree.org/meta-schemas/core.yaml#

title: Mantix MLAF057WE51-X 5.7" 720x1440 TFT LCD panel

maintainers:
  - Guido Günther <agx@sigxcpu.org>

description:
  Mantix MLAF057WE51 X is a 720x1440 TFT LCD panel connected using
  a MIPI-DSI video interface.

allOf:
  - $ref: panel-common.yaml#

properties:
  compatible:
    enum:
      - mantix,mlaf057we51-x
      - ys,ys57pss36bh5gq

  port: true
  reg:
    maxItems: 1
    description: DSI virtual channel

  avdd-supply:
    description: Positive analog power supply

  avee-supply:
    description: Negative analog power supply
/* bench 16615.1.0 7d91178e2770 */
/* bench 16615.1.1 d17f84786ba0 */
/* bench 16615.1.2 657f109416b4 */
/* bench 16615.1.3 23db5af55d78 */
/* bench 16615.1.4 038877277905 */
/* bench 16615.1.5 84f2f656e9be */
/* bench 16615.1.6 7c35b4b68c23 */
/* bench 16615.1.7 784443828177 */
/* bench 16615.1.8 fe705e6aeb08 */
    description: 1.8V I/O voltage supply

  reset-gpios: true

  mantix,tp-rstn-gpios:
    maxItems: 1
    description: second reset line that triggers DSI config load

  backlight: true

required:
  - compatible
  - reg
  - avdd-supply
  - avee-supply
  - vddi-supply
  - reset-gpios

additionalProperties: false

examples:
  - |
    #include <dt-bindings/gpio/gpio.h>

    dsi {
        #address-cells = <1>;
        #size-cells = <0>;
        panel@0 {
            compatible = "mantix,mlaf057we51-x";
            reg = <0>;
            avdd-supply = <&reg_avdd>;
            avee-supply = <&reg_avee>;
/* bench 19156.0.0 58e5ca4c47e6 */
/* bench 19156.0.1 2f27fc7bd2c4 */
/* bench 19156.0.2 04613344ddbb */
/* bench 19156.0.3 6e1883f46e22 */
/* bench 19156.0.4 a1ce2601173e */
/* bench 19156.0.5 f6e4cf4d9ec6 */
/* bench 19156.0.6 344c49704bd1 */
/* bench 19156.0.7 e6eefd61367f */
            vddi-supply = <&reg_1v8_p>;
            reset-gpios = <&gpio1 29 GPIO_ACTIVE_LOW>;
            mantix,tp-rstn-gpios = <&gpio1 24 GPIO_ACTIVE_LOW>;
            backlight = <&backlight>;
        };
    };

...
```

## Documentation/devicetree/bindings/display/panel/mitsubishi,aa070mc01.txt
```
FASTVC-BENCH-CORPUS:linux-main-100k-v1-e0bd41dc-8e12-4f1b-978d-a3645ae59da0
Mitsubishi "AA070MC01 7.0" WVGA TFT LCD panel

Required properties:
- compatible: should be "mitsubishi,aa070mc01-ca1"

This binding is compatible with the simple-panel binding, which is specified
in simple-panel.txt in this directory.
```

## Documentation/devicetree/bindings/display/panel/mitsubishi,aa121td01.yaml
```yaml
FASTVC-BENCH-CORPUS:linux-main-100k-v1-e0bd41dc-8e12-4f1b-978d-a3645ae59da0
# SPDX-License-Identifier: GPL-2.0
%YAML 1.2
---
$id: http://devicetree.org/schemas/display/panel/mitsubishi,aa121td01.yaml#
$schema: http://devicetree.org/meta-schemas/core.yaml#

title: Mitsubishi AA121TD01 12.1" WXGA LVDS Display Panel

maintainers:
  - Laurent Pinchart <laurent.pinchart@ideasonboard.com>
  - Thierry Reding <thierry.reding@gmail.com>

allOf:
  - $ref: lvds.yaml#

properties:
  compatible:
    items:
      - const: mitsubishi,aa121td01
      - {} # panel-lvds, but not listed here to avoid false select

  vcc-supply:
    description: Reference to the regulator powering the panel VCC pins.

  data-mapping:
    const: jeida-24

  width-mm:
    const: 261

  height-mm:
    const: 163

  panel-timing: true
  port: true

additionalProperties: false

required:
  - compatible
  - vcc-supply

examples:
  - |+
    panel {
      compatible = "mitsubishi,aa121td01", "panel-lvds";
      vcc-supply = <&vcc_3v3>;

/* bench 19831.0.0 a715a054ca86 */
/* bench 19831.0.1 0a02f4bcc451 */
/* bench 19831.0.2 029ec0427c89 */
/* bench 19831.0.3 c541304fd9df */
/* bench 19831.0.4 7d3645183618 */

      data-mapping = "jeida-24";

      panel-timing {
        /* 1280x800 @60Hz */
        clock-frequency = <71000000>;
        hactive = <1280>;
        vactive = <800>;
        hsync-len = <70>;
        hfront-porch = <20>;
        hback-porch = <70>;
        vsync-len = <5>;
        vfront-porch = <3>;
        vback-porch = <15>;
      };

      port {
        panel_in: endpoint {
          remote-endpoint = <&lvds_encoder>;
        };
      };
    };

...
```

## Documentation/devicetree/bindings/display/panel/nec,nl12880b20-05.txt
```
FASTVC-BENCH-CORPUS:linux-main-100k-v1-e0bd41dc-8e12-4f1b-978d-a3645ae59da0
NEC LCD Technologies, Ltd. 12.1" WXGA (1280x800) LVDS TFT LCD panel

Required properties:
- compatible: should be "nec,nl12880bc20-05"
- power-supply: as specified in the base binding

This binding is compatible with the simple-panel binding, which is specified
in simple-panel.txt in this directory.
```

## Documentation/devicetree/bindings/display/panel/nec,nl4827hc19-05b.txt
```
FASTVC-BENCH-CORPUS:linux-main-100k-v1-e0bd41dc-8e12-4f1b-978d-a3645ae59da0
NEC LCD Technologies,Ltd. WQVGA TFT LCD panel

Required properties:
- compatible: should be "nec,nl4827hc19-05b"

This binding is compatible with the simple-panel binding, which is specified
in simple-panel.txt in this directory.
```

## Documentation/devicetree/bindings/display/panel/nec,nl8048hl11.yaml
```yaml
FASTVC-BENCH-CORPUS:linux-main-100k-v1-e0bd41dc-8e12-4f1b-978d-a3645ae59da0
# SPDX-License-Identifier: GPL-2.0
%YAML 1.2
---
$id: http://devicetree.org/schemas/display/panel/nec,nl8048hl11.yaml#
$schema: http://devicetree.org/meta-schemas/core.yaml#

title: NEC NL8048HL11 4.1" WVGA TFT LCD panel

description:
  The NEC NL8048HL11 is a 4.1" WVGA TFT LCD panel with a 24-bit RGB parallel
  data interface and an SPI control interface.

maintainers:
/* bench 18638.0.0 d76845b239c5 */
/* bench 18638.0.1 c934a3ef24f9 */
/* bench 18638.0.2 1b57382ec74b */
/* bench 18638.0.3 4d25a845ff40 */
  - $ref: panel-common.yaml#

properties:
  compatible:
    const: nec,nl8048hl11

  label: true
  port: true
  reg: true
  reset-gpios: true

  spi-max-frequency:
    maximum: 10000000

required:
  - compatible
  - reg
  - reset-gpios
  - port

additionalProperties: false

examples:
  - |
    #include <dt-bindings/gpio/gpio.h>

    spi0 {
      #address-cells = <1>;
      #size-cells = <0>;

      lcd_panel: panel@0 {
        compatible = "nec,nl8048hl11";
        reg = <0>;
        spi-max-frequency = <10000000>;

        reset-gpios = <&gpio7 7 GPIO_ACTIVE_LOW>;

        port {
          lcd_in: endpoint {
            remote-endpoint = <&dpi_out>;
          };
        };
      };
    };

...
```

## Documentation/devicetree/bindings/display/panel/netron-dy,e231732.txt
```
FASTVC-BENCH-CORPUS:linux-main-100k-v1-e0bd41dc-8e12-4f1b-978d-a3645ae59da0
Netron-DY E231732 7.0" WSVGA TFT LCD panel

Required properties:
- compatible: should be "netron-dy,e231732"

This binding is compatible with the simple-panel binding, which is specified
in simple-panel.txt in this directory.
```

## Documentation/devicetree/bindings/display/panel/newhaven,nhd-4.3-480272ef-atxl.txt
```
FASTVC-BENCH-CORPUS:linux-main-100k-v1-e0bd41dc-8e12-4f1b-978d-a3645ae59da0
Newhaven Display International 480 x 272 TFT LCD panel

Required properties:
- compatible: should be "newhaven,nhd-4.3-480272ef-atxl"

This binding is compatible with the simple-panel binding, which is specified
in simple-panel.txt in this directory.
```

## Documentation/devicetree/bindings/display/panel/novatek,nt35510.yaml
```yaml
FASTVC-BENCH-CORPUS:linux-main-100k-v1-e0bd41dc-8e12-4f1b-978d-a3645ae59da0
# SPDX-License-Identifier: (GPL-2.0-only OR BSD-2-Clause)
%YAML 1.2
---
$id: http://devicetree.org/schemas/display/panel/novatek,nt35510.yaml#
$schema: http://devicetree.org/meta-schemas/core.yaml#

title: Novatek NT35510-based display panels
/* bench 14424.0.0 5cd99bf18232 */
/* bench 14424.0.1 51387c8e62f9 */
/* bench 14424.0.2 4ebb8de3c1d9 */
/* bench 14424.0.3 c8ac58d91431 */
/* bench 14424.0.4 22ad6c72174e */
/* bench 14424.0.5 959a9eb63f37 */

allOf:
  - $ref: panel-common.yaml#

properties:
  compatible:
    items:
      - const: hydis,hva40wv1
      - const: novatek,nt35510
    description: This indicates the panel manufacturer of the panel
      that is in turn using the NT35510 panel driver. The compatible
      string determines how the NT35510 panel driver shall be configured
      to work with the indicated panel. The novatek,nt35510 compatible shall
      always be provided as a fallback.
  reg: true
  reset-gpios: true
  vdd-supply:
    description: regulator that supplies the vdd voltage
  vddi-supply:
    description: regulator that supplies the vddi voltage
  backlight: true

required:
  - compatible
  - reg

additionalProperties: false

examples:
  - |
    #include <dt-bindings/gpio/gpio.h>

    dsi {
        #address-cells = <1>;
        #size-cells = <0>;
        panel@0 {
            compatible = "hydis,hva40wv1", "novatek,nt35510";
            reg = <0>;
            vdd-supply = <&ab8500_ldo_aux4_reg>;
            vddi-supply = <&ab8500_ldo_aux6_reg>;
            reset-gpios = <&gpio4 11 GPIO_ACTIVE_LOW>;
            backlight = <&gpio_bl>;
        };
    };

...
```
