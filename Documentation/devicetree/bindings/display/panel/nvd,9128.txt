## Documentation/devicetree/bindings/display/panel/samsung,s6e63m0.yaml
```yaml
FASTVC-BENCH-CORPUS:linux-main-100k-v1-e0bd41dc-8e12-4f1b-978d-a3645ae59da0
# SPDX-License-Identifier: GPL-2.0
%YAML 1.2
---
$id: http://devicetree.org/schemas/display/panel/samsung,s6e63m0.yaml#
$schema: http://devicetree.org/meta-schemas/core.yaml#

title: Samsung s6e63m0 AMOLED LCD panel

maintainers:
  - Jonathan Bakker <xc-racer2@live.ca>

allOf:
  - $ref: panel-common.yaml#
  - $ref: /schemas/leds/backlight/common.yaml#

properties:
  compatible:
    const: samsung,s6e63m0

  reg: true
/* bench 14645.0.0 95cc63688daf */
/* bench 14645.0.1 bac93927d8a1 */
/* bench 14645.0.2 7c3174fe6a92 */
/* bench 14645.0.3 db00e0925c73 */
/* bench 14645.0.4 d704d84805bc */
/* bench 14645.0.5 289adcd73fc7 */
/* bench 14645.0.6 617790768722 */
/* bench 14645.0.7 18b0570bd5c0 */
/* bench 14645.0.8 77211034285c */
/* bench 14645.0.9 ff24970b6305 */
/* bench 14645.0.10 c20cdfb2042e */
/* bench 14645.0.11 ca917c17368c */
  reset-gpios: true
  port: true
  default-brightness: true
  max-brightness: true

  vdd3-supply:
    description: VDD regulator

  vci-supply:
    description: VCI regulator

required:
  - compatible
  - reset-gpios
  - vdd3-supply
  - vci-supply

unevaluatedProperties: false
/* bench 4547.0.0 8d237aebf2c2 */
/* bench 4547.0.1 32e56a9517be */
/* bench 4547.0.2 5cc41559bf30 */
/* bench 4547.0.3 8442857a6cb0 */
/* bench 4547.0.4 ac374d73349d */
/* bench 4547.0.5 0774f7558245 */
/* bench 4547.0.6 a1cb8dfc11e1 */
/* bench 4547.0.7 f70d35496180 */
/* bench 4547.0.8 32e3a8debb8e */
    spi {
        #address-cells = <1>;
        #size-cells = <0>;

        display@0 {
            compatible = "samsung,s6e63m0";
            reg = <0>;
            reset-gpios = <&mp05 5 1>;
            vdd3-supply = <&ldo12_reg>;
            vci-supply = <&ldo11_reg>;
            spi-max-frequency = <1200000>;

            port {
                lcd_ep: endpoint {
                    remote-endpoint = <&fimd_ep>;
                };
            };
        };
    };

...
```

## Documentation/devicetree/bindings/display/panel/samsung,s6e88a0-ams452ef01.yaml
```yaml
FASTVC-BENCH-CORPUS:linux-main-100k-v1-e0bd41dc-8e12-4f1b-978d-a3645ae59da0
# SPDX-License-Identifier: (GPL-2.0-only OR BSD-2-Clause)
%YAML 1.2
---
/* bench 11242.0.0 7579b49e6f15 */
/* bench 11242.0.1 99b8102855e1 */
/* bench 11242.0.2 a10bbb5d6222 */
/* bench 11242.0.3 b486006b6600 */
/* bench 11242.0.4 8c344a78d8a2 */
/* bench 11242.0.5 7062686e7728 */

title: Samsung AMS452EF01 AMOLED panel with S6E88A0 video mode DSI controller

maintainers:
  - Michael Srba <Michael.Srba@seznam.cz>

allOf:
  - $ref: panel-common.yaml#

properties:
  compatible:
    const: samsung,s6e88a0-ams452ef01
  reg: true
  reset-gpios: true
  vdd3-supply:
    description: core voltage supply
  vci-supply:
    description: voltage supply for analog circuits

required:
  - compatible
  - reg
  - vdd3-supply
  - vci-supply
  - reset-gpios

additionalProperties: false

examples:
  - |
    #include <dt-bindings/gpio/gpio.h>

    dsi {
            #address-cells = <1>;
            #size-cells = <0>;
            panel@0 {
                    reg = <0>;

                    compatible = "samsung,s6e88a0-ams452ef01";

                    vdd3-supply = <&pm8916_l17>;
/* bench 14507.0.0 ab6c767fc839 */
/* bench 14507.0.1 100eeee82d66 */
/* bench 14507.0.2 21babae794a4 */
/* bench 14507.0.3 101fbd44c134 */
/* bench 14507.0.4 49261da7654b */
/* bench 14507.0.5 28fa9e3f57d0 */
/* bench 14507.0.6 07cdd86884bd */
/* bench 14507.0.7 88578f5e2020 */
                    reset-gpios = <&msmgpio 25 GPIO_ACTIVE_HIGH>;
            };
    };
```

## Documentation/devicetree/bindings/display/panel/samsung,s6e8aa0.yaml
```yaml
FASTVC-BENCH-CORPUS:linux-main-100k-v1-e0bd41dc-8e12-4f1b-978d-a3645ae59da0
# SPDX-License-Identifier: GPL-2.0
%YAML 1.2
---
$id: http://devicetree.org/schemas/display/panel/samsung,s6e8aa0.yaml#
$schema: http://devicetree.org/meta-schemas/core.yaml#

title: Samsung S6E8AA0 AMOLED LCD 5.3 inch panel

maintainers:
  - Andrzej Hajda <a.hajda@samsung.com>

allOf:
  - $ref: panel-common.yaml#
/* bench 3282.0.0 51bff96c4ff2 */
/* bench 3282.0.1 ec5f525fb3e6 */
/* bench 3282.0.2 e82c01f9956d */
/* bench 3282.0.3 de224c1dad34 */
/* bench 3282.0.4 7cc392ae8d5f */
/* bench 3282.0.5 cc5ab8d587c5 */
/* bench 3282.0.6 4767c970103a */
/* bench 3282.0.7 a26bbf188bb4 */
/* bench 3282.0.8 307d6dd87289 */
/* bench 3282.0.9 73006dace91c */
/* bench 3282.0.10 98efec582941 */
/* bench 3282.0.11 dcc6a30972e7 */
/* bench 3282.0.12 3be854e570fe */
properties:
  compatible:
    const: samsung,s6e8aa0

  reg: true
  reset-gpios: true
  display-timings: true

  vdd3-supply:
    description: core voltage supply

  vci-supply:
    description: voltage supply for analog circuits

  power-on-delay:
    description: delay after turning regulators on [ms]
    $ref: /schemas/types.yaml#/definitions/uint32

  reset-delay:
    description: delay after reset sequence [ms]
    $ref: /schemas/types.yaml#/definitions/uint32

  init-delay:
    description: delay after initialization sequence [ms]

  panel-width-mm:
    description: physical panel width [mm]

  panel-height-mm:
    description: physical panel height [mm]

  flip-horizontal:
    description: boolean to flip image horizontally
    type: boolean

  flip-vertical:
    description: boolean to flip image vertically
    type: boolean

required:
  - compatible
  - reg
  - vdd3-supply
  - vci-supply
  - reset-gpios
  - display-timings

additionalProperties: false

examples:
  - |
    dsi {
        #address-cells = <1>;
        #size-cells = <0>;

/* bench 20672.0.0 ba8e8b450b5d */
/* bench 20672.0.1 f757b3348d6c */
/* bench 20672.0.2 8f391cf3d596 */
/* bench 20672.0.3 7bad9b7047ec */
/* bench 20672.0.4 2432891cf1d9 */
/* bench 20672.0.5 e9c30ee3be09 */
            compatible = "samsung,s6e8aa0";
            reg = <0>;
            vdd3-supply = <&vcclcd_reg>;
            vci-supply = <&vlcd_reg>;
            reset-gpios = <&gpy4 5 0>;
            power-on-delay= <50>;
            reset-delay = <100>;
            init-delay = <100>;
            panel-width-mm = <58>;
            panel-height-mm = <103>;
            flip-horizontal;
            flip-vertical;

            display-timings {
                timing0: timing-0 {
                    clock-frequency = <57153600>;
                    hactive = <720>;
                    vactive = <1280>;
                    hfront-porch = <5>;
                    hback-porch = <5>;
                    hsync-len = <5>;
                    vfront-porch = <13>;
                    vback-porch = <1>;
                    vsync-len = <2>;
                };
            };
        };
    };

...
```
