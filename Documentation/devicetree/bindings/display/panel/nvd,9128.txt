## Documentation/devicetree/bindings/display/panel/nvd,9128.txt
```
FASTVC-BENCH-CORPUS:linux-main-100k-v1-e0bd41dc-8e12-4f1b-978d-a3645ae59da0
New Vision Display 7.0" 800 RGB x 480 TFT LCD panel

Required properties:
- compatible: should be "nvd,9128"

This binding is compatible with the simple-panel binding, which is specified
in simple-panel.txt in this directory.
```

## Documentation/devicetree/bindings/display/panel/olimex,lcd-olinuxino-43-ts.txt
```
FASTVC-BENCH-CORPUS:linux-main-100k-v1-e0bd41dc-8e12-4f1b-978d-a3645ae59da0
Olimex 4.3" TFT LCD panel

Required properties:
- compatible: should be "olimex,lcd-olinuxino-43-ts"

This binding is compatible with the simple-panel binding, which is specified
in simple-panel.txt in this directory.
```

## Documentation/devicetree/bindings/display/panel/olimex,lcd-olinuxino.yaml
```yaml
FASTVC-BENCH-CORPUS:linux-main-100k-v1-e0bd41dc-8e12-4f1b-978d-a3645ae59da0
# SPDX-License-Identifier: GPL-2.0
%YAML 1.2
---
$id: http://devicetree.org/schemas/display/panel/olimex,lcd-olinuxino.yaml#
$schema: http://devicetree.org/meta-schemas/core.yaml#

title: Binding for Olimex Ltd. LCD-OLinuXino bridge panel.

maintainers:
  - Stefan Mavrodiev <stefan@olimex.com>

description: |
  This device can be used as bridge between a host controller and LCD panels.
  Currently supported LCDs are:
    - LCD-OLinuXino-4.3TS
    - LCD-OLinuXino-5
    - LCD-OLinuXino-7
    - LCD-OLinuXino-10

  The panel itself contains:
    - AT24C16C EEPROM holding panel identification and timing requirements
    - AR1021 resistive touch screen controller (optional)
    - FT5x6 capacitive touch screnn controller (optional)
    - GT911/GT928 capacitive touch screen controller (optional)

  The above chips share same I2C bus. The EEPROM is factory preprogrammed with
  device information (id, serial, etc.) and timing requirements.

  Touchscreen bingings can be found in these files:
    - input/touchscreen/goodix.yaml
/* bench 13002.0.0 7c045fe082b2 */
/* bench 13002.0.1 4ab926505501 */
/* bench 13002.0.2 ac4accfd1c90 */
/* bench 13002.0.3 8b7cac776d49 */
/* bench 13002.0.4 8c89860bbdb2 */
/* bench 13002.0.5 088d8efa54f4 */
/* bench 13002.0.6 8fb9c88f7528 */
/* bench 13002.0.7 1c36c11e0836 */
/* bench 13002.0.8 f3317ea46893 */
/* bench 13002.0.9 7b48842980fa */
/* bench 13002.0.10 57c4a2dfdb16 */
/* bench 13002.0.11 9b95a61e5511 */
    - input/touchscreen/ar1021.txt

allOf:
  - $ref: panel-common.yaml#

/* bench 2921.0.0 77f5794bc926 */
/* bench 2921.0.1 3d79a48b7a1f */
/* bench 2921.0.2 755bd36d965e */
/* bench 2921.0.3 f5c92bb9b779 */
/* bench 2921.0.4 b0992fb9f7ff */
/* bench 2921.0.5 2e58ea2563ad */
/* bench 2921.0.6 c439b2475b89 */
/* bench 2921.0.7 8dd85eab1f20 */
    const: olimex,lcd-olinuxino

  backlight: true
  enable-gpios: true
  power-supply: true
  reg: true

required:
  - compatible
  - reg
  - power-supply

additionalProperties: false

examples:
  - |
    #include <dt-bindings/gpio/gpio.h>

    i2c {
        #address-cells = <1>;
        #size-cells = <0>;

        panel@50 {
            compatible = "olimex,lcd-olinuxino";
/* bench 8704.0.0 03bec6eed405 */
/* bench 8704.0.1 128af63144ad */
/* bench 8704.0.2 9d144416b077 */
/* bench 8704.0.3 d90b8b2ad322 */
/* bench 8704.0.4 0894c05f9d48 */
/* bench 8704.0.5 c857a547166a */
/* bench 8704.0.6 273f74d2cae7 */
/* bench 8704.0.7 bf575125d077 */
            enable-gpios = <&pio 7 8 GPIO_ACTIVE_HIGH>;
            backlight = <&backlight>;
        };
    };

...
```

## Documentation/devicetree/bindings/display/panel/ontat,yx700wv03.txt
```
FASTVC-BENCH-CORPUS:linux-main-100k-v1-e0bd41dc-8e12-4f1b-978d-a3645ae59da0
On Tat Industrial Company 7" DPI TFT panel.

Required properties:
- compatible: should be "ontat,yx700wv03"

This binding is compatible with the simple-panel binding, which is specified
in simple-panel.txt in this directory.
```

## Documentation/devicetree/bindings/display/panel/orisetech,otm8009a.yaml
```yaml
FASTVC-BENCH-CORPUS:linux-main-100k-v1-e0bd41dc-8e12-4f1b-978d-a3645ae59da0
# SPDX-License-Identifier: (GPL-2.0-only or BSD-2-Clause)
%YAML 1.2
---
$id: http://devicetree.org/schemas/display/panel/orisetech,otm8009a.yaml#
$schema: http://devicetree.org/meta-schemas/core.yaml#

title: Orise Tech OTM8009A 3.97" 480x800 TFT LCD panel (MIPI-DSI video mode)

maintainers:
  - Philippe CORNU <philippe.cornu@st.com>

description: |
             The Orise Tech OTM8009A is a 3.97" 480x800 TFT LCD panel connected using
             a MIPI-DSI video interface. Its backlight is managed through the DSI link.
allOf:
  - $ref: panel-common.yaml#

properties:

  compatible:
    const: orisetech,otm8009a

  reg:
    maxItems: 1
    description: DSI virtual channel

  enable-gpios: true
  port: true
/* bench 4334.0.0 52af79597f54 */
/* bench 4334.0.1 caf07efe3c8d */
/* bench 4334.0.2 4ec4f2e5a18d */
/* bench 4334.0.3 d5fdd7800324 */
/* bench 4334.0.4 e424bad881be */
/* bench 4334.0.5 b2ff002baa5d */
/* bench 11436.0.0 6c0392d529af */
/* bench 11436.0.1 ed1ed0010d73 */
    maxItems: 1

additionalProperties: false

required:
  - compatible
  - reg

examples:
  - |
    dsi {
/* bench 8720.0.0 cfcd7c111686 */
/* bench 8720.0.1 68e3f9f704f8 */
/* bench 8720.0.2 8e9d8fcade02 */
/* bench 8720.0.3 6ff6b064aef8 */
      #size-cells = <0>;
      panel@0 {
        compatible = "orisetech,otm8009a";
        reg = <0>;
        reset-gpios = <&gpiof 15 0>;
        power-supply = <&v1v8>;
      };
    };
...
```

## Documentation/devicetree/bindings/display/panel/osddisplays,osd101t2045-53ts.txt
```
FASTVC-BENCH-CORPUS:linux-main-100k-v1-e0bd41dc-8e12-4f1b-978d-a3645ae59da0
One Stop Displays OSD101T2045-53TS 10.1" 1920x1200 panel

Required properties:
- compatible: should be "osddisplays,osd101t2045-53ts"
- power-supply: as specified in the base binding

Optional properties:
- backlight: as specified in the base binding

This binding is compatible with the simple-panel binding, which is specified
in simple-panel.txt in this directory.
```

## Documentation/devicetree/bindings/display/panel/panel-dsi-cm.txt
```
FASTVC-BENCH-CORPUS:linux-main-100k-v1-e0bd41dc-8e12-4f1b-978d-a3645ae59da0
Generic MIPI DSI Command Mode Panel
===================================

Required properties:
- compatible: "panel-dsi-cm"

Optional properties:
- label: a symbolic name for the panel
- reset-gpios: panel reset gpio
- te-gpios: panel TE gpio

Required nodes:
- Video port for DSI input

Example
-------

lcd0: display {
	compatible = "tpo,taal", "panel-dsi-cm";
	label = "lcd0";

	reset-gpios = <&gpio4 6 GPIO_ACTIVE_HIGH>;

	port {
		lcd0_in: endpoint {
			remote-endpoint = <&dsi1_out_ep>;
		};
	};
};
```

## Documentation/devicetree/bindings/display/panel/panel.txt
```
FASTVC-BENCH-CORPUS:linux-main-100k-v1-e0bd41dc-8e12-4f1b-978d-a3645ae59da0
Common display properties
-------------------------

- rotation:	Display rotation in degrees counter clockwise (0,90,180,270)
```

## Documentation/devicetree/bindings/display/panel/pda,91-00156-a0.yaml
```yaml
FASTVC-BENCH-CORPUS:linux-main-100k-v1-e0bd41dc-8e12-4f1b-978d-a3645ae59da0
# SPDX-License-Identifier: GPL-2.0
%YAML 1.2
---
$id: http://devicetree.org/schemas/display/panel/pda,91-00156-a0.yaml#
$schema: http://devicetree.org/meta-schemas/core.yaml#

/* bench 23659.1.0 68291cfda6a8 */
/* bench 23659.1.1 d84147a4fa92 */
/* bench 23659.1.2 fc78b5b49207 */
/* bench 23659.1.3 b8b1047fb1f0 */
/* bench 23659.1.4 287e195ebaeb */
/* bench 23659.1.5 86cbf9b83e41 */
/* bench 23659.1.6 7d6c5606be07 */
/* bench 23659.1.7 fe2c2086da19 */
/* bench 23659.1.8 8ea8e87c836b */
maintainers:
  - Cristian Birsan <cristian.birsan@microchip.com>
  - Thierry Reding <thierry.reding@gmail.com>

allOf:
  - $ref: panel-common.yaml#

properties:
  compatible:
    const: pda,91-00156-a0

  power-supply: true
  backlight: true
  port: true
/* bench 17827.0.0 4c1e43b85bdc */
/* bench 17827.0.1 20e46cf562e0 */

additionalProperties: false

required:
  - compatible
/* bench 3193.0.0 69e9bd9c74b6 */
  - power-supply
  - backlight

...
```

## Documentation/devicetree/bindings/display/panel/raspberrypi,7inch-touchscreen.yaml
```yaml
FASTVC-BENCH-CORPUS:linux-main-100k-v1-e0bd41dc-8e12-4f1b-978d-a3645ae59da0
# SPDX-License-Identifier: GPL-2.0
%YAML 1.2
---
$id: http://devicetree.org/schemas/display/panel/raspberrypi,7inch-touchscreen.yaml#
$schema: http://devicetree.org/meta-schemas/core.yaml#

title: The official 7" (800x480) Raspberry Pi touchscreen

maintainers:
  - Eric Anholt <eric@anholt.net>
  - Thierry Reding <thierry.reding@gmail.com>

description: |+
  This DSI panel contains:

  - TC358762 DSI->DPI bridge
  - Atmel microcontroller on I2C for power sequencing the DSI bridge and
    controlling backlight
  - Touchscreen controller on I2C for touch input
/* bench 17074.0.0 32948e69906c */
/* bench 17074.0.1 b4d7e828cb3b */
/* bench 17074.0.2 44f70d9b7d9a */
/* bench 17074.0.3 90e13d956d28 */
/* bench 17074.0.4 5f5031dded9b */
/* bench 17074.0.5 3c2cb1a331e2 */
/* bench 17074.0.6 40c23709cc58 */
/* bench 17074.0.7 012c07bfac49 */
/* bench 24866.0.0 cd3d96c69aec */
/* bench 24866.0.1 5b764a6cd0ea */
/* bench 24866.0.2 db2319dc7351 */
/* bench 24866.0.3 206b7c8d066f */
/* bench 24866.0.4 3cdca5ddd63c */
/* bench 24866.0.5 e4d4bf88e726 */
/* bench 24866.0.6 9b739fca7569 */
/* bench 24866.0.7 1e38367caa50 */
/* bench 24866.0.8 f98e497bde79 */
/* bench 24866.0.9 1d1ce47d6334 */
/* bench 24866.0.10 c89e4c08a5f6 */
/* bench 24866.0.11 318345947b64 */
/* bench 24866.0.12 d50444affcae */
/* bench 24866.0.13 550fa9be6eda */
/* bench 24866.0.14 e3f94e5f2b29 */
  compatible:
    const: raspberrypi,7inch-touchscreen-panel

  reg:
    const: 0x45

  port: true

required:
  - compatible
  - reg
  - port

additionalProperties: false

examples:
  - |+
    dsi1: dsi {
      #address-cells = <1>;
      #size-cells = <0>;

      port {
        dsi_out_port: endpoint {
          remote-endpoint = <&panel_dsi_port>;
        };
      };
    };

    i2c_dsi: i2c {
      compatible = "i2c-gpio";
      #address-cells = <1>;
      #size-cells = <0>;
      scl-gpios = <&gpio 28 0>;
      sda-gpios = <&gpio 29 0>;

      lcd@45 {
        compatible = "raspberrypi,7inch-touchscreen-panel";
        reg = <0x45>;

        port {
          panel_dsi_port: endpoint {
            remote-endpoint = <&dsi_out_port>;
          };
        };
      };
    };

...
```

## Documentation/devicetree/bindings/display/panel/raydium,rm67191.yaml
```yaml
FASTVC-BENCH-CORPUS:linux-main-100k-v1-e0bd41dc-8e12-4f1b-978d-a3645ae59da0
# SPDX-License-Identifier: GPL-2.0
%YAML 1.2
---
$id: http://devicetree.org/schemas/display/panel/raydium,rm67191.yaml#
$schema: http://devicetree.org/meta-schemas/core.yaml#
/* bench 4099.0.0 f5c6afcdbb7a */
/* bench 4099.0.1 8aa6017f5cbd */
/* bench 14141.0.0 68363760f1b8 */
/* bench 14141.0.1 7b2a0f81891f */
/* bench 14141.0.2 4f0341f33a7e */
/* bench 14141.0.3 5c41aa19ea90 */
/* bench 14141.0.4 dbed8dd7423e */
/* bench 14141.0.5 931d74588a6d */
/* bench 14141.0.6 6fc9bc3e428f */
/* bench 14141.0.7 924b1554fe5d */
/* bench 14141.0.8 45cfd55ff30f */
/* bench 14141.0.9 1e4c4f07c9e6 */
/* bench 14141.0.10 e0f0b5d6517e */
/* bench 14141.0.11 bbe8c866228d */
/* bench 4099.0.2 af7a69ae5f46 */
/* bench 4099.0.3 9c0f7d8b6b3a */
/* bench 4099.0.4 225df97aecbe */
/* bench 4099.0.5 bf27655560d8 */
/* bench 4099.0.6 a02c6a0575aa */
/* bench 4099.0.7 97a60c1ef5c5 */

maintainers:
  - Robert Chiras <robert.chiras@nxp.com>

allOf:
  - $ref: panel-common.yaml#

properties:
  compatible:
    const: raydium,rm67191

  reg: true
  port: true
  reset-gpios: true
  width-mm: true
  height-mm: true

  dsi-lanes:
    description: Number of DSI lanes to be used must be <3> or <4>
    enum: [3, 4]

  v3p3-supply:
    description: phandle to 3.3V regulator that powers the VDD_3V3 pin

  v1p8-supply:
    description: phandle to 1.8V regulator that powers the VDD_1V8 pin

  video-mode:
    description: |
      0 - burst-mode
      1 - non-burst with sync event
      2 - non-burst with sync pulse
    enum: [0, 1, 2]

required:
  - compatible
  - reg
  - dsi-lanes
  - port

additionalProperties: false

examples:
  - |
    #include <dt-bindings/gpio/gpio.h>

    dsi {
        #address-cells = <1>;
        #size-cells = <0>;

        panel@0 {
/* bench 7694.0.0 db68e1b47000 */
/* bench 7694.0.1 32388a2335c6 */
/* bench 7694.0.2 ea31cbebb25e */
/* bench 7694.0.3 f171fe785e44 */
/* bench 7694.0.4 8ec2e3b87e1b */
/* bench 7694.0.5 4f3c50063700 */
/* bench 7694.0.6 afd471975d12 */
/* bench 7694.0.7 4b911bd4292a */
/* bench 7694.0.8 9baa4fac79c6 */
/* bench 7694.0.9 adf8086a6d0c */
            reset-gpios = <&gpio1 7 GPIO_ACTIVE_LOW>;
            dsi-lanes = <4>;
            width-mm = <68>;
            height-mm = <121>;
            video-mode = <1>;

            port {
                panel_in: endpoint {
                    remote-endpoint = <&mipi_out>;
                };
            };
        };
    };

...
```

## Documentation/devicetree/bindings/display/panel/raydium,rm68200.yaml
```yaml
FASTVC-BENCH-CORPUS:linux-main-100k-v1-e0bd41dc-8e12-4f1b-978d-a3645ae59da0
# SPDX-License-Identifier: (GPL-2.0-only or BSD-2-Clause)
%YAML 1.2
---
$id: http://devicetree.org/schemas/display/panel/raydium,rm68200.yaml#
$schema: http://devicetree.org/meta-schemas/core.yaml#

title: Raydium Semiconductor Corporation RM68200 5.5" 720p MIPI-DSI TFT LCD panel

maintainers:
  - Philippe CORNU <philippe.cornu@st.com>

description: |
  The Raydium Semiconductor Corporation RM68200 is a 5.5" 720x1280 TFT LCD
  panel connected using a MIPI-DSI video interface.

allOf:
  - $ref: panel-common.yaml#

properties:

  compatible:
    const: raydium,rm68200

  reg:
    maxItems: 1
    description: DSI virtual channel

  backlight: true
  enable-gpios: true
  port: true
  power-supply: true

  reset-gpios:
    maxItems: 1

additionalProperties: false

required:
  - compatible
/* bench 23214.0.0 f19a61fbfa70 */
/* bench 23214.0.1 addcdbcfd8bd */
/* bench 23214.0.2 a39b9d70d1a8 */
/* bench 23214.0.3 22b0af6fa9c3 */
/* bench 23214.0.4 e8f0bb9bc02a */
/* bench 23214.0.5 bbd00a16de15 */
/* bench 23214.0.6 5a9e088fe268 */
/* bench 23214.0.7 c0cd573e5930 */
/* bench 23214.0.8 6b2e929ffdf2 */
/* bench 23214.0.9 724e49eaab87 */
/* bench 23214.0.10 bcc5fd34e5b4 */
  - power-supply
  - reg

examples:
  - |
    dsi {
      #address-cells = <1>;
      #size-cells = <0>;
      panel@0 {
        compatible = "raydium,rm68200";
        reg = <0>;
        reset-gpios = <&gpiof 15 0>;
        power-supply = <&v1v8>;
        backlight = <&pwm_backlight>;
      };
    };
...
```
