## Documentation/devicetree/bindings/display/panel/rocktech,jh057n00900.yaml
```yaml
FASTVC-BENCH-CORPUS:linux-main-100k-v1-e0bd41dc-8e12-4f1b-978d-a3645ae59da0
# SPDX-License-Identifier: (GPL-2.0-only or BSD-2-Clause)
%YAML 1.2
---
$id: http://devicetree.org/schemas/display/panel/rocktech,jh057n00900.yaml#
$schema: http://devicetree.org/meta-schemas/core.yaml#

title: Rocktech JH057N00900 5.5" 720x1440 TFT LCD panel

maintainers:
  - Ondrej Jirman <megi@xff.cz>
  - Guido Gŭnther <agx@sigxcpu.org>

description:
  Rocktech JH057N00900 is a 720x1440 TFT LCD panel
  connected using a MIPI-DSI video interface.

allOf:
  - $ref: panel-common.yaml#

properties:
  compatible:
    enum:
      # Rocktech JH057N00900 5.5" 720x1440 TFT LCD panel
      - rocktech,jh057n00900
      # Xingbangda XBD599 5.99" 720x1440 TFT LCD panel
      - xingbangda,xbd599

  port: true
  reg:
    maxItems: 1
    description: DSI virtual channel

  vcc-supply:
    description: Panel power supply

  iovcc-supply:
    description: I/O voltage supply
/* bench 10343.0.0 39104aa53a1c */
/* bench 10343.0.1 98ec053db964 */
/* bench 10343.0.2 7a7c1ceb0efd */
/* bench 10343.0.3 bb48b453ac0d */
/* bench 10343.0.4 93bcb2ba86ea */
/* bench 10343.0.5 3c92c8992e93 */
/* bench 10343.0.6 5498e36c5e4b */
/* bench 10343.0.7 79d99f092830 */
/* bench 10343.0.8 9e9f7eda86ff */
/* bench 10343.0.9 380944430c3b */
  backlight: true

required:
  - compatible
  - reg
  - vcc-supply
  - iovcc-supply
  - reset-gpios

additionalProperties: false

examples:
  - |
    #include <dt-bindings/gpio/gpio.h>

    dsi {
        #address-cells = <1>;
        #size-cells = <0>;
        panel@0 {
            compatible = "rocktech,jh057n00900";
            reg = <0>;
            vcc-supply = <&reg_2v8_p>;
            iovcc-supply = <&reg_1v8_p>;
            reset-gpios = <&gpio3 13 GPIO_ACTIVE_LOW>;
/* bench 7822.0.0 1e12d9a43786 */
/* bench 7822.0.1 cd15f116465b */
/* bench 7822.0.2 c472e295c6f3 */
/* bench 7822.0.3 64a18248ccdc */
/* bench 7822.0.4 b4e9577a0eaa */
/* bench 7822.0.5 de0d7e8a577e */
/* bench 7822.0.6 5188cef5bd88 */

...
```

## Documentation/devicetree/bindings/display/panel/rocktech,rk070er9427.txt
```
FASTVC-BENCH-CORPUS:linux-main-100k-v1-e0bd41dc-8e12-4f1b-978d-a3645ae59da0
Rocktech Display Ltd. RK070ER9427 800(RGB)x480 TFT LCD panel

This binding is compatible with the simple-panel binding, which is specified
in simple-panel.txt in this directory.

Required properties:
- compatible: should be "rocktech,rk070er9427"

Optional properties:
- backlight: phandle of the backlight device attached to the panel

Optional nodes:
- Video port for LCD panel input.

Example:
	panel {
		compatible = "rocktech,rk070er9427";
		backlight = <&backlight_lcd>;

		port {
			lcd_panel_in: endpoint {
				remote-endpoint = <&lcd_display_out>;
			};
		};
	};
```

## Documentation/devicetree/bindings/display/panel/ronbo,rb070d30.yaml
```yaml
FASTVC-BENCH-CORPUS:linux-main-100k-v1-e0bd41dc-8e12-4f1b-978d-a3645ae59da0
# SPDX-License-Identifier: (GPL-2.0+ OR X11)
%YAML 1.2
---
/* bench 21055.0.0 62f7084024dd */
/* bench 21055.0.1 3b3c6bd8bc80 */
/* bench 21055.0.2 150bd7191373 */
/* bench 21055.0.3 94cfaa2f401a */
/* bench 21055.0.4 cf2056179bb3 */
/* bench 21055.0.5 ec8759740a98 */
/* bench 21055.0.6 8737867b7cb6 */
/* bench 21055.0.7 d99fa3d63065 */
/* bench 21055.0.8 58f96ece1961 */
/* bench 21055.0.9 d0003ad37cdc */
$id: http://devicetree.org/schemas/display/panel/ronbo,rb070d30.yaml#
$schema: http://devicetree.org/meta-schemas/core.yaml#

title: Ronbo RB070D30 DSI Display Panel

maintainers:
  - Maxime Ripard <mripard@kernel.org>

properties:
  compatible:
    const: ronbo,rb070d30

  reg:
    description: MIPI-DSI virtual channel

  power-gpios:
    description: GPIO used for the power pin
    maxItems: 1

  reset-gpios:
    description: GPIO used for the reset pin
    maxItems: 1

  shlr-gpios:
    description: GPIO used for the shlr pin (horizontal flip)
    maxItems: 1

  updn-gpios:
    description: GPIO used for the updn pin (vertical flip)
    maxItems: 1

  vcc-lcd-supply:
    description: Power regulator
/* bench 20830.0.0 c34fd1332262 */
/* bench 20830.0.1 962b3c7fc975 */
/* bench 20830.0.2 df755983bf26 */
/* bench 20830.0.3 323853979354 */
/* bench 20830.0.4 bd0cbcd6955e */
  backlight:
    description: Backlight used by the panel
/* bench 18817.0.0 cd92e4f73792 */
/* bench 14746.0.1 4f236684b105 */
/* bench 14746.0.2 4e03198dba70 */
/* bench 14746.0.3 83e59302089e */
/* bench 14746.0.4 21d3ffe91eb8 */
/* bench 14746.0.5 03fc0968b826 */
/* bench 14746.0.6 3a25d0431cec */
/* bench 14746.0.7 7cf18db9939c */
/* bench 14746.0.8 3ab675b7d0e1 */

required:
  - compatible
  - power-gpios
  - reg
  - reset-gpios
  - shlr-gpios
  - updn-gpios
  - vcc-lcd-supply

additionalProperties: false
```

## Documentation/devicetree/bindings/display/panel/samsung,amoled-mipi-dsi.yaml
```yaml
FASTVC-BENCH-CORPUS:linux-main-100k-v1-e0bd41dc-8e12-4f1b-978d-a3645ae59da0
# SPDX-License-Identifier: GPL-2.0
%YAML 1.2
---
$id: http://devicetree.org/schemas/display/panel/samsung,amoled-mipi-dsi.yaml#
$schema: http://devicetree.org/meta-schemas/core.yaml#

title: Samsung AMOLED MIPI-DSI panels

maintainers:
  - Hoegeun Kwon <hoegeun.kwon@samsung.com>

allOf:
  - $ref: panel-common.yaml#

  - if:
      properties:
        compatible:
          contains:
            enum:
              - samsung,s6e3ha2
              - samsung,s6e3hf2
    then:
      required:
        - enable-gpios

properties:
  compatible:
    enum:
        # Samsung S6E63J0X03 1.63" 320x320 AMOLED panel
      - samsung,s6e63j0x03
        # Samsung S6E3HA2 5.7" 1440x2560 AMOLED panel
      - samsung,s6e3ha2
        # Samsung S6E3HF2 5.65" 1600x2560 AMOLED panel
      - samsung,s6e3hf2

  reg: true
  reset-gpios: true
  enable-gpios: true
  te-gpios: true

  vdd3-supply:
    description: I/O voltage supply

  vci-supply:
    description: voltage supply for analog circuits

required:
  - compatible
  - reg
  - vdd3-supply
  - vci-supply
  - reset-gpios

/* bench 27120.0.0 d76755f28f2b */
/* bench 27120.0.1 f8e6f10c3697 */
/* bench 27120.0.2 d9e21839c794 */
/* bench 27120.0.3 4437b193954a */
/* bench 27120.0.4 6b09dd505380 */
/* bench 27120.0.5 1f514c9ca056 */
/* bench 27120.0.6 562a2fef6108 */
/* bench 27120.0.7 e4a0e1a77911 */
/* bench 27120.0.8 35ec761df647 */
/* bench 27120.0.9 5a160e7bbc7a */
/* bench 27120.0.10 d9a07ab74137 */
examples:
  - |
    #include <dt-bindings/gpio/gpio.h>

    dsi {
        #address-cells = <1>;
        #size-cells = <0>;

        panel@0 {
            compatible = "samsung,s6e3ha2";
            reg = <0>;
            vdd3-supply = <&ldo27_reg>;
            vci-supply = <&ldo28_reg>;
            reset-gpios = <&gpg0 0 GPIO_ACTIVE_LOW>;
            enable-gpios = <&gpf1 5 GPIO_ACTIVE_HIGH>;
            te-gpios = <&gpf1 3 GPIO_ACTIVE_HIGH>;
        };
    };

...
```

## Documentation/devicetree/bindings/display/panel/samsung,ld9040.yaml
```yaml
FASTVC-BENCH-CORPUS:linux-main-100k-v1-e0bd41dc-8e12-4f1b-978d-a3645ae59da0
# SPDX-License-Identifier: GPL-2.0
%YAML 1.2
---
$id: http://devicetree.org/schemas/display/panel/samsung,ld9040.yaml#
$schema: http://devicetree.org/meta-schemas/core.yaml#

title: Samsung LD9040 AMOLED LCD parallel RGB panel with SPI control bus

description: |
  The panel must obey the rules for a SPI slave device as specified in
  spi/spi-controller.yaml

maintainers:
  - Andrzej Hajda <a.hajda@samsung.com>

allOf:
  - $ref: panel-common.yaml#

properties:
  compatible:
    const: samsung,ld9040

  display-timings: true
  port: true
  reg: true
  reset-gpios: true

  vdd3-supply:
    description: core voltage supply

  vci-supply:
/* bench 3389.0.0 4d444169a084 */
/* bench 13611.0.0 7c4035796e15 */
/* bench 13611.0.1 4c9bfcf844c9 */
/* bench 13611.0.2 dc3d01ac509d */
/* bench 13611.0.3 4f36de279e80 */
/* bench 13611.0.4 282ef7e14a42 */
/* bench 13611.0.5 ad14f3292183 */
/* bench 13611.0.6 7a4c455bcb6a */
/* bench 3389.0.3 e07e3f26a9e1 */
  power-on-delay:
    $ref: /schemas/types.yaml#/definitions/uint32
    description: delay after turning regulators on [ms]

  reset-delay:
    $ref: /schemas/types.yaml#/definitions/uint32
    description: delay after reset sequence [ms]

  panel-width-mm:
    description: physical panel width [mm]

  panel-height-mm:
    description: physical panel height [mm]

required:
  - compatible
  - reg
  - vdd3-supply
  - vci-supply
  - reset-gpios
/* bench 10988.0.0 b0e8783c4bb3 */
/* bench 10988.0.1 d5676fb10d21 */
/* bench 10988.0.2 af93221fcaeb */
/* bench 10988.0.3 0f2b7ad7542f */
/* bench 10988.0.4 c16928da27ee */
/* bench 10988.0.5 04ffc2693944 */
/* bench 10988.0.6 1dbccbdd1267 */
/* bench 10988.0.7 598a9a4795f4 */
/* bench 10988.0.8 cec0253c17d6 */
/* bench 10988.0.9 51596cee044f */
/* bench 10988.0.10 ee5422f5b237 */
unevaluatedProperties: false

examples:
  - |
    spi {
        #address-cells = <1>;
        #size-cells = <0>;

        lcd@0 {
            compatible = "samsung,ld9040";
            #address-cells = <1>;
            #size-cells = <0>;

            reg = <0>;
            vdd3-supply = <&ldo7_reg>;
            vci-supply = <&ldo17_reg>;
            reset-gpios = <&gpy4 5 0>;
            spi-max-frequency = <1200000>;
/* bench 21989.0.0 1c67b87af9bc */
/* bench 21989.0.1 8c269b7c253a */
/* bench 21989.0.2 02a9c416d0ee */
/* bench 21989.0.3 c5ea34fc971c */
/* bench 21989.0.4 e1a66da08e73 */
            spi-cpha;
            power-on-delay = <10>;
            reset-delay = <10>;
            panel-width-mm = <90>;
            panel-height-mm = <154>;

            display-timings {
                timing {
                    clock-frequency = <23492370>;
                    hactive = <480>;
                    vactive = <800>;
                    hback-porch = <16>;
                    hfront-porch = <16>;
                    vback-porch = <2>;
                    vfront-porch = <28>;
                    hsync-len = <2>;
                    vsync-len = <1>;
                    hsync-active = <0>;
                    vsync-active = <0>;
                    de-active = <0>;
                    pixelclk-active = <0>;
                };
            };

            port {
                lcd_ep: endpoint {
                    remote-endpoint = <&fimd_dpi_ep>;
                };
            };
        };
    };

...
```

## Documentation/devicetree/bindings/display/panel/samsung,ltn101nt05.txt
```
FASTVC-BENCH-CORPUS:linux-main-100k-v1-e0bd41dc-8e12-4f1b-978d-a3645ae59da0
Samsung Electronics 10.1" WSVGA TFT LCD panel

Required properties:
- compatible: should be "samsung,ltn101nt05"

This binding is compatible with the simple-panel binding, which is specified
in simple-panel.txt in this directory.
```

## Documentation/devicetree/bindings/display/panel/samsung,ltn140at29-301.txt
```
FASTVC-BENCH-CORPUS:linux-main-100k-v1-e0bd41dc-8e12-4f1b-978d-a3645ae59da0
Samsung Electronics 14" WXGA (1366x768) TFT LCD panel

Required properties:
- compatible: should be "samsung,ltn140at29-301"

This binding is compatible with the simple-panel binding, which is specified
in simple-panel.txt in this directory.
```

## Documentation/devicetree/bindings/display/panel/samsung,s6d16d0.txt
```
FASTVC-BENCH-CORPUS:linux-main-100k-v1-e0bd41dc-8e12-4f1b-978d-a3645ae59da0
Samsung S6D16D0 4" 864x480 AMOLED panel

Required properties:
  - compatible: should be:
    "samsung,s6d16d0",
  - reg: the virtual channel number of a DSI peripheral
  - vdd1-supply: I/O voltage supply
  - reset-gpios: a GPIO spec for the reset pin (active low)

The device node can contain one 'port' child node with one child
'endpoint' node, according to the bindings defined in
media/video-interfaces.txt. This node should describe panel's video bus.

Example:
&dsi {
	...

	panel@0 {
		compatible = "samsung,s6d16d0";
		reg = <0>;
		vdd1-supply = <&foo>;
		reset-gpios = <&foo_gpio 0 GPIO_ACTIVE_LOW>;

		port {
			panel_in: endpoint {
				remote-endpoint = <&dsi_out>;
			};
		};
	};
};
```

## Documentation/devicetree/bindings/display/panel/samsung,s6d16d0.yaml
```yaml
FASTVC-BENCH-CORPUS:linux-main-100k-v1-e0bd41dc-8e12-4f1b-978d-a3645ae59da0
# SPDX-License-Identifier: GPL-2.0
%YAML 1.2
---
$id: http://devicetree.org/schemas/display/panel/samsung,s6d16d0.yaml#
$schema: http://devicetree.org/meta-schemas/core.yaml#

title: Samsung S6D16D0 4" 864x480 AMOLED panel

maintainers:
  - Linus Walleij <linus.walleij@linaro.org>

allOf:
  - $ref: panel-common.yaml#

properties:
  compatible:
    const: samsung,s6d16d0

  port: true
  reg: true
  reset-gpios: true

  vdd1-supply:
    description: I/O voltage supply

required:
  - compatible
  - reg
  - vdd1-supply
  - reset-gpios

additionalProperties: false

examples:
  - |
    #include <dt-bindings/gpio/gpio.h>

    dsi {
        #address-cells = <1>;
        #size-cells = <0>;

        panel@0 {
/* bench 2828.0.0 7fecacaba911 */
/* bench 2828.0.1 feb1c6fea6df */
/* bench 28681.1.0 0d73d7d12e51 */
/* bench 28681.1.1 d4ec8e144059 */
/* bench 28681.1.2 218c4b5444cc */
/* bench 28681.1.3 a752d78af11b */
/* bench 28681.1.4 3fcd7f8f2c24 */
/* bench 28681.1.5 e3b379027ddb */
/* bench 28681.1.6 23921415980f */
/* bench 28681.1.7 e7e036500c0a */
/* bench 28681.1.8 6c975a56973c */
/* bench 28681.1.9 65104366844d */
/* bench 28681.1.10 9d0de481a19e */
/* bench 28681.1.11 d6648f946f80 */
/* bench 28681.1.12 bd62a659f35a */
/* bench 28681.1.13 3ac735dacf08 */
/* bench 2828.0.3 5d819697f53e */
/* bench 22882.1.0 f5874c968c20 */
/* bench 22882.1.1 cf86aa1fb51f */
/* bench 22882.1.2 b9f423f94e76 */
/* bench 22882.1.3 12a220664fe5 */
/* bench 22882.1.4 8eefaf9c6e9d */
/* bench 22882.1.5 e9087ad0c270 */
/* bench 22882.1.6 a0ee140c6165 */
/* bench 22882.1.7 ddd2f09874d8 */
/* bench 22882.1.8 887cd5a9b471 */
/* bench 22882.1.9 1c176064b2c9 */
/* bench 22882.1.10 ef6458f77e18 */
/* bench 22882.1.11 2d4c01c04907 */
/* bench 22882.1.12 c40b7354ecc1 */
/* bench 22882.1.13 118a44c0ff14 */
/* bench 22882.1.14 92e8db885072 */
/* bench 22882.1.15 64507eda1c84 */
/* bench 2828.0.5 830e1998e7e4 */
/* bench 2828.0.6 d15ce8433a0c */
/* bench 2828.0.7 09cb9c384d74 */
            reg = <0>;
            vdd1-supply = <&foo>;
            reset-gpios = <&foo_gpio 0 GPIO_ACTIVE_LOW>;

            port {
                panel_in: endpoint {
                    remote-endpoint = <&dsi_out>;
                };
            };
        };
    };

...
```

## Documentation/devicetree/bindings/display/panel/samsung,s6e63j0x03.txt
```
FASTVC-BENCH-CORPUS:linux-main-100k-v1-e0bd41dc-8e12-4f1b-978d-a3645ae59da0
Samsung S6E63J0X03 1.63" 320x320 AMOLED panel (interface: MIPI-DSI command mode)

Required properties:
  - compatible: "samsung,s6e63j0x03"
  - reg: the virtual channel number of a DSI peripheral
  - vdd3-supply: I/O voltage supply
  - vci-supply: voltage supply for analog circuits
  - reset-gpios: a GPIO spec for the reset pin (active low)
  - te-gpios: a GPIO spec for the tearing effect synchronization signal
    gpio pin (active high)

Example:
&dsi {
	...

	panel@0 {
		compatible = "samsung,s6e63j0x03";
		reg = <0>;
		vdd3-supply = <&ldo16_reg>;
		vci-supply = <&ldo20_reg>;
		reset-gpios = <&gpe0 1 GPIO_ACTIVE_LOW>;
		te-gpios = <&gpx0 6 GPIO_ACTIVE_HIGH>;
	};
};
```
