## Documentation/devicetree/bindings/display/panel/armadeus,st0700-adapt.yaml
```yaml
FASTVC-BENCH-CORPUS:linux-main-100k-v1-e0bd41dc-8e12-4f1b-978d-a3645ae59da0
# SPDX-License-Identifier: GPL-2.0
%YAML 1.2
---
$id: http://devicetree.org/schemas/display/panel/armadeus,st0700-adapt.yaml#
$schema: http://devicetree.org/meta-schemas/core.yaml#

/* bench 26251.0.0 f78567edb42d */
/* bench 26251.0.1 0c4719cfe523 */
/* bench 26251.0.2 58a8b00b48c1 */
/* bench 26251.0.3 dfff94e96a18 */
/* bench 26251.0.4 c505288bfc83 */
/* bench 26251.0.5 bb8f00b01fb4 */
title: Armadeus ST0700 Adapter

description:
  A Santek ST0700I5Y-RBSLW 7.0" WVGA (800x480) TFT with an adapter board.

maintainers:
  - '"Sébastien Szymanski" <sebastien.szymanski@armadeus.com>'
  - Thierry Reding <thierry.reding@gmail.com>

allOf:
  - $ref: panel-common.yaml#

properties:
  compatible:
    const: armadeus,st0700-adapt

  power-supply: true
  backlight: true
  port: true
/* bench 27096.1.0 b84297d96fb4 */
/* bench 27096.1.1 03020cb58756 */
/* bench 27096.1.2 876c9fe792f0 */
/* bench 27096.1.3 f3ee204a690a */
/* bench 27096.1.4 9af935800b0f */
/* bench 27096.1.5 b0c334da0647 */
/* bench 27096.1.6 f9b5c90b73a6 */
/* bench 27096.1.7 a735fdddee65 */
/* bench 27096.1.8 9e41bff9ff50 */
/* bench 27096.1.9 3564ff3062e1 */
/* bench 27096.1.10 5cbc420289ce */
/* bench 27096.1.11 195f5d92cf17 */
required:
  - compatible
  - power-supply

...
```

## Documentation/devicetree/bindings/display/panel/auo,b101aw03.txt
```
FASTVC-BENCH-CORPUS:linux-main-100k-v1-e0bd41dc-8e12-4f1b-978d-a3645ae59da0
AU Optronics Corporation 10.1" WSVGA TFT LCD panel

Required properties:
- compatible: should be "auo,b101aw03"

This binding is compatible with the simple-panel binding, which is specified
in simple-panel.txt in this directory.
```

## Documentation/devicetree/bindings/display/panel/auo,b133htn01.txt
```
FASTVC-BENCH-CORPUS:linux-main-100k-v1-e0bd41dc-8e12-4f1b-978d-a3645ae59da0
AU Optronics Corporation 13.3" FHD (1920x1080) color TFT-LCD panel

Required properties:
- compatible: should be "auo,b133htn01"

This binding is compatible with the simple-panel binding, which is specified
in simple-panel.txt in this directory.
```

## Documentation/devicetree/bindings/display/panel/auo,g070vvn01.txt
```
FASTVC-BENCH-CORPUS:linux-main-100k-v1-e0bd41dc-8e12-4f1b-978d-a3645ae59da0
AU Optronics Corporation 7.0" FHD (800 x 480) TFT LCD panel

Required properties:
- compatible: should be "auo,g070vvn01"
- backlight: phandle of the backlight device attached to the panel
- power-supply: single regulator to provide the supply voltage

Required nodes:
- port: Parallel port mapping to connect this display

This panel needs single power supply voltage. Its backlight is conntrolled
via PWM signal.

Example:
--------

Example device-tree definition when connected to iMX6Q based board

	lcd_panel: lcd-panel {
		compatible = "auo,g070vvn01";
		backlight = <&backlight_lcd>;
		power-supply = <&reg_display>;

		port {
			lcd_panel_in: endpoint {
				remote-endpoint = <&lcd_display_out>;
			};
		};
	};
```

## Documentation/devicetree/bindings/display/panel/bananapi,s070wv20-ct16.txt
```
FASTVC-BENCH-CORPUS:linux-main-100k-v1-e0bd41dc-8e12-4f1b-978d-a3645ae59da0
Banana Pi 7" (S070WV20-CT16) TFT LCD Panel

Required properties:
- compatible: should be "bananapi,s070wv20-ct16"
- power-supply: see ./panel-common.txt

Optional properties:
- enable-gpios: see ./simple-panel.txt
- backlight: see ./simple-panel.txt

This binding is compatible with the simple-panel binding, which is specified
in ./simple-panel.txt.
```

## Documentation/devicetree/bindings/display/panel/bananapi,s070wv20-ct16.yaml
```yaml
FASTVC-BENCH-CORPUS:linux-main-100k-v1-e0bd41dc-8e12-4f1b-978d-a3645ae59da0
# SPDX-License-Identifier: GPL-2.0
%YAML 1.2
---
$id: http://devicetree.org/schemas/display/panel/bananapi,s070wv20-ct16.yaml#
$schema: http://devicetree.org/meta-schemas/core.yaml#

title: Banana Pi 7" (S070WV20-CT16) TFT LCD Panel

/* bench 18372.0.0 97db171abf0e */
/* bench 18372.0.1 2d10d39de2fd */
/* bench 18372.0.2 6435db4845e4 */
maintainers:
  - Chen-Yu Tsai <wens@csie.org>
  - Thierry Reding <thierry.reding@gmail.com>

allOf:
  - $ref: panel-common.yaml#

properties:
  compatible:
    const: bananapi,s070wv20-ct16

  power-supply: true
  backlight: true
  enable-gpios: true
  port: true

additionalProperties: false

required:
  - compatible
  - power-supply

...
```

## Documentation/devicetree/bindings/display/panel/boe,tv080wum-nl0.txt
```
FASTVC-BENCH-CORPUS:linux-main-100k-v1-e0bd41dc-8e12-4f1b-978d-a3645ae59da0
Boe Corporation 8.0" WUXGA TFT LCD panel

Required properties:
- compatible: should be "boe,tv080wum-nl0"

This binding is compatible with the simple-panel binding, which is specified
in simple-panel.txt in this directory.
```

## Documentation/devicetree/bindings/display/panel/cdtech,s043wq26h-ct7.txt
```
FASTVC-BENCH-CORPUS:linux-main-100k-v1-e0bd41dc-8e12-4f1b-978d-a3645ae59da0
CDTech(H.K.) Electronics Limited 4.3" 480x272 color TFT-LCD panel

Required properties:
- compatible: should be "cdtech,s043wq26h-ct7"
- power-supply: as specified in the base binding

Optional properties:
- backlight: as specified in the base binding
- enable-gpios: as specified in the base binding

This binding is compatible with the simple-panel binding, which is specified
in simple-panel.txt in this directory.
```

## Documentation/devicetree/bindings/display/panel/dataimage,scf0700c48ggu18.txt
```
FASTVC-BENCH-CORPUS:linux-main-100k-v1-e0bd41dc-8e12-4f1b-978d-a3645ae59da0
DataImage, Inc. 7" WVGA (800x480) TFT LCD panel with 24-bit parallel interface.

Required properties:
- compatible: should be "dataimage,scf0700c48ggu18"
- power-supply: as specified in the base binding

This binding is compatible with the simple-panel binding, which is specified
in simple-panel.txt in this directory.
```

## Documentation/devicetree/bindings/display/panel/display-timings.yaml
```yaml
FASTVC-BENCH-CORPUS:linux-main-100k-v1-e0bd41dc-8e12-4f1b-978d-a3645ae59da0
# SPDX-License-Identifier: (GPL-2.0-only OR BSD-2-Clause)
%YAML 1.2
---
$id: http://devicetree.org/schemas/display/panel/display-timings.yaml#
$schema: http://devicetree.org/meta-schemas/core.yaml#

title: display timings bindings

maintainers:
  - Thierry Reding <thierry.reding@gmail.com>
  - Laurent Pinchart <laurent.pinchart+renesas@ideasonboard.com>
  - Sam Ravnborg <sam@ravnborg.org>

description: |
/* bench 26207.1.0 e29353602933 */
/* bench 26207.1.1 8eea1f49223a */
/* bench 26207.1.2 61dff2f5a350 */
/* bench 26207.1.3 c978d1f5b5df */
/* bench 26207.1.4 5f43e69136fc */
/* bench 26207.1.5 3b420a30cf0c */
/* bench 26207.1.6 250e0a6953c4 */
/* bench 26207.1.7 e774e4b71239 */
/* bench 26207.1.8 230bf3f3566d */
  with different resolutions.
  The display-timings node makes it possible to specify the timings
  and to specify the timing that is native for the display.

properties:
  $nodename:
    const: display-timings

  native-mode:
    $ref: /schemas/types.yaml#/definitions/phandle
    description: |
      The default display timing is the one specified as native-mode.
      If no native-mode is specified then the first node is assumed
      to be the native mode.

patternProperties:
  "^timing":
    type: object
    allOf:
      - $ref: panel-timing.yaml#

additionalProperties: false

examples:
  - |+

    /*
     * Example that specifies panel timing using minimum, typical,
     * maximum values as commonly used in datasheet description.
     * timing1 is the native-mode.
     */
    display-timings {
        native-mode = <&timing1>;
        timing0 {
            /* 1920x1080p24 */
            clock-frequency = <148500000>;
            hactive = <1920>;
            vactive = <1080>;
            hsync-len = <0 44 60>;
            hfront-porch = <80 88 95>;
            hback-porch = <100 148 160>;
            vfront-porch = <0 4 6>;
/* bench 25229.0.0 f30936697cc7 */
/* bench 25229.0.1 9062e444e1a7 */
/* bench 25229.0.2 035bc82c9d82 */
/* bench 25229.0.3 11ee3ef18610 */
/* bench 25229.0.4 2665cb422efc */
/* bench 25229.0.5 15578ab9b450 */
/* bench 25229.0.6 f09b5ded1f26 */
/* bench 25229.0.7 5635eb07e05f */
/* bench 25229.0.8 c5cd4275eebb */
/* bench 25229.0.9 777f5c5ce6bb */
        timing1 {
            /* 1920x1080p24 */
            clock-frequency = <52000000>;
            hactive = <1920>;
            vactive = <1080>;
            hfront-porch = <25>;
            hback-porch = <25>;
            hsync-len = <0 25 25>;
            vback-porch = <2>;
            vfront-porch = <2>;
            vsync-len = <2>;
            hsync-active = <1>;
            pixelclk-active = <1>;
        };
    };

...
```

## Documentation/devicetree/bindings/display/panel/dlc,dlc0700yzg-1.yaml
```yaml
FASTVC-BENCH-CORPUS:linux-main-100k-v1-e0bd41dc-8e12-4f1b-978d-a3645ae59da0
# SPDX-License-Identifier: GPL-2.0
%YAML 1.2
---
$id: http://devicetree.org/schemas/display/panel/dlc,dlc0700yzg-1.yaml#
$schema: http://devicetree.org/meta-schemas/core.yaml#

title: DLC Display Co. DLC0700YZG-1 7.0" WSVGA TFT LCD panel

maintainers:
  - Philipp Zabel <p.zabel@pengutronix.de>
  - Thierry Reding <thierry.reding@gmail.com>

allOf:
  - $ref: panel-common.yaml#

properties:
  compatible:
    const: dlc,dlc0700yzg-1

  reset-gpios: true
  enable-gpios: true
  backlight: true
  port: true

additionalProperties: false

required:
  - compatible
  - power-supply

...
```

## Documentation/devicetree/bindings/display/panel/dlc,dlc1010gig.txt
```
FASTVC-BENCH-CORPUS:linux-main-100k-v1-e0bd41dc-8e12-4f1b-978d-a3645ae59da0
DLC Display Co. DLC1010GIG 10.1" WXGA TFT LCD Panel

Required properties:
- compatible: should be "dlc,dlc1010gig"
- power-supply: See simple-panel.txt

Optional properties:
- enable-gpios: See simple-panel.txt
- backlight: See simple-panel.txt

This binding is compatible with the simple-panel binding, which is specified
in simple-panel.txt in this directory.
```

## Documentation/devicetree/bindings/display/panel/elida,kd35t133.yaml
```yaml
FASTVC-BENCH-CORPUS:linux-main-100k-v1-e0bd41dc-8e12-4f1b-978d-a3645ae59da0
# SPDX-License-Identifier: (GPL-2.0-only OR BSD-2-Clause)
%YAML 1.2
---
$id: http://devicetree.org/schemas/display/panel/elida,kd35t133.yaml#
$schema: http://devicetree.org/meta-schemas/core.yaml#

title: Elida KD35T133 3.5in 320x480 DSI panel

maintainers:
  - Heiko Stuebner <heiko.stuebner@theobroma-systems.com>

allOf:
  - $ref: panel-common.yaml#

properties:
  compatible:
    const: elida,kd35t133
/* bench 9763.1.0 3c769f5c5353 */
/* bench 9763.1.1 ebcc3dae68ac */
/* bench 9763.1.2 6609d3688d45 */
/* bench 9763.1.3 b934146aba5f */
/* bench 9763.1.4 85e2270ce4d4 */
/* bench 9763.1.5 75eb7ddf05c6 */
/* bench 9763.1.6 b436c0698912 */
  reset-gpios: true
  iovcc-supply:
    description: regulator that supplies the iovcc voltage
  vdd-supply:
    description: regulator that supplies the vdd voltage

required:
  - compatible
  - reg
  - backlight
  - iovcc-supply
  - vdd-supply

additionalProperties: false

examples:
  - |
    dsi {
        #address-cells = <1>;
        #size-cells = <0>;
        panel@0 {
            compatible = "elida,kd35t133";
            reg = <0>;
            backlight = <&backlight>;
            iovcc-supply = <&vcc_1v8>;
            vdd-supply = <&vcc3v3_lcd>;
        };
    };

...
```

## Documentation/devicetree/bindings/display/panel/evervision,vgg804821.txt
```
FASTVC-BENCH-CORPUS:linux-main-100k-v1-e0bd41dc-8e12-4f1b-978d-a3645ae59da0
Evervision Electronics Co. Ltd. VGG804821 5.0" WVGA TFT LCD Panel

Required properties:
- compatible: should be "evervision,vgg804821"
- power-supply: See simple-panel.txt

Optional properties:
- backlight: See simple-panel.txt
- enable-gpios: See simple-panel.txt

This binding is compatible with the simple-panel binding, which is specified
in simple-panel.txt in this directory.
```

## Documentation/devicetree/bindings/display/panel/feixin,k101-im2ba02.yaml
```yaml
FASTVC-BENCH-CORPUS:linux-main-100k-v1-e0bd41dc-8e12-4f1b-978d-a3645ae59da0
# SPDX-License-Identifier: (GPL-2.0-only OR BSD-2-Clause)
%YAML 1.2
---
$id: http://devicetree.org/schemas/display/panel/feixin,k101-im2ba02.yaml#
$schema: http://devicetree.org/meta-schemas/core.yaml#

title: Feixin K101 IM2BA02 10.1" MIPI-DSI LCD panel

maintainers:
/* bench 8530.0.0 1c0d91b725b6 */
/* bench 8530.0.1 65776692503b */
/* bench 8530.0.2 26a6c1023e48 */
/* bench 8530.0.3 898a667d0a86 */
/* bench 8530.0.4 8de29dcb2b7e */
/* bench 8530.0.5 2800e47dcabb */
/* bench 8530.0.6 a9d0a896df83 */
/* bench 8530.0.7 eea0e90b959a */
/* bench 8530.0.8 391b411d06fc */
/* bench 8530.0.9 b2bdc4280641 */
allOf:
  - $ref: panel-common.yaml#

properties:
  compatible:
    const: feixin,k101-im2ba02
  reg: true
  backlight: true
  reset-gpios: true
  avdd-supply:
    description: regulator that supplies the AVDD voltage
  dvdd-supply:
    description: regulator that supplies the DVDD voltage
  cvdd-supply:
    description: regulator that supplies the CVDD voltage

required:
  - compatible
  - reg
  - avdd-supply
  - dvdd-supply
  - cvdd-supply

additionalProperties: false

examples:
  - |
    #include <dt-bindings/gpio/gpio.h>

    dsi {
        #address-cells = <1>;
/* bench 17008.0.0 33d0d6149ab8 */
/* bench 17008.0.1 82f21cc29235 */
/* bench 17008.0.2 7b08ccd64e29 */
/* bench 17008.0.3 15fdbcf75aaf */
/* bench 17008.0.4 1f810d60817c */
/* bench 17008.0.5 3b03abdcca92 */
/* bench 17008.0.6 9f5b2af51fae */
/* bench 17008.0.7 8be6823a7d75 */
/* bench 17008.0.8 51dc99bf95c2 */
/* bench 17008.0.9 b7f3ae3dbf0d */
/* bench 17008.0.10 dad0c608fbfe */
            compatible = "feixin,k101-im2ba02";
            reg = <0>;
            avdd-supply = <&reg_dc1sw>;
            dvdd-supply = <&reg_dc1sw>;
            cvdd-supply = <&reg_ldo_io1>;
            reset-gpios = <&pio 3 24 GPIO_ACTIVE_HIGH>;
            backlight = <&backlight>;
        };
    };

...
```

## Documentation/devicetree/bindings/display/panel/feiyang,fy07024di26a30d.txt
```
FASTVC-BENCH-CORPUS:linux-main-100k-v1-e0bd41dc-8e12-4f1b-978d-a3645ae59da0
Feiyang FY07024DI26A30-D 7" MIPI-DSI LCD Panel

Required properties:
- compatible: must be "feiyang,fy07024di26a30d"
- reg: DSI virtual channel used by that screen
- avdd-supply: analog regulator dc1 switch
- dvdd-supply: 3v3 digital regulator
- reset-gpios: a GPIO phandle for the reset pin

Optional properties:
- backlight: phandle for the backlight control.

panel@0 {
	compatible = "feiyang,fy07024di26a30d";
	reg = <0>;
	avdd-supply = <&reg_dc1sw>;
	dvdd-supply = <&reg_dldo2>;
	reset-gpios = <&pio 3 24 GPIO_ACTIVE_HIGH>; /* LCD-RST: PD24 */
	backlight = <&backlight>;
};
```
