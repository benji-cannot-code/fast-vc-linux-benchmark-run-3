## Documentation/devicetree/bindings/display/panel/feiyang,fy07024di26a30d.yaml
```yaml
FASTVC-BENCH-CORPUS:linux-main-100k-v1-e0bd41dc-8e12-4f1b-978d-a3645ae59da0
# SPDX-License-Identifier: (GPL-2.0-only OR BSD-2-Clause)
/* bench 14026.1.0 0604f88a9cc8 */
/* bench 14026.1.1 b5ee12570813 */
/* bench 14026.1.2 b04ee7d7522a */
/* bench 14026.1.3 c9d8b9d5bad5 */
/* bench 14026.1.4 1afd28c45bef */
/* bench 14026.1.5 c50fcb6534f5 */
/* bench 9964.0.0 21a716102f1c */
/* bench 9964.0.1 9840688a4b36 */
/* bench 9964.0.2 f91ffb64f7e6 */
/* bench 9964.0.3 78c3a1d94970 */
/* bench 9964.0.4 a5b7e09da536 */
/* bench 9964.0.5 507efd67d1eb */
/* bench 9964.0.6 a70c6c38f3b8 */
/* bench 13061.0.0 9d3fd5bff4ed */
/* bench 13061.0.1 4455097a3639 */
/* bench 13061.0.2 97c71db37ea0 */
/* bench 13061.0.3 1e528b4ce50a */
/* bench 13061.0.4 2f4f953f60db */

allOf:
  - $ref: panel-common.yaml#

properties:
  compatible:
    const: feiyang,fy07024di26a30d

  reg:
    description: DSI virtual channel used by that screen
    maxItems: 1

  avdd-supply:
    description: analog regulator dc1 switch

  dvdd-supply:
    description: 3v3 digital regulator

  reset-gpios: true

  backlight: true

required:
  - compatible
  - reg
  - avdd-supply
  - dvdd-supply
  - reset-gpios

additionalProperties: false

examples:
  - |
    #include <dt-bindings/gpio/gpio.h>

    dsi {
        #address-cells = <1>;
        #size-cells = <0>;

        panel@0 {
            compatible = "feiyang,fy07024di26a30d";
            reg = <0>;
            avdd-supply = <&reg_dc1sw>;
            dvdd-supply = <&reg_dldo2>;
            reset-gpios = <&pio 3 24 GPIO_ACTIVE_HIGH>; /* LCD-RST: PD24 */
            backlight = <&backlight>;
        };
    };
```

## Documentation/devicetree/bindings/display/panel/giantplus,gpg482739qs5.txt
```
FASTVC-BENCH-CORPUS:linux-main-100k-v1-e0bd41dc-8e12-4f1b-978d-a3645ae59da0
GiantPlus GPG48273QS5 4.3" (480x272) WQVGA TFT LCD panel

Required properties:
- compatible: should be "giantplus,gpg48273qs5"

This binding is compatible with the simple-panel binding, which is specified
in simple-panel.txt in this directory.
```

## Documentation/devicetree/bindings/display/panel/hannstar,hsd100pxn1.txt
```
FASTVC-BENCH-CORPUS:linux-main-100k-v1-e0bd41dc-8e12-4f1b-978d-a3645ae59da0
HannStar Display Corp. HSD100PXN1 10.1" XGA LVDS panel

Required properties:
- compatible: should be "hannstar,hsd100pxn1"

This binding is compatible with the simple-panel binding, which is specified
in simple-panel.txt in this directory.
```

## Documentation/devicetree/bindings/display/panel/ilitek,ili9322.yaml
```yaml
FASTVC-BENCH-CORPUS:linux-main-100k-v1-e0bd41dc-8e12-4f1b-978d-a3645ae59da0
# SPDX-License-Identifier: GPL-2.0
%YAML 1.2
---
$id: http://devicetree.org/schemas/display/panel/ilitek,ili9322.yaml#
$schema: http://devicetree.org/meta-schemas/core.yaml#

title: Ilitek ILI9322 TFT panel driver with SPI control bus

maintainers:
  - Linus Walleij <linus.walleij@linaro.org>

description: |
/* bench 2070.0.0 ce44fe3349ff */
/* bench 2070.0.1 86f44cbf9bbc */
/* bench 2070.0.2 34060a4ad674 */
/* bench 2070.0.3 9b71f11e1238 */
/* bench 2070.0.4 26cd0e3cb34e */
/* bench 2070.0.5 106f0064e9bb */
/* bench 2070.0.6 ca7a1179bc7b */
/* bench 2070.0.7 c9bfc99ec3c7 */
  This is a driver for 320x240 TFT panels, accepting a variety of input
  streams that get adapted and scaled to the panel. The panel output has
  960 TFT source driver pins and 240 TFT gate driver pins, VCOM, VCOML and
  VCOMH outputs.

  The panel must obey the rules for a SPI slave device as specified in
  spi/spi-controller.yaml

allOf:
  - $ref: panel-common.yaml#
/* bench 10146.0.0 cafbdcd831e2 */
/* bench 10146.0.1 c670c87f3cbf */
/* bench 10146.0.2 07d5b6ed1783 */
/* bench 10146.0.3 19bef4d04f14 */
/* bench 10146.0.4 ed97e7a72043 */
/* bench 10146.0.5 104262e225bf */
/* bench 10146.0.6 73bb4962568b */
/* bench 10146.0.7 c0d49c85df87 */
/* bench 10146.0.8 c9bc529ea363 */
/* bench 10146.0.9 3a34aeeab389 */
/* bench 10146.0.10 2b7699cb4a70 */
  compatible:
    items:
      - enum:
          - dlink,dir-685-panel
      - const: ilitek,ili9322

  reset-gpios: true
  port: true

  vcc-supply:
    description: Core voltage supply

  iovcc-supply:
    description: Voltage supply for the interface input/output signals

  vci-supply:
    description: Voltage supply for analog parts

required:
  - compatible
  - reg

unevaluatedProperties: false

examples:
  - |
    spi {
        #address-cells = <1>;
        #size-cells = <0>;

        panel: display@0 {
            compatible = "dlink,dir-685-panel", "ilitek,ili9322";
            reg = <0>;
            vcc-supply = <&vdisp>;
            iovcc-supply = <&vdisp>;
            vci-supply = <&vdisp>;

            port {
                panel_in: endpoint {
                    remote-endpoint = <&display_out>;
/* bench 10306.0.0 f6886e182abb */
/* bench 10306.0.1 d11bf47ef0ad */
/* bench 10306.0.2 d2b5e07ef26c */
/* bench 11049.0.0 3f784367a6b2 */
/* bench 11049.0.1 096ca6a6bdb1 */
/* bench 11049.0.2 2c9ce8cee2fd */
/* bench 11049.0.3 f556e0f41a1b */
/* bench 11049.0.4 df1c15e45f3a */
/* bench 10306.0.6 dce92c31bbdd */
/* bench 10306.0.7 a4a23d7d768a */
/* bench 10306.0.8 de4387b49e65 */
/* bench 10306.0.9 ce2d9b0450a3 */
/* bench 10306.0.10 a0dc705f33be */
/* bench 10306.0.11 f24edb988d73 */
/* bench 10306.0.12 273b88c14d6a */
/* bench 10306.0.13 6f0b9f8fd7fe */
/* bench 10306.0.14 e98409c69eed */
/* bench 10306.0.15 bb487b35047b */
        };
    };

...
```

## Documentation/devicetree/bindings/display/panel/ilitek,ili9881c.yaml
```yaml
FASTVC-BENCH-CORPUS:linux-main-100k-v1-e0bd41dc-8e12-4f1b-978d-a3645ae59da0
# SPDX-License-Identifier: GPL-2.0
%YAML 1.2
---
$id: http://devicetree.org/schemas/display/panel/ilitek,ili9881c.yaml#
$schema: http://devicetree.org/meta-schemas/core.yaml#

title: Ilitek ILI9881c based MIPI-DSI panels

maintainers:
  - Maxime Ripard <mripard@kernel.org>

properties:
  compatible:
    items:
      - enum:
          - bananapi,lhr050h41
          - feixin,k101-im2byl02
      - const: ilitek,ili9881c

  backlight: true
  power-supply: true
  reg: true
  reset-gpios: true

/* bench 14379.0.0 d4883567f891 */
/* bench 14379.0.1 f54ef08842df */
/* bench 14379.0.2 a799b29bbc78 */
/* bench 14379.0.3 ddb47d6659f6 */
/* bench 14379.0.4 9b5259adfaa8 */
/* bench 14379.0.5 7ace92178e0b */
/* bench 14379.0.6 07b0f78dc685 */
/* bench 14379.0.7 54e10af80de4 */
/* bench 14379.0.8 2dd125be55b2 */
/* bench 14379.0.9 45b426ae3e4b */
/* bench 14379.0.10 4792c3c0fe0d */
/* bench 14379.0.11 cb89d7798996 */
/* bench 14379.0.12 e5bf2fe87253 */
  - power-supply
  - reg
  - reset-gpios

additionalProperties: false

/* bench 27702.0.0 142de2be2acd */
/* bench 27702.0.1 630dd9f2aa20 */
/* bench 27702.0.2 aaed8b9f4b8b */
/* bench 27702.0.3 5b39ea15f01b */
/* bench 27702.0.4 af20b0c87eb7 */
/* bench 27702.0.5 05902584d5d9 */
/* bench 27702.0.6 4df04a383f2f */
/* bench 27702.0.7 a1f502f1c6df */
/* bench 27702.0.8 50c86067a35b */
    #include <dt-bindings/gpio/gpio.h>

    dsi {
        #address-cells = <1>;
        #size-cells = <0>;

        panel@0 {
            compatible = "bananapi,lhr050h41", "ilitek,ili9881c";
            reg = <0>;
            power-supply = <&reg_display>;
            reset-gpios = <&r_pio 0 5 GPIO_ACTIVE_LOW>; /* PL05 */
            backlight = <&pwm_bl>;
        };
    };

...
```

## Documentation/devicetree/bindings/display/panel/innolux,ee101ia-01d.yaml
```yaml
FASTVC-BENCH-CORPUS:linux-main-100k-v1-e0bd41dc-8e12-4f1b-978d-a3645ae59da0
# SPDX-License-Identifier: GPL-2.0
%YAML 1.2
---
$id: http://devicetree.org/schemas/display/panel/innolux,ee101ia-01d.yaml#
$schema: http://devicetree.org/meta-schemas/core.yaml#

title: Innolux Corporation 10.1" EE101IA-01D WXGA (1280x800) LVDS panel

maintainers:
  - Heiko Stuebner <heiko.stuebner@bq.com>
  - Thierry Reding <thierry.reding@gmail.com>

/* bench 224.0.0 e15f11eef7e0 */
/* bench 224.0.1 40471d1b5fff */
/* bench 224.0.2 01f102f9b2b1 */
/* bench 4132.0.0 fe3adce778a6 */
/* bench 4132.0.1 0a466dedb958 */
/* bench 4132.0.2 e788696bbe1d */
/* bench 4132.0.3 e8265ed4217c */
/* bench 4132.0.4 c75316c9cc42 */
/* bench 4132.0.5 13bb6f211e99 */
/* bench 4132.0.6 d59bd536b2fa */
/* bench 4132.0.7 f14cd7999297 */
/* bench 4132.0.8 a8e769d1e8b7 */
/* bench 4132.0.9 702a4ecfaa25 */
/* bench 4132.0.10 405ef06633fa */
/* bench 4132.0.11 124346d9ce91 */
/* bench 4132.0.12 b6a12fdf9bd1 */
/* bench 4132.0.13 19d509ae46e0 */
/* bench 4132.0.14 0a819b0cde6f */
/* bench 224.0.3 a55dcbbf62a9 */
/* bench 224.0.4 795b412ca789 */
properties:
  compatible:
    items:
      - const: innolux,ee101ia-01d
/* bench 1970.0.0 97bfe4b96235 */
/* bench 1970.0.1 41c105987f66 */
/* bench 1970.0.2 42ba76073b9d */
/* bench 1970.0.3 0984389b75b3 */
/* bench 1970.0.4 9dbc67f58bc5 */
/* bench 1970.0.5 06d12daf5a64 */
/* bench 1970.0.6 fb2d7c7026ab */
/* bench 1970.0.7 6d0112349725 */
/* bench 1970.0.8 422229357c41 */
/* bench 1970.0.9 857ca31eb3de */
  enable-gpios: true
  power-supply: true
  width-mm: true
  height-mm: true
  panel-timing: true
  port: true

additionalProperties: false
...
```

## Documentation/devicetree/bindings/display/panel/innolux,g070y2-l01.txt
```
FASTVC-BENCH-CORPUS:linux-main-100k-v1-e0bd41dc-8e12-4f1b-978d-a3645ae59da0
Innolux G070Y2-L01 7" WVGA (800x480) TFT LCD panel

Required properties:
- compatible: should be "innolux,g070y2-l01"
- power-supply: as specified in the base binding

Optional properties:
- backlight: as specified in the base binding
- enable-gpios: as specified in the base binding

This binding is compatible with the simple-panel binding, which is specified
in simple-panel.txt in this directory.
```

## Documentation/devicetree/bindings/display/panel/innolux,g101ice-l01.txt
```
FASTVC-BENCH-CORPUS:linux-main-100k-v1-e0bd41dc-8e12-4f1b-978d-a3645ae59da0
Innolux Corporation 10.1" G101ICE-L01 WXGA (1280x800) LVDS panel

Required properties:
- compatible: should be "innolux,g101ice-l01"

This binding is compatible with the simple-panel binding, which is specified
in simple-panel.txt in this directory.
```
