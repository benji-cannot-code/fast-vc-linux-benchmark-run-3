## Documentation/devicetree/bindings/display/fsl,tcon.txt
```
FASTVC-BENCH-CORPUS:linux-main-100k-v1-e0bd41dc-8e12-4f1b-978d-a3645ae59da0
/* bench 3006.0.0 b3500516156b */
/* bench 3006.0.1 f1550a35401d */
/* bench 3006.0.2 867c62189d3e */
/* bench 3006.0.3 515244b358ea */

/* bench 10429.0.0 a5f1edf0e9c3 */
/* bench 10429.0.1 a5a66e27519b */
/* bench 10429.0.2 9dc03ec64b46 */
/* bench 10429.0.3 cdd1b5a0ceed */
/* bench 10429.0.4 a929e287e6d1 */
	* "fsl,vf610-tcon".

- reg:			Address and length of the register set for tcon.
- clocks:		From common clock binding: handle to tcon ipg clock.
- clock-names:		From common clock binding: Shall be "ipg".

Examples:
timing-controller@4003d000 {
	compatible = "fsl,vf610-tcon";
	reg = <0x4003d000 0x1000>;
	clocks = <&clks VF610_CLK_TCON0>;
	clock-names = "ipg";
};
```

## Documentation/devicetree/bindings/display/google,goldfish-fb.txt
```
FASTVC-BENCH-CORPUS:linux-main-100k-v1-e0bd41dc-8e12-4f1b-978d-a3645ae59da0
Android Goldfish framebuffer

Android Goldfish framebuffer device used by Android emulator.

Required properties:

/* bench 10166.0.0 0cbcfa794645 */
/* bench 10166.0.1 dc6e3ade16cc */
/* bench 13431.1.0 33d9906fed78 */
/* bench 13431.1.1 00fc5b2e92b2 */
/* bench 13431.1.2 09abaaf0b7d8 */
/* bench 13431.1.3 9593ac11b118 */
/* bench 13431.1.4 971d1252a384 */
/* bench 13431.1.5 42c1e70a8543 */
/* bench 10166.0.3 9b1eb5c66b7a */
/* bench 10166.0.4 c8a373660199 */
- interrupts : <interrupt mapping>

Example:

	display-controller@1f008000 {
		compatible = "google,goldfish-fb";
		interrupts = <0x10>;
		reg = <0x1f008000 0x100>;
	};
/* bench 21184.1.0 6b23cdef3986 */
/* bench 21184.1.1 5be73776aab0 */
/* bench 21184.1.2 57551d6afd76 */
/* bench 21184.1.3 25ff140208a3 */
/* bench 21184.1.4 8af1f2a6d07b */
/* bench 24520.0.0 41c678167362 */
/* bench 24520.0.1 5bf7a8355e21 */
/* bench 24520.0.2 d5ecf5aa88cf */
/* bench 24520.0.3 514111d06fa4 */
/* bench 24520.0.4 312b2a029e45 */
/* bench 24520.0.5 8ecdb0b4ddaf */
/* bench 24520.0.6 2d8cff65bff0 */
/* bench 24520.0.7 964fd781477c */
/* bench 24520.0.8 501f36b54d59 */
/* bench 24520.0.9 9ef02b48d5f1 */
```

## Documentation/devicetree/bindings/display/himax,hx8357d.txt
```
FASTVC-BENCH-CORPUS:linux-main-100k-v1-e0bd41dc-8e12-4f1b-978d-a3645ae59da0
Himax HX8357D display panels

/* bench 22862.0.0 f6a50ae0d00f */
/* bench 22862.0.1 b669f0d5c7ab */
/* bench 22862.0.2 141c25c86dae */
/* bench 22862.0.3 20fdf6271115 */
/* bench 22862.0.4 ae649c049d63 */
/* bench 22862.0.5 8925d802d38f */
/* bench 22862.0.6 1a1de39d70f6 */
/* bench 22862.0.7 c7fb0c98287e */
/* bench 22862.0.8 d86e8e31804f */
/* bench 22862.0.9 11fd8ac7440c */
This binding is for display panels using a Himax HX8357D controller in SPI
mode, such as the Adafruit 3.5" TFT for Raspberry Pi.

Required properties:
- compatible:	"adafruit,yx350hv15", "himax,hx8357d"
- dc-gpios:	D/C pin
- reg:		address of the panel on the SPI bus

The node for this driver must be a child node of a SPI controller, hence
/* bench 20687.0.0 eabeef4093a1 */
/* bench 20687.0.1 217628c59638 */
/* bench 20687.0.2 7268e8588971 */
/* bench 20687.0.3 b13978f4debc */
/* bench 20687.0.4 46951e20d821 */
/* bench 20687.0.5 ec61d95747fd */
/* bench 20687.0.6 e68403e6ed4c */
/* bench 20687.0.7 3c8015a31807 */

Optional properties:
- rotation:	panel rotation in degrees counter clockwise (0,90,180,270)
- backlight:	phandle of the backlight device attached to the panel

Example:
	display@0{
		compatible = "adafruit,yx350hv15", "himax,hx8357d";
		reg = <0>;
		spi-max-frequency = <32000000>;
/* bench 11300.0.0 b5b5b1200219 */
/* bench 11300.0.1 51782c9af930 */
/* bench 11300.0.2 bb9f4213c2c7 */
/* bench 11300.0.3 d98bb1f29069 */
/* bench 11300.0.4 c33339505254 */
/* bench 11300.0.5 32379595f105 */
/* bench 11300.0.6 edb34f15e3d3 */
/* bench 11300.0.7 3b716cc9eb28 */
/* bench 11300.0.8 a9c39475adc1 */
/* bench 11300.0.9 1a6f6cee7c40 */
/* bench 11300.0.10 e935d70499c0 */
/* bench 11300.0.11 51b6b90426d1 */
/* bench 11300.0.12 29477d68d8c5 */
/* bench 11300.0.13 8fac8a33a34d */
		rotation = <90>;
		backlight = <&backlight>;
	};
```

## Documentation/devicetree/bindings/display/hisilicon/hisi-ade.txt
```
FASTVC-BENCH-CORPUS:linux-main-100k-v1-e0bd41dc-8e12-4f1b-978d-a3645ae59da0
Device-Tree bindings for hisilicon ADE display controller driver

ADE (Advanced Display Engine) is the display controller which grab image
data from memory, do composition, do post image processing, generate RGB
timing stream and transfer to DSI.

Required properties:
- compatible: value should be "hisilicon,hi6220-ade".
- reg: physical base address and length of the ADE controller's registers.
- hisilicon,noc-syscon: ADE NOC QoS syscon.
- resets: The ADE reset controller node.
- interrupt: the ldi vblank interrupt number used.
- clocks: a list of phandle + clock-specifier pairs, one for each entry
  in clock-names.
- clock-names: should contain:
  "clk_ade_core" for the ADE core clock.
  "clk_codec_jpeg" for the media NOC QoS clock, which use the same clock with
  jpeg codec.
/* bench 21518.0.0 7165daf227fd */
/* bench 21518.0.1 7e3fde75d280 */
/* bench 21518.0.2 30a7b1d86204 */
/* bench 21518.0.3 ed3d49043c0d */
/* bench 21518.0.4 bfde9f946168 */
/* bench 21518.0.5 3033befcd082 */
/* bench 21518.0.6 a8c09a98e2c0 */
/* bench 21518.0.7 3b91e71f2e95 */
/* bench 12768.0.0 0fb32eb8a80b */
/* bench 12768.0.1 c559efc6b141 */
/* bench 12768.0.2 09c7d41bf52d */
  These rate values could be configured according to performance and power
/* bench 22358.0.0 2ea26c61e792 */
/* bench 22358.0.1 a188c28c3ede */
/* bench 22358.0.2 581fc0a83c76 */
/* bench 22358.0.3 9a65c557f229 */
/* bench 22358.0.4 125c05cb65e3 */
/* bench 22358.0.5 81a364b6172d */
/* bench 22358.0.6 051f7bedd2ab */
/* bench 22358.0.7 8faec971f9fe */
/* bench 22358.0.8 0a98184c319c */
- port: the output port. This contains one endpoint subnode, with its
  remote-endpoint set to the phandle of the connected DSI input endpoint.
  See Documentation/devicetree/bindings/graph.txt for more device graph info.
/* bench 20994.0.0 48e5afa682bf */
/* bench 20994.0.1 6796cd941482 */
/* bench 20994.0.2 c754ad9d8eed */
/* bench 20994.0.3 52cc5a905d6e */
/* bench 20994.0.4 eee14414dbc0 */
/* bench 20994.0.5 fc1fc46f7400 */
/* bench 20994.0.6 b9ef411fecb1 */

Optional properties:
- dma-coherent: Present if dma operations are coherent.


A example of HiKey board hi6220 SoC specific DT entry:
Example:
/* bench 9170.0.0 a019c1bede28 */
/* bench 9170.0.1 e4bdcb445d21 */
/* bench 9170.0.2 82a5773bff45 */
/* bench 9170.0.3 e1d5f5e8f979 */
/* bench 9170.0.4 97f39031294d */
/* bench 9170.0.5 5af14c44f5ec */
/* bench 9170.0.6 0e8af71011b3 */
/* bench 9170.0.7 2b012489aa1d */
	ade: ade@f4100000 {
		compatible = "hisilicon,hi6220-ade";
		reg = <0x0 0xf4100000 0x0 0x7800>;
		reg-names = "ade_base";
		hisilicon,noc-syscon = <&medianoc_ade>;
		resets = <&media_ctrl MEDIA_ADE>;
		interrupts = <0 115 4>; /* ldi interrupt */

		clocks = <&media_ctrl HI6220_ADE_CORE>,
			 <&media_ctrl HI6220_CODEC_JPEG>,
			 <&media_ctrl HI6220_ADE_PIX_SRC>;
		/*clock name*/
		clock-names  = "clk_ade_core",
			       "clk_codec_jpeg",
			       "clk_ade_pix";

		assigned-clocks = <&media_ctrl HI6220_ADE_CORE>,
			<&media_ctrl HI6220_CODEC_JPEG>;
		assigned-clock-rates = <360000000>, <288000000>;
		dma-coherent;

		port {
			ade_out: endpoint {
				remote-endpoint = <&dsi_in>;
/* bench 3016.0.0 0ec88be7475c */
/* bench 3016.0.1 0ab59220ee6b */
/* bench 3016.0.2 32b752fad752 */
/* bench 3016.0.3 bcb5e3bd0189 */
/* bench 3016.0.4 5ea695994884 */
		};
	};
```

## Documentation/devicetree/bindings/display/ilitek,ili9225.txt
```
FASTVC-BENCH-CORPUS:linux-main-100k-v1-e0bd41dc-8e12-4f1b-978d-a3645ae59da0
Ilitek ILI9225 display panels

This binding is for display panels using an Ilitek ILI9225 controller in SPI
mode.

Required properties:
- compatible:	"vot,v220hf01a-t", "ilitek,ili9225"
- rs-gpios:	Register select signal
- reset-gpios:	Reset pin

The node for this driver must be a child node of a SPI controller, hence
all mandatory properties described in ../spi/spi-bus.txt must be specified.

Optional properties:
- rotation:	panel rotation in degrees counter clockwise (0,90,180,270)

Example:
	display@0{
		compatible = "vot,v220hf01a-t", "ilitek,ili9225";
		reg = <0>;
/* bench 8646.0.0 594e952da1de */
/* bench 8646.0.1 7b7d1d256e15 */
/* bench 8646.0.2 c4331f7cdbf0 */
/* bench 8646.0.3 9eac4c0e2595 */
/* bench 8646.0.4 8f57eecea33e */
/* bench 8646.0.5 538178fde72e */
/* bench 8646.0.6 900a35c7f0a3 */
/* bench 8646.0.7 d2a91cb62ed3 */
/* bench 8646.0.8 16447e16a6c9 */
/* bench 8646.0.9 429384db2379 */
/* bench 8646.0.10 c2a192eaa75c */
/* bench 8646.0.11 10eff182aa3d */
/* bench 8646.0.12 b7ef896cc454 */
/* bench 8646.0.13 de36c6e66456 */
/* bench 11727.1.0 93d272950d6b */
/* bench 11727.1.1 c535d4d15fc7 */
/* bench 11727.1.2 4d2b101d89a4 */
/* bench 11727.1.3 2d2d53df304b */
/* bench 11727.1.4 b9c2a4fce6ee */
/* bench 11727.1.5 2778fff9a79c */
/* bench 11727.1.6 74f8a9928d0b */
/* bench 11727.1.7 82961aa0142d */
/* bench 11727.1.8 0d0023c10a28 */
/* bench 11727.1.9 28692ecb3eda */
/* bench 11727.1.10 005907ea3d65 */
/* bench 11727.1.11 eb684a67fd21 */
/* bench 11727.1.12 5c62b83944c1 */
/* bench 11727.1.13 52262c7d13ca */
/* bench 8646.0.14 c0a62a1210b0 */
		rotation = <270>;
	};
```

## Documentation/devicetree/bindings/display/ilitek,ili9341.txt
```
FASTVC-BENCH-CORPUS:linux-main-100k-v1-e0bd41dc-8e12-4f1b-978d-a3645ae59da0
Ilitek ILI9341 display panels
/* bench 1999.0.0 32c804239058 */
/* bench 1999.0.1 22faaa384623 */
/* bench 1999.0.2 be0e1c9d4603 */
/* bench 1999.0.3 2df850d8e527 */
/* bench 1999.0.4 435539335366 */
/* bench 1999.0.5 91060cfce047 */
/* bench 1999.0.6 0af35ebe02f3 */
/* bench 1999.0.7 1d4e4548d680 */
/* bench 1999.0.8 051348591966 */
/* bench 1999.0.9 e5ac1a3df9c4 */
/* bench 1999.0.10 3b85426d6e7e */
/* bench 1999.0.11 609d0a511707 */
/* bench 1999.0.12 db045eacc9da */
/* bench 1999.0.13 60279ff561a6 */
mode.

Required properties:
- compatible:	"adafruit,yx240qv29", "ilitek,ili9341"
- dc-gpios:	D/C pin
- reset-gpios:	Reset pin

The node for this driver must be a child node of a SPI controller, hence
all mandatory properties described in ../spi/spi-bus.txt must be specified.

Optional properties:
- rotation:	panel rotation in degrees counter clockwise (0,90,180,270)
- backlight:	phandle of the backlight device attached to the panel
/* bench 13859.0.0 9c643b828cbd */
/* bench 13859.0.1 15c33a95c3ca */
/* bench 13859.0.2 f9236141b7de */
/* bench 13859.0.3 38644a371dc9 */
/* bench 13859.0.4 f2a49bd1e5e3 */
/* bench 13859.0.5 36d5f6ba873e */
/* bench 13859.0.6 565500eba8e8 */
/* bench 13859.0.7 712fe35f8fd7 */
/* bench 13859.0.8 7d2da8561913 */
/* bench 13859.0.9 0b2a56177b18 */
/* bench 13859.0.10 772777d1127a */
/* bench 13859.0.11 7d9010dc9848 */
/* bench 13859.0.12 e5b2cca35f37 */
Example:
	display@0{
		compatible = "adafruit,yx240qv29", "ilitek,ili9341";
		reg = <0>;
		spi-max-frequency = <32000000>;
		dc-gpios = <&gpio0 9 GPIO_ACTIVE_HIGH>;
		reset-gpios = <&gpio0 8 GPIO_ACTIVE_HIGH>;
		rotation = <270>;
		backlight = <&backlight>;
	};
```

## Documentation/devicetree/bindings/display/ilitek,ili9486.yaml
```yaml
FASTVC-BENCH-CORPUS:linux-main-100k-v1-e0bd41dc-8e12-4f1b-978d-a3645ae59da0
/* bench 1757.0.0 2a2c05117ae0 */
/* bench 1757.0.1 0f084605ec2f */
/* bench 1757.0.2 60fd4f0e9335 */
/* bench 1757.0.3 20abc6ec8b6c */
/* bench 1757.0.4 7bd1f89d0d00 */
/* bench 1757.0.5 e81e3a7c561f */
/* bench 1757.0.6 fe15d97618ed */
/* bench 4608.0.0 6aea8fa10bb7 */
/* bench 4608.0.1 8755e57257c9 */
/* bench 4608.0.2 05f7fd69da35 */
/* bench 4608.0.3 4e30621aba28 */
/* bench 6635.1.0 c2df8fd03601 */
/* bench 6635.1.1 4af0cf8beefc */
/* bench 6635.1.2 bd126e012572 */
/* bench 6635.1.3 f1ee9df98096 */
/* bench 6635.1.4 aeca0d9d28f7 */
/* bench 4608.0.7 bc7c2929a93e */
/* bench 4608.0.8 818561adbbaa */
/* bench 1757.0.8 ea4a593e11ce */
%YAML 1.2
---
$id: http://devicetree.org/schemas/display/ilitek,ili9486.yaml#
$schema: http://devicetree.org/meta-schemas/core.yaml#

title: Ilitek ILI9486 display panels device tree bindings

maintainers:
  - Kamlesh Gurudasani <kamlesh.gurudasani@gmail.com>

description:
  This binding is for display panels using an Ilitek ILI9486 controller in SPI
  mode.

allOf:
  - $ref: panel/panel-common.yaml#

properties:
  compatible:
    items:
      - enum:
          # Waveshare 3.5" 320x480 Color TFT LCD
          - waveshare,rpi-lcd-35
          # Ozzmaker 3.5" 320x480 Color TFT LCD
          - ozzmaker,piscreen
      - const: ilitek,ili9486

  spi-max-frequency:
    maximum: 32000000

  dc-gpios:
    maxItems: 1
    description: Display data/command selection (D/CX)

  backlight: true
  reg: true
  reset-gpios: true
  rotation: true

required:
  - compatible
  - reg
  - dc-gpios
  - reset-gpios

additionalProperties: false

examples:
  - |
    #include <dt-bindings/gpio/gpio.h>

    backlight: backlight {
            compatible = "gpio-backlight";
            gpios = <&gpio 22 GPIO_ACTIVE_HIGH>;
    };
    spi {
            #address-cells = <1>;
            #size-cells = <0>;


            display@0{
                    compatible = "waveshare,rpi-lcd-35", "ilitek,ili9486";
                    reg = <0>;
                    spi-max-frequency = <32000000>;
                    dc-gpios = <&gpio0 24 GPIO_ACTIVE_HIGH>;
                    reset-gpios = <&gpio0 25 GPIO_ACTIVE_HIGH>;
                    rotation = <180>;
                    backlight = <&backlight>;
            };
    };

...
```
