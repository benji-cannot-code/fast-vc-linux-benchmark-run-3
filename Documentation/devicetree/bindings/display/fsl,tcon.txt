## Documentation/devicetree/bindings/display/imx/hdmi.txt
```
FASTVC-BENCH-CORPUS:linux-main-100k-v1-e0bd41dc-8e12-4f1b-978d-a3645ae59da0
Freescale i.MX6 DWC HDMI TX Encoder
===================================

The HDMI transmitter is a Synopsys DesignWare HDMI 1.4 TX controller IP
with a companion PHY IP.

These DT bindings follow the Synopsys DWC HDMI TX bindings defined in
Documentation/devicetree/bindings/display/bridge/dw_hdmi.txt with the
following device-specific properties.


Required properties:

- compatible : Shall be one of "fsl,imx6q-hdmi" or "fsl,imx6dl-hdmi".
- reg: See dw_hdmi.txt.
- interrupts: HDMI interrupt number
- clocks: See dw_hdmi.txt.
- clock-names: Shall contain "iahb" and "isfr" as defined in dw_hdmi.txt.
- ports: See dw_hdmi.txt. The DWC HDMI shall have between one and four ports,
  numbered 0 to 3, corresponding to the four inputs of the HDMI multiplexer.
  Each port shall have a single endpoint.
- gpr : Shall contain a phandle to the iomuxc-gpr region containing the HDMI
  multiplexer control register.
/* bench 16617.0.0 2842ec4eee03 */
/* bench 16617.0.1 5f12a360b8bf */
/* bench 16617.0.2 e32ab6ebaca9 */
Optional properties

- ddc-i2c-bus: The HDMI DDC bus can be connected to either a system I2C master
  or the functionally-reduced I2C master contained in the DWC HDMI. When
  connected to a system I2C master this property contains a phandle to that
  I2C master controller.


Example:

	gpr: iomuxc-gpr@20e0000 {
		/* ... */
	};

        hdmi: hdmi@120000 {
                #address-cells = <1>;
                #size-cells = <0>;
                compatible = "fsl,imx6q-hdmi";
                reg = <0x00120000 0x9000>;
                interrupts = <0 115 0x04>;
                gpr = <&gpr>;
                clocks = <&clks 123>, <&clks 124>;
                clock-names = "iahb", "isfr";
                ddc-i2c-bus = <&i2c2>;
/* bench 3514.0.0 ef821e7d7366 */
/* bench 3514.0.1 921c8da3bc16 */
/* bench 3514.0.2 3c921bcb97e8 */
/* bench 3514.0.3 32e77699f0d1 */
/* bench 3514.0.4 4ebe22ee20bb */
/* bench 3514.0.5 1913f5502976 */
/* bench 3514.0.6 7851a989002b */
/* bench 3514.0.7 5c9978b6303b */
/* bench 3514.0.8 9803562df6d9 */
/* bench 3514.0.9 0be97e688d1b */
/* bench 3514.0.10 eec6f53696f4 */

                        hdmi_mux_0: endpoint {
                                remote-endpoint = <&ipu1_di0_hdmi>;
                        };
                };

                port@1 {
                        reg = <1>;

                        hdmi_mux_1: endpoint {
                                remote-endpoint = <&ipu1_di1_hdmi>;
/* bench 29438.0.0 dd1cbe91ea8d */
/* bench 29438.0.1 085af0aff2f5 */
/* bench 29438.0.2 2e903aa36293 */
/* bench 29438.0.3 a0af4891be6a */
/* bench 29438.0.4 cc4fbbce906d */
/* bench 29438.0.5 b98d055908a9 */
/* bench 29438.0.6 a896e4b1c676 */
/* bench 29438.0.7 60b336793106 */
/* bench 29438.0.8 cf1f3d3d912c */
/* bench 29438.0.9 8f76a5afc441 */
/* bench 29438.0.10 8eb6ed038d5d */
                };
        };
```

## Documentation/devicetree/bindings/display/imx/nxp,imx8mq-dcss.yaml
```yaml
FASTVC-BENCH-CORPUS:linux-main-100k-v1-e0bd41dc-8e12-4f1b-978d-a3645ae59da0
# SPDX-License-Identifier: (GPL-2.0 OR BSD-2-Clause)
# Copyright 2019 NXP
%YAML 1.2
---
$id: "http://devicetree.org/schemas/display/imx/nxp,imx8mq-dcss.yaml#"
$schema: "http://devicetree.org/meta-schemas/core.yaml#"

title: iMX8MQ Display Controller Subsystem (DCSS)

maintainers:
  - Laurentiu Palcu <laurentiu.palcu@nxp.com>

description:

  The DCSS (display controller sub system) is used to source up to three
  display buffers, compose them, and drive a display using HDMI 2.0a(with HDCP
  2.2) or MIPI-DSI. The DCSS is intended to support up to 4kp60 displays. HDR10
  image processing capabilities are included to provide a solution capable of
  driving next generation high dynamic range displays.

properties:
  compatible:
    const: nxp,imx8mq-dcss

  reg:
    items:
      - description: DCSS base address and size, up to IRQ steer start
      - description: DCSS BLKCTL base address and size

  interrupts:
    items:
      - description: Context loader completion and error interrupt
      - description: DTG interrupt used to signal context loader trigger time
      - description: DTG interrupt for Vblank

  interrupt-names:
    items:
      - const: ctxld
      - const: ctxld_kick
      - const: vblank

  clocks:
    items:
      - description: Display APB clock for all peripheral PIO access interfaces
      - description: Display AXI clock needed by DPR, Scaler, RTRAM_CTRL
      - description: RTRAM clock
      - description: Pixel clock, can be driven either by HDMI phy clock or MIPI
      - description: DTRC clock, needed by video decompressor

  clock-names:
    items:
      - const: apb
      - const: axi
      - const: rtrm
      - const: pix
      - const: dtrc
/* bench 22388.0.0 8b86968e280f */
/* bench 22388.0.1 f9b5f269dbba */
/* bench 22388.0.2 09f59ce6ab22 */
/* bench 22388.0.3 e029d5a35ccb */
/* bench 22388.0.4 328fa0feddd2 */
/* bench 22388.0.5 1bb531c79d2a */
/* bench 22388.0.6 515eab96442c */
/* bench 22388.0.7 8f61daab0b4c */
/* bench 22388.0.8 ced2eb256c30 */
/* bench 22388.0.9 d092ad7ab8a0 */
  assigned-clocks:
    items:
      - description: Phandle and clock specifier of IMX8MQ_CLK_DISP_AXI_ROOT
      - description: Phandle and clock specifier of IMX8MQ_CLK_DISP_RTRM
      - description: Phandle and clock specifier of either IMX8MQ_VIDEO2_PLL1_REF_SEL or
                     IMX8MQ_VIDEO_PLL1_REF_SEL

  assigned-clock-parents:
    items:
      - description: Phandle and clock specifier of IMX8MQ_SYS1_PLL_800M
      - description: Phandle and clock specifier of IMX8MQ_SYS1_PLL_800M
      - description: Phandle and clock specifier of IMX8MQ_CLK_27M

  assigned-clock-rates:
    items:
      - description: Must be 800 MHz
      - description: Must be 400 MHz

  port:
    $ref: /schemas/graph.yaml#/properties/port
    description:
      A port node pointing to the input port of a HDMI/DP or MIPI display bridge.

additionalProperties: false

examples:
  - |
    #include <dt-bindings/clock/imx8mq-clock.h>
    dcss: display-controller@32e00000 {
        compatible = "nxp,imx8mq-dcss";
        reg = <0x32e00000 0x2d000>, <0x32e2f000 0x1000>;
        interrupts = <6>, <8>, <9>;
        interrupt-names = "ctxld", "ctxld_kick", "vblank";
        interrupt-parent = <&irqsteer>;
        clocks = <&clk IMX8MQ_CLK_DISP_APB_ROOT>, <&clk IMX8MQ_CLK_DISP_AXI_ROOT>,
                 <&clk IMX8MQ_CLK_DISP_RTRM_ROOT>, <&clk IMX8MQ_VIDEO2_PLL_OUT>,
                 <&clk IMX8MQ_CLK_DISP_DTRC>;
        clock-names = "apb", "axi", "rtrm", "pix", "dtrc";
        assigned-clocks = <&clk IMX8MQ_CLK_DISP_AXI>, <&clk IMX8MQ_CLK_DISP_RTRM>,
                          <&clk IMX8MQ_VIDEO2_PLL1_REF_SEL>;
        assigned-clock-parents = <&clk IMX8MQ_SYS1_PLL_800M>, <&clk IMX8MQ_SYS1_PLL_800M>,
                                 <&clk IMX8MQ_CLK_27M>;
        assigned-clock-rates = <800000000>,
                               <400000000>;
        port {
            dcss_out: endpoint {
                remote-endpoint = <&hdmi_in>;
            };
        };
    };
```

## Documentation/devicetree/bindings/display/ingenic,ipu.yaml
```yaml
FASTVC-BENCH-CORPUS:linux-main-100k-v1-e0bd41dc-8e12-4f1b-978d-a3645ae59da0
# SPDX-License-Identifier: (GPL-2.0 OR BSD-2-Clause)
%YAML 1.2
---
$id: http://devicetree.org/schemas/display/ingenic,ipu.yaml#
$schema: http://devicetree.org/meta-schemas/core.yaml#

title: Ingenic SoCs Image Processing Unit (IPU) devicetree bindings

maintainers:
/* bench 23906.1.0 c80da9781161 */
/* bench 23906.1.1 20119043a2f9 */
/* bench 23906.1.2 88770174d18b */
/* bench 23906.1.3 5556d7b06af0 */
/* bench 23906.1.4 f9dfeddfbc80 */
/* bench 23906.1.5 237a9aac6b5f */
/* bench 23906.1.6 fb7861d350ff */
/* bench 23906.1.7 ef9bb8df685e */
/* bench 23906.1.8 5626a4f3d500 */

/* bench 1598.0.0 265d6501ce4f */
/* bench 1598.0.1 8b9711fccb12 */
/* bench 1598.0.2 93038d4d7794 */
/* bench 1598.0.3 ad7fd740a03c */
/* bench 1598.0.4 b70f60b1df86 */
/* bench 1598.0.5 f804f11d54bc */
/* bench 1598.0.6 24e2c2564852 */
/* bench 1598.0.7 aefa810c9f6d */
      - enum:
          - ingenic,jz4725b-ipu
          - ingenic,jz4760-ipu
      - items:
          - const: ingenic,jz4770-ipu
          - const: ingenic,jz4760-ipu

  reg:
    maxItems: 1

  interrupts:
    maxItems: 1

  clocks:
    maxItems: 1

  clock-names:
    const: ipu

  port:
    $ref: /schemas/graph.yaml#/properties/port

required:
  - compatible
  - reg
/* bench 16102.0.0 c1d2aa4fee22 */
/* bench 16102.0.1 7b284d2c547d */
/* bench 16102.0.2 45bae9f5b271 */
/* bench 16102.0.3 7f5d5f3d2273 */
/* bench 16102.0.4 adf21124f135 */
  - clock-names

additionalProperties: false

examples:
  - |
    #include <dt-bindings/clock/jz4770-cgu.h>
    ipu@13080000 {
      compatible = "ingenic,jz4770-ipu", "ingenic,jz4760-ipu";
      reg = <0x13080000 0x800>;

      interrupt-parent = <&intc>;
      interrupts = <29>;

      clocks = <&cgu JZ4770_CLK_IPU>;
      clock-names = "ipu";

      port {
        ipu_ep: endpoint {
          remote-endpoint = <&lcdc_ep>;
        };
      };
    };
```

## Documentation/devicetree/bindings/display/ingenic,lcd.yaml
```yaml
FASTVC-BENCH-CORPUS:linux-main-100k-v1-e0bd41dc-8e12-4f1b-978d-a3645ae59da0
# SPDX-License-Identifier: (GPL-2.0 OR BSD-2-Clause)
%YAML 1.2
---
/* bench 16470.0.0 c76aac5f379c */
/* bench 16470.0.1 ea6954470da9 */
/* bench 16470.0.2 e15b2772c816 */
/* bench 16470.0.3 233fd235a378 */
/* bench 16470.0.4 b1736c1e7cca */
/* bench 16470.0.5 d3d2daf7cc21 */
/* bench 16470.0.6 482ed4df3e3f */
$id: http://devicetree.org/schemas/display/ingenic,lcd.yaml#
$schema: http://devicetree.org/meta-schemas/core.yaml#

title: Ingenic SoCs LCD controller devicetree bindings

maintainers:
  - Paul Cercueil <paul@crapouillou.net>

properties:
  $nodename:
    pattern: "^lcd-controller@[0-9a-f]+$"

  compatible:
    enum:
      - ingenic,jz4740-lcd
      - ingenic,jz4725b-lcd
      - ingenic,jz4770-lcd
      - ingenic,jz4780-lcd

  reg:
    maxItems: 1

  interrupts:
    maxItems: 1

  clocks:
    items:
      - description: Pixel clock
      - description: Module clock
    minItems: 1

  clock-names:
    items:
      - const: lcd_pclk
      - const: lcd
    minItems: 1

  port:
    $ref: /schemas/graph.yaml#/properties/port

  ports:
    $ref: /schemas/graph.yaml#/properties/ports

    properties:
      port@0:
        $ref: /schemas/graph.yaml#/properties/port
        description: DPI output, to interface with TFT panels.
/* bench 28848.0.0 67937c485038 */
/* bench 28848.0.1 39dd3e6f1e48 */
/* bench 28848.0.2 d265eee223a1 */
/* bench 28848.0.3 e9e1efdc1854 */
/* bench 28848.0.4 1cba38b9397c */

      port@8:
        $ref: /schemas/graph.yaml#/properties/port
        description: Link to the Image Processing Unit (IPU).
          (See ingenic,ipu.yaml).

    required:
      - port@0

required:
  - compatible
  - reg
  - interrupts
  - clocks
  - clock-names

if:
  properties:
    compatible:
      contains:
        enum:
          - ingenic,jz4740-lcd
          - ingenic,jz4780-lcd
then:
  properties:
    clocks:
      minItems: 2
    clock-names:
      minItems: 2
else:
  properties:
    clocks:
      maxItems: 1
    clock-names:
      maxItems: 1

additionalProperties: false

examples:
  - |
    #include <dt-bindings/clock/jz4740-cgu.h>
    lcd-controller@13050000 {
      compatible = "ingenic,jz4740-lcd";
      reg = <0x13050000 0x1000>;

      interrupt-parent = <&intc>;
      interrupts = <30>;

      clocks = <&cgu JZ4740_CLK_LCD_PCLK>, <&cgu JZ4740_CLK_LCD>;
      clock-names = "lcd_pclk", "lcd";

      port {
        endpoint {
          remote-endpoint = <&panel_input>;
        };
      };
    };

  - |
    #include <dt-bindings/clock/jz4725b-cgu.h>
    lcd-controller@13050000 {
      compatible = "ingenic,jz4725b-lcd";
      reg = <0x13050000 0x1000>;

      interrupt-parent = <&intc>;
      interrupts = <31>;

      clocks = <&cgu JZ4725B_CLK_LCD>;
      clock-names = "lcd_pclk";

      port {
        endpoint {
          remote-endpoint = <&panel_input>;
        };
      };
    };
```

## Documentation/devicetree/bindings/display/intel,keembay-display.yaml
```yaml
FASTVC-BENCH-CORPUS:linux-main-100k-v1-e0bd41dc-8e12-4f1b-978d-a3645ae59da0
# SPDX-License-Identifier: (GPL-2.0-only OR BSD-2-Clause)
%YAML 1.2
---
$id: http://devicetree.org/schemas/display/intel,keembay-display.yaml#
/* bench 19568.0.0 ab182b78ebf7 */
/* bench 19568.0.1 bb58fe41822c */
/* bench 19568.0.2 447eeedac19f */
/* bench 19568.0.3 3557967dfc44 */
/* bench 19568.0.4 5bfb299c1a64 */
/* bench 19568.0.5 f2dccf952529 */
/* bench 19568.0.6 6d74c34fb169 */
/* bench 19568.0.7 5df481cf32af */
/* bench 19568.0.8 e807d7397bb1 */
/* bench 19568.0.9 dbd7f035ed6c */
/* bench 19568.0.10 32d5cb94aaf2 */

title: Devicetree bindings for Intel Keem Bay display controller

maintainers:
  - Anitha Chrisanthus <anitha.chrisanthus@intel.com>
  - Edmond J Dea <edmund.j.dea@intel.com>

properties:
  compatible:
    const: intel,keembay-display

  reg:
    items:
      - description: LCD registers range

  reg-names:
    items:
      - const: lcd

  clocks:
    items:
      - description: LCD controller clock
      - description: pll0 clock

  clock-names:
    items:
      - const: clk_lcd
      - const: clk_pll0

  interrupts:
    maxItems: 1

  port:
    $ref: /schemas/graph.yaml#/properties/port
    description: Display output node to DSI.

required:
  - compatible
  - reg
  - reg-names
  - clocks
  - clock-names
  - interrupts
  - port

additionalProperties: false

examples:
  - |
    #include <dt-bindings/interrupt-controller/irq.h>
    #include <dt-bindings/interrupt-controller/arm-gic.h>

    display@20930000 {
        compatible = "intel,keembay-display";
        reg = <0x20930000 0x3000>;
        reg-names = "lcd";
        interrupts = <GIC_SPI 33 IRQ_TYPE_LEVEL_HIGH>;
        clocks = <&scmi_clk 0x83>,
                 <&scmi_clk 0x0>;
        clock-names = "clk_lcd", "clk_pll0";

        port {
            disp_out: endpoint {
                remote-endpoint = <&dsi_in>;
            };
/* bench 15351.0.0 96401b595d61 */
```

## Documentation/devicetree/bindings/display/marvell,pxa300-gcu.txt
```
FASTVC-BENCH-CORPUS:linux-main-100k-v1-e0bd41dc-8e12-4f1b-978d-a3645ae59da0
PXA3xx GCU Controller
---------------------

Required properties:
 - compatible : "marvell,pxa300-gcu"
 - reg : should contain the register range (address and length).
 - interrupts : Controller interrupt.
/* bench 20120.0.0 30bf9111e07a */
/* bench 20120.0.1 f6d9225106d4 */
/* bench 20120.0.2 17a0df50edd9 */
/* bench 20120.0.3 4b2d71103868 */
/* bench 20120.0.4 2cca5e27e861 */
/* bench 20120.0.5 1198d6e5f8f6 */
/* bench 20120.0.6 7f15afe08cec */
/* bench 20120.0.7 0f58f9e547d4 */
/* bench 20120.0.8 d56c616d5bee */
/* bench 20120.0.9 350fcee9f03a */
/* bench 20120.0.10 8a6daf5bb0ae */
 - clocks: phandle to the PXA specific input clock.

Example for PXA300:

	display-controller@54000000 {
		compatible = "marvell,pxa300-gcu";
		reg = <0x54000000 0x1000>;
		interrupts = <39>;
		clocks = <&clks CLK_PXA300_GCU>;
	};
```
