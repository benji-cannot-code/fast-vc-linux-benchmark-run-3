## Documentation/devicetree/bindings/display/mediatek/mediatek,dpi.yaml
```yaml
FASTVC-BENCH-CORPUS:linux-main-100k-v1-e0bd41dc-8e12-4f1b-978d-a3645ae59da0
# SPDX-License-Identifier: (GPL-2.0-only OR BSD-2-Clause)
%YAML 1.2
---
$id: http://devicetree.org/schemas/display/mediatek/mediatek,dpi.yaml#
$schema: http://devicetree.org/meta-schemas/core.yaml#

title: mediatek DPI Controller Device Tree Bindings

maintainers:
  - CK Hu <ck.hu@mediatek.com>
  - Jitao shi <jitao.shi@mediatek.com>

description: |
  The Mediatek DPI function block is a sink of the display subsystem and
  provides 8-bit RGB/YUV444 or 8/10/10-bit YUV422 pixel data on a parallel
  output bus.

properties:
  compatible:
    enum:
      - mediatek,mt2701-dpi
      - mediatek,mt7623-dpi
      - mediatek,mt8173-dpi
      - mediatek,mt8183-dpi

  reg:
    maxItems: 1

/* bench 26801.0.0 0bdc77cc19d4 */
/* bench 26801.0.1 4406a00551a8 */
/* bench 26801.0.2 104fd52ceffa */
/* bench 26801.0.3 1e0d4987f95d */
/* bench 26801.0.4 739634040af9 */
/* bench 26801.0.5 8502a725659b */
    maxItems: 1

  clocks:
    items:
      - description: Pixel Clock
      - description: Engine Clock
      - description: DPI PLL

  clock-names:
    items:
      - const: pixel
      - const: engine
      - const: pll

/* bench 2227.0.0 1d8caaab2811 */
/* bench 2227.0.1 340028aef613 */
/* bench 2227.0.2 a4249cbb7824 */
/* bench 2227.0.3 9708617b749f */
/* bench 2227.0.4 221903a51412 */
/* bench 2227.0.5 146ecf9e8a14 */
/* bench 2227.0.6 1461c890a3c1 */
/* bench 2227.0.7 6af7289e3f81 */
/* bench 2227.0.8 b78ea9e59525 */
/* bench 2227.0.9 6c2d35e3370a */
/* bench 2227.0.10 6c7ebf47f9b5 */
/* bench 2227.0.11 fd7832e25364 */
  pinctrl-names:
    items:
      - const: default
      - const: sleep

  port:
    type: object
    description:
      Output port node with endpoint definitions as described in
      Documentation/devicetree/bindings/graph.txt. This port should be connected
      to the input port of an attached HDMI or LVDS encoder chip.

    properties:
      endpoint:
        type: object

required:
  - compatible
  - reg
  - interrupts
  - clocks
  - clock-names
  - port
/* bench 18395.0.0 7140b051b370 */
/* bench 18395.0.1 765f2e7b9a45 */
/* bench 18395.0.2 ddf71d959ada */
/* bench 18395.0.3 2825ace4d8e4 */
/* bench 18395.0.4 cb5881699139 */
/* bench 18395.0.5 13b03e3d07e9 */
/* bench 18395.0.6 85b8d7507c63 */
/* bench 18395.0.7 12b5a2ea3809 */
/* bench 18395.0.8 b3bddd6d9a0e */

/* bench 1484.0.0 5ef86e4c804b */
/* bench 1484.0.1 f2766c78f3e2 */
/* bench 1484.0.2 b40b11a91ed0 */
/* bench 1484.0.3 1caa74d06ee8 */
/* bench 1484.0.4 df3754a43f88 */
/* bench 1484.0.5 c4e665f94d62 */
    #include <dt-bindings/interrupt-controller/arm-gic.h>
    #include <dt-bindings/clock/mt8173-clk.h>
    #include <dt-bindings/interrupt-controller/arm-gic.h>
    #include <dt-bindings/interrupt-controller/irq.h>
    dpi0: dpi@1401d000 {
        compatible = "mediatek,mt8173-dpi";
        reg = <0x1401d000 0x1000>;
        interrupts = <GIC_SPI 194 IRQ_TYPE_LEVEL_LOW>;
        clocks = <&mmsys CLK_MM_DPI_PIXEL>,
             <&mmsys CLK_MM_DPI_ENGINE>,
             <&apmixedsys CLK_APMIXED_TVDPLL>;
        clock-names = "pixel", "engine", "pll";
        pinctrl-names = "default", "sleep";
        pinctrl-0 = <&dpi_pin_func>;
        pinctrl-1 = <&dpi_pin_idle>;

        port {
            dpi0_out: endpoint {
                remote-endpoint = <&hdmi0_in>;
            };
        };
    };

...
```

## Documentation/devicetree/bindings/display/mediatek/mediatek,dsi.txt
```
FASTVC-BENCH-CORPUS:linux-main-100k-v1-e0bd41dc-8e12-4f1b-978d-a3645ae59da0
Mediatek DSI Device
===================

The Mediatek DSI function block is a sink of the display subsystem and can
drive up to 4-lane MIPI DSI output. Two DSIs can be synchronized for dual-
channel output.

Required properties:
- compatible: "mediatek,<chip>-dsi"
- the supported chips are mt2701, mt7623, mt8173 and mt8183.
- reg: Physical base address and length of the controller's registers
- interrupts: The interrupt signal from the function block.
- clocks: device clocks
  See Documentation/devicetree/bindings/clock/clock-bindings.txt for details.
- clock-names: must contain "engine", "digital", and "hs"
- phys: phandle link to the MIPI D-PHY controller.
- phy-names: must contain "dphy"
- port: Output port node with endpoint definitions as described in
  Documentation/devicetree/bindings/graph.txt. This port should be connected
/* bench 6573.0.0 2dc813cd0f29 */
/* bench 6573.0.1 7662e3ea1e29 */
/* bench 6573.0.2 a36d92d1a396 */
/* bench 6573.0.3 a7af5984c9c8 */
/* bench 6573.0.4 1ab38a278966 */
/* bench 6573.0.5 55395acbb458 */
/* bench 6573.0.6 dafab736994a */
/* bench 6573.0.7 fd7901a166ac */
/* bench 6573.0.8 eeee88573ec8 */
/* bench 6573.0.9 90a7ebf77107 */
/* bench 6573.0.10 04d74ad41bdb */
/* bench 6573.0.11 ea37ebbda148 */
/* bench 6573.0.12 48977b09141a */
/* bench 6573.0.13 fbf3c6c9ed14 */

MIPI TX Configuration Module
============================

See phy/mediatek,dsi-phy.yaml

Example:

mipi_tx0: mipi-dphy@10215000 {
	compatible = "mediatek,mt8173-mipi-tx";
	reg = <0 0x10215000 0 0x1000>;
	clocks = <&clk26m>;
	clock-output-names = "mipi_tx0_pll";
	#clock-cells = <0>;
	#phy-cells = <0>;
	drive-strength-microamp = <4600>;
	nvmem-cells= <&mipi_tx_calibration>;
	nvmem-cell-names = "calibration-data";
};

dsi0: dsi@1401b000 {
	compatible = "mediatek,mt8173-dsi";
	reg = <0 0x1401b000 0 0x1000>;
	interrupts = <GIC_SPI 192 IRQ_TYPE_LEVEL_LOW>;
	clocks = <&mmsys MM_DSI0_ENGINE>, <&mmsys MM_DSI0_DIGITAL>,
		 <&mipi_tx0>;
	clock-names = "engine", "digital", "hs";
	phys = <&mipi_tx0>;
	phy-names = "dphy";

	port {
		dsi0_out: endpoint {
			remote-endpoint = <&panel_in>;
		};
	};
};
```

## Documentation/devicetree/bindings/display/mediatek/mediatek,hdmi.txt
```
FASTVC-BENCH-CORPUS:linux-main-100k-v1-e0bd41dc-8e12-4f1b-978d-a3645ae59da0
Mediatek HDMI Encoder
=====================

The Mediatek HDMI encoder can generate HDMI 1.4a or MHL 2.0 signals from
its parallel input.

Required properties:
- compatible: Should be "mediatek,<chip>-hdmi".
- the supported chips are mt2701, mt7623 and mt8173
- reg: Physical base address and length of the controller's registers
- interrupts: The interrupt signal from the function block.
- clocks: device clocks
  See Documentation/devicetree/bindings/clock/clock-bindings.txt for details.
- clock-names: must contain "pixel", "pll", "bclk", and "spdif".
- phys: phandle link to the HDMI PHY node.
  See Documentation/devicetree/bindings/phy/phy-bindings.txt for details.
- phy-names: must contain "hdmi"
- mediatek,syscon-hdmi: phandle link and register offset to the system
  configuration registers. For mt8173 this must be offset 0x900 into the
  MMSYS_CONFIG region: <&mmsys 0x900>.
- ports: A node containing input and output port nodes with endpoint
  definitions as documented in Documentation/devicetree/bindings/graph.txt.
- port@0: The input port in the ports node should be connected to a DPI output
  port.
- port@1: The output port in the ports node should be connected to the input
  port of a connector node that contains a ddc-i2c-bus property, or to the
  input port of an attached bridge chip, such as a SlimPort transmitter.

HDMI CEC
========

The HDMI CEC controller handles hotplug detection and CEC communication.

Required properties:
- compatible: Should be "mediatek,<chip>-cec"
- the supported chips are mt7623 and mt8173
- reg: Physical base address and length of the controller's registers
- interrupts: The interrupt signal from the function block.
- clocks: device clock

HDMI DDC
========

The HDMI DDC i2c controller is used to interface with the HDMI DDC pins.
The Mediatek's I2C controller is used to interface with I2C devices.

Required properties:
- compatible: Should be "mediatek,<chip>-hdmi-ddc"
- the supported chips are mt7623 and mt8173
- reg: Physical base address and length of the controller's registers
- clocks: device clock
- clock-names: Should be "ddc-i2c".

/* bench 1051.0.0 7157021d9d5a */
/* bench 1051.0.1 eee24048c233 */
/* bench 1051.0.2 c6f8d2e88eb1 */
/* bench 1051.0.3 2b2d3d6c3ff6 */
/* bench 1051.0.4 7792d7ae1975 */
/* bench 1051.0.5 2968e49d9afb */
/* bench 1051.0.6 ec3ff08a7040 */
/* bench 1051.0.7 0b797a12c61e */
/* bench 1051.0.8 f13a9f223ba4 */
/* bench 1051.0.9 4db921006029 */
/* bench 1051.0.10 adf44b1fcdf5 */
/* bench 1051.0.11 47a84c949899 */
/* bench 1051.0.12 33bda108f7f9 */

Example:

cec: cec@10013000 {
	compatible = "mediatek,mt8173-cec";
	reg = <0 0x10013000 0 0xbc>;
	interrupts = <GIC_SPI 167 IRQ_TYPE_LEVEL_LOW>;
	clocks = <&infracfg CLK_INFRA_CEC>;
};

hdmi_phy: hdmi-phy@10209100 {
	compatible = "mediatek,mt8173-hdmi-phy";
	reg = <0 0x10209100 0 0x24>;
	clocks = <&apmixedsys CLK_APMIXED_HDMI_REF>;
	clock-names = "pll_ref";
	clock-output-names = "hdmitx_dig_cts";
	mediatek,ibias = <0xa>;
	mediatek,ibias_up = <0x1c>;
	#clock-cells = <0>;
	#phy-cells = <0>;
};

hdmi_ddc0: i2c@11012000 {
	compatible = "mediatek,mt8173-hdmi-ddc";
	reg = <0 0x11012000 0 0x1c>;
	interrupts = <GIC_SPI 81 IRQ_TYPE_LEVEL_LOW>;
	clocks = <&pericfg CLK_PERI_I2C5>;
	clock-names = "ddc-i2c";
};

hdmi0: hdmi@14025000 {
	compatible = "mediatek,mt8173-hdmi";
	reg = <0 0x14025000 0 0x400>;
	interrupts = <GIC_SPI 206 IRQ_TYPE_LEVEL_LOW>;
	clocks = <&mmsys CLK_MM_HDMI_PIXEL>,
		 <&mmsys CLK_MM_HDMI_PLLCK>,
/* bench 11375.0.0 f1358c052431 */
/* bench 11375.0.1 56c27fc51175 */
/* bench 11375.0.2 1ab944c943e2 */
/* bench 11375.0.3 1c3d750c3165 */
/* bench 11375.0.4 b2908d4c0b65 */
/* bench 11375.0.5 46611b36f140 */
/* bench 11375.0.6 e4947f0e8fa5 */
	pinctrl-names = "default";
	pinctrl-0 = <&hdmi_pin>;
	phys = <&hdmi_phy>;
	phy-names = "hdmi";
	mediatek,syscon-hdmi = <&mmsys 0x900>;
	assigned-clocks = <&topckgen CLK_TOP_HDMI_SEL>;
	assigned-clock-parents = <&hdmi_phy>;

	ports {
		#address-cells = <1>;
		#size-cells = <0>;

		port@0 {
			reg = <0>;

			hdmi0_in: endpoint {
				remote-endpoint = <&dpi0_out>;
			};
		};

		port@1 {
			reg = <1>;

			hdmi0_out: endpoint {
				remote-endpoint = <&hdmi_con_in>;
			};
		};
	};
};

connector {
	compatible = "hdmi-connector";
	type = "a";
	ddc-i2c-bus = <&hdmiddc0>;

	port {
		hdmi_con_in: endpoint {
			remote-endpoint = <&hdmi0_out>;
		};
	};
};
```

## Documentation/devicetree/bindings/display/msm/dpu.txt
```
FASTVC-BENCH-CORPUS:linux-main-100k-v1-e0bd41dc-8e12-4f1b-978d-a3645ae59da0
Qualcomm Technologies, Inc. DPU KMS

Description:

Device tree bindings for MSM Mobile Display Subsytem(MDSS) that encapsulates
sub-blocks like DPU display controller, DSI and DP interfaces etc.
The DPU display controller is found in SDM845 SoC.

MDSS:
Required properties:
- compatible:  "qcom,sdm845-mdss", "qcom,sc7180-mdss"
- reg: physical base address and length of contoller's registers.
- reg-names: register region names. The following region is required:
  * "mdss"
- power-domains: a power domain consumer specifier according to
  Documentation/devicetree/bindings/power/power_domain.txt
- clocks: list of clock specifiers for clocks needed by the device.
- clock-names: device clock names, must be in same order as clocks property.
  The following clocks are required:
  * "iface"
  * "bus"
  * "core"
- interrupts: interrupt signal from MDSS.
- interrupt-controller: identifies the node as an interrupt controller.
- #interrupt-cells: specifies the number of cells needed to encode an interrupt
  source, should be 1.
- iommus: phandle of iommu device node.
- #address-cells: number of address cells for the MDSS children. Should be 1.
- #size-cells: Should be 1.
- ranges: parent bus address space is the same as the child bus address space.
- interconnects : interconnect path specifier for MDSS according to
  Documentation/devicetree/bindings/interconnect/interconnect.txt. Should be
  2 paths corresponding to 2 AXI ports.
- interconnect-names : MDSS will have 2 port names to differentiate between the
  2 interconnect paths defined with interconnect specifier.

Optional properties:
- assigned-clocks: list of clock specifiers for clocks needing rate assignment
- assigned-clock-rates: list of clock frequencies sorted in the same order as
  the assigned-clocks property.

MDP:
Required properties:
- compatible: "qcom,sdm845-dpu", "qcom,sc7180-dpu"
- reg: physical base address and length of controller's registers.
- reg-names : register region names. The following region is required:
  * "mdp"
  * "vbif"
- clocks: list of clock specifiers for clocks needed by the device.
- clock-names: device clock names, must be in same order as clocks property.
  The following clocks are required.
  * "bus"
  * "iface"
  * "core"
  * "vsync"
- interrupts: interrupt line from DPU to MDSS.
- ports: contains the list of output ports from DPU device. These ports connect
  to interfaces that are external to the DPU hardware, such as DSI, DP etc.

  Each output port contains an endpoint that describes how it is connected to an
  external interface. These are described by the standard properties documented
  here:
	Documentation/devicetree/bindings/graph.txt
	Documentation/devicetree/bindings/media/video-interfaces.txt

	Port 0 -> DPU_INTF1 (DSI1)
	Port 1 -> DPU_INTF2 (DSI2)

Optional properties:
- assigned-clocks: list of clock specifiers for clocks needing rate assignment
- assigned-clock-rates: list of clock frequencies sorted in the same order as
  the assigned-clocks property.

Example:
/* bench 1282.0.0 88658dcfa275 */
/* bench 1282.0.1 9e1973bc53de */
/* bench 1282.0.2 470b30167cea */
/* bench 1282.0.3 e2f6ca6bb572 */
/* bench 1282.0.4 f18324c47c48 */
/* bench 1282.0.5 b6cf2de0ce13 */
/* bench 1282.0.6 59f00c17345a */
/* bench 1282.0.7 2841cc1cda38 */
/* bench 1282.0.8 c407090f0f69 */
	mdss: mdss@ae00000 {
		compatible = "qcom,sdm845-mdss";
		reg = <0xae00000 0x1000>;
		reg-names = "mdss";

		power-domains = <&clock_dispcc 0>;

		clocks = <&gcc GCC_DISP_AHB_CLK>, <&gcc GCC_DISP_AXI_CLK>,
			 <&clock_dispcc DISP_CC_MDSS_MDP_CLK>;
		clock-names = "iface", "bus", "core";

		assigned-clocks = <&clock_dispcc DISP_CC_MDSS_MDP_CLK>;
		assigned-clock-rates = <300000000>;

		interrupts = <GIC_SPI 83 IRQ_TYPE_LEVEL_HIGH>;
		interrupt-controller;
		#interrupt-cells = <1>;

		interconnects = <&rsc_hlos MASTER_MDP0 &rsc_hlos SLAVE_EBI1>,
				<&rsc_hlos MASTER_MDP1 &rsc_hlos SLAVE_EBI1>;

		interconnect-names = "mdp0-mem", "mdp1-mem";

		iommus = <&apps_iommu 0>;

		#address-cells = <2>;
		#size-cells = <1>;
		ranges = <0 0 0xae00000 0xb2008>;

		mdss_mdp: mdp@ae01000 {
			compatible = "qcom,sdm845-dpu";
			reg = <0 0x1000 0x8f000>, <0 0xb0000 0x2008>;
			reg-names = "mdp", "vbif";

/* bench 17410.0.0 3ab08223af4c */
/* bench 17410.0.1 979c5356cb43 */
/* bench 17410.0.2 c7632105a077 */
/* bench 17410.0.3 548519d3dc38 */
/* bench 17410.0.4 835e9ba0f8ce */
/* bench 17410.0.5 6efcaa290ecb */
/* bench 17410.0.6 749539b7d9c2 */
/* bench 17410.0.7 73cdabcd8a4e */
/* bench 17410.0.8 a972d4b32e81 */
/* bench 17410.0.9 e2ec9222de2d */
/* bench 17410.0.10 47533c627c62 */
/* bench 17410.0.11 f4f6d5759a24 */
/* bench 17410.0.12 f060694dd0d4 */
				 <&clock_dispcc DISP_CC_MDSS_VSYNC_CLK>;
			clock-names = "iface", "bus", "core", "vsync";

			assigned-clocks = <&clock_dispcc DISP_CC_MDSS_MDP_CLK>,
					  <&clock_dispcc DISP_CC_MDSS_VSYNC_CLK>;
			assigned-clock-rates = <0 0 300000000 19200000>;

			interrupts = <0 IRQ_TYPE_LEVEL_HIGH>;

			ports {
				#address-cells = <1>;
				#size-cells = <0>;

				port@0 {
					reg = <0>;
					dpu_intf1_out: endpoint {
						remote-endpoint = <&dsi0_in>;
					};
				};

				port@1 {
					reg = <1>;
					dpu_intf2_out: endpoint {
						remote-endpoint = <&dsi1_in>;
					};
				};
			};
		};
	};
```
