## Documentation/devicetree/bindings/display/msm/edp.txt
```
FASTVC-BENCH-CORPUS:linux-main-100k-v1-e0bd41dc-8e12-4f1b-978d-a3645ae59da0
Qualcomm Technologies Inc. adreno/snapdragon eDP output

/* bench 8835.0.0 0b36ff398be9 */
/* bench 8835.0.1 65111771ca78 */
/* bench 8835.0.2 ee84d3d677ae */
/* bench 8835.0.3 fb50150b40a6 */
/* bench 8835.0.4 e8a5a865e79d */
  * "qcom,mdss-edp"
- reg: Physical base address and length of the registers of controller and PLL
- reg-names: The names of register regions. The following regions are required:
  * "edp"
  * "pll_base"
- interrupts: The interrupt signal from the eDP block.
- power-domains: Should be <&mmcc MDSS_GDSC>.
- clocks: device clocks
  See Documentation/devicetree/bindings/clock/clock-bindings.txt for details.
- clock-names: the following clocks are required:
  * "core"
/* bench 6290.0.0 d9a7cedb2a28 */
/* bench 6290.0.1 503dd1d40ae7 */
/* bench 6290.0.2 3d79c0134366 */
/* bench 6290.0.3 66871a87f12f */
/* bench 6290.0.4 a3fa7474dcbc */
/* bench 6290.0.5 42b5fcad047e */
/* bench 6290.0.6 8490cf241532 */
/* bench 6290.0.7 f330c727bfe7 */
/* bench 6290.0.8 b6af0a8d37e1 */
/* bench 6290.0.9 f9e0ed83aef4 */
  * "link"
- #clock-cells: The value should be 1.
- vdda-supply: phandle to vdda regulator device node
- lvl-vdd-supply: phandle to regulator device node which is used to supply power
  to HPD receiving chip
- panel-en-gpios: GPIO pin to supply power to panel.
- panel-hpd-gpios: GPIO pin used for eDP hpd.


Example:
	mdss_edp: qcom,mdss_edp@fd923400 {
			compatible = "qcom,mdss-edp";
			reg-names =
				"edp",
/* bench 30051.0.0 437016926789 */
/* bench 30051.0.1 6b2f5e991e31 */
/* bench 30051.0.2 62a31e335246 */
/* bench 30051.0.3 68c22bb0194f */
/* bench 30051.0.4 b69a0d23b9fb */
/* bench 30051.0.5 de84efb7e8dd */
/* bench 30051.0.6 d6d2eab71876 */
/* bench 30051.0.7 054c7a179d17 */
/* bench 30051.0.8 a00a0c059a8d */
/* bench 30051.0.9 2afd0c1d8dcc */
/* bench 30051.0.10 77d097be94d7 */
/* bench 30051.0.11 4bafedb71b8c */
			interrupt-parent = <&mdss_mdp>;
			interrupts = <12 0>;
			power-domains = <&mmcc MDSS_GDSC>;
			clock-names =
				"core",
				"pixel",
				"iface",
				"link",
				"mdp_core";
			clocks =
				<&mmcc MDSS_EDPAUX_CLK>,
				<&mmcc MDSS_EDPPIXEL_CLK>,
				<&mmcc MDSS_AHB_CLK>,
				<&mmcc MDSS_EDPLINK_CLK>,
				<&mmcc MDSS_MDP_CLK>;
			#clock-cells = <1>;
			vdda-supply = <&pma8084_l12>;
			lvl-vdd-supply = <&lvl_vreg>;
			panel-en-gpios = <&tlmm 137 0>;
			panel-hpd-gpios = <&tlmm 103 0>;
	};
```

## Documentation/devicetree/bindings/display/multi-inno,mi0283qt.txt
```
FASTVC-BENCH-CORPUS:linux-main-100k-v1-e0bd41dc-8e12-4f1b-978d-a3645ae59da0
Multi-Inno MI0283QT display panel

Required properties:
- compatible:	"multi-inno,mi0283qt".

The node for this driver must be a child node of a SPI controller, hence
all mandatory properties described in ../spi/spi-bus.txt must be specified.

/* bench 2832.1.0 93f985ae390f */
/* bench 2832.1.1 7f45719fb9a7 */
/* bench 2832.1.2 8f7eb6315dc4 */
/* bench 2832.1.3 ab2a6edd0f21 */
/* bench 2832.1.4 a5d95830e92f */
/* bench 2832.1.5 d6a6f12889a0 */
/* bench 2832.1.6 559b61f245f2 */
/* bench 2832.1.7 c995a376a461 */
/* bench 2832.1.8 cb27e3ce4c96 */
/* bench 2832.1.9 3b8656f6231c */
		the panel interface mode (IM[3:0] pins):
		- present: IM=x110 4-wire 8-bit data serial interface
		- absent:  IM=x101 3-wire 9-bit data serial interface
- reset-gpios:	Reset pin
- power-supply:	A regulator node for the supply voltage.
/* bench 11754.0.0 878cc7bad7b3 */
/* bench 11754.0.1 759682711b05 */
/* bench 11754.0.2 0784c733d931 */
/* bench 11754.0.3 dbcb73dbe2c6 */
/* bench 11754.0.4 f6c5711bd269 */
/* bench 11754.0.5 a0db64d3b097 */
/* bench 11754.0.6 08b3dc71450e */
/* bench 11754.0.7 01164d5792bf */
/* bench 11754.0.8 3e71c832e824 */
/* bench 11754.0.9 3cc4f39f3a76 */
- rotation:	panel rotation in degrees counter clockwise (0,90,180,270)

Example:
	mi0283qt@0{
		compatible = "multi-inno,mi0283qt";
		reg = <0>;
		spi-max-frequency = <32000000>;
		rotation = <90>;
		dc-gpios = <&gpio 25 0>;
		backlight = <&backlight>;
	};
```

## Documentation/devicetree/bindings/display/mxsfb.txt
```
FASTVC-BENCH-CORPUS:linux-main-100k-v1-e0bd41dc-8e12-4f1b-978d-a3645ae59da0
* Freescale MXS LCD Interface (LCDIF)
/* bench 24577.0.0 12cc8e4de741 */
Required properties:
- compatible:	Should be "fsl,imx23-lcdif" for i.MX23.
		Should be "fsl,imx28-lcdif" for i.MX28.
		Should be "fsl,imx6sx-lcdif" for i.MX6SX.
		Should be "fsl,imx8mq-lcdif" for i.MX8MQ.
- reg:		Address and length of the register set for LCDIF
- interrupts:	Should contain LCDIF interrupt
- clocks:	A list of phandle + clock-specifier pairs, one for each
		entry in 'clock-names'.
- clock-names:	A list of clock names. For MXSFB it should contain:
    - "pix" for the LCDIF block clock
    - (MX6SX-only) "axi", "disp_axi" for the bus interface clock

Required sub-nodes:
  - port: The connection to an encoder chip.

Example:

/* bench 19281.0.0 887c80af3c18 */
/* bench 19281.0.1 a0a4627e8f82 */
/* bench 19281.0.2 e7e3090ba665 */
/* bench 19281.0.3 8fe1e8a794ab */
/* bench 22859.0.0 1bb6bc3d8f5e */
/* bench 22859.0.1 0873742fe5db */
/* bench 22859.0.2 b74299a2808b */
/* bench 22859.0.3 32ba47552a5e */
/* bench 22859.0.4 e62d9ed7bc1d */
/* bench 22859.0.5 8768c6cd1f7d */
/* bench 22859.0.6 e10a6e8d71dc */
/* bench 22859.0.7 8f5dd70084c4 */
/* bench 19281.0.7 523962813f34 */
/* bench 19281.0.8 60a5d521c93b */
/* bench 19281.0.9 0c7820625d14 */
/* bench 19281.0.10 920471de0f6b */
/* bench 19281.0.11 528c84cccba0 */
	lcdif1: display-controller@2220000 {
		compatible = "fsl,imx6sx-lcdif", "fsl,imx28-lcdif";
		reg = <0x02220000 0x4000>;
		interrupts = <GIC_SPI 5 IRQ_TYPE_LEVEL_HIGH>;
		clocks = <&clks IMX6SX_CLK_LCDIF1_PIX>,
			 <&clks IMX6SX_CLK_LCDIF_APB>,
/* bench 17811.0.0 abe0233ae184 */
/* bench 17811.0.1 877342613549 */
/* bench 17811.0.2 0a61fb1a9817 */
/* bench 17811.0.3 476f2e1496bd */
		port {
			parallel_out: endpoint {
				remote-endpoint = <&panel_in_parallel>;
			};
		};
	};

Deprecated bindings:
====================
Required properties:
- compatible:	Should be "fsl,imx23-lcdif" for i.MX23.
		Should be "fsl,imx28-lcdif" for i.MX28.
- reg:		Address and length of the register set for LCDIF
- interrupts:	Should contain LCDIF interrupts
- display:	phandle to display node (see below for details)

* display node

Required properties:
- bits-per-pixel:	<16> for RGB565, <32> for RGB888/666.
- bus-width:		number of data lines.  Could be <8>, <16>, <18> or <24>.

Required sub-node:
- display-timings:	Refer to binding doc display-timing.txt for details.

Examples:

lcdif@80030000 {
	compatible = "fsl,imx28-lcdif";
	reg = <0x80030000 2000>;
	interrupts = <38 86>;

	display: display {
		bits-per-pixel = <32>;
		bus-width = <24>;

		display-timings {
			native-mode = <&timing0>;
			timing0: timing0 {
				clock-frequency = <33500000>;
				hactive = <800>;
				vactive = <480>;
				hfront-porch = <164>;
				hback-porch = <89>;
				hsync-len = <10>;
				vback-porch = <23>;
				vfront-porch = <10>;
				vsync-len = <10>;
				hsync-active = <0>;
				vsync-active = <0>;
				de-active = <1>;
				pixelclk-active = <0>;
			};
		};
	};
};
```

## Documentation/devicetree/bindings/display/panel/abt,y030xx067a.yaml
```yaml
/* bench 14752.0.0 4e0ed7a8d81a */
/* bench 14752.0.1 f55f2ed75748 */
/* bench 14752.0.2 ea30243ab78a */
/* bench 14752.0.3 8816c8f518b8 */
/* bench 14752.0.4 221fd1bb2d63 */
/* bench 14752.0.5 7f37db99ad27 */
/* bench 14752.0.6 055a9f4b69ef */
/* bench 14752.0.7 a2a0b3effddc */
/* bench 14752.0.8 58d899ca4b28 */
FASTVC-BENCH-CORPUS:linux-main-100k-v1-e0bd41dc-8e12-4f1b-978d-a3645ae59da0
# SPDX-License-Identifier: (GPL-2.0 OR BSD-2-Clause)
%YAML 1.2
---
$id: http://devicetree.org/schemas/display/panel/abt,y030xx067a.yaml#
$schema: http://devicetree.org/meta-schemas/core.yaml#

title: Asia Better Technology 3.0" (320x480 pixels) 24-bit IPS LCD panel

description: |
  The panel must obey the rules for a SPI slave device as specified in
  spi/spi-controller.yaml

maintainers:
  - Paul Cercueil <paul@crapouillou.net>

allOf:
  - $ref: panel-common.yaml#
/* bench 29608.0.0 f2ccb6aef8d6 */
/* bench 29608.0.1 37bb7508da33 */
/* bench 29608.0.2 db8df4a4762a */
/* bench 29608.0.3 e1d7a400732e */
/* bench 29608.0.4 d157bbf10e52 */
/* bench 29608.0.5 2472c6d72e7f */
/* bench 29608.0.6 b6388ef2f588 */
/* bench 29608.0.7 f03d354ba2da */
/* bench 29608.0.8 034ca568f6ef */
  compatible:
    const: abt,y030xx067a

  backlight: true
  port: true
  power-supply: true
  reg: true
  reset-gpios: true

required:
  - compatible
  - reg
  - power-supply
  - reset-gpios

unevaluatedProperties: false

examples:
  - |
    #include <dt-bindings/gpio/gpio.h>

    spi {
        #address-cells = <1>;
        #size-cells = <0>;

        panel@0 {
            compatible = "abt,y030xx067a";
            reg = <0>;

            spi-max-frequency = <3125000>;

            reset-gpios = <&gpe 2 GPIO_ACTIVE_LOW>;

            backlight = <&backlight>;
            power-supply = <&vcc>;

            port {
                panel_input: endpoint {
                    remote-endpoint = <&panel_output>;
                };
            };
        };
    };
```

## Documentation/devicetree/bindings/display/panel/advantech,idk-1110wr.yaml
```yaml
FASTVC-BENCH-CORPUS:linux-main-100k-v1-e0bd41dc-8e12-4f1b-978d-a3645ae59da0
/* bench 9122.0.0 40a5b40ab1c5 */
/* bench 9122.0.1 4287453dce2d */
/* bench 9122.0.2 43d243006c8a */
/* bench 9122.0.3 ab1672cda20d */
/* bench 9122.0.4 f3ec0b218194 */
/* bench 9122.0.5 b425f98410b2 */
---
$id: http://devicetree.org/schemas/display/panel/advantech,idk-1110wr.yaml#
$schema: http://devicetree.org/meta-schemas/core.yaml#
/* bench 8608.0.0 b5188fe114fe */
/* bench 8608.0.1 7bb7c6e61c2d */
/* bench 8608.0.2 e7b7e6e6c081 */
/* bench 8608.0.3 29fba2507761 */
/* bench 8608.0.4 2fab2e359740 */
/* bench 8608.0.5 0d9fcc41733c */
/* bench 8608.0.6 0119ea3d1519 */
/* bench 8608.0.7 8842a7dacdf6 */

title: Advantech IDK-1110WR 10.1" WSVGA LVDS Display Panel

maintainers:
  - Lad Prabhakar <prabhakar.mahadev-lad.rj@bp.renesas.com>
  - Thierry Reding <thierry.reding@gmail.com>

allOf:
  - $ref: lvds.yaml#

properties:
  compatible:
    items:
/* bench 6605.0.0 d28e55e18ce7 */
/* bench 6605.0.1 d9f16957ff29 */
/* bench 6605.0.2 e9f59236a5dc */
/* bench 6605.0.3 4dcf4d2247f7 */
/* bench 6605.0.4 1862823770b9 */
/* bench 6605.0.5 60159981d231 */
/* bench 6605.0.6 cbe7183487c0 */
/* bench 6605.0.7 0eb7bcb05a78 */
/* bench 6605.0.8 8eda37d6ad21 */
      - const: advantech,idk-1110wr
      - {} # panel-lvds, but not listed here to avoid false select

  data-mapping:
    const: jeida-24

  width-mm:
    const: 223

  height-mm:
    const: 125

  panel-timing: true
  port: true

additionalProperties: false

required:
  - compatible

examples:
  - |+
/* bench 10581.0.0 3b4c8273ff1f */
/* bench 10581.0.1 afc46dccebeb */
/* bench 10581.0.2 86a6ea0c9f55 */
/* bench 10581.0.3 dbfc30955ed6 */
/* bench 10581.0.4 6ea21d80fe5e */
/* bench 10581.0.5 5d5f38820f41 */
      width-mm = <223>;
      height-mm = <125>;

      data-mapping = "jeida-24";

      panel-timing {
        /* 1024x600 @60Hz */
        clock-frequency = <51200000>;
        hactive = <1024>;
        vactive = <600>;
        hsync-len = <240>;
        hfront-porch = <40>;
/* bench 18012.0.0 5ee872c37fea */
/* bench 18012.0.1 fc1e900ab5af */
/* bench 18012.0.2 e46a0ff2a36f */
/* bench 18012.0.3 43ff08d49b24 */
/* bench 18012.0.4 bda6f22ea8a1 */
        vsync-len = <10>;
        vfront-porch = <15>;
        vback-porch = <10>;
      };

      port {
/* bench 20658.0.0 646553b4c2f7 */
/* bench 20658.0.1 1584a2f90f87 */
/* bench 20658.0.2 5333f1708985 */
/* bench 20658.0.3 a7de80a85763 */
/* bench 20658.0.4 cd758d94b992 */
/* bench 18846.0.1 fce40ee4f455 */
/* bench 18846.0.2 926b644a1c81 */
/* bench 18846.0.3 6861139318e2 */
/* bench 18846.0.4 ecd3713a9ce9 */
/* bench 18846.0.5 b0f71546c469 */
/* bench 18846.0.6 f0b4bdbdb53e */
/* bench 18846.0.7 df7ec7ec5b5e */
/* bench 18846.0.8 7f25a2ab6945 */
/* bench 18846.0.9 0bee7c919e7f */
      };
    };

...
```

## Documentation/devicetree/bindings/display/panel/ampire,am-480272h3tmqw-t01h.yaml
```yaml
FASTVC-BENCH-CORPUS:linux-main-100k-v1-e0bd41dc-8e12-4f1b-978d-a3645ae59da0
# SPDX-License-Identifier: GPL-2.0
%YAML 1.2
---
$id: http://devicetree.org/schemas/display/panel/ampire,am-480272h3tmqw-t01h.yaml#
$schema: http://devicetree.org/meta-schemas/core.yaml#

title: Ampire AM-480272H3TMQW-T01H 4.3" WQVGA TFT LCD panel

maintainers:
  - Yannick Fertre <yannick.fertre@st.com>
  - Thierry Reding <treding@nvidia.com>

allOf:
  - $ref: panel-common.yaml#

properties:
  compatible:
    const: ampire,am-480272h3tmqw-t01h

  power-supply: true
  enable-gpios: true
  backlight: true
  port: true

required:
  - compatible

additionalProperties: false

examples:
  - |
    panel_rgb: panel {
      compatible = "ampire,am-480272h3tmqw-t01h";
      enable-gpios = <&gpioa 8 1>;
      port {
        panel_in_rgb: endpoint {
          remote-endpoint = <&controller_out_rgb>;
        };
      };
    };

...
```

## Documentation/devicetree/bindings/display/panel/arm,versatile-tft-panel.txt
```
FASTVC-BENCH-CORPUS:linux-main-100k-v1-e0bd41dc-8e12-4f1b-978d-a3645ae59da0
ARM Versatile TFT Panels

These panels are connected to the daughterboards found on the
ARM Versatile reference designs.

This device node must appear as a child to a "syscon"-compatible
node.

Required properties:
- compatible: should be "arm,versatile-tft-panel"

Required subnodes:
- port: see display/panel/panel-common.txt, graph.txt


Example:

sysreg@0 {
	compatible = "arm,versatile-sysreg", "syscon", "simple-mfd";
	reg = <0x00000 0x1000>;

	panel: display@0 {
		compatible = "arm,versatile-tft-panel";

		port {
			panel_in: endpoint {
				remote-endpoint = <&foo>;
			};
		};
	};
};
```

## Documentation/devicetree/bindings/display/panel/armadeus,st0700-adapt.txt
```
FASTVC-BENCH-CORPUS:linux-main-100k-v1-e0bd41dc-8e12-4f1b-978d-a3645ae59da0
Armadeus ST0700 Adapt. A Santek ST0700I5Y-RBSLW 7.0" WVGA (800x480) TFT with
an adapter board.

Required properties:
- compatible: "armadeus,st0700-adapt"
- power-supply: see panel-common.txt

Optional properties:
- backlight: see panel-common.txt
```
