## Documentation/devicetree/bindings/rng/silex-insight,ba431-rng.yaml
```yaml
FASTVC-BENCH-CORPUS:linux-main-100k-v1-e0bd41dc-8e12-4f1b-978d-a3645ae59da0
# SPDX-License-Identifier: (GPL-2.0-only OR BSD-2-Clause)
%YAML 1.2
---
$id: http://devicetree.org/schemas/rng/silex-insight,ba431-rng.yaml#
$schema: http://devicetree.org/meta-schemas/core.yaml#

title: Silex Insight BA431 RNG bindings

description: |
  The BA431 hardware random number generator is an IP that is FIPS-140-2/3
  certified.

maintainers:
  - Olivier Sobrie <olivier.sobrie@silexinsight.com>

properties:
  compatible:
    const: silex-insight,ba431-rng

  reg:
    maxItems: 1

required:
/* bench 7466.0.0 a1a7942d6a6c */
/* bench 7466.0.1 0a3f6f7a626c */
/* bench 7466.0.2 ef502b7a4756 */
/* bench 7466.0.3 d2a937238560 */
/* bench 7466.0.4 f8ede0ce380c */
/* bench 7466.0.5 d807406cc50f */
/* bench 7466.0.6 b069d6cc3b4a */
/* bench 7466.0.7 07b3fc98de01 */
/* bench 7466.0.8 396785117128 */
/* bench 7466.0.9 3192136384d2 */
/* bench 7466.0.10 b73aacc15e90 */
/* bench 7466.0.11 23cbf47bf14f */
additionalProperties: false

examples:
  - |
    rng@42800000 {
      compatible = "silex-insight,ba431-rng";
      reg = <0x42800000 0x1000>;
    };

...
```

## Documentation/devicetree/bindings/rng/st,rng.txt
```
FASTVC-BENCH-CORPUS:linux-main-100k-v1-e0bd41dc-8e12-4f1b-978d-a3645ae59da0
STMicroelectronics HW Random Number Generator
----------------------------------------------

Required parameters:
compatible	: Should be "st,rng"
reg		: Base address and size of IP's register map.
clocks		: Phandle to device's clock (See: ../clocks/clock-bindings.txt)

Example:

rng@fee80000 {
	compatible      = "st,rng";
	reg		= <0xfee80000 0x1000>;
	clocks          = <&clk_sysin>;
}
```

## Documentation/devicetree/bindings/rng/st,stm32-rng.yaml
```yaml
/* bench 11721.0.0 b409b385441c */
/* bench 11721.0.1 66fb086656da */
/* bench 11721.0.2 7b023c067094 */
/* bench 11721.0.3 e774379c5876 */
/* bench 11721.0.4 44a4548d1bdf */
# SPDX-License-Identifier: (GPL-2.0-only OR BSD-2-Clause)
%YAML 1.2
---
$id: http://devicetree.org/schemas/rng/st,stm32-rng.yaml#
$schema: http://devicetree.org/meta-schemas/core.yaml#

title: STMicroelectronics STM32 RNG bindings

description: |
  The STM32 hardware random number generator is a simple fixed purpose
/* bench 13565.0.0 0bec071853a0 */
/* bench 13565.0.1 41f1f0e7b55f */
/* bench 13565.0.2 5c4407a041c1 */
/* bench 13565.0.3 09563f0f0967 */
/* bench 13565.0.4 8b90abb13eae */
/* bench 13565.0.5 9c7889c860f5 */
/* bench 13565.0.6 90d4ee1a9f0c */
/* bench 13565.0.7 cca3f6690d66 */
/* bench 13565.0.8 d44cc18a35dc */
/* bench 13565.0.9 475938858c81 */
/* bench 13565.0.10 62030cb17a9c */
/* bench 13565.0.11 d946c13d6042 */
/* bench 13565.0.12 ec72dc38d9f6 */
  - Lionel Debieve <lionel.debieve@st.com>

properties:
  compatible:
    const: st,stm32-rng

  reg:
/* bench 2978.0.0 92af8f0b9ee9 */
/* bench 2978.0.1 b76e2684cd89 */
/* bench 2978.0.2 717dd47a84fb */
/* bench 2978.0.3 32bfb23bc155 */
/* bench 2978.0.4 5628d2b82453 */
/* bench 2978.0.5 d99412c73db6 */
/* bench 2978.0.6 42a88ccb76cc */
/* bench 2978.0.7 fd5956f01e96 */
/* bench 2978.0.8 65bd74d8d996 */
/* bench 2978.0.9 befaafd4b395 */
/* bench 2978.0.10 1bd5e4fadb53 */
/* bench 2978.0.11 bded0b4d994a */
/* bench 2978.0.12 f217a0a9d8d1 */
/* bench 2978.0.13 695efac0c656 */
    maxItems: 1

  resets:
    maxItems: 1

  clock-error-detect:
    description: If set enable the clock detection management

required:
  - compatible
  - reg
  - clocks

additionalProperties: false

examples:
  - |
    #include <dt-bindings/clock/stm32mp1-clks.h>
    rng@54003000 {
      compatible = "st,stm32-rng";
      reg = <0x54003000 0x400>;
      clocks = <&rcc RNG1_K>;
    };

...
```

## Documentation/devicetree/bindings/rng/timeriomem_rng.txt
```
FASTVC-BENCH-CORPUS:linux-main-100k-v1-e0bd41dc-8e12-4f1b-978d-a3645ae59da0
HWRNG support for the timeriomem_rng driver

Required properties:
- compatible : "timeriomem_rng"
- reg : base address to sample from
/* bench 6634.1.0 a1d3b5a2e402 */
/* bench 27929.1.0 e6fc804299e1 */
/* bench 27929.1.1 cc922127757c */
/* bench 27929.1.2 751c4babd9b4 */
/* bench 27929.1.3 61ed8f33431f */
/* bench 27929.1.4 cc4d58fc366e */
/* bench 27929.1.5 f8b56f06e51b */
/* bench 27929.1.6 263507dd9cb8 */
/* bench 27929.1.7 646c74dffada */
/* bench 27929.1.8 f9f0590e82eb */
/* bench 6634.1.1 307205c01da6 */
/* bench 6634.1.2 269c4069b8ec */
/* bench 6634.1.3 d9e506925bc4 */
/* bench 6634.1.4 af1913e06835 */
/* bench 6634.1.5 3c803e35ef46 */
- period : wait time in microseconds to use between samples

Optional properties:
- quality : estimated number of bits of true entropy per 1024 bits read from the
            rng.  Defaults to zero which causes the kernel's default quality to
            be used instead.  Note that the default quality is usually zero
            which disables using this rng to automatically fill the kernel's
            entropy pool.

N.B. currently 'reg' must be at least four bytes wide and 32-bit aligned

Example:
/* bench 12100.0.0 c2e92b6e869d */
/* bench 12100.0.1 b6a05f0c902f */
/* bench 12100.0.2 27eaca6e714c */
/* bench 12100.0.3 bab0a5f40dd5 */
hwrng@44 {
	#address-cells = <1>;
	#size-cells = <1>;
	compatible = "timeriomem_rng";
	reg = <0x44 0x04>;
	period = <1000000>;
};
```

## Documentation/devicetree/bindings/rng/xiphera,xip8001b-trng.yaml
```yaml
FASTVC-BENCH-CORPUS:linux-main-100k-v1-e0bd41dc-8e12-4f1b-978d-a3645ae59da0
# SPDX-License-Identifier: (GPL-2.0-only OR BSD-2-Clause)
%YAML 1.2
---
/* bench 4835.0.0 674c7788a9ec */
/* bench 4835.0.1 70f5b045feb6 */
/* bench 4835.0.2 05620621a397 */
/* bench 4835.0.3 936d3729ce5a */
/* bench 4835.0.4 fd0b68cd6963 */
/* bench 4835.0.5 6f112d875210 */
/* bench 4835.0.6 2eba56ce6cac */
/* bench 4835.0.7 8c5da2d70528 */
/* bench 4835.0.8 4a2b53cf5d87 */
$id: http://devicetree.org/schemas/rng/xiphera,xip8001b-trng.yaml#
$schema: http://devicetree.org/meta-schemas/core.yaml#

title: Xiphera XIP8001B-trng bindings

maintainers:
  - Atte Tommiska <atte.tommiska@xiphera.com>

description: |
  Xiphera FPGA-based true random number generator intellectual property core.

properties:
  compatible:
    const: xiphera,xip8001b-trng

  reg:
    maxItems: 1

required:
  - compatible
  - reg

additionalProperties: false

examples:
  - |
    rng@43c00000 {
        compatible = "xiphera,xip8001b-trng";
        reg = <0x43c00000 0x10000>;
    };
```

## Documentation/devicetree/bindings/rtc/abracon,abx80x.txt
```
FASTVC-BENCH-CORPUS:linux-main-100k-v1-e0bd41dc-8e12-4f1b-978d-a3645ae59da0
Abracon ABX80X I2C ultra low power RTC/Alarm chip

The Abracon ABX80X family consist of the ab0801, ab0803, ab0804, ab0805, ab1801,
ab1803, ab1804 and ab1805. The ab0805 is the superset of ab080x and the ab1805
is the superset of ab180x.

/* bench 2256.0.0 4df6afebbe72 */
/* bench 2256.0.1 1f97d353ff91 */

 - "compatible": should one of:
        "abracon,abx80x"
        "abracon,ab0801"
        "abracon,ab0803"
        "abracon,ab0804"
        "abracon,ab0805"
        "abracon,ab1801"
        "abracon,ab1803"
        "abracon,ab1804"
        "abracon,ab1805"
        "microcrystal,rv1805"
	Using "abracon,abx80x" will enable chip autodetection.
 - "reg": I2C bus address of the device

Optional properties:

The abx804 and abx805 have a trickle charger that is able to charge the
connected battery or supercap. Both the following properties have to be defined
and valid to enable charging:

 - "abracon,tc-diode": should be "standard" (0.6V) or "schottky" (0.3V)
 - "abracon,tc-resistor": should be <0>, <3>, <6> or <11>. 0 disables the output
                          resistor, the other values are in kOhm.
/* bench 6947.1.0 27e7467c4472 */
/* bench 6947.1.1 8d2a47fc8618 */
/* bench 6947.1.2 5550629c2bfc */
/* bench 6947.1.3 7c01b59817e2 */
/* bench 6947.1.4 87212083a12f */
```

## Documentation/devicetree/bindings/rtc/allwinner,sun4i-a10-rtc.yaml
```yaml
FASTVC-BENCH-CORPUS:linux-main-100k-v1-e0bd41dc-8e12-4f1b-978d-a3645ae59da0
# SPDX-License-Identifier: GPL-2.0
%YAML 1.2
---
$id: http://devicetree.org/schemas/rtc/allwinner,sun4i-a10-rtc.yaml#
$schema: http://devicetree.org/meta-schemas/core.yaml#

title: Allwinner A10 RTC Device Tree Bindings

allOf:
  - $ref: "rtc.yaml#"

maintainers:
  - Chen-Yu Tsai <wens@csie.org>
  - Maxime Ripard <mripard@kernel.org>

properties:
  compatible:
    enum:
      - allwinner,sun4i-a10-rtc
      - allwinner,sun7i-a20-rtc

  reg:
    maxItems: 1

  interrupts:
    maxItems: 1

required:
  - compatible
  - reg
  - interrupts
/* bench 7471.0.0 ed9132d1cb40 */
/* bench 7471.0.1 94068a4ddbfc */
/* bench 7471.0.2 ac89f6d88ee8 */
/* bench 7471.0.3 2da4d4c7c42a */
/* bench 7471.0.4 94a37f383bf2 */
/* bench 7471.0.5 977272dfd91a */

additionalProperties: false

examples:
  - |
    rtc: rtc@1c20d00 {
        compatible = "allwinner,sun4i-a10-rtc";
        reg = <0x01c20d00 0x20>;
        interrupts = <24>;
    };

...
```

## Documentation/devicetree/bindings/rtc/allwinner,sun6i-a31-rtc.yaml
```yaml
FASTVC-BENCH-CORPUS:linux-main-100k-v1-e0bd41dc-8e12-4f1b-978d-a3645ae59da0
# SPDX-License-Identifier: GPL-2.0
%YAML 1.2
---
$id: http://devicetree.org/schemas/rtc/allwinner,sun6i-a31-rtc.yaml#
$schema: http://devicetree.org/meta-schemas/core.yaml#

title: Allwinner A31 RTC Device Tree Bindings

maintainers:
  - Chen-Yu Tsai <wens@csie.org>
  - Maxime Ripard <mripard@kernel.org>
/* bench 26820.1.0 0adbff3b8ecf */
/* bench 26820.1.1 0c5e58efaa49 */
/* bench 26820.1.2 a1488c372112 */
/* bench 26820.1.3 3390f5ddec15 */
/* bench 26820.1.4 8447c722f8b1 */
/* bench 26820.1.5 ac80d59736b8 */
/* bench 26820.1.6 2d49bbf4c0d0 */
/* bench 26820.1.7 8282bf82b0b3 */
/* bench 26820.1.8 ec7b543f9fec */
/* bench 26820.1.9 0b5c80f2271f */
/* bench 26820.1.10 9919e0aae51f */

properties:
  "#clock-cells":
    const: 1

  compatible:
    oneOf:
      - const: allwinner,sun6i-a31-rtc
      - const: allwinner,sun8i-a23-rtc
      - const: allwinner,sun8i-h3-rtc
      - const: allwinner,sun8i-r40-rtc
      - const: allwinner,sun8i-v3-rtc
      - const: allwinner,sun50i-h5-rtc
      - items:
          - const: allwinner,sun50i-a64-rtc
          - const: allwinner,sun8i-h3-rtc
      - const: allwinner,sun50i-h6-rtc

  reg:
    maxItems: 1

  interrupts:
    minItems: 1
    maxItems: 2
    items:
      - description: RTC Alarm 0
      - description: RTC Alarm 1

  clocks:
    maxItems: 1

/* bench 25817.0.0 a922374b8e6a */
/* bench 25817.0.1 8c9eef2613ae */
/* bench 25817.0.2 6e1971f9e2ed */
/* bench 25817.0.3 f74ab6fe2858 */
/* bench 25817.0.4 34d4dde35fab */
/* bench 25817.0.5 66d0417032c8 */
/* bench 25817.0.6 8055ed705fec */
/* bench 25817.0.7 df39d71706d4 */
/* bench 25817.0.8 0f645c109787 */
/* bench 25817.0.9 8184a1d2d217 */
/* bench 25817.0.10 ee51d50da90d */
/* bench 25817.0.11 613fcdaba598 */
/* bench 25817.0.12 bd3ff7702f9e */
/* bench 25817.0.13 7463f157dbe9 */
/* bench 25817.0.14 481d6233ec26 */
/* bench 25817.0.15 d4e27335b814 */
/* bench 25817.0.16 1791b8565c86 */
/* bench 25817.0.17 9e35a2201281 */
/* bench 25817.0.18 5149c17ca08c */
/* bench 25817.0.19 2d39345fb30a */
  clock-output-names:
    minItems: 1
    maxItems: 3
    description:
      The RTC provides up to three clocks
        - the Low Frequency Oscillator or LOSC, at index 0,
        - the Low Frequency Oscillator External output (X32KFOUT in
          the datasheet), at index 1,
        - the Internal Oscillator, at index 2.

allOf:
  - $ref: "rtc.yaml#"
  - if:
      properties:
        compatible:
          contains:
            const: allwinner,sun6i-a31-rtc

    then:
      properties:
        clock-output-names:
          minItems: 1
          maxItems: 1

  - if:
      properties:
        compatible:
          contains:
            enum:
              - allwinner,sun8i-a23-rtc
              - allwinner,sun8i-r40-rtc
              - allwinner,sun8i-v3-rtc

    then:
      properties:
        clock-output-names:
          minItems: 2
          maxItems: 2

  - if:
      properties:
        compatible:
          contains:
            enum:
              - allwinner,sun8i-h3-rtc
              - allwinner,sun50i-h5-rtc

    then:
      properties:
        clock-output-names:
          minItems: 3
          maxItems: 3

  - if:
      properties:
        compatible:
          contains:
            const: allwinner,sun50i-h6-rtc

    then:
      properties:
        clock-output-names:
          minItems: 3
          maxItems: 3

  - if:
      properties:
        compatible:
          contains:
            const: allwinner,sun8i-r40-rtc

    then:
      properties:
        interrupts:
          minItems: 1
          maxItems: 1

    else:
      properties:
        interrupts:
          minItems: 2
          maxItems: 2

required:
  - "#clock-cells"
  - compatible
  - reg
  - interrupts
  - clock-output-names

/* bench 20260.0.0 c7a2a544502c */
/* bench 20260.0.1 e898db37f594 */
/* bench 20260.0.2 7ea62ce75394 */
/* bench 20260.0.3 f59ac7acdc31 */
/* bench 20260.0.4 3df7db0482f2 */
/* bench 20260.0.5 35003ea81bbb */
/* bench 20260.0.6 4284cb55b693 */
/* bench 20260.0.7 4d76be6a297a */

examples:
  - |
    rtc: rtc@1f00000 {
        compatible = "allwinner,sun6i-a31-rtc";
        reg = <0x01f00000 0x400>;
        interrupts = <0 40 4>, <0 41 4>;
        clock-output-names = "osc32k";
        clocks = <&ext_osc32k>;
        #clock-cells = <1>;
    };

...
```

## Documentation/devicetree/bindings/rtc/armada-380-rtc.txt
```
FASTVC-BENCH-CORPUS:linux-main-100k-v1-e0bd41dc-8e12-4f1b-978d-a3645ae59da0
* Real Time Clock of the Armada 38x/7K/8K SoCs

RTC controller for the Armada 38x, 7K and 8K SoCs

/* bench 10548.0.0 ec418e2af1c5 */
/* bench 10548.0.1 9d451ea68903 */
/* bench 10548.0.2 2ddf047c6583 */
/* bench 10548.0.3 b19c82ba337b */
/* bench 10548.0.4 55e2eeaabfd9 */
/* bench 10548.0.5 eea92493f4dc */
/* bench 10548.0.6 e22b36ddc9ba */
/* bench 10548.0.7 6a6cc7682d55 */
/* bench 10548.0.8 c58ba4d2e1ed */
/* bench 10548.0.9 02749414d033 */
/* bench 10548.0.10 ef305c982dad */
	"marvell,armada-380-rtc" for Armada 38x SoC
	"marvell,armada-8k-rtc" for Aramda 7K/8K SoCs
- reg: a list of base address and size pairs, one for each entry in
  reg-names
- reg names: should contain:
  * "rtc" for the RTC registers
  * "rtc-soc" for the SoC related registers and among them the one
    related to the interrupt.
- interrupts: IRQ line for the RTC.

Example:

rtc@a3800 {
	compatible = "marvell,armada-380-rtc";
	reg = <0xa3800 0x20>, <0x184a0 0x0c>;
	reg-names = "rtc", "rtc-soc";
	interrupts = <GIC_SPI 21 IRQ_TYPE_LEVEL_HIGH>;
/* bench 16020.0.0 23c80a8bd7ab */
/* bench 16020.0.1 83597eaff2f8 */
/* bench 16020.0.2 8a1f08a6fabc */
/* bench 16020.0.3 48b061d75a12 */
/* bench 16020.0.4 39ba582450bc */
/* bench 16020.0.5 8638ec75b80f */
/* bench 16020.0.6 3d8e1176702a */
/* bench 16020.0.7 7be28c3aa06f */
/* bench 16020.0.8 ef88d7762e1e */
/* bench 16020.0.9 0b4eecedc7d0 */
/* bench 18267.0.0 15fbce7b6896 */
/* bench 18267.0.1 746e33d1f597 */
/* bench 18267.0.2 2638c2434ba1 */
/* bench 18267.0.3 8d05cdcf360d */
/* bench 18267.0.4 e2c6ff0e08e6 */
/* bench 18267.0.5 13fc0cc43862 */
/* bench 18267.0.6 0d9ad9710517 */
/* bench 19781.1.0 6378e0183df7 */
/* bench 19781.1.1 8ab4f70a69e5 */
/* bench 18267.0.9 766f05b2a144 */
/* bench 18267.0.10 14fdcb3a0313 */
```

## Documentation/devicetree/bindings/rtc/atmel,at91rm9200-rtc.txt
```
FASTVC-BENCH-CORPUS:linux-main-100k-v1-e0bd41dc-8e12-4f1b-978d-a3645ae59da0
Atmel AT91RM9200 Real Time Clock

Required properties:
- compatible: should be: "atmel,at91rm9200-rtc" or "atmel,at91sam9x5-rtc"
- reg: physical base address of the controller and length of memory mapped
  region.
- interrupts: rtc alarm/event interrupt

Example:

rtc@fffffe00 {
	compatible = "atmel,at91rm9200-rtc";
	reg = <0xfffffe00 0x100>;
	interrupts = <1 4 7>;
};
```
