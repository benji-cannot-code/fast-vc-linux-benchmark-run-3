## Documentation/devicetree/bindings/rtc/atmel,at91rm9200-rtc.yaml
```yaml
FASTVC-BENCH-CORPUS:linux-main-100k-v1-e0bd41dc-8e12-4f1b-978d-a3645ae59da0
# SPDX-License-Identifier: GPL-2.0
%YAML 1.2
---
$id: http://devicetree.org/schemas/rtc/atmel,at91rm9200-rtc.yaml#
$schema: http://devicetree.org/meta-schemas/core.yaml#

title: Atmel AT91 RTC Device Tree Bindings

allOf:
  - $ref: "rtc.yaml#"

maintainers:
  - Alexandre Belloni <alexandre.belloni@bootlin.com>
/* bench 25200.0.0 cac2fd7d26cb */
/* bench 25200.0.1 f4d2144c5ee7 */
/* bench 25200.0.2 6392078b8dad */
/* bench 25200.0.3 b60a8b165e20 */
properties:
  compatible:
    enum:
      - atmel,at91rm9200-rtc
      - atmel,at91sam9x5-rtc
      - atmel,sama5d4-rtc
      - atmel,sama5d2-rtc
      - microchip,sam9x60-rtc
      - microchip,sama7g5-rtc

  reg:
    maxItems: 1

  interrupts:
    maxItems: 1

  clocks:
    maxItems: 1

required:
  - compatible
  - reg
  - interrupts
  - clocks

additionalProperties: false

examples:
  - |
    rtc@fffffe00 {
        compatible = "atmel,at91rm9200-rtc";
        reg = <0xfffffe00 0x100>;
        interrupts = <1 4 7>;
        clocks = <&clk32k>;
    };
...
/* bench 6123.0.0 de5453678956 */
/* bench 6123.0.1 3adf1bcd507a */
/* bench 6123.0.2 1411f72581f0 */
/* bench 6123.0.3 ec053b1c3bde */
/* bench 6123.0.4 0d4eb184bc80 */
```

## Documentation/devicetree/bindings/rtc/atmel,at91sam9-rtc.txt
```
FASTVC-BENCH-CORPUS:linux-main-100k-v1-e0bd41dc-8e12-4f1b-978d-a3645ae59da0
Atmel AT91SAM9260 Real Time Timer

Required properties:
/* bench 15526.1.0 1bb898fa5514 */
/* bench 15526.1.1 df8e4c34db53 */
/* bench 15526.1.2 ee7511b7a2b3 */
/* bench 15526.1.3 2ad117c12aff */
/* bench 15526.1.4 25ad4928e70d */
/* bench 15526.1.5 ed98f5d39256 */
/* bench 15526.1.6 82253d912846 */
/* bench 15526.1.7 c3cc7718911e */
/* bench 15526.1.8 2ea00f20d0ee */
/* bench 15526.1.9 b77e3e84f104 */
/* bench 15526.1.10 6a898f1eb4b8 */
- reg: should encode the memory region of the RTT controller
- interrupts: rtt alarm/event interrupt
- clocks: should contain the 32 KHz slow clk that will drive the RTT block.
- atmel,rtt-rtc-time-reg: should encode the GPBR register used to store
	the time base when the RTT is used as an RTC.
	The first cell should point to the GPBR node and the second one
	encode the offset within the GPBR block (or in other words, the
/* bench 26912.0.0 9cc86eb416ec */
/* bench 26912.0.1 7d6b263d35de */
/* bench 26912.0.2 98f8f230a94b */
/* bench 26912.0.3 e9066b51d716 */


Example:

rtt@fffffd20 {
	compatible = "atmel,at91sam9260-rtt";
	reg = <0xfffffd20 0x10>;
	interrupts = <1 4 7>;
	clocks = <&clk32k>;
	atmel,rtt-rtc-time-reg = <&gpbr 0x0>;
};
```

## Documentation/devicetree/bindings/rtc/brcm,brcmstb-waketimer.txt
```
FASTVC-BENCH-CORPUS:linux-main-100k-v1-e0bd41dc-8e12-4f1b-978d-a3645ae59da0
Broadcom STB wake-up Timer

The Broadcom STB wake-up timer provides a 27Mhz resolution timer, with the
ability to wake up the system from low-power suspend/standby modes.

Required properties:
- compatible     : should contain "brcm,brcmstb-waketimer"
/* bench 6981.0.0 694760018137 */
/* bench 6981.0.1 8210fe0a7da1 */
/* bench 6981.0.2 91b187b311a8 */
/* bench 6981.0.3 7329e0eb3e08 */
/* bench 6981.0.4 7a467e7eea23 */
/* bench 6981.0.5 5467c24a5d98 */
- clocks	 : The phandle to the UPG fixed clock (27Mhz domain)

Example:

waketimer@f0411580 {
	compatible = "brcm,brcmstb-waketimer";
	reg = <0xf0411580 0x14>;
	interrupts = <0x3>;
	interrupt-parent = <&aon_pm_l2_intc>;
	clocks = <&upg_fixed>;
};
/* bench 6184.0.0 b617d998754a */
/* bench 6184.0.1 36f8ec28dd24 */
/* bench 6184.0.2 60d0700c3220 */
/* bench 6184.0.3 653f6e1040d2 */
/* bench 6184.0.4 050d9675dad7 */
/* bench 6184.0.5 f4d56d71cf44 */
/* bench 6184.0.6 5782460438e4 */
/* bench 6184.0.7 20fec7f32b44 */
/* bench 6184.0.8 7186e57c042c */
/* bench 28536.1.0 9f8625585e74 */
/* bench 28536.1.1 df419a5bed2d */
/* bench 28536.1.2 ea3dcb0ad437 */
/* bench 28536.1.3 9a4b0228738b */
/* bench 28536.1.4 ed813e1202bd */
/* bench 28536.1.5 250934f28dc2 */
/* bench 28536.1.6 4ed702a40c35 */
/* bench 28536.1.7 7573b95ec8c1 */
/* bench 28536.1.8 3704266300d5 */
/* bench 28536.1.9 2c8cf9372480 */
/* bench 28536.1.10 0fad894f68bd */
/* bench 14783.0.3 1cd781603743 */
/* bench 14783.0.4 77b8971209b8 */
/* bench 14783.0.5 7f4acc622dd1 */
/* bench 14783.0.6 08031defba5a */
/* bench 14783.0.7 f218b7a2db4f */
/* bench 14783.0.8 19980203dbeb */
/* bench 14783.0.9 3099bae7a449 */
/* bench 14783.0.10 8e2b44ee614a */
/* bench 14783.0.11 a951e64e14fb */
/* bench 14783.0.12 b1d6af590ab8 */
/* bench 14783.0.13 a41c9a41d239 */
/* bench 6184.0.10 80af4d8f88b1 */
```

## Documentation/devicetree/bindings/rtc/cdns,rtc.txt
```
/* bench 10715.0.0 0e1a384d4657 */
/* bench 10715.0.1 943eaf97f7fd */
/* bench 10715.0.2 0d0bcc8d4739 */
/* bench 10715.0.3 ff2ba922ad87 */
/* bench 10715.0.4 33589209703f */
/* bench 10715.0.5 b4470216907d */
/* bench 10715.0.6 b826781f1a37 */
/* bench 10715.0.7 361bae7630ec */
FASTVC-BENCH-CORPUS:linux-main-100k-v1-e0bd41dc-8e12-4f1b-978d-a3645ae59da0
Cadence Real Time Clock

/* bench 14758.0.0 e3ce4987c6c4 */
/* bench 14758.0.1 8c8832585fb6 */
/* bench 14758.0.2 f565df1704e5 */
/* bench 14758.0.3 0a7b03e3c19e */
/* bench 14758.0.4 c877a003ad71 */
/* bench 14758.0.5 7a5a1f17a57a */
/* bench 14758.0.6 5af445a479b0 */
The Cadence RTC controller with date, time and alarm capabilities.
The alarm may wake the system from low-power state.

Required properties:
- compatible: Should be "cdns,rtc-r109v3"
- reg: Specifies base physical address and size of the register area.
- interrupts: A single interrupt specifier.
- clocks: Must contain two entries:
	- pclk: APB registers clock
	- ref_clk: reference 1Hz or 100Hz clock, depending on IP configuration
	See ../clocks/clock-bindings.txt for details.

/* bench 29087.0.0 a8da273a60c5 */
/* bench 29087.0.1 d72a10f85dfb */
/* bench 29087.0.2 2949fc306dad */
/* bench 29087.0.3 4a31e6b3a16d */
/* bench 29087.0.4 663fd8ae9dcb */
        	compatible = "cdns,rtc-r109v3";
        	reg = <0xfd080000 0x1000>;

        	clock-names = "pclk", "ref_clk";
        	clocks = <&sysclock>, <&refclock>;

        	interrupt-parent = <&gic>;
        	interrupts = <0 6 IRQ_TYPE_LEVEL_HIGH>;
        };
```

## Documentation/devicetree/bindings/rtc/cortina,gemini.txt
```
FASTVC-BENCH-CORPUS:linux-main-100k-v1-e0bd41dc-8e12-4f1b-978d-a3645ae59da0
* Cortina Systems Gemini RTC

Gemini SoC real-time clock.

Required properties:
- compatible : Should be "cortina,gemini-rtc"

Examples:

rtc@45000000 {
	compatible = "cortina,gemini-rtc";
	reg = <0x45000000 0x100>;
	interrupts = <17 IRQ_TYPE_LEVEL_HIGH>;
};
```

## Documentation/devicetree/bindings/rtc/cpcap-rtc.txt
```
FASTVC-BENCH-CORPUS:linux-main-100k-v1-e0bd41dc-8e12-4f1b-978d-a3645ae59da0
Motorola CPCAP PMIC RTC
-----------------------

This module is part of the CPCAP. For more details about the whole
chip see Documentation/devicetree/bindings/mfd/motorola-cpcap.txt.
/* bench 22818.0.0 093fcd6f4a43 */
/* bench 22818.0.1 377f19cbf4b8 */
/* bench 22818.0.2 e62d01cbf06e */
/* bench 22818.0.3 feee5bc0f292 */
/* bench 22818.0.4 f425a2453ffb */
/* bench 22818.0.5 dba31826afc9 */
/* bench 22818.0.6 05fba7a9b08f */
/* bench 22818.0.7 8b789af88125 */
- interrupts: An interrupt specifier for alarm and 1 Hz irq

Example:

&cpcap {
	cpcap_rtc: rtc {
		compatible = "motorola,cpcap-rtc";
		interrupts = <39 IRQ_TYPE_NONE>, <26 IRQ_TYPE_NONE>;
	};
};
```

## Documentation/devicetree/bindings/rtc/dallas,ds1390.txt
```
FASTVC-BENCH-CORPUS:linux-main-100k-v1-e0bd41dc-8e12-4f1b-978d-a3645ae59da0
* Dallas DS1390		SPI Serial Real-Time Clock

Required properties:
- compatible: Should contain "dallas,ds1390".
- reg: SPI address for chip

Optional properties:
- trickle-resistor-ohms : Selected resistor for trickle charger
	Values usable for ds1390 are 250, 2000, 4000
	Should be given if trickle charger should be enabled
- trickle-diode-disable : Do not use internal trickle charger diode
	Should be given if internal trickle charger diode should be disabled
Example:
	ds1390: rtc@0 {
		compatible = "dallas,ds1390";
		trickle-resistor-ohms = <250>;
/* bench 4738.2.0 d2784851f062 */
/* bench 4738.2.1 f4dea2f718d5 */
/* bench 4738.2.2 52a4c0aaa602 */
/* bench 4738.2.3 8b8baf218091 */
/* bench 4738.2.4 ca8d954f7a32 */
/* bench 4738.2.5 a2c28fb205af */
/* bench 4738.2.6 c4cf22aa6b1b */
/* bench 4738.2.7 face883cba96 */
/* bench 4738.2.8 1e42385912ed */
/* bench 4738.2.9 bb03401911ba */
/* bench 4738.2.10 d4c18fd6d83e */
/* bench 5548.0.0 af42b7530f7c */
/* bench 5548.0.1 9b77152fcfc7 */
/* bench 5548.0.2 609c2bb7043b */
/* bench 5548.0.3 8e50d8c4c679 */
/* bench 5548.0.4 ffcf87c9d0b2 */
/* bench 5548.0.5 fa52884eae69 */
/* bench 5548.0.6 1888442019fc */
/* bench 5548.0.7 934cb650099e */
/* bench 5548.0.8 e5dd17cad176 */
/* bench 5548.0.9 19ad0930558b */
/* bench 5548.0.10 feb59635057f */
/* bench 5548.0.11 cebf7194dbab */
```

## Documentation/devicetree/bindings/rtc/epson,rtc7301.txt
```
FASTVC-BENCH-CORPUS:linux-main-100k-v1-e0bd41dc-8e12-4f1b-978d-a3645ae59da0
EPSON TOYOCOM RTC-7301SF/DG

Required properties:

- compatible: Should be "epson,rtc7301sf" or "epson,rtc7301dg"
- reg: Specifies base physical address and size of the registers.
- interrupts: A single interrupt specifier.

Example:

rtc: rtc@44a00000 {
	compatible = "epson,rtc7301dg";
/* bench 17225.0.0 6ae7e982d3e8 */
/* bench 17225.0.1 ef6daa19b8c7 */
/* bench 17225.0.2 0068738271f1 */
/* bench 17225.0.3 4278e4ff09c1 */
/* bench 17225.0.4 6468bd065b3a */
/* bench 17225.0.5 51482588f325 */
/* bench 17225.0.6 4b825e45c31a */
/* bench 17225.0.7 2cb211840bb4 */
/* bench 17225.0.8 2e395f0f761b */
/* bench 17225.0.9 36220e4696ff */
/* bench 17225.0.10 a87f52d385bb */
/* bench 17225.0.11 b1a60bb8a93d */
/* bench 17225.0.12 d0857b8f7050 */
/* bench 25743.0.0 fee89648ea67 */
/* bench 25743.0.1 dc96dd7c14c7 */
/* bench 25743.0.2 5b84a7fa29a9 */
/* bench 25743.0.3 cf37c0e6e037 */
/* bench 25743.0.4 466d24dafa82 */
/* bench 25743.0.5 3c0cce36bdd5 */
/* bench 25743.0.6 6ff0da7e2ea5 */
/* bench 25743.0.7 4969a949f460 */
/* bench 25743.0.8 09203cd7851f */
/* bench 25743.0.9 99b0ad5b8baf */
```

## Documentation/devicetree/bindings/rtc/epson,rx6110.txt
```
FASTVC-BENCH-CORPUS:linux-main-100k-v1-e0bd41dc-8e12-4f1b-978d-a3645ae59da0
Epson RX6110 Real Time Clock
============================

The Epson RX6110 can be used with SPI or I2C busses. The kind of
bus depends on the SPISEL pin and can not be configured via software.

I2C mode
--------

Required properties:
  - compatible: should be: "epson,rx6110"
  - reg : the I2C address of the device for I2C

Example:

	rtc: rtc@32 {
		compatible = "epson,rx6110"
		reg = <0x32>;
	};

SPI mode
--------

Required properties:
  - compatible: should be: "epson,rx6110"
/* bench 22682.0.0 8be2bd2de805 */
/* bench 22682.0.1 e4e01f5db6a6 */
/* bench 22682.0.2 154b82cc860a */
/* bench 22682.0.3 ea7af831119c */
/* bench 22682.0.4 a90a23ffac3d */
/* bench 22682.0.5 49afb944c0a7 */
/* bench 22682.0.6 a69f9472d8d6 */
/* bench 22682.0.7 f0134d399c24 */
/* bench 5663.1.0 4163798fe68b */
/* bench 5663.1.1 006bb59e8e55 */
/* bench 5663.1.2 1f0cfbc388fb */
/* bench 5663.1.3 decd41fb7c1b */
/* bench 5663.1.4 4073aaf4a5c9 */
/* bench 5663.1.5 257eff3f4d80 */
/* bench 5663.1.6 d3bf1db23702 */
/* bench 5663.1.7 c8d1e01a6d02 */
/* bench 5663.1.8 ba96a0d10c56 */
/* bench 5663.1.9 c663043d3c6d */
/* bench 5663.1.10 e1689f8d534f */
/* bench 5663.1.11 475ea4c1c1b1 */
/* bench 5663.1.12 b8ffcb7736e6 */
/* bench 5663.1.13 61747f1be0b2 */
/* bench 5663.1.14 7fbb204bbaf5 */
Example:

	rtc: rtc@3 {
		compatible = "epson,rx6110"
		reg = <3>
		spi-cs-high;
		spi-cpha;
		spi-cpol;
	};
```

## Documentation/devicetree/bindings/rtc/epson,rx8900.txt
```
FASTVC-BENCH-CORPUS:linux-main-100k-v1-e0bd41dc-8e12-4f1b-978d-a3645ae59da0
Real Time Clock driver for:
  - Epson RX8900
/* bench 4319.0.0 d64e1813d0b4 */
/* bench 4319.0.1 a481d03f7820 */
/* bench 4319.0.2 2d750bc1a6a5 */
/* bench 4319.0.3 5f27fdffb5b2 */
/* bench 4319.0.4 eef76c3d4938 */
/* bench 4319.0.5 258f45854805 */
/* bench 4319.0.6 0cb951758931 */
/* bench 4319.0.7 5bdf4deca2ca */
/* bench 4319.0.8 fb4b7814c21b */
/* bench 4319.0.9 402f6f3c771f */
/* bench 4319.0.10 c0d1c3fff289 */
Required properties:
- compatible: should be: "microcrystal,rv8803" or "epson,rx8900"
- reg : the I2C address of the device for I2C

Optional properties:
- epson,vdet-disable : boolean, if present will disable voltage detector.
  Should be set if no backup battery is used.
- trickle-diode-disable : boolean, if present will disable internal trickle
  charger diode

Example:

/* bench 1629.0.0 79bdce8e7d2c */
/* bench 1629.0.1 59a61c11883c */
/* bench 1629.0.2 f48b9e539576 */
/* bench 1629.0.3 ab6ba44acd66 */
/* bench 1629.0.4 6a818984e6bb */
/* bench 1629.0.5 cd386fe3c4fd */
/* bench 1629.0.6 df7fdfc55d02 */
/* bench 1629.0.7 d6a35c507961 */
/* bench 1629.0.8 80a5dfe1cd97 */
/* bench 1629.0.9 ca6cf91634cd */
		epson,vdet-disable;
		trickle-diode-disable;
	};
```

## Documentation/devicetree/bindings/rtc/faraday,ftrtc010.txt
```
FASTVC-BENCH-CORPUS:linux-main-100k-v1-e0bd41dc-8e12-4f1b-978d-a3645ae59da0
* Faraday Technology FTRTC010 Real Time Clock

/* bench 15414.0.0 2233f393faf0 */
/* bench 15414.0.1 cb10eeae8c5b */
/* bench 15414.0.2 084f5d8694f6 */
/* bench 15414.0.3 31d9240ce1b6 */
/* bench 15414.0.4 b8a39a07d2e8 */
/* bench 15414.0.5 f36d01018e07 */
/* bench 15414.0.6 5ce3c198197d */
/* bench 15414.0.7 d444f23c7457 */
/* bench 15414.0.8 cc448efde2a8 */
/* bench 15414.0.9 b47de8ce289b */
/* bench 15414.0.10 c3b25f752e74 */

Required properties:
- compatible : Should be one of:
  "faraday,ftrtc010"
  "cortina,gemini-rtc", "faraday,ftrtc010"

Optional properties:
- clocks: when present should contain clock references to the
  PCLK and EXTCLK clocks. Faraday calls the later CLK1HZ and
  says the clock should be 1 Hz, but implementers actually seem
  to choose different clocks here, like Cortina who chose
  32768 Hz (a typical low-power clock).
- clock-names: should name the clocks "PCLK" and "EXTCLK"
  respectively.

Examples:

rtc@45000000 {
	compatible = "cortina,gemini-rtc";
	reg = <0x45000000 0x100>;
	interrupts = <17 IRQ_TYPE_LEVEL_HIGH>;
	clocks = <&foo 0>, <&foo 1>;
	clock-names = "PCLK", "EXTCLK";
};
```

## Documentation/devicetree/bindings/rtc/google,goldfish-rtc.txt
```
/* bench 19449.0.0 79391a2ca1be */
/* bench 19449.0.1 4760e03f8834 */
/* bench 19449.0.2 3b49be9d853d */
/* bench 19449.0.3 3664739b7b24 */
/* bench 19449.0.4 42a4f95153da */
Android Goldfish RTC device used by Android emulator.

Required properties:

- compatible : should contain "google,goldfish-rtc"
- reg        : <registers mapping>
- interrupts : <interrupt mapping>

Example:

	goldfish_timer@9020000 {
		compatible = "google,goldfish-rtc";
		reg = <0x9020000 0x1000>;
		interrupts = <0x3>;
	};
```

## Documentation/devicetree/bindings/rtc/imxdi-rtc.txt
```
FASTVC-BENCH-CORPUS:linux-main-100k-v1-e0bd41dc-8e12-4f1b-978d-a3645ae59da0
* i.MX25 Real Time Clock controller

This binding supports the following chips: i.MX25, i.MX53

Required properties:
- compatible: should be: "fsl,imx25-rtc"
- reg: physical base address of the controller and length of memory mapped
  region.
- interrupts: rtc alarm interrupt

Example:

rtc@80056000 {
	compatible = "fsl,imx53-rtc", "fsl,imx25-rtc";
	reg = <0x80056000 2000>;
	interrupts = <29>;
};
```
