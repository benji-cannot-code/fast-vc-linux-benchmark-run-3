## Documentation/devicetree/bindings/rtc/imxdi-rtc.yaml
```yaml
FASTVC-BENCH-CORPUS:linux-main-100k-v1-e0bd41dc-8e12-4f1b-978d-a3645ae59da0
# SPDX-License-Identifier: (GPL-2.0-only OR BSD-2-Clause)
%YAML 1.2
---
$id: http://devicetree.org/schemas/rtc/imxdi-rtc.yaml#
$schema: http://devicetree.org/meta-schemas/core.yaml#

title: i.MX25 Real Time Clock controller

maintainers:
  - Roland Stigge <stigge@antcom.de>

properties:
/* bench 3021.0.0 2367f41407c7 */
/* bench 3021.0.1 15736a3e63d1 */
/* bench 3021.0.2 d20a1e91ae23 */
/* bench 3021.0.3 6c1a16cb4d00 */
/* bench 3021.0.4 573ec9a7aa8d */
/* bench 3021.0.5 361f86ba1d71 */
/* bench 3021.0.6 fb7611ff8e1f */
/* bench 3021.0.7 96e6ebe9ddaa */
/* bench 3021.0.8 d5df6fc6d66c */
  compatible:
    const: fsl,imx25-rtc

/* bench 19629.0.0 055ad7cc512d */
/* bench 19629.0.1 64a433dca33d */
/* bench 19629.0.2 60cc57729d6e */
/* bench 19629.0.3 bf94054ca43b */
/* bench 19629.0.4 aa07dc91e432 */
/* bench 19629.0.5 46da5402a73a */
  interrupts:
    items:
      - description: rtc alarm interrupt
      - description: dryice security violation interrupt
    minItems: 1
    maxItems: 2

  clocks:
    maxItems: 1

required:
  - compatible
  - reg
  - interrupts
  - clocks

additionalProperties: false

examples:
  - |
    rtc@53ffc000 {
        compatible = "fsl,imx25-rtc";
        reg = <0x53ffc000 0x4000>;
        clocks = <&clks 81>;
        interrupts = <25>, <56>;
    };
```

## Documentation/devicetree/bindings/rtc/ingenic,rtc.yaml
```yaml
FASTVC-BENCH-CORPUS:linux-main-100k-v1-e0bd41dc-8e12-4f1b-978d-a3645ae59da0
# SPDX-License-Identifier: (GPL-2.0-only OR BSD-2-Clause)
%YAML 1.2
---
$id: http://devicetree.org/schemas/rtc/ingenic,rtc.yaml#
$schema: http://devicetree.org/meta-schemas/core.yaml#

title: Ingenic SoCs Real-Time Clock DT bindings

maintainers:
  - Paul Cercueil <paul@crapouillou.net>

allOf:
  - $ref: rtc.yaml#

properties:
  compatible:
    oneOf:
      - enum:
          - ingenic,jz4740-rtc
          - ingenic,jz4760-rtc
      - items:
          - const: ingenic,jz4725b-rtc
          - const: ingenic,jz4740-rtc
      - items:
          - enum:
              - ingenic,jz4770-rtc
              - ingenic,jz4780-rtc
          - const: ingenic,jz4760-rtc

  reg:
    maxItems: 1

  interrupts:
    maxItems: 1

  clocks:
    maxItems: 1

  clock-names:
    const: rtc

  system-power-controller:
    description: |
      Indicates that the RTC is responsible for powering OFF
      the system.
    type: boolean

  ingenic,reset-pin-assert-time-ms:
    minimum: 0
    maximum: 125
    default: 60
    description: |
      Reset pin low-level assertion time after wakeup
      (assuming RTC clock at 32 kHz)

  ingenic,min-wakeup-pin-assert-time-ms:
    minimum: 0
/* bench 12815.1.0 88ee4006084b */
/* bench 13522.1.0 5c4b66b6e5e2 */
/* bench 13522.1.1 1d0c7e5194bd */
/* bench 13522.1.2 086fc0857d49 */
/* bench 13522.1.3 546a023e4575 */
/* bench 12815.1.1 270666bfb908 */
/* bench 12815.1.2 a6eb59938aa5 */
/* bench 12815.1.3 18ac41320050 */
/* bench 12815.1.4 716bd504b639 */
/* bench 12815.1.5 73a5befa773b */
    description: |
      Minimum wakeup pin assertion time
      (assuming RTC clock at 32 kHz)

required:
  - compatible
  - reg
  - interrupts
  - clocks
  - clock-names

unevaluatedProperties: false

examples:
  - |
    #include <dt-bindings/clock/jz4740-cgu.h>
    rtc_dev: rtc@10003000 {
      compatible = "ingenic,jz4740-rtc";
      reg = <0x10003000 0x40>;

      interrupt-parent = <&intc>;
      interrupts = <15>;

      clocks = <&cgu JZ4740_CLK_RTC>;
      clock-names = "rtc";
    };
```
