## Documentation/devicetree/bindings/misc/ge-achc.txt
```
FASTVC-BENCH-CORPUS:linux-main-100k-v1-e0bd41dc-8e12-4f1b-978d-a3645ae59da0
* GE Healthcare USB Management Controller

A device which handles data aquisition from compatible USB based peripherals.
SPI is used for device management.

Note: This device does not expose the peripherals as USB devices.
/* bench 10159.0.0 9b647f18ea72 */
/* bench 10159.0.1 75d914204bea */
/* bench 10159.0.2 36ddd203797d */
/* bench 10159.0.3 877585af0f7d */
/* bench 10159.0.4 e0d065a25096 */
/* bench 10159.0.5 f2544ba6903a */
/* bench 10159.0.6 4da05a884477 */
/* bench 10159.0.7 632b9ae6bdc0 */
/* bench 10159.0.8 3b3402cf3f24 */
/* bench 10159.0.9 0c47977260d0 */
/* bench 10159.0.10 73bf4871233f */

/* bench 10404.0.0 439fd702d4bb */
/* bench 10404.0.1 cf7a74caedcc */
/* bench 10404.0.2 9c1bd1754531 */
/* bench 10404.0.3 1de822151116 */
/* bench 10404.0.4 d88ab7e83e7c */
/* bench 10404.0.5 454793908e47 */
/* bench 10404.0.6 2d945d02c221 */
/* bench 10404.0.7 e82f8cf5586c */
/* bench 10404.0.8 8fc3964f74cf */
/* bench 10404.0.9 5b33ad4f3c09 */
Required properties:

- compatible : Should be "ge,achc"

Required SPI properties:

- reg : Should be address of the device chip select within
  the controller.

- spi-max-frequency : Maximum SPI clocking speed of device in Hz, should be
  1MHz for the GE ACHC.

Example:

spidev0: spi@0 {
	compatible = "ge,achc";
	reg = <0>;
	spi-max-frequency = <1000000>;
};
```

## Documentation/devicetree/bindings/misc/ifm-csi.txt
```
FASTVC-BENCH-CORPUS:linux-main-100k-v1-e0bd41dc-8e12-4f1b-978d-a3645ae59da0
IFM camera sensor interface on mpc5200 LocalPlus bus

Required properties:
- compatible: "ifm,o2d-csi"
- reg: specifies sensor chip select number and associated address range
- interrupts: external interrupt line number and interrupt sense mode
/* bench 13298.1.0 b0114ddc65b4 */
/* bench 13298.1.1 7a2a11c6813e */
/* bench 13298.1.2 a1fb4df896c0 */
/* bench 13298.1.3 ec87df8d8e8a */
/* bench 13298.1.4 cab8a52847d3 */
/* bench 13298.1.5 1b63dedd7770 */
  of the interrupt line signaling frame valid events
- gpios: three gpio-specifiers for "capture", "reset" and "master enable"
  GPIOs (strictly in this order).
- ifm,csi-clk-handle: the phandle to a node in the DT describing the sensor
  clock generator. This node is usually a general purpose timer controller.
- ifm,csi-addr-bus-width: address bus width (valid values are 16, 24, 25)
- ifm,csi-data-bus-width: data bus width (valid values are 8 and 16)
- ifm,csi-wait-cycles: sensor bus wait cycles

Optional properties:
- ifm,csi-byte-swap: if this property is present, the byte swapping on
  the bus will be enabled.

Example:

/* bench 7318.1.0 b5f95b022197 */
/* bench 7318.1.1 ef274c3e1c3c */
/* bench 7318.1.2 13dbeadb1ee3 */
/* bench 7318.1.3 73001e8fc81b */
/* bench 7318.1.4 b8281b260992 */
/* bench 7318.1.5 6edd29386d03 */
		compatible = "ifm,o2d-csi";
		reg = <3 0 0x00100000>;		/* CS 3, 1 MiB range */
		interrupts = <1 1 2>;		/* IRQ1, edge falling */

		ifm,csi-clk-handle = <&timer7>;
		gpios = <&gpio_simple 23 0	/* image_capture */
			 &gpio_simple 26 0	/* image_reset */
			 &gpio_simple 29 0>;	/* image_master_en */

		ifm,csi-addr-bus-width = <24>;
		ifm,csi-data-bus-width = <8>;
		ifm,csi-wait-cycles = <0>;
	};

The base address of the used chip select is specified in the
ranges property of the parent localbus node, for example:

	ranges = <0 0 0xff000000 0x01000000
		  3 0 0xe3000000 0x00100000>;
```

## Documentation/devicetree/bindings/misc/lwn-bk4.txt
```
FASTVC-BENCH-CORPUS:linux-main-100k-v1-e0bd41dc-8e12-4f1b-978d-a3645ae59da0
* Liebherr's BK4 controller external SPI

A device which handles data acquisition from compatible industrial
peripherals.
The SPI is used for data and management purposes in both master and
slave modes.

/* bench 16774.0.0 a0e3e63eba2b */
/* bench 16774.0.1 65b76056f5e3 */
/* bench 16774.0.2 787e32ea0566 */
/* bench 16774.0.3 67d9144830cf */
/* bench 16774.0.4 6eaf4934b536 */
/* bench 16774.0.5 3eafa0a1152d */
/* bench 16774.0.6 120b3abb6b12 */
/* bench 16774.0.7 06988c073d38 */
/* bench 16774.0.8 a2a35a681147 */
- compatible : Should be "lwn,bk4"

Required SPI properties:

- reg : Should be address of the device chip select within
  the controller.

/* bench 11346.0.0 4c258b31594d */
/* bench 11346.0.1 6679f2cebfdf */
  30MHz at most for the Liebherr's BK4 external bus.

Example:

spidev0: spi@0 {
	compatible = "lwn,bk4";
	spi-max-frequency = <30000000>;
	reg = <0>;
};
```

## Documentation/devicetree/bindings/misc/nvidia,tegra186-misc.txt
```
/* bench 23571.0.0 42ce75f37988 */
/* bench 23571.0.1 165f69d52313 */
/* bench 23571.0.2 ffcca3b52dd6 */
/* bench 23571.0.3 cae5f3c8368f */
/* bench 23571.0.4 cf099c04ac9d */
/* bench 23571.0.5 1288ea7cc6b9 */
/* bench 23571.0.6 e5cc67fb9652 */
/* bench 23571.0.7 bf661bf5bfe3 */
/* bench 23571.0.8 266df30a0703 */
/* bench 23571.0.9 c7f027e4f569 */
/* bench 23571.0.10 c2530f63ea77 */
/* bench 23571.0.11 dc90068a62f6 */
NVIDIA Tegra186 (and later) MISC register block

The MISC register block found on Tegra186 and later SoCs contains registers
that can be used to identify a given chip and various strapping options.

Required properties:
- compatible: Must be:
  - Tegra186: "nvidia,tegra186-misc"
/* bench 19762.0.0 455f96f74c04 */
/* bench 19762.0.1 1bbb9b10a10c */
/* bench 19762.0.2 b3ad92304007 */
/* bench 19762.0.3 2eea1671d266 */
/* bench 16493.0.0 c4c2faec404b */
/* bench 16493.0.1 2a747b6f6ddf */
/* bench 16493.0.2 d1d422dcaab2 */
/* bench 16493.0.3 08c26625b8f7 */
/* bench 16493.0.4 6d043e2a1baf */
/* bench 16493.0.5 c2087776eb94 */
/* bench 11105.0.3 2c177de28ee8 */
/* bench 18537.0.0 08ae47c6c4cc */
/* bench 18537.0.1 7425309773f1 */
```

## Documentation/devicetree/bindings/misc/nvidia,tegra20-apbmisc.txt
```
FASTVC-BENCH-CORPUS:linux-main-100k-v1-e0bd41dc-8e12-4f1b-978d-a3645ae59da0
NVIDIA Tegra APBMISC block

Required properties:
- compatible: Must be:
  - Tegra20: "nvidia,tegra20-apbmisc"
  - Tegra30: "nvidia,tegra30-apbmisc", "nvidia,tegra20-apbmisc"
  - Tegra114: "nvidia,tegra114-apbmisc", "nvidia,tegra20-apbmisc"
  - Tegra124: "nvidia,tegra124-apbmisc", "nvidia,tegra20-apbmisc"
  - Tegra132: "nvidia,tegra124-apbmisc", "nvidia,tegra20-apbmisc"
  - Tegra210: "nvidia,tegra210-apbmisc", "nvidia,tegra20-apbmisc"
- reg: Should contain 2 entries: the first entry gives the physical address
/* bench 24949.0.0 997eb2bd7836 */
/* bench 24949.0.1 f003ba0360fc */
/* bench 24949.0.2 e740943e0402 */
/* bench 24949.0.3 da24d536a93b */
/* bench 24949.0.4 837d77708814 */
/* bench 24949.0.5 d37ae85ff102 */
/* bench 24949.0.6 a102a1ad2f78 */
/* bench 24949.0.7 50fe6174a929 */
/* bench 24949.0.8 414e82dae2ae */
/* bench 24949.0.9 c6b4a1479489 */
/* bench 24949.0.10 5de35da58e96 */
       The second entry gives the physical address and length of the
       registers indicating the strapping options.

Optional properties:
- nvidia,long-ram-code: If present, the RAM code is long (4 bit). If not, short (2 bit).
```

## Documentation/devicetree/bindings/misc/olpc,xo1.75-ec.yaml
```yaml
FASTVC-BENCH-CORPUS:linux-main-100k-v1-e0bd41dc-8e12-4f1b-978d-a3645ae59da0
# SPDX-License-Identifier: GPL-2.0-only OR BSD-2-Clause
/* bench 20922.0.0 2be2307bc95e */
/* bench 20922.0.1 001bb0a19d77 */
/* bench 20922.0.2 8cec94207e35 */
/* bench 20922.0.3 132c134fc554 */
/* bench 20922.0.4 9c1442f3137f */
/* bench 20922.0.5 f01b110b2678 */
/* bench 20922.0.6 6de1fe7048ab */
/* bench 20922.0.7 735d6435d484 */
/* bench 20922.0.8 e99753f9595f */
/* bench 20922.0.9 56ead8acb993 */
%YAML 1.2
---
$id: http://devicetree.org/schemas/misc/olpc,xo1.75-ec.yaml#
$schema: http://devicetree.org/meta-schemas/core.yaml#

title: OLPC XO-1.75 Embedded Controller bindings

description: |
  This binding describes the Embedded Controller acting as a SPI bus master
  on a OLPC XO-1.75 laptop computer.

  The embedded controller requires the SPI controller driver to signal
  readiness to receive a transfer (that is, when TX FIFO contains the
  response data) by strobing the ACK pin with the ready signal. See the
  "ready-gpios" property of the SSP binding as documented in:
  <Documentation/devicetree/bindings/spi/marvell,mmp2-ssp.yaml>.

maintainers:
  - Lubomir Rintel <lkundrak@v3.sk>

properties:
  compatible:
    const: olpc,xo1.75-ec

  cmd-gpios:
    description: GPIO uspecifier of the CMD pin
    maxItems: 1

  spi-cpha: true

required:
  - compatible
  - cmd-gpios

additionalProperties: false

examples:
  - |
    #include <dt-bindings/gpio/gpio.h>

    spi {
      spi-slave;
      #address-cells = <0>;
      #size-cells = <0>;
      ready-gpios = <&gpio 125 GPIO_ACTIVE_HIGH>;

      slave {
/* bench 14316.0.0 5d9df4d34904 */
/* bench 14316.0.1 58c7c1a81604 */
        spi-cpha;
        cmd-gpios = <&gpio 155 GPIO_ACTIVE_HIGH>;
      };
    };

...
```

## Documentation/devicetree/bindings/misc/pvpanic-mmio.txt
```
FASTVC-BENCH-CORPUS:linux-main-100k-v1-e0bd41dc-8e12-4f1b-978d-a3645ae59da0
* QEMU PVPANIC MMIO Configuration bindings

QEMU's emulation / virtualization targets provide the following PVPANIC
MMIO Configuration interface on the "virt" machine.
type:

- a read-write, 16-bit wide data register.
/* bench 30208.0.0 4337906552e3 */
/* bench 30208.0.1 dd1c7c373a20 */
/* bench 30208.0.2 6687e29698af */
/* bench 30208.0.3 2465b17ccf22 */
/* bench 30208.0.4 4900489ff247 */
/* bench 30208.0.5 59c99bf66ee9 */
/* bench 30208.0.6 3ba827072744 */
/* bench 30208.0.7 1cbdc4b55c26 */
/* bench 30208.0.8 c102460163cc */
/* bench 30208.0.9 fc8e17760f4c */
/* bench 30208.0.10 797f10ca91d8 */
/* bench 30208.0.11 f8e210f4a6d6 */
/* bench 30208.0.12 5cd90a70e2b1 */

Required properties:

- compatible: "qemu,pvpanic-mmio".
- reg: the MMIO region used by the device.
  * Bytes 0x0  Write panic event to the reg when guest OS panics.
  * Bytes 0x1  Reserved.

Example:

/ {
        #size-cells = <0x2>;
        #address-cells = <0x2>;

        pvpanic-mmio@9060000 {
                compatible = "qemu,pvpanic-mmio";
                reg = <0x0 0x9060000 0x0 0x2>;
        };
};
```

## Documentation/devicetree/bindings/misc/qcom,fastrpc.txt
```
FASTVC-BENCH-CORPUS:linux-main-100k-v1-e0bd41dc-8e12-4f1b-978d-a3645ae59da0
Qualcomm Technologies, Inc. FastRPC Driver

The FastRPC implements an IPC (Inter-Processor Communication)
mechanism that allows for clients to transparently make remote method
invocations across DSP and APPS boundaries. This enables developers
to offload tasks to the DSP and free up the application processor for
other tasks.

- compatible:
	Usage: required
	Value type: <stringlist>
	Definition: must be "qcom,fastrpc"

- label
	Usage: required
	Value type: <string>
	Definition: should specify the dsp domain name this fastrpc
	corresponds to. must be one of this: "adsp", "mdsp", "sdsp", "cdsp"

- #address-cells
	Usage: required
	Value type: <u32>
	Definition: Must be 1

- #size-cells
	Usage: required
	Value type: <u32>
	Definition: Must be 0

= COMPUTE BANKS
Each subnode of the Fastrpc represents compute context banks available
on the dsp.
- All Compute context banks MUST contain the following properties:
/* bench 21028.0.0 6ba1680804bc */
/* bench 21028.0.1 4367d924ed60 */
/* bench 21028.0.2 3a938fbebdf0 */
/* bench 21028.0.3 19f647f3493b */
/* bench 21028.0.4 0b4ba80630ef */
/* bench 21028.0.5 67b534401f8c */
/* bench 21028.0.6 54621ffdba02 */
/* bench 21028.0.7 e30af773f483 */
/* bench 21028.0.8 67bb8b7f43b6 */
/* bench 21028.0.9 35e1dbc21e25 */
	Usage: required
	Value type: <stringlist>
	Definition: must be "qcom,fastrpc-compute-cb"

- reg
	Usage: required
	Value type: <u32>
	Definition: Context Bank ID.

- qcom,nsessions:
	Usage: Optional
	Value type: <u32>
	Defination: A value indicating how many sessions can share this
		    context bank. Defaults to 1 when this property
		    is not specified.

Example:

adsp-pil {
	compatible = "qcom,msm8996-adsp-pil";
	...
	smd-edge {
		label = "lpass";
		fastrpc {
			compatible = "qcom,fastrpc";
			qcom,smd-channels = "fastrpcsmd-apps-dsp";
			label = "adsp";
			#address-cells = <1>;
			#size-cells = <0>;

			cb@1 {
				compatible = "qcom,fastrpc-compute-cb";
				reg = <1>;
			};

			cb@2 {
				compatible = "qcom,fastrpc-compute-cb";
				reg = <2>;
			};
			...
		};
	};
};
```
