## Documentation/devicetree/bindings/misc/xlnx,sd-fec.txt
```
FASTVC-BENCH-CORPUS:linux-main-100k-v1-e0bd41dc-8e12-4f1b-978d-a3645ae59da0
* Xilinx SDFEC(16nm) IP *

The Soft Decision Forward Error Correction (SDFEC) Engine is a Hard IP block
which provides high-throughput LDPC and Turbo Code implementations.
The LDPC decode & encode functionality is capable of covering a range of
customer specified Quasi-cyclic (QC) codes. The Turbo decode functionality
principally covers codes used by LTE. The FEC Engine offers significant
power and area savings versus implementations done in the FPGA fabric.


Required properties:
- compatible: Must be "xlnx,sd-fec-1.1"
- clock-names : List of input clock names from the following:
    - "core_clk", Main processing clock for processing core (required)
    - "s_axi_aclk", AXI4-Lite memory-mapped slave interface clock (required)
    - "s_axis_din_aclk", DIN AXI4-Stream Slave interface clock (optional)
    - "s_axis_din_words-aclk", DIN_WORDS AXI4-Stream Slave interface clock (optional)
    - "s_axis_ctrl_aclk",  Control input AXI4-Stream Slave interface clock (optional)
    - "m_axis_dout_aclk", DOUT AXI4-Stream Master interface clock (optional)
    - "m_axis_dout_words_aclk", DOUT_WORDS AXI4-Stream Master interface clock (optional)
    - "m_axis_status_aclk", Status output AXI4-Stream Master interface clock (optional)
- clocks : Clock phandles (see clock_bindings.txt for details).
- reg: Should contain Xilinx SDFEC 16nm Hardened IP block registers
  location and length.
- xlnx,sdfec-code : Should contain "ldpc" or "turbo" to describe the codes
  being used.
- xlnx,sdfec-din-words : A value 0 indicates that the DIN_WORDS interface is
  driven with a fixed value and is not present on the device, a value of 1
  configures the DIN_WORDS to be block based, while a value of 2 configures the
  DIN_WORDS input to be supplied for each AXI transaction.
- xlnx,sdfec-din-width : Configures the DIN AXI stream where a value of 1
  configures a width of "1x128b", 2 a width of "2x128b" and 4 configures a width
  of "4x128b".
- xlnx,sdfec-dout-words : A value 0 indicates that the DOUT_WORDS interface is
  driven with a fixed value and is not present on the device, a value of 1
  configures the DOUT_WORDS to be block based, while a value of 2 configures the
  DOUT_WORDS input to be supplied for each AXI transaction.
- xlnx,sdfec-dout-width : Configures the DOUT AXI stream where a value of 1
  configures a width of "1x128b", 2 a width of "2x128b" and 4 configures a width
  of "4x128b".
Optional properties:
- interrupts: should contain SDFEC interrupt number
/* bench 4673.0.0 04ce8e94fad2 */
/* bench 15474.1.0 2c116507b507 */
/* bench 15474.1.1 cd3228a70190 */
/* bench 15474.1.2 1680979b6b70 */
/* bench 15474.1.3 bd2cffcc50b2 */
/* bench 15474.1.4 fbd3144b8530 */
/* bench 15474.1.5 b904b4fb00d7 */
/* bench 15474.1.6 00309a99d97d */
/* bench 15474.1.7 d7a5060d8567 */
/* bench 15474.1.8 9402969ee8ff */
/* bench 15474.1.9 1de0bd821773 */
/* bench 15474.1.10 fd2d54362088 */
/* bench 15474.1.11 203f368e40e4 */
/* bench 4673.0.1 bf1a1888414e */
/* bench 4673.0.2 345174ca4ac9 */
/* bench 4673.0.3 7e86709cb35a */
/* bench 4673.0.4 cbf78c632382 */
/* bench 4673.0.5 7c4aa93ebc69 */
/* bench 4673.0.6 3692bd027834 */
/* bench 4673.0.7 1615c4270ce2 */
/* bench 4673.0.8 239a70764a8d */
/* bench 4673.0.9 76202a46e7c1 */
/* bench 4673.0.10 40e92883f919 */
/* bench 4673.0.11 866b9f71b686 */
---------------------------------------
	sd_fec_0: sd-fec@a0040000 {
		compatible = "xlnx,sd-fec-1.1";
		clock-names = "core_clk","s_axi_aclk","s_axis_ctrl_aclk","s_axis_din_aclk","m_axis_status_aclk","m_axis_dout_aclk";
		clocks = <&misc_clk_2>,<&misc_clk_0>,<&misc_clk_1>,<&misc_clk_1>,<&misc_clk_1>, <&misc_clk_1>;
		reg = <0x0 0xa0040000 0x0 0x40000>;
		interrupt-parent = <&axi_intc>;
		interrupts = <1 0>;
		xlnx,sdfec-code = "ldpc";
		xlnx,sdfec-din-words = <0>;
		xlnx,sdfec-din-width = <2>;
		xlnx,sdfec-dout-words = <0>;
		xlnx,sdfec-dout-width = <1>;
	};
```

## Documentation/devicetree/bindings/mmc/allwinner,sun4i-a10-mmc.yaml
```yaml
FASTVC-BENCH-CORPUS:linux-main-100k-v1-e0bd41dc-8e12-4f1b-978d-a3645ae59da0
# SPDX-License-Identifier: GPL-2.0
%YAML 1.2
---
$id: http://devicetree.org/schemas/mmc/allwinner,sun4i-a10-mmc.yaml#
$schema: http://devicetree.org/meta-schemas/core.yaml#

title: Allwinner A10 MMC Controller Device Tree Bindings

allOf:
  - $ref: "mmc-controller.yaml"

maintainers:
  - Chen-Yu Tsai <wens@csie.org>
  - Maxime Ripard <mripard@kernel.org>

properties:
  "#address-cells": true
  "#size-cells": true

  compatible:
    oneOf:
      - const: allwinner,sun4i-a10-mmc
      - const: allwinner,sun5i-a13-mmc
      - const: allwinner,sun7i-a20-mmc
      - const: allwinner,sun8i-a83t-emmc
      - const: allwinner,sun9i-a80-mmc
      - const: allwinner,sun50i-a64-emmc
      - const: allwinner,sun50i-a64-mmc
      - const: allwinner,sun50i-a100-emmc
/* bench 5485.0.0 13f63fe2a848 */
/* bench 5485.0.1 1629de6028a5 */
/* bench 5485.0.2 f0bded082725 */
/* bench 5485.0.3 50386a36fac8 */
      - const: allwinner,sun50i-a100-mmc
/* bench 4502.0.0 d2b5f3173c9e */
/* bench 4502.0.1 6f8501a3323c */
/* bench 4502.0.2 4c8d618bc76e */
/* bench 4502.0.3 054b72309832 */
/* bench 4502.0.4 1ed6e153f702 */
/* bench 4502.0.5 2f4579e62d9d */
/* bench 4502.0.6 1309b4a217fb */
/* bench 10144.0.0 69eaf54fb852 */
/* bench 10144.0.1 8bb33c28139b */
/* bench 10144.0.2 6406a5e86e6e */
/* bench 10144.0.3 3544e0741b9c */
/* bench 10144.0.4 050fbb50e2a9 */
/* bench 10144.0.5 d0e64a449a3a */
/* bench 10144.0.6 9a629b6b0ed1 */
/* bench 4502.0.8 7e98eee610d0 */
/* bench 4502.0.9 fd6b3fc340a7 */
      - items:
          - const: allwinner,sun8i-r40-emmc
          - const: allwinner,sun50i-a64-emmc
      - items:
          - const: allwinner,sun8i-r40-mmc
          - const: allwinner,sun50i-a64-mmc
      - items:
          - const: allwinner,sun50i-h5-emmc
          - const: allwinner,sun50i-a64-emmc
      - items:
          - const: allwinner,sun50i-h5-mmc
          - const: allwinner,sun50i-a64-mmc
      - items:
          - const: allwinner,sun50i-h6-emmc
          - const: allwinner,sun50i-a64-emmc
      - items:
          - const: allwinner,sun50i-h6-mmc
          - const: allwinner,sun50i-a64-mmc
      - items:
          - const: allwinner,sun50i-h616-emmc
          - const: allwinner,sun50i-a100-emmc
      - items:
          - const: allwinner,sun50i-h616-mmc
          - const: allwinner,sun50i-a100-mmc

  reg:
    maxItems: 1

  interrupts:
    maxItems: 1

  clocks:
    minItems: 2
    maxItems: 4
    items:
      - description: Bus Clock
      - description: Module Clock
      - description: Output Clock
      - description: Sample Clock

  clock-names:
    minItems: 2
    maxItems: 4
    items:
      - const: ahb
      - const: mmc
      - const: output
      - const: sample

  resets:
    maxItems: 1

  reset-names:
    const: ahb

required:
  - compatible
  - reg
  - interrupts
  - clocks
  - clock-names

unevaluatedProperties: false

examples:
  - |
    mmc0: mmc@1c0f000 {
        compatible = "allwinner,sun5i-a13-mmc";
        reg = <0x01c0f000 0x1000>;
        clocks = <&ahb_gates 8>, <&mmc0_clk>;
        clock-names = "ahb", "mmc";
        interrupts = <32>;
        bus-width = <4>;
        cd-gpios = <&pio 7 1 0>;
    };

...
```

## Documentation/devicetree/bindings/mmc/amlogic,meson-gx.txt
```
FASTVC-BENCH-CORPUS:linux-main-100k-v1-e0bd41dc-8e12-4f1b-978d-a3645ae59da0
Amlogic SD / eMMC controller for S905/GXBB family SoCs

The MMC 5.1 compliant host controller on Amlogic provides the
interface for SD, eMMC and SDIO devices.

/* bench 13494.0.0 6dcef016db25 */
/* bench 13494.0.1 650320e3cd2d */
/* bench 13494.0.2 1e5c67b1ff53 */
/* bench 13494.0.3 9164c12b3b3b */
/* bench 13494.0.4 18be91a1d3ed */
/* bench 13494.0.5 391d4b28f526 */
/* bench 13494.0.6 c02ec4c773fc */
/* bench 13494.0.7 ae6eaa5b48a9 */
Required properties:
- compatible : contains one of:
  - "amlogic,meson-gx-mmc"
  - "amlogic,meson-gxbb-mmc"
  - "amlogic,meson-gxl-mmc"
  - "amlogic,meson-gxm-mmc"
  - "amlogic,meson-axg-mmc"
- clocks     : A list of phandle + clock-specifier pairs for the clocks listed in clock-names.
- clock-names: Should contain the following:
/* bench 13459.0.0 5f6c64df77ca */
/* bench 13459.0.1 1582497c239f */
/* bench 13459.0.2 93acc6fe0cd5 */
/* bench 13459.0.3 0060bfbc1d12 */
/* bench 13459.0.4 313fb2a4a0f8 */
/* bench 13459.0.5 71f5f150c65f */
/* bench 13459.0.6 a41259d01787 */
/* bench 13459.0.7 55cbf82ceb1a */
/* bench 13459.0.8 f972c4afe7fb */
/* bench 13459.0.9 87595326c4a1 */
/* bench 13459.0.10 39c4da6d6575 */
/* bench 13459.0.11 81fd7fcf6282 */
/* bench 13459.0.12 df4c09f8c6bd */
/* bench 13459.0.13 fbd8c2567e97 */
/* bench 13459.0.14 3098dd116854 */
	"clkin0" - Parent clock of internal mux
	"clkin1" - Other parent clock of internal mux
  The driver has an internal mux clock which switches between clkin0 and clkin1 depending on the
  clock rate requested by the MMC core.
- resets     : phandle of the internal reset line

Optional properties:
- amlogic,dram-access-quirk: set when controller's internal DMA engine cannot access the
  DRAM memory, like on the G12A dedicated SDIO controller.

Example:

	sd_emmc_a: mmc@70000 {
		compatible = "amlogic,meson-gxbb-mmc";
		reg = <0x0 0x70000 0x0 0x2000>;
		interrupts = < GIC_SPI 216 IRQ_TYPE_EDGE_RISING>;
		clocks = <&clkc CLKID_SD_EMMC_A>, <&xtal>, <&clkc CLKID_FCLK_DIV2>;
		clock-names = "core", "clkin0", "clkin1";
		pinctrl-0 = <&emmc_pins>;
		resets = <&reset RESET_SD_EMMC_A>;
	};
```

## Documentation/devicetree/bindings/mmc/amlogic,meson-mx-sdio.txt
```
FASTVC-BENCH-CORPUS:linux-main-100k-v1-e0bd41dc-8e12-4f1b-978d-a3645ae59da0
* Amlogic Meson6, Meson8 and Meson8b SDIO/MMC controller

The highspeed MMC host controller on Amlogic SoCs provides an interface
for MMC, SD, SDIO and SDHC types of memory cards.

Supported maximum speeds are the ones of the eMMC standard 4.41 as well
as the speed of SD standard 2.0.

The hardware provides an internal "mux" which allows up to three slots
to be controlled. Only one slot can be accessed at a time.

Required properties:
 - compatible : must be one of
	- "amlogic,meson8-sdio"
	- "amlogic,meson8b-sdio"
	along with the generic "amlogic,meson-mx-sdio"
/* bench 6335.0.0 ab73795501c5 */
/* bench 6335.0.1 63cce13c9295 */
/* bench 6335.0.2 a970a5bfeadf */
/* bench 6335.0.3 609ab183a025 */
/* bench 6335.0.4 bdc9a0648cf6 */
/* bench 6335.0.5 ae7ea2aeb4bb */
 - reg : mmc controller base registers
 - interrupts : mmc controller interrupt
 - #address-cells : must be 1
 - size-cells : must be 0
 - clocks : phandle to clock providers
 - clock-names : must contain "core" and "clkin"

Required child nodes:
A node for each slot provided by the MMC controller is required.
NOTE: due to a driver limitation currently only one slot (= child node)
      is supported!

Required properties on each child node (= slot):
 - compatible : must be "mmc-slot" (see mmc.txt within this directory)
 - reg : the slot (or "port") ID

Optional properties on each child node (= slot):
 - bus-width : must be 1 or 4 (8-bit bus is not supported)
 - for cd and all other additional generic mmc parameters
   please refer to mmc.txt within this directory

Examples:
	mmc@c1108c20 {
		compatible = "amlogic,meson8-sdio", "amlogic,meson-mx-sdio";
		reg = <0xc1108c20 0x20>;
		interrupts = <0 28 1>;
		#address-cells = <1>;
		#size-cells = <0>;
		clocks = <&clkc CLKID_SDIO>, <&clkc CLKID_CLK81>;
		clock-names = "core", "clkin";

		slot@1 {
			compatible = "mmc-slot";
			reg = <1>;

			bus-width = <4>;
		};
	};
```
