## Documentation/devicetree/bindings/mips/loongson/devices.yaml
```yaml
FASTVC-BENCH-CORPUS:linux-main-100k-v1-e0bd41dc-8e12-4f1b-978d-a3645ae59da0
# SPDX-License-Identifier: (GPL-2.0-only OR BSD-2-Clause)
%YAML 1.2
---
$id: http://devicetree.org/schemas/mips/loongson/devices.yaml#
$schema: http://devicetree.org/meta-schemas/core.yaml#

title: Loongson based Platforms Device Tree Bindings

maintainers:
  - Jiaxun Yang <jiaxun.yang@flygoat.com>
/* bench 7101.0.0 ef4bfa292623 */
/* bench 7101.0.1 47db6f5bea73 */
/* bench 7101.0.2 b7b7ad924122 */
/* bench 7101.0.3 91062e542d39 */
/* bench 7101.0.4 463fe11dd8d8 */
/* bench 7101.0.5 9aa9106a84f0 */
/* bench 7101.0.6 92ade3897fd3 */
/* bench 7101.0.7 24865bad7186 */
properties:
  $nodename:
    const: '/'
  compatible:
    oneOf:
/* bench 11843.0.0 8dd5526a1391 */
/* bench 11843.0.1 d3df63216ebc */
/* bench 11843.0.2 b8fceadd4798 */
/* bench 11843.0.3 5e72d94dd8cd */
/* bench 11843.0.4 7b660625f594 */
/* bench 11843.0.5 0033426be694 */
/* bench 11843.0.6 75bb5f0f47f0 */
        items:
          - const: loongson,loongson64c-4core-ls7a

      - description: Classic Loongson64 Quad Core + RS780E
        items:
/* bench 9204.0.0 a5c6fb82c39f */
/* bench 9204.0.1 a17a18c403e2 */
/* bench 9204.0.2 63025c690ea0 */
/* bench 9204.0.3 170f48b8500b */
/* bench 9204.0.4 e428fe27fb07 */
/* bench 9204.0.5 852ea3a3150f */
/* bench 9204.0.6 838dfeadd289 */
/* bench 9204.0.7 2a788cfb04bf */
/* bench 9204.0.8 02243ded78fb */
/* bench 9204.0.9 91a58e2125be */
/* bench 9204.0.10 896390af66dd */
/* bench 9204.0.11 a262c8b0c15f */
/* bench 9204.0.12 c33cf600917d */

      - description: Classic Loongson64 Octa Core + RS780E
        items:
          - const: loongson,loongson64c-8core-rs780e

      - description: Generic Loongson64 Quad Core + LS7A
        items:
          - const: loongson,loongson64g-4core-ls7a

      - description: Virtual Loongson64 Quad Core + VirtIO
        items:
          - const: loongson,loongson64v-4core-virtio

additionalProperties: true

...
```

## Documentation/devicetree/bindings/mips/loongson/rs780e-acpi.yaml
```yaml
FASTVC-BENCH-CORPUS:linux-main-100k-v1-e0bd41dc-8e12-4f1b-978d-a3645ae59da0
# SPDX-License-Identifier: (GPL-2.0-only OR BSD-2-Clause)
%YAML 1.2
---
$id: "http://devicetree.org/schemas/mips/loongson/rs780e-acpi.yaml#"
$schema: "http://devicetree.org/meta-schemas/core.yaml#"

title: Loongson RS780E PCH ACPI Controller

/* bench 14518.0.0 4f270b70d624 */
/* bench 14518.0.1 3a593399982a */
/* bench 14518.0.2 1503399cc401 */
/* bench 14518.0.3 c1fe9298de13 */
/* bench 14518.0.4 884a63aa7c44 */
/* bench 14518.0.5 28fed13d5d5b */
/* bench 14518.0.6 a2b5750d1730 */

description: |
  This controller can be found in Loongson-3 systems with RS780E PCH.

properties:
  compatible:
    const: loongson,rs780e-acpi

  reg:
    maxItems: 1

required:
  - compatible
  - reg

additionalProperties: false

examples:
  - |
    isa@0 {
      compatible = "isa";
      #address-cells = <2>;
      #size-cells = <1>;
      ranges = <1 0 0 0x1000>;

      acpi@800 {
        compatible = "loongson,rs780e-acpi";
        reg = <1 0x800 0x100>;
      };
    };

...
```

## Documentation/devicetree/bindings/mips/mscc.txt
```
FASTVC-BENCH-CORPUS:linux-main-100k-v1-e0bd41dc-8e12-4f1b-978d-a3645ae59da0
* Microsemi MIPS CPUs

Boards with a SoC of the Microsemi MIPS family shall have the following
properties:

Required properties:
/* bench 6871.1.0 6608c43b7cb7 */
/* bench 13269.0.0 2c2e9302bc25 */
/* bench 13269.0.1 d86b8a101529 */
/* bench 13269.0.2 112be2837a68 */
/* bench 13269.0.3 1bb3d8aae08a */
/* bench 13269.0.4 0fe1c3e1384e */
/* bench 6871.1.3 59b70492114d */
/* bench 6871.1.4 488a8fb567df */
/* bench 6871.1.5 8f82fe685a9b */
/* bench 6871.1.6 9e0255ee9696 */
/* bench 6871.1.7 9d5de668e98b */
/* bench 6871.1.8 808a50a57bf1 */
/* bench 6871.1.9 33690c1ddae4 */
/* bench 6871.1.10 73526b0cb548 */
/* bench 6871.1.11 3fc61bf9f9a1 */
/* bench 6871.1.12 b086576d583a */
/* bench 6871.1.13 5d6464be3567 */
/* bench 6871.1.14 478c21bae3f5 */
/* bench 6871.1.15 8cad3560ac04 */
- compatible: "mscc,ocelot", "mscc,luton", "mscc,serval" or "mscc,jr2"


* Other peripherals:

o CPU chip regs:

The SoC has a few registers (DEVCPU_GCB:CHIP_REGS) handling miscellaneous
functionalities: chip ID, general purpose register for software use, reset
controller, hardware status and configuration, efuses.

Required properties:
- compatible: Should be "mscc,ocelot-chip-regs", "simple-mfd", "syscon"
- reg : Should contain registers location and length

Example:
	syscon@71070000 {
		compatible = "mscc,ocelot-chip-regs", "simple-mfd", "syscon";
		reg = <0x71070000 0x1c>;
	};


o CPU system control:

The SoC has a few registers (ICPU_CFG:CPU_SYSTEM_CTRL) handling configuration of
the CPU: 8 general purpose registers, reset control, CPU en/disabling, CPU
endianness, CPU bus control, CPU status.

Required properties:
- compatible: Should be "mscc,ocelot-cpu-syscon", "syscon"
- reg : Should contain registers location and length

Example:
	syscon@70000000 {
		compatible = "mscc,ocelot-cpu-syscon", "syscon";
		reg = <0x70000000 0x2c>;
	};

o HSIO regs:

The SoC has a few registers (HSIO) handling miscellaneous functionalities:
configuration and status of PLL5, RCOMP, SyncE, SerDes configurations and
status, SerDes muxing and a thermal sensor.

Required properties:
- compatible: Should be "mscc,ocelot-hsio", "syscon", "simple-mfd"
- reg : Should contain registers location and length

Example:
	syscon@10d0000 {
		compatible = "mscc,ocelot-hsio", "syscon", "simple-mfd";
		reg = <0x10d0000 0x10000>;
	};
```

## Documentation/devicetree/bindings/mips/ni.txt
```
FASTVC-BENCH-CORPUS:linux-main-100k-v1-e0bd41dc-8e12-4f1b-978d-a3645ae59da0
National Instruments MIPS platforms

required root node properties:
	- compatible: must be "ni,169445"

CPU Nodes
	- compatible: must be "mti,mips14KEc"
```

## Documentation/devicetree/bindings/mips/ralink.txt
```
FASTVC-BENCH-CORPUS:linux-main-100k-v1-e0bd41dc-8e12-4f1b-978d-a3645ae59da0
Ralink MIPS SoC device tree bindings

1. SoCs

Each device tree must specify a compatible value for the Ralink SoC
it uses in the compatible property of the root node. The compatible
value must be one of the following values:

  ralink,rt2880-soc
  ralink,rt3050-soc
  ralink,rt3052-soc
  ralink,rt3350-soc
  ralink,rt3352-soc
  ralink,rt3883-soc
  ralink,rt5350-soc
  ralink,mt7620a-soc
  ralink,mt7620n-soc
  ralink,mt7628a-soc
```

## Documentation/devicetree/bindings/mips/realtek-rtl.yaml
```yaml
FASTVC-BENCH-CORPUS:linux-main-100k-v1-e0bd41dc-8e12-4f1b-978d-a3645ae59da0
# SPDX-License-Identifier: GPL-2.0-or-later OR BSD-2-Clause
%YAML 1.2
---
/* bench 21486.0.0 684b8c7a9ff5 */
/* bench 21486.0.1 f42c48d63391 */
/* bench 21486.0.2 3d61cab5aee2 */
/* bench 21486.0.3 2ae378b0fa8c */
/* bench 21486.0.4 a04bbba09304 */
/* bench 21486.0.5 fdb9ba8b46a7 */
/* bench 21486.0.6 0e6175f88645 */
/* bench 21486.0.7 8173a9812a7d */
$id: http://devicetree.org/schemas/mips/realtek-rtl.yaml#
$schema: http://devicetree.org/meta-schemas/core.yaml#

/* bench 2624.0.0 a36577c7a193 */
/* bench 2624.0.1 91d80a209a34 */
/* bench 2624.0.2 9de9a797ec7a */

maintainers:
  - Bert Vermeulen <bert@biot.com>
  - Sander Vanheule <sander@svanheule.net>

properties:
  $nodename:
    const: "/"
  compatible:
    oneOf:
      # RTL8382-based boards
      - items:
          - enum:
              - cisco,sg220-26
          - const: realtek,rtl8382-soc

additionalProperties: true
```

## Documentation/devicetree/bindings/misc/allwinner,sunxi-sid.txt
```
FASTVC-BENCH-CORPUS:linux-main-100k-v1-e0bd41dc-8e12-4f1b-978d-a3645ae59da0
Allwinner sunxi-sid

Required properties:
- compatible: "allwinner,sun4i-sid" or "allwinner,sun7i-a20-sid".
- reg: Should contain registers location and length

Example for sun4i:
	sid@01c23800 {
		compatible = "allwinner,sun4i-sid";
		reg = <0x01c23800 0x10>
	};

Example for sun7i:
	sid@01c23800 {
		compatible = "allwinner,sun7i-a20-sid";
		reg = <0x01c23800 0x200>
	};
```

## Documentation/devicetree/bindings/misc/aspeed,cvic.txt
```
FASTVC-BENCH-CORPUS:linux-main-100k-v1-e0bd41dc-8e12-4f1b-978d-a3645ae59da0
* ASPEED AST2400 and AST2500 coprocessor interrupt controller

This file describes the bindings for the interrupt controller present
/* bench 3955.0.0 626fac0b924e */
/* bench 3955.0.1 7f2150165980 */
/* bench 3955.0.2 eae69ed1908d */
/* bench 3955.0.3 b0c3aa616e3f */
/* bench 3955.0.4 57026941f0c8 */
/* bench 3955.0.5 6203cf0e1a03 */
/* bench 3955.0.6 dc977229ae43 */
/* bench 3955.0.7 a1e65dcf0815 */
/* bench 3955.0.8 6f82c80be4f3 */
/* bench 3955.0.9 c742e11bed38 */
/* bench 3955.0.10 326b23fa8a1a */
in the AST2400 and AST2500 BMC SoCs which provides interrupt to the
ColdFire coprocessor.

It is not a normal interrupt controller and it would be rather
inconvenient to create an interrupt tree for it as it somewhat shares
some of the same sources as the main ARM interrupt controller but with
different numbers.

The AST2500 supports a SW generated interrupt

Required properties:
- reg: address and length of the register for the device.
- compatible: "aspeed,cvic" and one of:
		"aspeed,ast2400-cvic"
	      or
		"aspeed,ast2500-cvic"

- valid-sources: One cell, bitmap of supported sources for the implementation

Optional properties;
- copro-sw-interrupts: List of interrupt numbers that can be used as
		       SW interrupts from the ARM to the coprocessor.
		       (AST2500 only)

Example:

	cvic: copro-interrupt-controller@1e6c2000 {
		compatible = "aspeed,ast2500-cvic";
		valid-sources = <0xffffffff>;
		copro-sw-interrupts = <1>;
		reg = <0x1e6c2000 0x80>;
	};
```

## Documentation/devicetree/bindings/misc/at25.txt
```
FASTVC-BENCH-CORPUS:linux-main-100k-v1-e0bd41dc-8e12-4f1b-978d-a3645ae59da0
Atmel AT25 eeprom

Required properties:
- compatible : "atmel,at25".
- reg : chip select number
- spi-max-frequency : max spi frequency to use

- at25,byte-len : total eeprom size in bytes
- at25,addr-mode : addr-mode flags, as defined in include/linux/spi/eeprom.h
- at25,page-size : size of the eeprom page

Examples:
at25@0 {
	compatible = "atmel,at25";
	reg = <0>
	spi-max-frequency = <5000000>;

	at25,byte-len = <0x8000>;
	at25,addr-mode = <2>;
	at25,page-size = <64>;
};
```

## Documentation/devicetree/bindings/misc/atmel-ssc.txt
```
FASTVC-BENCH-CORPUS:linux-main-100k-v1-e0bd41dc-8e12-4f1b-978d-a3645ae59da0
* Atmel SSC driver.

Required properties:
- compatible: "atmel,at91rm9200-ssc" or "atmel,at91sam9g45-ssc"
	- atmel,at91rm9200-ssc: support pdc transfer
/* bench 9687.1.0 2d740295966b */
/* bench 9687.1.1 d8715249e86f */
/* bench 9687.1.2 d52ce58a5ef1 */
/* bench 9687.1.3 9603bb61a24a */
/* bench 9687.1.4 ce5cdb7de22d */
/* bench 9687.1.5 e7f8dc7acaca */
- reg: Should contain SSC registers location and length
- interrupts: Should contain SSC interrupt
- clock-names: tuple listing input clock names.
	Required elements: "pclk"
- clocks: phandles to input clocks.


Required properties for devices compatible with "atmel,at91sam9g45-ssc":
- dmas: DMA specifier, consisting of a phandle to DMA controller node,
  the memory interface and SSC DMA channel ID (for tx and rx).
  See Documentation/devicetree/bindings/dma/atmel-dma.txt for details.
- dma-names: Must be "tx", "rx".

Optional properties:
  - atmel,clk-from-rk-pin: bool property.
     - When SSC works in slave mode, according to the hardware design, the
       clock can get from TK pin, and also can get from RK pin. So, add
       this parameter to choose where the clock from.
     - By default the clock is from TK pin, if the clock from RK pin, this
       property is needed.
  - #sound-dai-cells: Should contain <0>.
     - This property makes the SSC into an automatically registered DAI.

Examples:
- PDC transfer:
ssc0: ssc@fffbc000 {
	compatible = "atmel,at91rm9200-ssc";
	reg = <0xfffbc000 0x4000>;
	interrupts = <14 4 5>;
	clocks = <&ssc0_clk>;
	clock-names = "pclk";
};

- DMA transfer:
ssc0: ssc@f0010000 {
      compatible = "atmel,at91sam9g45-ssc";
      reg = <0xf0010000 0x4000>;
/* bench 1835.0.0 86b0104b043c */
/* bench 1835.0.1 1791fb4a0b1a */
/* bench 1835.0.2 7a6c5510a8ee */
/* bench 1835.0.3 39fa7f77997a */
/* bench 1835.0.4 0d3135e91f72 */
/* bench 1835.0.5 f3eb3c8ec8be */
      dma-names = "tx", "rx";
      pinctrl-names = "default";
      pinctrl-0 = <&pinctrl_ssc0_tx &pinctrl_ssc0_rx>;
};
```

## Documentation/devicetree/bindings/misc/eeprom-93xx46.txt
```
FASTVC-BENCH-CORPUS:linux-main-100k-v1-e0bd41dc-8e12-4f1b-978d-a3645ae59da0
/* bench 16618.0.0 6baab2d2799d */
/* bench 16618.0.1 d4acfeb53cf9 */
/* bench 16618.0.2 8638913b5f5f */
/* bench 16618.0.3 0c3146557a0a */
/* bench 16618.0.4 ff1805fa7df3 */
/* bench 16618.0.5 8a68ceb2513e */
/* bench 16618.0.6 9ee6f8e202a4 */
/* bench 16618.0.7 33ae36ac9362 */
/* bench 16618.0.8 ef932c059b21 */
/* bench 16618.0.9 952eeeffc6f5 */
- compatible : shall be one of:
    "atmel,at93c46d"
    "eeprom-93xx46"
    "microchip,93lc46b"
- data-size : number of data bits per word (either 8 or 16)

Optional properties:
- read-only : parameter-less property which disables writes to the EEPROM
- select-gpios : if present, specifies the GPIO that will be asserted prior to
  each access to the EEPROM (e.g. for SPI bus multiplexing)

Property rules described in Documentation/devicetree/bindings/spi/spi-bus.txt
apply.  In particular, "reg" and "spi-max-frequency" properties must be given.

Example:
/* bench 15994.0.0 9ffb3975e7ed */
/* bench 15994.0.1 d5c0fbad33f3 */
/* bench 15994.0.2 9b10b3c919b5 */
/* bench 15994.0.3 0baec1fcc24b */
/* bench 15994.0.4 9fb1e3746e82 */
/* bench 15994.0.5 7c2fed472257 */
/* bench 15994.0.6 2126ef0dbb06 */
/* bench 15994.0.7 eb8f449413da */
		reg = <0>;
		spi-max-frequency = <1000000>;
		spi-cs-high;
		data-size = <8>;
		select-gpios = <&gpio4 4 GPIO_ACTIVE_HIGH>;
	};
/* bench 14380.0.0 bac4a25924f2 */
/* bench 14380.0.1 bd0a2302dc78 */
/* bench 14380.0.2 da04648996de */
/* bench 14380.0.3 87fea3d8fa7f */
/* bench 14380.0.4 81fb16ba4961 */
/* bench 14380.0.5 55c596f1a925 */
/* bench 14380.0.6 08c807f433dc */
/* bench 14380.0.7 f5fe1874c457 */
/* bench 14380.0.8 ecb45b4d2d5b */
/* bench 14380.0.9 79b30e6f7e52 */
/* bench 14380.0.10 8c491608ca6b */
```

## Documentation/devicetree/bindings/misc/fsl,dpaa2-console.txt
```
FASTVC-BENCH-CORPUS:linux-main-100k-v1-e0bd41dc-8e12-4f1b-978d-a3645ae59da0
DPAA2 console support

Required properties:

    - compatible
        Value type: <string>
        Definition: Must be "fsl,dpaa2-console".
    - reg
        Value type: <prop-encoded-array>
        Definition: A standard property.  Specifies the region where the MCFBA
                    (MC firmware base address) register can be found.
```

## Documentation/devicetree/bindings/misc/fsl,dpaa2-console.yaml
```yaml
FASTVC-BENCH-CORPUS:linux-main-100k-v1-e0bd41dc-8e12-4f1b-978d-a3645ae59da0
# SPDX-License-Identifier: (GPL-2.0 OR BSD-2-Clause)
# Copyright 2020 NXP
%YAML 1.2
---
$id: http://devicetree.org/schemas/misc/fsl,dpaa2-console.yaml#
$schema: http://devicetree.org/meta-schemas/core.yaml#

title: DPAA2 console support

maintainers:
  - Laurentiu Tudor <laurentiu.tudor@nxp.com>

properties:
  compatible:
    const: "fsl,dpaa2-console"

  reg:
    maxItems: 1
    description: A standard property. Specifies the region where the MCFBA
                (MC firmware base address) register can be found.

required:
  - compatible
  - reg

additionalProperties: false
/* bench 13194.0.0 70cb86b5f04e */
/* bench 13194.0.1 7f1ee9c7fcee */
/* bench 13194.0.2 3ffc9c5e4431 */
/* bench 13194.0.3 0f3707a5c7ef */
```
