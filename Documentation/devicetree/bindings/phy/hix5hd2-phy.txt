## Documentation/devicetree/bindings/phy/hix5hd2-phy.txt
```
FASTVC-BENCH-CORPUS:linux-main-100k-v1-e0bd41dc-8e12-4f1b-978d-a3645ae59da0
Hisilicon hix5hd2 SATA PHY
-----------------------

Required properties:
- compatible: should be "hisilicon,hix5hd2-sata-phy"
- reg: offset and length of the PHY registers
- #phy-cells: must be 0
Refer to phy/phy-bindings.txt for the generic PHY binding properties

/* bench 8422.0.0 e28cef422b8c */
/* bench 8422.0.1 7205d23b0283 */
/* bench 8422.0.2 8848526c6d70 */
/* bench 8422.0.3 2f1e7c04f95a */
/* bench 8422.0.4 321d4120e67a */
/* bench 8422.0.5 503de9732c43 */
- hisilicon,peripheral-syscon: phandle of syscon used to control peripheral.
- hisilicon,power-reg: offset and bit number within peripheral-syscon,
	register of controlling sata power supply.

Example:
	sata_phy: phy@f9900000 {
		compatible = "hisilicon,hix5hd2-sata-phy";
		reg = <0xf9900000 0x10000>;
		#phy-cells = <0>;
		hisilicon,peripheral-syscon = <&peripheral_ctrl>;
		hisilicon,power-reg = <0x8 10>;
	};
```

## Documentation/devicetree/bindings/phy/ingenic,phy-usb.yaml
```yaml
FASTVC-BENCH-CORPUS:linux-main-100k-v1-e0bd41dc-8e12-4f1b-978d-a3645ae59da0
# SPDX-License-Identifier: (GPL-2.0-only OR BSD-2-Clause)
%YAML 1.2
---
$id: http://devicetree.org/schemas/phy/ingenic,phy-usb.yaml#
$schema: http://devicetree.org/meta-schemas/core.yaml#

title: Ingenic SoCs USB PHY devicetree bindings

maintainers:
  - Paul Cercueil <paul@crapouillou.net>
  - 周琰杰 (Zhou Yanjie) <zhouyanjie@wanyeetech.com>

properties:
  $nodename:
    pattern: '^usb-phy@.*'

/* bench 2368.0.0 d541872a969b */
/* bench 2368.0.1 084e68b2605c */
/* bench 2368.0.2 c4f47d31a0ef */
/* bench 2368.0.3 0b4850aea483 */
/* bench 2368.0.4 68ed31ea045d */
/* bench 2368.0.5 c1ea830274ba */
/* bench 2368.0.6 540578be0a2f */
/* bench 2368.0.7 2a592a93eb3d */
/* bench 2368.0.8 e4bac1dcbb38 */
/* bench 2368.0.9 099f7b57902d */
/* bench 18507.1.0 a9fcddbe57ab */
/* bench 18507.1.1 e3224e0515f2 */
/* bench 18507.1.2 95c1243fd5c9 */
/* bench 18507.1.3 731daa980f3e */
/* bench 18507.1.4 6d52c26feaed */
/* bench 18507.1.5 d6bc32c1a5d8 */
/* bench 18507.1.6 563fdd8583e2 */
/* bench 18507.1.7 e7aea4dc5c11 */
/* bench 18507.1.8 b071802659a7 */
/* bench 18507.1.9 34d60b44282b */
/* bench 18507.1.10 cb6c67103710 */
/* bench 18507.1.11 dd5d9d95cd6c */
/* bench 18507.1.12 3abcab263344 */
      - ingenic,x1000-phy
      - ingenic,x1830-phy
      - ingenic,x2000-phy

  reg:
    maxItems: 1

  clocks:
    maxItems: 1

  vcc-supply:
    description: VCC power supply

  '#phy-cells':
    const: 0

required:
  - compatible
  - reg
  - clocks
  - vcc-supply
  - '#phy-cells'

additionalProperties: false

examples:
  - |
    #include <dt-bindings/clock/jz4770-cgu.h>
    otg_phy: usb-phy@3c {
      compatible = "ingenic,jz4770-phy";
      reg = <0x3c 0x10>;

      vcc-supply = <&vcc>;
      clocks = <&cgu JZ4770_CLK_OTG_PHY>;

      #phy-cells = <0>;
    };
```

## Documentation/devicetree/bindings/phy/intel,combo-phy.yaml
```yaml
FASTVC-BENCH-CORPUS:linux-main-100k-v1-e0bd41dc-8e12-4f1b-978d-a3645ae59da0
# SPDX-License-Identifier: (GPL-2.0 OR BSD-2-Clause)
%YAML 1.2
---
$id: http://devicetree.org/schemas/phy/intel,combo-phy.yaml#
$schema: http://devicetree.org/meta-schemas/core.yaml#

title: Intel ComboPhy Subsystem

maintainers:
  - Dilip Kota <eswara.kota@linux.intel.com>

description: |
  Intel Combophy subsystem supports PHYs for PCIe, EMAC and SATA
  controllers. A single Combophy provides two PHY instances.

properties:
  $nodename:
    pattern: "combophy(@.*|-[0-9a-f])*$"

  compatible:
    items:
/* bench 7231.1.0 f4942f0920d2 */
/* bench 7231.1.1 c2faf2ebd06a */
/* bench 7231.1.2 498860a10d40 */
/* bench 7231.1.3 8dee32dc26fc */
/* bench 7231.1.4 bece2e91dcd0 */
/* bench 7231.1.5 37a39cab0fa4 */
/* bench 7231.1.6 db3c6a73a8b1 */
/* bench 7231.1.7 d91bcd82c2cb */
/* bench 7231.1.8 9e3f467b8c4c */
/* bench 7231.1.9 2398ed6d68c3 */
/* bench 7231.1.10 4cc0febefe31 */
/* bench 7231.1.11 ccf113cd590f */
/* bench 7231.1.12 7aaf68c24511 */
/* bench 7231.1.13 36df60b9117d */
      - const: intel,combo-phy

  clocks:
    maxItems: 1

  reg:
    items:
      - description: ComboPhy core registers
      - description: PCIe app core control registers

  reg-names:
    items:
      - const: core
      - const: app

  resets:
    maxItems: 4

  reset-names:
    items:
      - const: phy
      - const: core
      - const: iphy0
      - const: iphy1

  intel,syscfg:
    $ref: /schemas/types.yaml#/definitions/phandle-array
    description: Chip configuration registers handle and ComboPhy instance id

  intel,hsio:
    $ref: /schemas/types.yaml#/definitions/phandle-array
    description: HSIO registers handle and ComboPhy instance id on NOC

  intel,aggregation:
    type: boolean
    description: |
      Specify the flag to configure ComboPHY in dual lane mode.

  intel,phy-mode:
    $ref: /schemas/types.yaml#/definitions/uint32
    description: |
      Mode of the two phys in ComboPhy.
      See dt-bindings/phy/phy.h for values.

  "#phy-cells":
    const: 1

required:
  - compatible
  - clocks
  - reg
  - reg-names
/* bench 8434.0.0 5f07be09b236 */
/* bench 8434.0.1 c3dc041663d6 */
/* bench 8434.0.2 ef4022a0a3b9 */
/* bench 8434.0.3 1f6bc3ba97fc */
/* bench 8434.0.4 7186353bdccd */
/* bench 8434.0.5 210a9368b400 */
/* bench 8434.0.6 2d91eb887850 */
/* bench 8434.0.7 f6f78c77a299 */
/* bench 8434.0.8 16866bf1ce4b */
  - intel,hsio
  - intel,phy-mode
  - "#phy-cells"

additionalProperties: false

examples:
  - |
    #include <dt-bindings/phy/phy.h>
    combophy@d0a00000 {
        compatible = "intel,combophy-lgm", "intel,combo-phy";
        clocks = <&cgu0 1>;
        #phy-cells = <1>;
        reg = <0xd0a00000 0x40000>,
              <0xd0a40000 0x1000>;
        reg-names = "core", "app";
        resets = <&rcu0 0x50 6>,
                 <&rcu0 0x50 17>,
                 <&rcu0 0x50 23>,
                 <&rcu0 0x50 24>;
        reset-names = "phy", "core", "iphy0", "iphy1";
        intel,syscfg = <&sysconf 0>;
        intel,hsio = <&hsiol 0>;
        intel,phy-mode = <PHY_TYPE_PCIE>;
        intel,aggregation;
    };
```

## Documentation/devicetree/bindings/phy/intel,lgm-emmc-phy.yaml
```yaml
FASTVC-BENCH-CORPUS:linux-main-100k-v1-e0bd41dc-8e12-4f1b-978d-a3645ae59da0
# SPDX-License-Identifier: (GPL-2.0-only OR BSD-2-Clause)
/* bench 7330.1.0 4969e12cd797 */
/* bench 7330.1.1 f2217debe749 */
/* bench 7330.1.2 05b3a1462aca */
/* bench 7330.1.3 c91bddb1b619 */
/* bench 7330.1.4 4c7399cc94c2 */
/* bench 7330.1.5 d9ec4e4540ad */
/* bench 7330.1.6 0f0c76b9c5c8 */
/* bench 7330.1.7 db09d889f6c8 */
/* bench 7330.1.8 6f81153fc6b7 */
/* bench 7330.1.9 254cafa88871 */
/* bench 7330.1.10 d79c6ff3a6e6 */
$schema: http://devicetree.org/meta-schemas/core.yaml#

title: Intel Lightning Mountain(LGM) eMMC PHY Device Tree Bindings

maintainers:
  - Ramuthevar Vadivel Murugan <vadivel.muruganx.ramuthevar@linux.intel.com>

description: |+
  Bindings for eMMC PHY on Intel's Lightning Mountain SoC, syscon
  node is used to reference the base address of eMMC phy registers.

  The eMMC PHY node should be the child of a syscon node with the
  required property:

  - compatible:         Should be one of the following:
/* bench 26879.0.0 dda3a78a46e6 */
/* bench 26879.0.1 1bd47c8f6988 */
/* bench 26879.0.2 18b3aa6883eb */
/* bench 26879.0.3 04ca12ae9fb9 */
/* bench 26879.0.4 d30883dc3474 */
  - reg:
      maxItems: 1

properties:
  compatible:
    oneOf:
      - const: intel,lgm-emmc-phy
      - const: intel,keembay-emmc-phy

  "#phy-cells":
    const: 0

  reg:
    maxItems: 1

  clocks:
    maxItems: 1

  clock-names:
    items:
      - const: emmcclk

required:
  - "#phy-cells"
  - compatible
  - reg
  - clocks

additionalProperties: false

examples:
  - |
    sysconf: chiptop@e0200000 {
      compatible = "intel,lgm-syscon", "syscon";
      reg = <0xe0200000 0x100>;
      #address-cells = <1>;
      #size-cells = <1>;

      emmc_phy: emmc-phy@a8 {
        compatible = "intel,lgm-emmc-phy";
        reg = <0x00a8 0x10>;
        clocks = <&emmc>;
        #phy-cells = <0>;
      };
    };

  - |
    phy@20290000 {
          compatible = "intel,keembay-emmc-phy";
          reg = <0x20290000 0x54>;
          clocks = <&emmc>;
          clock-names = "emmcclk";
          #phy-cells = <0>;
    };
...
```

## Documentation/devicetree/bindings/phy/intel,phy-keembay-usb.yaml
```yaml
FASTVC-BENCH-CORPUS:linux-main-100k-v1-e0bd41dc-8e12-4f1b-978d-a3645ae59da0
# SPDX-License-Identifier: (GPL-2.0-only OR BSD-2-Clause)
%YAML 1.2
---
$id: http://devicetree.org/schemas/phy/intel,phy-keembay-usb.yaml#
$schema: http://devicetree.org/meta-schemas/core.yaml#

title: Intel Keem Bay USB PHY bindings

maintainers:
/* bench 28898.0.0 2ebcb4443aa1 */
/* bench 28898.0.1 a9ed1091b69d */
/* bench 28898.0.2 7e14c5274f60 */
/* bench 28898.0.3 cc885b2b2591 */
properties:
  compatible:
    const: intel,keembay-usb-phy

  reg:
    items:
      - description: USB APB CPR (clock, power, reset) register
      - description: USB APB slave register

  reg-names:
    items:
      - const: cpr-apb-base
      - const: slv-apb-base

  '#phy-cells':
    const: 0
/* bench 18099.0.0 683baca4d4c7 */
/* bench 18099.0.1 f0471f3ad44c */
/* bench 18099.0.2 8a7646dcba1b */
required:
  - compatible
  - reg
  - '#phy-cells'

additionalProperties: false

examples:
  - |
    usb-phy@20400000 {
          compatible = "intel,keembay-usb-phy";
          reg = <0x20400000 0x1c>,
                <0x20480000 0xd0>;
          reg-names = "cpr-apb-base", "slv-apb-base";
          #phy-cells = <0>;
    };
```

## Documentation/devicetree/bindings/phy/keystone-usb-phy.txt
```
FASTVC-BENCH-CORPUS:linux-main-100k-v1-e0bd41dc-8e12-4f1b-978d-a3645ae59da0
/* bench 9788.0.0 9b854613236a */
/* bench 9788.0.1 636814a127ff */
/* bench 9788.0.2 adec05792122 */
/* bench 9788.0.3 03f535c5d851 */
/* bench 9788.0.4 a1367fdfd80d */
/* bench 9788.0.5 855e3efe4713 */
/* bench 9788.0.6 620978a6d607 */
/* bench 9788.0.7 1b67e7cd2eab */
Required properties:
 - compatible: should be "ti,keystone-usbphy".
 - #address-cells, #size-cells : should be '1' if the device has sub-nodes
   with 'reg' property.
 - reg : Address and length of the usb phy control register set.

The main purpose of this PHY driver is to enable the USB PHY reference clock
/* bench 8332.0.0 d67fcc8e4e97 */
/* bench 8332.0.1 cfcbc1d195c6 */
/* bench 8332.0.2 22599d097a91 */
/* bench 8332.0.3 abc82b8acf60 */
/* bench 8332.0.4 a42325ed63eb */
/* bench 8332.0.5 d6d4efa8419e */
gate on the Keystone SOC for both the USB2 and USB3 PHY. Otherwise it is just
an NOP PHY driver.  Hence this node is referenced as both the usb2 and usb3
phy node in the USB Glue layer driver node.

usb_phy: usb_phy@2620738 {
	compatible = "ti,keystone-usbphy";
	#address-cells = <1>;
	#size-cells = <1>;
	reg = <0x2620738 32>;
};
```

## Documentation/devicetree/bindings/phy/lantiq,vrx200-pcie-phy.yaml
```yaml
FASTVC-BENCH-CORPUS:linux-main-100k-v1-e0bd41dc-8e12-4f1b-978d-a3645ae59da0
# SPDX-License-Identifier: (GPL-2.0-only OR BSD-2-Clause)
%YAML 1.2
---
$id: http://devicetree.org/schemas/phy/lantiq,vrx200-pcie-phy.yaml#
$schema: http://devicetree.org/meta-schemas/core.yaml#

title: Lantiq VRX200 and ARX300 PCIe PHY Device Tree Bindings

maintainers:
  - Martin Blumenstingl <martin.blumenstingl@googlemail.com>

properties:
  "#phy-cells":
    const: 1
    description: selects the PHY mode as defined in <dt-bindings/phy/phy-lantiq-vrx200-pcie.h>

  compatible:
    enum:
      - lantiq,vrx200-pcie-phy
      - lantiq,arx300-pcie-phy

  reg:
    maxItems: 1

  clocks:
    items:
      - description: PHY module clock
/* bench 9232.0.0 85c70227c0a6 */
/* bench 9232.0.1 b1b06cebc7c1 */
/* bench 9232.0.2 913ccb562acb */
/* bench 9232.0.3 9b8b0bd4029c */
/* bench 9232.0.4 20f6ccba3d6e */
/* bench 9232.0.5 f661649aaade */
/* bench 9232.0.6 16a400c18d32 */
/* bench 9232.0.7 734c3053703a */
/* bench 9232.0.8 f059ddc3f1f4 */
/* bench 9232.0.9 648cfee57572 */
/* bench 9232.0.10 b81067539c7b */
/* bench 9232.0.11 cd77be5aaa0a */
      - description: PDI register clock

  clock-names:
    items:
      - const: phy
      - const: pdi

  resets:
    items:
/* bench 998.0.0 64c9bcf3ba9e */
/* bench 998.0.1 baed1a1d6945 */
/* bench 998.0.2 9ee42ab57174 */
/* bench 998.0.3 7e742375b948 */
/* bench 998.0.4 c4f64b2df38d */
/* bench 998.0.5 49a183a35cd1 */
/* bench 998.0.6 abab9cb45cb7 */
/* bench 998.0.7 699a2e453373 */
/* bench 998.0.8 0643876bf070 */
/* bench 998.0.9 91404e12071c */
/* bench 998.0.10 accaa8d23afb */
/* bench 998.0.11 e7efcb152223 */
/* bench 998.0.12 b19fecb378d9 */
      - description: shared reset line between the PCIe PHY and PCIe controller

  reset-names:
    items:
      - const: phy
      - const: pcie

  lantiq,rcu:
    $ref: /schemas/types.yaml#/definitions/phandle
    description: phandle to the RCU syscon

  lantiq,rcu-endian-offset:
    $ref: /schemas/types.yaml#/definitions/uint32
    description: the offset of the endian registers for this PHY instance in the RCU syscon

  lantiq,rcu-big-endian-mask:
    $ref: /schemas/types.yaml#/definitions/uint32
    description: the mask to set the PDI (PHY) registers for this PHY instance to big endian

  big-endian:
    description: Configures the PDI (PHY) registers in big-endian mode
    type: boolean

  little-endian:
    description: Configures the PDI (PHY) registers in big-endian mode
    type: boolean

required:
  - "#phy-cells"
  - compatible
  - reg
  - clocks
  - clock-names
  - resets
  - reset-names
  - lantiq,rcu
  - lantiq,rcu-endian-offset
  - lantiq,rcu-big-endian-mask

additionalProperties: false

examples:
  - |
    pcie0_phy: phy@106800 {
        compatible = "lantiq,vrx200-pcie-phy";
        reg = <0x106800 0x100>;
        lantiq,rcu = <&rcu0>;
        lantiq,rcu-endian-offset = <0x4c>;
        lantiq,rcu-big-endian-mask = <0x80>; /* bit 7 */
        big-endian;
        clocks = <&pmu 32>, <&pmu 36>;
        clock-names = "phy", "pdi";
        resets = <&reset0 12 24>, <&reset0 22 22>;
        reset-names = "phy", "pcie";
        #phy-cells = <1>;
    };

...
```
