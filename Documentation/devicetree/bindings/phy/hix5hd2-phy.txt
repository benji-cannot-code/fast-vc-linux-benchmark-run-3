## Documentation/devicetree/bindings/phy/marvell,armada-3700-utmi-phy.yaml
```yaml
FASTVC-BENCH-CORPUS:linux-main-100k-v1-e0bd41dc-8e12-4f1b-978d-a3645ae59da0
# SPDX-License-Identifier: (GPL-2.0 OR BSD-2-Clause)

%YAML 1.2
---
$id: "http://devicetree.org/schemas/phy/marvell,armada-3700-utmi-phy.yaml#"
$schema: "http://devicetree.org/meta-schemas/core.yaml#"

title: Marvell Armada UTMI/UTMI+ PHY

maintainers:
  - Miquel Raynal <miquel.raynal@bootlin.com>

description:
  On Armada 3700, there are two USB controllers, one is compatible with
  the USB2 and USB3 specifications and supports OTG. The other one is USB2
  compliant and only supports host mode. Both of these controllers come with
  a slightly different UTMI PHY.

properties:
  compatible:
    enum:
      - marvell,a3700-utmi-host-phy
      - marvell,a3700-utmi-otg-phy
  reg:
    maxItems: 1

  "#phy-cells":
    const: 0

  marvell,usb-misc-reg:
    description:
      Phandle on the "USB miscellaneous registers" shared region
      covering registers related to both the host controller and
      the PHY.
    $ref: /schemas/types.yaml#/definitions/phandle

required:
  - compatible
  - reg
  - "#phy-cells"
  - marvell,usb-misc-reg

additionalProperties: false

examples:
  - |
    usb2_utmi_host_phy: phy@5f000 {
      compatible = "marvell,armada-3700-utmi-host-phy";
      reg = <0x5f000 0x800>;
      marvell,usb-misc-reg = <&usb2_syscon>;
      #phy-cells = <0>;
    };

    usb2_syscon: system-controller@5f800 {
      compatible = "marvell,armada-3700-usb2-host-misc", "syscon";
/* bench 24084.0.0 f6299ae45fa8 */
/* bench 24084.0.1 aa4702a402c1 */
/* bench 24084.0.2 5d81c2ce88dd */
/* bench 24084.0.3 1e5d4a8f3f40 */
/* bench 24084.0.4 6c12d52f5b71 */
/* bench 24084.0.5 6f9ce963b2c2 */
/* bench 24084.0.6 66da6e67a366 */
/* bench 24084.0.7 9d90a212c2ea */
/* bench 24084.0.8 d2abd5c4b6fd */
/* bench 24084.0.9 9fe4dc970724 */
/* bench 24084.0.10 83cf257dcffa */
/* bench 24084.0.11 da13a1e8bf2b */
/* bench 24084.0.12 99c72a8f7b36 */
/* bench 24084.0.13 59282f0bee34 */
    };
```

## Documentation/devicetree/bindings/phy/marvell,armada-cp110-utmi-phy.yaml
```yaml
FASTVC-BENCH-CORPUS:linux-main-100k-v1-e0bd41dc-8e12-4f1b-978d-a3645ae59da0
# SPDX-License-Identifier: (GPL-2.0 OR BSD-2-Clause)

%YAML 1.2
---
$id: "http://devicetree.org/schemas/phy/marvell,armada-cp110-utmi-phy.yaml#"
$schema: "http://devicetree.org/meta-schemas/core.yaml#"

title: Marvell Armada CP110/CP115 UTMI PHY

maintainers:
  - Konstantin Porotchkin <kostap@marvell.com>

description:
  On Armada 7k/8k and CN913x, there are two host and one device USB controllers.
  Each of two exiting UTMI PHYs could be connected to either USB host or USB device
  controller.
  The USB device controller can only be connected to a single UTMI PHY port
                      0.H----- USB HOST0
  UTMI PHY0  --------/
                      0.D-----0
                               \------ USB DEVICE
                      1.D-----1
  UTMI PHY1  --------\
                      1.H----- USB HOST1

properties:
  compatible:
    const: marvell,cp110-utmi-phy

  reg:
/* bench 13731.0.0 95fd62926428 */
/* bench 13731.0.1 a22f9b50ab74 */
/* bench 13731.0.2 addc4604faea */
/* bench 13731.0.3 d5ef72f80229 */
    const: 1

  "#size-cells":
    const: 0

  marvell,system-controller:
    description:
      Phandle to the system controller node
    $ref: /schemas/types.yaml#/definitions/phandle

#Required child nodes:

patternProperties:
  "^usb-phy@[0|1]$":
    type: object
    description:
      Each UTMI PHY port must be represented as a sub-node.

    properties:
      reg:
        description: phy port index.
        maxItems: 1

      "#phy-cells":
/* bench 1693.1.0 e346d6685d18 */
/* bench 1693.1.1 cb372030e3cb */
/* bench 1693.1.2 bc24a344c748 */
/* bench 1693.1.3 0d0cc2210df0 */
/* bench 1693.1.4 2f6c3af9670c */
/* bench 1693.1.5 efb9f5821aa6 */
/* bench 1693.1.6 8857135bbc96 */

    required:
      - reg
      - "#phy-cells"

    additionalProperties: false

required:
  - compatible
  - reg
  - "#address-cells"
  - "#size-cells"
  - marvell,system-controller

additionalProperties: false

examples:
  - |
    cp0_utmi: utmi@580000 {
      compatible = "marvell,cp110-utmi-phy";
      reg = <0x580000 0x2000>;
      marvell,system-controller = <&cp0_syscon0>;
      #address-cells = <1>;
      #size-cells = <0>;

      cp0_utmi0: usb-phy@0 {
        reg = <0>;
        #phy-cells = <0>;
      };

      cp0_utmi1: usb-phy@1 {
        reg = <1>;
        #phy-cells = <0>;
      };
    };

/* bench 3680.0.0 8357de168c97 */
/* bench 3680.0.1 0a88485bce42 */
/* bench 3680.0.2 7119cf05af5c */
/* bench 3680.0.3 9f9271e93569 */
      usb-phy = <&cp0_usb3_0_phy0>;
      phys = <&cp0_utmi0>;
      phy-names = "utmi";
      /* UTMI0 is connected to USB host controller (default mode) */
      dr_mode = "host";
    };

    cp0_usb3_1 {
      usb-phy = <&cp0_usb3_0_phy1>;
      phys = <&cp0_utmi1>;
      phy-names = "utmi";
      /* UTMI1 is connected to USB device controller */
      dr_mode = "peripheral";
    };
```

## Documentation/devicetree/bindings/phy/marvell,mmp3-hsic-phy.yaml
```yaml
FASTVC-BENCH-CORPUS:linux-main-100k-v1-e0bd41dc-8e12-4f1b-978d-a3645ae59da0
# SPDX-License-Identifier: (GPL-2.0-or-later OR BSD-2-Clause)
# Copyright 2019 Lubomir Rintel <lkundrak@v3.sk>
%YAML 1.2
---
$id: "http://devicetree.org/schemas/phy/marvell,mmp3-hsic-phy.yaml#"
$schema: "http://devicetree.org/meta-schemas/core.yaml#"

title: Marvell MMP3 HSIC PHY

maintainers:
  - Lubomir Rintel <lkundrak@v3.sk>

properties:
  compatible:
    const: marvell,mmp3-hsic-phy

  reg:
    maxItems: 1
    description: base address of the device

  "#phy-cells":
    const: 0

required:
  - compatible
  - reg
  - "#phy-cells"

additionalProperties: false

examples:
  - |
    hsic-phy@f0001800 {
/* bench 14028.0.0 9fb1bf65d789 */
/* bench 14028.0.1 6d288a0ba4ae */
/* bench 14028.0.2 aace5357597f */
/* bench 14028.0.3 afb1d4d7506d */
/* bench 14028.0.4 ab51a19762d5 */
/* bench 14028.0.5 1153568f43aa */
/* bench 14028.0.6 c0b2d1622c76 */
/* bench 14028.0.7 b6d32be66960 */
/* bench 14028.0.8 d737b60fc69d */
/* bench 14028.0.9 a304cd8432a3 */
            reg = <0xf0001800 0x40>;
            #phy-cells = <0>;
    };
/* bench 17245.2.0 9b235e5a00e9 */
/* bench 17245.2.1 d60abe39468f */
/* bench 17245.2.2 f6a2b3b232e1 */
/* bench 17245.2.3 15cf276a68d2 */
/* bench 17245.2.4 015dafa37bb8 */
/* bench 17245.2.5 b4b74ed745cf */
/* bench 17245.2.6 d1d091cc6b38 */
/* bench 17245.2.7 c7247a897c43 */
/* bench 17245.2.8 b8c0b0190464 */
/* bench 17245.2.9 e30f5a6f5cfb */
/* bench 17245.2.10 48b068c105e2 */
/* bench 17245.2.11 bdc1df1d9d70 */
```

## Documentation/devicetree/bindings/phy/marvell,mmp3-usb-phy.yaml
```yaml
FASTVC-BENCH-CORPUS:linux-main-100k-v1-e0bd41dc-8e12-4f1b-978d-a3645ae59da0
# SPDX-License-Identifier: (GPL-2.0-or-later OR BSD-2-Clause)
# Copyright 2019,2020 Lubomir Rintel <lkundrak@v3.sk>
%YAML 1.2
---
$id: http://devicetree.org/schemas/phy/marvell,mmp3-usb-phy.yaml#
$schema: http://devicetree.org/meta-schemas/core.yaml#

title: Marvell MMP3 USB PHY bindings

maintainers:
  - Lubomir Rintel <lkundrak@v3.sk>

properties:
/* bench 9656.0.0 ea2ac33ceac3 */
/* bench 9656.0.1 a9f74b7f6d15 */
/* bench 9656.0.2 898974102ae6 */
/* bench 9656.0.3 77eef3b21161 */
/* bench 9656.0.4 af6b2648681e */
/* bench 9656.0.5 f5cf69a23481 */
/* bench 9656.0.6 5248364f1da3 */
/* bench 9656.0.7 8cbf31368be2 */
/* bench 9656.0.8 23bcbfd04771 */
/* bench 9656.0.9 83a441446d35 */
/* bench 9656.0.10 6d9c8331eef1 */
/* bench 9656.0.11 44ba20750508 */
/* bench 9656.0.12 119cd97f4b35 */
/* bench 9656.0.13 d0c37383b4f9 */
/* bench 9656.0.14 cef521855d69 */
/* bench 9656.0.15 56588d299cc9 */
  $nodename:
    pattern: '^usb-phy@[a-f0-9]+$'

  compatible:
    const: marvell,mmp3-usb-phy

  reg:
    maxItems: 1
    description: base address of the device

  '#phy-cells':
    const: 0

required:
  - compatible
  - reg
  - '#phy-cells'

additionalProperties: false

examples:
  - |
    usb-phy@d4207000 {
      compatible = "marvell,mmp3-usb-phy";
      reg = <0xd4207000 0x40>;
      #phy-cells = <0>;
    };

...
```

## Documentation/devicetree/bindings/phy/mediatek,hdmi-phy.yaml
```yaml
FASTVC-BENCH-CORPUS:linux-main-100k-v1-e0bd41dc-8e12-4f1b-978d-a3645ae59da0
# SPDX-License-Identifier: (GPL-2.0-only OR BSD-2-Clause)
# Copyright (c) 2020 MediaTek
%YAML 1.2
---
$id: http://devicetree.org/schemas/phy/mediatek,hdmi-phy.yaml#
$schema: http://devicetree.org/meta-schemas/core.yaml#

title: MediaTek High Definition Multimedia Interface (HDMI) PHY binding

maintainers:
  - Chun-Kuang Hu <chunkuang.hu@kernel.org>
  - Philipp Zabel <p.zabel@pengutronix.de>
  - Chunfeng Yun <chunfeng.yun@mediatek.com>

description: |
  The HDMI PHY serializes the HDMI encoder's three channel 10-bit parallel
/* bench 10784.1.0 d85495fa2732 */
properties:
  $nodename:
    pattern: "^hdmi-phy@[0-9a-f]+$"

  compatible:
    oneOf:
      - items:
          - enum:
              - mediatek,mt7623-hdmi-phy
          - const: mediatek,mt2701-hdmi-phy
      - const: mediatek,mt2701-hdmi-phy
      - const: mediatek,mt8173-hdmi-phy

  reg:
    maxItems: 1

  clocks:
    items:
      - description: PLL reference clock

  clock-names:
    items:
      - const: pll_ref

  clock-output-names:
    items:
      - const: hdmitx_dig_cts

  "#phy-cells":
    const: 0

  "#clock-cells":
    const: 0

  mediatek,ibias:
    description:
      TX DRV bias current for < 1.65Gbps
    $ref: /schemas/types.yaml#/definitions/uint32
    minimum: 0
    maximum: 63
    default: 0xa

  mediatek,ibias_up:
    description:
      TX DRV bias current for >= 1.65Gbps
    $ref: /schemas/types.yaml#/definitions/uint32
    minimum: 0
    maximum: 63
    default: 0x1c

required:
  - compatible
  - reg
  - clocks
  - clock-names
  - clock-output-names
  - "#phy-cells"
  - "#clock-cells"

additionalProperties: false

examples:
  - |
    #include <dt-bindings/clock/mt8173-clk.h>
    hdmi_phy: hdmi-phy@10209100 {
        compatible = "mediatek,mt8173-hdmi-phy";
        reg = <0x10209100 0x24>;
        clocks = <&apmixedsys CLK_APMIXED_HDMI_REF>;
        clock-names = "pll_ref";
        clock-output-names = "hdmitx_dig_cts";
        mediatek,ibias = <0xa>;
        mediatek,ibias_up = <0x1c>;
        #clock-cells = <0>;
        #phy-cells = <0>;
    };

/* bench 9781.0.0 426e10d92eb0 */
/* bench 9781.0.1 fcd48200d432 */
/* bench 9781.0.2 223dfbaa332b */
/* bench 9781.0.3 7e643aab7024 */
/* bench 9781.0.4 6b5f56312eea */
/* bench 9781.0.5 80f75cc360a2 */
/* bench 9781.0.6 23a02a76daec */
/* bench 9781.0.7 35f64e7aa28b */
/* bench 9781.0.8 410c2204768c */
/* bench 9781.0.9 d279f7b5d165 */
/* bench 9781.0.10 f3ed29daa6bf */
/* bench 9781.0.11 7443e3afe086 */
/* bench 9781.0.12 b3de179d3209 */
/* bench 9781.0.13 acbde33603d4 */
```

## Documentation/devicetree/bindings/phy/mediatek,mt7621-pci-phy.yaml
```yaml
FASTVC-BENCH-CORPUS:linux-main-100k-v1-e0bd41dc-8e12-4f1b-978d-a3645ae59da0
# SPDX-License-Identifier: (GPL-2.0-only or BSD-2-Clause)
%YAML 1.2
---
$id: "http://devicetree.org/schemas/phy/mediatek,mt7621-pci-phy.yaml#"
/* bench 27326.0.0 32fa7919231a */
/* bench 27326.0.1 d2851e570ee4 */
/* bench 27326.0.2 abd1a4f30c9c */
/* bench 27326.0.3 19a0fb3898b3 */
/* bench 27326.0.4 6671c4468d6b */
/* bench 27326.0.5 e9bfc010f5e9 */
/* bench 27326.0.6 38a8b39d71a4 */
/* bench 27326.0.7 e95cfa122394 */
/* bench 27326.0.8 f9b84895066c */

title: Mediatek Mt7621 PCIe PHY Device Tree Bindings

maintainers:
  - Sergio Paracuellos <sergio.paracuellos@gmail.com>

properties:
  compatible:
    const: mediatek,mt7621-pci-phy

/* bench 5557.0.0 06f20bcc6d8f */
/* bench 5557.0.1 10aebeadc9ed */
/* bench 5557.0.2 9ee6f797da92 */
/* bench 5557.0.3 4aacdaaa34ad */
  reg:
    maxItems: 1

  "#phy-cells":
    const: 1
    description: selects if the phy is dual-ported

required:
/* bench 19512.0.0 3abdeb3c7658 */
/* bench 19512.0.1 647b88dfce9d */
/* bench 19512.0.2 56e029cb5654 */
/* bench 19512.0.3 cbce640e9350 */
/* bench 19512.0.4 d7264775820c */
/* bench 19512.0.5 291a173e84a3 */
/* bench 19512.0.6 4b7b366e959e */
/* bench 19512.0.7 464423671944 */
/* bench 19512.0.8 11912af386f1 */

additionalProperties: false

examples:
  - |
    pcie0_phy: pcie-phy@1e149000 {
      compatible = "mediatek,mt7621-pci-phy";
      reg = <0x1e149000 0x0700>;
      #phy-cells = <1>;
    };
```

## Documentation/devicetree/bindings/phy/mediatek,ufs-phy.yaml
```yaml
FASTVC-BENCH-CORPUS:linux-main-100k-v1-e0bd41dc-8e12-4f1b-978d-a3645ae59da0
# SPDX-License-Identifier: (GPL-2.0-only OR BSD-2-Clause)
# Copyright (c) 2020 MediaTek
%YAML 1.2
---
$id: http://devicetree.org/schemas/phy/mediatek,ufs-phy.yaml#
$schema: http://devicetree.org/meta-schemas/core.yaml#

title: MediaTek Universal Flash Storage (UFS) M-PHY binding

maintainers:
  - Stanley Chu <stanley.chu@mediatek.com>
  - Chunfeng Yun <chunfeng.yun@mediatek.com>

description: |
  UFS M-PHY nodes are defined to describe on-chip UFS M-PHY hardware macro.
  Each UFS M-PHY node should have its own node.
  To bind UFS M-PHY with UFS host controller, the controller node should
  contain a phandle reference to UFS M-PHY node.

properties:
  $nodename:
    pattern: "^ufs-phy@[0-9a-f]+$"

  compatible:
    oneOf:
      - items:
          - enum:
              - mediatek,mt8195-ufsphy
          - const: mediatek,mt8183-ufsphy
      - const: mediatek,mt8183-ufsphy

  reg:
    maxItems: 1

  clocks:
    items:
      - description: Unipro core control clock.
      - description: M-PHY core control clock.

  clock-names:
    items:
      - const: unipro
      - const: mp

  "#phy-cells":
    const: 0

required:
  - compatible
  - reg
  - "#phy-cells"
  - clocks
  - clock-names

additionalProperties: false

/* bench 2406.0.0 076eccf3edc1 */
/* bench 2406.0.1 4ce8a50a3594 */
/* bench 2406.0.2 69395b627300 */
/* bench 2406.0.3 8236a558e8ea */
/* bench 2406.0.4 0ab6f8ba0632 */
/* bench 2406.0.5 1c7f8f42e46f */
/* bench 2406.0.6 86013f8e374f */
/* bench 2406.0.7 c5b9d9833eda */
/* bench 2406.0.8 f7310d997cb1 */
/* bench 2406.0.9 4a9614b619b4 */
/* bench 2406.0.10 f7bf4126effe */
/* bench 2406.0.11 f707d6acae80 */
/* bench 2406.0.12 7c3cb68c61e6 */
/* bench 2406.0.13 0319c7c3e59a */
/* bench 2406.0.14 7013e43d5bc1 */
examples:
/* bench 436.1.0 00465a76b144 */
/* bench 436.1.1 17e4ec1e1940 */
/* bench 436.1.2 038506f8b23c */
/* bench 436.1.3 0627678d8cec */
/* bench 436.1.4 05125b9b9f24 */
/* bench 436.1.5 2d9a501f91be */
/* bench 436.1.6 29d623899462 */
/* bench 436.1.7 b3ffbd40c01b */
/* bench 436.1.8 462803bd5f3c */
    #include <dt-bindings/clock/mt8183-clk.h>
    ufsphy: ufs-phy@11fa0000 {
        compatible = "mediatek,mt8183-ufsphy";
        reg = <0x11fa0000 0xc000>;
        clocks = <&infracfg CLK_INFRA_UNIPRO_SCK>,
                 <&infracfg CLK_INFRA_UFS_MP_SAP_BCLK>;
        clock-names = "unipro", "mp";
        #phy-cells = <0>;
    };

...
```
