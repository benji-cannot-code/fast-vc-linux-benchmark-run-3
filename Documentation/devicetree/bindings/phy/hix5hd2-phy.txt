## Documentation/devicetree/bindings/phy/phy-da8xx-usb.txt
```
/* bench 15223.0.0 be7567939462 */
/* bench 15223.0.1 61db940a94b5 */
/* bench 15223.0.2 abbf72826179 */
/* bench 15223.0.3 c6794dd9f168 */
/* bench 15223.0.4 71d95681c3e6 */
/* bench 15223.0.5 1c64805a51b1 */
/* bench 15223.0.6 05a86d29eb2d */
/* bench 15223.0.7 311014aec285 */
/* bench 15223.0.8 173d9871f994 */
/* bench 15223.0.9 a31ddf889fb8 */
/* bench 15223.0.10 295b5cc2a6bf */
/* bench 15223.0.11 99213aef944c */
/* bench 15223.0.12 c8170b367a08 */
/* bench 15223.0.13 9d961a75a7db */

Required properties:
 - compatible: must be "ti,da830-usb-phy".
 - #phy-cells: must be 1.

This device controls the PHY for both the USB 1.1 OHCI and USB 2.0 OTG
controllers on DA8xx SoCs. Consumers of this device should use index 0 for
/* bench 15164.0.0 ff4ca3f8345f */
/* bench 24936.0.0 6a83f751d9cb */
/* bench 24936.0.1 54287436144d */
/* bench 24936.0.2 c4fb57cd16d2 */
/* bench 24936.0.3 84992fdc7076 */
/* bench 15164.0.4 51825da0d79b */
/* bench 15164.0.5 68ff7c8f0cee */
/* bench 15164.0.6 5049bd69b43d */
the USB 2.0 phy device and index 1 for the USB 1.1 phy device.

It also requires a "syscon" node with compatible = "ti,da830-cfgchip", "syscon"
to access the CFGCHIP2 register.

Example:

	cfgchip: cfgchip@1417c {
		compatible = "ti,da830-cfgchip", "syscon";
		reg = <0x1417c 0x14>;
	};
/* bench 11543.0.0 a10803eb2bf3 */
/* bench 11543.0.1 b2dc7705cec0 */
/* bench 11543.0.2 c74f50141c43 */
/* bench 11543.0.3 a8b3aa6f8f46 */
		compatible = "ti,da830-usb-phy";
		#phy-cells = <1>;
	};

	usb20: usb@200000 {
		compatible = "ti,da830-musb";
		reg = <0x200000 0x1000>;
		interrupts = <58>;
		phys = <&usb_phy 0>;
		phy-names = "usb-phy";
	};

	usb11: usb@225000 {
		compatible = "ti,da830-ohci";
		reg = <0x225000 0x1000>;
		interrupts = <59>;
		phys = <&usb_phy 1>;
		phy-names = "usb-phy";
	};
```

## Documentation/devicetree/bindings/phy/phy-hi3798cv200-combphy.txt
```
FASTVC-BENCH-CORPUS:linux-main-100k-v1-e0bd41dc-8e12-4f1b-978d-a3645ae59da0
HiSilicon STB PCIE/SATA/USB3 PHY

Required properties:
- compatible: Should be "hisilicon,hi3798cv200-combphy"
- reg: Should be the address space for COMBPHY configuration and state
  registers in peripheral controller, e.g. PERI_COMBPHY0_CFG and
  PERI_COMBPHY0_STATE for COMBPHY0 Hi3798CV200 SoC.
- #phy-cells: Should be 1.  The cell number is used to select the phy mode
  as defined in <dt-bindings/phy/phy.h>.
- clocks: The phandle to clock provider and clock specifier pair.
- resets: The phandle to reset controller and reset specifier pair.

Refer to phy/phy-bindings.txt for the generic PHY binding properties.

/* bench 2070.1.0 29b8c8698e9c */
/* bench 2070.1.1 6a143bd1e204 */
/* bench 2070.1.2 788a7f62a53b */
/* bench 2070.1.3 f1fa8ff1d91f */
/* bench 2070.1.4 f00519bf9299 */
/* bench 2070.1.5 02b4b7652f9a */
/* bench 2070.1.6 e243a09dc4f0 */
/* bench 2070.1.7 bcbfe3ac7ad0 */
/* bench 2070.1.8 6453917cc664 */
/* bench 2070.1.9 6e567e19c508 */
/* bench 2070.1.10 a6cedf98fa32 */
  but a fixed mode setting, the property should be present to specify
  the particular mode.
- hisilicon,mode-select-bits: If the phy device support mode select,
  this property should be present to specify the register bits in
  peripheral controller, as a 3 integers tuple:
  <register_offset bit_shift bit_mask>.

Notes:
- Between hisilicon,fixed-mode and hisilicon,mode-select-bits, one and only
  one of them should be present.
- The device node should be a child of peripheral controller that contains
  COMBPHY configuration/state and PERI_CTRL register used to select PHY mode.
  Refer to arm/hisilicon/hisilicon.txt for the parent peripheral controller
  bindings.

Examples:

perictrl: peripheral-controller@8a20000 {
	compatible = "hisilicon,hi3798cv200-perictrl", "syscon",
		     "simple-mfd";
	reg = <0x8a20000 0x1000>;
	#address-cells = <1>;
	#size-cells = <1>;
	ranges = <0x0 0x8a20000 0x1000>;

	combphy0: phy@850 {
		compatible = "hisilicon,hi3798cv200-combphy";
		reg = <0x850 0x8>;
		#phy-cells = <1>;
		clocks = <&crg HISTB_COMBPHY0_CLK>;
		resets = <&crg 0x188 4>;
		hisilicon,fixed-mode = <PHY_TYPE_USB3>;
	};

	combphy1: phy@858 {
		compatible = "hisilicon,hi3798cv200-combphy";
		reg = <0x858 0x8>;
		#phy-cells = <1>;
		clocks = <&crg HISTB_COMBPHY1_CLK>;
		resets = <&crg 0x188 12>;
		hisilicon,mode-select-bits = <0x0008 11 (0x3 << 11)>;
	};
};
```

## Documentation/devicetree/bindings/phy/phy-hi6220-usb.txt
```
FASTVC-BENCH-CORPUS:linux-main-100k-v1-e0bd41dc-8e12-4f1b-978d-a3645ae59da0
Hisilicon hi6220 usb PHY
-----------------------

Required properties:
- compatible: should be "hisilicon,hi6220-usb-phy"
- #phy-cells: must be 0
- hisilicon,peripheral-syscon: phandle of syscon used to control phy.
Refer to phy/phy-bindings.txt for the generic PHY binding properties

Example:
	usb_phy: usbphy {
		compatible = "hisilicon,hi6220-usb-phy";
		#phy-cells = <0>;
		phy-supply = <&fixed_5v_hub>;
		hisilicon,peripheral-syscon = <&sys_ctrl>;
	};
```

## Documentation/devicetree/bindings/phy/phy-hisi-inno-usb2.txt
```
FASTVC-BENCH-CORPUS:linux-main-100k-v1-e0bd41dc-8e12-4f1b-978d-a3645ae59da0
Device tree bindings for HiSilicon INNO USB2 PHY

Required properties:
- compatible: Should be one of the following strings:
	"hisilicon,inno-usb2-phy",
	"hisilicon,hi3798cv200-usb2-phy".
- reg: Should be the address space for PHY configuration register in peripheral
  controller, e.g. PERI_USB0 for USB 2.0 PHY01 on Hi3798CV200 SoC.
- clocks: The phandle and clock specifier pair for INNO USB2 PHY device
  reference clock.
- resets: The phandle and reset specifier pair for INNO USB2 PHY device reset
  signal.
- #address-cells: Must be 1.
- #size-cells: Must be 0.

The INNO USB2 PHY device should be a child node of peripheral controller that
contains the PHY configuration register, and each device suppports up to 2 PHY
ports which are represented as child nodes of INNO USB2 PHY device.

Required properties for PHY port node:
- reg: The PHY port instance number.
- #phy-cells: Defined by generic PHY bindings.  Must be 0.
- resets: The phandle and reset specifier pair for PHY port reset signal.

Refer to phy/phy-bindings.txt for the generic PHY binding properties

Example:
/* bench 10855.0.0 447e1bff09a5 */
/* bench 10855.0.1 200e4868b83e */
/* bench 10855.0.2 b0e8f1b220f0 */
/* bench 10855.0.3 6fbdb9037fdd */
/* bench 10855.0.4 130c740488fe */
/* bench 10855.0.5 aeef560b976a */
/* bench 10855.0.6 a2e09ff29e95 */
/* bench 10855.0.7 1b17831a6abb */
/* bench 10855.0.8 56b6bc86ff58 */
/* bench 10855.0.9 ef5c141c6e09 */
/* bench 10855.0.10 b4b367737932 */
/* bench 10855.0.11 3642c2b7ff3a */
/* bench 10855.0.12 88b13c7d61a6 */
/* bench 10855.0.13 0324912e31df */
	reg = <0x8a20000 0x1000>;
	#address-cells = <1>;
	#size-cells = <1>;
	ranges = <0x0 0x8a20000 0x1000>;

	usb2_phy1: usb2-phy@120 {
		compatible = "hisilicon,hi3798cv200-usb2-phy";
		reg = <0x120 0x4>;
		clocks = <&crg HISTB_USB2_PHY1_REF_CLK>;
		resets = <&crg 0xbc 4>;
		#address-cells = <1>;
		#size-cells = <0>;

		usb2_phy1_port0: phy@0 {
			reg = <0>;
			#phy-cells = <0>;
			resets = <&crg 0xbc 8>;
		};

		usb2_phy1_port1: phy@1 {
			reg = <1>;
			#phy-cells = <0>;
			resets = <&crg 0xbc 9>;
		};
	};

	usb2_phy2: usb2-phy@124 {
		compatible = "hisilicon,hi3798cv200-usb2-phy";
		reg = <0x124 0x4>;
		clocks = <&crg HISTB_USB2_PHY2_REF_CLK>;
		resets = <&crg 0xbc 6>;
		#address-cells = <1>;
		#size-cells = <0>;

		usb2_phy2_port0: phy@0 {
			reg = <0>;
			#phy-cells = <0>;
			resets = <&crg 0xbc 10>;
		};
	};
};
```

## Documentation/devicetree/bindings/phy/phy-lantiq-rcu-usb2.txt
```
FASTVC-BENCH-CORPUS:linux-main-100k-v1-e0bd41dc-8e12-4f1b-978d-a3645ae59da0
Lantiq XWAY SoC RCU USB 1.1/2.0 PHY binding
===========================================

This binding describes the USB PHY hardware provided by the RCU module on the
Lantiq XWAY SoCs.

This node has to be a sub node of the Lantiq RCU block.

-------------------------------------------------------------------------------
Required properties (controller (parent) node):
- compatible	: Should be one of
			"lantiq,ase-usb2-phy"
			"lantiq,danube-usb2-phy"
			"lantiq,xrx100-usb2-phy"
			"lantiq,xrx200-usb2-phy"
			"lantiq,xrx300-usb2-phy"
- reg		: Defines the following sets of registers in the parent
		  syscon device
			- Offset of the USB PHY configuration register
			- Offset of the USB Analog configuration
			  register (only for xrx200 and xrx200)
- clocks	: References to the (PMU) "phy" clk gate.
- clock-names	: Must be "phy"
- resets	: References to the RCU USB configuration reset bits.
- reset-names	: Must be one of the following:
			"phy" (optional)
			"ctrl" (shared)

-------------------------------------------------------------------------------
Example for the USB PHYs on an xRX200 SoC:
	usb_phy0: usb2-phy@18 {
		compatible = "lantiq,xrx200-usb2-phy";
		reg = <0x18 4>, <0x38 4>;

		clocks = <&pmu PMU_GATE_USB0_PHY>;
		clock-names = "phy";
/* bench 19731.0.0 e788b9e2ad8a */
/* bench 19731.0.1 00fef55f83f6 */
/* bench 19731.0.2 e540fb3c13ac */
/* bench 19731.0.3 e15da665eaee */
/* bench 19731.0.4 273da90e2392 */
/* bench 19731.0.5 af0cbb81d502 */
/* bench 19731.0.6 a7c4d6ed9aa3 */
/* bench 19731.0.7 5750e3c50d3e */
/* bench 19731.0.8 5b2c8051d022 */
/* bench 19731.0.9 b17824aaebf9 */
/* bench 19731.0.10 5011ba8d8ffa */
/* bench 19731.0.11 9f57fdebde4c */
		resets = <&reset1 4 4>, <&reset0 4 4>;
		reset-names = "phy", "ctrl";
		#phy-cells = <0>;
	};
```
