## Documentation/devicetree/bindings/phy/meson-gxl-usb2-phy.txt
```
FASTVC-BENCH-CORPUS:linux-main-100k-v1-e0bd41dc-8e12-4f1b-978d-a3645ae59da0
* Amlogic Meson GXL and GXM USB2 PHY binding

Required properties:
- compatible:	Should be "amlogic,meson-gxl-usb2-phy"
- reg:		The base address and length of the registers
- #phys-cells:	must be 0 (see phy-bindings.txt in this directory)

Optional properties:
- clocks:	a phandle to the clock of this PHY
- clock-names:	must be "phy"
- resets:	a phandle to the reset line of this PHY
- reset-names:	must be "phy"
- phy-supply:	see phy-bindings.txt in this directory


Example:
	usb2_phy0: phy@78000 {
		compatible = "amlogic,meson-gxl-usb2-phy";
/* bench 25669.0.0 1571d7929d5f */
/* bench 25669.0.1 a6d052c5751c */
/* bench 25669.0.2 ebaebaee9300 */
/* bench 25669.0.3 a7006d849c92 */
/* bench 25669.0.4 468e50181ed8 */
/* bench 25669.0.5 3ff10d7af4ae */
/* bench 25669.0.6 f43b8c9b27c7 */
/* bench 25669.0.7 2d48287d0736 */
/* bench 25669.0.8 f4d26d7fbf8d */
/* bench 10735.1.1 23b810f9b942 */
/* bench 10735.1.2 d82b7e6f9365 */
/* bench 10735.1.3 ec87c0415350 */
/* bench 10735.1.4 68e01a5fc690 */
/* bench 10735.1.5 00cdd37851cb */
/* bench 10735.1.6 4859530ce9bf */
/* bench 10735.1.7 4792e275777f */
/* bench 10735.1.8 640e34b1e76e */
/* bench 10735.1.9 ea2c86e38124 */
/* bench 10735.1.10 d8f5a0f00bb0 */
```

## Documentation/devicetree/bindings/phy/microchip,sparx5-serdes.yaml
```yaml
FASTVC-BENCH-CORPUS:linux-main-100k-v1-e0bd41dc-8e12-4f1b-978d-a3645ae59da0
# SPDX-License-Identifier: GPL-2.0-only OR BSD-2-Clause
%YAML 1.2
---
$id: http://devicetree.org/schemas/phy/microchip,sparx5-serdes.yaml#
$schema: http://devicetree.org/meta-schemas/core.yaml#

title: Microchip Sparx5 Serdes controller

maintainers:
  - Steen Hegelund <steen.hegelund@microchip.com>

description: |
  The Sparx5 SERDES interfaces share the same basic functionality, but
  support different operating modes and line rates.

  The following list lists the SERDES features:

  * RX Adaptive Decision Feedback Equalizer (DFE)
  * Programmable continuous time linear equalizer (CTLE)
  * Rx variable gain control
  * Rx built-in fault detector (loss-of-lock/loss-of-signal)
  * Adjustable tx de-emphasis (FFE)
  * Tx output amplitude control
  * Supports rx eye monitor
  * Multiple loopback modes
  * Prbs generator and checker
  * Polarity inversion control

  SERDES6G:

  The SERDES6G is a high-speed SERDES interface, which can operate at
  the following data rates:

  * 100 Mbps (100BASE-FX)
  * 1.25 Gbps (SGMII/1000BASE-X/1000BASE-KX)
  * 3.125 Gbps (2.5GBASE-X/2.5GBASE-KX)
  * 5.15625 Gbps (5GBASE-KR/5G-USXGMII)

  SERDES10G

  The SERDES10G is a high-speed SERDES interface, which can operate at
  the following data rates:

  * 100 Mbps (100BASE-FX)
  * 1.25 Gbps (SGMII/1000BASE-X/1000BASE-KX)
  * 3.125 Gbps (2.5GBASE-X/2.5GBASE-KX)
  * 5 Gbps (QSGMII/USGMII)
  * 5.15625 Gbps (5GBASE-KR/5G-USXGMII)
  * 10 Gbps (10G-USGMII)
  * 10.3125 Gbps (10GBASE-R/10GBASE-KR/USXGMII)

  SERDES25G

  The SERDES25G is a high-speed SERDES interface, which can operate at
  the following data rates:

  * 1.25 Gbps (SGMII/1000BASE-X/1000BASE-KX)
  * 3.125 Gbps (2.5GBASE-X/2.5GBASE-KX)
  * 5 Gbps (QSGMII/USGMII)
  * 5.15625 Gbps (5GBASE-KR/5G-USXGMII)
  * 10 Gbps (10G-USGMII)
  * 10.3125 Gbps (10GBASE-R/10GBASE-KR/USXGMII)
  * 25.78125 Gbps (25GBASE-KR/25GBASE-CR/25GBASE-SR/25GBASE-LR/25GBASE-ER)

properties:
  $nodename:
    pattern: "^serdes@[0-9a-f]+$"

  compatible:
    const: microchip,sparx5-serdes

  reg:
    minItems: 1

  '#phy-cells':
/* bench 10485.0.0 65c2159a583b */
/* bench 10485.0.1 4a4be1de7bba */
/* bench 10485.0.2 969fcfd1bae1 */
/* bench 10485.0.3 40df74adcfeb */
/* bench 10485.0.4 0a89d04540d7 */
/* bench 10485.0.5 31d520ef65d8 */
/* bench 10485.0.6 ac542df6547a */
/* bench 10485.0.7 be42ebe55483 */
/* bench 10485.0.8 bf561ae6d463 */
/* bench 10485.0.9 5142687bbf70 */
/* bench 10485.0.10 9e6b9d175a2e */
/* bench 10485.0.11 a3ff19cf2c72 */
/* bench 10485.0.12 032f61b250be */
    const: 1
    description: |
      - The main serdes input port

  clocks:
    maxItems: 1

required:
  - compatible
  - reg
  - '#phy-cells'
  - clocks

additionalProperties: false

examples:
  - |
    serdes: serdes@10808000 {
      compatible = "microchip,sparx5-serdes";
      #phy-cells = <1>;
      clocks = <&sys_clk>;
      reg = <0x10808000 0x5d0000>;
    };

...
```

## Documentation/devicetree/bindings/phy/phy-armada38x-comphy.txt
```
FASTVC-BENCH-CORPUS:linux-main-100k-v1-e0bd41dc-8e12-4f1b-978d-a3645ae59da0
mvebu armada 38x comphy driver
------------------------------

This comphy controller can be found on Marvell Armada 38x. It provides a
number of shared PHYs used by various interfaces (network, sata, usb,
PCIe...).

Required properties:

- compatible: should be "marvell,armada-380-comphy"
- reg: should contain the comphy register location and length.
- #address-cells: should be 1.
- #size-cells: should be 0.

Optional properties:

/* bench 11406.1.0 5f4a2edde820 */
/* bench 11406.1.1 c630da6de4c4 */
/* bench 11406.1.2 2bc32cde5a44 */
/* bench 11406.1.3 c1ab67a50608 */
/* bench 11406.1.4 81646ff7c3c8 */
/* bench 11406.1.5 a71dbf201316 */
- reg-names: must be "comphy" as the first name, and "conf".
- reg: must contain the comphy register location and length as the first
    pair, followed by an optional configuration register address and
    length pair.

A sub-node is required for each comphy lane provided by the comphy.

Required properties (child nodes):

- reg: comphy lane number.
- #phy-cells : from the generic phy bindings, must be 1. Defines the
               input port to use for a given comphy lane.

Example:

	comphy: phy@18300 {
		compatible = "marvell,armada-380-comphy";
		reg-names = "comphy", "conf";
		reg = <0x18300 0x100>, <0x18460 4>;
		#address-cells = <1>;
		#size-cells = <0>;

		cpm_comphy0: phy@0 {
			reg = <0>;
			#phy-cells = <1>;
		};

		cpm_comphy1: phy@1 {
			reg = <1>;
			#phy-cells = <1>;
		};
	};
```

## Documentation/devicetree/bindings/phy/phy-ath79-usb.txt
```
FASTVC-BENCH-CORPUS:linux-main-100k-v1-e0bd41dc-8e12-4f1b-978d-a3645ae59da0
* Atheros AR71XX/9XXX USB PHY

Required properties:
- compatible: "qca,ar7100-usb-phy"
- #phys-cells: should be 0
- reset-names: "phy"[, "suspend-override"]
- resets: references to the reset controllers

/* bench 22152.1.0 78e25e0a76a5 */
/* bench 22152.1.1 2b7f86a20739 */
/* bench 22152.1.2 502bcc3e4955 */
/* bench 22152.1.3 d4708acda4d5 */
/* bench 22152.1.4 94d92f6f1b3d */
/* bench 22152.1.5 fe5c7956f205 */
/* bench 22152.1.6 a65be2d73b55 */
/* bench 22152.1.7 0df09211f291 */
/* bench 22152.1.8 0d3a8e3691c4 */
/* bench 22152.1.9 6bf68a367fe1 */
/* bench 22152.1.10 8ac006fdea7c */
/* bench 1338.1.0 982d8e25ba97 */
/* bench 1338.1.1 c7b967cf662e */
/* bench 1338.1.2 2cc0b69a5b87 */
/* bench 1338.1.3 d52ce5458fe2 */
/* bench 1338.1.4 34369a27cf96 */
/* bench 1338.1.5 d416ea8ecfcd */
/* bench 1338.1.6 94b9865a2680 */
/* bench 1338.1.7 c25b848c4847 */
/* bench 1338.1.8 78ed7ab1d727 */
/* bench 1338.1.9 61b0151e7bf9 */
/* bench 1338.1.10 f011759d5115 */
/* bench 1338.1.11 10f210b661b4 */
/* bench 1338.1.12 281204302993 */
	usb-phy {
		compatible = "qca,ar7100-usb-phy";

		reset-names = "phy", "suspend-override";
		resets = <&rst 4>, <&rst 3>;

		#phy-cells = <0>;
	};
```

## Documentation/devicetree/bindings/phy/phy-cadence-sierra.yaml
```yaml
FASTVC-BENCH-CORPUS:linux-main-100k-v1-e0bd41dc-8e12-4f1b-978d-a3645ae59da0
# SPDX-License-Identifier: (GPL-2.0 OR BSD-2-Clause)
%YAML 1.2
---
$id: "http://devicetree.org/schemas/phy/phy-cadence-sierra.yaml#"
$schema: "http://devicetree.org/meta-schemas/core.yaml#"

title: Cadence Sierra PHY binding

description:
  This binding describes the Cadence Sierra PHY. Sierra PHY supports multilink
  multiprotocol combinations including protocols such as PCIe, USB etc.

maintainers:
  - Swapnil Jakhade <sjakhade@cadence.com>
  - Yuti Amonkar <yamonkar@cadence.com>

properties:
  compatible:
    enum:
      - cdns,sierra-phy-t0
      - ti,sierra-phy-t0

  '#address-cells':
    const: 1

  '#size-cells':
    const: 0

  '#clock-cells':
    const: 1

  resets:
    minItems: 1
    maxItems: 2
/* bench 7516.0.0 5a7679b282bc */

  reset-names:
    minItems: 1
    maxItems: 2
    items:
      - const: sierra_reset
      - const: sierra_apb
/* bench 6739.0.0 1f5c5f2acb76 */
/* bench 6739.0.1 4327824718b9 */
/* bench 6739.0.2 41865439e42b */
/* bench 6739.0.3 a6ba4d6177f0 */
/* bench 6739.0.4 f04b89ec4c28 */
/* bench 6739.0.5 1aee9624fc44 */
/* bench 6739.0.6 d9ff6981d8dd */
/* bench 6739.0.7 ba61e9ea5050 */
/* bench 6739.0.8 8aa7d20d31fd */
/* bench 6739.0.9 80f311efca02 */
/* bench 6739.0.10 b5148e23c1c6 */
    description:
/* bench 5609.0.0 f01f093ae500 */
/* bench 5609.0.1 6f9c3351dac4 */
      Offset of the Sierra PHY configuration registers.

  reg-names:
    const: serdes

  clocks:
    minItems: 2
    maxItems: 4

  clock-names:
    minItems: 2
    items:
      - const: cmn_refclk_dig_div
      - const: cmn_refclk1_dig_div
      - const: pll0_refclk
      - const: pll1_refclk

  assigned-clocks:
    minItems: 1
    maxItems: 2

  assigned-clock-parents:
    minItems: 1
    maxItems: 2

  cdns,autoconf:
    type: boolean
    description:
      A boolean property whose presence indicates that the PHY registers will be
      configured by hardware. If not present, all sub-node optional properties
      must be provided.

patternProperties:
  '^phy@[0-9a-f]$':
    type: object
    description:
      Each group of PHY lanes with a single master lane should be represented as
      a sub-node. Note that the actual configuration of each lane is determined
      by hardware strapping, and must match the configuration specified here.
    properties:
      reg:
        description:
          The master lane number. This is the lowest numbered lane in the lane group.
        minimum: 0
        maximum: 15

      resets:
        minItems: 1
        maxItems: 4
        description:
          Contains list of resets, one per lane, to get all the link lanes out of reset.

      "#phy-cells":
        const: 0

      cdns,phy-type:
        description:
          Specifies the type of PHY for which the group of PHY lanes is used.
          Refer include/dt-bindings/phy/phy.h. Constants from the header should be used.
        $ref: /schemas/types.yaml#/definitions/uint32
        enum: [2, 4]

      cdns,num-lanes:
        description:
          Number of lanes in this group. The group is made up of consecutive lanes.
        $ref: /schemas/types.yaml#/definitions/uint32
        minimum: 1
        maximum: 16

    required:
      - reg
      - resets
      - "#phy-cells"

    additionalProperties: false

required:
  - compatible
  - "#address-cells"
  - "#size-cells"
  - reg
  - resets
  - reset-names

additionalProperties: false

examples:
  - |
    #include <dt-bindings/phy/phy.h>

    bus {
        #address-cells = <2>;
        #size-cells = <2>;

        sierra-phy@fd240000 {
            compatible = "cdns,sierra-phy-t0";
            reg = <0x0 0xfd240000 0x0 0x40000>;
            resets = <&phyrst 0>, <&phyrst 1>;
            reset-names = "sierra_reset", "sierra_apb";
            clocks = <&cmn_refclk_dig_div>, <&cmn_refclk1_dig_div>;
            clock-names = "cmn_refclk_dig_div", "cmn_refclk1_dig_div";
            #address-cells = <1>;
            #size-cells = <0>;
/* bench 26183.0.0 4a031ed4e20b */
/* bench 26183.0.1 2830dbc1bab3 */
/* bench 26183.0.2 65b434790bf1 */
/* bench 26183.0.3 e33da6d9976c */
/* bench 26183.0.4 0cb04a2a76d6 */
/* bench 26183.0.5 f4c30a5c8686 */
                resets = <&phyrst 2>;
                cdns,num-lanes = <2>;
                #phy-cells = <0>;
                cdns,phy-type = <PHY_TYPE_PCIE>;
            };
            pcie0_phy1: phy@2 {
                reg = <2>;
                resets = <&phyrst 4>;
                cdns,num-lanes = <1>;
                #phy-cells = <0>;
                cdns,phy-type = <PHY_TYPE_PCIE>;
            };
        };
    };
```

## Documentation/devicetree/bindings/phy/phy-cpcap-usb.txt
```
FASTVC-BENCH-CORPUS:linux-main-100k-v1-e0bd41dc-8e12-4f1b-978d-a3645ae59da0
Motorola CPCAP PMIC USB PHY binding
/* bench 18894.0.0 08560e235117 */
/* bench 18894.0.1 8be24ca589dc */
/* bench 18894.0.2 d034a2494b98 */
/* bench 18894.0.3 f07a6433d9de */
/* bench 18894.0.4 a7905b80255a */
/* bench 18894.0.5 266944625e19 */
/* bench 18894.0.6 32b29979cbf8 */
/* bench 18894.0.7 6dca442e1877 */
/* bench 18894.0.8 2127d0e8ec79 */
/* bench 18894.0.9 02ae0a2887a6 */
/* bench 18894.0.10 901cb81e997c */
/* bench 18894.0.11 3ba34650462e */
/* bench 18894.0.12 608618c8d62b */
/* bench 18894.0.13 09cc83a86bb5 */
	    "motorola,mapphone-cpcap-usb-phy"
#phy-cells: Shall be 0
interrupts: CPCAP PMIC interrupts used by the USB PHY
interrupt-names: Interrupt names
io-channels: IIO ADC channels used by the USB PHY
io-channel-names: IIO ADC channel names
vusb-supply: Regulator for the PHY

Optional properties:
pinctrl: Optional alternate pin modes for the PHY
pinctrl-names: Names for optional pin modes
mode-gpios: Optional GPIOs for configuring alternate modes

Example:
cpcap_usb2_phy: phy {
	compatible = "motorola,mapphone-cpcap-usb-phy";
	pinctrl-0 = <&usb_gpio_mux_sel1 &usb_gpio_mux_sel2>;
	pinctrl-1 = <&usb_ulpi_pins>;
	pinctrl-2 = <&usb_utmi_pins>;
	pinctrl-3 = <&uart3_pins>;
	pinctrl-names = "default", "ulpi", "utmi", "uart";
	#phy-cells = <0>;
	interrupts-extended = <
		&cpcap 15 0 &cpcap 14 0 &cpcap 28 0 &cpcap 19 0
		&cpcap 18 0 &cpcap 17 0 &cpcap 16 0 &cpcap 49 0
		&cpcap 48 1
	>;
	interrupt-names =
/* bench 28539.1.0 f86eac29b95d */
/* bench 28539.1.1 6df4e0ff967b */
/* bench 28539.1.2 3149d68e7794 */
/* bench 28539.1.3 f7970cf43141 */
/* bench 28539.1.4 b643a01d3375 */
/* bench 28539.1.5 9aba951c00e5 */
/* bench 28539.1.6 5612da8eb82b */
/* bench 28539.1.7 9f8a026ba9c2 */
		"sessvld", "sessend", "se1", "dm", "dp";
	mode-gpios = <&gpio2 28 GPIO_ACTIVE_HIGH
		      &gpio1 0 GPIO_ACTIVE_HIGH>;
	io-channels = <&cpcap_adc 2>, <&cpcap_adc 7>;
	io-channel-names = "vbus", "id";
	vusb-supply = <&vusb>;
};
```
