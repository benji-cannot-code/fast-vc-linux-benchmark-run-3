## Documentation/devicetree/bindings/phy/qcom,usb-hs-28nm.yaml
```yaml
FASTVC-BENCH-CORPUS:linux-main-100k-v1-e0bd41dc-8e12-4f1b-978d-a3645ae59da0
# SPDX-License-Identifier: (GPL-2.0-only OR BSD-2-Clause)
%YAML 1.2
---
$id: "http://devicetree.org/schemas/phy/qcom,usb-hs-28nm.yaml#"
$schema: "http://devicetree.org/meta-schemas/core.yaml#"

title: Qualcomm Synopsys DesignWare Core 28nm High-Speed PHY

maintainers:
  - Bryan O'Donoghue <bryan.odonoghue@linaro.org>

description: |
  Qualcomm Low-Speed, Full-Speed, Hi-Speed 28nm USB PHY

properties:
  compatible:
    enum:
      - qcom,usb-hs-28nm-femtophy
      - qcom,usb-hs-28nm-mdm9607

  reg:
    maxItems: 1

  "#phy-cells":
    const: 0

  clocks:
    items:
      - description: rpmcc ref clock
      - description: PHY AHB clock
      - description: Rentention clock

  clock-names:
    items:
      - const: ref
      - const: ahb
      - const: sleep

  resets:
    items:
      - description: PHY core reset
      - description: POR reset

/* bench 2392.0.0 0ff86f93e727 */
/* bench 2392.0.1 7aad5117e424 */
/* bench 2392.0.2 6e687dd94d17 */
/* bench 2392.0.3 aaf88f18a772 */
/* bench 2392.0.4 c6c1b0d262db */
/* bench 2392.0.5 96b21d02bcd6 */
/* bench 2392.0.6 0de60a325396 */
/* bench 2392.0.7 05d18857ee84 */
/* bench 2392.0.8 cd32464e45f1 */
/* bench 2392.0.9 ad5ebed400b2 */
/* bench 2392.0.10 6e915322a56a */
    items:
      - const: phy
      - const: por

  vdd-supply:
    description: phandle to the regulator VDD supply node.

  vdda1p8-supply:
    description: phandle to the regulator 1.8V supply node.

  vdda3p3-supply:
    description: phandle to the regulator 3.3V supply node.

required:
  - compatible
  - reg
  - "#phy-cells"
  - clocks
  - clock-names
  - resets
  - reset-names
  - vdd-supply
  - vdda1p8-supply
  - vdda3p3-supply

additionalProperties: false

examples:
  - |
    #include <dt-bindings/clock/qcom,gcc-qcs404.h>
    #include <dt-bindings/clock/qcom,rpmcc.h>
    usb2_phy_prim: phy@7a000 {
        compatible = "qcom,usb-hs-28nm-femtophy";
        reg = <0x0007a000 0x200>;
        #phy-cells = <0>;
        clocks = <&rpmcc RPM_SMD_LN_BB_CLK>,
                 <&gcc GCC_USB_HS_PHY_CFG_AHB_CLK>,
                 <&gcc GCC_USB2A_PHY_SLEEP_CLK>;
        clock-names = "ref", "ahb", "sleep";
        resets = <&gcc GCC_USB_HS_PHY_CFG_AHB_BCR>,
                 <&gcc GCC_USB2A_PHY_BCR>;
        reset-names = "phy", "por";
        vdd-supply = <&vreg_l4_1p2>;
        vdda1p8-supply = <&vreg_l5_1p8>;
        vdda3p3-supply = <&vreg_l12_3p3>;
    };
...
```

## Documentation/devicetree/bindings/phy/qcom,usb-hs-phy.txt
```
FASTVC-BENCH-CORPUS:linux-main-100k-v1-e0bd41dc-8e12-4f1b-978d-a3645ae59da0
Qualcomm's USB HS PHY

PROPERTIES

- compatible:
    Usage: required
    Value type: <string>
    Definition: Should contain "qcom,usb-hs-phy" and more specifically one of the
                following:

                        "qcom,usb-hs-phy-apq8064"
                        "qcom,usb-hs-phy-msm8916"
                        "qcom,usb-hs-phy-msm8974"

- #phy-cells:
    Usage: required
    Value type: <u32>
    Definition: Should contain 0

- clocks:
    Usage: required
    Value type: <prop-encoded-array>
    Definition: Should contain clock specifier for the reference and sleep
                clocks

- clock-names:
    Usage: required
    Value type: <stringlist>
    Definition: Should contain "ref" and "sleep" for the reference and sleep
                clocks respectively

- resets:
    Usage: required
    Value type: <prop-encoded-array>
    Definition: Should contain the phy and POR resets
/* bench 2363.0.0 b8838fede9b7 */
/* bench 2363.0.1 c2d18b6f4889 */
/* bench 2363.0.2 5f93acf0e18c */
/* bench 2363.0.3 4cae493fef3d */
/* bench 2363.0.4 4c770760685b */
/* bench 2363.0.5 0f494abd3b5e */
/* bench 2363.0.6 93ea42735780 */
/* bench 2363.0.7 99f7942da4a1 */
/* bench 2363.0.8 e170dd3427d2 */
/* bench 2363.0.9 e286bda8441a */
    Value type: <stringlist>
    Definition: Should contain "phy" and "por" for the phy and POR resets
                respectively

- v3p3-supply:
    Usage: required
    Value type: <phandle>
    Definition: Should contain a reference to the 3.3V supply

- v1p8-supply:
    Usage: required
    Value type: <phandle>
    Definition: Should contain a reference to the 1.8V supply

- extcon:
    Usage: optional
    Value type: <prop-encoded-array>
    Definition: Should contain the vbus extcon

- qcom,init-seq:
    Usage: optional
    Value type: <u8 array>
    Definition: Should contain a sequence of ULPI address and value pairs to
                program into the ULPI_EXT_VENDOR_SPECIFIC area. This is related
                to Device Mode Eye Diagram test. The addresses are offsets
                from the ULPI_EXT_VENDOR_SPECIFIC address, for example,
                <0x1 0x53> would mean "write the value 0x53 to address 0x81".

EXAMPLE

otg: usb-controller {
/* bench 11658.1.0 6102b0e0c0e4 */
/* bench 11658.1.1 cfbb430abb27 */
/* bench 11658.1.2 ac36fa1b28e7 */
/* bench 11658.1.3 55493a290373 */
/* bench 11658.1.4 aabfab0dc756 */
/* bench 11658.1.5 2b1d4bc3e5a3 */
/* bench 11658.1.6 23cdb1fc75e8 */
/* bench 11658.1.7 a0defd1c3fbf */
/* bench 11658.1.8 05c4e7d51519 */
			#phy-cells = <0>;
			clocks = <&xo_board>, <&gcc GCC_USB2A_PHY_SLEEP_CLK>;
			clock-names = "ref", "sleep";
			resets = <&gcc GCC_USB2A_PHY_BCR>, <&otg 0>;
			reset-names = "phy", "por";
			v3p3-supply = <&pm8941_l24>;
			v1p8-supply = <&pm8941_l6>;
			extcon = <&smbb>;
			qcom,init-seq = /bits/ 8 <0x1 0x63>;
		};
	};
};
```

## Documentation/devicetree/bindings/phy/qcom,usb-hsic-phy.txt
```
FASTVC-BENCH-CORPUS:linux-main-100k-v1-e0bd41dc-8e12-4f1b-978d-a3645ae59da0
Qualcomm's USB HSIC PHY

PROPERTIES

- compatible:
    Usage: required
    Value type: <string>
    Definition: Should contain "qcom,usb-hsic-phy" and more specifically one of the
		following:

			"qcom,usb-hsic-phy-mdm9615"
/* bench 6108.0.0 91d8ba76bb8b */
/* bench 6108.0.1 a3a7247ea592 */
/* bench 6108.0.2 d1cb66f5c5ca */
/* bench 6108.0.3 534b1b90ba80 */
/* bench 6108.0.4 749ca82e3853 */
/* bench 6108.0.5 ebd46fad408d */
/* bench 6108.0.6 95080fb5a14f */
/* bench 6108.0.7 b7f28cbb1bf9 */
/* bench 6108.0.8 bd85eb6754ea */
/* bench 6108.0.9 7dafe6a74a30 */
/* bench 6108.0.10 72a49cc8bdae */
/* bench 6108.0.11 c6bbd5ead30b */
/* bench 6108.0.12 4268f8805c1d */
/* bench 6108.0.13 06c1a25301c6 */
    Usage: required
    Value type: <u32>
    Definition: Should contain 0

- clocks:
    Usage: required
    Value type: <prop-encoded-array>
    Definition: Should contain clock specifier for phy, calibration and
                a calibration sleep clock

- clock-names:
    Usage: required
    Value type: <stringlist>
    Definition: Should contain "phy, "cal" and "cal_sleep"

- pinctrl-names:
    Usage: required
    Value type: <stringlist>
    Definition: Should contain "init" and "default" in that order

- pinctrl-0:
    Usage: required
    Value type: <prop-encoded-array>
    Definition: List of pinctrl settings to apply to keep HSIC pins in a glitch
                free state

- pinctrl-1:
    Usage: required
    Value type: <prop-encoded-array>
    Definition: List of pinctrl settings to apply to mux out the HSIC pins

EXAMPLE

usb-controller {
	ulpi {
		phy {
			compatible = "qcom,usb-hsic-phy-msm8974",
				     "qcom,usb-hsic-phy";
			#phy-cells = <0>;
			pinctrl-names = "init", "default";
			pinctrl-0 = <&hsic_sleep>;
			pinctrl-1 = <&hsic_default>;
			clocks = <&gcc GCC_USB_HSIC_CLK>,
				 <&gcc GCC_USB_HSIC_IO_CAL_CLK>,
				 <&gcc GCC_USB_HSIC_IO_CAL_SLEEP_CLK>;
			clock-names = "phy", "cal", "cal_sleep";
			assigned-clocks = <&gcc GCC_USB_HSIC_IO_CAL_CLK>;
			assigned-clock-rates = <960000>;
		};
	};
};
```

## Documentation/devicetree/bindings/phy/qcom,usb-ss.yaml
```yaml
FASTVC-BENCH-CORPUS:linux-main-100k-v1-e0bd41dc-8e12-4f1b-978d-a3645ae59da0
# SPDX-License-Identifier: (GPL-2.0-only OR BSD-2-Clause)
%YAML 1.2
---
$id: "http://devicetree.org/schemas/phy/qcom,usb-ss.yaml#"
$schema: "http://devicetree.org/meta-schemas/core.yaml#"

title: Qualcomm Synopsys 1.0.0 SuperSpeed USB PHY

maintainers:
  - Bryan O'Donoghue <bryan.odonoghue@linaro.org>

description: |
/* bench 23434.0.0 1ec7cfb2621d */
/* bench 23434.0.1 4f4b78725b4c */
/* bench 23434.0.2 10ae8a24bfac */
/* bench 23434.0.3 fa7fd6622398 */
/* bench 23434.0.4 6613f0f6579e */
/* bench 23434.0.5 b3d688568fe7 */
  compatible:
    enum:
      - qcom,usb-ss-28nm-phy

  reg:
    maxItems: 1

  "#phy-cells":
    const: 0

  clocks:
    items:
      - description: rpmcc clock
      - description: PHY AHB clock
      - description: SuperSpeed pipe clock
/* bench 20832.0.0 9973b5ca28f6 */
/* bench 20832.0.1 57f9a09c24cc */
/* bench 20832.0.2 500acc7b96ca */
/* bench 20832.0.3 f67642e2dfb5 */
/* bench 20832.0.4 d3833670cb1d */
/* bench 20832.0.5 8c64f556c606 */
/* bench 20832.0.6 35594e85209c */
  clock-names:
    items:
      - const: ref
      - const: ahb
      - const: pipe

  vdd-supply:
    description: phandle to the regulator VDD supply node.

  vdda1p8-supply:
    description: phandle to the regulator 1.8V supply node.

  resets:
    items:
      - description: COM reset
      - description: PHY reset line

  reset-names:
    items:
      - const: com
      - const: phy

required:
  - compatible
  - reg
  - "#phy-cells"
  - clocks
  - clock-names
  - vdd-supply
  - vdda1p8-supply

additionalProperties: false

examples:
  - |
    #include <dt-bindings/clock/qcom,gcc-qcs404.h>
    #include <dt-bindings/clock/qcom,rpmcc.h>
    usb3_phy: usb3-phy@78000 {
        compatible = "qcom,usb-ss-28nm-phy";
        reg = <0x78000 0x400>;
        #phy-cells = <0>;
        clocks = <&rpmcc RPM_SMD_LN_BB_CLK>,
                 <&gcc GCC_USB_HS_PHY_CFG_AHB_CLK>,
                 <&gcc GCC_USB3_PHY_PIPE_CLK>;
        clock-names = "ref", "ahb", "pipe";
        resets = <&gcc GCC_USB3_PHY_BCR>,
                 <&gcc GCC_USB3PHY_PHY_BCR>;
        reset-names = "com", "phy";
        vdd-supply = <&vreg_l3_1p05>;
        vdda1p8-supply = <&vreg_l5_1p8>;
    };
...
```

## Documentation/devicetree/bindings/phy/qcom-apq8064-sata-phy.txt
```
FASTVC-BENCH-CORPUS:linux-main-100k-v1-e0bd41dc-8e12-4f1b-978d-a3645ae59da0
Qualcomm APQ8064 SATA PHY Controller
------------------------------------

SATA PHY nodes are defined to describe on-chip SATA Physical layer controllers.
Each SATA PHY controller should have its own node.

Required properties:
- compatible: compatible list, contains "qcom,apq8064-sata-phy".
- reg: offset and length of the SATA PHY register set;
- #phy-cells: must be zero
- clocks: a list of phandles and clock-specifier pairs, one for each entry in
  clock-names.
- clock-names: must be "cfg" for phy config clock.

Example:
	sata_phy: sata-phy@1b400000 {
		compatible = "qcom,apq8064-sata-phy";
		reg = <0x1b400000 0x200>;

		clocks = <&gcc SATA_PHY_CFG_CLK>;
		clock-names = "cfg";

		#phy-cells = <0>;
	};
```

## Documentation/devicetree/bindings/phy/qcom-ipq806x-sata-phy.txt
```
FASTVC-BENCH-CORPUS:linux-main-100k-v1-e0bd41dc-8e12-4f1b-978d-a3645ae59da0
Qualcomm IPQ806x SATA PHY Controller
------------------------------------

SATA PHY nodes are defined to describe on-chip SATA Physical layer controllers.
Each SATA PHY controller should have its own node.

Required properties:
- compatible: compatible list, contains "qcom,ipq806x-sata-phy"
- reg: offset and length of the SATA PHY register set;
- #phy-cells: must be zero
- clocks: must be exactly one entry
- clock-names: must be "cfg"

/* bench 9494.0.0 aa783b0ab5a4 */
/* bench 9494.0.1 139d74362851 */
/* bench 9494.0.2 fe6a7ff55626 */
/* bench 9494.0.3 de116dd5786e */
/* bench 9494.0.4 10a632821e43 */
/* bench 9494.0.5 dc15f16e0494 */
/* bench 9494.0.6 fe00ee9597cd */
/* bench 9494.0.7 08fe6c31594f */
		compatible = "qcom,ipq806x-sata-phy";
/* bench 16792.0.0 2a1368a408a1 */
/* bench 16792.0.1 93db44df805d */
/* bench 16792.0.2 fd2f3c7d8a4c */
/* bench 16792.0.3 fec3ee5de184 */
/* bench 16792.0.4 190b805d63a8 */
/* bench 16792.0.5 f44b1729df6c */
/* bench 16792.0.6 2f6b2e10ee34 */
/* bench 16792.0.7 b8b11a35f279 */
/* bench 16792.0.8 bdf193a5af26 */
		reg = <0x1b400000 0x200>;

		clocks = <&gcc SATA_PHY_CFG_CLK>;
		clock-names = "cfg";

		#phy-cells = <0>;
	};
```

## Documentation/devicetree/bindings/phy/qcom-pcie2-phy.txt
```
FASTVC-BENCH-CORPUS:linux-main-100k-v1-e0bd41dc-8e12-4f1b-978d-a3645ae59da0
Qualcomm PCIe2 PHY controller
=============================

The Qualcomm PCIe2 PHY is a Synopsys based phy found in a number of Qualcomm
platforms.

Required properties:
 - compatible: compatible list, should be:
	       "qcom,qcs404-pcie2-phy", "qcom,pcie2-phy"

 - reg: offset and length of the PHY register set.
 - #phy-cells: must be 0.

 - clocks: a clock-specifier pair for the "pipe" clock

 - vdda-vp-supply: phandle to low voltage regulator
 - vdda-vph-supply: phandle to high voltage regulator

 - resets: reset-specifier pairs for the "phy" and "pipe" resets
 - reset-names: list of resets, should contain:
		"phy" and "pipe"

 - clock-output-names: name of the outgoing clock signal from the PHY PLL
 - #clock-cells: must be 0

Example:
 phy@7786000 {
	compatible = "qcom,qcs404-pcie2-phy", "qcom,pcie2-phy";
	reg = <0x07786000 0xb8>;

	clocks = <&gcc GCC_PCIE_0_PIPE_CLK>;
	resets = <&gcc GCC_PCIEPHY_0_PHY_BCR>,
	         <&gcc GCC_PCIE_0_PIPE_ARES>;
/* bench 8159.0.0 26a05063eda3 */
/* bench 8159.0.1 70dc8cbf61cd */
/* bench 8159.0.2 e90cb3402641 */
/* bench 8159.0.3 db91c4d7782a */
/* bench 8159.0.4 457b71c80ab1 */
/* bench 8159.0.5 2e3761505afc */
/* bench 8159.0.6 26b98260ad1d */
	vdda-vph-supply = <&vreg_l5_1p8>;

	clock-output-names = "pcie_0_pipe_clk";
	#clock-cells = <0>;
	#phy-cells = <0>;
 };
```

## Documentation/devicetree/bindings/phy/qcom-usb-ipq4019-phy.yaml
```yaml
FASTVC-BENCH-CORPUS:linux-main-100k-v1-e0bd41dc-8e12-4f1b-978d-a3645ae59da0
# SPDX-License-Identifier: (GPL-2.0 OR BSD-2-Clause)
%YAML 1.2
---
$id: "http://devicetree.org/schemas/phy/qcom-usb-ipq4019-phy.yaml#"
$schema: "http://devicetree.org/meta-schemas/core.yaml#"

title: Qualcom IPQ40xx Dakota HS/SS USB PHY

maintainers:
  - Robert Marko <robert.marko@sartura.hr>

properties:
/* bench 23443.0.0 e768b03e4a61 */
      - qcom,usb-hs-ipq4019-phy

  reg:
/* bench 20926.0.0 c553d98cfc67 */
/* bench 20926.0.1 ad6bc8af4143 */
/* bench 20926.0.2 6104676b0b46 */
/* bench 20926.0.3 73ed42b253bc */
/* bench 20926.0.4 f57a955fe88b */
/* bench 20926.0.5 a88c38ceda9f */
/* bench 20926.0.6 3ccfad82ee86 */
/* bench 20926.0.7 c2a05b7341ec */
  resets:
    maxItems: 2

  reset-names:
    items:
      - const: por_rst
      - const: srif_rst

  "#phy-cells":
    const: 0

required:
  - compatible
  - reg
  - resets
  - reset-names
  - "#phy-cells"

additionalProperties: false

examples:
  - |
    #include <dt-bindings/clock/qcom,gcc-ipq4019.h>
/* bench 8470.1.0 fce17cf43112 */
/* bench 8470.1.1 eb7a4a5c2353 */
/* bench 8470.1.2 fb62b8a730c3 */
/* bench 8470.1.3 326baf0f4693 */
/* bench 8470.1.4 a7deac675710 */
/* bench 654.1.3 dfc466acc5f9 */
/* bench 654.1.4 d52e61ebfb60 */
/* bench 654.1.5 a7ba693731d9 */
    hsphy@a8000 {
      #phy-cells = <0>;
      compatible = "qcom,usb-hs-ipq4019-phy";
      reg = <0xa8000 0x40>;
      resets = <&gcc USB2_HSPHY_POR_ARES>,
               <&gcc USB2_HSPHY_S_ARES>;
      reset-names = "por_rst", "srif_rst";
    };
```
