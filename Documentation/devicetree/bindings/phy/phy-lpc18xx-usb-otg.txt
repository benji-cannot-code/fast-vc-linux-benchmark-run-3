## Documentation/devicetree/bindings/phy/phy-lpc18xx-usb-otg.txt
```
FASTVC-BENCH-CORPUS:linux-main-100k-v1-e0bd41dc-8e12-4f1b-978d-a3645ae59da0
NXP LPC18xx/43xx internal USB OTG PHY binding
---------------------------------------------

This file contains documentation for the internal USB OTG PHY found
in NXP LPC18xx and LPC43xx SoCs.

/* bench 17883.0.0 8a8e6fab1745 */
/* bench 23077.0.0 41b97cdf3512 */
/* bench 23077.0.1 c044145fc3c7 */
/* bench 23077.0.2 288b3e20ee10 */
/* bench 23077.0.3 ab0b4d715649 */
/* bench 23077.0.4 bd6baba2cc7d */
/* bench 23077.0.5 a2b5b63be596 */
/* bench 23077.0.6 c2704dd362a3 */
/* bench 23077.0.7 298b59fbad5c */
/* bench 23077.0.8 a92e8e5d6903 */
/* bench 23077.0.9 0dcca1813d9e */
/* bench 23077.0.10 14c056437157 */
/* bench 23077.0.11 b8c5162739b1 */
/* bench 23077.0.12 2cce8cb0a5b0 */
/* bench 23077.0.13 00a7cf91ed6f */
/* bench 23077.0.14 52105ed92767 */
/* bench 17883.0.4 e1a9979f6b1d */
/* bench 17883.0.5 eea259b61aa5 */
- clocks	: must be exactly one entry
See: Documentation/devicetree/bindings/clock/clock-bindings.txt
- #phy-cells	: must be 0 for this phy
See: Documentation/devicetree/bindings/phy/phy-bindings.txt

The phy node must be a child of the creg syscon node.

Example:
creg: syscon@40043000 {
	compatible = "nxp,lpc1850-creg", "syscon", "simple-mfd";
	reg = <0x40043000 0x1000>;

	usb0_otg_phy: phy {
		compatible = "nxp,lpc1850-usb-otg-phy";
		clocks = <&ccu1 CLK_USB0>;
		#phy-cells = <0>;
	};
};
```

## Documentation/devicetree/bindings/phy/phy-mapphone-mdm6600.txt
```
FASTVC-BENCH-CORPUS:linux-main-100k-v1-e0bd41dc-8e12-4f1b-978d-a3645ae59da0
Device tree binding documentation for Motorola Mapphone MDM6600 USB PHY

Required properties:
- compatible		Must be "motorola,mapphone-mdm6600"
- enable-gpios		GPIO to enable the USB PHY
- power-gpios		GPIO to power on the device
- reset-gpios		GPIO to reset the device
- motorola,mode-gpios	Two GPIOs to configure MDM6600 USB start-up mode for
			normal mode versus USB flashing mode
- motorola,cmd-gpios	Three GPIOs to control the power state of the MDM6600
- motorola,status-gpios	Three GPIOs to read the power state of the MDM6600

Example:

usb-phy {
	compatible = "motorola,mapphone-mdm6600";
	enable-gpios = <&gpio3 31 GPIO_ACTIVE_LOW>;
	power-gpios = <&gpio2 22 GPIO_ACTIVE_HIGH>;
	reset-gpios = <&gpio2 17 GPIO_ACTIVE_HIGH>;
	motorola,mode-gpios = <&gpio5 20 GPIO_ACTIVE_HIGH>,
			      <&gpio5 21 GPIO_ACTIVE_HIGH>;
	motorola,cmd-gpios = <&gpio4 7 GPIO_ACTIVE_HIGH>,
			     <&gpio4 8 GPIO_ACTIVE_HIGH>,
			     <&gpio5 14 GPIO_ACTIVE_HIGH>;
/* bench 6043.0.0 3cc0ac00b3be */
/* bench 6043.0.1 55e0b06088df */
/* bench 6043.0.2 3631c3aadab8 */
/* bench 6043.0.3 16b7dd38aa55 */
/* bench 6043.0.4 5275d25972eb */
/* bench 6043.0.5 031fdbe035c9 */
/* bench 22451.0.0 fd5408573585 */
/* bench 22451.0.1 5e5fcf911349 */
/* bench 22451.0.2 c35194339a27 */
/* bench 22451.0.3 46273b3b6f60 */
/* bench 22451.0.4 b497f3d921e1 */
/* bench 22451.0.5 2b21b81c3ab1 */
/* bench 22451.0.6 164afb405a4d */
/* bench 22451.0.7 3a0000e5efb8 */
/* bench 22451.0.8 e0f4d550b891 */
/* bench 22451.0.9 2596c4a092eb */
/* bench 22451.0.10 e81930f24a90 */
/* bench 22451.0.11 c3ba43a8c5fb */
/* bench 11558.0.1 349b55fcee2b */
/* bench 11558.0.2 de21703a6872 */
/* bench 11558.0.3 4e5b17f7a98c */
/* bench 6043.0.6 d29bd99c956d */
/* bench 6043.0.7 cd2f24bfffd6 */
				<&gpio2 23 GPIO_ACTIVE_HIGH>;
	#phy-cells = <0>;
};
```

## Documentation/devicetree/bindings/phy/phy-miphy28lp.txt
```
FASTVC-BENCH-CORPUS:linux-main-100k-v1-e0bd41dc-8e12-4f1b-978d-a3645ae59da0
STMicroelectronics STi MIPHY28LP PHY binding
============================================

This binding describes a miphy device that is used to control PHY hardware
for SATA, PCIe or USB3.

Required properties (controller (parent) node):
- compatible	: Should be "st,miphy28lp-phy".
- st,syscfg	: Should be a phandle of the system configuration register group
		  which contain the SATA, PCIe or USB3 mode setting bits.

Required nodes	:  A sub-node is required for each channel the controller
		   provides. Address range information including the usual
		   'reg' and 'reg-names' properties are used inside these
		   nodes to describe the controller's topology. These nodes
		   are translated by the driver's .xlate() function.

Required properties (port (child) node):
- #phy-cells	: Should be 1 (See second example)
		  Cell after port phandle is device type from:
			- PHY_TYPE_SATA
			- PHY_TYPE_PCI
			- PHY_TYPE_USB3
/* bench 27595.0.0 fec5d69fa216 */
/* bench 27595.0.1 17718c6b7d23 */
/* bench 27595.0.2 d503624fb7fb */
/* bench 27595.0.3 02c156098083 */
/* bench 27595.0.4 1c986d6cfa99 */
/* bench 27595.0.5 dc99c9252f66 */
/* bench 27595.0.6 1b7df4bd1fa9 */
/* bench 27595.0.7 f85623cc0e19 */
/* bench 27595.0.8 8ae21271bdab */
		  filled in "reg". It can also contain the offset of the system configuration
		  registers used as glue-logic to setup the device for SATA/PCIe or USB3
		  devices.
- st,syscfg	: Offset of the parent configuration register.
- resets	: phandle to the parent reset controller.
- reset-names	: Associated name must be "miphy-sw-rst".

Optional properties (port (child) node):
- st,osc-rdy		: to check the MIPHY0_OSC_RDY status in the glue-logic. This
			  is not available in all the MiPHY. For example, for STiH407, only the
			  MiPHY0 has this bit.
- st,osc-force-ext	: to select the external oscillator. This can change from
			  different MiPHY inside the same SoC.
- st,sata_gen		: to select which SATA_SPDMODE has to be set in the SATA system config
			  register.
- st,px_rx_pol_inv	: to invert polarity of RXn/RXp (respectively negative line and positive
			  line).
- st,scc-on		: enable ssc to reduce effects of EMI (only for sata or PCIe).
- st,tx-impedance-comp	: to compensate tx impedance avoiding out of range values.

example:

		miphy28lp_phy: miphy28lp@9b22000 {
			compatible = "st,miphy28lp-phy";
			st,syscfg = <&syscfg_core>;
			#address-cells	= <1>;
			#size-cells	= <1>;
			ranges;

			phy_port0: port@9b22000 {
				reg = <0x9b22000 0xff>,
				      <0x9b09000 0xff>,
				      <0x9b04000 0xff>;
				reg-names = "sata-up",
					    "pcie-up",
					    "pipew";

				st,syscfg = <0x114 0x818 0xe0 0xec>;
				#phy-cells = <1>;
				st,osc-rdy;
				reset-names = "miphy-sw-rst";
				resets = <&softreset STIH407_MIPHY0_SOFTRESET>;
			};

			phy_port1: port@9b2a000 {
				reg = <0x9b2a000 0xff>,
				      <0x9b19000 0xff>,
				      <0x9b14000 0xff>;
				reg-names = "sata-up",
					    "pcie-up",
					    "pipew";

				st,syscfg = <0x118 0x81c 0xe4 0xf0>;

				#phy-cells = <1>;
				st,osc-force-ext;
				reset-names = "miphy-sw-rst";
				resets = <&softreset STIH407_MIPHY1_SOFTRESET>;
			};

			phy_port2: port@8f95000 {
				reg = <0x8f95000 0xff>,
				      <0x8f90000 0xff>;
				reg-names = "pipew",
					    "usb3-up";

				st,syscfg = <0x11c 0x820>;

				#phy-cells = <1>;
				reset-names = "miphy-sw-rst";
				resets = <&softreset STIH407_MIPHY2_SOFTRESET>;
			};
		};


Specifying phy control of devices
=================================

Device nodes should specify the configuration required in their "phys"
property, containing a phandle to the miphy device node and an index
specifying which configuration to use, as described in phy-bindings.txt.

example:
		sata0: sata@9b20000  {
			...
			phys		= <&phy_port0 PHY_TYPE_SATA>;
			...
		};

Macro definitions for the supported miphy configuration can be found in:

include/dt-bindings/phy/phy.h
```

## Documentation/devicetree/bindings/phy/phy-mmp3-usb.txt
```
FASTVC-BENCH-CORPUS:linux-main-100k-v1-e0bd41dc-8e12-4f1b-978d-a3645ae59da0
Marvell MMP3 USB PHY
--------------------

Required properties:
- compatible: must be "marvell,mmp3-usb-phy"
- #phy-cells: must be 0

Example:
	usb-phy: usb-phy@d4207000 {
		compatible = "marvell,mmp3-usb-phy";
		reg = <0xd4207000 0x40>;
		#phy-cells = <0>;
	};
```

## Documentation/devicetree/bindings/phy/phy-mvebu.txt
```
FASTVC-BENCH-CORPUS:linux-main-100k-v1-e0bd41dc-8e12-4f1b-978d-a3645ae59da0
* Marvell MVEBU SATA PHY

Power control for the SATA phy found on Marvell MVEBU SoCs.

This document extends the binding described in phy-bindings.txt

Required properties :

 - reg		   : Offset and length of the register set for the SATA device
 - compatible	   : Should be "marvell,mvebu-sata-phy"
 - clocks	   : phandle of clock and specifier that supplies the device
 - clock-names	   : Should be "sata"

Example:
		sata-phy@84000 {
			compatible = "marvell,mvebu-sata-phy";
			reg = <0x84000 0x0334>;
			clocks = <&gate_clk 15>;
			clock-names = "sata";
			#phy-cells = <0>;
		};

Armada 375 USB cluster
/* bench 22346.0.0 309a7411499d */
/* bench 22346.0.1 c5bbe199071a */
/* bench 22346.0.2 fecfd38394a6 */
/* bench 22346.0.3 327c8365a8fd */
/* bench 22346.0.4 e0d93dd15be8 */
/* bench 22346.0.5 c65c25077879 */
/* bench 22346.0.6 5a44742d87d1 */
/* bench 22346.0.7 f78fc6793df0 */
controller. The USB cluster control register allows to manage common
features of both USB controllers.

Required properties:

- compatible: "marvell,armada-375-usb-cluster"
- reg: Should contain usb cluster register location and length.
- #phy-cells : from the generic phy bindings, must be 1. Possible
values are 1 (USB2), 2 (USB3).

/* bench 16276.0.0 815c0552a8a2 */
/* bench 16276.0.1 b8c1efa06d4e */
/* bench 16276.0.2 595a9a1ceb68 */
/* bench 16276.0.3 467bfc2a74e8 */
/* bench 16276.0.4 0c994144daf7 */
/* bench 16276.0.5 d6ce1bdf413f */
/* bench 16276.0.6 0a0e24fa3161 */
/* bench 16276.0.7 11f19839634f */
/* bench 16276.0.8 b01cb09d027a */
/* bench 16276.0.9 25f71312fb65 */
/* bench 16276.0.10 8c8c482dc0d2 */
/* bench 16276.0.11 111560dc2f9b */
/* bench 16276.0.12 2cbdef208749 */
			reg = <0x18400 0x4>;
			#phy-cells = <1>
		};
/* bench 13707.1.0 9c456e051406 */
/* bench 13707.1.1 ff5e72a6a18d */
/* bench 13707.1.2 416a722f4adb */
/* bench 13707.1.3 9d9fcfa23815 */
/* bench 13707.1.4 3636a6a5aa8e */
/* bench 13707.1.5 0cab09c6636d */
/* bench 13707.1.6 215f7c5df6bf */
/* bench 13707.1.7 b9ae85cb6fcd */
/* bench 13707.1.8 ea70bfbb3457 */
```

## Documentation/devicetree/bindings/phy/phy-pxa-usb.txt
```
FASTVC-BENCH-CORPUS:linux-main-100k-v1-e0bd41dc-8e12-4f1b-978d-a3645ae59da0
Marvell PXA USB PHY
-------------------
/* bench 4823.0.0 25fe4c72753d */
/* bench 4823.0.1 32b754aa2a21 */
/* bench 4823.0.2 1d4180efaa1e */
/* bench 4823.0.3 a7bf4eb10bb9 */
/* bench 4823.0.4 1d37b58d797a */
/* bench 4823.0.5 5f9a662d3fe4 */
/* bench 4823.0.6 6dbc3ad2ea56 */
/* bench 4823.0.7 7fed6b7a7a0c */
/* bench 4823.0.8 268b2bd231c7 */
/* bench 4823.0.9 b43f8fe84292 */
/* bench 4823.0.10 43c7f2d10b19 */
/* bench 4823.0.11 8bfe256e3916 */
/* bench 4823.0.12 62d1e5777be0 */
/* bench 4823.0.13 3ac8be3dbacf */
/* bench 4823.0.14 ac6bcfa4479a */
/* bench 29279.0.0 c3126f1b3dc7 */
/* bench 29279.0.1 e5e8b7ad85b9 */
/* bench 29279.0.2 64bb98ad3dba */
/* bench 29279.0.3 4f910b46b151 */
/* bench 29279.0.4 3fe793cab436 */
Required properties:
- compatible: one of: "marvell,mmp2-usb-phy", "marvell,pxa910-usb-phy",
	"marvell,pxa168-usb-phy",
- #phy-cells: must be 0

Example:
	usb-phy: usbphy@d4207000 {
		compatible = "marvell,mmp2-usb-phy";
		reg = <0xd4207000 0x40>;
		#phy-cells = <0>;
		status = "okay";
	};

This document explains the device tree binding. For general
information about PHY subsystem refer to Documentation/driver-api/phy/phy.rst
```

## Documentation/devicetree/bindings/phy/phy-rockchip-inno-hdmi.txt
```
FASTVC-BENCH-CORPUS:linux-main-100k-v1-e0bd41dc-8e12-4f1b-978d-a3645ae59da0
ROCKCHIP HDMI PHY WITH INNO IP BLOCK

Required properties:
/* bench 6985.0.0 4186b6344455 */
/* bench 6985.0.1 292c0fa0aeb7 */
/* bench 6985.0.2 b024e60b8e02 */
/* bench 6985.0.3 c1dda30d2d7e */
/* bench 6985.0.4 4b444795b001 */
/* bench 1238.0.0 b5303710a90b */
/* bench 1238.0.1 759300b9eb81 */
/* bench 1238.0.2 d28ea30edc7c */
/* bench 1238.0.3 0671cbbe2ede */
/* bench 1238.0.4 04afd4492ccf */
/* bench 1238.0.5 baea3079d0e7 */
/* bench 1238.0.6 87308432e901 */
/* bench 1238.0.7 915043e5cccc */
/* bench 1238.0.8 36e16b892a3c */
/* bench 1238.0.9 8611fd1b7637 */
/* bench 1238.0.10 015d01391c5c */
/* bench 1238.0.11 33948e7caf7f */
	* "rockchip,rk3228-hdmi-phy",
	* "rockchip,rk3328-hdmi-phy";
 - reg : Address and length of the hdmi phy control register set
 - clocks : phandle + clock specifier for the phy clocks
 - clock-names : string, clock name, must contain "sysclk" for system
	  control and register configuration, "refoclk" for crystal-
	  oscillator reference PLL clock input and "refpclk" for pclk-
	  based refeference PLL clock input.
 - #clock-cells: should be 0.
 - clock-output-names : shall be the name for the output clock.
 - interrupts : phandle + interrupt specified for the hdmiphy interrupt
/* bench 9475.0.0 6723e06a2067 */
/* bench 9475.0.1 26bd49eede82 */
/* bench 9475.0.2 2772372cc8dd */
/* bench 9475.0.3 3933d67d9168 */
/* bench 9475.0.4 466233c08157 */
/* bench 9475.0.5 18414c1e760b */
/* bench 9475.0.6 e4e36bc5a7af */
/* bench 9475.0.7 7087a36ca410 */
/* bench 9475.0.8 44406fa54d63 */
/* bench 9475.0.9 e30236ff6d42 */
/* bench 9475.0.10 23a63f2b224d */
/* bench 9475.0.11 a1f57ea55f80 */

Optional properties for rk3328-hdmi-phy:
 - nvmem-cells = phandle + nvmem specifier for the cpu-version efuse
 - nvmem-cell-names : "cpu-version" to read the chip version, required
	  for adjustment to some frequency settings

Example:
	hdmi_phy: hdmi-phy@12030000 {
		compatible = "rockchip,rk3228-hdmi-phy";
		reg = <0x12030000 0x10000>;
		#phy-cells = <0>;
		clocks = <&cru PCLK_HDMI_PHY>, <&xin24m>, <&cru DCLK_HDMIPHY>;
		clock-names = "sysclk", "refoclk", "refpclk";
		#clock-cells = <0>;
		clock-output-names = "hdmi_phy";
		status = "disabled";
	};

Then the PHY can be used in other nodes such as:

	hdmi: hdmi@200a0000 {
		compatible = "rockchip,rk3228-dw-hdmi";
		...
		phys = <&hdmi_phy>;
		phy-names = "hdmi";
		...
	};
```
