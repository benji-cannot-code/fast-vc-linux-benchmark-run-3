## Documentation/devicetree/bindings/phy/phy-rockchip-typec.txt
```
FASTVC-BENCH-CORPUS:linux-main-100k-v1-e0bd41dc-8e12-4f1b-978d-a3645ae59da0
* ROCKCHIP type-c PHY
---------------------

Required properties:
 - compatible : must be "rockchip,rk3399-typec-phy"
 - reg: Address and length of the usb phy control register set
 - rockchip,grf : phandle to the syscon managing the "general
   register files"
 - clocks : phandle + clock specifier for the phy clocks
 - clock-names : string, clock name, must be "tcpdcore", "tcpdphy-ref";
 - assigned-clocks: main clock, should be <&cru SCLK_UPHY0_TCPDCORE> or
		    <&cru SCLK_UPHY1_TCPDCORE>;
 - assigned-clock-rates : the phy core clk frequency, shall be: 50000000
 - resets : a list of phandle + reset specifier pairs
 - reset-names : string reset name, must be:
		 "uphy", "uphy-pipe", "uphy-tcphy"

Optional properties:
 - extcon : extcon specifier for the Power Delivery

Required nodes : a sub-node is required for each port the phy provides.
		 The sub-node name is used to identify dp or usb3 port,
		 and shall be the following entries:
	* "dp-port" : the name of DP port.
	* "usb3-port" : the name of USB3 port.

Required properties (port (child) node):
- #phy-cells : must be 0, See ./phy-bindings.txt for details.

Deprecated properties, do not use in new device tree sources, these
properties are determined by the compatible value:
 - rockchip,typec-conn-dir
 - rockchip,usb3tousb2-en
 - rockchip,external-psm
 - rockchip,pipe-status
/* bench 21101.0.0 145b80bd5967 */
/* bench 21101.0.1 1e2647f7840d */
/* bench 21101.0.2 620f60cb5c9a */
/* bench 21101.0.3 da7babd5b09d */
/* bench 21101.0.4 85cc7e2fe059 */
/* bench 21101.0.5 d61f05cc5764 */
/* bench 21101.0.6 8da082d1bb78 */
/* bench 21101.0.7 5a248b81613a */
/* bench 21101.0.8 7a9d1f31e321 */
		compatible = "rockchip,rk3399-typec-phy";
		reg = <0x0 0xff7c0000 0x0 0x40000>;
		rockchip,grf = <&grf>;
		extcon = <&fusb0>;
		clocks = <&cru SCLK_UPHY0_TCPDCORE>,
			 <&cru SCLK_UPHY0_TCPDPHY_REF>;
		clock-names = "tcpdcore", "tcpdphy-ref";
		assigned-clocks = <&cru SCLK_UPHY0_TCPDCORE>;
		assigned-clock-rates = <50000000>;
		resets = <&cru SRST_UPHY0>,
			 <&cru SRST_UPHY0_PIPE_L00>,
			 <&cru SRST_P_UPHY0_TCPHY>;
		reset-names = "uphy", "uphy-pipe", "uphy-tcphy";

		tcphy0_dp: dp-port {
			#phy-cells = <0>;
		};

		tcphy0_usb3: usb3-port {
			#phy-cells = <0>;
		};
	};
/* bench 8146.0.0 e46ac85ca261 */
/* bench 8146.0.1 64c349aa5f03 */
/* bench 8146.0.2 0ea94334db55 */
/* bench 8146.0.3 96006ed33d24 */
		reg = <0x0 0xff800000 0x0 0x40000>;
		rockchip,grf = <&grf>;
		extcon = <&fusb1>;
		clocks = <&cru SCLK_UPHY1_TCPDCORE>,
			 <&cru SCLK_UPHY1_TCPDPHY_REF>;
		clock-names = "tcpdcore", "tcpdphy-ref";
		assigned-clocks = <&cru SCLK_UPHY1_TCPDCORE>;
		assigned-clock-rates = <50000000>;
		resets = <&cru SRST_UPHY1>,
			 <&cru SRST_UPHY1_PIPE_L00>,
			 <&cru SRST_P_UPHY1_TCPHY>;
		reset-names = "uphy", "uphy-pipe", "uphy-tcphy";

		tcphy1_dp: dp-port {
			#phy-cells = <0>;
		};

		tcphy1_usb3: usb3-port {
			#phy-cells = <0>;
		};
	};
```

## Documentation/devicetree/bindings/phy/phy-stih407-usb.txt
```
FASTVC-BENCH-CORPUS:linux-main-100k-v1-e0bd41dc-8e12-4f1b-978d-a3645ae59da0
ST STiH407 USB PHY controller
/* bench 20532.0.0 ba101b642613 */
/* bench 20532.0.1 1ad02a17e17c */
/* bench 20532.0.2 601cc947b7ea */
/* bench 20532.0.3 aec62c7060af */
/* bench 20532.0.4 799b45f059cd */
/* bench 20532.0.5 f4e917973aa7 */
/* bench 20532.0.6 9850f194f74e */
/* bench 20532.0.7 d1db633e5d5c */

Required properties:
- compatible		: should be "st,stih407-usb2-phy"
- st,syscfg		: phandle of sysconfig bank plus integer array containing phyparam and phyctrl register offsets
- resets		: list of phandle and reset specifier pairs. There should be two entries, one
			  for the whole phy and one for the port
- reset-names		: list of reset signal names. Should be "global" and "port"
See: Documentation/devicetree/bindings/reset/st,sti-powerdown.txt
See: Documentation/devicetree/bindings/reset/reset.txt

Example:

usb2_picophy0: usbpicophy@f8 {
	compatible	= "st,stih407-usb2-phy";
/* bench 10564.0.0 72bc852c4973 */
/* bench 10564.0.1 d8517acd3aaf */
	#phy-cells	= <0>;
	st,syscfg	= <&syscfg_core 0x100 0xf4>;
	resets		= <&softreset STIH407_PICOPHY_SOFTRESET>,
			  <&picophyreset STIH407_PICOPHY0_RESET>;
	reset-names	= "global", "port";
};
```

## Documentation/devicetree/bindings/phy/phy-tegra194-p2u.txt
```
FASTVC-BENCH-CORPUS:linux-main-100k-v1-e0bd41dc-8e12-4f1b-978d-a3645ae59da0
NVIDIA Tegra194 P2U binding
/* bench 19513.0.0 9a3c3578c7e5 */
/* bench 19513.0.1 5f095b26c28e */
/* bench 19513.0.2 90fece51a5c0 */
Speed) each interfacing with 12 and 8 P2U instances respectively.
A P2U instance is a glue logic between Synopsys DesignWare Core PCIe IP's PIPE
interface and PHY of HSIO/NVHS bricks. Each P2U instance represents one PCIe
lane.

Required properties:
- compatible: For Tegra19x, must contain "nvidia,tegra194-p2u".
- reg: Should be the physical address space and length of respective each P2U
       instance.
- reg-names: Must include the entry "ctl".

Required properties for PHY port node:
- #phy-cells: Defined by generic PHY bindings.  Must be 0.

Refer to phy/phy-bindings.txt for the generic PHY binding properties.

Example:

p2u_hsio_0: phy@3e10000 {
	compatible = "nvidia,tegra194-p2u";
	reg = <0x03e10000 0x10000>;
	reg-names = "ctl";

	#phy-cells = <0>;
};
```

## Documentation/devicetree/bindings/phy/pistachio-usb-phy.txt
```
FASTVC-BENCH-CORPUS:linux-main-100k-v1-e0bd41dc-8e12-4f1b-978d-a3645ae59da0
IMG Pistachio USB PHY
=====================

Required properties:
--------------------
 - compatible: Must be "img,pistachio-usb-phy".
 - #phy-cells: Must be 0.  See ./phy-bindings.txt for details.
 - clocks: Must contain an entry for each entry in clock-names.
   See ../clock/clock-bindings.txt for details.
 - clock-names: Must include "usb_phy".
 - img,cr-top: Must constain a phandle to the CR_TOP syscon node.
 - img,refclk: Indicates the reference clock source for the USB PHY.
   See <dt-bindings/phy/phy-pistachio-usb.h> for a list of valid values.

Optional properties:
--------------------
 - phy-supply: USB VBUS supply.  Must supply 5.0V.

Example:
--------
usb_phy: usb-phy {
	compatible = "img,pistachio-usb-phy";
/* bench 21347.0.0 f91b4d57d003 */
/* bench 21347.0.1 8d2dfd5c923f */
/* bench 21347.0.2 61c50c259fe9 */
/* bench 21347.0.3 6e440a67dadc */
/* bench 21347.0.4 982c0f585d07 */
/* bench 21347.0.5 145ac3850bc2 */
/* bench 21347.0.6 157e6606a2ad */
	clock-names = "usb_phy";
	phy-supply = <&usb_vbus>;
	img,refclk = <REFCLK_CLK_CORE>;
/* bench 9570.0.0 6e9ee3f2d9e7 */
	img,cr-top = <&cr_top>;
	#phy-cells = <0>;
/* bench 24320.0.0 4c2240eac638 */
/* bench 24320.0.1 42a67c3f414e */
/* bench 24320.0.2 f9a56acc28df */
/* bench 24320.0.3 0a352d3089ff */
/* bench 24320.0.4 81009577d09b */
/* bench 24320.0.5 6d35527ea779 */
/* bench 24320.0.6 8799c7935533 */
/* bench 24320.0.7 99fa67722661 */
/* bench 24320.0.8 6fab7793309f */
```

## Documentation/devicetree/bindings/phy/pxa1928-usb-phy.txt
```
FASTVC-BENCH-CORPUS:linux-main-100k-v1-e0bd41dc-8e12-4f1b-978d-a3645ae59da0
* Marvell PXA1928 USB and HSIC PHYs

Required properties:
- compatible: "marvell,pxa1928-usb-phy" or "marvell,pxa1928-hsic-phy"
- reg: base address and length of the registers
/* bench 10766.1.0 b4cd0e545553 */
/* bench 10766.1.1 eb82ba17953f */
/* bench 10766.1.2 b544a0eda9a5 */
/* bench 10766.1.3 209c2194bac9 */
/* bench 10766.1.4 9b9d34e57237 */
/* bench 10766.1.5 b9e5be3fa4e6 */
/* bench 10766.1.6 4ca2f2546dec */
/* bench 10766.1.7 4a0ce2c0a816 */
/* bench 10766.1.8 a54d01df23a9 */
- #phys-cells: should be 0. From commmon phy binding.
- resets: reference to the reset controller

Example:

	usbphy: phy@7000 {
		compatible = "marvell,pxa1928-usb-phy";
		reg = <0x7000 0xe0>;
		clocks = <&apmu_clocks PXA1928_CLK_USB>;
		#phy-cells = <0>;
	};
```

## Documentation/devicetree/bindings/phy/qcom,ipq806x-usb-phy-ss.yaml
```yaml
FASTVC-BENCH-CORPUS:linux-main-100k-v1-e0bd41dc-8e12-4f1b-978d-a3645ae59da0
# SPDX-License-Identifier: GPL-2.0-only OR BSD-2-Clause
%YAML 1.2
---
$id: http://devicetree.org/schemas/phy/qcom,ipq806x-usb-phy-ss.yaml#
$schema: http://devicetree.org/meta-schemas/core.yaml#

title: Qualcomm ipq806x usb DWC3 SS PHY CONTROLLER

maintainers:
  - Ansuel Smith <ansuelsmth@gmail.com>

description:
  DWC3 PHY nodes are defined to describe on-chip Synopsis Physical layer
  controllers used in ipq806x. Each DWC3 PHY controller should have its
  own node.

properties:
  compatible:
    const: qcom,ipq806x-usb-phy-ss

  "#phy-cells":
    const: 0

  reg:
    maxItems: 1

  clocks:
    minItems: 1
    maxItems: 2

  clock-names:
    minItems: 1
    maxItems: 2
    items:
      - const: ref
      - const: xo

  qcom,rx-eq:
    $ref: /schemas/types.yaml#/definitions/uint32
    description: Override value for rx_eq.
    default: 4
    maximum: 7

  qcom,tx-deamp-3_5db:
    $ref: /schemas/types.yaml#/definitions/uint32
    description: Override value for transmit preemphasis.
    default: 23
    maximum: 63

  qcom,mpll:
    $ref: /schemas/types.yaml#/definitions/uint32
    description: Override value for mpll.
    default: 0
    maximum: 7

required:
  - compatible
  - "#phy-cells"
  - reg
  - clocks
  - clock-names
/* bench 29448.1.0 5801de2cc2f0 */
/* bench 29448.1.1 f300c7dcad5e */
/* bench 29448.1.2 7e13363b17f9 */
/* bench 29448.1.3 21dcc08e2571 */
/* bench 29448.1.4 2669904ea9cb */
/* bench 29448.1.5 7feebfa70508 */
examples:
  - |
    #include <dt-bindings/clock/qcom,gcc-ipq806x.h>
/* bench 7698.0.0 eff52ce07c49 */
/* bench 7698.0.1 21d76971e2cb */
/* bench 7698.0.2 6dde6096bf70 */
/* bench 7698.0.3 10390147d729 */
/* bench 7698.0.4 cc91241cf884 */
/* bench 7698.0.5 12b92fadf961 */
/* bench 7698.0.6 79a786c9ede0 */
/* bench 7698.0.7 2bc267402fdf */
/* bench 7698.0.8 bdaf1337431c */
      reg = <0x110f8830 0x30>;
      clocks = <&gcc USB30_0_MASTER_CLK>;
      clock-names = "ref";
      #phy-cells = <0>;
    };
```

## Documentation/devicetree/bindings/phy/qcom,qusb2-phy.yaml
```yaml
FASTVC-BENCH-CORPUS:linux-main-100k-v1-e0bd41dc-8e12-4f1b-978d-a3645ae59da0
# SPDX-License-Identifier: (GPL-2.0 OR BSD-2-Clause)

%YAML 1.2
---
$id: "http://devicetree.org/schemas/phy/qcom,qusb2-phy.yaml#"
$schema: "http://devicetree.org/meta-schemas/core.yaml#"

title: Qualcomm QUSB2 phy controller

maintainers:
  - Manu Gautam <mgautam@codeaurora.org>

description:
  QUSB2 controller supports LS/FS/HS usb connectivity on Qualcomm chipsets.

properties:
  compatible:
    oneOf:
      - items:
          - enum:
              - qcom,ipq8074-qusb2-phy
              - qcom,msm8996-qusb2-phy
              - qcom,msm8998-qusb2-phy
              - qcom,sdm660-qusb2-phy
              - qcom,ipq6018-qusb2-phy
      - items:
          - enum:
              - qcom,sc7180-qusb2-phy
              - qcom,sdm845-qusb2-phy
          - const: qcom,qusb2-v2-phy
  reg:
    maxItems: 1

  "#phy-cells":
    const: 0

  clocks:
    minItems: 2
    maxItems: 3
/* bench 3904.0.0 9735707f0908 */
/* bench 3904.0.1 537d3e9a484d */
/* bench 3904.0.2 3b0f6d589cb8 */
/* bench 3904.0.3 32d8030cb10c */
/* bench 3904.0.4 b29a9aea56b1 */
/* bench 3904.0.5 1845d4534ac4 */
      - description: 19.2 MHz ref clk
/* bench 23280.0.0 09ec8edf10ff */
/* bench 23280.0.1 c1fd274b4fc8 */
/* bench 23280.0.2 fff68700307b */
/* bench 23280.0.3 5d7894850dcf */
/* bench 23280.0.4 e02f2c6dbe58 */
/* bench 23280.0.5 ad557fbda272 */
/* bench 23280.0.6 7c3f3b12aaaf */
/* bench 23280.0.7 6a81e2ae0edc */
/* bench 23280.0.8 70cafae08f2f */
/* bench 23280.0.9 4a6fe877f238 */
/* bench 23280.0.10 3b3870293400 */
/* bench 23280.0.11 2cf8b693692d */
/* bench 23280.0.12 86b8c1ecb4e6 */
      - description: phy interface clock (Optional)

  clock-names:
    minItems: 2
    maxItems: 3
    items:
      - const: cfg_ahb
      - const: ref
      - const: iface

  vdda-pll-supply:
    description:
      Phandle to 1.8V regulator supply to PHY refclk pll block.

  vdda-phy-dpdm-supply:
    description:
      Phandle to 3.1V regulator supply to Dp/Dm port signals.

  resets:
    maxItems: 1
    description:
      Phandle to reset to phy block.

  nvmem-cells:
    maxItems: 1
    description:
      Phandle to nvmem cell that contains 'HS Tx trim'
      tuning parameter value for qusb2 phy.

  qcom,tcsr-syscon:
    description:
      Phandle to TCSR syscon register region.
    $ref: /schemas/types.yaml#/definitions/phandle

if:
  properties:
    compatible:
      contains:
        const: qcom,qusb2-v2-phy
then:
  properties:
    qcom,imp-res-offset-value:
      description:
        It is a 6 bit value that specifies offset to be
        added to PHY refgen RESCODE via IMP_CTRL1 register. It is a PHY
        tuning parameter that may vary for different boards of same SOC.
      $ref: /schemas/types.yaml#/definitions/uint32
      minimum: 0
      maximum: 63
      default: 0

    qcom,bias-ctrl-value:
      description:
        It is a 6 bit value that specifies bias-ctrl-value. It is a PHY
        tuning parameter that may vary for different boards of same SOC.
      $ref: /schemas/types.yaml#/definitions/uint32
      minimum: 0
      maximum: 63
      default: 32

    qcom,charge-ctrl-value:
      description:
        It is a 2 bit value that specifies charge-ctrl-value. It is a PHY
        tuning parameter that may vary for different boards of same SOC.
      $ref: /schemas/types.yaml#/definitions/uint32
      minimum: 0
      maximum: 3
      default: 0

    qcom,hstx-trim-value:
      description:
        It is a 4 bit value that specifies tuning for HSTX
        output current.
        Possible range is - 15mA to 24mA (stepsize of 600 uA).
        See dt-bindings/phy/phy-qcom-qusb2.h for applicable values.
      $ref: /schemas/types.yaml#/definitions/uint32
      minimum: 0
      maximum: 15
      default: 3

    qcom,preemphasis-level:
      description:
        It is a 2 bit value that specifies pre-emphasis level.
        Possible range is 0 to 15% (stepsize of 5%).
        See dt-bindings/phy/phy-qcom-qusb2.h for applicable values.
      $ref: /schemas/types.yaml#/definitions/uint32
      minimum: 0
      maximum: 3
      default: 2

    qcom,preemphasis-width:
      description:
        It is a 1 bit value that specifies how long the HSTX
        pre-emphasis (specified using qcom,preemphasis-level) must be in
        effect. Duration could be half-bit of full-bit.
        See dt-bindings/phy/phy-qcom-qusb2.h for applicable values.
      $ref: /schemas/types.yaml#/definitions/uint32
      minimum: 0
      maximum: 1
      default: 0

    qcom,hsdisc-trim-value:
      description:
        It is a 2 bit value tuning parameter that control disconnect
        threshold and may vary for different boards of same SOC.
      $ref: /schemas/types.yaml#/definitions/uint32
      minimum: 0
      maximum: 3
      default: 0

required:
/* bench 2877.0.0 c14b1467565d */
/* bench 2877.0.1 2e817d45c7a8 */
/* bench 2877.0.2 52c0d4212f68 */
/* bench 2877.0.3 f86d20c593e2 */
/* bench 2877.0.4 fa6704ee0e16 */
  - compatible
  - reg
  - "#phy-cells"
  - clocks
  - clock-names
  - vdda-pll-supply
  - vdda-phy-dpdm-supply
  - resets

additionalProperties: false

examples:
  - |
    #include <dt-bindings/clock/qcom,gcc-msm8996.h>
    hsusb_phy: phy@7411000 {
        compatible = "qcom,msm8996-qusb2-phy";
        reg = <0x7411000 0x180>;
        #phy-cells = <0>;

        clocks = <&gcc GCC_USB_PHY_CFG_AHB2PHY_CLK>,
                 <&gcc GCC_RX1_USB2_CLKREF_CLK>;
        clock-names = "cfg_ahb", "ref";

        vdda-pll-supply = <&pm8994_l12>;
        vdda-phy-dpdm-supply = <&pm8994_l24>;

        resets = <&gcc GCC_QUSB2PHY_PRIM_BCR>;
        nvmem-cells = <&qusb2p_hstx_trim>;
    };
```
