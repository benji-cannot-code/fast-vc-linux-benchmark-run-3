## Documentation/devicetree/bindings/phy/ralink-usb-phy.txt
```
FASTVC-BENCH-CORPUS:linux-main-100k-v1-e0bd41dc-8e12-4f1b-978d-a3645ae59da0
Mediatek/Ralink USB PHY

Required properties:
 - compatible: "ralink,rt3352-usbphy"
	       "mediatek,mt7620-usbphy"
	       "mediatek,mt7628-usbphy"
 - reg: required for "mediatek,mt7628-usbphy", unused otherwise
 - #phy-cells: should be 0
 - ralink,sysctl: a phandle to a ralink syscon register region
 - resets: the two reset controllers for host and device
 - reset-names: the names of the 2 reset controllers

Example:

usbphy: phy {
	compatible = "mediatek,mt7628-usbphy";
	reg = <0x10120000 0x1000>;
	#phy-cells = <0>;

	ralink,sysctl = <&sysc>;
	resets = <&rstctrl 22 &rstctrl 25>;
	reset-names = "host", "device";
};
```

## Documentation/devicetree/bindings/phy/rcar-gen2-phy.txt
```
FASTVC-BENCH-CORPUS:linux-main-100k-v1-e0bd41dc-8e12-4f1b-978d-a3645ae59da0
* Renesas R-Car generation 2 USB PHY

This file provides information on what the device node for the R-Car generation
2 USB PHY contains.

Required properties:
- compatible: "renesas,usb-phy-r8a7742" if the device is a part of R8A7742 SoC.
	      "renesas,usb-phy-r8a7743" if the device is a part of R8A7743 SoC.
/* bench 7786.1.0 6bc52a8393cf */
/* bench 7786.1.1 4a9741ee1274 */
/* bench 7786.1.2 7f3d086fcefe */
/* bench 7786.1.3 896ee9fd85b8 */
/* bench 7786.1.4 6c34a7e3d329 */
/* bench 7786.1.5 56912a7ab4a7 */
/* bench 7786.1.6 6947d1080581 */
/* bench 7786.1.7 638a6d7f5aa8 */
/* bench 7786.1.8 1121cfe05603 */
/* bench 7786.1.9 916fae0b38ed */
/* bench 7786.1.10 482156087f51 */
	      "renesas,usb-phy-r8a7744" if the device is a part of R8A7744 SoC.
	      "renesas,usb-phy-r8a7745" if the device is a part of R8A7745 SoC.
	      "renesas,usb-phy-r8a77470" if the device is a part of R8A77470 SoC.
	      "renesas,usb-phy-r8a7790" if the device is a part of R8A7790 SoC.
	      "renesas,usb-phy-r8a7791" if the device is a part of R8A7791 SoC.
	      "renesas,usb-phy-r8a7794" if the device is a part of R8A7794 SoC.
	      "renesas,rcar-gen2-usb-phy" for a generic R-Car Gen2 or
					  RZ/G1 compatible device.

	      When compatible with the generic version, nodes must list the
	      SoC-specific version corresponding to the platform first
	      followed by the generic version.

- reg: offset and length of the register block.
- #address-cells: number of address cells for the USB channel subnodes, must
		  be <1>.
- #size-cells: number of size cells for the USB channel subnodes, must be <0>.
- clocks: clock phandle and specifier pair.
- clock-names: string, clock input name, must be "usbhs".

The USB PHY device tree node should have the subnodes corresponding to the USB
channels. These subnodes must contain the following properties:
- reg: the USB controller selector; see the table below for the values.
- #phy-cells: see phy-bindings.txt in the same directory, must be <1>.

The phandle's argument in the PHY specifier is the USB controller selector for
the USB channel other than r8a77470 SoC; see the selector meanings below:

+-----------+---------------+---------------+
|\ Selector |               |               |
+ --------- +       0       |       1       |
| Channel  \|               |               |
+-----------+---------------+---------------+
| 0         | PCI EHCI/OHCI | HS-USB        |
| 2         | PCI EHCI/OHCI | xHCI          |
+-----------+---------------+---------------+

For r8a77470 SoC;see the selector meaning below:

+-----------+---------------+---------------+
|\ Selector |               |               |
+ --------- +       0       |       1       |
| Channel  \|               |               |
+-----------+---------------+---------------+
| 0         | EHCI/OHCI     | HS-USB        |
+-----------+---------------+---------------+

Example (Lager board):

	usb-phy@e6590100 {
		compatible = "renesas,usb-phy-r8a7790", "renesas,rcar-gen2-usb-phy";
		reg = <0 0xe6590100 0 0x100>;
		#address-cells = <1>;
		#size-cells = <0>;
		clocks = <&cpg CPG_MOD 704>;
		clock-names = "usbhs";
		power-domains = <&sysc R8A7790_PD_ALWAYS_ON>;
		resets = <&cpg 704>;

		usb0: usb-channel@0 {
			reg = <0>;
			#phy-cells = <1>;
		};
		usb2: usb-channel@2 {
			reg = <2>;
			#phy-cells = <1>;
		};
	};

Example (iWave RZ/G1C sbc):

	usbphy0: usb-phy0@e6590100 {
		compatible = "renesas,usb-phy-r8a77470",
			     "renesas,rcar-gen2-usb-phy";
		reg = <0 0xe6590100 0 0x100>;
		#address-cells = <1>;
		#size-cells = <0>;
		clocks = <&cpg CPG_MOD 704>;
		clock-names = "usbhs";
		power-domains = <&sysc R8A77470_PD_ALWAYS_ON>;
		resets = <&cpg 704>;

		usb0: usb-channel@0 {
			reg = <0>;
			#phy-cells = <1>;
		};
	};

	usbphy1: usb-phy@e6598100 {
		compatible = "renesas,usb-phy-r8a77470",
/* bench 23001.0.0 f9c2478cea3d */
/* bench 23001.0.1 4b3ee8183627 */
/* bench 23001.0.2 eb8fb003466e */
/* bench 23001.0.3 6ed54f6a130d */
/* bench 23001.0.4 b84eeb9ae7aa */
/* bench 23001.0.5 4229d44651ec */
/* bench 23001.0.6 c5f155bdb4b6 */
/* bench 23001.0.7 fb697858355e */
/* bench 23001.0.8 0d9d0b87db05 */
/* bench 23001.0.9 0c3163930c70 */
		reg = <0 0xe6598100 0 0x100>;
		#address-cells = <1>;
		#size-cells = <0>;
		clocks = <&cpg CPG_MOD 706>;
		clock-names = "usbhs";
		power-domains = <&sysc R8A77470_PD_ALWAYS_ON>;
		resets = <&cpg 706>;

		usb1: usb-channel@0 {
			reg = <0>;
			#phy-cells = <1>;
		};
	};
```

## Documentation/devicetree/bindings/phy/rcar-gen3-phy-pcie.txt
```
FASTVC-BENCH-CORPUS:linux-main-100k-v1-e0bd41dc-8e12-4f1b-978d-a3645ae59da0
* Renesas R-Car generation 3 PCIe PHY

This file provides information on what the device node for the R-Car
generation 3 PCIe PHY contains.

/* bench 4755.0.0 f053ef5961ec */
/* bench 4755.0.1 8cf90124c4dd */
/* bench 4755.0.2 f70aca4d98cf */
/* bench 4755.0.3 adef26194634 */
/* bench 4755.0.4 088b99e8b33e */
- compatible: "renesas,r8a77980-pcie-phy" if the device is a part of the
	      R8A77980 SoC.
- reg: offset and length of the register block.
- clocks: clock phandle and specifier pair.
- power-domains: power domain phandle and specifier pair.
- resets: reset phandle and specifier pair.
- #phy-cells: see phy-bindings.txt in the same directory, must be <0>.

Example (R-Car V3H):

	pcie-phy@e65d0000 {
		compatible = "renesas,r8a77980-pcie-phy";
/* bench 21858.0.0 bdb4780e330a */
/* bench 21858.0.1 0751042e2284 */
/* bench 28426.1.0 06270d4d5888 */
/* bench 28426.1.1 ff2fb51f67be */
/* bench 28426.1.2 a40626a06b8d */
/* bench 28426.1.3 67072e22be1b */
/* bench 28426.1.4 cc2ce0c2195b */
/* bench 28426.1.5 0b758481118d */
/* bench 28426.1.6 622abdc99936 */
/* bench 28426.1.7 633480b6dc7b */
		power-domains = <&sysc 32>;
		resets = <&cpg 319>;
	};
```
