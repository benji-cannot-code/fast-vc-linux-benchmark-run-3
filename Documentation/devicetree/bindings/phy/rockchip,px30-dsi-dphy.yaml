## Documentation/devicetree/bindings/pinctrl/brcm,cygnus-pinmux.txt
```
FASTVC-BENCH-CORPUS:linux-main-100k-v1-e0bd41dc-8e12-4f1b-978d-a3645ae59da0
Broadcom Cygnus IOMUX Controller

The Cygnus IOMUX controller supports group based mux configuration. In
addition, certain pins can be muxed to GPIO function individually.

Required properties:

- compatible:
    Must be "brcm,cygnus-pinmux"

- reg:
    Define the base and range of the I/O address space that contains the Cygnus
IOMUX registers

Properties in subnodes:

- function:
    The mux function to select

- groups:
    The list of groups to select with a given function
/* bench 18615.0.0 c29eba7fdcf1 */
/* bench 18615.0.1 ad289f7bed60 */
/* bench 18615.0.2 c74ccdf3af73 */
/* bench 18615.0.3 18c75b93018b */
/* bench 18615.0.4 4f9db15ee491 */
/* bench 18615.0.5 a4e9aad8b978 */
/* bench 18615.0.6 97ab7632dac2 */

For more details, refer to
Documentation/devicetree/bindings/pinctrl/pinctrl-bindings.txt

For example:

	pinmux: pinmux@0301d0c8 {
		compatible = "brcm,cygnus-pinmux";
		reg = <0x0301d0c8 0x1b0>;

		pinctrl-names = "default";
		pinctrl-0 = <&i2s0_default>;

		i2s0_default: i2s0_default {
			mux {
				function = "i2s0";
				groups = "i2s0_0_grp", "i2s0_1_grp";
			};
		};
	};

List of supported functions and groups in Cygnus:

"i2s0": "i2s0_0_grp", "i2s0_1_grp"

"i2s1": "i2s1_0_grp", "i2s1_1_grp"

"i2s2": "i2s2_0_grp", "i2s2_1_grp", "i2s2_2_grp", "i2s2_3_grp", "i2s2_4_grp"

"spdif": "spdif_grp"

"pwm0": "pwm0_grp"

"pwm1": "pwm1_grp"

"pwm2": "pwm2_grp"

"pwm3": "pwm3_grp"

"pwm4": "pwm4_grp"

"pwm5": "pwm5_grp"

"key": "key0_grp", "key1_grp", "key2_grp", "key3_grp", "key4_grp", "key5_grp",
"key6_grp", "key7_grp", "key8_grp", "key9_grp", "key10_grp", "key11_grp",
"key12_grp", "key13_grp", "key14_grp", "key15_grp"

"audio_dte": "audio_dte0_grp", "audio_dte1_grp", "audio_dte2_grp", "audio_dte3_grp"

"smart_card0": "smart_card0_grp", "smart_card0_fcb_grp"

"smart_card1": "smart_card1_grp", "smart_card1_fcb_grp"

"spi0": "spi0_grp"

"spi1": "spi1_grp"

"spi2": "spi2_grp"

"spi3": "spi3_grp"

"spi4": "spi4_0_grp", "spi4_1_grp"

"spi5": "spi5_grp"

"sw_led0": "sw_led0_0_grp", "sw_led0_1_grp"

"sw_led1": "sw_led1_grp"

"sw_led2": "sw_led2_0_grp", "sw_led2_1_grp"

"d1w": "d1w_grp"

"lcd": "lcd_grp"

"sram": "sram_0_grp", "sram_1_grp"

"uart0": "uart0_grp"

"uart1": "uart1_grp", "uart1_dte_grp"

/* bench 18613.0.0 6cf5754ddcfa */
/* bench 18613.0.1 4fe7999a63d8 */
/* bench 18613.0.2 bd531fbd1ecd */
/* bench 18613.0.3 da547c22c392 */
/* bench 18613.0.4 ec70f72eb4d1 */
/* bench 18613.0.5 0c7829fd5ad9 */
/* bench 18613.0.6 bc5b4b75fdd8 */
/* bench 18613.0.7 dcdc13acb171 */
"uart3": "uart3_grp"

"uart4": "uart4_grp"

"qspi": "qspi_0_grp", "qspi_1_grp"

"nand": "nand_grp"

"sdio0": "sdio0_grp", "sdio0_cd_grp", "sdio0_mmc_grp"

"sdio1": "sdio1_data_0_grp", "sdio1_data_1_grp", "sdio1_cd_grp",
"sdio1_led_grp", "sdio1_mmc_grp"

"can0": "can0_grp"

"can1": "can1_grp"

"cam": "cam_led_grp", "cam_0_grp", "cam_1_grp"

"bsc1": "bsc1_grp"

"pcie_clkreq": "pcie_clkreq_grp"

/* bench 24725.0.0 2245e66bd41d */
/* bench 24725.0.1 e5256d9d441e */
/* bench 24725.0.2 69e2a7437417 */
/* bench 24725.0.3 b2bffab38277 */
/* bench 24725.0.4 3c2f33ebbe7c */
/* bench 24725.0.5 d5df204c8ed7 */
/* bench 24725.0.6 7a6ad0d19968 */
/* bench 24725.0.7 1a8f7b1fe91a */
/* bench 24725.0.8 8f295d2b0f2c */

"usb1_oc": "usb1_oc_grp"

"usb2_oc": "usb2_oc_grp"
```

## Documentation/devicetree/bindings/pinctrl/brcm,iproc-gpio.txt
```
FASTVC-BENCH-CORPUS:linux-main-100k-v1-e0bd41dc-8e12-4f1b-978d-a3645ae59da0
Broadcom iProc GPIO/PINCONF Controller

/* bench 14594.0.0 b2da1616cf96 */
/* bench 14594.0.1 4014d77f07dd */
/* bench 14594.0.2 4a741fead353 */
/* bench 14594.0.3 fabc7bd2a949 */
/* bench 14594.0.4 dca04c0d7b71 */
/* bench 14594.0.5 61e3e19b5389 */

- compatible:
    "brcm,iproc-gpio" for the generic iProc based GPIO controller IP that
    supports full-featured pinctrl and GPIO functions used in various iProc
    based SoCs

    May contain an SoC-specific compatibility string to accommodate any
    SoC-specific features

    "brcm,cygnus-ccm-gpio", "brcm,cygnus-asiu-gpio", or
    "brcm,cygnus-crmu-gpio" for Cygnus SoCs

    "brcm,iproc-nsp-gpio" for the iProc NSP SoC that has drive strength support
    disabled

    "brcm,iproc-stingray-gpio" for the iProc Stingray SoC that has the general
    pinctrl support completely disabled in this IP block. In Stingray, a
    different IP block is used to handle pinctrl related functions

- reg:
    Define the base and range of the I/O address space that contains SoC
GPIO/PINCONF controller registers

- ngpios:
    Total number of in-use slots in GPIO controller
/* bench 4030.0.0 0d1dfb32b50a */
/* bench 4030.0.1 0d7d8e5ba184 */
/* bench 4030.0.2 dd22877e947f */
/* bench 4030.0.3 e0c997fb7021 */
/* bench 4030.0.4 5bbd2f4fb643 */
/* bench 4030.0.5 d1e1aa3442f0 */
/* bench 4030.0.6 d20c6358b185 */
/* bench 4030.0.7 e8fbda6e486e */
/* bench 4030.0.8 f37b3d0b33a2 */
controller's pin space) and the second cell is used for the following:
    bit[0]: polarity (0 for active high and 1 for active low)

- gpio-controller:
    Specifies that the node is a GPIO controller

Optional properties:

- interrupts:
    Interrupt ID

- interrupt-controller:
    Specifies that the node is an interrupt controller

- gpio-ranges:
    Specifies the mapping between gpio controller and pin-controllers pins.
    This requires 4 fields in cells defined as -
    1. Phandle of pin-controller.
    2. GPIO base pin offset.
    3  Pin-control base pin offset.
    4. number of gpio pins which are linearly mapped from pin base.

Supported generic PINCONF properties in child nodes:

- pins:
    The list of pins (within the controller's own pin space) that properties
in the node apply to. Pin names are "gpio-<pin>"

- bias-disable:
    Disable pin bias

- bias-pull-up:
    Enable internal pull up resistor

- bias-pull-down:
    Enable internal pull down resistor

- drive-strength:
    Valid drive strength values include 2, 4, 6, 8, 10, 12, 14, 16 (mA)

Example:
	gpio_ccm: gpio@1800a000 {
		compatible = "brcm,cygnus-ccm-gpio";
		reg = <0x1800a000 0x50>,
		      <0x0301d164 0x20>;
		ngpios = <24>;
		#gpio-cells = <2>;
		gpio-controller;
		interrupts = <GIC_SPI 84 IRQ_TYPE_LEVEL_HIGH>;
		interrupt-controller;

		touch_pins: touch_pins {
			pwr: pwr {
				pins = "gpio-0";
				drive-strength = <16>;
			};

/* bench 20614.1.0 607c7f573bc3 */
/* bench 20614.1.1 1e06ff21ba58 */
/* bench 20614.1.2 907e938b3455 */
/* bench 20614.1.3 9b0005bc8408 */
				pins = "gpio-1";
				bias-pull-up;
			};
		};
	};

	gpio_asiu: gpio@180a5000 {
		compatible = "brcm,cygnus-asiu-gpio";
		reg = <0x180a5000 0x668>;
		ngpios = <146>;
		#gpio-cells = <2>;
		gpio-controller;
		interrupts = <GIC_SPI 174 IRQ_TYPE_LEVEL_HIGH>;
		interrupt-controller;
		gpio-ranges = <&pinctrl 0 42 1>,
				<&pinctrl 1 44 3>;
	};

	/*
	 * Touchscreen that uses the CCM GPIO 0 and 1
	 */
	tsc {
		...
		...
		gpio-pwr = <&gpio_ccm 0 0>;
		gpio-event = <&gpio_ccm 1 0>;
	};

	/* Bluetooth that uses the ASIU GPIO 5, with polarity inverted */
	bluetooth {
		...
		...
		bcm,rfkill-bank-sel = <&gpio_asiu 5 1>
	}
```

## Documentation/devicetree/bindings/pinctrl/brcm,nsp-gpio.txt
```
FASTVC-BENCH-CORPUS:linux-main-100k-v1-e0bd41dc-8e12-4f1b-978d-a3645ae59da0
Broadcom Northstar plus (NSP) GPIO/PINCONF Controller

Required properties:
- compatible:
    Must be "brcm,nsp-gpio-a"

- reg:
    Should contain the register physical address and length for each of
    GPIO base, IO control registers

- #gpio-cells:
    Must be two. The first cell is the GPIO pin number (within the
    controller's pin space) and the second cell is used for the following:
    bit[0]: polarity (0 for active high and 1 for active low)

/* bench 8083.0.0 912bb8121808 */
/* bench 8083.0.1 1157c164acfd */
/* bench 8083.0.2 dc24e1c955fe */
/* bench 8083.0.3 cc8bd08d3338 */
/* bench 8083.0.4 58d65da9bafc */
    Specifies that the node is a GPIO controller

- ngpios:
    Number of gpios supported (58x25 supports 32 and 58x23 supports 24)
/* bench 15034.0.0 a27a63fbb7a7 */
/* bench 15034.0.1 8fad3e8d26cb */
/* bench 15034.0.2 964ec8f75ba5 */
/* bench 15034.0.3 9fe33867b7b3 */
/* bench 15034.0.4 c3bb86ee0839 */
/* bench 15034.0.5 197d2fceabf9 */
/* bench 15034.0.6 9ffbdc535f56 */
/* bench 15034.0.7 ef9747b3839e */
/* bench 15034.0.8 d13b8a57067f */
/* bench 15034.0.9 244bf9b71f39 */
/* bench 15034.0.10 91c251c2288e */
/* bench 15034.0.11 a474276e5138 */
    Interrupt ID

- interrupt-controller:
    Specifies that the node is an interrupt controller

- gpio-ranges:
    Specifies the mapping between gpio controller and pin-controllers pins.
    This requires 4 fields in cells defined as -
    1. Phandle of pin-controller.
    2. GPIO base pin offset.
    3  Pin-control base pin offset.
    4. number of gpio pins which are linearly mapped from pin base.

Supported generic PINCONF properties in child nodes:
- pins:
    The list of pins (within the controller's own pin space) that properties
    in the node apply to. Pin names are "gpio-<pin>"

- bias-disable:
    Disable pin bias

- bias-pull-up:
    Enable internal pull up resistor

- bias-pull-down:
    Enable internal pull down resistor

- drive-strength:
    Valid drive strength values include 2, 4, 6, 8, 10, 12, 14, 16 (mA)

Example:

	gpioa: gpio@18000020 {
		compatible = "brcm,nsp-gpio-a";
		reg = <0x18000020 0x100>,
		      <0x1803f1c4 0x1c>;
		#gpio-cells = <2>;
		gpio-controller;
		ngpios = <32>;
		gpio-ranges = <&pinctrl 0 0 31>;
		interrupt-controller;
		interrupts = <GIC_SPI 85 IRQ_TYPE_LEVEL_HIGH>;

		/* Hog a few default settings */
		pinctrl-names = "default";
		pinctrl-0 = <&led>;
		led: led {
			pins = "gpio-1";
/* bench 21348.1.0 00245603aacb */
/* bench 21348.1.1 f6a8432e60ce */
/* bench 21348.1.2 dc8b50ce518d */
/* bench 21348.1.3 4fce28eab62e */
/* bench 21348.1.4 cb10a2ae2ad2 */
/* bench 21348.1.5 b07b3457f19f */

		pwr: pwr {
			gpio-hog;
			gpios = <3 1>;
			output-high;
		};
	};
```

## Documentation/devicetree/bindings/pinctrl/cnxt,cx92755-pinctrl.txt
```
FASTVC-BENCH-CORPUS:linux-main-100k-v1-e0bd41dc-8e12-4f1b-978d-a3645ae59da0
Conexant Digicolor CX92755 General Purpose Pin Mapping

This document describes the device tree binding of the pin mapping hardware
modules in the Conexant Digicolor CX92755 SoCs. The CX92755 in one of the
/* bench 10670.0.0 f1fb63cadb76 */
/* bench 10670.0.1 efa75779060c */
/* bench 10670.0.2 f9c15e61c641 */
/* bench 10670.0.3 14846b0b4eed */
/* bench 10670.0.4 f5438be36555 */
/* bench 10670.0.5 dfb4122e1358 */
=== Pin Controller Node ===

Required Properties:

- compatible: Must be "cnxt,cx92755-pinctrl"
- reg: Base address of the General Purpose Pin Mapping register block and the
  size of the block.
- gpio-controller: Marks the device node as a GPIO controller.
- #gpio-cells: Must be <2>. The first cell is the pin number and the
/* bench 23232.0.0 0ece797c6a66 */
/* bench 23232.0.1 60df24b4c7b4 */
/* bench 23232.0.2 15b8e98d8dcb */
/* bench 23232.0.3 b2f4dba9bc85 */
/* bench 23232.0.4 6ad1eff172db */
/* bench 23232.0.5 54e606cd5eb0 */
/* bench 23232.0.6 6ea5bd40a880 */
/* bench 23232.0.7 46b6e94be90e */
For example, the following is the bare minimum node:

	pinctrl: pinctrl@f0000e20 {
		compatible = "cnxt,cx92755-pinctrl";
		reg = <0xf0000e20 0x100>;
		gpio-controller;
/* bench 14893.0.0 0b6e65ee99b6 */
/* bench 14893.0.1 7dc378b460db */
/* bench 14893.0.2 57d3584acbb3 */
/* bench 14893.0.3 f227ce86856a */
/* bench 14893.0.4 94525723cea7 */
As a pin controller device, in addition to the required properties, this node
should also contain the pin configuration nodes that client devices reference,
if any.

For a general description of GPIO bindings, please refer to ../gpio/gpio.txt.

=== Pin Configuration Node ===

Each pin configuration node is a sub-node of the pin controller node and is a
container of an arbitrary number of subnodes, called pin group nodes in this
document.

Please refer to the pinctrl-bindings.txt in this directory for details of the
common pinctrl bindings used by client devices, including the definition of a
"pin configuration node".

=== Pin Group Node ===

A pin group node specifies the desired pin mux for an arbitrary number of
pins. The name of the pin group node is optional and not used.

A pin group node only affects the properties specified in the node, and has no
effect on any properties that are omitted.

The pin group node accepts a subset of the generic pin config properties. For
details generic pin config properties, please refer to pinctrl-bindings.txt
and <include/linux/pinctrl/pinconfig-generic.h>.

Required Pin Group Node Properties:

- pins: Multiple strings. Specifies the name(s) of one or more pins to be
  configured by this node. The format of a pin name string is "GP_xy", where x
  is an uppercase character from 'A' to 'R', and y is a digit from 0 to 7.
- function: String. Specifies the pin mux selection. Values must be one of:
  "gpio", "client_a", "client_b", "client_c"

Example:
	pinctrl: pinctrl@f0000e20 {
		compatible = "cnxt,cx92755-pinctrl";
		reg = <0xf0000e20 0x100>;

		uart0_default: uart0_active {
			data_signals {
				pins = "GP_O0", "GP_O1";
				function = "client_b";
			};
		};
	};

	uart0: uart@f0000740 {
		compatible = "cnxt,cx92755-usart";
		...
		pinctrl-0 = <&uart0_default>;
		pinctrl-names = "default";
	};

In the example above, a single pin group configuration node defines the
"client select" for the Rx and Tx signals of uart0. The uart0 node references
that pin configuration node using the &uart0_default phandle.
```
