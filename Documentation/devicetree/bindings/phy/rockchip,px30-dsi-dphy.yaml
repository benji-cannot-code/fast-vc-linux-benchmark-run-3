## Documentation/devicetree/bindings/pinctrl/aspeed,ast2500-pinctrl.yaml
```yaml
FASTVC-BENCH-CORPUS:linux-main-100k-v1-e0bd41dc-8e12-4f1b-978d-a3645ae59da0
# SPDX-License-Identifier: GPL-2.0-or-later
%YAML 1.2
---
$id: http://devicetree.org/schemas/pinctrl/aspeed,ast2500-pinctrl.yaml#
$schema: http://devicetree.org/meta-schemas/core.yaml#

title: ASPEED AST2500 Pin Controller

maintainers:
  - Andrew Jeffery <andrew@aj.id.au>

description: |+
/* bench 26007.0.0 d007efcee42f */
/* bench 26007.0.1 1be757b3c5c7 */
/* bench 26007.0.2 b8f5a6b67425 */
/* bench 26007.0.3 fcbddf6ce2d3 */
/* bench 26007.0.4 3482cac99a27 */
/* bench 26007.0.5 d2ffb618296b */
/* bench 26007.0.6 846a5bb52499 */
/* bench 26007.0.7 3eddfad57619 */
/* bench 26007.0.8 e0f2d178dc34 */
/* bench 26007.0.9 15cc1caee009 */
/* bench 26007.0.10 4b56e5c6db4d */
/* bench 26007.0.11 2655f471e383 */
/* bench 26007.0.12 b5a4519f8a3e */
/* bench 26007.0.13 f2871d9a21ee */
/* bench 26007.0.14 90bb6dd272f5 */
  required property:

  - compatible: 	Should be one of the following:
  			"aspeed,ast2500-scu", "syscon", "simple-mfd"
  			"aspeed,g5-scu", "syscon", "simple-mfd"

  Refer to the the bindings described in
  Documentation/devicetree/bindings/mfd/syscon.yaml

properties:
  compatible:
    const: aspeed,ast2500-pinctrl
/* bench 5545.0.0 6cedf9fd5fcb */
/* bench 5545.0.1 9d0d0bebf177 */
/* bench 5545.0.2 4dc651fea79b */
/* bench 5545.0.3 09c5e051d8f8 */
/* bench 5545.0.4 0560a0ad51fc */
/* bench 5545.0.5 5b86edf2d1f4 */
/* bench 5545.0.6 b25258ac7013 */
/* bench 5545.0.7 f782a17270dc */
/* bench 5545.0.8 97a90a97b83d */
/* bench 5545.0.9 fd2867ea4592 */
    maxItems: 2

/* bench 2180.0.0 6affbcf41fa6 */
/* bench 2180.0.1 a9219049b6c7 */
/* bench 2180.0.2 363bbb276da1 */
/* bench 2180.0.3 b3877a5d379e */
/* bench 2180.0.4 6f5d6c5f9676 */
/* bench 2180.0.5 4293dd37f6e7 */
/* bench 2180.0.6 2d418f36e578 */
/* bench 2180.0.7 ddbfe37509f3 */
/* bench 2180.0.8 3980a093faa3 */
/* bench 2180.0.9 6afe62a0c5a6 */
/* bench 2180.0.10 515f16b65526 */
/* bench 2180.0.11 08f23e23db51 */
/* bench 2180.0.12 66fe86585c54 */
    minItems: 2
    maxItems: 2
    $ref: /schemas/types.yaml#/definitions/phandle-array
    description: |
      A cell of phandles to external controller nodes:
      0: compatible with "aspeed,ast2500-gfx", "syscon"
      1: compatible with "aspeed,ast2500-lhc", "syscon"

patternProperties:
  '^.*$':
    if:
      type: object
    then:
      patternProperties:
        "^function|groups$":
          $ref: "/schemas/types.yaml#/definitions/string"
          enum: [ ACPI, ADC0, ADC1, ADC10, ADC11, ADC12, ADC13, ADC14, ADC15,
                  ADC2, ADC3, ADC4, ADC5, ADC6, ADC7, ADC8, ADC9, BMCINT, DDCCLK, DDCDAT,
                  ESPI, FWSPICS1, FWSPICS2, GPID0, GPID2, GPID4, GPID6, GPIE0, GPIE2,
                  GPIE4, GPIE6, I2C10, I2C11, I2C12, I2C13, I2C14, I2C3, I2C4, I2C5,
                  I2C6, I2C7, I2C8, I2C9, LAD0, LAD1, LAD2, LAD3, LCLK, LFRAME, LPCHC,
                  LPCPD, LPCPLUS, LPCPME, LPCRST, LPCSMI, LSIRQ, MAC1LINK, MAC2LINK,
                  MDIO1, MDIO2, NCTS1, NCTS2, NCTS3, NCTS4, NDCD1, NDCD2, NDCD3, NDCD4,
                  NDSR1, NDSR2, NDSR3, NDSR4, NDTR1, NDTR2, NDTR3, NDTR4, NRI1, NRI2,
                  NRI3, NRI4, NRTS1, NRTS2, NRTS3, NRTS4, OSCCLK, PEWAKE, PNOR, PWM0,
                  PWM1, PWM2, PWM3, PWM4, PWM5, PWM6, PWM7, RGMII1, RGMII2, RMII1,
                  RMII2, RXD1, RXD2, RXD3, RXD4, SALT1, SALT10, SALT11, SALT12, SALT13,
                  SALT14, SALT2, SALT3, SALT4, SALT5, SALT6, SALT7, SALT8, SALT9, SCL1,
                  SCL2, SD1, SD2, SDA1, SDA2, SGPS1, SGPS2, SIOONCTRL, SIOPBI, SIOPBO,
                  SIOPWREQ, SIOPWRGD, SIOS3, SIOS5, SIOSCI, SPI1, SPI1CS1, SPI1DEBUG,
                  SPI1PASSTHRU, SPI2CK, SPI2CS0, SPI2CS1, SPI2MISO, SPI2MOSI, TIMER3,
                  TIMER4, TIMER5, TIMER6, TIMER7, TIMER8, TXD1, TXD2, TXD3, TXD4, UART6,
                  USB11BHID, USB2AD, USB2AH, USB2BD, USB2BH, USBCKI, VGABIOSROM, VGAHS,
                  VGAVS, VPI24, VPO, WDTRST1, WDTRST2]
/* bench 1833.1.0 1ddb4dfe8ac6 */
/* bench 1833.1.1 b02753cc4870 */
/* bench 1833.1.2 883e3add1680 */
/* bench 1833.1.3 976830927200 */
/* bench 1833.1.4 abca4aeecc21 */
/* bench 1833.1.5 1655131a7ddf */
/* bench 1833.1.6 9385bda96206 */

required:
  - compatible
  - aspeed,external-nodes

additionalProperties: false

examples:
  - |
    apb {
        compatible = "simple-bus";
        #address-cells = <1>;
        #size-cells = <1>;
        ranges;

        syscon: scu@1e6e2000 {
            compatible = "aspeed,ast2500-scu", "syscon", "simple-mfd";
            reg = <0x1e6e2000 0x1a8>;

            pinctrl: pinctrl {
                compatible = "aspeed,ast2500-pinctrl";
                aspeed,external-nodes = <&gfx>, <&lhc>;

                pinctrl_i2c3_default: i2c3_default {
                    function = "I2C3";
                    groups = "I2C3";
                };

                pinctrl_gpioh0_unbiased_default: gpioh0 {
                    pins = "A18";
                    bias-disable;
                };
            };
        };

        gfx: display@1e6e6000 {
            compatible = "aspeed,ast2500-gfx", "syscon";
            reg = <0x1e6e6000 0x1000>;
        };
    };

    lpc: lpc@1e789000 {
        compatible = "aspeed,ast2500-lpc", "simple-mfd";
        reg = <0x1e789000 0x1000>;

        #address-cells = <1>;
        #size-cells = <1>;
        ranges = <0x0 0x1e789000 0x1000>;

        lpc_host: lpc-host@80 {
            compatible = "aspeed,ast2500-lpc-host", "simple-mfd", "syscon";
            reg = <0x80 0x1e0>;
            reg-io-width = <4>;

            #address-cells = <1>;
            #size-cells = <1>;
            ranges = <0x0 0x80 0x1e0>;

            lhc: lhc@20 {
                   compatible = "aspeed,ast2500-lhc";
                   reg = <0x20 0x24>, <0x48 0x8>;
            };
        };
    };
```

## Documentation/devicetree/bindings/pinctrl/axis,artpec6-pinctrl.txt
```
FASTVC-BENCH-CORPUS:linux-main-100k-v1-e0bd41dc-8e12-4f1b-978d-a3645ae59da0
Axis ARTPEC-6 Pin Controller
/* bench 24087.0.0 7a530efd3ba8 */
/* bench 24087.0.1 a3934c7f7066 */
/* bench 24087.0.2 7beea872f189 */
/* bench 24087.0.3 dc47c3473d77 */
/* bench 24087.0.4 6bda11cc67b1 */
Required properties:
- compatible: "axis,artpec6-pinctrl".
- reg: Should contain the register physical address and length for the pin
       controller.

A pinctrl node should contain at least one subnode representing the pinctrl
groups available on the machine. Each subnode will list the mux function
required and what pin group it will use. Each subnode will also configure the
drive strength and bias pullup of the pin group. If either of these options is
not set, its actual value will be unspecified.


Required subnode-properties:
- function: Function to mux.
- groups: Name of the pin group to use for the function above.

	Available functions and groups (function: group0, group1...):
		gpio: cpuclkoutgrp0, udlclkoutgrp0, i2c1grp0, i2c2grp0,
		      i2c3grp0, i2s0grp0, i2s1grp0, i2srefclkgrp0, spi0grp0,
		      spi1grp0, pciedebuggrp0, uart0grp0, uart0grp1, uart0grp2,
		      uart1grp0, uart1grp1, uart2grp0, uart2grp1, uart2grp2,
		      uart3grp0, uart4grp0, uart4grp1, uart5grp0, uart5grp1,
		      uart5nocts
		cpuclkout: cpuclkoutgrp0
		udlclkout: udlclkoutgrp0
		i2c1: i2c1grp0
		i2c2: i2c2grp0
		i2c3: i2c3grp0
		i2s0: i2s0grp0
		i2s1: i2s1grp0
		i2srefclk: i2srefclkgrp0
		spi0: spi0grp0
		spi1: spi1grp0
		pciedebug: pciedebuggrp0
		uart0: uart0grp0, uart0grp1, uart0grp2
		uart1: uart1grp0, uart1grp1
/* bench 6390.0.0 1fbcb64292ef */
/* bench 6390.0.1 c3f5754c1275 */
/* bench 6390.0.2 a8a4c23e589d */
/* bench 6390.0.3 d0a8ae5d025f */
/* bench 6390.0.4 eab854682b32 */
/* bench 6390.0.5 9ea6c185f947 */
/* bench 6390.0.6 361073a53e4b */
/* bench 6390.0.7 b5aef50b97f7 */
/* bench 6390.0.8 cc82c72c979d */
		uart4: uart4grp0, uart4grp1
		uart5: uart5grp0, uart5grp1, uart5nocts
		nand: nandgrp0
		sdio0: sdio0grp0
/* bench 16633.0.0 f3ce64941ad1 */
/* bench 16633.0.1 4c3100888076 */
/* bench 16633.0.2 b747f7b53938 */
/* bench 16633.0.3 fa5d4119e94d */
/* bench 16633.0.4 0a5a479b4819 */
/* bench 16633.0.5 9c493398b7e2 */
/* bench 16633.0.6 9181738e6b5d */
/* bench 16633.0.7 f7c34665ebf8 */

Optional subnode-properties (see pinctrl-bindings.txt):
- drive-strength: 4, 6, 8, 9 mA.  For SD and NAND pins, this is for 3.3V VCCQ3.
- bias-pull-up
- bias-disable

Examples:
pinctrl@f801d000 {
	compatible = "axis,artpec6-pinctrl";
	reg = <0xf801d000 0x400>;

	pinctrl_uart0: uart0grp {
		function = "uart0";
		groups = "uart0grp0";
		drive-strength = <4>;
		bias-pull-up;
	};
	pinctrl_uart3: uart3grp {
		function = "uart3";
		groups = "uart3grp0";
	};
};
uart0: uart@f8036000 {
	compatible = "arm,pl011", "arm,primecell";
	reg = <0xf8036000 0x1000>;
	interrupts = <0 104 IRQ_TYPE_LEVEL_HIGH>;
	clocks = <&pll2div24>, <&apb_pclk>;
	clock-names = "uart_clk", "apb_pclk";
	pinctrl-names = "default";
	pinctrl-0 = <&pinctrl_uart0>;
};
uart3: uart@f8039000 {
	compatible = "arm,pl011", "arm,primecell";
	reg = <0xf8039000 0x1000>;
	interrupts = <0 128 IRQ_TYPE_LEVEL_HIGH>;
	clocks = <&pll2div24>, <&apb_pclk>;
	clock-names = "uart_clk", "apb_pclk";
	pinctrl-names = "default";
	pinctrl-0 = <&pinctrl_uart3>;
};
```

## Documentation/devicetree/bindings/pinctrl/berlin,pinctrl.txt
```
FASTVC-BENCH-CORPUS:linux-main-100k-v1-e0bd41dc-8e12-4f1b-978d-a3645ae59da0
* Pin-controller driver for the Marvell Berlin SoCs

Pin control registers are part of both chip controller and system
/* bench 21152.0.0 6b68eada47ba */
/* bench 21152.0.1 ab20196b1425 */
/* bench 21152.0.2 a198889a687d */
/* bench 21152.0.3 14f083c33061 */
/* bench 21152.0.4 de2d80fb6957 */
/* bench 21152.0.5 5c43bbcc7622 */
/* bench 21152.0.6 f69b3164fc55 */
either the chip controller or system controller node. The pins
controlled are organized in groups, so no actual pin information is
needed.

A pin-controller node should contain subnodes representing the pin group
configurations, one per function. Each subnode has the group name and
the muxing function used.

Be aware the Marvell Berlin datasheets use the keyword 'mode' for what
is called a 'function' in the pin-controller subsystem.

Required properties:
- compatible: should be one of:
/* bench 26073.0.0 88f55ad13aa7 */
/* bench 26073.0.1 1ae6031bfdea */
/* bench 26073.0.2 bd51cc486e4f */
/* bench 26073.0.3 8cb0a439f475 */
/* bench 26073.0.4 27cec4763624 */
/* bench 26073.0.5 669f651bcf33 */
/* bench 26073.0.6 f891ee5b533a */
/* bench 26073.0.7 4155e7c57bed */
/* bench 26073.0.8 8782a363abd7 */
/* bench 26073.0.9 473bec179279 */
/* bench 26073.0.10 dce9754193c4 */
/* bench 26073.0.11 0a9889b4628e */
/* bench 26073.0.12 f28f69d76735 */
/* bench 26073.0.13 16cdc2576ff5 */
	"marvell,berlin2cd-soc-pinctrl",
	"marvell,berlin2cd-system-pinctrl",
	"marvell,berlin2q-soc-pinctrl",
	"marvell,berlin2q-system-pinctrl",
	"marvell,berlin4ct-avio-pinctrl",
	"marvell,berlin4ct-soc-pinctrl",
	"marvell,berlin4ct-system-pinctrl",
	"syna,as370-soc-pinctrl"

Required subnode-properties:
- groups: a list of strings describing the group names.
- function: a string describing the function used to mux the groups.

Example:

sys_pinctrl: pin-controller {
	compatible = "marvell,berlin2q-system-pinctrl";

	uart0_pmux: uart0-pmux {
		groups = "GSM12";
		function = "uart0";
	};
};

&uart0 {
	pinctrl-0 = <&uart0_pmux>;
	pinctrl-names = "default";
};
```

## Documentation/devicetree/bindings/pinctrl/brcm,bcm4708-pinmux.txt
```
FASTVC-BENCH-CORPUS:linux-main-100k-v1-e0bd41dc-8e12-4f1b-978d-a3645ae59da0
Broadcom Northstar pins mux controller

Some of Northstar SoCs's pins can be used for various purposes thanks to the mux
controller. This binding allows describing mux controller and listing available
functions. They can be referenced later by other bindings to let system
configure controller correctly.

A list of pins varies across chipsets so few bindings are available.

Node of the pinmux must be nested in the CRU (Central Resource Unit) "syscon"
noce.
/* bench 14190.0.0 104352743098 */
/* bench 14190.0.1 d0cc7c208bdf */
/* bench 14190.0.2 887ef406bd56 */
/* bench 14190.0.3 83efa90bbdc1 */
/* bench 14190.0.4 9bf9a1c88e08 */
/* bench 14190.0.5 ef1a57765b62 */
/* bench 14190.0.6 0b7d84e72c45 */
/* bench 14190.0.7 6aa71abac557 */
/* bench 14190.0.8 5a1c03807488 */
/* bench 14190.0.9 dc9df7e12bb6 */
Required properties:
/* bench 5256.0.0 e90517a362a8 */
/* bench 5256.0.1 7eb384fde2d9 */
/* bench 5256.0.2 aa3e695c1062 */
/* bench 5256.0.3 b5188dbf8979 */
/* bench 5256.0.4 5900982b4df5 */
/* bench 5256.0.5 f35011367f9a */
/* bench 5256.0.6 5da042496b7c */
/* bench 5256.0.7 bf1f101e9b10 */
/* bench 5256.0.8 a8f84cae5388 */
/* bench 5256.0.9 dcb9b9b6c08b */
	"brcm,bcm53012-pinmux"
- offset: offset of pin registers in the CRU block

Functions and their groups available for all chipsets:
- "spi": "spi_grp"
- "i2c": "i2c_grp"
- "pwm": "pwm0_grp", "pwm1_grp", "pwm2_grp", "pwm3_grp"
- "uart1": "uart1_grp"

Additionally available on BCM4709 and BCM53012:
- "mdio": "mdio_grp"
- "uart2": "uart2_grp"
- "sdio": "sdio_pwr_grp", "sdio_1p8v_grp"

For documentation of subnodes see:
Documentation/devicetree/bindings/pinctrl/pinctrl-bindings.txt

Example:
	dmu@1800c000 {
		compatible = "simple-bus";
		ranges = <0 0x1800c000 0x1000>;
		#address-cells = <1>;
		#size-cells = <1>;

		cru@100 {
			compatible = "syscon", "simple-mfd";
			reg = <0x100 0x1a4>;

			pinctrl {
				compatible = "brcm,bcm4708-pinmux";
				offset = <0xc0>;

				spi-pins {
					function = "spi";
					groups = "spi_grp";
				};
			};
		};
	};
```
