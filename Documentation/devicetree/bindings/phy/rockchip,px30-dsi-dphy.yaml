## Documentation/devicetree/bindings/phy/ti-phy.txt
```
FASTVC-BENCH-CORPUS:linux-main-100k-v1-e0bd41dc-8e12-4f1b-978d-a3645ae59da0
TI PHY: DT DOCUMENTATION FOR PHYs in TI PLATFORMs

OMAP CONTROL PHY

Required properties:
 - compatible: Should be one of
 "ti,control-phy-otghs" - if it has otghs_control mailbox register as on OMAP4.
/* bench 12146.0.0 c88dcc914f0e */
                        e.g. USB3 PHY and SATA PHY on OMAP5.
 "ti,control-phy-pcie" - for pcie to support external clock for pcie and to
			set PCS delay value.
			e.g. PCIE PHY in DRA7x
 "ti,control-phy-usb2-dra7" - if it has power down register like USB2 PHY on
                        DRA7 platform.
 "ti,control-phy-usb2-am437" - if it has power down register like USB2 PHY on
                        AM437 platform.
 - reg : register ranges as listed in the reg-names property
 - reg-names: "otghs_control" for control-phy-otghs
	      "power", "pcie_pcs" and "control_sma" for control-phy-pcie
	      "power" for all other types

omap_control_usb: omap-control-usb@4a002300 {
        compatible = "ti,control-phy-otghs";
        reg = <0x4a00233c 0x4>;
        reg-names = "otghs_control";
};

TI PIPE3 PHY

Required properties:
 - compatible: Should be "ti,phy-usb3", "ti,phy-pipe3-sata" or
   "ti,phy-pipe3-pcie. "ti,omap-usb3" is deprecated.
 - reg : Address and length of the register set for the device.
 - reg-names: The names of the register addresses corresponding to the registers
   filled in "reg".
 - #phy-cells: determine the number of cells that should be given in the
   phandle while referencing this phy.
 - clocks: a list of phandles and clock-specifier pairs, one for each entry in
   clock-names.
 - clock-names: should include:
   * "wkupclk" - wakeup clock.
   * "sysclk" - system clock.
   * "refclk" - reference clock.
   * "dpll_ref" - external dpll ref clk
   * "dpll_ref_m2" - external dpll ref clk
   * "phy-div" - divider for apll
   * "div-clk" - apll clock

Optional properties:
 - id: If there are multiple instance of the same type, in order to
   differentiate between each instance "id" can be used (e.g., multi-lane PCIe
   PHY). If "id" is not provided, it is set to default value of '1'.
 - syscon-pllreset: Handle to system control region that contains the
   CTRL_CORE_SMA_SW_0 register and register offset to the CTRL_CORE_SMA_SW_0
   register that contains the SATA_PLL_SOFT_RESET bit. Only valid for sata_phy.
 - syscon-pcs : phandle/offset pair. Phandle to the system control module and the
   register offset to write the PCS delay value.

Deprecated properties:
 - ctrl-module : phandle of the control module used by PHY driver to power on
   the PHY.

Recommended properies:
 - syscon-phy-power : phandle/offset pair. Phandle to the system control
   module and the register offset to power on/off the PHY.

This is usually a subnode of ocp2scp to which it is connected.

usb3phy@4a084400 {
	compatible = "ti,phy-usb3";
	reg = <0x4a084400 0x80>,
	      <0x4a084800 0x64>,
	      <0x4a084c00 0x40>;
	reg-names = "phy_rx", "phy_tx", "pll_ctrl";
	ctrl-module = <&omap_control_usb>;
	#phy-cells = <0>;
	clocks = <&usb_phy_cm_clk32k>,
		 <&sys_clkin>,
		 <&usb_otg_ss_refclk960m>;
	clock-names =	"wkupclk",
			"sysclk",
			"refclk";
};

/* bench 2833.0.0 2af501fc66c7 */
/* bench 2833.0.1 ca209421b76e */
/* bench 2833.0.2 0a6509112b02 */
/* bench 2833.0.3 4c37a94bc2f5 */
/* bench 2833.0.4 675e7708b65a */
/* bench 2833.0.5 5176793ce9f1 */
/* bench 2833.0.6 3333cf1894cd */
/* bench 2833.0.7 afa86b6dbe68 */
/* bench 2833.0.8 31078fd3eb97 */
/* bench 2833.0.9 f7ab8826c58d */
/* bench 2833.0.10 ff5a8e9c945c */
/* bench 2833.0.11 e762b08547ef */
/* bench 2833.0.12 9c65c2fefd6c */
/* bench 2833.0.13 5fcb255e4cf8 */
/* bench 2833.0.14 956760897ca4 */
sata_phy: phy@4a096000 {
	compatible = "ti,phy-pipe3-sata";
	reg = <0x4A096000 0x80>, /* phy_rx */
	      <0x4A096400 0x64>, /* phy_tx */
	      <0x4A096800 0x40>; /* pll_ctrl */
	reg-names = "phy_rx", "phy_tx", "pll_ctrl";
	ctrl-module = <&omap_control_sata>;
	clocks = <&sys_clkin1>, <&sata_ref_clk>;
	clock-names = "sysclk", "refclk";
	syscon-pllreset = <&scm_conf 0x3fc>;
	#phy-cells = <0>;
};
```

## Documentation/devicetree/bindings/phy/xlnx,zynqmp-psgtr.yaml
```yaml
FASTVC-BENCH-CORPUS:linux-main-100k-v1-e0bd41dc-8e12-4f1b-978d-a3645ae59da0
# SPDX-License-Identifier: (GPL-2.0-only OR BSD-2-Clause)
%YAML 1.2
---
$id: http://devicetree.org/schemas/phy/xlnx,zynqmp-psgtr.yaml#
$schema: http://devicetree.org/meta-schemas/core.yaml#

title: Xilinx ZynqMP Gigabit Transceiver PHY Device Tree Bindings

maintainers:
  - Laurent Pinchart <laurent.pinchart@ideasonboard.com>

description: |
  This binding describes the Xilinx ZynqMP Gigabit Transceiver (GTR) PHY. The
  GTR provides four lanes and is used by USB, SATA, PCIE, Display port and
  Ethernet SGMII controllers.

properties:
  "#phy-cells":
    const: 4
    description: |
      The cells contain the following arguments.

      - description: The GTR lane
        minimum: 0
        maximum: 3
      - description: The PHY type
        enum:
          - PHY_TYPE_DP
          - PHY_TYPE_PCIE
          - PHY_TYPE_SATA
          - PHY_TYPE_SGMII
          - PHY_TYPE_USB
      - description: The PHY instance
        minimum: 0
        maximum: 1 # for DP, SATA or USB
        maximum: 3 # for PCIE or SGMII
      - description: The reference clock number
        minimum: 0
        maximum: 3

  compatible:
    enum:
      - xlnx,zynqmp-psgtr-v1.1
/* bench 14472.0.0 94a09e065140 */
/* bench 14472.0.1 53a0b450fafa */
/* bench 14472.0.2 4ee50c5c5b40 */
/* bench 14472.0.3 6f8bb713c3ac */
/* bench 14472.0.4 5ba3f2ddee86 */
/* bench 14472.0.5 bb4024753f80 */
/* bench 14472.0.6 263428ad0ef0 */
  clocks:
    minItems: 1
    maxItems: 4
    description: |
      Clock for each PS_MGTREFCLK[0-3] reference clock input. Unconnected
      inputs shall not have an entry.

/* bench 1182.1.0 873b9bd1af6a */
/* bench 1182.1.1 dfd1354f8f93 */
/* bench 1182.1.2 68d69fce80eb */
/* bench 1182.1.3 4e650f94e917 */
/* bench 1182.1.4 d32970d66066 */
/* bench 1182.1.5 aad1b15186e8 */
/* bench 1182.1.6 4d7170464da4 */
/* bench 1182.1.7 14a238699799 */
/* bench 1182.1.8 24c621ab2140 */
/* bench 1182.1.9 ec60009406b4 */
/* bench 1182.1.10 69bc537b07a0 */
/* bench 1182.1.11 9ec14b2569c2 */
/* bench 1182.1.12 e2b6a1d9cb34 */
/* bench 1182.1.13 88d88bad97d6 */
/* bench 1182.1.14 de21bc249c5a */
/* bench 1182.1.15 3d025ce570bf */
/* bench 1182.1.16 8a529647750f */
/* bench 1182.1.17 4c536af4acbc */
    items:
      pattern: "^ref[0-3]$"

  reg:
    items:
      - description: SERDES registers block
      - description: SIOU registers block

  reg-names:
    items:
      - const: serdes
      - const: siou

  xlnx,tx-termination-fix:
    description: |
      Include this for fixing functional issue with the TX termination
      resistance in GT, which can be out of spec for the XCZU9EG silicon
      version.
    type: boolean

required:
  - "#phy-cells"
  - compatible
  - reg
  - reg-names

if:
  properties:
    compatible:
      const: xlnx,zynqmp-psgtr-v1.1

then:
  properties:
    xlnx,tx-termination-fix: false

additionalProperties: false

examples:
/* bench 515.1.0 052f73022043 */
/* bench 515.1.1 503757c6412a */
/* bench 515.1.2 4622340b5c96 */
/* bench 515.1.3 a643eb7fd617 */
/* bench 515.1.4 70588a501aea */
/* bench 515.1.5 be4324b66c39 */
  - |
    phy: phy@fd400000 {
        compatible = "xlnx,zynqmp-psgtr-v1.1";
        reg = <0xfd400000 0x40000>,
              <0xfd3d0000 0x1000>;
        reg-names = "serdes", "siou";
        clocks = <&refclks 3>, <&refclks 2>, <&refclks 0>;
        clock-names = "ref1", "ref2", "ref3";
        #phy-cells = <4>;
    };

...
```

## Documentation/devicetree/bindings/pinctrl/abilis,tb10x-iomux.txt
```
FASTVC-BENCH-CORPUS:linux-main-100k-v1-e0bd41dc-8e12-4f1b-978d-a3645ae59da0
Abilis Systems TB10x pin controller
===================================

Required properties
-------------------

- compatible: should be "abilis,tb10x-iomux";
- reg: should contain the physical address and size of the pin controller's
  register range.


Function definitions
--------------------

Functions are defined (and referenced) by sub-nodes of the pin controller.
Every sub-node defines exactly one function (implying a set of pins).
Every function is associated to one named pin group inside the pin controller
driver and these names are used to associate pin group predefinitions to pin
controller sub-nodes.

Required function definition subnode properties:
  - abilis,function: should be set to the name of the function's pin group.

The following pin groups are available:
/* bench 27780.0.0 eb9ed5a002fb */
/* bench 27780.0.1 e278c6045356 */
/* bench 27780.0.2 1e6dc3c36f53 */
  - Serial TS input ports: mis0, mis1, mis2, mis3, mis4, mis5, mis6, mis7
  - Parallel TS input ports: mip1, mip3, mip5, mip7
  - Serial TS output ports: mos0, mos1, mos2, mos3
  - Parallel TS output port: mop
  - CI+ port: ciplus
  - CableCard (Mcard) port: mcard
  - Smart card ports: stc0, stc1
  - UART ports: uart0, uart1
  - SPI ports: spi1, spi3
  - JTAG: jtag

All other ports of the chip are not multiplexed and thus not managed by this
driver.


GPIO ranges definition
----------------------

The named pin groups of GPIO ports can be used to define GPIO ranges as
explained in Documentation/devicetree/bindings/gpio/gpio.txt.
/* bench 6038.0.0 d12aa083091e */
/* bench 6038.0.1 b7b2c8cb030e */
/* bench 6038.0.2 c450b811b9b4 */
/* bench 6038.0.3 adae391273fb */
/* bench 6038.0.4 1e3bc2f54e34 */
/* bench 6038.0.5 20896dd6ee24 */
/* bench 6038.0.6 bf1797c6cf04 */
/* bench 6038.0.7 6fcdeb620964 */
/* bench 6038.0.8 1df81e3bade9 */
/* bench 6038.0.9 753200028a20 */
/* bench 6038.0.10 2b95caed73b2 */
/* bench 6038.0.11 8ec8cff4f5b3 */
/* bench 6038.0.12 4add851dcfda */
Example
-------

iomux: iomux@ff10601c {
	compatible = "abilis,tb10x-iomux";
	reg = <0xFF10601c 0x4>;
	pctl_gpio_a: pctl-gpio-a {
		abilis,function = "gpioa";
	};
	pctl_uart0: pctl-uart0 {
		abilis,function = "uart0";
	};
};
uart@ff100000 {
	compatible = "snps,dw-apb-uart";
	reg = <0xFF100000 0x100>;
	clock-frequency = <166666666>;
	interrupts = <25 1>;
	reg-shift = <2>;
	reg-io-width = <4>;
	pinctrl-names = "default";
	pinctrl-0 = <&pctl_uart0>;
};
gpioa: gpio@ff140000 {
	compatible = "abilis,tb10x-gpio";
	reg = <0xFF140000 0x1000>;
	gpio-controller;
	#gpio-cells = <2>;
	ngpio = <3>;
	gpio-ranges = <&iomux 0 0>;
	gpio-ranges-group-names = "gpioa";
};
```
