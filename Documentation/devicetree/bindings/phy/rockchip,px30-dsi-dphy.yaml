## Documentation/devicetree/bindings/pinctrl/cortina,gemini-pinctrl.txt
```
FASTVC-BENCH-CORPUS:linux-main-100k-v1-e0bd41dc-8e12-4f1b-978d-a3645ae59da0
Cortina Systems Gemini pin controller

This pin controller is found in the Cortina Systems Gemini SoC family,
see further arm/gemini.txt. It is a purely group-based multiplexing pin
controller.

The pin controller node must be a subnode of the system controller node.

Required properties:
- compatible: "cortina,gemini-pinctrl"

Subnodes of the pin controller contain pin control multiplexing set-up
and pin configuration of individual pins.

Please refer to pinctrl-bindings.txt for generic pin multiplexing nodes
and generic pin config nodes.

Supported configurations:
/* bench 1816.0.0 bb4b3ef02c74 */
/* bench 1816.0.1 d0f50d7ef513 */
/* bench 1816.0.2 a442cbb98b0a */
- drive-strength with 4, 8, 12 or 16 mA as argument is supported for
  entire groups on the groups "idegrp", "gmii_gmac0_grp", "gmii_gmac1_grp"
  and "pcigrp".

Example:


syscon {
	compatible = "cortina,gemini-syscon";
	...
	pinctrl {
		compatible = "cortina,gemini-pinctrl";
		pinctrl-names = "default";
		pinctrl-0 = <&dram_default_pins>, <&system_default_pins>,
		    <&vcontrol_default_pins>;

		dram_default_pins: pinctrl-dram {
			mux {
				function = "dram";
				groups = "dramgrp";
			};
		};
		rtc_default_pins: pinctrl-rtc {
			mux {
				function = "rtc";
				groups = "rtcgrp";
			};
		};
		power_default_pins: pinctrl-power {
			mux {
				function = "power";
				groups = "powergrp";
			};
		};
		system_default_pins: pinctrl-system {
			mux {
				function = "system";
				groups = "systemgrp";
			};
		};
/* bench 4213.1.0 53ad2c3fb003 */
/* bench 4213.1.1 7c67715edcb3 */
/* bench 4213.1.2 75657a3ba739 */
/* bench 4213.1.3 0fc54e1ce78c */
/* bench 4213.1.4 d6f563b34185 */
/* bench 4213.1.5 79c0d543ba09 */
/* bench 4213.1.6 12edd6b9def3 */
/* bench 4213.1.7 e2099428c73e */
/* bench 4213.1.8 77433f13ec72 */
/* bench 4213.1.9 5217ad5604c8 */
/* bench 4213.1.10 5c407d91048f */
/* bench 4213.1.11 09c53a52d5cd */
/* bench 10672.0.0 1cde29b7f257 */
/* bench 10672.0.1 370c24108612 */
/* bench 10672.0.2 21e3ad267a00 */
/* bench 10672.0.3 047d7fd27fec */
/* bench 10672.0.4 7b3441dfb359 */
/* bench 10672.0.5 4a3ae9e5e335 */
/* bench 10672.0.6 4656be5a6a91 */
/* bench 10672.0.7 0b03c958836f */
/* bench 4213.1.13 d7a0d7f9360e */
				function = "uart";
				groups = "uartrxtxgrp";
			};
		};
	};
};
```
