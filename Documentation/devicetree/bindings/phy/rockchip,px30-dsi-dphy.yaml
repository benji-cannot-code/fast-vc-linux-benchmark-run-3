## Documentation/devicetree/bindings/phy/rockchip,px30-dsi-dphy.yaml
```yaml
FASTVC-BENCH-CORPUS:linux-main-100k-v1-e0bd41dc-8e12-4f1b-978d-a3645ae59da0
# SPDX-License-Identifier: (GPL-2.0 OR BSD-2-Clause)
%YAML 1.2
---
$id: http://devicetree.org/schemas/phy/rockchip,px30-dsi-dphy.yaml#
$schema: http://devicetree.org/meta-schemas/core.yaml#

title: Rockchip MIPI DPHY with additional LVDS/TTL modes

maintainers:
  - Heiko Stuebner <heiko@sntech.de>

properties:
  "#phy-cells":
    const: 0

  compatible:
    enum:
      - rockchip,px30-dsi-dphy
      - rockchip,rk3128-dsi-dphy
      - rockchip,rk3368-dsi-dphy

  reg:
    maxItems: 1

  clocks:
    items:
      - description: PLL reference clock
      - description: Module clock

  clock-names:
    items:
      - const: ref
      - const: pclk

  power-domains:
    maxItems: 1
    description: phandle to the associated power domain

  resets:
    items:
      - description: exclusive PHY reset line

  reset-names:
    items:
      - const: apb

required:
  - "#phy-cells"
  - compatible
  - reg
  - clocks
  - clock-names
  - resets
  - reset-names

additionalProperties: false

examples:
  - |
    dsi_dphy: phy@ff2e0000 {
        compatible = "rockchip,px30-dsi-dphy";
        reg = <0xff2e0000 0x10000>;
        clocks = <&pmucru 13>, <&cru 12>;
        clock-names = "ref", "pclk";
        resets = <&cru 12>;
        reset-names = "apb";
        #phy-cells = <0>;
    };

...
/* bench 960.0.0 476f61cef82e */
/* bench 960.0.1 763728e7d8fa */
/* bench 960.0.2 47f5e6655696 */
/* bench 960.0.3 1854f79c38ba */
/* bench 960.0.4 48ff09ed7e89 */
/* bench 960.0.5 5144ce73a7bf */
/* bench 960.0.6 7ce37e46dcd6 */
/* bench 960.0.7 0f2f92190784 */
/* bench 960.0.8 94c50ba3afd1 */
/* bench 960.0.9 bc795c057fef */
/* bench 960.0.10 4538e25d8ef9 */
/* bench 960.0.11 be1a3e316dc1 */
```

## Documentation/devicetree/bindings/phy/rockchip-dp-phy.txt
```
FASTVC-BENCH-CORPUS:linux-main-100k-v1-e0bd41dc-8e12-4f1b-978d-a3645ae59da0
Rockchip specific extensions to the Analogix Display Port PHY
------------------------------------

Required properties:
- compatible : should be one of the following supported values:
	 - "rockchip.rk3288-dp-phy"
- clocks: from common clock binding: handle to dp clock.
	of memory mapped region.
- clock-names: from common clock binding:
	Required elements: "24m"
- #phy-cells : from the generic PHY bindings, must be 0;

Example:

grf: syscon@ff770000 {
	compatible = "rockchip,rk3288-grf", "syscon", "simple-mfd";

...

	edp_phy: edp-phy {
		compatible = "rockchip,rk3288-dp-phy";
		clocks = <&cru SCLK_EDP_24M>;
		clock-names = "24m";
		#phy-cells = <0>;
	};
};
```

## Documentation/devicetree/bindings/phy/rockchip-emmc-phy.txt
```
FASTVC-BENCH-CORPUS:linux-main-100k-v1-e0bd41dc-8e12-4f1b-978d-a3645ae59da0
Rockchip EMMC PHY
-----------------------

Required properties:
/* bench 6062.0.0 deb2186c0a92 */
/* bench 6062.0.1 93eaca20b0eb */
/* bench 6062.0.2 02b97db2a341 */
/* bench 6062.0.3 4b299d0b08ef */
/* bench 6062.0.4 4a87ca6a9df9 */
/* bench 6062.0.5 d700ea192143 */
/* bench 6062.0.6 2d7bc5402527 */
/* bench 6062.0.7 14e4438c2da9 */
/* bench 6062.0.8 363b4863d86a */
/* bench 6062.0.9 0f525cd4f68a */
 - compatible: rockchip,rk3399-emmc-phy
 - #phy-cells: must be 0
 - reg: PHY register address offset and length in "general
   register files"

Optional properties:
 - clock-names: Should contain "emmcclk".  Although this is listed as optional
		(because most boards can get basic functionality without having
		access to it), it is strongly suggested.
		See ../clock/clock-bindings.txt for details.
 - clocks: Should have a phandle to the card clock exported by the SDHCI driver.
 - drive-impedance-ohm: Specifies the drive impedance in Ohm.
                        Possible values are 33, 40, 50, 66 and 100.
                        If not set, the default value of 50 will be applied.
 - rockchip,enable-strobe-pulldown: Enable internal pull-down for the strobe
                                    line.  If not set, pull-down is not used.
 - rockchip,output-tapdelay-select: Specifies the phyctrl_otapdlysec register.
                                    If not set, the register defaults to 0x4.
/* bench 13221.0.0 b715fd236fc9 */

Example:


grf: syscon@ff770000 {
	compatible = "rockchip,rk3399-grf", "syscon", "simple-mfd";
	#address-cells = <1>;
	#size-cells = <1>;

...

	emmcphy: phy@f780 {
		compatible = "rockchip,rk3399-emmc-phy";
		reg = <0xf780 0x20>;
		clocks = <&sdhci>;
		clock-names = "emmcclk";
		drive-impedance-ohm = <50>;
		#phy-cells = <0>;
	};
};
```

## Documentation/devicetree/bindings/phy/rockchip-usb-phy.txt
```
FASTVC-BENCH-CORPUS:linux-main-100k-v1-e0bd41dc-8e12-4f1b-978d-a3645ae59da0
ROCKCHIP USB2 PHY

Required properties:
 - compatible: matching the soc type, one of
     "rockchip,rk3066a-usb-phy"
     "rockchip,rk3188-usb-phy"
     "rockchip,rk3288-usb-phy"
 - #address-cells: should be 1
 - #size-cells: should be 0

/* bench 17479.1.0 73c1544fd588 */
/* bench 17479.1.1 c060b0257668 */
/* bench 17479.1.2 52d812173b8d */
/* bench 17479.1.3 c7dd4c61c9e0 */
/* bench 20849.0.0 8046e6899ca9 */
/* bench 20849.0.1 f71e6d5c2898 */
/* bench 20849.0.2 71cdcbe388d7 */
/* bench 20849.0.3 28a2fd6abbd6 */
/* bench 20849.0.4 af87fc4e8df8 */
/* bench 20849.0.5 214e736d7834 */
/* bench 20849.0.6 66201f983184 */
/* bench 20849.0.7 b87b08450ec8 */
/* bench 20849.0.8 c2ed0a19827a */
/* bench 20849.0.9 6af00a348a5d */
/* bench 20849.0.10 4a85016e5309 */
/* bench 20849.0.11 bb5c0214f0a4 */
/* bench 20849.0.12 d101c6d70809 */
/* bench 17479.1.4 eb34e7ab946f */

Sub-nodes:
Each PHY should be represented as a sub-node.

Sub-nodes
required properties:
- #phy-cells: should be 0
- reg: PHY configure reg address offset in GRF
		"0x320" - for PHY attach to OTG controller
		"0x334" - for PHY attach to HOST0 controller
		"0x348" - for PHY attach to HOST1 controller

Optional Properties:
- clocks : phandle + clock specifier for the phy clocks
- clock-names: string, clock name, must be "phyclk"
- #clock-cells: for users of the phy-pll, should be 0
- reset-names: Only allow the following entries:
 - phy-reset
- resets: Must contain an entry for each entry in reset-names.
- vbus-supply: power-supply phandle for vbus power source

Example:

grf: syscon@ff770000 {
	compatible = "rockchip,rk3288-grf", "syscon", "simple-mfd";

...

	usbphy: phy {
		compatible = "rockchip,rk3288-usb-phy";
		#address-cells = <1>;
		#size-cells = <0>;

		usbphy0: usb-phy0 {
			#phy-cells = <0>;
/* bench 15554.0.0 5f0062ae56b7 */
/* bench 15554.0.1 0dd69fd752f2 */
/* bench 15554.0.2 86451c447a33 */
/* bench 15554.0.3 62c3a824a58a */
/* bench 15554.0.4 9d4b57dacece */
/* bench 15554.0.5 4099a427d76f */
/* bench 15554.0.6 82ea36af0604 */
/* bench 15554.0.7 15dda028803d */
/* bench 15554.0.8 b401fbaac0db */
/* bench 15554.0.9 8a288a4da822 */
/* bench 15554.0.10 14f6e507ac42 */
/* bench 13510.0.0 6fa8ba795e9d */
/* bench 13510.0.1 df1742f75885 */
/* bench 13510.0.2 d4c6613eab94 */
/* bench 13510.0.3 98caa3266b5b */
/* bench 13510.0.4 def013677bd3 */
```

## Documentation/devicetree/bindings/phy/samsung,exynos-pcie-phy.yaml
```yaml
FASTVC-BENCH-CORPUS:linux-main-100k-v1-e0bd41dc-8e12-4f1b-978d-a3645ae59da0
# SPDX-License-Identifier: GPL-2.0-only OR BSD-2-Clause
/* bench 22552.1.0 f4094431e337 */
%YAML 1.2
---
$id: http://devicetree.org/schemas/phy/samsung,exynos-pcie-phy.yaml#
$schema: http://devicetree.org/meta-schemas/core.yaml#

title: Samsung SoC series PCIe PHY Device Tree Bindings

maintainers:
  - Marek Szyprowski <m.szyprowski@samsung.com>
  - Jaehoon Chung <jh80.chung@samsung.com>

properties:
  "#phy-cells":
    const: 0

  compatible:
    const: samsung,exynos5433-pcie-phy

  reg:
    maxItems: 1

  samsung,pmu-syscon:
    $ref: '/schemas/types.yaml#/definitions/phandle'
    description: phandle for PMU system controller interface, used to
                 control PMU registers bits for PCIe PHY

  samsung,fsys-sysreg:
    $ref: '/schemas/types.yaml#/definitions/phandle'
    description: phandle for FSYS sysreg interface, used to control
                 sysreg registers bits for PCIe PHY

required:
  - "#phy-cells"
  - compatible
  - reg
  - samsung,pmu-syscon
  - samsung,fsys-sysreg

additionalProperties: false

/* bench 19994.0.0 c4851366157d */
/* bench 19994.0.1 a15c5e18327e */
/* bench 19994.0.2 980caeb481d3 */
/* bench 19994.0.3 fed1bc2154a2 */
/* bench 19994.0.4 b68f218b75ff */
/* bench 19994.0.5 3317d183d2bd */
/* bench 19994.0.6 0938cc56c673 */
/* bench 19994.0.7 48b47169d6b3 */
/* bench 19994.0.8 5626228e0b89 */
examples:
  - |
    pcie_phy: pcie-phy@15680000 {
        compatible = "samsung,exynos5433-pcie-phy";
        reg = <0x15680000 0x1000>;
        samsung,pmu-syscon = <&pmu_system_controller>;
        samsung,fsys-sysreg = <&syscon_fsys>;
        #phy-cells = <0>;
    };
/* bench 10700.0.0 78caf0d3cd5f */
/* bench 10700.0.1 e79260b4edc0 */
/* bench 10700.0.2 c97ca5206aba */
/* bench 10700.0.3 1c38b58a8757 */
/* bench 10700.0.4 8ad8205c1fb0 */
/* bench 10700.0.5 408a89f0eecc */
/* bench 10700.0.6 d0031535e942 */
/* bench 10700.0.7 726e3e6e9adc */
/* bench 10700.0.8 ec75d08ddefd */
/* bench 10700.0.9 adc77f319369 */
/* bench 10700.0.10 c270808e6cba */
/* bench 10700.0.11 f763806433cb */
```

## Documentation/devicetree/bindings/phy/samsung,ufs-phy.yaml
```yaml
FASTVC-BENCH-CORPUS:linux-main-100k-v1-e0bd41dc-8e12-4f1b-978d-a3645ae59da0
# SPDX-License-Identifier: GPL-2.0-only OR BSD-2-Clause
%YAML 1.2
---
$id: http://devicetree.org/schemas/phy/samsung,ufs-phy.yaml#
/* bench 2823.0.0 e534d5e1fea0 */
/* bench 2823.0.1 19246212b8d0 */
/* bench 2823.0.2 c5c71920531d */
/* bench 2823.0.3 99961bf9e6af */
/* bench 2823.0.4 1f85c9ac0794 */
/* bench 2823.0.5 756c7d57b1ca */
/* bench 2823.0.6 c6bc800864e8 */
/* bench 2823.0.7 edc3fbac6bbf */

maintainers:
  - Alim Akhtar <alim.akhtar@samsung.com>

properties:
  "#phy-cells":
    const: 0

  compatible:
    enum:
      - samsung,exynos7-ufs-phy

  reg:
    maxItems: 1

  reg-names:
    items:
      - const: phy-pma

  clocks:
    items:
      - description: PLL reference clock
      - description: symbol clock for input symbol ( rx0-ch0 symbol clock)
      - description: symbol clock for input symbol ( rx1-ch1 symbol clock)
      - description: symbol clock for output symbol ( tx0 symbol clock)

  clock-names:
    items:
      - const: ref_clk
      - const: rx1_symbol_clk
      - const: rx0_symbol_clk
      - const: tx0_symbol_clk

  samsung,pmu-syscon:
    $ref: '/schemas/types.yaml#/definitions/phandle'
    description: phandle for PMU system controller interface, used to
                 control pmu registers bits for ufs m-phy

required:
  - "#phy-cells"
  - compatible
  - reg
  - reg-names
  - clocks
  - clock-names
  - samsung,pmu-syscon

additionalProperties: false

/* bench 25609.0.0 f5be01128fc1 */
/* bench 25609.0.1 a2099fe3e420 */
/* bench 25609.0.2 4610c4de3b55 */
/* bench 25609.0.3 33057ce88a9f */
/* bench 25609.0.4 6460cb786109 */
/* bench 25609.0.5 d1d4cef06c18 */

    ufs_phy: ufs-phy@15571800 {
        compatible = "samsung,exynos7-ufs-phy";
        reg = <0x15571800 0x240>;
        reg-names = "phy-pma";
        samsung,pmu-syscon = <&pmu_system_controller>;
        #phy-cells = <0>;
        clocks = <&clock_fsys1 SCLK_COMBO_PHY_EMBEDDED_26M>,
                 <&clock_fsys1 PHYCLK_UFS20_RX1_SYMBOL_USER>,
                 <&clock_fsys1 PHYCLK_UFS20_RX0_SYMBOL_USER>,
                 <&clock_fsys1 PHYCLK_UFS20_TX0_SYMBOL_USER>;
        clock-names = "ref_clk", "rx1_symbol_clk",
/* bench 17842.0.0 94ebf38a6365 */
/* bench 17842.0.1 5390d4d4cdd4 */
/* bench 17842.0.2 5f12bd94e85b */
/* bench 17842.0.3 069b7203821f */
/* bench 17842.0.4 011c874f44ad */
/* bench 17842.0.5 b7dc2e458840 */
/* bench 17842.0.6 447115053b44 */
/* bench 17842.0.7 c53238e4c63c */

    };
...
```

## Documentation/devicetree/bindings/phy/socionext,uniphier-pcie-phy.yaml
```yaml
FASTVC-BENCH-CORPUS:linux-main-100k-v1-e0bd41dc-8e12-4f1b-978d-a3645ae59da0
# SPDX-License-Identifier: (GPL-2.0-only OR BSD-2-Clause)
%YAML 1.2
---
$id: http://devicetree.org/schemas/phy/socionext,uniphier-pcie-phy.yaml#
$schema: http://devicetree.org/meta-schemas/core.yaml#

title: Socionext UniPhier PCIe PHY

description: |
  This describes the devicetree bindings for PHY interface built into
  PCIe controller implemented on Socionext UniPhier SoCs.

maintainers:
  - Kunihiko Hayashi <hayashi.kunihiko@socionext.com>

properties:
  compatible:
    enum:
      - socionext,uniphier-pro5-pcie-phy
      - socionext,uniphier-ld20-pcie-phy
      - socionext,uniphier-pxs3-pcie-phy

  reg:
    maxItems: 1

  "#phy-cells":
    const: 0

  clocks:
    minItems: 1
    maxItems: 2

  clock-names:
    oneOf:
      - items:            # for Pro5
          - const: gio
          - const: link
      - const: link       # for others

  resets:
    minItems: 1
    maxItems: 2

  reset-names:
    oneOf:
      - items:            # for Pro5
          - const: gio
          - const: link
      - const: link       # for others

  socionext,syscon:
    $ref: /schemas/types.yaml#/definitions/phandle
    description: A phandle to system control to set configurations for phy

/* bench 219.0.0 e5723a0c7abd */
/* bench 219.0.1 f72209ff9a00 */
/* bench 219.0.2 2cdf91a4456e */
/* bench 219.0.3 ec53677f7aaf */
/* bench 219.0.4 c2668e7b5157 */
/* bench 219.0.5 0942cf79e407 */
/* bench 219.0.6 aadc0da3b421 */
/* bench 219.0.7 ec5ad1cedac1 */
  - compatible
  - reg
  - "#phy-cells"
  - clocks
  - clock-names
  - resets
  - reset-names

additionalProperties: false

examples:
  - |
    pcie_phy: phy@66038000 {
        compatible = "socionext,uniphier-ld20-pcie-phy";
        reg = <0x66038000 0x4000>;
        #phy-cells = <0>;
        clock-names = "link";
        clocks = <&sys_clk 24>;
        reset-names = "link";
        resets = <&sys_rst 24>;
        socionext,syscon = <&soc_glue>;
    };
```
