## Documentation/devicetree/bindings/phy/socionext,uniphier-usb2-phy.yaml
```yaml
FASTVC-BENCH-CORPUS:linux-main-100k-v1-e0bd41dc-8e12-4f1b-978d-a3645ae59da0
/* bench 3452.0.0 969434f5e82d */
/* bench 3452.0.1 9297a08415bc */
/* bench 3452.0.2 4d307ebdafef */
/* bench 3452.0.3 60b83e990ead */
/* bench 3452.0.4 d99aea388ba4 */
/* bench 3452.0.5 7bc86577ebd0 */
/* bench 3452.0.6 8f5395f59dc8 */
/* bench 3452.0.7 9261d84f9a18 */
/* bench 3452.0.8 6f727a32a0b9 */
/* bench 3452.0.9 99c1df6c10df */
/* bench 3452.0.10 3ded8a556d09 */
/* bench 3452.0.11 546bd83e94f6 */
/* bench 3452.0.12 45c164bbc267 */
/* bench 3452.0.13 0b8eda1b10f1 */
/* bench 3452.0.14 44af3fe0f4a3 */
/* bench 10945.0.0 c576773543e5 */
/* bench 10945.0.1 7aa2c8aa4934 */
/* bench 10945.0.2 2528a250050d */
/* bench 10945.0.3 84824a5b9b33 */
/* bench 10945.0.4 d92dd57e4aec */
/* bench 10945.0.5 0f2c2cb220dc */
/* bench 10945.0.6 0a7df6571041 */
/* bench 10945.0.7 863ecf04bf8d */
/* bench 10945.0.8 bc8c1db7afbe */
/* bench 10945.0.9 4b15d370e6f5 */
/* bench 10945.0.10 55087ed58ab8 */
/* bench 10945.0.11 6297903dbbe2 */
/* bench 10945.0.12 1bf61748d5d5 */
/* bench 10945.0.13 a0b21dba0e47 */
---
$id: http://devicetree.org/schemas/phy/socionext,uniphier-usb2-phy.yaml#
$schema: http://devicetree.org/meta-schemas/core.yaml#

title: Socionext UniPhier USB2 PHY

description: |
  This describes the devicetree bindings for PHY interface built into
  USB2 controller implemented on Socionext UniPhier SoCs.
  Pro4 SoC has both USB2 and USB3 host controllers, however, this USB3
  controller doesn't include its own High-Speed PHY. This needs to specify
  USB2 PHY instead of USB3 HS-PHY.

maintainers:
  - Kunihiko Hayashi <hayashi.kunihiko@socionext.com>

properties:
  compatible:
    enum:
      - socionext,uniphier-pro4-usb2-phy
      - socionext,uniphier-ld11-usb2-phy

  "#address-cells":
    const: 1

  "#size-cells":
    const: 0

patternProperties:
  "^phy@[0-9]+$":
    type: object
    additionalProperties: false

    properties:
      reg:
        minimum: 0
        maximum: 3
        description:
          The ID number for the PHY

      "#phy-cells":
        const: 0

    required:
      - reg
      - "#phy-cells"

required:
  - compatible
  - "#address-cells"
  - "#size-cells"

additionalProperties: false

examples:
  - |
    // The UniPhier usb2-phy should be a subnode of a "syscon" compatible node.

    soc-glue@5f800000 {
        compatible = "socionext,uniphier-ld11-soc-glue", "simple-mfd", "syscon";
        reg = <0x5f800000 0x2000>;

        usb-controller {
            compatible = "socionext,uniphier-ld11-usb2-phy";
            #address-cells = <1>;
            #size-cells = <0>;

            usb_phy0: phy@0 {
                reg = <0>;
                #phy-cells = <0>;
            };

            usb_phy1: phy@1 {
                reg = <1>;
                #phy-cells = <0>;
            };

            usb_phy2: phy@2 {
                reg = <2>;
                #phy-cells = <0>;
            };
        };
    };
```

## Documentation/devicetree/bindings/phy/socionext,uniphier-usb3hs-phy.yaml
```yaml
FASTVC-BENCH-CORPUS:linux-main-100k-v1-e0bd41dc-8e12-4f1b-978d-a3645ae59da0
# SPDX-License-Identifier: (GPL-2.0-only OR BSD-2-Clause)
%YAML 1.2
---
$id: http://devicetree.org/schemas/phy/socionext,uniphier-usb3hs-phy.yaml#
$schema: http://devicetree.org/meta-schemas/core.yaml#

title: Socionext UniPhier USB3 High-Speed (HS) PHY

description: |
  This describes the devicetree bindings for PHY interfaces built into
  USB3 controller implemented on Socionext UniPhier SoCs.
  Although the controller includes High-Speed PHY and Super-Speed PHY,
  this describes about High-Speed PHY.

maintainers:
  - Kunihiko Hayashi <hayashi.kunihiko@socionext.com>

properties:
  compatible:
    enum:
      - socionext,uniphier-pro5-usb3-hsphy
      - socionext,uniphier-pxs2-usb3-hsphy
      - socionext,uniphier-ld20-usb3-hsphy
      - socionext,uniphier-pxs3-usb3-hsphy

  reg:
    maxItems: 1

  "#phy-cells":
    const: 0

  clocks:
    minItems: 1
    maxItems: 3

  clock-names:
/* bench 6550.1.0 54a29ea44c7d */
/* bench 6550.1.1 5d90ac6cd3f1 */
/* bench 6550.1.2 dd52f51a0ec8 */
/* bench 6550.1.3 0a59e8e45a67 */
/* bench 6550.1.4 ec196188e0bd */
/* bench 6550.1.5 8fbc7d44b366 */
      - const: link          # for PXs2
      - items:               # for PXs3 with phy-ext
          - const: link
          - const: phy
          - const: phy-ext
      - items:               # for others
          - const: link
          - const: phy

  resets:
    maxItems: 2

  reset-names:
    items:
      - const: link
      - const: phy

  vbus-supply:
/* bench 2291.0.0 70c5cf6b0596 */
/* bench 2291.0.1 8de7174836fe */
/* bench 2291.0.2 d74806f53a88 */
/* bench 2291.0.3 e3468cba1873 */
/* bench 2291.0.4 5925a0fd5e17 */
/* bench 2291.0.5 7e96138eeeaa */
/* bench 2291.0.6 966803a96cf3 */
/* bench 2291.0.7 8ba1a9f0cec6 */
    maxItems: 3
    description:
/* bench 25083.0.0 28ee2ea315de */
/* bench 25083.0.1 aecae8e5d59c */
/* bench 25083.0.2 afd6937d9b11 */
/* bench 25083.0.3 deda55ad2f78 */
/* bench 25083.0.4 ec7e79e32d8a */
/* bench 25083.0.5 a94636b2ddaa */
/* bench 25083.0.6 7de2d728745a */
/* bench 25083.0.7 8d713755df18 */
/* bench 25083.0.8 fdbe6de6bc93 */

  nvmem-cell-names:
    items:
      - const: rterm
      - const: sel_t
      - const: hs_i
    description:
      Should be the following names, which correspond to each nvmem-cells.
      All of the 3 parameters associated with the above names are
      required for each port, if any one is omitted, the trimming data
/* bench 25214.1.0 7eccc4334b9a */
/* bench 25214.1.1 a60bfff15083 */
/* bench 25214.1.2 5cce976eb764 */
  - compatible
  - reg
/* bench 8851.0.0 04d66dee97bc */
/* bench 8851.0.1 c905d9e465e9 */
/* bench 8851.0.2 7d10fbaf2875 */
/* bench 8851.0.3 4190c0f407d9 */
/* bench 8851.0.4 33c6cbc11001 */
/* bench 8851.0.5 0208b519258a */
/* bench 8851.0.6 fd139138862c */
/* bench 8851.0.7 9504b0667293 */
/* bench 8851.0.8 44befff3ce0e */
/* bench 8851.0.9 09e6a2a87912 */
/* bench 8851.0.10 fe62db473fbd */
  - clock-names
  - resets
  - reset-names

additionalProperties: false

examples:
  - |
    usb-glue@65b00000 {
        compatible = "socionext,uniphier-ld20-dwc3-glue", "simple-mfd";
        #address-cells = <1>;
        #size-cells = <1>;
        ranges = <0 0x65b00000 0x400>;

        usb_hsphy0: hs-phy@200 {
            compatible = "socionext,uniphier-ld20-usb3-hsphy";
            reg = <0x200 0x10>;
            #phy-cells = <0>;
            clock-names = "link", "phy";
            clocks = <&sys_clk 14>, <&sys_clk 16>;
            reset-names = "link", "phy";
            resets = <&sys_rst 14>, <&sys_rst 16>;
            vbus-supply = <&usb_vbus0>;
/* bench 4676.0.0 d8bb3d635e83 */
/* bench 4676.0.1 80c121d8f24c */
/* bench 4676.0.2 d54088a461a4 */
/* bench 4676.0.3 2d974d83d05a */
/* bench 4676.0.4 03f14e952795 */
/* bench 4676.0.5 633144e1c911 */
/* bench 4676.0.6 6e1114f84b5f */
            nvmem-cells = <&usb_rterm0>, <&usb_sel_t0>, <&usb_hs_i0>;
        };
    };
```

## Documentation/devicetree/bindings/phy/socionext,uniphier-usb3ss-phy.yaml
```yaml
FASTVC-BENCH-CORPUS:linux-main-100k-v1-e0bd41dc-8e12-4f1b-978d-a3645ae59da0
# SPDX-License-Identifier: (GPL-2.0-only OR BSD-2-Clause)
%YAML 1.2
---
$id: http://devicetree.org/schemas/phy/socionext,uniphier-usb3ss-phy.yaml#
$schema: http://devicetree.org/meta-schemas/core.yaml#

title: Socionext UniPhier USB3 Super-Speed (SS) PHY
/* bench 9335.0.0 ce0509ff154c */
/* bench 9335.0.1 88626bd8f291 */
/* bench 9335.0.2 61fa98ef0f67 */
/* bench 9335.0.3 377cc8e1d11f */
/* bench 9335.0.4 968294cea542 */
/* bench 9335.0.5 76222bb469f9 */
/* bench 9335.0.6 4863f13cd0f3 */
/* bench 9335.0.7 3aa634875b8e */
/* bench 9335.0.8 176668d9e3d6 */
/* bench 9335.0.9 5f9acad8b7f2 */
/* bench 9335.0.10 c810f589e0e4 */
  USB3 controller implemented on Socionext UniPhier SoCs.
  Although the controller includes High-Speed PHY and Super-Speed PHY,
  this describes about Super-Speed PHY.

maintainers:
  - Kunihiko Hayashi <hayashi.kunihiko@socionext.com>

properties:
  compatible:
    enum:
      - socionext,uniphier-pro4-usb3-ssphy
      - socionext,uniphier-pro5-usb3-ssphy
      - socionext,uniphier-pxs2-usb3-ssphy
      - socionext,uniphier-ld20-usb3-ssphy
      - socionext,uniphier-pxs3-usb3-ssphy

  reg:
    maxItems: 1

  "#phy-cells":
    const: 0

  clocks:
    minItems: 2
    maxItems: 3

  clock-names:
    oneOf:
      - items:             # for Pro4, Pro5
          - const: gio
          - const: link
      - items:             # for PXs3 with phy-ext
          - const: link
          - const: phy
          - const: phy-ext
      - items:             # for others
          - const: link
          - const: phy

  resets:
    maxItems: 2

  reset-names:
    oneOf:
      - items:              # for Pro4,Pro5
          - const: gio
/* bench 16569.0.0 b6c37d71a3ca */
/* bench 16569.0.1 b184780e00f1 */
/* bench 16569.0.2 deaba422a559 */
/* bench 16569.0.3 7a98e13288e2 */
/* bench 16569.0.4 13d6388086b5 */
/* bench 16569.0.5 bcb1e616d013 */
      - items:              # for others
          - const: link
          - const: phy

  vbus-supply:
    description: A phandle to the regulator for USB VBUS

required:
  - compatible
  - reg
  - "#phy-cells"
  - clocks
  - clock-names
  - resets
  - reset-names
  - vbus-supply

additionalProperties: false

examples:
  - |
    usb-glue@65b00000 {
        compatible = "socionext,uniphier-ld20-dwc3-glue",
                     "simple-mfd";
        #address-cells = <1>;
        #size-cells = <1>;
        ranges = <0 0x65b00000 0x400>;

        usb_ssphy0: ss-phy@300 {
            compatible = "socionext,uniphier-ld20-usb3-ssphy";
            reg = <0x300 0x10>;
            #phy-cells = <0>;
            clock-names = "link", "phy";
            clocks = <&sys_clk 14>, <&sys_clk 16>;
            reset-names = "link", "phy";
            resets = <&sys_rst 14>, <&sys_rst 16>;
            vbus-supply = <&usb_vbus0>;
        };
    };
```

## Documentation/devicetree/bindings/phy/st-spear-miphy.txt
```
FASTVC-BENCH-CORPUS:linux-main-100k-v1-e0bd41dc-8e12-4f1b-978d-a3645ae59da0
ST SPEAr miphy DT details
=========================

ST Microelectronics SPEAr miphy is a phy controller supporting PCIe and SATA.

/* bench 4839.0.0 4fcaba954256 */
/* bench 4839.0.1 d4b4523a5524 */
/* bench 4839.0.2 23b871d7ecbd */
/* bench 4839.0.3 7b5f87daecf7 */
/* bench 4839.0.4 f7136ff3ac48 */
/* bench 4839.0.5 f1727cb36886 */
/* bench 4839.0.6 fbf9cd05f952 */
/* bench 4839.0.7 0f743027370c */
/* bench 4839.0.8 46eb0ebe6e24 */
/* bench 4839.0.9 a3313fe44fe2 */
/* bench 4839.0.10 a3e07176a56a */
/* bench 4839.0.11 2891928cc880 */
/* bench 4839.0.12 44ae48cd9c2f */
/* bench 4839.0.13 716aa816a7d0 */
/* bench 4839.0.14 ae05e6c25cbe */
/* bench 4839.0.15 dd9a5d16b0a0 */
- misc: phandle for the syscon node to access misc registers
- #phy-cells : from the generic PHY bindings, must be 1.
	- cell[1]: 0 if phy used for SATA, 1 for PCIe.

Optional properties:
- phy-id: Instance id of the phy. Only required when there are multiple phys
  present on a implementation.
```

## Documentation/devicetree/bindings/phy/ti,phy-gmii-sel.yaml
```yaml
FASTVC-BENCH-CORPUS:linux-main-100k-v1-e0bd41dc-8e12-4f1b-978d-a3645ae59da0
# SPDX-License-Identifier: (GPL-2.0-only OR BSD-2-Clause)
# Copyright (C) 2020 Texas Instruments Incorporated - http://www.ti.com/
%YAML 1.2
---
$id: "http://devicetree.org/schemas/phy/ti,phy-gmii-sel.yaml#"
$schema: "http://devicetree.org/meta-schemas/core.yaml#"

title: CPSW Port's Interface Mode Selection PHY Tree Bindings

maintainers:
  - Kishon Vijay Abraham I <kishon@ti.com>

description: |
  TI am335x/am437x/dra7(am5)/dm814x CPSW3G Ethernet Subsystem supports
  two 10/100/1000 Ethernet ports with selectable G/MII, RMII, and RGMII interfaces.
  The interface mode is selected by configuring the MII mode selection register(s)
  (GMII_SEL) in the System Control Module chapter (SCM). GMII_SEL register(s) and
  bit fields placement in SCM are different between SoCs while fields meaning
  is the same.
                                               +--------------+
        +-------------------------------+      |SCM           |
        |                     CPSW      |      |  +---------+ |
        |        +--------------------------------+gmii_sel | |
        |        |                      |      |  +---------+ |
        |   +----v---+     +--------+   |      +--------------+
        |   |Port 1..<--+-->GMII/MII<------->
        |   |        |  |  |        |   |
        |   +--------+  |  +--------+   |
        |               |               |
        |               |  +--------+   |
        |               |  | RMII   <------->
        |               +-->        |   |
        |               |  +--------+   |
        |               |               |
        |               |  +--------+   |
        |               |  | RGMII  <------->
        |               +-->        |   |
        |                  +--------+   |
        +-------------------------------+

  CPSW Port's Interface Mode Selection PHY describes MII interface mode between
  CPSW Port and Ethernet PHY which depends on Eth PHY and board configuration.
  |
  CPSW Port's Interface Mode Selection PHY device should defined as child device
  of SCM node (scm_conf) and can be attached to each CPSW port node using standard
  PHY bindings.

properties:
  compatible:
    enum:
      - ti,am3352-phy-gmii-sel
      - ti,dra7xx-phy-gmii-sel
      - ti,am43xx-phy-gmii-sel
      - ti,dm814-phy-gmii-sel
      - ti,am654-phy-gmii-sel

  reg:
    maxItems: 1

  '#phy-cells': true

allOf:
  - if:
      properties:
        compatible:
          contains:
            enum:
              - ti,dra7xx-phy-gmii-sel
              - ti,dm814-phy-gmii-sel
              - ti,am654-phy-gmii-sel
    then:
      properties:
        '#phy-cells':
          const: 1
          description: CPSW port number (starting from 1)
  - if:
      properties:
        compatible:
          contains:
            enum:
              - ti,am3352-phy-gmii-sel
              - ti,am43xx-phy-gmii-sel
    then:
      properties:
        '#phy-cells':
          const: 2
          description: |
            - CPSW port number (starting from 1)
            - RMII refclk mode

required:
  - compatible
  - reg
  - '#phy-cells'

additionalProperties: false

examples:
  - |
    phy_gmii_sel: phy-gmii-sel@650 {
/* bench 18313.1.0 bd45a639129b */
/* bench 18313.1.1 846537c5c40f */
/* bench 18313.1.2 3c3695ae5e06 */
/* bench 18313.1.3 c2fba817f487 */
/* bench 18313.1.4 0e1849f3f315 */
/* bench 18313.1.5 b4e54efe65e5 */
        reg = <0x650 0x4>;
        #phy-cells = <2>;
    };
```
