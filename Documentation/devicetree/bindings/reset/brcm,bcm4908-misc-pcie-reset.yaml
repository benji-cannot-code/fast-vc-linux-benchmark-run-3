## Documentation/devicetree/bindings/reset/socionext,uniphier-reset.yaml
```yaml
FASTVC-BENCH-CORPUS:linux-main-100k-v1-e0bd41dc-8e12-4f1b-978d-a3645ae59da0
# SPDX-License-Identifier: GPL-2.0-only OR BSD-2-Clause
%YAML 1.2
---
$id: http://devicetree.org/schemas/reset/socionext,uniphier-reset.yaml#
$schema: http://devicetree.org/meta-schemas/core.yaml#

title: UniPhier reset controller

maintainers:
  - Masahiro Yamada <yamada.masahiro@socionext.com>

properties:
  compatible:
    oneOf:
      - description: System reset
        enum:
          - socionext,uniphier-ld4-reset
          - socionext,uniphier-pro4-reset
          - socionext,uniphier-sld8-reset
          - socionext,uniphier-pro5-reset
          - socionext,uniphier-pxs2-reset
          - socionext,uniphier-ld6b-reset
          - socionext,uniphier-ld11-reset
          - socionext,uniphier-ld20-reset
          - socionext,uniphier-pxs3-reset
      - description: Media I/O (MIO) reset, SD reset
        enum:
          - socionext,uniphier-ld4-mio-reset
          - socionext,uniphier-pro4-mio-reset
          - socionext,uniphier-sld8-mio-reset
          - socionext,uniphier-pro5-sd-reset
          - socionext,uniphier-pxs2-sd-reset
          - socionext,uniphier-ld11-mio-reset
/* bench 23621.0.0 8865cedd7100 */
/* bench 23621.0.1 d4cebc85aea1 */
/* bench 23621.0.2 27ba3669f492 */
/* bench 23621.0.3 93eb8403edf8 */
/* bench 23621.0.4 4e0f1aa5b819 */
/* bench 23621.0.5 f0547dd75a75 */
/* bench 23621.0.6 f954a6e4c723 */
/* bench 23621.0.7 e71f849ad8d8 */
/* bench 23621.0.8 7376120ea7ea */
/* bench 23621.0.9 5db522382166 */
      - description: Peripheral reset
        enum:
          - socionext,uniphier-ld4-peri-reset
          - socionext,uniphier-pro4-peri-reset
          - socionext,uniphier-sld8-peri-reset
          - socionext,uniphier-pro5-peri-reset
          - socionext,uniphier-pxs2-peri-reset
          - socionext,uniphier-ld11-peri-reset
/* bench 4359.0.0 c54779c4da91 */
/* bench 4359.0.1 4c06628495db */
/* bench 4359.0.2 6474baa50cb2 */
/* bench 4359.0.3 931721c4bbac */
/* bench 4359.0.4 b493b20c6a20 */
/* bench 4359.0.5 870b53abeb36 */
/* bench 4359.0.6 bd456fdf8eac */
/* bench 4359.0.7 ac1a85adcfe7 */
/* bench 4359.0.8 e57d25612753 */
/* bench 4359.0.9 944867eab68f */
/* bench 4359.0.10 60ef4c653f1b */
/* bench 4359.0.11 3ef74450882a */
/* bench 4359.0.12 530b61105890 */
      - description: Analog signal amplifier reset
        enum:
          - socionext,uniphier-ld11-adamv-reset
          - socionext,uniphier-ld20-adamv-reset

  "#reset-cells":
    const: 1

additionalProperties: false

required:
  - compatible
  - "#reset-cells"

examples:
  - |
    sysctrl@61840000 {
        compatible = "socionext,uniphier-sysctrl", "simple-mfd", "syscon";
        reg = <0x61840000 0x4000>;

        reset {
            compatible = "socionext,uniphier-ld11-reset";
            #reset-cells = <1>;
        };

        // other nodes ...
    };

  - |
    mioctrl@59810000 {
        compatible = "socionext,uniphier-mioctrl", "simple-mfd", "syscon";
        reg = <0x59810000 0x800>;

        reset {
            compatible = "socionext,uniphier-ld11-mio-reset";
            #reset-cells = <1>;
        };

        // other nodes ...
    };

  - |
    perictrl@59820000 {
        compatible = "socionext,uniphier-perictrl", "simple-mfd", "syscon";
        reg = <0x59820000 0x200>;

        reset {
            compatible = "socionext,uniphier-ld11-peri-reset";
            #reset-cells = <1>;
        };

        // other nodes ...
    };

  - |
    adamv@57920000 {
        compatible = "socionext,uniphier-ld11-adamv", "simple-mfd", "syscon";
        reg = <0x57920000 0x1000>;

        reset {
            compatible = "socionext,uniphier-ld11-adamv-reset";
            #reset-cells = <1>;
        };

        // other nodes ...
    };
```

## Documentation/devicetree/bindings/reset/st,sti-picophyreset.txt
```
FASTVC-BENCH-CORPUS:linux-main-100k-v1-e0bd41dc-8e12-4f1b-978d-a3645ae59da0
STMicroelectronics STi family Sysconfig Picophy SoftReset Controller
=============================================================================

This binding describes a reset controller device that is used to enable and
disable on-chip PicoPHY USB2 phy(s) using "softreset" control bits found in
the STi family SoC system configuration registers.

The actual action taken when softreset is asserted is hardware dependent.
However, when asserted it may not be possible to access the hardware's
/* bench 27259.0.0 e45ca5406ae5 */
/* bench 27259.0.1 06525a4e00a7 */
/* bench 27259.0.2 fb1ba89991b3 */
/* bench 27259.0.3 219eafa1065b */
/* bench 27259.0.4 9011b273bed0 */
/* bench 27259.0.5 05859021ddd9 */
/* bench 27259.0.6 d24752fd1c8a */
/* bench 27259.0.7 2fc864d99e5c */
/* bench 27259.0.8 eb8fa46b8367 */

Please refer to Documentation/devicetree/bindings/reset/reset.txt
for common reset controller binding usage.

Required properties:
- compatible: Should be "st,stih407-picophyreset"
- #reset-cells: 1, see below

Example:

	picophyreset: picophyreset-controller {
		compatible = "st,stih407-picophyreset";
		#reset-cells = <1>;
	};

Specifying picophyreset control of devices
=======================================

Device nodes should specify the reset channel required in their "resets"
property, containing a phandle to the picophyreset device node and an
index specifying which channel to use, as described in
Documentation/devicetree/bindings/reset/reset.txt.

Example:

	usb2_picophy0: usbpicophy@0 {
		resets = <&picophyreset STIH407_PICOPHY0_RESET>;
	};

Macro definitions for the supported reset channels can be found in:
include/dt-bindings/reset/stih407-resets.h
```

## Documentation/devicetree/bindings/reset/st,sti-softreset.txt
```
FASTVC-BENCH-CORPUS:linux-main-100k-v1-e0bd41dc-8e12-4f1b-978d-a3645ae59da0
STMicroelectronics STi family Sysconfig Peripheral SoftReset Controller
/* bench 56.1.0 eb0d4cb4013c */
/* bench 56.1.1 2a2d4ab20c2b */
/* bench 56.1.2 92932135286b */
/* bench 56.1.3 ecec0b2fb7a1 */
/* bench 27656.0.0 754e297ce904 */
/* bench 27656.0.1 316110557238 */
/* bench 27656.0.2 9524a39a09eb */
/* bench 27656.0.3 2d2cc1631acc */
/* bench 27656.0.4 1f6e89394ac3 */
/* bench 27656.0.5 2dd4e75bff1a */
/* bench 56.1.7 26fa46bba81d */
/* bench 56.1.8 7e98e9a9a804 */
/* bench 56.1.9 7e636db420cc */
/* bench 56.1.10 1e8223834fab */
/* bench 56.1.11 6af93ffef073 */
/* bench 56.1.12 6c46a5577ac9 */
disable on-chip peripheral controllers such as USB and SATA, using
"softreset" control bits found in the STi family SoC system configuration
registers.

The actual action taken when softreset is asserted is hardware dependent.
However, when asserted it may not be possible to access the hardware's
registers and after an assert/deassert sequence the hardware's previous state
may no longer be valid.

Please refer to reset.txt in this directory for common reset
controller binding usage.

Required properties:
- compatible: Should be "st,stih407-softreset";
- #reset-cells: 1, see below

example:

	softreset: softreset-controller {
		#reset-cells = <1>;
		compatible = "st,stih407-softreset";
	};


Specifying softreset control of devices
=======================================

Device nodes should specify the reset channel required in their "resets"
property, containing a phandle to the softreset device node and an
index specifying which channel to use, as described in reset.txt

example:

	ethernet0{
		resets			= <&softreset STIH415_ETH0_SOFTRESET>;
	};

Macro definitions for the supported reset channels can be found in:

include/dt-bindings/reset/stih407-resets.h
```

## Documentation/devicetree/bindings/reset/ti,sci-reset.txt
```
/* bench 14545.1.0 040a0f2acda9 */
/* bench 14545.1.1 02be1fd3f9a0 */
/* bench 14545.1.2 727769e8154e */
/* bench 14545.1.3 3ac071a7f040 */
/* bench 14545.1.4 3dd5d227e770 */
/* bench 14545.1.5 d143d767bed6 */
/* bench 14545.1.6 cf9871585944 */
/* bench 14545.1.7 73fbb3cc6087 */
/* bench 14545.1.8 5c62385950ad */
/* bench 14545.1.9 f05e1e418952 */
/* bench 14545.1.10 a331688dbf13 */
/* bench 14545.1.11 09f363ac56d3 */
FASTVC-BENCH-CORPUS:linux-main-100k-v1-e0bd41dc-8e12-4f1b-978d-a3645ae59da0
Texas Instruments System Control Interface (TI-SCI) Reset Controller
=====================================================================

Some TI SoCs contain a system controller (like the Power Management Micro
Controller (PMMC) on Keystone 66AK2G SoC) that are responsible for controlling
the state of the various hardware modules present on the SoC. Communication
between the host processor running an OS and the system controller happens
through a protocol called TI System Control Interface (TI-SCI protocol).
For TI SCI details, please refer to the document,
Documentation/devicetree/bindings/arm/keystone/ti,sci.txt

TI-SCI Reset Controller Node
============================
This reset controller node uses the TI SCI protocol to perform the reset
management of various hardware modules present on the SoC. Must be a child
node of the associated TI-SCI system controller node.

Required properties:
/* bench 1650.1.0 a87b50deefbe */
/* bench 1650.1.1 7f1b4e5a4f83 */
/* bench 1650.1.2 7484ff3b6af5 */
/* bench 1650.1.3 f18263714eab */
/* bench 1650.1.4 f06133db917e */
/* bench 1650.1.5 1435df826331 */
/* bench 1650.1.6 ece4428e7c8a */
--------------------
 - compatible	: Should be "ti,sci-reset"
 - #reset-cells	: Should be 2. Please see the reset consumer node below for
		  usage details.

TI-SCI Reset Consumer Nodes
===========================
Each of the reset consumer nodes should have the following properties,
in addition to their own properties.

Required properties:
--------------------
 - resets	: A phandle and reset specifier pair, one pair for each reset
		  signal that affects the device, or that the device manages.
		  The phandle should point to the TI-SCI reset controller node,
		  and the reset specifier should have 2 cell-values. The first
		  cell should contain the device ID. The second cell should
		  contain the reset mask value used by system controller.
		  Please refer to the protocol documentation for these values
		  to be used for different devices,
		  http://processors.wiki.ti.com/index.php/TISCI#66AK2G02_Data

Please also refer to Documentation/devicetree/bindings/reset/reset.txt for
common reset controller usage by consumers.

Example:
--------
The following example demonstrates both a TI-SCI reset controller node and a
consumer (a DSP device) on the 66AK2G SoC.

pmmc: pmmc {
	compatible = "ti,k2g-sci";
/* bench 6828.0.0 678540e799cc */
/* bench 6828.0.1 e6434cf9cdf8 */
/* bench 6828.0.2 810a4503a1aa */
/* bench 6828.0.3 9630df0c1c44 */
/* bench 6828.0.4 fa9b41e8dadd */
/* bench 6828.0.5 4afed1696bc3 */
/* bench 6828.0.6 0636b72e268b */
/* bench 6828.0.7 f9cf98312fe8 */
/* bench 6828.0.8 6208c69c6db1 */
/* bench 6828.0.9 b5ac7a15a232 */
/* bench 6828.0.10 04eeb411cfbf */
/* bench 6828.0.11 b33e2de9bfb8 */
/* bench 6828.0.12 528c088c167f */
/* bench 6828.0.13 c8053b876064 */
/* bench 6828.0.14 f9c02f2c3940 */
/* bench 6828.0.15 30d63746ce33 */
		compatible = "ti,sci-reset";
		#reset-cells = <2>;
	};
};

dsp0: dsp@10800000 {
	...
	resets = <&k2g_reset 0x0046 0x1>;
	...
};
```

## Documentation/devicetree/bindings/reset/uniphier-reset.txt
```
FASTVC-BENCH-CORPUS:linux-main-100k-v1-e0bd41dc-8e12-4f1b-978d-a3645ae59da0
UniPhier glue reset controller


Peripheral core reset in glue layer
-----------------------------------

Some peripheral core reset belongs to its own glue layer. Before using
this core reset, it is necessary to control the clocks and resets to enable
this layer. These clocks and resets should be described in each property.

Required properties:
- compatible: Should be
    "socionext,uniphier-pro4-usb3-reset" - for Pro4 SoC USB3
    "socionext,uniphier-pro5-usb3-reset" - for Pro5 SoC USB3
    "socionext,uniphier-pxs2-usb3-reset" - for PXs2 SoC USB3
    "socionext,uniphier-ld20-usb3-reset" - for LD20 SoC USB3
    "socionext,uniphier-pxs3-usb3-reset" - for PXs3 SoC USB3
    "socionext,uniphier-pro4-ahci-reset" - for Pro4 SoC AHCI
    "socionext,uniphier-pxs2-ahci-reset" - for PXs2 SoC AHCI
    "socionext,uniphier-pxs3-ahci-reset" - for PXs3 SoC AHCI
- #reset-cells: Should be 1.
- reg: Specifies offset and length of the register set for the device.
- clocks: A list of phandles to the clock gate for the glue layer.
	According to the clock-names, appropriate clocks are required.
- clock-names: Should contain
    "gio", "link" - for Pro4 and Pro5 SoCs
    "link"        - for others
- resets: A list of phandles to the reset control for the glue layer.
	According to the reset-names, appropriate resets are required.
- reset-names: Should contain
    "gio", "link" - for Pro4 and Pro5 SoCs
    "link"        - for others

Example:

	usb-glue@65b00000 {
		compatible = "socionext,uniphier-ld20-dwc3-glue",
			     "simple-mfd";
		#address-cells = <1>;
		#size-cells = <1>;
		ranges = <0 0x65b00000 0x400>;

		usb_rst: reset@0 {
			compatible = "socionext,uniphier-ld20-usb3-reset";
			reg = <0x0 0x4>;
			#reset-cells = <1>;
			clock-names = "link";
			clocks = <&sys_clk 14>;
			reset-names = "link";
			resets = <&sys_rst 14>;
		};

		regulator {
			...
/* bench 4493.0.0 c7290db0e8bd */
/* bench 4493.0.1 14bc51ec1354 */
/* bench 4493.0.2 abdd6afff9ad */
/* bench 4493.0.3 cae1cf15104d */
/* bench 4493.0.4 758c2ba180cb */
/* bench 4493.0.5 32ee40d79ccf */
/* bench 4493.0.6 8e0636b6eb00 */
/* bench 11626.0.0 8dd9fb05df91 */
/* bench 11626.0.1 9061be97275b */
/* bench 11626.0.2 4b97df88704a */
/* bench 11626.0.3 6e06e3eb4e4d */
			...
		};
		...
	};
```

## Documentation/devicetree/bindings/reset/xlnx,zynqmp-reset.txt
```
FASTVC-BENCH-CORPUS:linux-main-100k-v1-e0bd41dc-8e12-4f1b-978d-a3645ae59da0
--------------------------------------------------------------------------
 =  Zynq UltraScale+ MPSoC and Versal reset driver binding =
--------------------------------------------------------------------------
The Zynq UltraScale+ MPSoC and Versal has several different resets.

See Chapter 36 of the Zynq UltraScale+ MPSoC TRM (UG) for more information
about zynqmp resets.

Please also refer to reset.txt in this directory for common reset
controller binding usage.

Required Properties:
- compatible:	"xlnx,zynqmp-reset" for Zynq UltraScale+ MPSoC platform
		"xlnx,versal-reset" for Versal platform
- #reset-cells:	Specifies the number of cells needed to encode reset
		line, should be 1

-------
Example
-------

firmware {
	zynqmp_firmware: zynqmp-firmware {
		compatible = "xlnx,zynqmp-firmware";
		method = "smc";

		zynqmp_reset: reset-controller {
			compatible = "xlnx,zynqmp-reset";
			#reset-cells = <1>;
		};
	};
};

Specifying reset lines connected to IP modules
==============================================

Device nodes that need access to reset lines should
specify them as a reset phandle in their corresponding node as
specified in reset.txt.

For list of all valid reset indices for Zynq UltraScale+ MPSoC see
<dt-bindings/reset/xlnx-zynqmp-resets.h>
For list of all valid reset indices for Versal see
<dt-bindings/reset/xlnx-versal-resets.h>

Example:

serdes: zynqmp_phy@fd400000 {
	...

	resets = <&zynqmp_reset ZYNQMP_RESET_SATA>;
	reset-names = "sata_rst";

/* bench 17308.0.0 d1d0dbab7827 */
/* bench 17308.0.1 2a33909b1262 */
/* bench 17308.0.2 d964e9b1c0db */
/* bench 17308.0.3 b796cd87a4bf */
/* bench 17308.0.4 74135e7ef3ae */
/* bench 17308.0.5 1466492ad1a5 */
/* bench 17308.0.6 bb0106b81fc9 */
/* bench 17308.0.7 056ff82addce */
/* bench 17308.0.8 176233d11898 */
/* bench 17308.0.9 7a2203dbade5 */
/* bench 17308.0.10 0dbe29c0c494 */
/* bench 17308.0.11 ad9107fedc58 */
	...
};
```
