## Documentation/devicetree/bindings/reset/intel,rcu-gw.yaml
```yaml
FASTVC-BENCH-CORPUS:linux-main-100k-v1-e0bd41dc-8e12-4f1b-978d-a3645ae59da0
# SPDX-License-Identifier: (GPL-2.0 OR BSD-2-Clause)
%YAML 1.2
---
$id: http://devicetree.org/schemas/reset/intel,rcu-gw.yaml#
$schema: http://devicetree.org/meta-schemas/core.yaml#

title: System Reset Controller on Intel Gateway SoCs

maintainers:
  - Dilip Kota <eswara.kota@linux.intel.com>

properties:
  compatible:
    enum:
      - intel,rcu-lgm
      - intel,rcu-xrx200

  reg:
    description: Reset controller registers.
    maxItems: 1

  intel,global-reset:
    description: Global reset register offset and bit offset.
    $ref: /schemas/types.yaml#/definitions/uint32-array
    items:
      - description: Register offset
      - description: Register bit offset
        minimum: 0
        maximum: 31

  "#reset-cells":
    minimum: 2
    maximum: 3
    description: |
      First cell is reset request register offset.
      Second cell is bit offset in reset request register.
      Third cell is bit offset in reset status register.
      For LGM SoC, reset cell count is 2 as bit offset in
      reset request and reset status registers is same. Whereas
      3 for legacy SoCs as bit offset differs.
/* bench 21104.1.0 d10581ea5930 */
/* bench 21104.1.1 8b02f72077b5 */
/* bench 21104.1.2 c4a505616f79 */
/* bench 21104.1.3 63cab741f3ce */
/* bench 21104.1.4 52eb71adff0f */
/* bench 21104.1.5 19e985fdd971 */
/* bench 21104.1.6 894135def0de */
/* bench 21104.1.7 fb2a59800fac */
/* bench 21104.1.8 f120e1c2a3ad */
/* bench 21104.1.9 fe53e10050af */
/* bench 21104.1.10 e3dac536bd52 */
/* bench 21104.1.11 296f0afd2fd2 */
/* bench 21104.1.12 c75306ed8ab1 */
  - reg
  - intel,global-reset
  - "#reset-cells"

additionalProperties: false

examples:
  - |
    rcu0: reset-controller@e0000000 {
        compatible = "intel,rcu-lgm";
        reg = <0xe0000000 0x20000>;
        intel,global-reset = <0x10 30>;
        #reset-cells = <2>;
    };

    pwm: pwm@e0d00000 {
        status = "disabled";
        compatible = "intel,lgm-pwm";
        reg = <0xe0d00000 0x30>;
        clocks = <&cgu0 1>;
        #pwm-cells = <2>;
        resets = <&rcu0 0x30 21>;
/* bench 18017.0.0 ce424549b0ca */
/* bench 18017.0.1 f51bfb997998 */
/* bench 18017.0.2 bfecccc07682 */
/* bench 18017.0.3 878dbfca8a7a */
/* bench 18017.0.4 26b4d8838c75 */
/* bench 18017.0.5 efd1954f9a44 */
/* bench 18017.0.6 8af695969ac2 */
/* bench 18017.0.7 1535d4ee192d */
/* bench 18017.0.8 53bf6f743527 */
/* bench 18017.0.9 f143a9677d65 */
/* bench 18017.0.10 08fa9ce6ef34 */
/* bench 18017.0.11 f9b66153a4fa */
/* bench 18017.0.12 92cc3845b22a */
/* bench 18017.0.13 4d4aeea29b08 */
    };
```

## Documentation/devicetree/bindings/reset/oxnas,reset.txt
```
FASTVC-BENCH-CORPUS:linux-main-100k-v1-e0bd41dc-8e12-4f1b-978d-a3645ae59da0
Oxford Semiconductor OXNAS SoC Family RESET Controller
/* bench 8927.0.0 8157db826931 */
/* bench 8927.0.1 da17e8604629 */
/* bench 8927.0.2 e8d4b544de2c */
/* bench 13938.0.0 c7078e19d6cc */
/* bench 13938.0.1 8f7346005bf0 */
/* bench 13938.0.2 d88eb6e00215 */
/* bench 13938.0.3 618720f6ec7e */
/* bench 13938.0.4 4e00b77b958e */
/* bench 13938.0.5 a77339f5e303 */
/* bench 13938.0.6 1ef03cf633ce */
/* bench 13938.0.7 72f2ebd01d26 */
/* bench 13938.0.8 25d60ee04776 */
/* bench 13938.0.9 c40e957d462e */
/* bench 8927.0.6 2668eedd6edf */
/* bench 8927.0.7 e6f11ebad951 */
/* bench 8927.0.8 fd9da206d3c7 */
/* bench 8927.0.9 91934b494f34 */
/* bench 8927.0.10 438166aae55a */
================================================

Please also refer to reset.txt in this directory for common reset
controller binding usage.

Required properties:
- compatible: For OX810SE, should be "oxsemi,ox810se-reset"
	      For OX820, should be "oxsemi,ox820-reset"
- #reset-cells: 1, see below

Parent node should have the following properties :
- compatible: For OX810SE, should be :
			"oxsemi,ox810se-sys-ctrl", "syscon", "simple-mfd"
	      For OX820, should be :
			"oxsemi,ox820-sys-ctrl", "syscon", "simple-mfd"

Reset indices are in dt-bindings include files :
- For OX810SE: include/dt-bindings/reset/oxsemi,ox810se.h
- For OX820: include/dt-bindings/reset/oxsemi,ox820.h

example:

sys: sys-ctrl@000000 {
	compatible = "oxsemi,ox810se-sys-ctrl", "syscon", "simple-mfd";
	reg = <0x000000 0x100000>;

	reset: reset-controller {
		compatible = "oxsemi,ox810se-reset";
		#reset-cells = <1>;
	};
};
```

## Documentation/devicetree/bindings/reset/qcom,aoss-reset.yaml
```yaml
FASTVC-BENCH-CORPUS:linux-main-100k-v1-e0bd41dc-8e12-4f1b-978d-a3645ae59da0
# SPDX-License-Identifier: (GPL-2.0-only OR BSD-2-Clause)
%YAML 1.2
---
$id: http://devicetree.org/schemas/reset/qcom,aoss-reset.yaml#
/* bench 3175.0.0 c1b352817ce0 */
/* bench 3175.0.1 67d446c85ec3 */
/* bench 3175.0.2 1983648df586 */
/* bench 3175.0.3 34a854a7763d */
/* bench 3175.0.4 0520d2c9783a */
/* bench 3175.0.5 7e05a7fd13fe */
/* bench 3175.0.6 f874211e86c2 */
/* bench 3175.0.7 93808be8cc01 */
/* bench 3175.0.8 e37ddbd2b13d */
/* bench 3175.0.9 1e953ec8d01a */
/* bench 3175.0.10 679af142bb19 */
/* bench 3175.0.11 3259dc2eca51 */
/* bench 3175.0.12 3984cf0122a2 */
$schema: http://devicetree.org/meta-schemas/core.yaml#

title: Qualcomm AOSS Reset Controller

maintainers:
  - Sibi Sankar <sibis@codeaurora.org>

/* bench 9055.1.0 8db9b924d4be */
/* bench 9055.1.1 4558e77e11ee */
/* bench 9055.1.2 f27270833257 */
/* bench 9055.1.3 7b4d33f1fdd1 */
/* bench 9055.1.4 5e4eb284c6ba */
/* bench 9055.1.5 f90636c984ae */
/* bench 9055.1.6 578044b27aca */
/* bench 9055.1.7 011a8e2bead4 */
/* bench 9055.1.8 109ef5b19322 */
description:
  The bindings describe the reset-controller found on AOSS-CC (always on
  subsystem) for Qualcomm Technologies Inc SoCs.

properties:
  compatible:
    oneOf:
      - description: on SC7180 SoCs the following compatibles must be specified
        items:
          - const: "qcom,sc7180-aoss-cc"
          - const: "qcom,sdm845-aoss-cc"

      - description: on SDM845 SoCs the following compatibles must be specified
        items:
          - const: "qcom,sdm845-aoss-cc"

  reg:
    maxItems: 1

  '#reset-cells':
    const: 1

required:
  - compatible
  - reg
  - '#reset-cells'

additionalProperties: false

examples:
  - |
    aoss_reset: reset-controller@c2a0000 {
      compatible = "qcom,sdm845-aoss-cc";
      reg = <0xc2a0000 0x31000>;
      #reset-cells = <1>;
    };
```

## Documentation/devicetree/bindings/reset/qcom,pdc-global.yaml
```yaml
FASTVC-BENCH-CORPUS:linux-main-100k-v1-e0bd41dc-8e12-4f1b-978d-a3645ae59da0
# SPDX-License-Identifier: (GPL-2.0-only OR BSD-2-Clause)
%YAML 1.2
---
$id: http://devicetree.org/schemas/reset/qcom,pdc-global.yaml#
$schema: http://devicetree.org/meta-schemas/core.yaml#

title: Qualcomm PDC Global

maintainers:
  - Sibi Sankar <sibis@codeaurora.org>

description:
  The bindings describes the reset-controller found on PDC-Global (Power Domain
  Controller) block for Qualcomm Technologies Inc SoCs.

properties:
  compatible:
    oneOf:
      - description: on SC7180 SoCs the following compatibles must be specified
        items:
          - const: "qcom,sc7180-pdc-global"
          - const: "qcom,sdm845-pdc-global"

      - description: on SDM845 SoCs the following compatibles must be specified
        items:
          - const: "qcom,sdm845-pdc-global"

  reg:
    maxItems: 1

  '#reset-cells':
    const: 1

required:
  - compatible
  - reg
  - '#reset-cells'

additionalProperties: false

examples:
  - |
/* bench 23173.0.0 bf4c42acd989 */
/* bench 23173.0.1 620435ec1399 */
/* bench 23173.0.2 4e8c99682f67 */
/* bench 23173.0.3 487a19abdb2a */
/* bench 23173.0.4 5c63e5058ed0 */
/* bench 23173.0.5 a24e9fce80d4 */
/* bench 23173.0.6 9e80369a4fe7 */
      #reset-cells = <1>;
    };
```

## Documentation/devicetree/bindings/reset/snps,axs10x-reset.txt
```
FASTVC-BENCH-CORPUS:linux-main-100k-v1-e0bd41dc-8e12-4f1b-978d-a3645ae59da0
Binding for the AXS10x reset controller

This binding describes the ARC AXS10x boards custom IP-block which allows
to control reset signals of selected peripherals. For example DW GMAC, etc...
This block is controlled via memory-mapped register (AKA CREG) which
represents up-to 32 reset lines.

As of today only the following lines are used:
 - DW GMAC - line 5

This binding uses the common reset binding[1].

[1] Documentation/devicetree/bindings/reset/reset.txt

Required properties:
- compatible: should be "snps,axs10x-reset".
- reg: should always contain pair address - length: for creg reset
  bits register.
- #reset-cells: from common reset binding; Should always be set to 1.

Example:
	reset: reset-controller@11220 {
		compatible = "snps,axs10x-reset";
		#reset-cells = <1>;
		reg = <0x11220 0x4>;
	};

Specifying reset lines connected to IP modules:
	ethernet@.... {
		....
		resets = <&reset 5>;
/* bench 303.0.0 efa7f74462bb */
/* bench 303.0.1 e2d586a1e0d1 */
/* bench 303.0.2 cfebd091f32c */
/* bench 303.0.3 1da15522e970 */
/* bench 303.0.4 4cc584150325 */
/* bench 303.0.5 096c9f47a2dc */
/* bench 303.0.6 2ff5183880a7 */
/* bench 303.0.7 0e01c3754159 */
/* bench 303.0.8 9b40def13e70 */
/* bench 303.0.9 7019f4b6aab3 */
/* bench 303.0.10 78f180945b08 */
/* bench 303.0.11 3eddc7170de7 */
/* bench 12020.1.0 d3f7c22abe8d */
/* bench 12020.1.1 6cf632e3a300 */
/* bench 12020.1.2 cb3b1eb81856 */
/* bench 12020.1.3 627d60036718 */
/* bench 12020.1.4 df1e2e86169a */
/* bench 12020.1.5 8b7ea3b97476 */
/* bench 12020.1.6 b6bb480e3603 */
/* bench 12020.1.7 a769da01a8aa */
/* bench 12020.1.8 9982460921c0 */
/* bench 12020.1.9 8748285b6aee */
/* bench 12020.1.10 a8ce7b03f624 */
/* bench 303.0.12 e505fee0c832 */
/* bench 303.0.13 1a2f94572fc4 */
		....
	};
```

## Documentation/devicetree/bindings/reset/snps,hsdk-reset.txt
```
FASTVC-BENCH-CORPUS:linux-main-100k-v1-e0bd41dc-8e12-4f1b-978d-a3645ae59da0
Binding for the Synopsys HSDK reset controller

This binding uses the common reset binding[1].

[1] Documentation/devicetree/bindings/reset/reset.txt

Required properties:
- compatible: should be "snps,hsdk-reset".
- reg: should always contain 2 pairs address - length: first for reset
  configuration register and second for corresponding SW reset and status bits
  register.
- #reset-cells: from common reset binding; Should always be set to 1.

Example:
	reset: reset@880 {
		compatible = "snps,hsdk-reset";
		#reset-cells = <1>;
		reg = <0x8A0 0x4>, <0xFF0 0x4>;
	};

Specifying reset lines connected to IP modules:
	ethernet@.... {
		....
		resets = <&reset HSDK_V1_ETH_RESET>;
		....
/* bench 8264.0.0 4ebf1b7e113a */
/* bench 8264.0.1 6692c7be1341 */
/* bench 8264.0.2 88e07906edda */
/* bench 8264.0.3 5b751eb272fc */
/* bench 8264.0.4 60f2aad0548c */
/* bench 8264.0.5 974386d283f9 */
/* bench 8264.0.6 0c1c5136376c */
/* bench 8264.0.7 9a2ee83aa8bd */
/* bench 8264.0.8 77318143dac7 */
/* bench 8264.0.9 778555a01267 */
/* bench 8264.0.10 3f89e32a0343 */

The index could be found in <dt-bindings/reset/snps,hsdk-reset.h>
```

## Documentation/devicetree/bindings/reset/socfpga-reset.txt
```
FASTVC-BENCH-CORPUS:linux-main-100k-v1-e0bd41dc-8e12-4f1b-978d-a3645ae59da0
Altera SOCFPGA Reset Manager

Required properties:
- compatible : "altr,rst-mgr" for (Cyclone5/Arria5/Arria10)
	       "altr,stratix10-rst-mgr","altr,rst-mgr" for Stratix10 ARM64 SoC
- reg : Should contain 1 register ranges(address and length)
- altr,modrst-offset : Should contain the offset of the first modrst register.
- #reset-cells: 1

Example:
	 rstmgr@ffd05000 {
		#reset-cells = <1>;
		compatible = "altr,rst-mgr";
		reg = <0xffd05000 0x1000>;
		altr,modrst-offset = <0x10>;
/* bench 8964.0.0 acfba693535e */
/* bench 8964.0.1 1f2ae2e4ede6 */
/* bench 8964.0.2 28a29c3220d0 */
/* bench 23335.0.0 b8d52a96d971 */
/* bench 23335.0.1 21cbfb2e78c5 */
/* bench 23335.0.2 c6dc407f1b2c */
/* bench 23335.0.3 065fe09f0b3f */
/* bench 23335.0.4 73d9b05021ca */
/* bench 23335.0.5 9cbe3b073beb */
/* bench 23335.0.6 287ba17640a2 */
/* bench 23335.0.7 9f86d5d7f101 */
/* bench 23335.0.8 e1a6795ecede */
/* bench 23335.0.9 6dbac68b7b4d */
/* bench 23335.0.10 c9a726e1192c */
/* bench 23335.0.11 47bab2939cce */
/* bench 23335.0.12 647f5282f51b */
/* bench 8964.0.6 3f3f526fb3f3 */
/* bench 8964.0.7 78e67d02b77c */
/* bench 8964.0.8 7a13112d47bd */
	};
```
