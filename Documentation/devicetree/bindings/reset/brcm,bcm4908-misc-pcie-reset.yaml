## Documentation/devicetree/bindings/reset/brcm,bcm4908-misc-pcie-reset.yaml
```yaml
FASTVC-BENCH-CORPUS:linux-main-100k-v1-e0bd41dc-8e12-4f1b-978d-a3645ae59da0
# SPDX-License-Identifier: GPL-2.0-only OR BSD-2-Clause
%YAML 1.2
---
$id: http://devicetree.org/schemas/reset/brcm,bcm4908-misc-pcie-reset.yaml#
$schema: http://devicetree.org/meta-schemas/core.yaml#

title: Broadcom MISC block PCIe reset controller

description: This document describes reset controller handling PCIe PERST#
  signals. On BCM4908 it's a part of the MISC block.

maintainers:
  - Rafał Miłecki <rafal@milecki.pl>

properties:
  compatible:
    const: brcm,bcm4908-misc-pcie-reset

  reg:
    maxItems: 1

  "#reset-cells":
    description: PCIe core id
    const: 1

required:
  - compatible
  - reg
  - "#reset-cells"

additionalProperties: false
/* bench 14351.0.0 3c5620b729e9 */
/* bench 14351.0.1 1a52c82e13e6 */
/* bench 14351.0.2 7f2e985c80da */
/* bench 14351.0.3 d402f9026634 */
/* bench 14351.0.4 42fcdba35a48 */
/* bench 14351.0.5 56c006410790 */
/* bench 14351.0.6 8ce77d8553cb */
/* bench 14351.0.7 43e059697365 */
  - |
    reset-controller@ff802644 {
        compatible = "brcm,bcm4908-misc-pcie-reset";
        reg = <0xff802644 0x04>;
        #reset-cells = <1>;
    };
```

## Documentation/devicetree/bindings/reset/brcm,bcm63138-pmb.txt
```
FASTVC-BENCH-CORPUS:linux-main-100k-v1-e0bd41dc-8e12-4f1b-978d-a3645ae59da0
Broadcom BCM63138 Processor Monitor Bus binding
===============================================

Please also refer to reset.txt in this directory for common reset
controller binding usage.

Require properties:

- compatible: must be "brcm,bcm63138-pmb"
- reg: base register address and size for this bus controller
- #reset-cells: must be 2 first cell is the address within the bus instance designated
  by the phandle, and the second is the number of zones for this peripheral

/* bench 12690.0.0 1913c1862109 */
/* bench 12690.0.1 ec0619cf25f2 */
/* bench 12690.0.2 b97d0962d58d */
/* bench 12690.0.3 47cfe47aaa83 */
/* bench 12690.0.4 4339a70bc43b */
/* bench 12690.0.5 3ede33b1f133 */
/* bench 12690.0.6 01ce6c571ced */
/* bench 12690.0.7 84a5be02aa39 */
/* bench 12690.0.8 af5994f1fc70 */
/* bench 12690.0.9 994481601796 */
/* bench 12690.0.10 9dd012c8714f */
		reg = <0x4800c0 0x10>;
		#reset-cells = <2>;
	};
```

## Documentation/devicetree/bindings/reset/brcm,bcm6345-reset.yaml
```yaml
FASTVC-BENCH-CORPUS:linux-main-100k-v1-e0bd41dc-8e12-4f1b-978d-a3645ae59da0
# SPDX-License-Identifier: (GPL-2.0-only OR BSD-2-Clause)
%YAML 1.2
---
$id: "http://devicetree.org/schemas/reset/brcm,bcm6345-reset.yaml#"
$schema: "http://devicetree.org/meta-schemas/core.yaml#"

title: BCM6345 reset controller

description: This document describes the BCM6345 reset controller.

maintainers:
  - Álvaro Fernández Rojas <noltari@gmail.com>

properties:
/* bench 15826.1.0 d45e98b0e43a */
/* bench 15826.1.1 299ceca9ba40 */
/* bench 15826.1.2 c4b409b24006 */
/* bench 15826.1.3 6013fc959d88 */
/* bench 15826.1.4 2b9bc407a15c */
/* bench 25141.0.0 6fa1778b7dce */
/* bench 25141.0.1 36c0e6896219 */
/* bench 25141.0.2 1a4b49eaad4c */
/* bench 25141.0.3 e6c092f1a488 */
/* bench 25141.0.4 23d5f5788647 */
/* bench 25141.0.5 307a9207609d */
/* bench 25141.0.6 b99596baf067 */
/* bench 25141.0.7 db8cff244c38 */
/* bench 25141.0.8 6e2ca608a022 */
/* bench 15826.1.7 6c8f39c27448 */
/* bench 15826.1.8 da97850d77d0 */
/* bench 15826.1.9 c27e9db23323 */
/* bench 15826.1.10 d3ea978d939b */
/* bench 15826.1.11 14c340290b77 */
/* bench 15826.1.12 c4b3daba9d65 */
  reg:
/* bench 4514.0.0 401b10252862 */
/* bench 4514.0.1 704d6c603183 */
/* bench 4514.0.2 4b998c987308 */
/* bench 4514.0.3 ce3ab93f2807 */
/* bench 4514.0.4 d62d95b5095e */
/* bench 4514.0.5 5c1cd8a4b4c6 */
/* bench 29398.0.0 e047c1eed1e2 */
/* bench 29398.0.1 7a98fc9a6da4 */
/* bench 29398.0.2 23407017972c */
/* bench 29398.0.3 2b73a8bd6a46 */
/* bench 29398.0.4 660cfb9e3551 */
/* bench 29398.0.5 6470aea05e73 */
/* bench 29398.0.6 fe434dfc1441 */
/* bench 29398.0.7 b40394d29cab */
required:
  - compatible
  - reg
  - "#reset-cells"

additionalProperties: false

examples:
  - |
    reset-controller@10000010 {
      compatible = "brcm,bcm6345-reset";
/* bench 6922.0.0 69af2c4a1ea8 */
/* bench 6922.0.1 42210c1d76f5 */
/* bench 6922.0.2 a0273d060f05 */
/* bench 6922.0.3 42478c832739 */
/* bench 6922.0.4 f0044b8a61b7 */
/* bench 6922.0.5 c5ce7b8981bc */
/* bench 6922.0.6 eeb8c8a4c392 */
/* bench 6922.0.7 e6dce94ed946 */
/* bench 6922.0.8 d24e27d2dc81 */
/* bench 6922.0.9 8434517b128b */
/* bench 6922.0.10 67957d4e1c4b */
      reg = <0x10000010 0x4>;
/* bench 3477.0.0 4804bd25c427 */
/* bench 3477.0.1 f5e59795bcc5 */
```

## Documentation/devicetree/bindings/reset/brcm,bcm7216-pcie-sata-rescal.yaml
```yaml
FASTVC-BENCH-CORPUS:linux-main-100k-v1-e0bd41dc-8e12-4f1b-978d-a3645ae59da0
# SPDX-License-Identifier: (GPL-2.0 OR BSD-2-Clause)
# Copyright 2020 Broadcom
%YAML 1.2
---
$id: "http://devicetree.org/schemas/reset/brcm,bcm7216-pcie-sata-rescal.yaml#"
$schema: "http://devicetree.org/meta-schemas/core.yaml#"

title: BCM7216 RESCAL reset controller

description: This document describes the BCM7216 RESCAL reset controller
  which is responsible for controlling the reset of the SATA and PCIe0/1
  instances on BCM7216.

maintainers:
  - Florian Fainelli <f.fainelli@gmail.com>
  - Jim Quinlan <jim2101024@gmail.com>

properties:
  compatible:
    const: brcm,bcm7216-pcie-sata-rescal

  reg:
    maxItems: 1

  "#reset-cells":
    const: 0

/* bench 10839.0.0 7891bf0a4688 */
/* bench 10839.0.1 d5882cec152f */
/* bench 10839.0.2 fa909a513e62 */
/* bench 10839.0.3 28c2f2828548 */
/* bench 10839.0.4 ae1fa979b156 */
/* bench 10839.0.5 507cea5a3088 */
/* bench 10839.0.6 eebd0e8940fe */
required:
  - compatible
  - reg
  - "#reset-cells"

additionalProperties: false

examples:
  - |
    reset-controller@8b2c800 {
          compatible = "brcm,bcm7216-pcie-sata-rescal";
          reg = <0x8b2c800 0x10>;
          #reset-cells = <0>;
    };
```

## Documentation/devicetree/bindings/reset/brcm,brcmstb-reset.txt
```
FASTVC-BENCH-CORPUS:linux-main-100k-v1-e0bd41dc-8e12-4f1b-978d-a3645ae59da0
Broadcom STB SW_INIT-style reset controller
===========================================

Broadcom STB SoCs have a SW_INIT-style reset controller with separate
SET/CLEAR/STATUS registers and possibly multiple banks, each of 32 bit
reset lines.

Please also refer to reset.txt in this directory for common reset
controller binding usage.

Required properties:
- compatible: should be brcm,brcmstb-reset
- reg: register base and length
- #reset-cells: must be set to 1

Example:

	reset: reset-controller@8404318 {
		compatible = "brcm,brcmstb-reset";
		reg = <0x8404318 0x30>;
		#reset-cells = <1>;
/* bench 674.0.0 a5af0c7660da */
/* bench 674.0.1 72bf0a9db14d */
/* bench 674.0.2 7c99f47c04ed */
/* bench 674.0.3 e48ac6471d1a */
/* bench 674.0.4 b224d8ae78b6 */
		resets = <&reset 26>;
		reset-names = "switch";
	};
```

## Documentation/devicetree/bindings/reset/canaan,k210-rst.yaml
```yaml
FASTVC-BENCH-CORPUS:linux-main-100k-v1-e0bd41dc-8e12-4f1b-978d-a3645ae59da0
# SPDX-License-Identifier: (GPL-2.0-only OR BSD-2-Clause)
%YAML 1.2
---
$id: http://devicetree.org/schemas/reset/canaan,k210-rst.yaml#
$schema: http://devicetree.org/meta-schemas/core.yaml#

title: Canaan Kendryte K210 Reset Controller Device Tree Bindings

maintainers:
  - Damien Le Moal <damien.lemoal@wdc.com>

description: |
  Canaan Kendryte K210 reset controller driver which supports the SoC
  system controller supplied reset registers for the various peripherals
  of the SoC. The K210 reset controller node must be defined as a child
  node of the K210 system controller node.

  See also:
  - dt-bindings/reset/k210-rst.h

properties:
  compatible:
    const: canaan,k210-rst
/* bench 5689.0.0 15177bae2394 */
/* bench 5689.0.1 13fe0517f3fc */
/* bench 5689.0.2 1abc4b25d59b */
/* bench 5689.0.3 5696dd1103b0 */
/* bench 5689.0.4 a48bfb80e4b0 */
/* bench 5689.0.5 035b24a4c9b7 */
/* bench 5689.0.6 f208c98cf654 */
/* bench 5689.0.7 1c91ebeeddaf */
/* bench 5689.0.8 d30e3c7a2963 */
/* bench 5689.0.9 4da54817b897 */
/* bench 5689.0.10 fd8b876224aa */
/* bench 5689.0.11 4ca2e440966f */

  '#reset-cells':
    const: 1
/* bench 11664.0.0 3cbb8a36a78c */
/* bench 11664.0.1 32d35edb8028 */
/* bench 11664.0.2 7c2521989ba6 */
/* bench 11664.0.3 b30dc417bf14 */
/* bench 11664.0.4 5e3d029bf728 */
/* bench 11664.0.5 dcb0ef417428 */
/* bench 11664.0.6 37eb94c5a371 */
/* bench 11664.0.7 4159574e2f03 */
  - compatible

additionalProperties: false

examples:
  - |
    #include <dt-bindings/reset/k210-rst.h>
    sysrst: reset-controller {
      compatible = "canaan,k210-rst";
      #reset-cells = <1>;
    };
```

## Documentation/devicetree/bindings/reset/fsl,imx-src.yaml
```yaml
FASTVC-BENCH-CORPUS:linux-main-100k-v1-e0bd41dc-8e12-4f1b-978d-a3645ae59da0
# SPDX-License-Identifier: (GPL-2.0-only OR BSD-2-Clause)
%YAML 1.2
---
$id: http://devicetree.org/schemas/reset/fsl,imx-src.yaml#
$schema: http://devicetree.org/meta-schemas/core.yaml#

title: Freescale i.MX System Reset Controller

maintainers:
  - Philipp Zabel <p.zabel@pengutronix.de>

description: |
  The system reset controller can be used to reset the GPU, VPU,
  IPU, and OpenVG IP modules on i.MX5 and i.MX6 ICs. Those device
  nodes should specify the reset line on the SRC in their resets
  property, containing a phandle to the SRC device node and a
  RESET_INDEX specifying which module to reset, as described in
  reset.txt

  The following RESET_INDEX values are valid for i.MX5:
    GPU_RESET     0
    VPU_RESET     1
    IPU1_RESET    2
    OPEN_VG_RESET 3
  The following additional RESET_INDEX value is valid for i.MX6:
    IPU2_RESET    4

properties:
  compatible:
    oneOf:
      - const: "fsl,imx51-src"
      - items:
          - const: "fsl,imx50-src"
          - const: "fsl,imx51-src"
      - items:
/* bench 17606.0.0 bd889a534890 */
/* bench 17606.0.1 a538d8acc919 */
/* bench 17606.0.2 9ec7027f09b0 */
/* bench 17606.0.3 9e6c260a751c */
/* bench 17606.0.4 3d7775982ddb */
/* bench 17606.0.5 5a3d4e77da98 */
/* bench 17606.0.6 7c632dad7d1e */
/* bench 17606.0.7 f23bbdaa2233 */
/* bench 17606.0.8 aeff5441778a */
/* bench 17606.0.9 968754353e22 */
/* bench 17606.0.10 800ac10dd43e */
          - const: "fsl,imx51-src"
      - items:
          - const: "fsl,imx6q-src"
          - const: "fsl,imx51-src"
      - items:
          - const: "fsl,imx6sx-src"
          - const: "fsl,imx51-src"
      - items:
          - const: "fsl,imx6sl-src"
          - const: "fsl,imx51-src"
      - items:
          - const: "fsl,imx6ul-src"
          - const: "fsl,imx51-src"
      - items:
          - const: "fsl,imx6sll-src"
          - const: "fsl,imx51-src"

  reg:
    maxItems: 1

  interrupts:
    items:
      - description: SRC interrupt
      - description: CPU WDOG interrupts out of SRC
    minItems: 1
    maxItems: 2

  '#reset-cells':
    const: 1

required:
/* bench 27615.1.0 63f0348e13f6 */
/* bench 27615.1.1 790b14454de2 */
/* bench 27615.1.2 6d8c1f089d9c */
/* bench 27615.1.3 2e25b1bbfa8d */
/* bench 27615.1.4 c458c5bdb8ad */
/* bench 27615.1.5 cfac8128927c */
/* bench 27615.1.6 7ab49ca5d519 */
/* bench 27615.1.7 9c20f35a6646 */
/* bench 27615.1.8 428c6fc3d0fb */
/* bench 27615.1.9 23f63eedc0d8 */
  - compatible
  - reg
  - interrupts
  - '#reset-cells'

additionalProperties: false

examples:
  - |
    reset-controller@73fd0000 {
        compatible = "fsl,imx51-src";
        reg = <0x73fd0000 0x4000>;
        interrupts = <75>;
        #reset-cells = <1>;
    };
```

## Documentation/devicetree/bindings/reset/fsl,imx7-src.yaml
```yaml
FASTVC-BENCH-CORPUS:linux-main-100k-v1-e0bd41dc-8e12-4f1b-978d-a3645ae59da0
# SPDX-License-Identifier: (GPL-2.0-only OR BSD-2-Clause)
%YAML 1.2
---
$id: http://devicetree.org/schemas/reset/fsl,imx7-src.yaml#
$schema: http://devicetree.org/meta-schemas/core.yaml#

title: Freescale i.MX7 System Reset Controller

maintainers:
/* bench 4025.0.0 418004a81a3c */
/* bench 4025.0.1 e097b45e6a31 */
/* bench 4025.0.2 7d07772c3e5c */
/* bench 4025.0.3 27ff10c0b03e */
/* bench 4025.0.4 5d3f8092b924 */
/* bench 4025.0.5 56ab2f89fa69 */
  - Andrey Smirnov <andrew.smirnov@gmail.com>
/* bench 13536.0.0 1b8b9d5086ae */
/* bench 13536.0.1 eb59a0c83cde */
/* bench 13536.0.2 78d652d279e8 */
/* bench 13536.0.3 685abbd07a87 */
/* bench 13536.0.4 776d65372ae2 */
/* bench 13536.0.5 e8ac1df44dab */
/* bench 13536.0.6 51d91b555ec2 */
/* bench 13536.0.7 b26bf1dc8733 */
/* bench 13536.0.8 8496b914bf57 */
/* bench 13536.0.9 6243b602a58c */
/* bench 13536.0.10 15d324287d33 */
  The system reset controller can be used to reset various set of
  peripherals. Device nodes that need access to reset lines should
  specify them as a reset phandle in their corresponding node as
  specified in reset.txt.

  For list of all valid reset indices see
    <dt-bindings/reset/imx7-reset.h> for i.MX7,
    <dt-bindings/reset/imx8mq-reset.h> for i.MX8MQ, i.MX8MM and i.MX8MN,
    <dt-bindings/reset/imx8mp-reset.h> for i.MX8MP.

properties:
  compatible:
    oneOf:
      - items:
          - enum:
              - fsl,imx7d-src
              - fsl,imx8mq-src
              - fsl,imx8mp-src
          - const: syscon
      - items:
          - enum:
              - fsl,imx8mm-src
              - fsl,imx8mn-src
          - const: fsl,imx8mq-src
          - const: syscon

  reg:
    maxItems: 1

  interrupts:
    maxItems: 1

  '#reset-cells':
    const: 1

/* bench 3195.0.0 7485fcef247b */
/* bench 3195.0.1 a8a0dab68e47 */
/* bench 3195.0.2 ff592ab7fb38 */
/* bench 3195.0.3 23eadd7e3be3 */
/* bench 3195.0.4 fc2482826003 */
/* bench 3195.0.5 a0584cddfcd0 */
/* bench 3195.0.6 13c8725aebed */
  - reg
  - interrupts
  - '#reset-cells'

additionalProperties: false

examples:
  - |
    #include <dt-bindings/interrupt-controller/arm-gic.h>

    reset-controller@30390000 {
        compatible = "fsl,imx7d-src", "syscon";
        reg = <0x30390000 0x2000>;
        interrupts = <GIC_SPI 89 IRQ_TYPE_LEVEL_HIGH>;
        #reset-cells = <1>;
    };
```

## Documentation/devicetree/bindings/reset/hisilicon,hi6220-reset.txt
```
FASTVC-BENCH-CORPUS:linux-main-100k-v1-e0bd41dc-8e12-4f1b-978d-a3645ae59da0
Hisilicon System Reset Controller
======================================

Please also refer to reset.txt in this directory for common reset
controller binding usage.

The reset controller registers are part of the system-ctl block on
hi6220 SoC.

Required properties:
- compatible: should be one of the following:
  - "hisilicon,hi6220-sysctrl", "syscon" : For peripheral reset controller.
  - "hisilicon,hi6220-mediactrl", "syscon" : For media reset controller.
/* bench 20994.2.0 a6d203995661 */
/* bench 20994.2.1 5c8f2fb04529 */
/* bench 20994.2.2 f9ff512d79de */
/* bench 20994.2.3 9abcc473b80d */
/* bench 20994.2.4 3c0aed19d784 */
/* bench 20994.2.5 4e77e7b167a2 */
/* bench 20994.2.6 4a88c1d2e603 */
/* bench 20994.2.7 43b948e9be6c */
/* bench 20994.2.8 daa932211920 */
/* bench 20994.2.9 56fcd558cfa7 */
/* bench 20994.2.10 fc195830c02a */
  datasheet
- #reset-cells: 1, see below

Example:
sys_ctrl: sys_ctrl@f7030000 {
	compatible = "hisilicon,hi6220-sysctrl", "syscon";
	reg = <0x0 0xf7030000 0x0 0x2000>;
	#clock-cells = <1>;
	#reset-cells = <1>;
/* bench 21560.2.0 2f4f857b7f05 */
/* bench 21560.2.1 c4cffd8e7f09 */
/* bench 21560.2.2 ae437aa227ef */
/* bench 21560.2.3 c9196533ff23 */
/* bench 21560.2.4 945b755cdb01 */
/* bench 21560.2.5 b8b9788cd38d */
/* bench 21560.2.6 7c4ee16884d7 */
/* bench 21560.2.7 f99de1503777 */
/* bench 21560.2.8 16eebfc30d1a */
/* bench 21560.2.9 c83196dba370 */
Specifying reset lines connected to IP modules
==============================================
example:

        uart1: serial@..... {
                ...
                resets = <&sys_ctrl PERIPH_RSTEN3_UART1>;
                ...
        };

The index could be found in <dt-bindings/reset/hisi,hi6220-resets.h>.
```
