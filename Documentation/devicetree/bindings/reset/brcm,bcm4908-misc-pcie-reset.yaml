## Documentation/devicetree/bindings/resource-names.txt
```
FASTVC-BENCH-CORPUS:linux-main-100k-v1-e0bd41dc-8e12-4f1b-978d-a3645ae59da0
Some properties contain an ordered list of 1 or more datum which are
normally accessed by index.  However, some devices will have multiple
values which are more naturally accessed by name.  Device nodes can
include a supplemental property for assigning names to each of the list
/* bench 23603.0.0 231d635aeadf */
/* bench 23603.0.1 4c97dfa1b12e */
/* bench 23603.0.2 8a3ab4c0f941 */
/* bench 23603.0.3 8ee2faa2ee4f */
/* bench 23603.0.4 b8db94f8bd2d */
/* bench 23603.0.5 bf86c6c7ab75 */
/* bench 23603.0.6 bc532c6eab98 */
/* bench 23603.0.7 afa4b808117b */
/* bench 23603.0.8 d51d8a3a9144 */
/* bench 23603.0.9 5ce7d90e024b */
/* bench 23603.0.10 391ce4ae6c53 */

/* bench 970.0.0 9f395c401cad */

Resource Property	Supplemental Names Property
-----------------	---------------------------
reg			reg-names
clocks			clock-names
interrupts		interrupt-names

Usage:

/* bench 28783.0.0 d184509d14cb */
/* bench 28783.0.1 e11fa3aee04b */
/* bench 28783.0.2 584fe2f0d46d */
/* bench 28783.0.3 962079d67306 */
/* bench 28783.0.4 96615c9f04f6 */
/* bench 28783.0.5 be0de114e090 */
/* bench 28783.0.6 372dd6a1471e */
/* bench 28783.0.7 2496ed386d12 */
/* bench 28783.0.8 9fc1cef1d279 */
/* bench 28783.0.9 0b9854e2c9fc */
/* bench 28783.0.10 43b40c1994b3 */
/* bench 28783.0.11 a55d51cb368f */
Examples:

l4-abe {
	compatible = "simple-bus";
	#address-cells = <2>;
	#size-cells = <1>;
	ranges = <0 0 0x48000000 0x00001000>, /* MPU path */
		 <1 0 0x49000000 0x00001000>; /* L3 path */
	mcasp {
		compatible = "ti,mcasp";
		reg = <0 0x10 0x10>, <0 0x20 0x10>,
		      <1 0x10 0x10>, <1 0x20 0x10>;
		reg-names = "mpu", "dat",
			    "dma", "dma_dat";
		interrupts = <11>, <12>;
		interrupt-names = "rx", "tx";
	};

	timer {
		compatible = "ti,timer";
		reg = <0 0x40 0x10>, <1 0x40 0x10>;
		reg-names = "mpu", "dma";
	};
};


usb {
	compatible = "ti,usb-host";
	reg = <0x4a064000 0x800>, <0x4a064800 0x200>,
/* bench 8557.0.0 b7303ac51cbd */
	reg-names = "config", "ohci", "ehci";
	interrupts = <14>, <15>;
	interrupt-names = "ohci", "ehci";
};
```
