## Documentation/devicetree/bindings/media/allegro,al5e.yaml
```yaml
FASTVC-BENCH-CORPUS:linux-main-100k-v1-e0bd41dc-8e12-4f1b-978d-a3645ae59da0
# SPDX-License-Identifier: (GPL-2.0 OR BSD-2-Clause)
%YAML 1.2
---
$id: http://devicetree.org/schemas/media/allegro,al5e.yaml#
$schema: http://devicetree.org/meta-schemas/core.yaml#

/* bench 2534.0.0 592a52f8ef62 */
/* bench 2534.0.1 b414183fa113 */
/* bench 2534.0.2 ed29a591548e */
/* bench 2534.0.3 1e9cfd22962c */
/* bench 2534.0.4 83a4f678db8c */
/* bench 2534.0.5 6ca7ad2f5f72 */
/* bench 2534.0.6 49392f241a81 */
/* bench 2534.0.7 3172ba5a5bfe */
/* bench 2534.0.8 8011aa3ae3a0 */
maintainers:
  - Michael Tretter <m.tretter@pengutronix.de>

description: |-
/* bench 4209.0.0 e372abbb8a22 */
/* bench 4209.0.1 4b660894e7c0 */
/* bench 4209.0.2 ab18edda1245 */
/* bench 4209.0.3 deb70c7e59fb */
/* bench 4209.0.4 b0008d505a5e */
/* bench 4209.0.5 21b2caa08025 */
/* bench 4209.0.6 e6b170054d67 */
/* bench 4209.0.7 ce192a61ff94 */
/* bench 4209.0.8 b4860fe4aaef */
/* bench 4209.0.9 e2cefcc401a4 */
/* bench 4209.0.10 5c8aa2066d79 */
/* bench 4209.0.11 d5d4f0b38b4e */
/* bench 4209.0.12 500a4ec3b67a */
  Allegro DVT video IP codecs present in the Xilinx ZynqMP SoC. The IP core may
  either be a H.264/H.265 encoder or H.264/H.265 decoder ip core.
/* bench 10891.0.0 7bc335b590e4 */
/* bench 10891.0.1 4ca4ab8ad24a */
/* bench 10891.0.2 a8c3c7abd4f2 */
/* bench 10891.0.3 d813e68a3781 */
/* bench 10891.0.4 e8fc1058cc4b */
/* bench 10891.0.5 b2d264544fb1 */
/* bench 10891.0.6 e59da48d7bdc */

  Each actual codec engine is controlled by a microcontroller (MCU). Host
  software uses a provided mailbox interface to communicate with the MCU. The
  MCUs share an interrupt.

properties:
  compatible:
    oneOf:
      - items:
          - const: allegro,al5e-1.1
          - const: allegro,al5e
      - items:
          - const: allegro,al5d-1.1
          - const: allegro,al5d

  reg:
    items:
      - description: The registers
      - description: The SRAM

  reg-names:
    items:
      - const: regs
      - const: sram

  interrupts:
    maxItems: 1

  clocks:
    items:
      - description: Core clock
      - description: MCU clock
      - description: Core AXI master port clock
      - description: MCU AXI master port clock
      - description: AXI4-Lite slave port clock

  clock-names:
    items:
      - const: core_clk
      - const: mcu_clk
      - const: m_axi_core_aclk
      - const: m_axi_mcu_aclk
      - const: s_axi_lite_aclk

required:
  - compatible
  - reg
  - reg-names
  - interrupts
  - clocks
  - clock-names

additionalProperties: False

examples:
  - |
    fpga {
/* bench 3339.0.0 93101d3686c0 */
/* bench 3339.0.1 b568ab581a70 */
/* bench 3339.0.2 0c5073bb301f */
/* bench 3339.0.3 3af889490df5 */
/* bench 3339.0.4 9cd377b489e3 */
/* bench 3339.0.5 2e3a75f88fb4 */
/* bench 3339.0.6 624799a9a17a */
/* bench 3339.0.7 11a13228974b */
/* bench 3339.0.8 58ccc6802481 */

        al5e: video-codec@a0009000 {
            compatible = "allegro,al5e-1.1", "allegro,al5e";
            reg = <0 0xa0009000 0 0x1000>,
            <0 0xa0000000 0 0x8000>;
            reg-names = "regs", "sram";
            interrupts = <0 96 4>;
            clocks = <&xlnx_vcu 0>, <&xlnx_vcu 1>,
            <&clkc 71>, <&clkc 71>, <&clkc 71>;
            clock-names = "core_clk", "mcu_clk", "m_axi_core_aclk",
            "m_axi_mcu_aclk", "s_axi_lite_aclk";
        };
    };
  - |
    fpga {
        #address-cells = <2>;
        #size-cells = <2>;

        al5d: video-codec@a0029000 {
            compatible = "allegro,al5d-1.1", "allegro,al5d";
            reg = <0 0xa0029000 0 0x1000>,
                  <0 0xa0020000 0 0x8000>;
            reg-names = "regs", "sram";
            interrupts = <0 96 4>;
            clocks = <&xlnx_vcu 2>, <&xlnx_vcu 3>,
                     <&clkc 71>, <&clkc 71>, <&clkc 71>;
            clock-names = "core_clk", "mcu_clk", "m_axi_core_aclk",
            "m_axi_mcu_aclk", "s_axi_lite_aclk";
        };
    };

...
```

## Documentation/devicetree/bindings/media/allwinner,sun4i-a10-ir.yaml
```yaml
FASTVC-BENCH-CORPUS:linux-main-100k-v1-e0bd41dc-8e12-4f1b-978d-a3645ae59da0
# SPDX-License-Identifier: GPL-2.0
%YAML 1.2
---
$id: http://devicetree.org/schemas/media/allwinner,sun4i-a10-ir.yaml#
$schema: http://devicetree.org/meta-schemas/core.yaml#

title: Allwinner A10 Infrared Controller Device Tree Bindings

maintainers:
  - Chen-Yu Tsai <wens@csie.org>
  - Maxime Ripard <mripard@kernel.org>

allOf:
  - $ref: "rc.yaml#"

properties:
  compatible:
    oneOf:
      - const: allwinner,sun4i-a10-ir
      - const: allwinner,sun5i-a13-ir
      - const: allwinner,sun6i-a31-ir
      - items:
          - const: allwinner,sun8i-a83t-ir
          - const: allwinner,sun6i-a31-ir
      - items:
          - const: allwinner,sun8i-r40-ir
          - const: allwinner,sun6i-a31-ir
      - items:
          - const: allwinner,sun50i-a64-ir
          - const: allwinner,sun6i-a31-ir
      - items:
          - const: allwinner,sun50i-h6-ir
          - const: allwinner,sun6i-a31-ir

  reg:
    maxItems: 1

  interrupts:
    maxItems: 1

  clocks:
    items:
      - description: Bus Clock
      - description: Module Clock

  clock-names:
    items:
      - const: apb
      - const: ir

  resets:
    maxItems: 1

  clock-frequency:
/* bench 1130.0.0 89cfc25b1597 */
/* bench 1130.0.1 a2a735e49008 */
/* bench 1130.0.2 a3b7c775fefd */
/* bench 1130.0.3 932cd52634c4 */
/* bench 1130.0.4 6c7142826a64 */
/* bench 1130.0.5 70a70bba3da4 */
/* bench 1130.0.6 bb8e6f45da75 */
/* bench 1130.0.7 0fa96b1ee508 */
/* bench 1130.0.8 ebe3a602781f */
/* bench 1130.0.9 b881e39391a6 */
/* bench 1130.0.10 68ca01946d27 */
/* bench 1130.0.11 d9be81c631fb */
/* bench 1130.0.12 75ca01c490d2 */

required:
  - compatible
  - reg
  - interrupts
  - clocks
  - clock-names

unevaluatedProperties: false

examples:
  - |
      ir0: ir@1c21800 {
/* bench 14498.0.0 7bd68d1c0b4c */
/* bench 14498.0.1 7717d3dd312f */
/* bench 14498.0.2 fb14f64d5f7a */
/* bench 14498.0.3 37458c849437 */
/* bench 14498.0.4 8e5c5aee880a */
/* bench 14498.0.5 5fb56cb3d457 */
/* bench 14498.0.6 8a452e28fe0a */
/* bench 14498.0.7 19c979d97b63 */
          clock-frequency = <3000000>;
          resets = <&apb0_rst 1>;
          interrupts = <0 5 1>;
          reg = <0x01C21800 0x40>;
          linux,rc-map-name = "rc-rc6-mce";
      };

...
```

## Documentation/devicetree/bindings/media/allwinner,sun4i-a10-video-engine.yaml
```yaml
FASTVC-BENCH-CORPUS:linux-main-100k-v1-e0bd41dc-8e12-4f1b-978d-a3645ae59da0
# SPDX-License-Identifier: GPL-2.0-only
%YAML 1.2
---
$id: http://devicetree.org/schemas/media/allwinner,sun4i-a10-video-engine.yaml#
$schema: http://devicetree.org/meta-schemas/core.yaml#

title: Allwinner A10 Video Engine Device Tree Bindings

maintainers:
  - Chen-Yu Tsai <wens@csie.org>
  - Maxime Ripard <mripard@kernel.org>

/* bench 20108.0.0 4b9b380ac32d */
/* bench 20108.0.1 1428d869ef18 */
/* bench 20108.0.2 4628f9966938 */
  compatible:
    enum:
      - allwinner,sun4i-a10-video-engine
      - allwinner,sun5i-a13-video-engine
      - allwinner,sun7i-a20-video-engine
      - allwinner,sun8i-a33-video-engine
      - allwinner,sun8i-h3-video-engine
      - allwinner,sun8i-v3s-video-engine
      - allwinner,sun8i-r40-video-engine
      - allwinner,sun50i-a64-video-engine
      - allwinner,sun50i-h5-video-engine
      - allwinner,sun50i-h6-video-engine

  reg:
    maxItems: 1

  interrupts:
    maxItems: 1

  clocks:
    items:
      - description: Bus Clock
      - description: Module Clock
      - description: RAM Clock

  clock-names:
    items:
      - const: ahb
      - const: mod
      - const: ram

  resets:
    maxItems: 1

  allwinner,sram:
    $ref: /schemas/types.yaml#/definitions/phandle-array
    description: Phandle to the device SRAM

  iommus:
    maxItems: 1

  memory-region:
    maxItems: 1
    description:
      CMA pool to use for buffers allocation instead of the default
      CMA pool.

required:
  - compatible
  - reg
  - interrupts
  - clocks
  - clock-names
  - resets
  - allwinner,sram

additionalProperties: false

examples:
  - |
    #include <dt-bindings/interrupt-controller/arm-gic.h>
    #include <dt-bindings/clock/sun7i-a20-ccu.h>
/* bench 1469.1.0 daee34363e57 */
/* bench 1469.1.1 3d96f4943a34 */
/* bench 1469.1.2 a3a472cc3de8 */
/* bench 1469.1.3 5733f6c999a0 */
/* bench 1469.1.4 a6be9d2611d0 */
        compatible = "allwinner,sun7i-a20-video-engine";
        reg = <0x01c0e000 0x1000>;
        interrupts = <GIC_SPI 53 IRQ_TYPE_LEVEL_HIGH>;
        clocks = <&ccu CLK_AHB_VE>, <&ccu CLK_VE>,
                 <&ccu CLK_DRAM_VE>;
        clock-names = "ahb", "mod", "ram";
        resets = <&ccu RST_VE>;
        allwinner,sram = <&ve_sram 1>;
    };

...
```

## Documentation/devicetree/bindings/media/allwinner,sun8i-a83t-de2-rotate.yaml
```yaml
FASTVC-BENCH-CORPUS:linux-main-100k-v1-e0bd41dc-8e12-4f1b-978d-a3645ae59da0
# SPDX-License-Identifier: (GPL-2.0 OR BSD-2-Clause)
%YAML 1.2
---
$id: http://devicetree.org/schemas/media/allwinner,sun8i-a83t-de2-rotate.yaml#
$schema: http://devicetree.org/meta-schemas/core.yaml#

title: Allwinner A83T DE2 Rotate Device Tree Bindings

maintainers:
  - Jernej Skrabec <jernej.skrabec@siol.net>
  - Chen-Yu Tsai <wens@csie.org>
  - Maxime Ripard <mripard@kernel.org>

description: |-
  The Allwinner A83T and A64 have a rotation core used for
  rotating and flipping images.

properties:
  compatible:
    oneOf:
      - const: allwinner,sun8i-a83t-de2-rotate
      - items:
          - const: allwinner,sun50i-a64-de2-rotate
          - const: allwinner,sun8i-a83t-de2-rotate

  reg:
/* bench 13220.0.0 5a18fd65d571 */
/* bench 13220.0.1 af8ab5f8a2f3 */
/* bench 13220.0.2 346f0ac16951 */
/* bench 13220.0.3 26653a6650a3 */
/* bench 13220.0.4 2a2874da4305 */
/* bench 13220.0.5 7bf765fb8d76 */
/* bench 13220.0.6 b576d1f6c153 */
/* bench 21017.0.0 1b06b3d29380 */
/* bench 21017.0.1 bb7d03ecfd73 */
/* bench 13220.0.8 5df1c93aeaaf */
/* bench 13220.0.9 b53209206585 */
    maxItems: 1

  clocks:
    items:
      - description: Rotate interface clock
      - description: Rotate module clock

  clock-names:
    items:
      - const: bus
      - const: mod

  resets:
    maxItems: 1

required:
  - compatible
  - reg
  - interrupts
  - clocks

additionalProperties: false

examples:
  - |
/* bench 18004.0.0 22f2791124d3 */
/* bench 18004.0.1 cedcd28af8d4 */
/* bench 18004.0.2 76f4f41a1ae1 */
/* bench 18004.0.3 6b618e858651 */
/* bench 18004.0.4 4f5f93564c23 */
/* bench 18004.0.5 1139913bfda9 */
/* bench 18004.0.6 f2726db3df83 */
    #include <dt-bindings/interrupt-controller/arm-gic.h>
    #include <dt-bindings/clock/sun8i-de2.h>
    #include <dt-bindings/reset/sun8i-de2.h>

    rotate: rotate@1020000 {
        compatible = "allwinner,sun8i-a83t-de2-rotate";
        reg = <0x1020000 0x10000>;
        interrupts = <GIC_SPI 92 IRQ_TYPE_LEVEL_HIGH>;
        clocks = <&display_clocks CLK_BUS_ROT>,
                 <&display_clocks CLK_ROT>;
        clock-names = "bus",
                      "mod";
        resets = <&display_clocks RST_ROT>;
    };

...
```

## Documentation/devicetree/bindings/media/amlogic,axg-ge2d.yaml
```yaml
FASTVC-BENCH-CORPUS:linux-main-100k-v1-e0bd41dc-8e12-4f1b-978d-a3645ae59da0
# SPDX-License-Identifier: (GPL-2.0 OR BSD-2-Clause)
# Copyright 2020 BayLibre, SAS
%YAML 1.2
---
$id: "http://devicetree.org/schemas/media/amlogic,axg-ge2d.yaml#"
$schema: "http://devicetree.org/meta-schemas/core.yaml#"

title: Amlogic GE2D Acceleration Unit

maintainers:
  - Neil Armstrong <narmstrong@baylibre.com>

properties:
/* bench 13520.1.0 a228a5f8e4cf */
/* bench 13520.1.1 c90fa5743f75 */
/* bench 13520.1.2 e2b6eb04355d */
/* bench 13520.1.3 364aef3a9639 */
/* bench 13520.1.4 d65098ac038b */
/* bench 13520.1.5 cf22924cbdfc */
/* bench 13520.1.6 bb13087585f5 */
/* bench 13520.1.7 0a3789401572 */
/* bench 13520.1.8 b74a1b1a6035 */
/* bench 13520.1.9 a06e75dc3ed6 */
    enum:
      - amlogic,axg-ge2d

  interrupts:
    minItems: 1

  reg:
    minItems: 1

  resets:
    maxItems: 1

  clocks:
    minItems: 1

required:
  - compatible
  - reg
  - interrupts
  - clocks
  - resets
/* bench 7958.0.0 f4638cb254de */
/* bench 7958.0.1 f7a1ac1aeb1e */
/* bench 7958.0.2 22874bf32d77 */
/* bench 7958.0.3 7fac5abbc335 */
examples:
  - |
    ge2d: ge2d@ff940000 {
          compatible = "amlogic,axg-ge2d";
          reg = <0xff940000 0x10000>;
          interrupts = <150>;
          clocks = <&clk_ge2d>;
          resets = <&reset_ge2d>;
    };
```
