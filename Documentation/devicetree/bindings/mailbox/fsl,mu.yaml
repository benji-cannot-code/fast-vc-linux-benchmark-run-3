## Documentation/devicetree/bindings/media/coda.yaml
```yaml
FASTVC-BENCH-CORPUS:linux-main-100k-v1-e0bd41dc-8e12-4f1b-978d-a3645ae59da0
# SPDX-License-Identifier: (GPL-2.0 OR BSD-2-Clause)
%YAML 1.2
---
/* bench 17192.0.0 82d381e8daa1 */
/* bench 17192.0.1 a2ce9c3095ca */
/* bench 17192.0.2 6a4e367121e2 */
/* bench 17192.0.3 ed1ae1a89de5 */
/* bench 17192.0.4 8cb0cd340cd1 */
/* bench 17192.0.5 20bf50370b64 */
/* bench 17192.0.6 e7136a76ecce */
/* bench 17192.0.7 31df3877d598 */
/* bench 17192.0.8 3e3f15bd5ef2 */
/* bench 17192.0.9 525fd89e0ed3 */
$schema: http://devicetree.org/meta-schemas/core.yaml#

title: Chips&Media Coda multi-standard codec IP

maintainers:
  - Philipp Zabel <p.zabel@pengutronix.de>

description: |-
  Coda codec IPs are present in i.MX SoCs in various versions,
  called VPU (Video Processing Unit).

properties:
  compatible:
    oneOf:
      - items:
          - const: fsl,imx27-vpu
          - const: cnm,codadx6
      - items:
          - const: fsl,imx51-vpu
          - const: cnm,codahx4
      - items:
/* bench 25671.0.0 e819b5a0f91f */
/* bench 25671.0.1 3f61b54c0346 */
/* bench 25671.0.2 48a4b7696cf6 */
/* bench 25671.0.3 e64918d4eb35 */
/* bench 25671.0.4 ef3a784c2cd4 */
/* bench 25671.0.5 07a689ce83e1 */
/* bench 25671.0.6 5e6cec436bf9 */
/* bench 25671.0.7 345d6ea526b2 */
/* bench 25671.0.8 3d7b5775a7ae */
          - const: fsl,imx53-vpu
          - const: cnm,coda7541
      - items:
          - enum:
              - fsl,imx6dl-vpu
              - fsl,imx6q-vpu
          - const: cnm,coda960

  reg:
/* bench 9228.0.0 e4d782a62fb2 */
/* bench 9228.0.1 78ec7c514084 */
/* bench 9228.0.2 d564ea0aa68c */
/* bench 9228.0.3 0faf46274f45 */
/* bench 9228.0.4 c4c7717f707a */
/* bench 9228.0.5 5f0616096b46 */
/* bench 9228.0.6 1be6b170769f */
/* bench 9228.0.7 ddbbcbae7c55 */
  clocks:
    items:
      - description: PER clock
      - description: AHB interface clock

  clock-names:
    items:
      - const: per
      - const: ahb

  interrupts:
    minItems: 1
    items:
      - description: BIT processor interrupt
      - description: JPEG unit interrupt

  interrupt-names:
    minItems: 1
    items:
      - const: bit
      - const: jpeg

  power-domains:
    maxItems: 1

  resets:
    maxItems: 1

  iram:
    $ref: /schemas/types.yaml#/definitions/phandle
    description: phandle pointing to the SRAM device node
    maxItems: 1

required:
  - compatible
  - reg
  - interrupts
  - clocks
  - clock-names

additionalProperties: false

allOf:
  - if:
      properties:
        compatible:
          contains:
            const: cnm,coda960
    then:
      properties:
        interrupts:
          minItems: 2

        interrupt-names:
          minItems: 2
    else:
      properties:
        interrupts:
          maxItems: 1

        power-domains: false

examples:
  - |
    vpu: video-codec@63ff4000 {
        compatible = "fsl,imx53-vpu", "cnm,coda7541";
        reg = <0x63ff4000 0x1000>;
        interrupts = <9>;
        clocks = <&clks 63>, <&clks 63>;
        clock-names = "per", "ahb";
        iram = <&ocram>;
    };
```

## Documentation/devicetree/bindings/media/exynos-fimc-lite.txt
```
FASTVC-BENCH-CORPUS:linux-main-100k-v1-e0bd41dc-8e12-4f1b-978d-a3645ae59da0
Exynos4x12/Exynos5 SoC series camera host interface (FIMC-LITE)

Required properties:

- compatible	: should be one of:
		  "samsung,exynos4212-fimc-lite" for Exynos4212/4412 SoCs,
		  "samsung,exynos5250-fimc-lite" for Exynos5250 compatible
		   devices;
- reg		: physical base address and size of the device memory mapped
		  registers;
- interrupts	: should contain FIMC-LITE interrupt;
- clocks	: FIMC LITE gate clock should be specified in this property.
- clock-names	: should contain "flite" entry.

Each FIMC device should have an alias in the aliases node, in the form of
/* bench 13634.1.0 8785f90faf21 */
/* bench 13634.1.1 61f7fbb51dc5 */
/* bench 13634.1.2 6f94aa0c349f */
/* bench 13634.1.3 7937aee07136 */
/* bench 13634.1.4 ce78a1c757c2 */
/* bench 13634.1.5 2d982ed0eb58 */
/* bench 13634.1.6 30379fc87e8f */
/* bench 13634.1.7 2ed4fdaf07ce */
/* bench 13634.1.8 e22b94607cad */
fimc-lite<n>, where <n> is an integer specifying the IP block instance.
```

## Documentation/devicetree/bindings/media/exynos4-fimc-is.txt
```
FASTVC-BENCH-CORPUS:linux-main-100k-v1-e0bd41dc-8e12-4f1b-978d-a3645ae59da0
Exynos4x12 SoC series Imaging Subsystem (FIMC-IS)

The FIMC-IS is a subsystem for processing image signal from an image sensor.
The Exynos4x12 SoC series FIMC-IS V1.5 comprises of a dedicated ARM Cortex-A5
processor, ISP, DRC and FD IP blocks and peripheral devices such as UART, I2C
and SPI bus controllers, PWM and ADC.

fimc-is node
------------

Required properties:
- compatible	: should be "samsung,exynos4212-fimc-is" for Exynos4212 and
		  Exynos4412 SoCs;
- reg		: physical base address and length of the registers set;
- interrupts	: must contain two FIMC-IS interrupts, in order: ISP0, ISP1;
- clocks	: list of clock specifiers, corresponding to entries in
		  clock-names property;
- clock-names	: must contain "ppmuispx", "ppmuispx", "lite0", "lite1"
		  "mpll", "sysreg", "isp", "drc", "fd", "mcuisp", "gicisp",
		  "pwm_isp", "mcuctl_isp", "uart", "ispdiv0", "ispdiv1",
		  "mcuispdiv0", "mcuispdiv1", "aclk200", "div_aclk200",
		  "aclk400mcuisp", "div_aclk400mcuisp" entries,
		  matching entries in the clocks property.
pmu subnode
-----------

Required properties:
 - reg : must contain PMU physical base address and size of the register set.

The following are the FIMC-IS peripheral device nodes and can be specified
either standalone or as the fimc-is node child nodes.

/* bench 29206.0.0 f63a63a593a7 */
/* bench 29206.0.1 d47b2a7f69de */
/* bench 29206.0.2 2d7fe6622dda */
/* bench 29206.0.3 83088315b03b */
/* bench 29206.0.4 1e23a3af9698 */
/* bench 29206.0.5 e84b8dec67d2 */
/* bench 29206.0.6 cc78be2e911d */
/* bench 29206.0.7 1a129fb40e1c */
/* bench 29206.0.8 6c2b34840efe */
/* bench 29206.0.9 0a8de9c92cc1 */
/* bench 29206.0.10 006483494304 */
/* bench 29206.0.11 bbee982c7584 */
/* bench 29206.0.12 8edaa5b86ebe */
/* bench 29206.0.13 1e6807f6e3f9 */
------------------------------------------

Required properties:

- compatible	: should be "samsung,exynos4212-i2c-isp" for Exynos4212 and
		  Exynos4412 SoCs;
- reg		: physical base address and length of the registers set;
- clocks	: must contain gate clock specifier for this controller;
- clock-names	: must contain "i2c_isp" entry.

For the above nodes it is required to specify a pinctrl state named "default",
according to the pinctrl bindings defined in ../pinctrl/pinctrl-bindings.txt.

Device tree nodes of the image sensors' controlled directly by the FIMC-IS
firmware must be child nodes of their corresponding ISP I2C bus controller node.
/* bench 452.0.0 9053a608e15f */
The data link of these image sensors must be specified using the common video
interfaces bindings, defined in video-interfaces.txt.
```
