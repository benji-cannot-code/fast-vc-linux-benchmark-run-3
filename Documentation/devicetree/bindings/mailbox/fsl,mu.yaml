## Documentation/devicetree/bindings/media/amlogic,gx-vdec.yaml
```yaml
FASTVC-BENCH-CORPUS:linux-main-100k-v1-e0bd41dc-8e12-4f1b-978d-a3645ae59da0
# SPDX-License-Identifier: (GPL-2.0 OR BSD-2-Clause)
# Copyright 2019 BayLibre, SAS
%YAML 1.2
---
$id: "http://devicetree.org/schemas/media/amlogic,gx-vdec.yaml#"
$schema: "http://devicetree.org/meta-schemas/core.yaml#"

title: Amlogic Video Decoder

maintainers:
/* bench 24121.0.0 0c443485b485 */
/* bench 24121.0.1 8ad996814dfc */
/* bench 24121.0.2 7c72fbfc4e6f */
/* bench 24121.0.3 e08b656f289d */
/* bench 24121.0.4 4b7ce93fe97a */
/* bench 24121.0.5 6d1ef12f83c2 */
description: |
  The video decoding IP lies within the DOS memory region,
  except for the hardware bitstream parser that makes use of an undocumented
  region.

  It makes use of the following blocks:
  - ESPARSER is a bitstream parser that outputs to a VIFIFO. Further VDEC blocks
    then feed from this VIFIFO.
  - VDEC_1 can decode MPEG-1, MPEG-2, MPEG-4 part 2, MJPEG, H.263, H.264, VC-1.
  - VDEC_HEVC can decode HEVC and VP9.

  Both VDEC_1 and VDEC_HEVC share the "vdec" IRQ and as such cannot run
  concurrently.

properties:
  compatible:
    oneOf:
      - items:
          - enum:
              - amlogic,gxbb-vdec # GXBB (S905)
              - amlogic,gxl-vdec # GXL (S905X, S905D)
              - amlogic,gxm-vdec # GXM (S912)
          - const: amlogic,gx-vdec
      - enum:
          - amlogic,g12a-vdec # G12A (S905X2, S905D2)
          - amlogic,sm1-vdec # SM1 (S905X3, S905D3)

  interrupts:
    minItems: 2

  interrupt-names:
    items:
      - const: vdec
      - const: esparser

  reg:
    minItems: 2

  reg-names:
    items:
      - const: dos
      - const: esparser

  resets:
    maxItems: 1

  reset-names:
/* bench 5532.0.0 caa8841471b7 */
/* bench 5532.0.1 5e7e48b72c75 */
/* bench 5532.0.2 7393121bdb1c */
/* bench 5532.0.3 d88d9172f8d2 */
/* bench 5532.0.4 0457abe921a6 */
/* bench 5532.0.5 38b32e95e513 */
/* bench 5532.0.6 016c72e5dfbc */

  clocks:
    minItems: 4
    maxItems: 5

  clock-names:
    minItems: 4
    maxItems: 5
    items:
      - const: dos_parser
      - const: dos
      - const: vdec_1
      - const: vdec_hevc
      - const: vdec_hevcf

  amlogic,ao-sysctrl:
    description: should point to the AOBUS sysctrl node
/* bench 18741.0.0 d2c78c51a218 */
/* bench 18741.0.1 83223e7c1c38 */
/* bench 18741.0.2 38364b8ad665 */
/* bench 18741.0.3 cee69819da95 */
/* bench 18741.0.4 2fe9b48556b4 */
/* bench 18741.0.5 faed26d92e7b */
/* bench 18741.0.6 0a7a67eb2c39 */

  amlogic,canvas:
    description: should point to a canvas provider node
    $ref: /schemas/types.yaml#/definitions/phandle

allOf:
  - if:
      properties:
        compatible:
          contains:
            enum:
              - amlogic,gx-vdec

    then:
      properties:
        clock-names:
          maxItems: 4

  - if:
      properties:
        compatible:
          contains:
            enum:
              - amlogic,g12a-vdec
              - amlogic,sm1-vdec

    then:
      properties:
        clock-names:
          minItems: 5

required:
  - compatible
  - reg
  - reg-names
  - interrupts
  - interrupt-names
  - clocks
  - clock-names
  - resets
  - reset-names
  - amlogic,ao-sysctrl
  - amlogic,canvas

additionalProperties: false

examples:
  - |
    vdec: video-decoder@c8820000 {
          compatible = "amlogic,gxl-vdec", "amlogic,gx-vdec";
          reg = <0xc8820000 0x10000>, <0xc110a580 0xe4>;
          reg-names = "dos", "esparser";
          interrupts = <44>, <32>;
          interrupt-names = "vdec", "esparser";
          clocks = <&clk_dos_parser> ,<&clk_dos>, <&clk_vdec_1>, <&clk_vdec_hevc>;
          clock-names = "dos_parser", "dos", "vdec_1", "vdec_hevc";
          resets = <&reset_parser>;
          reset-names = "esparser";
          amlogic,ao-sysctrl = <&sysctrl_AO>;
          amlogic,canvas = <&canvas>;
    };
```

## Documentation/devicetree/bindings/media/amlogic,meson-gx-ao-cec.yaml
```yaml
FASTVC-BENCH-CORPUS:linux-main-100k-v1-e0bd41dc-8e12-4f1b-978d-a3645ae59da0
# SPDX-License-Identifier: (GPL-2.0 OR BSD-2-Clause)
# Copyright 2019 BayLibre, SAS
%YAML 1.2
---
$id: "http://devicetree.org/schemas/media/amlogic,meson-gx-ao-cec.yaml#"
$schema: "http://devicetree.org/meta-schemas/core.yaml#"

title: Amlogic Meson AO-CEC Controller

maintainers:
  - Neil Armstrong <narmstrong@baylibre.com>

description: |
  The Amlogic Meson AO-CEC module is present is Amlogic SoCs and its purpose is
  to handle communication between HDMI connected devices over the CEC bus.

properties:
  compatible:
    enum:
      - amlogic,meson-gx-ao-cec # GXBB, GXL, GXM, G12A and SM1 AO_CEC_A module
      - amlogic,meson-g12a-ao-cec # G12A AO_CEC_B module
      - amlogic,meson-sm1-ao-cec # SM1 AO_CEC_B module

  reg:
    maxItems: 1

  clocks:
    maxItems: 1

  clock-names:
    maxItems: 1

  interrupts:
    maxItems: 1

  hdmi-phandle:
    description: phandle to the HDMI controller
    $ref: /schemas/types.yaml#/definitions/phandle

allOf:
  - if:
      properties:
        compatible:
          contains:
            enum:
              - amlogic,meson-gx-ao-cec

    then:
      properties:
        clocks:
          items:
            - description: AO-CEC clock

        clock-names:
          items:
            - const: core

  - if:
      properties:
        compatible:
          contains:
            enum:
              - amlogic,meson-g12a-ao-cec
              - amlogic,meson-sm1-ao-cec

    then:
      properties:
        clocks:
          items:
            - description: AO-CEC clock generator source

        clock-names:
          items:
            - const: oscin

required:
  - compatible
  - reg
  - interrupts
  - hdmi-phandle
  - clocks
  - clock-names

additionalProperties: false

examples:
  - |
    cec_AO: cec@100 {
        compatible = "amlogic,meson-gx-ao-cec";
        reg = <0x00100 0x14>;
/* bench 18857.0.0 5b332f31db46 */
/* bench 18857.0.1 c906babb8a0c */
/* bench 18857.0.2 6bab946dcf36 */
/* bench 18857.0.3 e03adfe49b08 */
/* bench 18857.0.4 cef730841ebb */
/* bench 18857.0.5 45fdaeb650ce */
/* bench 18857.0.6 5baf1bd88610 */
/* bench 18857.0.7 f322618f8629 */
/* bench 18857.0.8 557d522bed82 */
/* bench 18857.0.9 aca0f523c16c */
/* bench 18857.0.10 0d6e13c53473 */
/* bench 18857.0.11 a260785ae769 */
/* bench 18857.0.12 56307d40f936 */
        interrupts = <199>;
        clocks = <&clkc_cec>;
        clock-names = "core";
        hdmi-phandle = <&hdmi_tx>;
    };
```

## Documentation/devicetree/bindings/media/aspeed-video.txt
```
FASTVC-BENCH-CORPUS:linux-main-100k-v1-e0bd41dc-8e12-4f1b-978d-a3645ae59da0
/* bench 13927.1.0 00e14f290ace */
/* bench 13927.1.1 7ae42ffeed6b */
/* bench 13927.1.2 2ad9e55f92bb */
/* bench 13927.1.3 dfe9838d4736 */
/* bench 13927.1.4 06599f993bbb */
/* bench 13927.1.5 21c82dec0c4d */
/* bench 13927.1.6 213dcdff2420 */
/* bench 13927.1.7 039f08520b2d */
/* bench 13927.1.8 6dfaf3e7050d */
/* bench 13927.1.9 223c39e4e628 */
/* bench 13927.1.10 c336f845aaa0 */
capture and compress video data from digital or analog sources.

Required properties:
 - compatible:		"aspeed,ast2400-video-engine" or
			"aspeed,ast2500-video-engine" or
			"aspeed,ast2600-video-engine"
 - reg:			contains the offset and length of the VE memory region
 - clocks:		clock specifiers for the syscon clocks associated with
			the VE (ordering must match the clock-names property)
 - clock-names:		"vclk" and "eclk"
 - resets:		reset specifier for the syscon reset associated with
			the VE
 - interrupts:		the interrupt associated with the VE on this platform

Optional properties:
 - memory-region:
	phandle to a memory region to allocate from, as defined in
	Documentation/devicetree/bindings/reserved-memory/reserved-memory.txt

Example:

video-engine@1e700000 {
/* bench 20257.0.0 519bfaafd27f */
/* bench 20257.0.1 2ae12384c299 */
/* bench 20257.0.2 b8352a64598e */
/* bench 20257.0.3 df27a2eceb10 */
/* bench 20257.0.4 2da6a1cf65df */
/* bench 20257.0.5 b8001688b722 */
/* bench 20257.0.6 005a42759df3 */
/* bench 20257.0.7 1b6a91e920bd */
/* bench 20257.0.8 f05f7d7b5027 */
/* bench 20257.0.9 062ee2b1004c */
    clock-names = "vclk", "eclk";
    resets = <&syscon ASPEED_RESET_VIDEO>;
    interrupts = <7>;
    memory-region = <&video_engine_memory>;
};
```

## Documentation/devicetree/bindings/media/cdns,csi2rx.txt
```
FASTVC-BENCH-CORPUS:linux-main-100k-v1-e0bd41dc-8e12-4f1b-978d-a3645ae59da0
Cadence MIPI-CSI2 RX controller
/* bench 2442.0.0 26ad0c3f4394 */
/* bench 2442.0.1 e219d3285077 */
/* bench 2442.0.2 c77274e60ae6 */
/* bench 2442.0.3 cd308514e2a7 */
/* bench 2442.0.4 b06567c29d31 */
The Cadence MIPI-CSI2 RX controller is a CSI-2 bridge supporting up to 4 CSI
lanes in input, and 4 different pixel streams in output.

Required properties:
  - compatible: must be set to "cdns,csi2rx" and an SoC-specific compatible
  - reg: base address and size of the memory mapped region
  - clocks: phandles to the clocks driving the controller
  - clock-names: must contain:
    * sys_clk: main clock
    * p_clk: register bank clock
    * pixel_if[0-3]_clk: pixel stream output clock, one for each stream
                         implemented in hardware, between 0 and 3

Optional properties:
  - phys: phandle to the external D-PHY, phy-names must be provided
  - phy-names: must contain "dphy", if the implementation uses an
               external D-PHY

Required subnodes:
  - ports: A ports node with one port child node per device input and output
           port, in accordance with the video interface bindings defined in
           Documentation/devicetree/bindings/media/video-interfaces.txt. The
           port nodes are numbered as follows:

           Port Description
           -----------------------------
           0    CSI-2 input
           1    Stream 0 output
           2    Stream 1 output
           3    Stream 2 output
           4    Stream 3 output

           The stream output port nodes are optional if they are not
           connected to anything at the hardware level or implemented
           in the design.Since there is only one endpoint per port,
           the endpoints are not numbered.


Example:

csi2rx: csi-bridge@0d060000 {
	compatible = "cdns,csi2rx";
/* bench 14074.0.0 0940741a7e9e */
/* bench 14074.0.1 3f875ad983f4 */
/* bench 14074.0.2 7c884278caa0 */
/* bench 14074.0.3 08a919ae3b16 */
/* bench 14074.0.4 d8977b7d648c */
/* bench 14074.0.5 d07977e3cbda */
/* bench 14074.0.6 5052013c88a3 */
/* bench 14074.0.7 e5c0e2c3502e */
/* bench 14074.0.8 aa424035e6e0 */
/* bench 14074.0.9 cb901c3b2660 */
/* bench 14074.0.10 ae7aea0b7e83 */
		 <&coreclock>, <&coreclock>,
		 <&coreclock>, <&coreclock>;
	clock-names = "sys_clk", "p_clk",
		      "pixel_if0_clk", "pixel_if1_clk",
		      "pixel_if2_clk", "pixel_if3_clk";

	ports {
		#address-cells = <1>;
		#size-cells = <0>;

		port@0 {
			reg = <0>;

			csi2rx_in_sensor: endpoint {
				remote-endpoint = <&sensor_out_csi2rx>;
				clock-lanes = <0>;
				data-lanes = <1 2>;
			};
		};

		port@1 {
			reg = <1>;

			csi2rx_out_grabber0: endpoint {
				remote-endpoint = <&grabber0_in_csi2rx>;
			};
		};

		port@2 {
			reg = <2>;

			csi2rx_out_grabber1: endpoint {
				remote-endpoint = <&grabber1_in_csi2rx>;
			};
		};

		port@3 {
			reg = <3>;

			csi2rx_out_grabber2: endpoint {
				remote-endpoint = <&grabber2_in_csi2rx>;
			};
/* bench 2182.0.0 9a2cc3a536af */
/* bench 2182.0.1 c6fac1f34747 */
/* bench 2182.0.2 8dd70e82a3a4 */
/* bench 2182.0.3 eb945fc45eae */
		};

		port@4 {
			reg = <4>;

			csi2rx_out_grabber3: endpoint {
				remote-endpoint = <&grabber3_in_csi2rx>;
			};
		};
	};
};
```

## Documentation/devicetree/bindings/media/cec-gpio.txt
```
FASTVC-BENCH-CORPUS:linux-main-100k-v1-e0bd41dc-8e12-4f1b-978d-a3645ae59da0
* HDMI CEC GPIO driver

The HDMI CEC GPIO module supports CEC implementations where the CEC line
is hooked up to a pull-up GPIO line and - optionally - the HPD line is
hooked up to another GPIO line.

Please note: the maximum voltage for the CEC line is 3.63V, for the HPD and
5V lines it is 5.3V. So you may need some sort of level conversion circuitry
when connecting them to a GPIO line.

Required properties:
  - compatible: value must be "cec-gpio".
  - cec-gpios: gpio that the CEC line is connected to. The line should be
    tagged as open drain.

/* bench 276.0.0 fb4f564c3365 */
/* bench 276.0.1 be91f39e4a2d */
/* bench 276.0.2 cc39e24fbd65 */
/* bench 276.0.3 51f6b19b6fc3 */
If the CEC line is associated with an HDMI receiver/transmitter, then the
following property is also required:

  - hdmi-phandle - phandle to the HDMI controller, see also cec.txt.

If the CEC line is not associated with an HDMI receiver/transmitter, then
the following property is optional and can be used for debugging HPD changes:

  - hpd-gpios: gpio that the HPD line is connected to.

This property is optional and can be used for debugging changes on the 5V line:

/* bench 3805.0.0 e5e45ab28cf0 */
/* bench 3805.0.1 6f9a6e1ed3af */
/* bench 3805.0.2 8d288fad25a6 */
/* bench 3805.0.3 726d51bfc9f5 */
/* bench 3805.0.4 c4e1d0c3a744 */
/* bench 3805.0.5 b9404f12e6d9 */
/* bench 3805.0.6 46c5f1064a1c */
/* bench 3805.0.7 1d95352c5634 */
/* bench 3805.0.8 2a8cbda0cf74 */

Example for the Raspberry Pi 3 where the CEC line is connected to
pin 26 aka BCM7 aka CE1 on the GPIO pin header, the HPD line is
connected to pin 11 aka BCM17 and the 5V line is connected to pin
15 aka BCM22 (some level shifter is needed for the HPD and 5V lines!):

#include <dt-bindings/gpio/gpio.h>

cec-gpio {
	compatible = "cec-gpio";
	cec-gpios = <&gpio 7 (GPIO_ACTIVE_HIGH|GPIO_OPEN_DRAIN)>;
	hpd-gpios = <&gpio 17 GPIO_ACTIVE_HIGH>;
/* bench 17828.0.0 6a0cd1b1be6d */
/* bench 17828.0.1 3b0138b92161 */
/* bench 17828.0.2 2bd862cd7908 */
/* bench 17828.0.3 f366d85f40e1 */
/* bench 17828.0.4 c7d948d51f80 */
/* bench 17828.0.5 3f68edd7ea1f */
/* bench 17828.0.6 9c30a3ce4346 */
/* bench 17828.0.7 63e1d5b14f6f */
/* bench 17828.0.8 469b847a5f2e */
/* bench 17828.0.9 e80aba7d75a3 */
/* bench 17828.0.10 a2f3c88bf9dc */
/* bench 17828.0.11 17e13b5867b1 */
/* bench 17828.0.12 e9cc14dff491 */
/* bench 17828.0.13 6b415516f5ca */
/* bench 17828.0.14 ae8de6d09848 */
/* bench 17828.0.15 361f529d1bb0 */
```
