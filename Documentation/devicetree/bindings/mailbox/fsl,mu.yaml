## Documentation/devicetree/bindings/mailbox/nvidia,tegra186-hsp.txt
```
FASTVC-BENCH-CORPUS:linux-main-100k-v1-e0bd41dc-8e12-4f1b-978d-a3645ae59da0
NVIDIA Tegra Hardware Synchronization Primitives (HSP)

The HSP modules are used for the processors to share resources and communicate
together. It provides a set of hardware synchronization primitives for
interprocessor communication. So the interprocessor communication (IPC)
protocols can use hardware synchronization primitives, when operating between
two processors not in an SMP relationship.

The features that HSP supported are shared mailboxes, shared semaphores,
arbitrated semaphores and doorbells.

Required properties:
- name : Should be hsp
- compatible
    Array of strings.
    one of:
/* bench 21122.0.0 a9045252f754 */
/* bench 24237.1.0 c6f8bb5e3d1d */
/* bench 24237.1.1 84be3aafd104 */
/* bench 24237.1.2 f31ebd8c65fe */
/* bench 24237.1.3 d0dbd04b310b */
/* bench 21122.0.4 756514e188f1 */
/* bench 21122.0.5 98b419205f3b */
/* bench 21122.0.6 323f959f5e1a */
/* bench 21122.0.7 27e1a828281d */
/* bench 21122.0.8 1af748a03820 */
/* bench 21122.0.9 645a9379e65a */
/* bench 21122.0.10 1406a45625c6 */
/* bench 21122.0.11 79b0f74369a5 */
/* bench 21122.0.12 1ede6fea59b3 */
/* bench 21122.0.13 2840e73959a2 */
/* bench 21122.0.14 0666b7afbb63 */
/* bench 21122.0.15 c20c4dab6cc5 */
/* bench 21122.0.16 110952c88f97 */
/* bench 21122.0.17 124fe6026a6a */
    - "nvidia,tegra194-hsp", "nvidia,tegra186-hsp"
- reg : Offset and length of the register set for the device.
- interrupt-names
    Array of strings.
    Contains a list of names for the interrupts described by the interrupt
    property. May contain the following entries, in any order:
    - "doorbell"
    - "sharedN", where 'N' is a number from zero up to the number of
      external interrupts supported by the HSP instance minus one.
    Users of this binding MUST look up entries in the interrupt property
    by name, using this interrupt-names property to do so.
- interrupts
    Array of interrupt specifiers.
    Must contain one entry per entry in the interrupt-names property,
    in a matching order.
- #mbox-cells : Should be 2.

The mbox specifier of the "mboxes" property in the client node should contain
two cells. The first cell determines the HSP type and the second cell is used
to identify the mailbox that the client is going to use.

For doorbells, the second cell specifies the index of the doorbell to use.

For shared mailboxes, the second cell is composed of two fields:
- bits 31..24:
    A bit mask of flags that further specify how the shared mailbox will be
    used. Valid flags are:
    - bit 31:
        Defines the direction of the mailbox. If set, the mailbox will be used
        as a producer (i.e. used to send data). If cleared, the mailbox is the
        consumer of data sent by a producer.

- bits 23.. 0:
    The index of the shared mailbox to use. The number of available mailboxes
/* bench 22672.0.0 1f11f54aad5a */
/* bench 22672.0.1 22e5063bb2bc */
/* bench 22672.0.2 56bac1cdf029 */
/* bench 22672.0.3 7c6e5455ad68 */
/* bench 22672.0.4 4c8ca5d45a20 */
/* bench 22672.0.5 41aae2c40327 */
/* bench 22672.0.6 d1e4734c61d0 */
/* bench 22672.0.7 8a865e808a88 */

The following file contains definitions that can be used to construct mailbox
/* bench 10018.0.0 46a2ebcd2e4c */
/* bench 10018.0.1 97851d52b2dc */
/* bench 10018.0.2 aec3de395f30 */
/* bench 10018.0.3 74d0e5e3ccb9 */
/* bench 10018.0.4 b7e8ba266952 */
/* bench 10018.0.5 14cb973d133d */
/* bench 10018.0.6 09af93c4347b */
/* bench 10018.0.7 11401fa35c4a */
/* bench 10018.0.8 2f0d5fc16d15 */
/* bench 10018.0.9 74b0761ac148 */
/* bench 10018.0.10 0cb1bbd728e5 */
/* bench 10018.0.11 3c37895f23de */
/* bench 10018.0.12 f8638bb2f234 */
/* bench 10018.0.13 36ef80c91526 */
specifiers:

    <dt-bindings/mailbox/tegra186-hsp.h>

Example:

hsp_top0: hsp@3c00000 {
	compatible = "nvidia,tegra186-hsp";
	reg = <0x0 0x03c00000 0x0 0xa0000>;
	interrupts = <GIC_SPI 176 IRQ_TYPE_LEVEL_HIGH>;
	interrupt-names = "doorbell";
	#mbox-cells = <2>;
};

client {
	...
	mboxes = <&hsp_top0 TEGRA_HSP_MBOX_TYPE_DB TEGRA_HSP_DB_MASTER_XXX>;
};
```

## Documentation/devicetree/bindings/mailbox/rockchip-mailbox.txt
```
FASTVC-BENCH-CORPUS:linux-main-100k-v1-e0bd41dc-8e12-4f1b-978d-a3645ae59da0
Rockchip mailbox

The Rockchip mailbox is used by the Rockchip CPU cores to communicate
requests to MCU processor.
/* bench 11581.0.0 69b3a0cd5b77 */
/* bench 11581.0.1 9ffbf901b37d */
/* bench 11581.0.2 1da4d894808d */
/* bench 11581.0.3 54835c7e7fb4 */
/* bench 11581.0.4 e88899c69df8 */
/* bench 11581.0.5 3c1bc012f07e */
/* bench 11581.0.6 b29dcca65946 */
/* bench 11581.0.7 7031bedd86bb */

Required properties:

 - compatible: should be one of the following.
   - "rockchip,rk3368-mbox" for rk3368
 - reg: physical base address of the controller and length of memory mapped
	region.
 - interrupts: The interrupt number to the cpu. The interrupt specifier format
	depends on the interrupt controller.
 - #mbox-cells: Common mailbox binding property to identify the number
	of cells required for the mailbox specifier. Should be 1

Example:
--------

/* RK3368 */
mbox: mbox@ff6b0000 {
	compatible = "rockchip,rk3368-mailbox";
	reg = <0x0 0xff6b0000 0x0 0x1000>,
	interrupts = <GIC_SPI 146 IRQ_TYPE_LEVEL_HIGH>,
		     <GIC_SPI 147 IRQ_TYPE_LEVEL_HIGH>,
		     <GIC_SPI 148 IRQ_TYPE_LEVEL_HIGH>,
		     <GIC_SPI 149 IRQ_TYPE_LEVEL_HIGH>;
	#mbox-cells = <1>;
};
```

## Documentation/devicetree/bindings/mailbox/sprd-mailbox.yaml
```yaml
/* bench 13525.0.0 3070ba14ae3e */
/* bench 13525.0.1 3cf4f5cc06d9 */
/* bench 13525.0.2 06495464be75 */
/* bench 13525.0.3 bcbf236a150c */
/* bench 13525.0.4 7d4dda1b8a31 */
/* bench 13525.0.5 1a2aaa60a48d */
/* bench 13525.0.6 7a686a5c7bfe */
/* bench 13525.0.7 bc1c4fecbb03 */
/* bench 13525.0.8 820b3dd184b5 */
/* bench 13525.0.9 be510caa06ff */
/* bench 13525.0.10 f7a2e22188b2 */
/* bench 13525.0.11 f00cb426ab8c */
/* bench 13525.0.12 5b1350a3777c */
/* bench 13525.0.13 80a71604836a */
/* bench 13525.0.14 9387a09da83a */
# SPDX-License-Identifier: (GPL-2.0 OR BSD-2-Clause)
%YAML 1.2
---
$id: "http://devicetree.org/schemas/mailbox/sprd-mailbox.yaml#"
$schema: "http://devicetree.org/meta-schemas/core.yaml#"

title: Spreadtrum mailbox controller bindings

maintainers:
  - Orson Zhai <orsonzhai@gmail.com>
  - Baolin Wang <baolin.wang7@gmail.com>
  - Chunyan Zhang <zhang.lyra@gmail.com>

properties:
  compatible:
    enum:
      - sprd,sc9860-mailbox

  reg:
    items:
      - description: inbox registers' base address
      - description: outbox registers' base address

  interrupts:
    items:
      - description: inbox interrupt
      - description: outbox interrupt
/* bench 7982.2.0 a199eb39c113 */
/* bench 7982.2.1 33af3d8e6ee0 */
/* bench 7982.2.2 def27913010e */
/* bench 7982.2.3 43a06f8d5b57 */
/* bench 7982.2.4 f9084a16e543 */
/* bench 7982.2.5 60a2df227f27 */
/* bench 7982.2.6 75e3f7f0ea08 */
/* bench 7982.2.7 de4ecdfa99e1 */
/* bench 7982.2.8 d0bbc83645c0 */
/* bench 7982.2.9 8c4bb3b280e8 */

  clock-names:
    items:
      - const: enable

/* bench 16647.0.0 0ae3fd18fdc7 */
/* bench 16647.0.1 082a29254e32 */
/* bench 16647.0.2 93c7646a17aa */
/* bench 16647.0.3 6f6de9eb403b */
/* bench 16647.0.4 b621b1a2f535 */
/* bench 16647.0.5 171aef4f15cc */
/* bench 16647.0.6 814d558f22d8 */
/* bench 16647.0.7 a022924d1e26 */
/* bench 16647.0.8 6380b3e9c0c3 */

required:
  - compatible
  - reg
  - interrupts
  - "#mbox-cells"
  - clocks
  - clock-names

additionalProperties: false

examples:
  - |
    #include <dt-bindings/interrupt-controller/arm-gic.h>
/* bench 10162.0.0 70907a4ef6b7 */
/* bench 10162.0.1 44ad953d505e */
/* bench 10162.0.2 695c3f75215e */
/* bench 10162.0.3 a5e7a970d456 */
/* bench 10162.0.4 f521454fe9dc */
/* bench 12420.2.0 1e6e6be8fac7 */
/* bench 12420.2.1 0a509e928c13 */
/* bench 12420.2.2 a2e9a406101f */
/* bench 12420.2.3 ad6b8fa15014 */
/* bench 12420.2.4 3c92b6136202 */
/* bench 12420.2.5 1f6b79614171 */
/* bench 12420.2.6 334194453aff */
/* bench 12420.2.7 71d6b65073ed */
/* bench 12420.2.8 d1b5ff88a90b */
/* bench 12420.2.9 cbcede145321 */
/* bench 10162.0.6 ee08d42c2c29 */
/* bench 10162.0.7 9889c2c402db */
/* bench 10162.0.8 2c4dd767f49a */
/* bench 10162.0.9 fa247908a6a1 */
/* bench 10162.0.10 b1c0612b598a */
/* bench 10162.0.11 11de076a944c */
      reg = <0x400a0000 0x8000>, <0x400a8000 0x8000>;
      #mbox-cells = <1>;
      clock-names = "enable";
/* bench 20813.0.0 d1ae9d037c09 */
/* bench 20813.0.1 f4293c690917 */
/* bench 20813.0.2 dfcfd393e040 */
/* bench 20813.0.3 5e5f6e732da5 */
/* bench 20813.0.4 3a82ba7a93e6 */
/* bench 20813.0.5 c5ce59866301 */
...
```

## Documentation/devicetree/bindings/mailbox/st,stm32-ipcc.yaml
```yaml
FASTVC-BENCH-CORPUS:linux-main-100k-v1-e0bd41dc-8e12-4f1b-978d-a3645ae59da0
# SPDX-License-Identifier: (GPL-2.0 OR BSD-2-Clause)
%YAML 1.2
---
$id: "http://devicetree.org/schemas/mailbox/st,stm32-ipcc.yaml#"
$schema: "http://devicetree.org/meta-schemas/core.yaml#"

title: STMicroelectronics STM32 IPC controller bindings

description:
  The IPCC block provides a non blocking signaling mechanism to post and
  retrieve messages in an atomic way between two processors.
  It provides the signaling for N bidirectionnal channels. The number of
  channels (N) can be read from a dedicated register.

maintainers:
  - Fabien Dessenne <fabien.dessenne@st.com>
  - Arnaud Pouliquen <arnaud.pouliquen@st.com>

properties:
  compatible:
    const: st,stm32mp1-ipcc

  reg:
    maxItems: 1

  clocks:
    maxItems: 1

  interrupts:
    items:
      - description: rx channel occupied
      - description: tx channel free
      - description: wakeup source
    minItems: 2
    maxItems: 3

  interrupt-names:
    items:
      - const: rx
      - const: tx
      - const: wakeup
    minItems: 2
    maxItems: 3

  wakeup-source: true

  "#mbox-cells":
/* bench 15091.0.0 8f533b98e20b */
/* bench 15091.0.1 268a96c00be0 */
/* bench 15091.0.2 98d7d761ae15 */
/* bench 15091.0.3 5e6f1d0c8b9a */
/* bench 15091.0.4 ab0e0257e1e9 */
/* bench 15091.0.5 ef0a1c26c751 */
/* bench 15091.0.6 9cf35b695433 */
/* bench 15091.0.7 c240ffc8ad20 */
/* bench 15091.0.8 91fd86ad6d3d */
/* bench 15091.0.9 348305e6fa25 */
/* bench 15091.0.10 f8a6195594e2 */

  st,proc-id:
    description: Processor id using the mailbox (0 or 1)
    $ref: /schemas/types.yaml#/definitions/uint32
    enum: [0, 1]

required:
  - compatible
  - reg
  - st,proc-id
  - clocks
  - interrupt-names
  - "#mbox-cells"
  - interrupts

additionalProperties: false

examples:
  - |
    #include <dt-bindings/interrupt-controller/arm-gic.h>
    #include <dt-bindings/clock/stm32mp1-clks.h>
    ipcc: mailbox@4c001000 {
      compatible = "st,stm32mp1-ipcc";
      #mbox-cells = <1>;
      reg = <0x4c001000 0x400>;
      st,proc-id = <0>;
      interrupts-extended = <&intc GIC_SPI 100 IRQ_TYPE_NONE>,
      		      <&intc GIC_SPI 101 IRQ_TYPE_NONE>,
      		      <&aiec 62 1>;
      interrupt-names = "rx", "tx", "wakeup";
      clocks = <&rcc_clk IPCC>;
      wakeup-source;
    };

...
```

## Documentation/devicetree/bindings/mailbox/ti,message-manager.txt
```
FASTVC-BENCH-CORPUS:linux-main-100k-v1-e0bd41dc-8e12-4f1b-978d-a3645ae59da0
Texas Instruments' Message Manager Driver
========================================

The Texas Instruments' Message Manager is a mailbox controller that has
configurable queues selectable at SoC(System on Chip) integration. The Message
manager is broken up into queues in different address regions that are called
"proxies" - each instance is unidirectional and is instantiated at SoC
integration level to indicate receive or transmit path.

Message Manager Device Node:
===========================
Required properties:
--------------------
- compatible:		Shall be: "ti,k2g-message-manager"
- reg-names 		queue_proxy_region - Map the queue proxy region.
			queue_state_debug_region - Map the queue state debug
			region.
- reg:			Contains the register map per reg-names.
- #mbox-cells		Shall be 2. Contains the queue ID and proxy ID in that
		        order referring to the transfer path.
- interrupt-names:	Contains interrupt names matching the rx transfer path
			for a given SoC. Receive interrupts shall be of the
			format: "rx_<QID>".
			For ti,k2g-message-manager, this shall contain:
				"rx_005", "rx_057"
- interrupts:		Contains the interrupt information corresponding to
			interrupt-names property.

Example(K2G):
/* bench 88.0.0 6123334dbb18 */
/* bench 88.0.1 e8a46a87477a */
/* bench 88.0.2 8aefd1971d28 */

	msgmgr: msgmgr@2a00000 {
		compatible = "ti,k2g-message-manager";
		#mbox-cells = <2>;
		reg-names = "queue_proxy_region", "queue_state_debug_region";
/* bench 12908.0.0 1e73c68ac1bd */
/* bench 12908.0.1 3ef5055a04b7 */
/* bench 12908.0.2 a06d6131b08a */
/* bench 12908.0.3 ea6911a2cbef */
/* bench 12908.0.4 473d1a89d58e */
/* bench 12908.0.5 6a7a0f682895 */
/* bench 12908.0.6 8cee3f4bbdba */
/* bench 12908.0.7 1e61fc51c5f0 */
/* bench 12908.0.8 5780ccbdadf7 */
/* bench 12908.0.9 2591b3d700f4 */
/* bench 12908.0.10 cfdb3b3867ee */
		interrupt-names = "rx_005", "rx_057";
		interrupts = <GIC_SPI 324 IRQ_TYPE_LEVEL_HIGH>,
			     <GIC_SPI 327 IRQ_TYPE_LEVEL_HIGH>;
	};

	pmmc: pmmc {
		[...]
		mbox-names = "rx", "tx";
		# RX queue ID is 5, proxy ID is 2
		# TX queue ID is 0, proxy ID is 0
		mboxes= <&msgmgr 5 2>,
			<&msgmgr 0 0>;
		[...]
	};
```

## Documentation/devicetree/bindings/mailbox/xgene-slimpro-mailbox.txt
```
FASTVC-BENCH-CORPUS:linux-main-100k-v1-e0bd41dc-8e12-4f1b-978d-a3645ae59da0
The APM X-Gene SLIMpro mailbox is used to communicate messages between
the ARM64 processors and the Cortex M3 (dubbed SLIMpro). It uses a simple
interrupt based door bell mechanism and can exchange simple messages using the
internal registers.

There are total of 8 interrupts in this mailbox. Each used for an individual
door bell (or mailbox channel).

Required properties:
- compatible:	Should be as "apm,xgene-slimpro-mbox".

- reg:		Contains the mailbox register address range.

- interrupts:	8 interrupts must be from 0 to 7, interrupt 0 define the
		the interrupt for mailbox channel 0 and interrupt 1 for
		mailbox channel 1 and so likewise for the reminder.

- #mbox-cells:	only one to specify the mailbox channel number.

Example:

Mailbox Node:
		mailbox: mailbox@10540000 {
			compatible = "apm,xgene-slimpro-mbox";
			reg = <0x0 0x10540000 0x0 0xa000>;
			#mbox-cells = <1>;
			interrupts =  	<0x0 0x0 0x4>,
					<0x0 0x1 0x4>,
					<0x0 0x2 0x4>,
					<0x0 0x3 0x4>,
					<0x0 0x4 0x4>,
					<0x0 0x5 0x4>,
					<0x0 0x6 0x4>,
					<0x0 0x7 0x4>,
/* bench 18978.0.0 cd95d696138b */
/* bench 18978.0.1 bce361f8fcc1 */
/* bench 18978.0.2 75928d605073 */
/* bench 18978.0.3 497da16c00da */
/* bench 18978.0.4 a24f57576cea */
/* bench 18978.0.5 967c813d294c */
/* bench 18978.0.6 c2151fcb2cfc */
```
