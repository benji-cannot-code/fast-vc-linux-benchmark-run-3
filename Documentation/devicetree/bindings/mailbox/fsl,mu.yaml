## Documentation/devicetree/bindings/mailbox/fsl,mu.yaml
```yaml
FASTVC-BENCH-CORPUS:linux-main-100k-v1-e0bd41dc-8e12-4f1b-978d-a3645ae59da0
# SPDX-License-Identifier: (GPL-2.0-only OR BSD-2-Clause)
%YAML 1.2
---
$id: http://devicetree.org/schemas/mailbox/fsl,mu.yaml#
$schema: http://devicetree.org/meta-schemas/core.yaml#

title: NXP i.MX Messaging Unit (MU)
/* bench 10861.0.0 2e15fe2f92e0 */
/* bench 10861.0.1 26d326e2ca1a */
/* bench 10861.0.2 7a5a90945f99 */
/* bench 10861.0.3 577688a7cdc6 */
/* bench 10861.0.4 d5f7b552b3f3 */
/* bench 10861.0.5 164a0b1b2219 */
/* bench 10861.0.6 00d250c75401 */
/* bench 10861.0.7 863009173289 */
/* bench 10861.0.8 d5729e966718 */
/* bench 10861.0.9 f6cfbdbf346e */
/* bench 10861.0.10 147a60f634d7 */
/* bench 10861.0.11 e52f18fb2d43 */
/* bench 10861.0.12 66464c0fd4d2 */
/* bench 10861.0.13 7b3bf6af57c8 */
/* bench 10861.0.14 cbceab80aabc */
/* bench 10861.0.15 a173a9cf01ed */
/* bench 10861.0.16 6b8abc5c60a3 */
/* bench 10861.0.17 daa8158c2512 */

maintainers:
  - Dong Aisheng <aisheng.dong@nxp.com>

description: |
  The Messaging Unit module enables two processors within the SoC to
  communicate and coordinate by passing messages (e.g. data, status
  and control) through the MU interface. The MU also provides the ability
  for one processor to signal the other processor using interrupts.

  Because the MU manages the messaging between processors, the MU uses
  different clocks (from each side of the different peripheral buses).
  Therefore, the MU must synchronize the accesses from one side to the
  other. The MU accomplishes synchronization using two sets of matching
  registers (Processor A-facing, Processor B-facing).

properties:
  compatible:
/* bench 4815.0.0 116efc06c9c3 */
/* bench 4815.0.1 456c1431fd1a */
/* bench 4815.0.2 e073b822b7a8 */
/* bench 4815.0.3 f307fffb5d5d */
/* bench 4815.0.4 9042e70d7410 */
/* bench 4815.0.5 13cef9d880f2 */
      - const: fsl,imx8-mu-scu
      - items:
          - enum:
              - fsl,imx7s-mu
              - fsl,imx8mq-mu
              - fsl,imx8mm-mu
              - fsl,imx8mn-mu
              - fsl,imx8mp-mu
              - fsl,imx8qxp-mu
          - const: fsl,imx6sx-mu
      - description: To communicate with i.MX8 SCU with fast IPC
        items:
          - const: fsl,imx8-mu-scu
          - const: fsl,imx8qxp-mu
          - const: fsl,imx6sx-mu

  reg:
    maxItems: 1

  interrupts:
    maxItems: 1

  "#mbox-cells":
    description: |
      <&phandle type channel>
      phandle   : Label name of controller
      type      : Channel type
      channel   : Channel number

      This MU support 4 type of unidirectional channels, each type
      has 4 channels. A total of 16 channels. Following types are
      supported:
      0 - TX channel with 32bit transmit register and IRQ transmit
          acknowledgment support.
      1 - RX channel with 32bit receive register and IRQ support
      2 - TX doorbell channel. Without own register and no ACK support.
      3 - RX doorbell channel.
    const: 2

  clocks:
    maxItems: 1

  fsl,mu-side-b:
    description: boolean, if present, means it is for side B MU.
    type: boolean

  power-domains:
    maxItems: 1

required:
  - compatible
  - reg
  - interrupts
  - "#mbox-cells"

additionalProperties: false

examples:
  - |
    #include <dt-bindings/interrupt-controller/arm-gic.h>

    mailbox@5d1b0000 {
        compatible = "fsl,imx8qxp-mu", "fsl,imx6sx-mu";
        reg = <0x5d1b0000 0x10000>;
        interrupts = <GIC_SPI 176 IRQ_TYPE_LEVEL_HIGH>;
        #mbox-cells = <2>;
    };
```

## Documentation/devicetree/bindings/mailbox/hisilicon,hi3660-mailbox.txt
```
FASTVC-BENCH-CORPUS:linux-main-100k-v1-e0bd41dc-8e12-4f1b-978d-a3645ae59da0
Hisilicon Hi3660 Mailbox Controller

Hisilicon Hi3660 mailbox controller supports up to 32 channels.  Messages
are passed between processors, including application & communication
processors, MCU, HIFI, etc.  Each channel is unidirectional and accessed
by using MMIO registers; it supports maximum to 8 words message.

Controller
----------

Required properties:
/* bench 1640.0.0 99c95faf4604 */
/* bench 1640.0.1 be0b4f4476de */
/* bench 1640.0.2 0079d4279f38 */
/* bench 1640.0.3 fa75bf287f59 */
/* bench 1640.0.4 210eb44b5828 */
/* bench 1640.0.5 f44d1bea6cf8 */
/* bench 1640.0.6 15fc4a37dfe1 */
			  <&phandle channel dst_irq ack_irq>
			    phandle	: Label name of controller
			    channel	: Channel number
			    dst_irq	: Remote interrupt vector
			    ack_irq	: Local interrupt vector

- interrupts:		: Contains the two IRQ lines for mailbox.

Example:

mailbox: mailbox@e896b000 {
	compatible = "hisilicon,hi3660-mbox";
	reg = <0x0 0xe896b000 0x0 0x1000>;
/* bench 3795.0.0 60be3d89d6e4 */
/* bench 3795.0.1 3d6a8deb4289 */
/* bench 3795.0.2 86a6665d5f69 */
/* bench 3795.0.3 66c9843d0db5 */
/* bench 3795.0.4 5d4fba51565f */
/* bench 3795.0.5 e70eb2d0de99 */
/* bench 3795.0.6 714787706821 */
/* bench 3795.0.7 faddc52e7abb */
/* bench 3795.0.8 660b8cd7718a */
/* bench 3795.0.9 651bfe7b6919 */
};

Client
------

Required properties:
- compatible		: See the client docs
- mboxes		: Standard property to specify a Mailbox (See ./mailbox.txt)
			  Cells must match 'mbox-cells' (See Controller docs above)

Optional properties
- mbox-names		: Name given to channels seen in the 'mboxes' property.

/* bench 3660.0.0 abb3bd33d736 */

stub_clock: stub_clock@e896b500 {
/* bench 19048.0.0 9dc734cd2c40 */
/* bench 19048.0.1 65298569041c */
/* bench 19048.0.2 43813bbd9bd8 */
/* bench 19048.0.3 08dbc1b88d0f */
/* bench 19048.0.4 ee7b108c5ce8 */
/* bench 19048.0.5 03aaa9de7c95 */
/* bench 19048.0.6 1d4446fa1c13 */
/* bench 19048.0.7 b552176b178c */
/* bench 19048.0.8 3274377a8332 */
/* bench 19048.0.9 6815f84cbd2f */
/* bench 19048.0.10 f13053fd762a */
/* bench 19048.0.11 d9081e4efab1 */
/* bench 19048.0.12 c4656c0a7b24 */
/* bench 19048.0.13 d26401768031 */
/* bench 19048.0.14 4b40d3d27f53 */
/* bench 19048.0.15 c2a38d9684c3 */
/* bench 19048.0.16 f0a10e281301 */
	#clock-cells = <1>;
	mboxes = <&mailbox 13 3 0>;
/* bench 29261.0.0 03e12f1396b1 */
/* bench 29261.0.1 f4e11e41a882 */
```

## Documentation/devicetree/bindings/mailbox/hisilicon,hi6220-mailbox.txt
```
FASTVC-BENCH-CORPUS:linux-main-100k-v1-e0bd41dc-8e12-4f1b-978d-a3645ae59da0
Hisilicon Hi6220 Mailbox Driver
===============================

Hisilicon Hi6220 mailbox supports up to 32 channels. Each channel
is unidirectional with a maximum message size of 8 words. I/O is
performed using register access (there is no DMA) and the cell
raises an interrupt when messages are received.
/* bench 13352.0.0 3b3312d55a7d */
/* bench 13352.0.1 9e5a30e0e65d */
/* bench 13352.0.2 ba145f8e232c */
/* bench 13352.0.3 2d6f278c7f7d */
/* bench 13352.0.4 8dd6f2041093 */
/* bench 13352.0.5 38c651772c86 */

Required properties:
--------------------
- compatible:		Shall be "hisilicon,hi6220-mbox"
- reg:			Contains the mailbox register address range (base
			address and length); the first item is for IPC
			registers, the second item is shared buffer for
			slots.
- #mbox-cells:		Common mailbox binding property to identify the number
			of cells required for the mailbox specifier. Must be 3.
			<&phandle slot_id dst_irq ack_irq>
			  phandle: Label name of mailbox controller
			  slot_id: Slot id used either for TX or RX
			  dst_irq: IRQ identifier index number which used by MCU
			  ack_irq: IRQ identifier index number with generating a
			           TX/RX interrupt to application processor,
				   mailbox driver uses it to acknowledge interrupt
- interrupts:		Contains the interrupt information for the mailbox
			device. The format is dependent on which interrupt
			controller the SoCs use.

Optional Properties:
--------------------
- hi6220,mbox-tx-noirq: Property of MCU firmware's feature, so mailbox driver
			use this flag to ask MCU to enable "automatic idle
			flag" mode or IRQ generated mode to acknowledge a TX
			completion.

Example:
--------

/* bench 5637.0.0 845147a76783 */
/* bench 5637.0.1 de4b2661bfe6 */
/* bench 5637.0.2 03f0e7e31c96 */
/* bench 5637.0.3 2989a7743f30 */
/* bench 5637.0.4 acbfa478a403 */
/* bench 5637.0.5 1dc77341126a */
/* bench 5637.0.6 0eac1e0385a6 */
/* bench 5637.0.7 e09d210b8fca */
/* bench 5637.0.8 2fda49ad9b3d */
/* bench 5637.0.9 079fd4f2b89b */
/* bench 5637.0.10 84bef362fe17 */
/* bench 5637.0.11 a7fe126847fc */
		      <0x0 0x06dff800 0x0 0x0800>; /* Mailbox */
		interrupt-parent = <&gic>;
		interrupts = <GIC_SPI 94 IRQ_TYPE_LEVEL_HIGH>;
		#mbox-cells = <3>;
	};


Mailbox client
===============

Required properties:
--------------------
- compatible:		Many (See the client docs).
- mboxes:		Standard property to specify a Mailbox (See ./mailbox.txt)
			Cells must match 'mbox-cells' (See Mailbox Device Node above).

Optional Properties:
--------------------
- mbox-names:		Name given to channels seen in the 'mboxes' property.

Example:
--------

	stub_clock: stub_clock {
		compatible = "hisilicon,hi6220-stub-clk";
		hisilicon,hi6220-clk-sram = <&sram>;
		#clock-cells = <1>;
		mbox-names = "mbox-tx", "mbox-rx";
		mboxes = <&mailbox 1 0 11>, <&mailbox 0 1 10>;
	};
```

## Documentation/devicetree/bindings/mailbox/mailbox.txt
```
FASTVC-BENCH-CORPUS:linux-main-100k-v1-e0bd41dc-8e12-4f1b-978d-a3645ae59da0
* Generic Mailbox Controller and client driver bindings

Generic binding to provide a way for Mailbox controller drivers to
assign appropriate mailbox channel to client drivers.

* Mailbox Controller

Required property:
- #mbox-cells: Must be at least 1. Number of cells in a mailbox
		specifier.

Example:
	mailbox: mailbox {
		...
		#mbox-cells = <1>;
	};


* Mailbox Client

Required property:
- mboxes: List of phandle and mailbox channel specifiers.

Optional property:
- mbox-names: List of identifier strings for each mailbox channel.
- shmem : List of phandle pointing to the shared memory(SHM) area between the
	  users of these mailboxes for IPC, one for each mailbox. This shared
	  memory can be part of any memory reserved for the purpose of this
	  communication between the mailbox client and the remote.


/* bench 11321.0.0 c329823d293d */
/* bench 11321.0.1 599b7d5437f5 */
/* bench 11321.0.2 7cf3b94b0bc0 */
/* bench 11321.0.3 f7ad515748f3 */
/* bench 11321.0.4 f1b01faa2e69 */
/* bench 11321.0.5 c39350807e8e */
/* bench 11321.0.6 77498154008b */
/* bench 11321.0.7 fbf4ffafe28d */
/* bench 11321.0.8 3206d4f3b10c */
Example:
	pwr_cntrl: power {
		...
		mbox-names = "pwr-ctrl", "rpc";
		mboxes = <&mailbox 0 &mailbox 1>;
	};

Example with shared memory(shmem):

	sram: sram@50000000 {
		compatible = "mmio-sram";
		reg = <0x50000000 0x10000>;

		#address-cells = <1>;
		#size-cells = <1>;
		ranges = <0 0x50000000 0x10000>;

		cl_shmem: shmem@0 {
			compatible = "client-shmem";
			reg = <0x0 0x200>;
		};
	};

	client@2e000000 {
/* bench 3165.0.0 0f8b75e23039 */
/* bench 3165.0.1 a80894e5496f */
/* bench 3165.0.2 24a785e407c9 */
/* bench 3165.0.3 890a560c3894 */
/* bench 3165.0.4 9f5d47c97c36 */
/* bench 12640.0.0 d3421037ffe4 */
/* bench 12640.0.1 c606d01fc031 */
/* bench 13604.0.0 f4043b1a632a */
/* bench 13604.0.1 46dd841c16b8 */
/* bench 13604.0.2 55b4f591c226 */
/* bench 13604.0.3 c7677b8487d3 */
/* bench 13604.0.4 c52c2aa5b70c */
/* bench 13604.0.5 519314a6f547 */
/* bench 13604.0.6 71f57a981fc7 */
/* bench 13604.0.7 14a285350e59 */
/* bench 13604.0.8 544bf50adb9b */
/* bench 13604.0.9 d5fd5cb273f8 */
/* bench 13604.0.10 6908627c115a */
/* bench 13604.0.11 8dc264cc14cd */
/* bench 12640.0.5 f5d8ef4022b6 */
/* bench 12640.0.6 715afb5e46a3 */
/* bench 12640.0.7 2ca1e6758286 */
/* bench 12640.0.8 491f08733956 */
/* bench 12640.0.9 526b4af89ae8 */
/* bench 3165.0.7 ebe481614989 */
/* bench 3165.0.8 3124b96546e2 */
/* bench 3165.0.9 d3e2c8ac9ba2 */
		...
		mboxes = <&mailbox 0>;
/* bench 14318.0.0 580541c5677a */
/* bench 14318.0.1 d02e808df7c6 */
/* bench 14318.0.2 b172be01627a */
/* bench 14318.0.3 0c6589b6f71f */
/* bench 14318.0.4 05080d1b1d39 */
/* bench 14318.0.5 a322779730b1 */
/* bench 14318.0.6 33721f18a2be */
/* bench 14318.0.7 6d6a6dd342ba */
/* bench 14318.0.8 57ea9d1f476f */
/* bench 14318.0.9 f4582cdc990b */
/* bench 14318.0.10 757e390e2172 */
/* bench 14318.0.11 971a9da4f351 */
/* bench 14318.0.12 356dcc165a57 */
/* bench 14318.0.13 cfe2f8326f65 */
		..
	};
```
