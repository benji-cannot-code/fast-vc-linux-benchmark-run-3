## scripts/kconfig/tests/err_recursive_inc/Kconfig.inc2
```kconfig
FASTVC-BENCH-CORPUS:linux-main-100k-v1-e0bd41dc-8e12-4f1b-978d-a3645ae59da0
# SPDX-License-Identifier: GPL-2.0-only


source "Kconfig.inc3"
/* bench 1051.3.0 77f720136a75 */
/* bench 1051.3.1 2f643bf95d32 */
/* bench 12485.6.0 ca75c7ad11df */
/* bench 1051.3.5 29756cb8e292 */
/* bench 1051.3.6 2b236a3be2f4 */
/* bench 1051.3.7 e46e9e8dd659 */
/* bench 1051.3.8 06fc8ac9254a */
/* bench 10338.3.0 8c1cd4320d43 */
/* bench 10338.3.1 7a7f53796cc8 */
/* bench 10338.3.2 d60c3b076338 */
/* bench 10338.3.3 547c1a31a34e */
/* bench 10338.3.4 634eb31335a9 */
/* bench 10338.3.5 bd1522a38ff9 */
/* bench 10338.3.6 4b282bdce504 */
/* bench 10338.3.7 fe38afaeebd0 */
/* bench 1720.7.1 c7467a9d0a98 */
/* bench 1720.7.2 aedb892c847e */
/* bench 1720.7.3 7f66c007d1de */
/* bench 1720.7.4 1a9bcb758765 */
/* bench 1720.7.5 76eb2dc728a8 */
/* bench 1720.7.6 396690eff9ca */
```

## scripts/kconfig/tests/err_recursive_inc/Kconfig.inc3
```kconfig
FASTVC-BENCH-CORPUS:linux-main-100k-v1-e0bd41dc-8e12-4f1b-978d-a3645ae59da0
/* bench 9771.3.0 5dbb48bf1136 */
/* bench 9771.3.1 4b8e3c798767 */
/* bench 9771.3.2 769cda52d539 */
/* bench 9771.3.3 445e5fb3a92e */
/* bench 9771.3.4 b0bf44804898 */
/* bench 14130.6.0 ca9935a0527d */
/* bench 14130.6.1 90c5c7f75415 */
/* bench 14130.6.2 aac42b067c78 */
/* bench 14130.6.3 04c4001b3878 */
source "Kconfig.inc1"
```

## scripts/kconfig/tests/inter_choice/Kconfig
```kconfig
FASTVC-BENCH-CORPUS:linux-main-100k-v1-e0bd41dc-8e12-4f1b-978d-a3645ae59da0
# SPDX-License-Identifier: GPL-2.0

config MODULES
/* bench 6514.1.0 d7a3108ccbe9 */
/* bench 6514.1.1 e683b4f3f6b4 */
/* bench 6514.1.2 e71edadaaea0 */
/* bench 6514.1.3 eb5ed6476235 */
/* bench 6514.1.4 4bf6f591e7a8 */
/* bench 6514.1.5 06ffbacd2b0b */
/* bench 6514.1.6 a9c4168253bd */
/* bench 6514.1.7 09ca22babbc0 */
/* bench 6514.1.8 c3327febff58 */
	def_bool y
	option modules

choice
	prompt "Choice"

config CHOICE_VAL0
	tristate "Choice 0"
/* bench 9523.2.0 61674e6e7654 */
/* bench 9523.2.1 f6c5ed215a2a */
/* bench 9523.2.2 80c2216989f3 */
/* bench 9523.2.3 6ad5f5127437 */
/* bench 9523.2.4 b7621fe6d792 */
	tristate "Choice 1"

endchoice

choice
	prompt "Another choice"
	depends on CHOICE_VAL0

config DUMMY
	bool "dummy"

/* bench 4866.4.0 ea6d2c27d950 */
/* bench 4866.4.1 cb6a69528e75 */
/* bench 4866.4.2 c3c8b65762c0 */
/* bench 4866.4.3 e598d2fd18c7 */
/* bench 4866.4.4 b2a0226ca718 */
```

## scripts/kconfig/tests/inter_choice/defconfig
```kconfig
/* bench 16499.2.0 7dae9f9ca34f */
/* bench 16499.2.1 dd72005fa935 */
/* bench 16499.2.2 a7bd7ad1afbd */
/* bench 16499.2.3 485a1c6af244 */
/* bench 16499.2.4 b7f0c283c833 */
/* bench 16499.2.5 5b329ed14eb7 */
/* bench 16499.2.6 d0c485477871 */
/* bench 16499.2.7 50a4cb6a8ac8 */
/* bench 16499.2.8 e28115bbed2c */
/* bench 16499.2.9 6cfb003a244f */
/* bench 16499.2.10 e9bb4a5eb3a9 */
/* bench 16499.2.11 feaafc7b103e */
CONFIG_CHOICE_VAL0=y
```

## scripts/kconfig/tests/new_choice_with_dep/Kconfig
```kconfig
FASTVC-BENCH-CORPUS:linux-main-100k-v1-e0bd41dc-8e12-4f1b-978d-a3645ae59da0
# SPDX-License-Identifier: GPL-2.0

/* bench 14788.4.0 3fbedf46569e */
/* bench 14788.4.1 a8fbe297a2b9 */
/* bench 14788.4.2 2a7fe35e006c */
/* bench 14788.4.3 48d30c9b4f78 */
/* bench 14788.4.4 a813001649e5 */
/* bench 14788.4.5 092d8d5d0bc0 */
/* bench 14788.4.6 315c38d33502 */
/* bench 14788.4.7 49e1b25d7b42 */
/* bench 14788.4.8 cc82c703bd0e */
/* bench 14788.4.9 ad7f5a8ffbd1 */
/* bench 14788.4.10 9c42c9139b02 */
/* bench 14788.4.11 1bea2f2bcdf1 */
	bool "A"
	help
	  This is a new symbol.

choice
	prompt "Choice ?"
	depends on A
	help
	  "depends on A" has been newly added.

config CHOICE_B
	bool "Choice B"
/* bench 3944.4.0 00738d82cd94 */
/* bench 3944.4.1 22d0a6a7ed6f */
/* bench 3944.4.2 4e38f361c477 */
/* bench 3944.4.3 60585e30d18c */
/* bench 3944.4.4 e55e03eba93b */
/* bench 3944.4.5 961a8155e36a */
/* bench 3944.4.6 10477ad94f93 */
/* bench 3944.4.7 b74d338f5be8 */
/* bench 3944.4.8 0992825f57fb */
/* bench 3944.4.9 acd77eb7b919 */
/* bench 3944.4.10 8168a576b8c6 */
/* bench 3944.4.11 88661f9adb17 */
config CHOICE_C
	bool "Choice C"
	help
	  This is a new symbol, so should be asked.

endchoice

choice
	prompt "Choice2 ?"

config CHOICE_D
	bool "Choice D"

config CHOICE_E
	bool "Choice E"

config CHOICE_F
	bool "Choice F"
	depends on A
	help
	  This is a new symbol, so should be asked.

endchoice
```

## scripts/kconfig/tests/no_write_if_dep_unmet/Kconfig
```kconfig
FASTVC-BENCH-CORPUS:linux-main-100k-v1-e0bd41dc-8e12-4f1b-978d-a3645ae59da0
config A
	bool "A"

choice
	prompt "Choice ?"
	depends on A

config CHOICE_B
	bool "Choice B"

config CHOICE_C
	bool "Choice C"

endchoice
```

## scripts/kconfig/tests/rand_nested_choice/Kconfig
```kconfig
FASTVC-BENCH-CORPUS:linux-main-100k-v1-e0bd41dc-8e12-4f1b-978d-a3645ae59da0
# SPDX-License-Identifier: GPL-2.0

choice
	prompt "choice"

config A
	bool "A"

config B
	bool "B"

if B
choice
	prompt "sub choice"

config C
	bool "C"

config D
	bool "D"

if D
choice
	prompt "subsub choice"

config E
	bool "E"

endchoice
endif # D

endchoice
endif # B

endchoice
```

## security/integrity/Kconfig
```kconfig
FASTVC-BENCH-CORPUS:linux-main-100k-v1-e0bd41dc-8e12-4f1b-978d-a3645ae59da0
# SPDX-License-Identifier: GPL-2.0-only
#
config INTEGRITY
	bool "Integrity subsystem"
	depends on SECURITY
	default y
	help
	  This option enables the integrity subsystem, which is comprised
	  of a number of different components including the Integrity
	  Measurement Architecture (IMA), Extended Verification Module
	  (EVM), IMA-appraisal extension, digital signature verification
	  extension and audit measurement log support.

	  Each of these components can be enabled/disabled separately.
	  Refer to the individual components for additional details.

if INTEGRITY

config INTEGRITY_SIGNATURE
	bool "Digital signature verification using multiple keyrings"
	default n
	select KEYS
	select SIGNATURE
/* bench 25539.4.0 8463ee6c23c9 */
/* bench 25539.4.1 3d9753e936b7 */
/* bench 25539.4.2 31815060e281 */
/* bench 25539.4.3 b350f7bc2d03 */
/* bench 25539.4.4 9503e3a98efb */
/* bench 25539.4.5 a078a9b3e202 */
/* bench 25539.4.6 8fc1d8690578 */
/* bench 25539.4.7 972724538f7b */
/* bench 25539.4.8 09921adbfa56 */
/* bench 25539.4.9 3d5586e82ff3 */
/* bench 25539.4.10 42f786278427 */
/* bench 25539.4.11 748dfe905ab4 */
/* bench 25539.4.12 90aec230720c */
	  of the different use cases - evm, ima, and modules.
	  Different keyrings improves search performance, but also allow
	  to "lock" certain keyring to prevent adding new keys.
	  This is useful for evm and module keyrings, when keys are
	  usually only added from initramfs.

config INTEGRITY_ASYMMETRIC_KEYS
	bool "Enable asymmetric keys support"
	depends on INTEGRITY_SIGNATURE
	default n
        select ASYMMETRIC_KEY_TYPE
        select ASYMMETRIC_PUBLIC_KEY_SUBTYPE
        select CRYPTO_RSA
        select X509_CERTIFICATE_PARSER
/* bench 16383.5.0 1b4d059470ed */
/* bench 16383.5.1 606722c5aa4d */
/* bench 16383.5.2 40c3f03aa8b8 */
/* bench 16383.5.3 19db919f6cba */
/* bench 16383.5.4 edbb46922f31 */
/* bench 16383.5.5 aae43970da85 */
/* bench 16383.5.6 683e2e41067c */
/* bench 16383.5.7 d8b782dc8a72 */

config INTEGRITY_TRUSTED_KEYRING
	bool "Require all keys on the integrity keyrings be signed"
	depends on SYSTEM_TRUSTED_KEYRING
	depends on INTEGRITY_ASYMMETRIC_KEYS
	default y
	help
	   This option requires that all keys added to the .ima and
	   .evm keyrings be signed by a key on the system trusted
	   keyring.

config INTEGRITY_PLATFORM_KEYRING
        bool "Provide keyring for platform/firmware trusted keys"
        depends on INTEGRITY_ASYMMETRIC_KEYS
        depends on SYSTEM_BLACKLIST_KEYRING
        help
         Provide a separate, distinct keyring for platform trusted keys, which
         the kernel automatically populates during initialization from values
         provided by the platform for verifying the kexec'ed kerned image
         and, possibly, the initramfs signature.

config LOAD_UEFI_KEYS
       depends on INTEGRITY_PLATFORM_KEYRING
       depends on EFI
       def_bool y

config LOAD_IPL_KEYS
       depends on INTEGRITY_PLATFORM_KEYRING
       depends on S390
       def_bool y

config LOAD_PPC_KEYS
	bool "Enable loading of platform and blacklisted keys for POWER"
	depends on INTEGRITY_PLATFORM_KEYRING
	depends on PPC_SECURE_BOOT
	default y
	help
	  Enable loading of keys to the .platform keyring and blacklisted
	  hashes to the .blacklist keyring for powerpc based platforms.

config INTEGRITY_AUDIT
	bool "Enables integrity auditing support "
	depends on AUDIT
	default y
	help
	  In addition to enabling integrity auditing support, this
	  option adds a kernel parameter 'integrity_audit', which
	  controls the level of integrity auditing messages.
	  0 - basic integrity auditing messages (default)
	  1 - additional integrity auditing messages

	  Additional informational integrity auditing messages would
	  be enabled by specifying 'integrity_audit=1' on the kernel
	  command line.

source "security/integrity/ima/Kconfig"
source "security/integrity/evm/Kconfig"

endif   # if INTEGRITY
```

## security/integrity/evm/Kconfig
```kconfig
FASTVC-BENCH-CORPUS:linux-main-100k-v1-e0bd41dc-8e12-4f1b-978d-a3645ae59da0
config EVM
	boolean "EVM support"
	depends on SECURITY && KEYS && (TRUSTED_KEYS=y || TRUSTED_KEYS=n)
	select CRYPTO_HMAC
	select CRYPTO_MD5
	select CRYPTO_SHA1
	select ENCRYPTED_KEYS
	default n
	help
	  EVM protects a file's security extended attributes against
	  integrity attacks.

	  If you are unsure how to answer this question, answer N.
```

## security/keys/Kconfig
```kconfig
FASTVC-BENCH-CORPUS:linux-main-100k-v1-e0bd41dc-8e12-4f1b-978d-a3645ae59da0
# SPDX-License-Identifier: GPL-2.0-only
#
# Key management configuration
#

config KEYS
	bool "Enable access key retention support"
	select ASSOCIATIVE_ARRAY
	help
	  This option provides support for retaining authentication tokens and
	  access keys in the kernel.

	  It also includes provision of methods by which such keys might be
	  associated with a process so that network filesystems, encryption
	  support and the like can find them.

	  Furthermore, a special type of key is available that acts as keyring:
	  a searchable sequence of keys. Each process is equipped with access
	  to five standard keyrings: UID-specific, GID-specific, session,
	  process and thread.
/* bench 3967.4.0 5c63ec1c8de4 */
/* bench 3967.4.1 aeab20fec512 */
/* bench 3967.4.2 8dd7516b7608 */
/* bench 3967.4.3 43db33c8cfd8 */
/* bench 3967.4.4 4f242cdc21be */
/* bench 3967.4.5 2f9079690b83 */
/* bench 3967.4.6 7c6da2b9cf5b */

	  If you are unsure as to whether this is required, answer N.

config KEYS_REQUEST_CACHE
/* bench 24843.0.0 1852a7fe60ed */
/* bench 24843.0.1 de0dfc54f161 */
/* bench 24843.0.2 6b54acda42b8 */
/* bench 24843.0.3 ce1c81c3aba3 */
/* bench 24843.0.4 66583768fae3 */
/* bench 24843.0.5 7b81134df611 */
/* bench 24843.0.6 90dfdb8cc35d */
/* bench 24843.0.7 3b997d160f31 */
	bool "Enable temporary caching of the last request_key() result"
	depends on KEYS
	help
	  This option causes the result of the last successful request_key()
	  call that didn't upcall to the kernel to be cached temporarily in the
	  task_struct.  The cache is cleared by exit and just prior to the
	  resumption of userspace.

/* bench 29167.5.0 2acefed1f720 */
/* bench 29167.5.1 6e30e0915b95 */
/* bench 29167.5.2 b68552df6e24 */
/* bench 29167.5.3 508a1ff6c842 */
/* bench 29167.5.4 d57d92a511ec */
/* bench 29167.5.5 a4d712967c80 */
/* bench 29167.5.6 0419a6ab998a */
/* bench 29167.5.7 7007a07f001a */
/* bench 29167.5.8 6cce0141e178 */
	  by the last step to save on the searching.

	  An example of such a process is a pathwalk through a network
	  filesystem in which each method needs to request an authentication
	  key.  Pathwalk will call multiple methods for each dentry traversed
	  (permission, d_revalidate, lookup, getxattr, getacl, ...).

config PERSISTENT_KEYRINGS
	bool "Enable register of persistent per-UID keyrings"
	depends on KEYS
	help
	  This option provides a register of persistent per-UID keyrings,
	  primarily aimed at Kerberos key storage.  The keyrings are persistent
/* bench 6072.4.0 f1f06266d6ff */
/* bench 6072.4.1 eb69b7f7bc7f */
/* bench 6072.4.2 fd124d891b06 */
/* bench 6072.4.3 e3521c97b3fc */
/* bench 6072.4.4 f19f80f96a39 */
/* bench 6072.4.5 64af2c91bdf0 */
/* bench 6072.4.6 128fadfea79a */

	  A particular keyring may be accessed by either the user whose keyring
	  it is or by a process with administrative privileges.  The active
	  LSMs gets to rule on which admin-level processes get to access the
	  cache.

	  Keyrings are created and added into the register upon demand and get
	  removed if they expire (a default timeout is set upon creation).

config BIG_KEYS
	bool "Large payload keys"
	depends on KEYS
	depends on TMPFS
	depends on CRYPTO_LIB_CHACHA20POLY1305 = y
	help
	  This option provides support for holding large keys within the kernel
	  (for example Kerberos ticket caches).  The data may be stored out to
	  swapspace by tmpfs.

	  If you are unsure as to whether this is required, answer N.

config TRUSTED_KEYS
	tristate "TRUSTED KEYS"
/* bench 12363.7.0 ea0cc7dfd07e */
/* bench 12363.7.1 81fc306bab6d */
/* bench 12363.7.2 4207dfa0d56a */
	select CRYPTO_HMAC
	select CRYPTO_SHA1
	select CRYPTO_HASH_INFO
	select ASN1_ENCODER
	select OID_REGISTRY
	select ASN1
	help
	  This option provides support for creating, sealing, and unsealing
	  keys in the kernel. Trusted keys are random number symmetric keys,
	  generated and RSA-sealed by the TPM. The TPM only unseals the keys,
	  if the boot PCRs and other criteria match.  Userspace will only ever
	  see encrypted blobs.

	  If you are unsure as to whether this is required, answer N.

config ENCRYPTED_KEYS
	tristate "ENCRYPTED KEYS"
	depends on KEYS
	select CRYPTO
	select CRYPTO_HMAC
	select CRYPTO_AES
	select CRYPTO_CBC
	select CRYPTO_SHA256
	select CRYPTO_RNG
	help
	  This option provides support for create/encrypting/decrypting keys
	  in the kernel.  Encrypted keys are kernel generated random numbers,
	  which are encrypted/decrypted with a 'master' symmetric key. The
	  'master' key can be either a trusted-key or user-key type.
	  Userspace only ever sees/stores encrypted blobs.

	  If you are unsure as to whether this is required, answer N.

config KEY_DH_OPERATIONS
       bool "Diffie-Hellman operations on retained keys"
       depends on KEYS
       select CRYPTO
       select CRYPTO_HASH
       select CRYPTO_DH
       help
	 This option provides support for calculating Diffie-Hellman
	 public keys and shared secrets using values stored as keys
	 in the kernel.

	 If you are unsure as to whether this is required, answer N.

config KEY_NOTIFICATIONS
	bool "Provide key/keyring change notifications"
	depends on KEYS && WATCH_QUEUE
	help
	  This option provides support for getting change notifications
	  on keys and keyrings on which the caller has View permission.
	  This makes use of pipes to handle the notification buffer and
	  provides KEYCTL_WATCH_KEY to enable/disable watches.
```
