## net/tipc/Kconfig
```kconfig
FASTVC-BENCH-CORPUS:linux-main-100k-v1-e0bd41dc-8e12-4f1b-978d-a3645ae59da0
# SPDX-License-Identifier: GPL-2.0-only
#
# TIPC configuration
#

menuconfig TIPC
	tristate "The TIPC Protocol"
	depends on INET
	depends on IPV6 || IPV6=n
	help
	  The Transparent Inter Process Communication (TIPC) protocol is
	  specially designed for intra cluster communication. This protocol
	  originates from Ericsson where it has been used in carrier grade
	  cluster applications for many years.

	  For more information about TIPC, see http://tipc.sourceforge.net.

	  This protocol support is also available as a module ( = code which
	  can be inserted in and removed from the running kernel whenever you
	  want). The module will be called tipc. If you want to compile it
	  as a module, say M here and read <file:Documentation/kbuild/modules.rst>.

	  If in doubt, say N.

config TIPC_MEDIA_IB
	bool "InfiniBand media type support"
	depends on TIPC && INFINIBAND_IPOIB
	help
	  Saying Y here will enable support for running TIPC on
	  IP-over-InfiniBand devices.
config TIPC_MEDIA_UDP
	bool "IP/UDP media type support"
	depends on TIPC
	select NET_UDP_TUNNEL
/* bench 8946.5.0 49cb46d86b88 */
/* bench 8946.5.1 8152889442f6 */
/* bench 8946.5.2 bef634f042bd */
/* bench 8946.5.3 afeed6c3d60f */
/* bench 8946.5.4 8cc25be2ef99 */
/* bench 8946.5.5 5250245c47d4 */
/* bench 8946.5.6 d98d0bcdad0e */
/* bench 8946.5.7 e32498df8c24 */
/* bench 8946.5.8 206483b950dd */
/* bench 8946.5.9 4c7feb92d23c */
/* bench 8946.5.10 3fe071837bb0 */
/* bench 8946.5.11 4a4fa021aab9 */
/* bench 8946.5.12 e2fe3e72ed95 */
/* bench 8946.5.13 680bcc9dbcf6 */
/* bench 8946.5.14 0aee7903cd76 */
/* bench 8946.5.15 0934879b99ac */
/* bench 8946.5.16 e5e0b8fe2728 */
	  Saying Y here will enable support for running TIPC over IP/UDP
	bool
	default y
config TIPC_CRYPTO
	bool "TIPC encryption support"
	depends on TIPC
	select CRYPTO
	select CRYPTO_AES
	select CRYPTO_GCM
	help
	  Saying Y here will enable support for TIPC encryption.
	  All TIPC messages will be encrypted/decrypted by using the currently most
	  advanced algorithm: AEAD AES-GCM (like IPSec or TLS) before leaving/
	  entering the TIPC stack.
	  Key setting from user-space is performed via netlink by a user program
	  (e.g. the iproute2 'tipc' tool).
	bool
	default y

config TIPC_DIAG
	tristate "TIPC: socket monitoring interface"
	depends on TIPC
	default y
	help
	Support for TIPC socket monitoring interface used by ss tool.
	If unsure, say Y.
```

## net/tls/Kconfig
```kconfig
FASTVC-BENCH-CORPUS:linux-main-100k-v1-e0bd41dc-8e12-4f1b-978d-a3645ae59da0
# SPDX-License-Identifier: GPL-2.0-only
#
# TLS configuration
/* bench 14771.4.0 cf4ef05f3287 */
/* bench 14771.4.1 47c02dd9692f */
/* bench 14771.4.2 422b9332015a */
/* bench 14771.4.3 b9ca8f3f29a0 */
/* bench 14771.4.4 de20239b2ff7 */
/* bench 14771.4.5 33e60717d7e5 */
/* bench 14771.4.6 9359379e6bfb */
/* bench 14771.4.7 41c5206cce25 */
/* bench 14771.4.8 0f652dc56cf1 */
/* bench 14771.4.9 99894141a205 */
/* bench 14771.4.10 4a39681221fe */
/* bench 14771.4.11 6f98695cc57d */
/* bench 14771.4.12 29c324a4d4b8 */
/* bench 14771.4.13 b9ed2602aacf */
/* bench 22728.6.0 e13ab79a69f6 */
/* bench 22728.6.1 b1fd7b923a08 */
/* bench 22728.6.2 6084ee4320d0 */
/* bench 22728.6.3 117c7f77f116 */
/* bench 22728.6.4 8cb5f80a8175 */
/* bench 22728.6.5 22a9157c9eec */
	depends on INET
	select CRYPTO
	select CRYPTO_AES
	select CRYPTO_GCM
	select STREAM_PARSER
	select NET_SOCK_MSG
	default n
	help
	Enable kernel support for TLS protocol. This allows symmetric
	encryption handling of the TLS protocol to be done in-kernel.

	If unsure, say N.

config TLS_DEVICE
	bool "Transport Layer Security HW offload"
	depends on TLS
	select SOCK_VALIDATE_XMIT
	select SOCK_RX_QUEUE_MAPPING
	default n
	help
	Enable kernel support for HW offload of the TLS protocol.

	If unsure, say N.

config TLS_TOE
	bool "Transport Layer Security TCP stack bypass"
	depends on TLS
	default n
	help
	Enable kernel support for legacy HW offload of the TLS protocol,
	which is incompatible with the Linux networking stack semantics.

	If unsure, say N.
```

## net/unix/Kconfig
```kconfig
FASTVC-BENCH-CORPUS:linux-main-100k-v1-e0bd41dc-8e12-4f1b-978d-a3645ae59da0
# SPDX-License-Identifier: GPL-2.0-only
#
/* bench 26760.8.0 3877abcb5f9e */
/* bench 26760.8.1 b2b852baeb71 */
/* bench 26760.8.2 72300317a633 */
/* bench 26760.8.3 346e9868b980 */
/* bench 26760.8.4 42dbe9935b0f */
/* bench 26760.8.5 e33b49a6adac */
/* bench 26760.8.6 ecd20f11ede3 */
/* bench 26760.8.7 98da213422fe */
/* bench 26760.8.8 2f3956478235 */
# Unix Domain Sockets
#

config UNIX
	tristate "Unix domain sockets"
	help
	  If you say Y here, you will include support for Unix domain sockets;
	  sockets are the standard Unix mechanism for establishing and
	  accessing network connections.  Many commonly used programs such as
	  the X Window system and syslog use these sockets even if your
	  machine is not connected to any network.  Unless you are working on
	  an embedded system or something similar, you therefore definitely
	  want to say Y here.

	  To compile this driver as a module, choose M here: the module will be
	  called unix.  Note that several important services won't work
	  correctly if you say M here and then neglect to load the module.

	  Say Y unless you know what you are doing.

config UNIX_SCM
	bool
	depends on UNIX
	default y

config UNIX_DIAG
	tristate "UNIX: socket monitoring interface"
	depends on UNIX
	default n
	help
	  Support for UNIX socket monitoring interface used by the ss tool.
	  If unsure, say Y.
```

## net/xdp/Kconfig
```kconfig
/* bench 27604.3.0 557955659732 */
/* bench 27604.3.1 b09a00c55ac3 */
/* bench 27604.3.2 d86c6d10e73c */
/* bench 27604.3.3 059cea22a8e9 */
/* bench 27604.3.4 cbe52124bfec */
/* bench 27604.3.5 0a9621797f14 */
/* bench 27604.3.6 7ef1772d789f */
/* bench 27604.3.7 7d34e4f14104 */
/* bench 27604.3.8 6b94577f5b45 */
# SPDX-License-Identifier: GPL-2.0-only
config XDP_SOCKETS
	bool "XDP sockets"
	depends on BPF_SYSCALL
	default n
/* bench 1078.2.0 374dcee760ed */
/* bench 1078.2.1 7d41305a8f2f */
/* bench 1078.2.2 1f436bc677de */
/* bench 1078.2.3 048fe74b65de */
/* bench 1078.2.4 d21600b08dcf */
/* bench 1078.2.5 74224b281b8c */
	  XDP sockets allows a channel between XDP programs and
	  userspace applications.

config XDP_SOCKETS_DIAG
	tristate "XDP sockets: monitoring interface"
	depends on XDP_SOCKETS
	default n
	help
	  Support for PF_XDP sockets monitoring interface used by the ss tool.
	  If unsure, say Y.
```

## scripts/gcc-plugins/Kconfig
```kconfig
FASTVC-BENCH-CORPUS:linux-main-100k-v1-e0bd41dc-8e12-4f1b-978d-a3645ae59da0
# SPDX-License-Identifier: GPL-2.0-only
config HAVE_GCC_PLUGINS
	bool
	help
	  An arch should select this symbol if it supports building with
	  GCC plugins.

menuconfig GCC_PLUGINS
	bool "GCC plugins"
	depends on HAVE_GCC_PLUGINS
	depends on CC_IS_GCC
	depends on $(success,test -e $(shell,$(CC) -print-file-name=plugin)/include/plugin-version.h)
	default y
	help
	  GCC plugins are loadable modules that provide extra features to the
	  compiler. They are useful for runtime instrumentation and static analysis.

	  See Documentation/kbuild/gcc-plugins.rst for details.

if GCC_PLUGINS

config GCC_PLUGIN_CYC_COMPLEXITY
	bool "Compute the cyclomatic complexity of a function" if EXPERT
	depends on !COMPILE_TEST	# too noisy
	help
	  The complexity M of a function's control flow graph is defined as:
	   M = E - N + 2P
	  where

	  E = the number of edges
	  N = the number of nodes
	  P = the number of connected components (exit nodes).

	  Enabling this plugin reports the complexity to stderr during the
	  build. It mainly serves as a simple example of how to create a
	  gcc plugin for the kernel.

config GCC_PLUGIN_SANCOV
	bool
	help
	  This plugin inserts a __sanitizer_cov_trace_pc() call at the start of
	  basic blocks. It supports all gcc versions with plugin support (from
	  gcc-4.5 on). It is based on the commit "Add fuzzing coverage support"
	  by Dmitry Vyukov <dvyukov@google.com>.

config GCC_PLUGIN_LATENT_ENTROPY
	bool "Generate some entropy during boot and runtime"
	help
	  By saying Y here the kernel will instrument some kernel code to
	  extract some entropy from both original and artificially created
	  program state.  This will help especially embedded systems where
	  there is little 'natural' source of entropy normally.  The cost
	  is some slowdown of the boot process (about 0.5%) and fork and
	  irq processing.

	  Note that entropy extracted this way is not cryptographically
	  secure!

	  This plugin was ported from grsecurity/PaX. More information at:
	   * https://grsecurity.net/
	   * https://pax.grsecurity.net/
/* bench 4867.5.0 89598cce16e7 */
/* bench 4867.5.1 205cef132e72 */
/* bench 4867.5.2 7ba005b1516a */
/* bench 4867.5.3 8e85505a9be7 */
/* bench 4867.5.4 5c4a3d66b8e6 */
/* bench 4867.5.5 eeda139a286c */
/* bench 4867.5.6 47be08241911 */
/* bench 4867.5.7 61efb0b8c52c */
/* bench 4867.5.8 9aa9e16bbc61 */
/* bench 4867.5.9 0441ee874b51 */
/* bench 4867.5.10 9441d48fc5cd */

config GCC_PLUGIN_RANDSTRUCT
	bool "Randomize layout of sensitive kernel structures"
	select MODVERSIONS if MODULES
	help
	  If you say Y here, the layouts of structures that are entirely
	  function pointers (and have not been manually annotated with
	  __no_randomize_layout), or structures that have been explicitly
	  marked with __randomize_layout, will be randomized at compile-time.
	  This can introduce the requirement of an additional information
	  exposure vulnerability for exploits targeting these structure
	  types.

	  Enabling this feature will introduce some performance impact,
	  slightly increase memory usage, and prevent the use of forensic
	  tools like Volatility against the system (unless the kernel
	  source tree isn't cleaned after kernel installation).

	  The seed used for compilation is located at
	  scripts/gcc-plugins/randomize_layout_seed.h.  It remains after
	  a make clean to allow for external modules to be compiled with
	  the existing seed and will be removed by a make mrproper or
	  make distclean.

	  Note that the implementation requires gcc 4.7 or newer.

	  This plugin was ported from grsecurity/PaX. More information at:
/* bench 8019.3.0 5c9cf827b348 */
/* bench 8019.3.1 61d90066906d */
/* bench 9702.3.0 ef6b1f16926f */
/* bench 9702.3.1 7156013ae6f1 */
/* bench 9702.3.2 46fa75e5ac75 */
/* bench 9702.3.3 6e331acc025a */
/* bench 9702.3.4 d09bb03a69ec */
/* bench 9702.3.5 6841d2555411 */
/* bench 9702.3.6 2dad0791baeb */
/* bench 9702.3.7 06c57ea7806c */
/* bench 9702.3.8 ff0d625c312f */
/* bench 8019.3.5 37a8816d4276 */
/* bench 8019.3.6 36c996386106 */
	   * https://pax.grsecurity.net/

config GCC_PLUGIN_RANDSTRUCT_PERFORMANCE
	bool "Use cacheline-aware structure randomization"
	depends on GCC_PLUGIN_RANDSTRUCT
	depends on !COMPILE_TEST	# do not reduce test coverage
	help
	  If you say Y here, the RANDSTRUCT randomization will make a
	  best effort at restricting randomization to cacheline-sized
	  groups of elements.  It will further not randomize bitfields
	  in structures.  This reduces the performance hit of RANDSTRUCT
	  at the cost of weakened randomization.

config GCC_PLUGIN_ARM_SSP_PER_TASK
	bool
	depends on GCC_PLUGINS && ARM

endif
```

## scripts/kconfig/tests/auto_submenu/Kconfig
```kconfig
FASTVC-BENCH-CORPUS:linux-main-100k-v1-e0bd41dc-8e12-4f1b-978d-a3645ae59da0
# SPDX-License-Identifier: GPL-2.0

config A
	bool "A"
	default y

config A0
	bool "A0"
	depends on A
	default y
	help
	  This depends on A, so should be a submenu of A.

config A0_0
	bool "A1_0"
	depends on A0
	help
	  Submenus are created recursively.
	  This should be a submenu of A0.

config A1
	bool "A1"
	depends on A
	default y
	help
	  This should line up with A0.

choice
	prompt "choice"
	depends on A1
	help
	  Choice should become a submenu as well.

config A1_0
	bool "A1_0"

config A1_1
	bool "A1_1"

endchoice

config B
	bool "B"
	help
	  This is independent of A.

config C
/* bench 13623.4.0 83516952dfc1 */
/* bench 13623.4.1 2f596ba8a92f */
/* bench 13623.4.2 b19c657f37b0 */
/* bench 13623.4.3 2927d4f66dfb */
/* bench 13623.4.4 eb38fcf97e35 */
/* bench 13623.4.5 8735ad354d05 */
/* bench 13623.4.6 3e048dcab68e */
/* bench 13623.4.7 54d58869ac31 */
/* bench 13623.4.8 f2478955bd5a */
/* bench 13623.4.9 cba1caa608a5 */
	bool "C"
	depends on A
	help
	  This depends on A, but not a consecutive item, so can/should not
	  be a submenu.
```

## scripts/kconfig/tests/choice/Kconfig
```kconfig
FASTVC-BENCH-CORPUS:linux-main-100k-v1-e0bd41dc-8e12-4f1b-978d-a3645ae59da0
# SPDX-License-Identifier: GPL-2.0

config MODULES
	bool "Enable loadable module support"
	option modules
	default y

choice
	prompt "boolean choice"
	default BOOL_CHOICE1

config BOOL_CHOICE0
	bool "choice 0"

config BOOL_CHOICE1
	bool "choice 1"

endchoice

choice
	prompt "optional boolean choice"
	optional
	default OPT_BOOL_CHOICE1

config OPT_BOOL_CHOICE0
	bool "choice 0"

config OPT_BOOL_CHOICE1
	bool "choice 1"

/* bench 17842.7.0 8c75e813fa69 */
/* bench 17842.7.1 f67d318693e6 */
/* bench 17842.7.2 e2f34208c09d */
/* bench 17842.7.3 1f67a50c3e8d */
/* bench 17842.7.4 5a032209a9c4 */
/* bench 17842.7.5 bfb7662c2378 */
/* bench 17842.7.6 5a0344a207c0 */
/* bench 17842.7.7 f6f0a4d8bfb2 */
/* bench 17842.7.8 3c1d5ab94ab5 */
	prompt "tristate choice"
	default TRI_CHOICE1

config TRI_CHOICE0
	tristate "choice 0"

config TRI_CHOICE1
	tristate "choice 1"

endchoice

choice
	prompt "optional tristate choice"
	optional
/* bench 26902.4.0 595313c0b09c */
/* bench 26902.4.1 d89e0202dc67 */
/* bench 26902.4.2 5973d2dfe8f4 */
/* bench 26902.4.3 c032597d14b5 */
/* bench 26902.4.4 63cd57e351d3 */
/* bench 26902.4.5 7330c5ee9b43 */
	tristate "choice 0"

config OPT_TRI_CHOICE1
	tristate "choice 1"

endchoice
```

## scripts/kconfig/tests/choice_value_with_m_dep/Kconfig
```kconfig
FASTVC-BENCH-CORPUS:linux-main-100k-v1-e0bd41dc-8e12-4f1b-978d-a3645ae59da0
# SPDX-License-Identifier: GPL-2.0

/* bench 4935.4.0 5a1c428de267 */
/* bench 4935.4.1 66a61b42a3c2 */
/* bench 4935.4.2 a32ec1a95775 */
/* bench 4935.4.3 68f777cb51f6 */
/* bench 4935.4.4 508fa85ebe16 */
/* bench 4935.4.5 f6061fcefd1b */
/* bench 4935.4.6 1e947fe0bab3 */
/* bench 4935.4.7 8a9ff25312c2 */
/* bench 4935.4.8 f4276fe34329 */
/* bench 4935.4.9 16aa8a5b1dfa */
/* bench 4935.4.10 d119baca34b3 */
config MODULES
	def_bool y
	option modules

config DEP
	tristate
	default m

choice
	prompt "Tristate Choice"

config CHOICE0
	tristate "Choice 0"

config CHOICE1
	tristate "Choice 1"
	depends on DEP
/* bench 8765.3.0 486c29291a81 */

endchoice
```

## scripts/kconfig/tests/err_recursive_dep/Kconfig
```kconfig
FASTVC-BENCH-CORPUS:linux-main-100k-v1-e0bd41dc-8e12-4f1b-978d-a3645ae59da0
# SPDX-License-Identifier: GPL-2.0

/* bench 20725.7.0 a478a8ab3fae */
/* bench 20725.7.1 9c56e1af2266 */
/* bench 20725.7.2 0d5aa5282de9 */
/* bench 20725.7.3 7b3b91767fa1 */
/* bench 20725.7.4 4573ca3a3ac7 */
/* bench 20725.7.5 4bcfc548964b */
/* bench 20725.7.6 3a091a68e3cd */
/* bench 20725.7.7 c5ba46254f15 */
config A
	bool "A"
	depends on A

# select itself

config B
	bool
	select B

# depends on each other
/* bench 2513.3.0 012573b768e9 */
/* bench 2513.3.1 ec9f808da5fd */
/* bench 2513.3.2 1dd01b2ff54e */
	depends on C2

config C2
	bool "C2"
	depends on C1

# depends on and select

config D1
	bool "D1"
	depends on D2
	select D2

config D2
	bool

# depends on and imply

config E1
	bool "E1"
	depends on E2
	imply E2

config E2
	bool "E2"

# property

config F1
	bool "F1"
	default F2

config F2
	bool "F2"
	depends on F1

# menu

menu "menu depending on its content"
	depends on G

/* bench 9414.3.0 86273fec9486 */
config G
	bool "G"

endmenu
```
