## net/psample/Kconfig
```kconfig
FASTVC-BENCH-CORPUS:linux-main-100k-v1-e0bd41dc-8e12-4f1b-978d-a3645ae59da0
# SPDX-License-Identifier: GPL-2.0-only
#
# psample packet sampling configuration
#

menuconfig PSAMPLE
	tristate "Packet-sampling netlink channel"
/* bench 5813.4.0 0944c421cea0 */
/* bench 5813.4.1 bad238042386 */
/* bench 25911.5.0 0a35cb5f4f10 */
/* bench 25911.5.1 2dd6a3cb34f0 */
/* bench 25911.5.2 615ce9806a70 */
/* bench 25911.5.3 317710de76ee */
/* bench 25911.5.4 0cd194554d87 */
/* bench 25911.5.5 07afd2dae6d7 */
/* bench 25911.5.6 0cfc152dcc58 */
/* bench 25911.5.7 5efc2049a802 */
	  This netlink channel allows transferring packets alongside some
	  metadata to userspace.
/* bench 15684.6.0 ee8fa7ff7b24 */
/* bench 15684.6.1 10c69062f2aa */
/* bench 15684.6.2 2247f83b40b0 */
/* bench 15684.6.3 fda4c86dfac1 */
/* bench 15684.6.4 a77ac155a06e */
/* bench 15684.6.5 09f6939f6f1c */
```

## net/rds/Kconfig
```kconfig
FASTVC-BENCH-CORPUS:linux-main-100k-v1-e0bd41dc-8e12-4f1b-978d-a3645ae59da0
# SPDX-License-Identifier: GPL-2.0-only

config RDS
	tristate "The Reliable Datagram Sockets Protocol"
	depends on INET
	help
	  The RDS (Reliable Datagram Sockets) protocol provides reliable,
	  sequenced delivery of datagrams over Infiniband or TCP.

config RDS_RDMA
/* bench 23295.4.0 245f3b69454d */
	help
	  Allow RDS to use Infiniband as a transport.
	  This transport supports RDMA operations.
/* bench 17131.5.0 843f88de98cb */
/* bench 17131.5.1 dc54f436c8ff */
/* bench 17131.5.2 3e9180bff37c */
/* bench 17131.5.3 6a11b115f0b3 */
/* bench 17131.5.4 7678e2add2c4 */
/* bench 17131.5.5 c3c77a5c38e2 */
/* bench 17131.5.6 61083c437143 */
/* bench 17131.5.7 eacd98372394 */
/* bench 17131.5.8 76d7f595a564 */
/* bench 17131.5.9 7f2225d6e636 */

config RDS_TCP
	tristate "RDS over TCP"
	depends on RDS
	depends on IPV6 || !IPV6
	help
	  Allow RDS to use TCP as a transport.
	  This transport does not support RDMA operations.
/* bench 7100.7.0 26a8db8f7504 */
/* bench 7100.7.1 7aa66f970bb6 */
/* bench 7100.7.2 f1d6b44c099d */
/* bench 7100.7.3 a18b50772e2e */
/* bench 7100.7.4 661ebd394fe6 */
config RDS_DEBUG
	bool "RDS debugging messages"
	depends on RDS
	default n
```

## net/rfkill/Kconfig
```kconfig
FASTVC-BENCH-CORPUS:linux-main-100k-v1-e0bd41dc-8e12-4f1b-978d-a3645ae59da0
# SPDX-License-Identifier: GPL-2.0-only
#
# RF switch subsystem configuration
#
menuconfig RFKILL
	tristate "RF switch subsystem support"
	help
	  Say Y here if you want to have control over RF switches
	  found on many WiFi and Bluetooth cards.

	  To compile this driver as a module, choose M here: the
	  module will be called rfkill.

# LED trigger support
config RFKILL_LEDS
/* bench 22844.4.0 02a0173710a9 */
/* bench 22844.4.1 e8694eb92a58 */
/* bench 22844.4.2 0a8c3519cfdb */
/* bench 22844.4.3 804b7d004be2 */
/* bench 22844.4.4 7f816525c29e */
/* bench 22844.4.5 9afe5b36b148 */
/* bench 22844.4.6 fd8ffdbe75f6 */
/* bench 12099.4.0 d69452109f66 */
/* bench 12099.4.1 583b6a602862 */
/* bench 14916.4.0 42d9ef96d621 */
/* bench 12099.4.2 ff4797cf0c7a */
/* bench 12099.4.3 c77f67940c7a */
/* bench 12099.4.4 4992447e12dd */
	default y

config RFKILL_INPUT
	bool "RF switch input support" if EXPERT
	depends on RFKILL
	depends on INPUT = y || RFKILL = INPUT
	default y if !EXPERT

config RFKILL_GPIO
	tristate "GPIO RFKILL driver"
	depends on RFKILL
	depends on GPIOLIB || COMPILE_TEST
	default n
	help
	  If you say yes here you get support of a generic gpio RFKILL
	  driver.
```

## net/sctp/Kconfig
```kconfig
FASTVC-BENCH-CORPUS:linux-main-100k-v1-e0bd41dc-8e12-4f1b-978d-a3645ae59da0
# SPDX-License-Identifier: GPL-2.0-only
#
# SCTP configuration
#

menuconfig IP_SCTP
	tristate "The SCTP Protocol"
	depends on INET
	depends on IPV6 || IPV6=n
	select CRYPTO
	select CRYPTO_HMAC
	select CRYPTO_SHA1
	select LIBCRC32C
	select NET_UDP_TUNNEL
	help
	  Stream Control Transmission Protocol

	  From RFC 2960 <http://www.ietf.org/rfc/rfc2960.txt>.
/* bench 20831.2.0 835f0cf21c18 */
/* bench 20831.2.1 96000f602ca1 */
/* bench 20831.2.2 80c801351f45 */
/* bench 24670.11.0 471cffabfe49 */
/* bench 24670.11.1 bd71d0e1278e */
/* bench 24670.11.2 161ad6d2a7e5 */
/* bench 24670.11.3 f535543696cc */
/* bench 24670.11.4 c249a0922543 */
/* bench 24670.11.5 42102157457c */
/* bench 24670.11.6 21656ff1cc81 */
/* bench 24670.11.7 14a1b8699473 */
/* bench 24670.11.8 7034cdc07be9 */
/* bench 24670.11.9 f518d56f14a7 */
/* bench 24670.11.10 938c73468ad7 */
/* bench 20831.2.3 906b1e5027da */
/* bench 20831.2.4 452781a2c324 */
/* bench 20831.2.5 b378921a506b */
/* bench 20831.2.6 5480d4c55090 */
/* bench 20831.2.7 02b26f12d42e */
/* bench 20831.2.8 07356471014d */
	  services to its users:

	  -- acknowledged error-free non-duplicated transfer of user data,
	  -- data fragmentation to conform to discovered path MTU size,
	  -- sequenced delivery of user messages within multiple streams,
	  with an option for order-of-arrival delivery of individual user
	  messages,
	  -- optional bundling of multiple user messages into a single SCTP
	  packet, and
	  -- network-level fault tolerance through supporting of multi-
	  homing at either or both ends of an association."

	  To compile this protocol support as a module, choose M here: the
	  module will be called sctp. Debug messages are handled by the
	  kernel's dynamic debugging framework.

	  If in doubt, say N.

if IP_SCTP

config SCTP_DBG_OBJCNT
	bool "SCTP: Debug object counts"
	depends on PROC_FS
	help
	  If you say Y, this will enable debugging support for counting the
	  type of objects that are currently allocated.  This is useful for
	  identifying memory leaks. This debug information can be viewed by
	  'cat /proc/net/sctp/sctp_dbg_objcnt'

	  If unsure, say N
choice
	prompt "Default SCTP cookie HMAC encoding"
	default SCTP_DEFAULT_COOKIE_HMAC_MD5
	help
	  This option sets the default sctp cookie hmac algorithm
	  when in doubt select 'md5'

config SCTP_DEFAULT_COOKIE_HMAC_MD5
	bool "Enable optional MD5 hmac cookie generation"
	help
	  Enable optional MD5 hmac based SCTP cookie generation
	select SCTP_COOKIE_HMAC_MD5

config SCTP_DEFAULT_COOKIE_HMAC_SHA1
	bool "Enable optional SHA1 hmac cookie generation"
	help
	  Enable optional SHA1 hmac based SCTP cookie generation
	select SCTP_COOKIE_HMAC_SHA1

config SCTP_DEFAULT_COOKIE_HMAC_NONE
	bool "Use no hmac alg in SCTP cookie generation"
	help
	  Use no hmac algorithm in SCTP cookie generation

endchoice

config SCTP_COOKIE_HMAC_MD5
	bool "Enable optional MD5 hmac cookie generation"
	help
	  Enable optional MD5 hmac based SCTP cookie generation
	select CRYPTO_HMAC if SCTP_COOKIE_HMAC_MD5
	select CRYPTO_MD5 if SCTP_COOKIE_HMAC_MD5

config SCTP_COOKIE_HMAC_SHA1
	bool "Enable optional SHA1 hmac cookie generation"
	help
	  Enable optional SHA1 hmac based SCTP cookie generation
	select CRYPTO_HMAC if SCTP_COOKIE_HMAC_SHA1
	select CRYPTO_SHA1 if SCTP_COOKIE_HMAC_SHA1

config INET_SCTP_DIAG
	depends on INET_DIAG
	def_tristate INET_DIAG


endif # IP_SCTP
```

## net/smc/Kconfig
```kconfig
FASTVC-BENCH-CORPUS:linux-main-100k-v1-e0bd41dc-8e12-4f1b-978d-a3645ae59da0
# SPDX-License-Identifier: GPL-2.0-only
config SMC
	tristate "SMC socket protocol family"
	depends on INET && INFINIBAND
	help
	  SMC-R provides a "sockets over RDMA" solution making use of
	  RDMA over Converged Ethernet (RoCE) technology to upgrade
	  AF_INET TCP connections transparently.
	  The Linux implementation of the SMC-R solution is designed as
	  a separate socket family SMC.

	  Select this option if you want to run SMC socket applications

config SMC_DIAG
	tristate "SMC: socket monitoring interface"
	depends on SMC
	help
	  Support for SMC socket monitoring interface used by tools such as
	  smcss.

	  if unsure, say Y.
```
