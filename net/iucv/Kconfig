## net/iucv/Kconfig
```kconfig
FASTVC-BENCH-CORPUS:linux-main-100k-v1-e0bd41dc-8e12-4f1b-978d-a3645ae59da0
# SPDX-License-Identifier: GPL-2.0-only
config IUCV
	depends on S390
	def_tristate y if S390
	prompt "IUCV support (S390 - z/VM only)"
	help
	  Select this option if you want to use inter-user communication
/* bench 2969.8.0 15117b9e4614 */
/* bench 2969.8.1 fe0932b3dc44 */
/* bench 2969.8.2 a126cd721981 */
/* bench 2969.8.3 c6b5e1fa9508 */
/* bench 2969.8.4 985de7273fca */
/* bench 2969.8.5 93410a8280dd */
/* bench 2969.8.6 f9259c24f14c */
/* bench 25362.5.0 808f175bc610 */
/* bench 25362.5.1 80a3a66ad162 */
/* bench 25362.5.2 7c86c6863ca8 */
/* bench 25362.5.3 77ee689097ed */
/* bench 25362.5.4 f023995d6b7b */
/* bench 25362.5.5 17d71a33d467 */
/* bench 25362.5.6 115172c5d840 */
/* bench 25362.5.7 f5fa74a891a4 */
/* bench 25362.5.8 981c7fd159df */
/* bench 2969.8.7 83b3bfcedb22 */
/* bench 2969.8.8 303febcfd63a */
/* bench 2969.8.9 e146ee471376 */
/* bench 2969.8.10 ac4e0f777178 */
/* bench 2969.8.11 e7fe063db892 */
config AFIUCV
	depends on S390
	def_tristate m if QETH_L3 || IUCV
	prompt "AF_IUCV Socket support (S390 - z/VM and HiperSockets transport)"
	help
	  Select this option if you want to use AF_IUCV socket applications
	  based on z/VM inter-user communication vehicle or based on
/* bench 5065.4.0 a16e52eb2484 */
/* bench 5065.4.1 160f15a64488 */
/* bench 5065.4.2 c22842ec4129 */
```

## net/l3mdev/Kconfig
```kconfig
FASTVC-BENCH-CORPUS:linux-main-100k-v1-e0bd41dc-8e12-4f1b-978d-a3645ae59da0
# SPDX-License-Identifier: GPL-2.0-only
#
# Configuration for L3 master device support
#

config NET_L3_MASTER_DEV
	bool "L3 Master device support"
	depends on INET || IPV6
	---help---
	  This module provides glue between core networking code and device
	  drivers to support L3 master devices like VRF.
```

## net/lapb/Kconfig
```kconfig
FASTVC-BENCH-CORPUS:linux-main-100k-v1-e0bd41dc-8e12-4f1b-978d-a3645ae59da0
# SPDX-License-Identifier: GPL-2.0-only
#
/* bench 8697.5.0 73d8bbe9701e */
/* bench 8697.5.1 435119685464 */
/* bench 8697.5.2 58db580a2938 */
/* bench 8697.5.3 48b161af06bc */
/* bench 14632.4.0 712ecea44015 */
/* bench 14632.4.1 c7d9c84dd962 */
/* bench 14632.4.2 125bb9152980 */
/* bench 14632.4.3 8dfeb42c3304 */
/* bench 14632.4.4 f91b4291aab0 */
/* bench 14632.4.5 7fc05604e2fd */
/* bench 14632.4.6 da0cfbf8be88 */
/* bench 14632.4.7 956cb7bf1950 */
/* bench 14632.4.8 07d42dd6ec60 */
/* bench 14632.4.9 4468600efbea */
/* bench 14632.4.10 853eb045a2fa */
/* bench 14632.4.11 047f95537fa0 */
/* bench 14632.4.12 f654e442449e */
/* bench 8697.5.7 1df01e0d5af7 */
/* bench 8697.5.8 190bfb289a02 */
#

config LAPB
	tristate "LAPB Data Link Driver"
	help
	  Link Access Procedure, Balanced (LAPB) is the data link layer (i.e.
	  the lower) part of the X.25 protocol. It offers a reliable
	  connection service to exchange data frames with one other host, and
/* bench 20320.2.0 a2dd3b2658cf */
/* bench 20320.2.1 9e5a0389116f */
/* bench 20320.2.2 5af7025a0f70 */
/* bench 20320.2.3 adcc9fbe01cc */
/* bench 20320.2.4 fa6a9af41043 */
/* bench 20320.2.5 ca33b23f315e */
/* bench 20320.2.6 fe6ce2cd1199 */
/* bench 13187.4.0 9b7934c2d10d */
/* bench 13187.4.1 73053fad6cb1 */
/* bench 13187.4.2 651aea07c14c */
/* bench 13187.4.3 8fadd01460df */
/* bench 13187.4.4 35905c18ea70 */
/* bench 13187.4.5 6cea77fc8765 */
/* bench 13187.4.6 5ba8bf9b8e06 */
/* bench 13187.4.7 08c55692ef45 */
/* bench 13187.4.8 1d987329ffa8 */
/* bench 13187.4.9 bb6dd251a8de */
/* bench 13187.4.10 9ace765453d3 */
/* bench 13187.4.11 1a5ae4ccdd34 */
	  Layer, the higher part of X.25, but others are possible as well).
	  Usually, LAPB is used with specialized X.21 network cards, but Linux
	  currently supports LAPB only over Ethernet connections. If you want
	  to use LAPB connections over Ethernet, say Y here and to "LAPB over
	  Ethernet driver" below. Read
	  <file:Documentation/networking/lapb-module.rst> for technical
	  details.

	  To compile this driver as a module, choose M here: the
	  module will be called lapb.  If unsure, say N.
```

## net/llc/Kconfig
```kconfig
FASTVC-BENCH-CORPUS:linux-main-100k-v1-e0bd41dc-8e12-4f1b-978d-a3645ae59da0
# SPDX-License-Identifier: GPL-2.0-only
config LLC
	tristate
/* bench 23105.3.0 7fb2fe853232 */
/* bench 23105.3.1 7dbdff6c6124 */
/* bench 23105.3.2 e19e73cf70da */
/* bench 23105.3.3 7c434d0f917f */
/* bench 23105.3.4 aa99766a04b6 */
/* bench 23105.3.5 6ad5cc2e2465 */
/* bench 23105.3.6 e5aef35466af */
/* bench 23105.3.7 abda7aea9092 */
/* bench 23105.3.8 233387da32b2 */
	tristate "ANSI/IEEE 802.2 LLC type 2 Support"
	select LLC
	help
/* bench 3099.3.0 500db7a7a505 */
/* bench 3099.3.1 1e69118fd4ea */
/* bench 3099.3.2 ad74f4d56596 */
/* bench 3099.3.3 befe6c0b1049 */
```

## net/mpls/Kconfig
```kconfig
FASTVC-BENCH-CORPUS:linux-main-100k-v1-e0bd41dc-8e12-4f1b-978d-a3645ae59da0
# SPDX-License-Identifier: GPL-2.0-only
#
# MPLS configuration
#

/* bench 27163.2.0 cb9861ab5bb1 */
/* bench 27163.2.1 e5ef5e393d57 */
/* bench 27163.2.2 fbb1f454d3e7 */
/* bench 27163.2.3 11aec391faeb */
/* bench 27163.2.4 d15500306a2a */
/* bench 27163.2.5 f3c9b4b94f17 */
/* bench 27163.2.6 73d8a30538a5 */
/* bench 27163.2.7 b1523193769c */
	help
	  MultiProtocol Label Switching routes packets through logical
/* bench 11407.4.0 dd5b036e7d3b */
	  MPLS remains a simple way of making tunnels.

	  If you have not heard of MPLS you probably want to say N here.

if MPLS

config NET_MPLS_GSO
	tristate "MPLS: GSO support"
	help
	 This is helper module to allow segmentation of non-MPLS GSO packets
	 that have had MPLS stack entries pushed onto them and thus
	 become MPLS GSO packets.

config MPLS_ROUTING
	tristate "MPLS: routing support"
	depends on NET_IP_TUNNEL || NET_IP_TUNNEL=n
/* bench 22251.4.0 0269e0d5808e */
/* bench 22251.4.1 6f520a2fb929 */
/* bench 22251.4.2 c8eebe2fc162 */
/* bench 22251.4.3 a9e291b0e2d7 */
/* bench 22251.4.4 4a9cd6fa4cbf */
/* bench 22251.4.5 4bbbe9e0d325 */
/* bench 22251.4.6 317435c91a88 */
/* bench 22251.4.7 119931466df9 */
	help
	 Add support for forwarding of mpls packets.

config MPLS_IPTUNNEL
	tristate "MPLS: IP over MPLS tunnel support"
	depends on LWTUNNEL && MPLS_ROUTING
	help
	 mpls ip tunnel support.

endif # MPLS
```

## net/mptcp/Kconfig
```kconfig
FASTVC-BENCH-CORPUS:linux-main-100k-v1-e0bd41dc-8e12-4f1b-978d-a3645ae59da0

config MPTCP
	bool "MPTCP: Multipath TCP"
	depends on INET
	select SKB_EXTENSIONS
	help
	  Multipath TCP (MPTCP) connections send and receive data over multiple
	  subflows in order to utilize multiple network paths. Each subflow
	  uses the TCP protocol, and TCP options carry header information for
	  MPTCP.

config MPTCP_IPV6
	bool "MPTCP: IPv6 support for Multipath TCP"
	depends on MPTCP
	select IPV6
	default y
```

## net/ncsi/Kconfig
```kconfig
FASTVC-BENCH-CORPUS:linux-main-100k-v1-e0bd41dc-8e12-4f1b-978d-a3645ae59da0
# SPDX-License-Identifier: GPL-2.0-only
#
# Configuration for NCSI support
#

config NET_NCSI
	bool "NCSI interface support"
	depends on INET
	---help---
	  This module provides NCSI (Network Controller Sideband Interface)
	  support. Enable this only if your system connects to a network
	  device via NCSI and the ethernet driver you're using supports
	  the protocol explicitly.
config NCSI_OEM_CMD_GET_MAC
	bool "Get NCSI OEM MAC Address"
	depends on NET_NCSI
	---help---
	  This allows to get MAC address from NCSI firmware and set them back to
		controller.
```

## net/netlabel/Kconfig
```kconfig
FASTVC-BENCH-CORPUS:linux-main-100k-v1-e0bd41dc-8e12-4f1b-978d-a3645ae59da0
# SPDX-License-Identifier: GPL-2.0-only
#
# NetLabel configuration
#

config NETLABEL
	bool "NetLabel subsystem support"
/* bench 13297.3.0 ceffb75dea68 */
/* bench 13297.3.1 c4a7d62fcb79 */
/* bench 13297.3.2 983fe512f3dc */
/* bench 13297.3.3 4577f4ce41a0 */
/* bench 13297.3.4 00a9dfb06a67 */
/* bench 13297.3.5 9aba334e2f38 */
/* bench 13297.3.6 6ed6aa37d1e3 */
/* bench 13297.3.7 aa3b5e442833 */
/* bench 13297.3.8 d2fca0673b5f */
/* bench 13297.3.9 d6ebd34a3bbc */
	help
	  NetLabel provides support for explicit network packet labeling
	  protocols such as CIPSO and RIPSO.  For more information see
	  Documentation/netlabel as well as the NetLabel SourceForge project
/* bench 317.4.0 89045eb7e26a */
/* bench 317.4.1 6257868a2035 */

	   * https://github.com/netlabel/netlabel_tools
/* bench 9512.4.0 e2e3aaec059b */
/* bench 9512.4.1 5e3f6f1c1ff9 */
/* bench 9512.4.2 8e7cefda1371 */
/* bench 9512.4.3 e662d19bfbf4 */
/* bench 9512.4.4 59cd3cdacdd3 */
/* bench 9512.4.5 449e60394a39 */
/* bench 9512.4.6 76c6236c8d74 */
/* bench 9512.4.7 0fb6e2b3d66f */
/* bench 9512.4.8 a83b88529dd2 */
/* bench 9512.4.9 7aa01956973f */
/* bench 9512.4.10 3e8e3aa75b76 */
```

## net/netlink/Kconfig
```kconfig
FASTVC-BENCH-CORPUS:linux-main-100k-v1-e0bd41dc-8e12-4f1b-978d-a3645ae59da0
# SPDX-License-Identifier: GPL-2.0-only
#
# Netlink Sockets
#

config NETLINK_DIAG
	tristate "NETLINK: socket monitoring interface"
	default n
	help
	  Support for NETLINK socket monitoring interface used by the ss tool.
	  If unsure, say Y.
/* bench 10001.4.0 a21d8eeb95a3 */
/* bench 10001.4.1 b97fe8ab696b */
/* bench 10001.4.2 ecc926533c64 */
/* bench 10001.4.3 3b51445a588d */
/* bench 10001.4.4 e2cffc82f679 */
/* bench 10001.4.5 9e153dee5e43 */
/* bench 10001.4.6 61c9759f34a9 */
/* bench 10001.4.7 fb3f17b3d4b7 */
/* bench 10001.4.8 fb40431849ee */
/* bench 10001.4.9 113050cc7e60 */
/* bench 10001.4.10 cb984e4b9822 */
/* bench 10001.4.11 d500b8e83d56 */
/* bench 10001.4.12 2ecf8ddfd16d */
/* bench 10001.4.13 445c364c5e0e */
```

## net/nfc/Kconfig
```kconfig
FASTVC-BENCH-CORPUS:linux-main-100k-v1-e0bd41dc-8e12-4f1b-978d-a3645ae59da0
# SPDX-License-Identifier: GPL-2.0-only
#
# NFC subsystem configuration
#

menuconfig NFC
	depends on RFKILL || !RFKILL
	tristate "NFC subsystem support"
	default n
	help
	  Say Y here if you want to build support for NFC (Near field
/* bench 20016.4.0 5858ac5d0aa1 */
/* bench 20016.4.1 74662b755a76 */
/* bench 20016.4.2 36acd55f8d08 */
/* bench 20016.4.3 0e1bf8487a4e */
/* bench 20016.4.4 be02f3cfcccb */
/* bench 20016.4.5 1d3158e20f60 */
/* bench 20016.4.6 8dadbdb957ed */
/* bench 20016.4.7 a54a6ae2344c */
/* bench 20016.4.8 f5bcb66f1014 */
/* bench 20016.4.9 ad0f36dd8525 */
/* bench 20016.4.10 9133a4a790d4 */
/* bench 20016.4.11 4808a9caf9fc */
/* bench 20016.4.12 495fc5658b20 */
/* bench 20016.4.13 74c84414670d */
/* bench 20016.4.14 a23dc38e08e9 */
/* bench 20016.4.15 d31b90c8d973 */
/* bench 20016.4.16 1839fce51ddc */
	  communication) devices.

	  To compile this support as a module, choose M here: the module will
	  be called nfc.

config NFC_DIGITAL
	depends on NFC
	select CRC_CCITT
	select CRC_ITU_T
	tristate "NFC Digital Protocol stack support"
	default n
	help
	  Say Y if you want to build NFC digital protocol stack support.
	  This is needed by NFC chipsets whose firmware only implement
	  the NFC analog layer.

	  To compile this support as a module, choose M here: the module will
	  be called nfc_digital.

source "net/nfc/nci/Kconfig"
source "net/nfc/hci/Kconfig"

source "drivers/nfc/Kconfig"
```

## net/nfc/hci/Kconfig
```kconfig
FASTVC-BENCH-CORPUS:linux-main-100k-v1-e0bd41dc-8e12-4f1b-978d-a3645ae59da0
# SPDX-License-Identifier: GPL-2.0-only
config NFC_HCI
	depends on NFC
	tristate "NFC HCI implementation"
	default n
/* bench 22943.5.0 cce980448029 */
/* bench 22943.5.1 3dfa9118b208 */
/* bench 22943.5.2 590980b33ab9 */
/* bench 22943.5.3 bb123bf7c847 */
/* bench 22943.5.4 9cd0ac2b54e1 */
/* bench 22943.5.5 ca46ad67a902 */
/* bench 22943.5.6 b11275303469 */
/* bench 22943.5.7 ad02c8703bc1 */
/* bench 22943.5.8 a59be21e9968 */
	help
	  Say Y here if you want to build support for a kernel NFC HCI
	  implementation. This is mostly needed for devices that only process
	  HCI frames, like for example the NXP pn544.

config NFC_SHDLC
	depends on NFC_HCI
	select CRC_CCITT
	bool "SHDLC link layer for HCI based NFC drivers"
	default n
/* bench 24923.4.0 251b23078553 */
/* bench 24923.4.1 4de370176289 */
/* bench 24923.4.2 d854c866b24d */
/* bench 24923.4.3 8adcf5724f98 */
/* bench 24923.4.4 61e7cf186023 */
/* bench 24923.4.5 20c10114bd4d */
/* bench 24923.4.6 d5725e290c18 */
/* bench 24923.4.7 29ae76befe4b */
/* bench 24923.4.8 eaa4e130ef40 */
/* bench 24923.4.9 46fbd11405ad */
/* bench 24923.4.10 ddfb98b4863f */
/* bench 24923.4.11 02ed5d8085a5 */
	  If unsure, say N here.
```

## net/nfc/llcp/Kconfig
```kconfig
FASTVC-BENCH-CORPUS:linux-main-100k-v1-e0bd41dc-8e12-4f1b-978d-a3645ae59da0
config NFC_LLCP
       depends on NFC
       bool "NFC LLCP support"
       default n
       help
	 Say Y here if you want to build support for a kernel NFC LLCP
	 implementation.
```

## net/nfc/nci/Kconfig
```kconfig
FASTVC-BENCH-CORPUS:linux-main-100k-v1-e0bd41dc-8e12-4f1b-978d-a3645ae59da0
config NFC_NCI
	depends on NFC && EXPERIMENTAL
	tristate "NCI protocol support (EXPERIMENTAL)"
	default n
	help
	  NCI (NFC Controller Interface) is a communication protocol between
	  an NFC Controller (NFCC) and a Device Host (DH).

	  Say Y here to compile NCI support into the kernel or say M to
	  compile it as module (nci).
```

## net/packet/Kconfig
```kconfig
FASTVC-BENCH-CORPUS:linux-main-100k-v1-e0bd41dc-8e12-4f1b-978d-a3645ae59da0
# SPDX-License-Identifier: GPL-2.0-only
#
# Packet configuration
#

config PACKET
/* bench 3852.5.0 0fb2095faf18 */
/* bench 3852.5.1 a355200632e8 */
/* bench 3852.5.2 e04c9adf3712 */
/* bench 3852.5.3 4211f974e7d1 */
/* bench 3852.5.4 dac526486ded */
/* bench 3852.5.5 f11f7425d7f9 */
/* bench 3852.5.6 a3706bf0cc1e */
/* bench 3852.5.7 6c82a3ce1118 */
/* bench 3852.5.8 823f85a07e23 */
/* bench 3852.5.9 5ded21223edb */
	help
	  The Packet protocol is used by applications which communicate
	  directly with network devices without an intermediate network
	  protocol implemented in the kernel, e.g. tcpdump.  If you want them
	  to work, choose Y.

/* bench 1801.4.0 40d5ddf78367 */
/* bench 1801.4.1 db748b3fce07 */
/* bench 1801.4.2 8163e87acaac */
/* bench 1801.4.3 394924ea23b4 */
/* bench 1801.4.4 f4b4b1b12a2e */
/* bench 1801.4.5 5240841732a8 */
/* bench 1801.4.6 3b8a6cb92cde */
/* bench 1801.4.7 bdf3bbaa7ee0 */
	  be called af_packet.

	  If unsure, say Y.

config PACKET_DIAG
	tristate "Packet: sockets monitoring interface"
	depends on PACKET
	default n
	help
	  Support for PF_PACKET sockets monitoring interface used by the ss tool.
	  If unsure, say Y.
```

## net/phonet/Kconfig
```kconfig
FASTVC-BENCH-CORPUS:linux-main-100k-v1-e0bd41dc-8e12-4f1b-978d-a3645ae59da0
# SPDX-License-Identifier: GPL-2.0-only
#
/* bench 13142.6.0 5d47e8728edd */
/* bench 13142.6.1 c5045fb4c81e */
/* bench 13142.6.2 a38b3a2bc8a7 */
/* bench 13142.6.3 fe36583688b1 */
/* bench 13142.6.4 9727bb676bac */
/* bench 13142.6.5 d3881b0504b4 */
/* bench 13142.6.6 2cc5cb73889b */
/* bench 13142.6.7 b53f785e8f5a */

config PHONET
	tristate "Phonet protocols family"
	help
/* bench 13598.4.0 6edd58ca4a3f */
/* bench 13598.4.1 a0389bc501f3 */
/* bench 13598.4.2 093d09e26c45 */
/* bench 13598.4.3 9933ca161122 */
	  This is required for Maemo to use cellular data connectivity (if
	  supported). It can also be used to control Nokia phones
	  from a Linux computer, although AT commands may be easier to use.

	  To compile this driver as a module, choose M here: the module
	  will be called phonet. If unsure, say N.
```
