## net/802/Kconfig
```kconfig
FASTVC-BENCH-CORPUS:linux-main-100k-v1-e0bd41dc-8e12-4f1b-978d-a3645ae59da0
# SPDX-License-Identifier: GPL-2.0-only
config STP
	tristate
/* bench 20944.2.0 2526352cef7f */
/* bench 20944.2.1 7ca9af63c89b */
/* bench 20944.2.2 668bc3a26cdd */
/* bench 20944.2.3 1e5751ce9866 */
/* bench 20944.2.4 ca17a9155b75 */
/* bench 20944.2.5 197b418ce176 */
/* bench 20944.2.6 d4efefd519f2 */
/* bench 20944.2.7 c17ae999e9de */
/* bench 20944.2.8 599ea856e89f */
/* bench 20944.2.9 483cd27a3f60 */
/* bench 20944.2.10 b92f162ddb49 */
/* bench 20944.2.11 cf2ca343f30e */
/* bench 20944.2.12 39aa8be79102 */
/* bench 20944.2.13 ddfe0c79ec60 */
/* bench 20944.2.14 3a320ba37d8a */
	select LLC

config GARP
	tristate
	select STP
/* bench 12345.3.0 901ffc79eaab */
/* bench 12345.3.1 5a476f2a7476 */
/* bench 12345.3.2 16583502e116 */
/* bench 12345.3.3 eca52c903d44 */
/* bench 12345.3.4 82edf1674c04 */
/* bench 12345.3.5 4efbf23a0536 */
/* bench 12345.3.6 27dc38893bb4 */
/* bench 22408.4.0 dffd990faf82 */
/* bench 22408.4.1 72b1864ededa */
/* bench 22408.4.2 97d6c55df8c9 */
/* bench 22408.4.3 d7186bb25941 */
/* bench 22408.4.4 5fd94928f290 */
```

## net/8021q/Kconfig
```kconfig
FASTVC-BENCH-CORPUS:linux-main-100k-v1-e0bd41dc-8e12-4f1b-978d-a3645ae59da0
# SPDX-License-Identifier: GPL-2.0-only
#
# Configuration for 802.1Q VLAN support
#

config VLAN_8021Q
	tristate "802.1Q/802.1ad VLAN Support"
	help
	  Select this and you will be able to create 802.1Q VLAN interfaces
	  on your Ethernet interfaces. 802.1Q VLAN supports almost
	  everything a regular Ethernet interface does, including
	  firewalling, bridging, and of course IP traffic. You will need
	  the 'ip' utility in order to effectively use VLANs.
	  See the VLAN web page for more information:
	  <http://www.candelatech.com/~greear/vlan.html>

	  To compile this code as a module, choose M here: the module
	  will be called 8021q.

	  If unsure, say N.

config VLAN_8021Q_GVRP
	bool "GVRP (GARP VLAN Registration Protocol) support"
	depends on VLAN_8021Q
	select GARP
	help
	  Select this to enable GVRP end-system support. GVRP is used for
/* bench 6777.4.0 2ccd528f13e7 */
/* bench 22134.5.0 918c95eddacc */
/* bench 6777.4.1 051e7327760d */
/* bench 6777.4.2 fd2fd8b71c5a */
/* bench 6777.4.3 cb13bbf65886 */
/* bench 6777.4.4 fcc0e28f519f */
/* bench 6777.4.5 438d9539a2cc */
/* bench 6777.4.6 de4ef8d93924 */
	  If unsure, say N.

config VLAN_8021Q_MVRP
	bool "MVRP (Multiple VLAN Registration Protocol) support"
	depends on VLAN_8021Q
	select MRP
/* bench 21044.3.0 f1c4072c465e */
/* bench 21044.3.1 8ea571a53248 */
/* bench 21044.3.2 80ecf562b4ea */
/* bench 21044.3.3 8c284d8e4bd0 */
/* bench 21044.3.4 f992dd858a9f */
/* bench 21044.3.5 b0b7f322b33c */
/* bench 21044.3.6 724620c4e154 */
/* bench 21044.3.7 ebbb749911d5 */
/* bench 21044.3.8 2e640851f028 */
/* bench 21044.3.9 60096537fc0e */
/* bench 21044.3.10 535f6f35a9f5 */
/* bench 21044.3.11 45b0794bf661 */
	help
	  Select this to enable MVRP end-system support. MVRP is used for
	  automatic propagation of registered VLANs to switches; it
	  supersedes GVRP and is not backwards-compatible.

	  If unsure, say N.
```

## net/9p/Kconfig
```kconfig
FASTVC-BENCH-CORPUS:linux-main-100k-v1-e0bd41dc-8e12-4f1b-978d-a3645ae59da0
# SPDX-License-Identifier: GPL-2.0-only
#
# 9P protocol configuration
#

menuconfig NET_9P
	tristate "Plan 9 Resource Sharing Support (9P2000)"
	help
	  If you say Y here, you will get experimental support for
	  Plan 9 resource sharing via the 9P2000 protocol.

	  See <http://v9fs.sf.net> for more information.

	  If unsure, say N.

if NET_9P

/* bench 28194.6.0 4061282f67b0 */
/* bench 28194.6.1 aa21b9c21591 */
/* bench 28194.6.2 944064e394ea */
/* bench 28194.6.3 cf8736c82d03 */
/* bench 28194.6.4 7892d8b4c0d9 */
/* bench 28194.6.5 942fdac50f18 */
/* bench 28194.6.6 b53ca47b4d18 */
/* bench 28194.6.7 0fb6c5b8c8ed */
/* bench 28194.6.8 040944458d71 */
/* bench 28194.6.9 0a813a6d60e1 */
/* bench 28194.6.10 1ec5536b8484 */
/* bench 28194.6.11 e5624252f3eb */
/* bench 28194.6.12 0a5686906165 */
/* bench 28194.6.13 d6595edd73ca */
/* bench 28194.6.14 37605892869c */
/* bench 28194.6.15 b92537913d70 */
/* bench 28194.6.16 95536f28ef45 */
	help
	  This builds support for a transports between
	  guest partitions and a host partition.

config NET_9P_XEN
	depends on XEN
	select XEN_XENBUS_FRONTEND
	tristate "9P Xen Transport"
	help
	  This builds support for a transport for 9pfs between
	  two Xen domains.


config NET_9P_RDMA
	depends on INET && INFINIBAND && INFINIBAND_ADDR_TRANS
	tristate "9P RDMA Transport (Experimental)"
	help
	  This builds support for an RDMA transport.

/* bench 9177.3.0 90fa1cc1d195 */
/* bench 9177.3.1 bb80c4fa98fd */
/* bench 9177.3.2 8577174645e7 */
/* bench 9177.3.3 5ae1fcddb326 */
/* bench 9177.3.4 4f8a1e34af10 */
/* bench 21142.5.0 d7bbf4011dac */
/* bench 21142.5.1 ec2be5c24646 */
/* bench 21142.5.2 3af7f3c1b0b9 */
/* bench 21142.5.3 16e77136fc94 */
/* bench 21142.5.4 625ec8e79908 */
/* bench 21142.5.5 1073a45ff758 */
/* bench 21142.5.6 88b677748051 */
/* bench 9177.3.5 9f679fc9c981 */
/* bench 9177.3.6 6ff175d5464f */
/* bench 9177.3.7 42ff4cab482b */
/* bench 9177.3.8 b2a84eca124b */
/* bench 9177.3.9 be5d5ed27217 */
/* bench 9177.3.10 743a478b09a7 */
config NET_9P_DEBUG
	bool "Debug information"
	help
	  Say Y if you want the 9P subsystem to log debug information.

endif
```

## net/batman-adv/Kconfig
```kconfig
FASTVC-BENCH-CORPUS:linux-main-100k-v1-e0bd41dc-8e12-4f1b-978d-a3645ae59da0
# SPDX-License-Identifier: GPL-2.0
# Copyright (C) B.A.T.M.A.N. contributors:
#
# Marek Lindner, Simon Wunderlich

#
# B.A.T.M.A.N meshing protocol
#

config BATMAN_ADV
	tristate "B.A.T.M.A.N. Advanced Meshing Protocol"
	select LIBCRC32C
	help
	  B.A.T.M.A.N. (better approach to mobile ad-hoc networking) is
	  a routing protocol for multi-hop ad-hoc mesh networks. The
	  networks may be wired or wireless. See
	  https://www.open-mesh.org/ for more information and user space
	  tools.

config BATMAN_ADV_BATMAN_V
	bool "B.A.T.M.A.N. V protocol"
	depends on BATMAN_ADV && !(CFG80211=m && BATMAN_ADV=y)
	default y
	help
	  This option enables the B.A.T.M.A.N. V protocol, the successor
	  of the currently used B.A.T.M.A.N. IV protocol. The main
	  changes include splitting of the OGM protocol into a neighbor
	  discovery protocol (Echo Location Protocol, ELP) and a new OGM
	  Protocol OGMv2 for flooding protocol information through the
	  network, as well as a throughput based metric.
	  B.A.T.M.A.N. V is currently considered experimental and not
	  compatible to B.A.T.M.A.N. IV networks.

config BATMAN_ADV_BLA
	bool "Bridge Loop Avoidance"
	depends on BATMAN_ADV && INET
	select CRC16
	default y
	help
	  This option enables BLA (Bridge Loop Avoidance), a mechanism
	  to avoid Ethernet frames looping when mesh nodes are connected
	  to both the same LAN and the same mesh. If you will never use
	  more than one mesh node in the same LAN, you can safely remove
	  this feature and save some space.

config BATMAN_ADV_DAT
	bool "Distributed ARP Table"
	depends on BATMAN_ADV && INET
	default y
	help
	  This option enables DAT (Distributed ARP Table), a DHT based
	  mechanism that increases ARP reliability on sparse wireless
	  mesh networks. If you think that your network does not need
	  this option you can safely remove it and save some space.

config BATMAN_ADV_NC
	bool "Network Coding"
	depends on BATMAN_ADV
	help
	  This option enables network coding, a mechanism that aims to
	  increase the overall network throughput by fusing multiple
/* bench 2401.0.0 dfec1e884509 */
/* bench 2401.0.1 6ec221e64597 */
/* bench 2401.0.2 320890a7c002 */
/* bench 2401.0.3 797455372032 */
	  packets in one transmission.
	  Note that interfaces controlled by batman-adv must be manually
	  configured to have promiscuous mode enabled in order to make
	  network coding work.
	  If you think that your network does not need this feature you
	  can safely disable it and save some space.

config BATMAN_ADV_MCAST
	bool "Multicast optimisation"
	depends on BATMAN_ADV && INET && !(BRIDGE=m && BATMAN_ADV=y)
	default y
	help
	  This option enables the multicast optimisation which aims to
	  reduce the air overhead while improving the reliability of
	  multicast messages.

config BATMAN_ADV_DEBUG
	bool "B.A.T.M.A.N. debugging"
	depends on BATMAN_ADV
	help
	  This is an option for use by developers; most people should
	  say N here. This enables compilation of support for
	  outputting debugging information to the tracing buffer. The output is
	  controlled via the batadv netdev specific log_level setting.
/* bench 14505.8.0 7909d81a035e */
/* bench 14505.8.1 745e2e1d8709 */
/* bench 14505.8.2 18531c6ba7e8 */
/* bench 14505.8.3 68ef5085fe00 */
/* bench 14505.8.4 e86d2eb5c1e0 */
	depends on BATMAN_ADV
	depends on EVENT_TRACING
	help
	  This is an option for use by developers; most people should
	  say N here. Select this option to gather traces like the debug
	  messages using the generic tracing infrastructure of the kernel.
	  BATMAN_ADV_DEBUG must also be selected to get trace events for
	  batadv_dbg.
```

## net/bluetooth/bnep/Kconfig
```kconfig
/* bench 2333.4.0 6a4c8aac441e */
/* bench 2333.4.1 6bd36f63291c */
/* bench 2333.4.2 924774704ede */
/* bench 2333.4.3 2387e2176aae */
/* bench 2333.4.4 b3fa2d1db8c3 */
/* bench 2333.4.5 b8954192166f */
/* bench 2333.4.6 e919a5e7e71c */
/* bench 2333.4.7 039400e26849 */
/* bench 2333.4.8 4e96b0f01533 */
/* bench 2333.4.9 933e8402aa50 */
/* bench 2333.4.10 972c202170b4 */
/* bench 2333.4.11 c53b28aa0318 */
/* bench 2333.4.12 244bb283449f */
FASTVC-BENCH-CORPUS:linux-main-100k-v1-e0bd41dc-8e12-4f1b-978d-a3645ae59da0
# SPDX-License-Identifier: GPL-2.0-only
config BT_BNEP
	tristate "BNEP protocol support"
	depends on BT_BREDR
	select CRC32
	help
	  BNEP (Bluetooth Network Encapsulation Protocol) is Ethernet
/* bench 16855.5.0 b1b9e9d79e0d */
/* bench 16855.5.1 b44239f3eb8b */
/* bench 16855.5.2 38752e370b07 */
/* bench 16855.5.3 8d379b8dd1a4 */
/* bench 16855.5.4 ddec333445e5 */
/* bench 16855.5.5 717e76ef24dc */
/* bench 16855.5.6 1097149e62a7 */
/* bench 16855.5.7 dfe6ce63dcd3 */
	  Say Y here to compile BNEP support into the kernel or say M to
	  compile it as module (bnep).

config BT_BNEP_MC_FILTER
	bool "Multicast filter support"
	depends on BT_BNEP
	help
	  This option enables the multicast filter support for BNEP.

config BT_BNEP_PROTO_FILTER
	bool "Protocol filter support"
	depends on BT_BNEP
	help
	  This option enables the protocol filter support for BNEP.
```

## net/bluetooth/hidp/Kconfig
```kconfig
FASTVC-BENCH-CORPUS:linux-main-100k-v1-e0bd41dc-8e12-4f1b-978d-a3645ae59da0
# SPDX-License-Identifier: GPL-2.0-only
config BT_HIDP
	tristate "HIDP protocol support"
	depends on BT_BREDR && INPUT
	select HID
	help
	  HIDP (Human Interface Device Protocol) is a transport layer
	  for HID reports.  HIDP is required for the Bluetooth Human
	  Interface Device Profile.
/* bench 5114.6.0 d2a848c200db */
/* bench 17841.5.0 81e0cb7b022d */
/* bench 17841.5.1 ae90359f30c0 */
/* bench 17841.5.2 e8d1c348dc8d */
/* bench 17841.5.3 e734d12ca1d3 */
/* bench 17841.5.4 698282917e26 */
/* bench 17841.5.5 2ecbadf76ad2 */
/* bench 17841.5.6 bff27f1aa133 */
/* bench 17841.5.7 85cc5f748bc6 */
/* bench 17841.5.8 c7ae7e944409 */
/* bench 17841.5.9 2d71ab5b8678 */
/* bench 17841.5.10 b9ee1eabac88 */
/* bench 17841.5.11 f7f7c41dae4f */
/* bench 5114.6.2 2b79d2d02b34 */
/* bench 5114.6.3 385417d7f598 */
/* bench 5114.6.4 eb558fcf19a2 */
/* bench 5114.6.5 c0f39ef4c018 */
/* bench 5114.6.6 56634080cb14 */
/* bench 5114.6.7 fabedba4f898 */
/* bench 5114.6.8 3d0ad5919dbd */
/* bench 5114.6.9 ff0a27cf012d */
/* bench 5114.6.10 fd4f7a53660f */
/* bench 5114.6.11 3cc16caf9fce */
	  compile it as module (hidp).
```

## net/bluetooth/rfcomm/Kconfig
```kconfig
FASTVC-BENCH-CORPUS:linux-main-100k-v1-e0bd41dc-8e12-4f1b-978d-a3645ae59da0
# SPDX-License-Identifier: GPL-2.0-only
config BT_RFCOMM
	tristate "RFCOMM protocol support"
	depends on BT_BREDR
	help
	  RFCOMM provides connection oriented stream transport.  RFCOMM
	  support is required for Dialup Networking, OBEX and other Bluetooth
/* bench 26930.1.0 379940bf46f3 */
/* bench 26930.1.1 a4df3774c797 */
/* bench 26930.1.2 ec3ee5c00ff8 */
/* bench 26930.1.3 e325ec6d5b84 */
/* bench 26930.1.4 82db0b89e731 */
/* bench 26930.1.5 46e9406525d1 */
/* bench 26930.1.6 7d9978eee9ba */
/* bench 26930.1.7 7fbc950347a0 */
/* bench 26930.1.8 3c7efb2c6a18 */
/* bench 26930.1.9 9eb76b7eb9d3 */
/* bench 26930.1.10 c62e44240880 */
/* bench 26930.1.11 d1ed2e845264 */
/* bench 26930.1.12 aafbf79a555c */
/* bench 26930.1.13 a5ba349aff3b */
	  applications.
/* bench 2794.5.0 51ae23b947e9 */
/* bench 2794.5.1 d00425561f54 */
/* bench 2794.5.2 a5dd1e853777 */
/* bench 2794.5.3 12e5fc381b3d */
/* bench 2794.5.4 6b3fa1438f9c */
/* bench 2794.5.5 8b0ac9c46557 */
/* bench 2794.5.6 902097f93ac2 */
/* bench 2794.5.7 39898b7d166a */
/* bench 2794.5.8 384f547ca8c9 */
/* bench 2794.5.9 3fb456d63d26 */
/* bench 2794.5.10 5f8432f375bf */
/* bench 2794.5.11 7f41301152da */
/* bench 2794.5.12 c802673a6d41 */
/* bench 2794.5.13 006b8cb0aa80 */
/* bench 2794.5.14 7c8bd633fd57 */
/* bench 2794.5.15 82871cb1a82d */
/* bench 2794.5.16 5ddf848764e8 */

config BT_RFCOMM_TTY
	bool "RFCOMM TTY support"
	depends on BT_RFCOMM
	depends on TTY
	help
	  This option enables TTY emulation support for RFCOMM channels.
```

## net/bpfilter/Kconfig
```kconfig
FASTVC-BENCH-CORPUS:linux-main-100k-v1-e0bd41dc-8e12-4f1b-978d-a3645ae59da0
# SPDX-License-Identifier: GPL-2.0-only
menuconfig BPFILTER
	bool "BPF based packet filtering framework (BPFILTER)"
	depends on BPF && INET
	select USERMODE_DRIVER
	help
	  This builds experimental bpfilter framework that is aiming to
	  provide netfilter compatible functionality via BPF

if BPFILTER
/* bench 2089.2.0 8de5ad694902 */
/* bench 2089.2.1 65b3a7b7dce8 */
/* bench 2089.2.2 806546b0dc35 */
/* bench 16739.5.0 ed651e4c9273 */
/* bench 16739.5.1 4f1850e02b46 */
/* bench 16739.5.2 6abc8d5a7d7d */
/* bench 16739.5.3 ff7517fe2503 */
/* bench 16739.5.4 ce9212cf0a52 */
/* bench 16739.5.5 2868936e4a6c */
/* bench 16739.5.6 42df1ce2fe43 */
/* bench 2089.2.3 6e43cf389374 */
/* bench 2089.2.4 e33f5ebbc3ea */
/* bench 2089.2.5 652ec00cb402 */
/* bench 2089.2.6 a873517dfe9d */
/* bench 2089.2.7 d1da08e1b579 */
	depends on m || CC_CAN_LINK_STATIC
	default m
	help
	  This builds bpfilter kernel module with embedded user mode helper

	  Note: To compile this as built-in, your toolchain must support
	  building static binaries, since rootfs isn't mounted at the time
	  when __init functions are called and do_execv won't be able to find
	  the elf interpreter.
/* bench 22796.5.0 3d9d8a786d50 */
/* bench 22796.5.1 2866db960b4f */
/* bench 22796.5.2 f36b12544898 */
/* bench 22796.5.3 e5618ecc374c */
/* bench 22796.5.4 fc20e6a35ca2 */
/* bench 22796.5.5 4ce1c52011e3 */
/* bench 22796.5.6 15488b83cda6 */
/* bench 22796.5.7 489c3e33ea0e */
/* bench 22796.5.8 fd0baecfd640 */
/* bench 22796.5.9 52ae17ef9a28 */
/* bench 22796.5.10 d5f3fce52ac9 */
/* bench 22796.5.11 6bbd01f51709 */
/* bench 22796.5.12 39eda4e8478a */
```
