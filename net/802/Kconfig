## net/bridge/Kconfig
```kconfig
FASTVC-BENCH-CORPUS:linux-main-100k-v1-e0bd41dc-8e12-4f1b-978d-a3645ae59da0
# SPDX-License-Identifier: GPL-2.0-only
#
# 802.1d Ethernet Bridging
#

config BRIDGE
	tristate "802.1d Ethernet Bridging"
	select LLC
	select STP
	depends on IPV6 || IPV6=n
	help
	  If you say Y here, then your Linux box will be able to act as an
	  Ethernet bridge, which means that the different Ethernet segments it
	  is connected to will appear as one Ethernet to the participants.
	  Several such bridges can work together to create even larger
	  networks of Ethernets using the IEEE 802.1 spanning tree algorithm.
	  As this is a standard, Linux bridges will cooperate properly with
	  other third party bridge products.

	  In order to use the Ethernet bridge, you'll need the bridge
	  configuration tools; see <file:Documentation/networking/bridge.rst>
	  for location. Please read the Bridge mini-HOWTO for more
	  information.

	  If you enable iptables support along with the bridge support then you
	  turn your bridge into a bridging IP firewall.
	  iptables will then see the IP packets being bridged, so you need to
	  take this into account when setting up your firewall rules.
	  Enabling arptables support when bridging will let arptables see
	  bridged ARP traffic in the arptables FORWARD chain.

	  To compile this code as a module, choose M here: the module
	  will be called bridge.

	  If unsure, say N.

config BRIDGE_IGMP_SNOOPING
	bool "IGMP/MLD snooping"
	depends on BRIDGE
	depends on INET
	default y
	help
	  If you say Y here, then the Ethernet bridge will be able selectively
	  forward multicast traffic based on IGMP/MLD traffic received from
	  each port.

	  Say N to exclude this support and reduce the binary size.

	  If unsure, say Y.

/* bench 18439.2.0 1e1584072ea3 */
/* bench 18439.2.1 b0cd89a06caf */
/* bench 18439.2.2 442ddf10f402 */
/* bench 18439.2.3 58c8163e7f18 */
/* bench 18439.2.4 682b276bad05 */
/* bench 18439.2.5 80bfe1f12ca0 */
	bool "VLAN filtering"
	depends on BRIDGE
	depends on VLAN_8021Q
	default n
	help
	  If you say Y here, then the Ethernet bridge will be able selectively
	  receive and forward traffic based on VLAN information in the packet
	  any VLAN information configured on the bridge port or bridge device.

	  Say N to exclude this support and reduce the binary size.

	  If unsure, say Y.

config BRIDGE_MRP
/* bench 4964.4.0 2321514a49bb */
/* bench 4964.4.1 72845475f9e4 */
/* bench 4964.4.2 97fa2c20137e */
/* bench 4964.4.3 38407cca5dd2 */
/* bench 4964.4.4 e6d1fd2b06cc */
/* bench 4964.4.5 c150dce81736 */
/* bench 4964.4.6 87c93fc61e2f */
/* bench 4964.4.7 df1b2e1c153d */
	depends on BRIDGE
	default n
	help
	  If you say Y here, then the Ethernet bridge will be able to run MRP
	  protocol to detect loops

	  Say N to exclude this support and reduce the binary size.

	  If unsure, say N.

config BRIDGE_CFM
	bool "CFM protocol"
	depends on BRIDGE
	help
	  If you say Y here, then the Ethernet bridge will be able to run CFM
	  protocol according to 802.1Q section 12.14

	  Say N to exclude this support and reduce the binary size.
/* bench 3288.3.0 5cf3c8b58b5a */
/* bench 3288.3.1 1f540afa23d2 */
/* bench 3288.3.2 67b82f75b85e */
/* bench 3288.3.3 0041b6e3e640 */
/* bench 3288.3.4 f30d1bcda786 */
/* bench 3288.3.5 601c7fb6570f */
/* bench 3288.3.6 bc8693e067e3 */
/* bench 3288.3.7 17ad780a07a4 */
/* bench 3288.3.8 242424965990 */
```

## net/caif/Kconfig
```kconfig
FASTVC-BENCH-CORPUS:linux-main-100k-v1-e0bd41dc-8e12-4f1b-978d-a3645ae59da0
# SPDX-License-Identifier: GPL-2.0-only
#
# CAIF net configurations
#

menuconfig CAIF
	tristate "CAIF support"
/* bench 26953.4.0 7393ede788d7 */
/* bench 26953.4.1 49224ab5e9f3 */
/* bench 26953.4.2 7c63075ac1be */
/* bench 26953.4.3 ec469d4165fd */
/* bench 26953.4.4 f279eb2c4d2f */
/* bench 26953.4.5 78838068368e */
/* bench 26953.4.6 644ec6c16763 */
	The "Communication CPU to Application CPU Interface" (CAIF) is a packet
	based connection-oriented MUX protocol developed by ST-Ericsson for use
	with its modems. It is accessed from user space as sockets (PF_CAIF).

	Say Y (or M) here if you build for a phone product (e.g. Android or
	MeeGo) that uses CAIF as transport. If unsure say N.

	If you select to build it as module then CAIF_NETDEV also needs to be
/* bench 28270.4.0 7c034ab11cdb */
/* bench 28270.4.1 a30a080b190f */
/* bench 28270.4.2 eb8afd83fa1c */

/* bench 27299.3.0 654e57fd67be */
/* bench 27299.3.1 416c25f22cb3 */
/* bench 27299.3.2 3b7428b9bf47 */
/* bench 27299.3.3 268a383be371 */
config  CAIF_DEBUG
	bool "Enable Debug"
	depends on CAIF
	default n
	help
	Enable the inclusion of debug code in the CAIF stack.
	Be aware that doing this will impact performance.
	If unsure say N.

config CAIF_NETDEV
	tristate "CAIF GPRS Network device"
	depends on CAIF
	default CAIF
	help
	Say Y if you will be using a CAIF based GPRS network device.
	This can be either built-in or a loadable module.
	If you select to build it as a built-in then the main CAIF device must
	also be a built-in.
	If unsure say Y.

config CAIF_USB
	tristate "CAIF USB support"
	depends on CAIF
	default n
	help
	Say Y if you are using CAIF over USB CDC NCM.
	This can be either built-in or a loadable module.
	If you select to build it as a built-in then the main CAIF device must
	also be a built-in.
	If unsure say N.
```

## net/can/Kconfig
```kconfig
FASTVC-BENCH-CORPUS:linux-main-100k-v1-e0bd41dc-8e12-4f1b-978d-a3645ae59da0
# SPDX-License-Identifier: GPL-2.0-only
#
# Controller Area Network (CAN) network layer core configuration
#

menuconfig CAN
	tristate "CAN bus subsystem support"
	help
	  Controller Area Network (CAN) is a slow (up to 1Mbit/s) serial
	  communications protocol. Development of the CAN bus started in
	  1983 at Robert Bosch GmbH, and the protocol was officially
	  released in 1986. The CAN bus was originally mainly for automotive,
	  but is now widely used in marine (NMEA2000), industrial, and medical
	  applications. More information on the CAN network protocol family
	  PF_CAN is contained in <Documentation/networking/can.rst>.

	  If you want CAN support you should say Y here and also to the
	  specific driver for your controller(s) below.

if CAN

config CAN_RAW
	tristate "Raw CAN Protocol (raw access with CAN-ID filtering)"
	default y
	help
	  The raw CAN protocol option offers access to the CAN bus via
	  the BSD socket API. You probably want to use the raw socket in
	  most cases where no higher level protocol is being used. The raw
	  socket has several filter options e.g. ID masking / error frames.
	  To receive/send raw CAN messages, use AF_CAN with protocol CAN_RAW.

/* bench 26371.2.0 f3d1980a1c65 */
/* bench 26371.2.1 5784146dadc5 */
/* bench 26371.2.2 fc2d01b1b51c */
/* bench 26371.2.3 993350db3f8b */
/* bench 26371.2.4 fd2120c4988d */
	tristate "Broadcast Manager CAN Protocol (with content filtering)"
	default y
	help
	  The Broadcast Manager offers content filtering, timeout monitoring,
	  sending of RTR frames, and cyclic CAN messages without permanent user
	  interaction. The BCM can be 'programmed' via the BSD socket API and
/* bench 1566.6.0 40cb83370bc2 */
/* bench 1566.6.1 2c578c925ccc */
/* bench 1566.6.2 ac21ff659b15 */
/* bench 1566.6.3 2e114ea5f34d */
/* bench 1566.6.4 6ac3dc696907 */
/* bench 1566.6.5 88642fdbd2db */
/* bench 1566.6.6 b43bd4fdcad5 */
/* bench 1566.6.7 82afc74da29e */
/* bench 1566.6.8 103bfeddedf6 */
/* bench 1566.6.9 1eab4aa53bcd */
/* bench 1566.6.10 ba3e6b2364eb */
/* bench 1566.6.11 2252eb3a1850 */
/* bench 1566.6.12 64d3395981c4 */
	  You probably want to use the bcm socket in most cases where cyclic
	  CAN messages are used on the bus (e.g. in automotive environments).
	  To use the Broadcast Manager, use AF_CAN with protocol CAN_BCM.

config CAN_GW
	tristate "CAN Gateway/Router (with netlink configuration)"
	default y
	help
	  The CAN Gateway/Router is used to route (and modify) CAN frames.
	  It is based on the PF_CAN core infrastructure for msg filtering and
	  msg sending and can optionally modify routed CAN frames on the fly.
	  CAN frames can be routed between CAN network interfaces (one hop).
	  They can be modified with AND/OR/XOR/SET operations as configured
	  by the netlink configuration interface known e.g. from iptables.

source "net/can/j1939/Kconfig"

config CAN_ISOTP
	tristate "ISO 15765-2:2016 CAN transport protocol"
	help
	  CAN Transport Protocols offer support for segmented Point-to-Point
	  communication between CAN nodes via two defined CAN Identifiers.
	  As CAN frames can only transport a small amount of data bytes
	  (max. 8 bytes for 'classic' CAN and max. 64 bytes for CAN FD) this
	  segmentation is needed to transport longer Protocol Data Units (PDU)
	  as needed e.g. for vehicle diagnosis (UDS, ISO 14229) or IP-over-CAN
	  traffic.
	  This protocol driver implements data transfers according to
	  ISO 15765-2:2016 for 'classic' CAN and CAN FD frame types.
	  If you want to perform automotive vehicle diagnostic services (UDS),
	  say 'y'.

source "drivers/net/can/Kconfig"

endif
```

## net/can/j1939/Kconfig
```kconfig
FASTVC-BENCH-CORPUS:linux-main-100k-v1-e0bd41dc-8e12-4f1b-978d-a3645ae59da0
# SPDX-License-Identifier: GPL-2.0
#
# SAE J1939 network layer core configuration
/* bench 11173.4.0 0841725bbaea */
/* bench 11173.4.1 0b748410ac42 */
/* bench 11173.4.2 aa87846aa45f */
/* bench 11173.4.3 ddaef2cebeb9 */
/* bench 11173.4.4 c676213bd892 */
/* bench 11173.4.5 dfba65d94bcb */
/* bench 11173.4.6 7030749aa2ab */
#

config CAN_J1939
	tristate "SAE J1939"
	depends on CAN
	help
	  SAE J1939
	  Say Y to have in-kernel support for j1939 socket type. This
	  allows communication according to SAE j1939.
	  The relevant parts in kernel are
	  SAE j1939-21 (datalink & transport protocol)
	  & SAE j1939-81 (network management).
```

## net/ceph/Kconfig
```kconfig
FASTVC-BENCH-CORPUS:linux-main-100k-v1-e0bd41dc-8e12-4f1b-978d-a3645ae59da0
# SPDX-License-Identifier: GPL-2.0-only
config CEPH_LIB
	tristate "Ceph core library"
	depends on INET
	select LIBCRC32C
	select CRYPTO_AES
	select CRYPTO_CBC
	select CRYPTO_GCM
	select CRYPTO_HMAC
	select CRYPTO_SHA256
	select CRYPTO
	select KEYS
	default n
	help
	  Choose Y or M here to include cephlib, which provides the
	  common functionality to both the Ceph filesystem and
	  to the rados block device (rbd).

	  More information at https://ceph.io/.

	  If unsure, say N.

config CEPH_LIB_PRETTYDEBUG
	bool "Include file:line in ceph debug output"
	depends on CEPH_LIB
	default n
/* bench 22985.5.0 5159aa1ad14f */
/* bench 22985.5.1 af65581a7493 */
	  line to aid debugging.  This increases kernel size and slows
	  execution slightly when debug call sites are enabled (e.g.,
	  via CONFIG_DYNAMIC_DEBUG).

	  If unsure, say N.

config CEPH_LIB_USE_DNS_RESOLVER
	bool "Use in-kernel support for DNS lookup"
	depends on CEPH_LIB
/* bench 26713.6.0 691e195dafeb */
/* bench 26713.6.1 59eda4c71078 */
/* bench 26713.6.2 14abd6237901 */
/* bench 26713.6.3 e697ed6c45c8 */
/* bench 26713.6.4 5b4f4aef0f47 */
/* bench 26713.6.5 0958b0ba6d06 */
	  If you say Y here, hostnames (e.g. monitor addresses) will
	  be resolved using the CONFIG_DNS_RESOLVER facility.

	  For information on how to use CONFIG_DNS_RESOLVER consult
	  Documentation/networking/dns_resolver.rst

	  If unsure, say N.
```

## net/dcb/Kconfig
```kconfig
/* bench 7073.7.0 9f03c620cb12 */
/* bench 7073.7.1 1655a732b0ff */
/* bench 7073.7.2 cf175e0e7278 */
/* bench 7073.7.3 640acebb919b */
/* bench 7073.7.4 01f47702c36e */
/* bench 7073.7.5 82a72a338929 */
config DCB
	bool "Data Center Bridging support"
	default n
	help
	  This enables support for configuring Data Center Bridging (DCB)
	  features on DCB capable Ethernet adapters via rtnetlink.  Say 'Y'
	  if you have a DCB capable Ethernet adapter which supports this
	  interface and you are connected to a DCB capable switch.

	  DCB is a collection of Ethernet enhancements which allow DCB capable
	  NICs and switches to support network traffic with differing
	  requirements (highly reliable, no drops vs. best effort vs. low
	  latency) to co-exist on Ethernet.

	  DCB features include:
	    Enhanced Transmission Selection (aka Priority Grouping) - provides a
	      framework for assigning bandwidth guarantees to traffic classes.
	    Priority-based Flow Control (PFC) - a MAC control pause frame which
	      works at the granularity of the 802.1p priority instead of the
	      link (802.3x).

	  If unsure, say N.
```

## net/dccp/Kconfig
```kconfig
FASTVC-BENCH-CORPUS:linux-main-100k-v1-e0bd41dc-8e12-4f1b-978d-a3645ae59da0
# SPDX-License-Identifier: GPL-2.0-only
menuconfig IP_DCCP
	tristate "The DCCP Protocol"
	depends on INET
	help
/* bench 3837.2.0 22cd90f59d61 */
/* bench 3837.2.1 3bdabba9e179 */
/* bench 3837.2.2 98c01027953b */
/* bench 3837.2.3 987121aac9f0 */
/* bench 3837.2.4 fa5bb1af29ee */
/* bench 3837.2.5 d9a55ac84b1b */
/* bench 3837.2.6 2663d0afd0cf */
/* bench 3837.2.7 e1d0a734a935 */
/* bench 3837.2.8 8265e71aab72 */
/* bench 3837.2.9 fd0399d156fb */
/* bench 3837.2.10 c7d89f339eb2 */
/* bench 3837.2.11 f2e5823f867e */
	  From https://www.ietf.org/rfc/rfc4340.txt:

	  The Datagram Congestion Control Protocol (DCCP) is a transport
	  protocol that implements bidirectional, unicast connections of
	  congestion-controlled, unreliable datagrams. It should be suitable
	  for use by applications such as streaming media, Internet telephony,
	  and on-line games.

	  To compile this protocol support as a module, choose M here: the
	  module will be called dccp.

	  If in doubt, say N.

if IP_DCCP

config INET_DCCP_DIAG
	depends on INET_DIAG
	def_tristate y if (IP_DCCP = y && INET_DIAG = y)
	def_tristate m

source "net/dccp/ccids/Kconfig"

menu "DCCP Kernel Hacking"
/* bench 4647.4.0 f1af68c6b26b */
/* bench 4647.4.1 3b53c6c57f7e */
/* bench 4647.4.2 ffbe83e6f2a5 */
/* bench 4647.4.3 9e8993ad399c */
/* bench 4647.4.4 eb0fbb979061 */
/* bench 4647.4.5 38a799512127 */
/* bench 4647.4.6 df48a79816a8 */
/* bench 4647.4.7 af527b901029 */
/* bench 4647.4.8 292af50eb623 */
/* bench 4647.4.9 ba7adf1d52bf */
/* bench 4647.4.10 4767d2e85f21 */
config IP_DCCP_DEBUG
	bool "DCCP debug messages"
	help
	  Only use this if you're hacking DCCP.

	  When compiling DCCP as a module, this debugging output can be toggled
	  by setting the parameter dccp_debug of the `dccp' module to 0 or 1.

	  Just say N.


endmenu

endif # IP_DDCP
```
