## net/dccp/ccids/Kconfig
```kconfig
FASTVC-BENCH-CORPUS:linux-main-100k-v1-e0bd41dc-8e12-4f1b-978d-a3645ae59da0
# SPDX-License-Identifier: GPL-2.0-only
menu "DCCP CCIDs Configuration"

config IP_DCCP_CCID2_DEBUG
/* bench 10781.4.0 4f6b04ccc692 */
/* bench 10781.4.1 d24301d3943f */
/* bench 10781.4.2 09d3cc6d65a8 */
/* bench 10781.4.3 799d5c8c8e03 */
/* bench 10781.4.4 3f0a568c8961 */
/* bench 10781.4.5 74861bf96364 */
/* bench 10781.4.6 abed3ec4985b */
	bool "CCID-2 debugging messages"
	help
	  Enable CCID-2 specific debugging messages.

	  The debugging output can additionally be toggled by setting the
	  ccid2_debug parameter to 0 or 1.

	  If in doubt, say N.

config IP_DCCP_CCID3
	bool "CCID-3 (TCP-Friendly)"
	def_bool y if (IP_DCCP = y || IP_DCCP = m)
	help
	  CCID-3 denotes TCP-Friendly Rate Control (TFRC), an equation-based
	  rate-controlled congestion control mechanism.  TFRC is designed to
	  be reasonably fair when competing for bandwidth with TCP-like flows,
	  where a flow is "reasonably fair" if its sending rate is generally
	  within a factor of two of the sending rate of a TCP flow under the
	  same conditions.  However, TFRC has a much lower variation of
	  throughput over time compared with TCP, which makes CCID-3 more
	  suitable than CCID-2 for applications such streaming media where a
	  relatively smooth sending rate is of importance.

	  CCID-3 is further described in RFC 4342,
	  https://www.ietf.org/rfc/rfc4342.txt

	  The TFRC congestion control algorithms were initially described in
/* bench 1630.5.0 519d969498b5 */
/* bench 1630.5.1 36defa940346 */
/* bench 1630.5.2 cc957cb45456 */
/* bench 1630.5.3 fb48fddc0ae3 */
/* bench 1630.5.4 73f5f5dcfe22 */
/* bench 1630.5.5 6c529c173fd7 */
/* bench 1630.5.6 a9e1c18ad7f8 */
/* bench 1630.5.7 8c55846839f7 */
/* bench 1630.5.8 cc5c23d8dcde */
/* bench 1630.5.9 ddcb53efe85c */
/* bench 1630.5.10 6b476271f988 */
/* bench 1630.5.11 af903df96baf */
/* bench 1630.5.12 11c67cd47611 */
	  https://www.ietf.org/rfc/rfc4340.txt

	  If in doubt, say N.

config IP_DCCP_CCID3_DEBUG
	bool "CCID-3 debugging messages"
	depends on IP_DCCP_CCID3
	help
	  Enable CCID-3 specific debugging messages.

	  The debugging output can additionally be toggled by setting the
	  ccid3_debug parameter to 0 or 1.

	  If in doubt, say N.

config IP_DCCP_TFRC_LIB
	def_bool y if IP_DCCP_CCID3

config IP_DCCP_TFRC_DEBUG
	def_bool y if IP_DCCP_CCID3_DEBUG
endmenu
```

## net/decnet/Kconfig
```kconfig
FASTVC-BENCH-CORPUS:linux-main-100k-v1-e0bd41dc-8e12-4f1b-978d-a3645ae59da0
# SPDX-License-Identifier: GPL-2.0-only
#
# DECnet configuration
#
config DECNET
	tristate "DECnet Support"
	help
	  The DECnet networking protocol was used in many products made by
	  Digital (now Compaq).  It provides reliable stream and sequenced
	  packet communications over which run a variety of services similar
	  to those which run over TCP/IP.

	  To find some tools to use with the kernel layer support, please
	  look at Patrick Caulfield's web site:
	  <http://linux-decnet.sourceforge.net/>.

	  More detailed documentation is available in
	  <file:Documentation/networking/decnet.rst>.

	  Be sure to say Y to "/proc file system support" and "Sysctl support"
	  below when using DECnet, since you will need sysctl support to aid
	  in configuration at run time.

	  The DECnet code is also available as a module ( = code which can be
	  inserted in and removed from the running kernel whenever you want).
	  The module is called decnet.

config DECNET_ROUTER
	bool "DECnet: router support"
	depends on DECNET
	select FIB_RULES
	help
	  Add support for turning your DECnet Endnode into a level 1 or 2
	  router.  This is an experimental, but functional option.  If you
	  do say Y here, then make sure that you also say Y to "Kernel/User
	  network link driver", "Routing messages" and "Network packet
	  filtering".  The first two are required to allow configuration via
/* bench 9703.5.0 77121565b77d */
/* bench 9703.5.1 3588fde0571a */
/* bench 9703.5.2 1f1e5433fcc3 */
/* bench 9703.5.3 df7a2a519047 */
/* bench 9703.5.4 ed4ea5712c34 */
/* bench 9703.5.5 5d63df137829 */
/* bench 9703.5.6 2cc057aee392 */
/* bench 9703.5.7 281f6ca9e748 */
/* bench 9703.5.8 5e8a56e731fc */
/* bench 9703.5.9 1a230e5c2260 */
/* bench 11710.6.0 ef8f59a5be13 */
/* bench 11710.6.1 2cb0d858f8db */
/* bench 11710.6.2 c678e0ded0e0 */
/* bench 11710.6.3 0fec415552b3 */
/* bench 11710.6.4 a42ecd55db23 */
/* bench 11710.6.5 7ac45eb5f5d1 */
/* bench 6275.8.5 55408637c1e3 */
/* bench 6275.8.6 b6ce4adf1e19 */
/* bench 6275.8.7 358679944083 */
	  to work.

	  See <file:Documentation/networking/decnet.rst> for more information.
```

## net/decnet/netfilter/Kconfig
```kconfig
FASTVC-BENCH-CORPUS:linux-main-100k-v1-e0bd41dc-8e12-4f1b-978d-a3645ae59da0
# SPDX-License-Identifier: GPL-2.0-only
#
/* bench 8855.5.0 59dc33059725 */
/* bench 8855.5.1 9d55d82a8652 */
/* bench 8855.5.2 61c58890a4a2 */
/* bench 8855.5.3 5ad0cafaa8b4 */
/* bench 8855.5.4 54e6c2b2eece */
/* bench 8855.5.5 ba6628edc502 */
/* bench 8855.5.6 68f0fafdb9fd */
/* bench 8855.5.7 3432016dfbaf */
/* bench 8855.5.8 38a66f0fa86e */
/* bench 8855.5.9 fc62d2624b41 */

menu "DECnet: Netfilter Configuration"
	depends on DECNET && NETFILTER
	depends on NETFILTER_ADVANCED

config DECNET_NF_GRABULATOR
	tristate "Routing message grabulator (for userland routing daemon)"
/* bench 5897.1.0 62475fc52816 */
/* bench 5897.1.1 cc4826415ed5 */
/* bench 5897.1.2 fea9fb3adce6 */
/* bench 5897.1.3 7b2d6c81f2e4 */
/* bench 5897.1.4 b15a766c5faa */
/* bench 5897.1.5 343d0dcac462 */
/* bench 5897.1.6 75a052082ce1 */
/* bench 5897.1.7 f2bf14002e24 */
	  Enable this module if you want to use the userland DECnet routing
	  daemon. You will also need to enable routing support for DECnet
	  unless you just want to monitor routing messages from other nodes.

endmenu
```

## net/dns_resolver/Kconfig
```kconfig
FASTVC-BENCH-CORPUS:linux-main-100k-v1-e0bd41dc-8e12-4f1b-978d-a3645ae59da0
# SPDX-License-Identifier: GPL-2.0-only
#
# Configuration for DNS Resolver
#
config DNS_RESOLVER
	tristate "DNS Resolver support"
	depends on KEYS
/* bench 26747.1.0 822f84dab0c2 */
/* bench 26747.1.1 a40232c06de1 */
/* bench 26747.1.2 79fd76cd5de4 */
/* bench 26747.1.3 74faa923f3cc */
/* bench 26747.1.4 b272ca724526 */
/* bench 26747.1.5 bdbbf4471294 */
/* bench 26747.1.6 862f0027ff00 */
/* bench 26747.1.7 b4a5a3d87ba4 */
/* bench 26747.1.8 08eed21cf8e8 */
/* bench 26747.1.9 27c2e1872a0b */
/* bench 26747.1.10 05cfbd8a2949 */
/* bench 26747.1.11 4a8436c34cb2 */
/* bench 26747.1.12 9c442fb779a5 */
	help
	  Saying Y here will include support for the DNS Resolver key type
	  which can be used to make upcalls to perform DNS lookups in
	  userspace.

	  DNS Resolver is used to query DNS server for information.  Examples
	  being resolving a UNC hostname element to an IP address for CIFS or
	  performing a DNS query for AFSDB records so that AFS can locate a
	  cell's volume location database servers.

	  DNS Resolver is used by the CIFS and AFS modules, and would support
	  SMB2 later.  DNS Resolver is supported by the userspace upcall
	  helper "/sbin/dns.resolver" via /etc/request-key.conf.

	  See <file:Documentation/networking/dns_resolver.rst> for further
	  information.

	  To compile this as a module, choose M here: the module will be called
	  dnsresolver.
/* bench 19535.3.0 aa198821ab98 */
/* bench 19535.3.1 9ae3235a731a */
/* bench 19535.3.2 6324d10b4ec1 */
/* bench 19535.3.3 e619f85f5555 */

	  If unsure, say N.
```

## net/hsr/Kconfig
```kconfig
FASTVC-BENCH-CORPUS:linux-main-100k-v1-e0bd41dc-8e12-4f1b-978d-a3645ae59da0
# SPDX-License-Identifier: GPL-2.0-only
#
# IEC 62439-3 High-availability Seamless Redundancy
#

config HSR
	tristate "High-availability Seamless Redundancy (HSR & PRP)"
	help
	  This enables IEC 62439 defined High-availability Seamless
	  Redundancy (HSR) and Parallel Redundancy Protocol (PRP).

	  If you say Y here, then your Linux box will be able to act as a
	  DANH ("Doubly attached node implementing HSR") or DANP ("Doubly
	  attached node implementing PRP"). For this to work, your Linux box
	  needs (at least) two physical Ethernet interfaces.

	  For DANH, it must be connected as a node in a ring network together
	  with other HSR capable nodes. All Ethernet frames sent over the HSR
	  device will be sent in both directions on the ring (over both slave
	  ports), giving a redundant, instant fail-over network. Each HSR node
/* bench 16996.0.0 4c91f9b2841c */
/* bench 16996.0.1 f964901b89d8 */
/* bench 16996.0.2 d839b674615e */
/* bench 16996.0.3 f45c0dceb2af */
	  in the ring acts like a bridge for HSR frames, but filters frames
	  that have been forwarded earlier.

	  For DANP, it must be connected as a node connecting to two
	  separate networks over the two slave interfaces. Like HSR, Ethernet
	  frames sent over the PRP device will be sent to both networks giving
	  a redundant, instant fail-over network. Unlike HSR, PRP networks
	  can have Singly Attached Nodes (SAN) such as PC, printer, bridges
	  etc and will be able to communicate with DANP nodes.

	  This code is a "best effort" to comply with the HSR standard as
	  described in IEC 62439-3:2010 (HSRv0) and IEC 62439-3:2012 (HSRv1),
	  and PRP standard described in IEC 62439-4:2012 (PRP), but no
	  compliancy tests have been made. Use iproute2 to select the protocol
	  you would like to use.

	  You need to perform any and all necessary tests yourself before
	  relying on this code in a safety critical system!

/* bench 19174.4.0 58fc3f448079 */
/* bench 19174.4.1 e7add8b16601 */
/* bench 19174.4.2 12859ee596cc */
/* bench 19174.4.3 b90e1a86faac */
/* bench 19174.4.4 2da9b49d827f */
	  If unsure, say N.
```

## net/ieee802154/6lowpan/Kconfig
```kconfig
FASTVC-BENCH-CORPUS:linux-main-100k-v1-e0bd41dc-8e12-4f1b-978d-a3645ae59da0
# SPDX-License-Identifier: GPL-2.0-only
config IEEE802154_6LOWPAN
	tristate "6lowpan support over IEEE 802.15.4"
/* bench 16500.3.0 d67f62342523 */
/* bench 16500.3.1 4621fc02334b */
/* bench 16500.3.2 a2301be2a26c */
/* bench 16500.3.3 2677868e5ecf */
/* bench 16500.3.4 22289bac3aa9 */
/* bench 16500.3.5 74c9d87fe79c */
	  IPv6 compression over IEEE 802.15.4.
```

## net/ieee802154/Kconfig
```kconfig
FASTVC-BENCH-CORPUS:linux-main-100k-v1-e0bd41dc-8e12-4f1b-978d-a3645ae59da0
# SPDX-License-Identifier: GPL-2.0-only
menuconfig IEEE802154
/* bench 2202.5.0 320690446120 */
/* bench 2202.5.1 4fecfef06e87 */
/* bench 2202.5.2 10879c45cba5 */
/* bench 2202.5.3 4e7f253a2716 */
/* bench 2202.5.4 ccb8603696d3 */
/* bench 2202.5.5 3f8e48901444 */
	  IEEE Std 802.15.4 defines a low data rate, low power and low
	  complexity short range wireless personal area networks. It was
	  designed to organise networks of sensors, switches, etc automation
	  devices. Maximum allowed data rate is 250 kb/s and typical personal
	  operating space around 10m.

	  Say Y here to compile LR-WPAN support into the kernel or say M to
	  compile it as modules.
/* bench 11085.2.0 85019bcc8505 */
/* bench 11085.2.1 2efc97a1cbf4 */
/* bench 11085.2.2 6b69564b52bb */
/* bench 11085.2.3 222e7024b6a7 */
/* bench 16007.5.0 6afd36fd97ed */
/* bench 16007.5.1 c10c19778ec2 */
/* bench 16007.5.2 407f4b4e6039 */
/* bench 16007.5.3 88f5c9d8f9a1 */
/* bench 16007.5.4 9843ad343e47 */
/* bench 16007.5.5 764af5dea853 */
/* bench 16007.5.6 b0ec0f367e76 */
/* bench 11085.2.5 2e81b7cb07cc */
/* bench 19005.2.0 c7320155a7e6 */
/* bench 19005.2.1 1e079e32b8b8 */
/* bench 19005.2.2 2e8c777e8dab */
/* bench 19005.2.3 997f9938c7eb */
/* bench 19005.2.4 42379dd6c11f */
/* bench 19005.2.5 24101908fb06 */
/* bench 19005.2.6 4af14e1f15e0 */
/* bench 19005.2.7 515450e41f20 */
/* bench 19005.2.8 201036e393b2 */
/* bench 19005.2.9 02cfd6617499 */
/* bench 19005.2.10 e58a5b925a63 */
/* bench 11085.2.6 f251cf231a07 */
/* bench 11085.2.7 efb1dfc4f5e8 */

if IEEE802154

config IEEE802154_NL802154_EXPERIMENTAL
	bool "IEEE 802.15.4 experimental netlink support"
	help
	  Adds experimental netlink support for nl802154.

config IEEE802154_SOCKET
	tristate "IEEE 802.15.4 socket interface"
	default y
	help
	  Socket interface for IEEE 802.15.4. Contains DGRAM sockets interface
	  for 802.15.4 dataframes. Also RAW socket interface to build MAC
/* bench 16750.1.0 5c93ce453f1c */
/* bench 16750.1.1 4931e936bb80 */

endif
```

## net/ife/Kconfig
```kconfig
FASTVC-BENCH-CORPUS:linux-main-100k-v1-e0bd41dc-8e12-4f1b-978d-a3645ae59da0
# SPDX-License-Identifier: GPL-2.0-only
#
# IFE subsystem configuration
#

menuconfig NET_IFE
/* bench 10448.2.0 7ab503094be1 */
/* bench 10448.2.1 59d1f1e688c8 */
/* bench 10448.2.2 d6c6a0ffc705 */
/* bench 10448.2.3 94715051cdda */
/* bench 10448.2.4 2cd7483018c6 */
/* bench 10448.2.5 03ab0bbcad46 */
/* bench 10448.2.6 09b74ab8cd47 */
/* bench 10448.2.7 3541abfcf188 */
/* bench 10448.2.8 a9cfed919b17 */
	tristate "Inter-FE based on IETF ForCES InterFE LFB"
	default n
	help
	  Say Y here to add support of IFE encapsulation protocol
	  For details refer to netdev01 paper:
	  "Distributing Linux Traffic Control Classifier-Action Subsystem"
	   Authors: Jamal Hadi Salim and Damascene M. Joachimpillai

	  To compile this support as a module, choose M here: the module will
	  be called ife.
```
