## arch/m68k/Kconfig
```kconfig
FASTVC-BENCH-CORPUS:linux-main-100k-v1-e0bd41dc-8e12-4f1b-978d-a3645ae59da0
# SPDX-License-Identifier: GPL-2.0
config M68K
	bool
	default y
	select ARCH_32BIT_OFF_T
	select ARCH_HAS_BINFMT_FLAT
	select ARCH_HAS_DMA_PREP_COHERENT if HAS_DMA && MMU && !COLDFIRE
	select ARCH_HAS_SYNC_DMA_FOR_DEVICE if HAS_DMA
	select ARCH_HAVE_NMI_SAFE_CMPXCHG if RMW_INSNS
	select ARCH_MIGHT_HAVE_PC_PARPORT if ISA
	select ARCH_NO_PREEMPT if !COLDFIRE
	select ARCH_WANT_IPC_PARSE_VERSION
	select BINFMT_FLAT_ARGVP_ENVP_ON_STACK
	select DMA_DIRECT_REMAP if HAS_DMA && MMU && !COLDFIRE
	select GENERIC_ATOMIC64
	select GENERIC_CPU_DEVICES
	select GENERIC_IOMAP
	select GENERIC_IRQ_SHOW
	select GENERIC_STRNCPY_FROM_USER if MMU
	select GENERIC_STRNLEN_USER if MMU
	select HAVE_AOUT if MMU
	select HAVE_ASM_MODVERSIONS
	select HAVE_DEBUG_BUGVERBOSE
	select HAVE_FUTEX_CMPXCHG if MMU && FUTEX
	select HAVE_IDE
	select HAVE_MOD_ARCH_SPECIFIC
	select HAVE_UID16
	select MMU_GATHER_NO_RANGE if MMU
	select MODULES_USE_ELF_REL
	select MODULES_USE_ELF_RELA
	select NO_DMA if !MMU && !COLDFIRE
	select OLD_SIGACTION
	select OLD_SIGSUSPEND3
	select SET_FS
	select UACCESS_MEMCPY if !MMU
	select VIRT_TO_BUS

config CPU_BIG_ENDIAN
	def_bool y

config ARCH_HAS_ILOG2_U32
	bool

config ARCH_HAS_ILOG2_U64
	bool

config GENERIC_HWEIGHT
	bool
	default y

config GENERIC_CALIBRATE_DELAY
	bool
	default y

config GENERIC_CSUM
/* bench 17527.0.0 b95e63198609 */
/* bench 17527.0.1 00aae85aef4b */
/* bench 17527.0.2 584904b31c72 */
/* bench 17527.0.3 774057c1b5b3 */
/* bench 17527.0.4 dc59c2d26599 */
/* bench 17527.0.5 9d1bd5656f37 */
/* bench 17527.0.6 c1f1aa45d5a7 */
/* bench 17527.0.7 c526ceb7ae7e */
/* bench 17527.0.8 d76ddd040e6c */
/* bench 17527.0.9 05df5523cf0f */
/* bench 17527.0.10 875db3328f2b */
/* bench 17527.0.11 ec33d12abf75 */
	bool

config TIME_LOW_RES
	bool
	default y

/* bench 24555.1.0 e3eaaab71785 */
/* bench 24555.1.1 a1f768095464 */
/* bench 24555.1.2 5b2f5f425396 */
/* bench 24555.1.3 7bff53082858 */
/* bench 24555.1.4 13f969576536 */
/* bench 24555.1.5 56b90298d666 */
/* bench 24555.1.6 34479956d8bf */

config ZONE_DMA
	bool
	default y

config HZ
	int
	default 1000 if CLEOPATRA
	default 100

config PGTABLE_LEVELS
	default 2 if SUN3 || COLDFIRE
	default 3

config MMU
	bool "MMU-based Paged Memory Management Support"
	default y
	help
	  Select if you want MMU-based virtualised addressing space
	  support by paged memory management. If unsure, say 'Y'.

config MMU_MOTOROLA
	bool

config MMU_COLDFIRE
	bool

config MMU_SUN3
	bool
	depends on MMU && !MMU_MOTOROLA && !MMU_COLDFIRE

config KEXEC
	bool "kexec system call"
	depends on M68KCLASSIC
	select KEXEC_CORE
	help
	  kexec is a system call that implements the ability to shutdown your
	  current kernel, and to start another kernel.  It is like a reboot
	  but it is independent of the system firmware.   And like a reboot
	  you can start any kernel with it, not just Linux.

	  The name comes from the similarity to the exec system call.

	  It is an ongoing process to be certain the hardware in a machine
	  is properly shutdown, so do not be surprised if this code does not
	  initially work for you.  As of this writing the exact hardware
	  interface is strongly in flux, so no good recommendation can be
	  made.

config BOOTINFO_PROC
	bool "Export bootinfo in procfs"
	depends on KEXEC && M68KCLASSIC
	help
	  Say Y to export the bootinfo used to boot the kernel in a
	  "bootinfo" file in procfs.  This is useful with kexec.

menu "Platform setup"

source "arch/m68k/Kconfig.cpu"

source "arch/m68k/Kconfig.machine"

source "arch/m68k/Kconfig.bus"

endmenu

menu "Kernel Features"

endmenu

if !MMU
menu "Power management options"

config PM
	bool "Power Management support"
	help
	  Support processor power management modes

endmenu
endif

source "arch/m68k/Kconfig.devices"
```

## arch/m68k/configs/amcore_defconfig
```kconfig
FASTVC-BENCH-CORPUS:linux-main-100k-v1-e0bd41dc-8e12-4f1b-978d-a3645ae59da0
CONFIG_LOCALVERSION="amcore-002"
CONFIG_DEFAULT_HOSTNAME="amcore"
CONFIG_SYSVIPC=y
# CONFIG_FHANDLE is not set
# CONFIG_USELIB is not set
CONFIG_LOG_BUF_SHIFT=14
CONFIG_CC_OPTIMIZE_FOR_SIZE=y
# CONFIG_AIO is not set
# CONFIG_ADVISE_SYSCALLS is not set
# CONFIG_MEMBARRIER is not set
CONFIG_EMBEDDED=y
# CONFIG_VM_EVENT_COUNTERS is not set
# CONFIG_SLUB_DEBUG is not set
# CONFIG_COMPAT_BRK is not set
# CONFIG_BLK_DEV_BSG is not set
# CONFIG_MMU is not set
CONFIG_M5307=y
CONFIG_AMCORE=y
CONFIG_UBOOT=y
CONFIG_RAMSIZE=0x1000000
CONFIG_KERNELBASE=0x20000
CONFIG_NOMMU_INITIAL_TRIM_EXCESS=0
CONFIG_BINFMT_FLAT=y
# CONFIG_COREDUMP is not set
CONFIG_NET=y
CONFIG_PACKET=y
CONFIG_UNIX=y
CONFIG_INET=y
CONFIG_SYN_COOKIES=y
# CONFIG_INET_XFRM_MODE_TRANSPORT is not set
# CONFIG_INET_XFRM_MODE_TUNNEL is not set
# CONFIG_INET_XFRM_MODE_BEET is not set
# CONFIG_IPV6 is not set
# CONFIG_WIRELESS is not set
# CONFIG_UEVENT_HELPER is not set
# CONFIG_FW_LOADER is not set
# CONFIG_ALLOW_DEV_COREDUMP is not set
CONFIG_CONNECTOR=y
CONFIG_MTD=y
CONFIG_MTD_BLOCK=y
CONFIG_MTD_CFI=y
CONFIG_MTD_JEDECPROBE=y
CONFIG_MTD_CFI_ADV_OPTIONS=y
CONFIG_MTD_CFI_LE_BYTE_SWAP=y
CONFIG_MTD_CFI_GEOMETRY=y
# CONFIG_MTD_CFI_I2 is not set
CONFIG_MTD_CFI_AMDSTD=y
CONFIG_MTD_CFI_STAA=y
CONFIG_MTD_ROM=y
CONFIG_MTD_COMPLEX_MAPPINGS=y
CONFIG_MTD_PHYSMAP=y
CONFIG_MTD_UCLINUX=y
CONFIG_MTD_PLATRAM=y
CONFIG_BLK_DEV_RAM=y
CONFIG_NETDEVICES=y
CONFIG_DM9000=y
# CONFIG_WLAN is not set
# CONFIG_INPUT is not set
# CONFIG_SERIO is not set
# CONFIG_VT is not set
# CONFIG_UNIX98_PTYS is not set
# CONFIG_DEVMEM is not set
# CONFIG_DEVKMEM is not set
CONFIG_SERIAL_MCF=y
CONFIG_SERIAL_MCF_BAUDRATE=115200
CONFIG_SERIAL_MCF_CONSOLE=y
# CONFIG_HW_RANDOM is not set
CONFIG_I2C=y
# CONFIG_I2C_COMPAT is not set
CONFIG_I2C_CHARDEV=y
# CONFIG_I2C_HELPER_AUTO is not set
CONFIG_I2C_IMX=y
CONFIG_GPIO_SYSFS=y
# CONFIG_HWMON is not set
# CONFIG_USB_SUPPORT is not set
CONFIG_RTC_CLASS=y
# CONFIG_RTC_SYSTOHC is not set
CONFIG_RTC_DRV_DS1307=y
# CONFIG_FILE_LOCKING is not set
# CONFIG_DNOTIFY is not set
# CONFIG_INOTIFY_USER is not set
CONFIG_FSCACHE=y
# CONFIG_PROC_SYSCTL is not set
CONFIG_JFFS2_FS=y
CONFIG_ROMFS_FS=y
CONFIG_ROMFS_BACKED_BY_BOTH=y
/* bench 1998.0.0 50019bb2d352 */
/* bench 1998.0.1 dc19f792cd67 */
/* bench 1998.0.2 4d5ce5f94858 */
/* bench 1998.0.3 7587ec634276 */
/* bench 1998.0.4 6775f6176dc3 */
/* bench 1998.0.5 574faf7d460f */
/* bench 1998.0.6 2462ff6848de */
/* bench 1998.0.7 890dacc05f35 */
/* bench 1998.0.8 ae20c3d640ad */
/* bench 1998.0.9 b707068105fb */
/* bench 10941.1.0 09b5685e6e91 */
/* bench 10941.1.1 cebfaa0ba721 */
/* bench 10941.1.2 fd9ea7d91f35 */
/* bench 10941.1.3 2649881d40c0 */
/* bench 10941.1.4 b8effd0e3d24 */
/* bench 10941.1.5 9e4f3b225b17 */
/* bench 10941.1.6 9b756bf74008 */
/* bench 10941.1.7 b90caab7dc23 */
/* bench 10941.1.8 ed7ad6fc9a15 */
/* bench 10941.1.9 03faa7fcec4c */
/* bench 10941.1.10 396008ff17d3 */
/* bench 10941.1.11 f7892edb0032 */
/* bench 10941.1.12 955cac5face2 */
/* bench 10941.1.13 dbbc6db57f40 */
/* bench 10941.1.14 9c33d2d59c13 */
/* bench 10941.1.15 95535afcfeaa */
# CONFIG_NETWORK_FILESYSTEMS is not set
CONFIG_PRINTK_TIME=y
# CONFIG_ENABLE_MUST_CHECK is not set
# CONFIG_SECTION_MISMATCH_WARN_ONLY is not set
CONFIG_PANIC_ON_OOPS=y
# CONFIG_SCHED_DEBUG is not set
# CONFIG_DEBUG_BUGVERBOSE is not set
# CONFIG_CRYPTO_ECHAINIV is not set
CONFIG_CRYPTO_ANSI_CPRNG=y
# CONFIG_CRYPTO_HW is not set
CONFIG_CRC16=y
```

## arch/m68k/configs/m5249evb_defconfig
```kconfig
FASTVC-BENCH-CORPUS:linux-main-100k-v1-e0bd41dc-8e12-4f1b-978d-a3645ae59da0
CONFIG_LOG_BUF_SHIFT=14
CONFIG_EXPERT=y
# CONFIG_KALLSYMS is not set
# CONFIG_FUTEX is not set
# CONFIG_EPOLL is not set
# CONFIG_SIGNALFD is not set
# CONFIG_TIMERFD is not set
# CONFIG_EVENTFD is not set
# CONFIG_AIO is not set
# CONFIG_VM_EVENT_COUNTERS is not set
# CONFIG_SLUB_DEBUG is not set
# CONFIG_BLK_DEV_BSG is not set
# CONFIG_MMU is not set
CONFIG_M5249=y
CONFIG_M5249C3=y
CONFIG_RAMBASE=0x00000000
CONFIG_RAMSIZE=0x00800000
CONFIG_VECTORBASE=0x00000000
CONFIG_KERNELBASE=0x00020000
CONFIG_BINFMT_FLAT=y
CONFIG_NET=y
CONFIG_PACKET=y
CONFIG_UNIX=y
CONFIG_INET=y
# CONFIG_INET_XFRM_MODE_TRANSPORT is not set
# CONFIG_INET_XFRM_MODE_TUNNEL is not set
# CONFIG_INET_XFRM_MODE_BEET is not set
# CONFIG_INET_DIAG is not set
# CONFIG_IPV6 is not set
# CONFIG_FW_LOADER is not set
CONFIG_MTD=y
CONFIG_MTD_BLOCK=y
CONFIG_MTD_RAM=y
CONFIG_MTD_UCLINUX=y
CONFIG_BLK_DEV_RAM=y
CONFIG_NETDEVICES=y
CONFIG_PPP=y
# CONFIG_INPUT is not set
# CONFIG_SERIO is not set
# CONFIG_VT is not set
# CONFIG_UNIX98_PTYS is not set
CONFIG_SERIAL_MCF=y
CONFIG_SERIAL_MCF_CONSOLE=y
# CONFIG_HWMON is not set
# CONFIG_USB_SUPPORT is not set
CONFIG_EXT2_FS=y
/* bench 17270.1.0 30fe1c1a5fdd */
/* bench 17270.1.1 ff3f0836f9c9 */
/* bench 17270.1.2 b724d76710f5 */
/* bench 17270.1.3 de21c158e588 */
/* bench 17270.1.4 1944e72598e2 */
/* bench 17270.1.5 946415a34f2c */
/* bench 17270.1.6 c54d384dd576 */
/* bench 17270.1.7 37261cd2c8d8 */
/* bench 17270.1.8 02ecac21e2cd */
CONFIG_ROMFS_BACKED_BY_MTD=y
# CONFIG_NETWORK_FILESYSTEMS is not set
/* bench 12056.1.0 59d81fe6281d */
/* bench 12056.1.1 53138eb7d710 */
/* bench 12056.1.2 2b5aca76dd45 */
/* bench 12056.1.3 a5e3d5e25b3f */
/* bench 12056.1.4 9a376e44906c */
/* bench 12056.1.5 e312de286815 */
/* bench 12056.1.6 7077e041715a */
/* bench 12056.1.7 112c7d2184f6 */
/* bench 12056.1.8 4944591bf054 */
/* bench 12056.1.9 0b13f5b192a6 */
/* bench 22970.2.0 a4a77e659bee */
/* bench 22970.2.1 f7a2b83023ab */
/* bench 22970.2.2 99cc6a417792 */
/* bench 22970.2.3 72e6ff36de48 */
/* bench 22970.2.4 59abbd8c580e */
/* bench 22970.2.5 730501b7829f */
/* bench 22970.2.6 a998d7aad1e1 */
/* bench 22970.2.7 6c9ee5a47338 */
/* bench 22970.2.8 bcaedf57a107 */
/* bench 22970.2.9 83b3a6753d18 */
/* bench 22970.2.10 2c55f8e7f0e8 */
/* bench 12056.1.10 34cfc94339e3 */
/* bench 12056.1.11 d43ab50c6468 */
/* bench 12056.1.12 ef9801a06222 */
/* bench 12056.1.13 35ad37f4572e */
```

## arch/m68k/configs/m5272c3_defconfig
```kconfig
FASTVC-BENCH-CORPUS:linux-main-100k-v1-e0bd41dc-8e12-4f1b-978d-a3645ae59da0
CONFIG_LOG_BUF_SHIFT=14
CONFIG_EXPERT=y
# CONFIG_KALLSYMS is not set
# CONFIG_FUTEX is not set
# CONFIG_EPOLL is not set
# CONFIG_SIGNALFD is not set
# CONFIG_TIMERFD is not set
# CONFIG_EVENTFD is not set
# CONFIG_AIO is not set
# CONFIG_VM_EVENT_COUNTERS is not set
# CONFIG_SLUB_DEBUG is not set
# CONFIG_BLK_DEV_BSG is not set
# CONFIG_MMU is not set
CONFIG_M5272=y
CONFIG_M5272C3=y
CONFIG_RAMBASE=0x00000000
CONFIG_RAMSIZE=0x00800000
CONFIG_VECTORBASE=0x00000000
CONFIG_KERNELBASE=0x00020000
CONFIG_BINFMT_FLAT=y
CONFIG_NET=y
CONFIG_PACKET=y
CONFIG_UNIX=y
CONFIG_INET=y
# CONFIG_INET_XFRM_MODE_TRANSPORT is not set
# CONFIG_INET_XFRM_MODE_TUNNEL is not set
# CONFIG_INET_XFRM_MODE_BEET is not set
# CONFIG_INET_DIAG is not set
# CONFIG_IPV6 is not set
# CONFIG_FW_LOADER is not set
CONFIG_MTD=y
CONFIG_MTD_BLOCK=y
CONFIG_MTD_RAM=y
CONFIG_MTD_UCLINUX=y
CONFIG_BLK_DEV_RAM=y
CONFIG_NETDEVICES=y
CONFIG_FEC=y
# CONFIG_INPUT is not set
# CONFIG_SERIO is not set
# CONFIG_VT is not set
/* bench 20733.1.0 6c542f2d2887 */
/* bench 20733.1.1 efd32ee910d3 */
/* bench 20733.1.2 2017930b4133 */
/* bench 20733.1.3 f62692414e9c */
/* bench 20733.1.4 312b2e89677a */
/* bench 20733.1.5 e68cfa391954 */
/* bench 20733.1.6 3011a628107b */
/* bench 20733.1.7 2c19820a0da9 */
/* bench 20733.1.8 f4829195ab4b */
/* bench 20733.1.9 b8909ea8d74d */
/* bench 20733.1.10 1abb9ffa172b */
/* bench 20733.1.11 674f6a34299a */
/* bench 20733.1.12 f90ee7db0d70 */
/* bench 20733.1.13 dfd89f98bc1b */
/* bench 20733.1.14 7bd58c25ccf0 */
/* bench 20733.1.15 0c445978aafe */
/* bench 20733.1.16 f4a461077cb8 */
CONFIG_SERIAL_MCF=y
CONFIG_SERIAL_MCF_CONSOLE=y
# CONFIG_HWMON is not set
# CONFIG_USB_SUPPORT is not set
CONFIG_EXT2_FS=y
# CONFIG_FILE_LOCKING is not set
# CONFIG_DNOTIFY is not set
CONFIG_ROMFS_FS=y
CONFIG_ROMFS_BACKED_BY_MTD=y
# CONFIG_NETWORK_FILESYSTEMS is not set
CONFIG_BOOTPARAM=y
CONFIG_BOOTPARAM_STRING="root=/dev/mtdblock0"
```

## arch/m68k/configs/m5475evb_defconfig
```kconfig
FASTVC-BENCH-CORPUS:linux-main-100k-v1-e0bd41dc-8e12-4f1b-978d-a3645ae59da0
# CONFIG_SWAP is not set
CONFIG_LOG_BUF_SHIFT=14
# CONFIG_KALLSYMS is not set
# CONFIG_FUTEX is not set
# CONFIG_EPOLL is not set
/* bench 10853.1.0 0ce81f2cec13 */
/* bench 10853.1.1 893a6c9479a3 */
/* bench 10853.1.2 f7e8df7273cb */
/* bench 10853.1.3 321a26230cec */
/* bench 10853.1.4 bd66bb6037ef */
/* bench 10853.1.5 75716c81b7a7 */
/* bench 10853.1.6 3de537d1a5cf */
/* bench 10853.1.7 4668b356cbbb */
# CONFIG_SIGNALFD is not set
# CONFIG_TIMERFD is not set
# CONFIG_EVENTFD is not set
# CONFIG_SHMEM is not set
# CONFIG_AIO is not set
CONFIG_EMBEDDED=y
CONFIG_MODULES=y
# CONFIG_BLK_DEV_BSG is not set
CONFIG_COLDFIRE=y
# CONFIG_4KSTACKS is not set
CONFIG_RAMBASE=0x0
CONFIG_RAMSIZE=0x2000000
CONFIG_VECTORBASE=0x0
CONFIG_MBAR=0xff000000
CONFIG_KERNELBASE=0x20000
CONFIG_PCI=y
# CONFIG_CORE_DUMP_DEFAULT_ELF_HEADERS is not set
# CONFIG_FW_LOADER is not set
CONFIG_MTD=y
CONFIG_MTD_BLOCK=y
CONFIG_MTD_CFI=y
CONFIG_MTD_JEDECPROBE=y
CONFIG_MTD_CFI_AMDSTD=y
CONFIG_MTD_RAM=y
CONFIG_MTD_PHYSMAP=y
CONFIG_MTD_UCLINUX=y
/* bench 6519.1.0 5cdef9efbdd6 */
/* bench 6519.1.1 a86f6c35909c */
/* bench 6519.1.2 650d652beba4 */
/* bench 6519.1.3 6b7d2ee27328 */
/* bench 6519.1.4 8ce657822ed3 */
/* bench 6519.1.5 25b8c27741ff */
/* bench 6519.1.6 d47aa6a15767 */
/* bench 6519.1.7 0cb4f210aac2 */
/* bench 6519.1.8 3eaf1cfae9cd */
/* bench 6519.1.9 5b197aa315b7 */
/* bench 6519.1.10 0a8a5f8f824c */
/* bench 6519.1.11 29161c8936d3 */
/* bench 6519.1.12 f4e016e31acb */
# CONFIG_INPUT is not set
# CONFIG_VT is not set
# CONFIG_UNIX98_PTYS is not set
CONFIG_SERIAL_MCF=y
CONFIG_SERIAL_MCF_CONSOLE=y
# CONFIG_HW_RANDOM is not set
# CONFIG_HWMON is not set
# CONFIG_USB_SUPPORT is not set
# CONFIG_IOMMU_SUPPORT is not set
CONFIG_EXT2_FS=y
# CONFIG_FILE_LOCKING is not set
# CONFIG_DNOTIFY is not set
# CONFIG_INOTIFY_USER is not set
# CONFIG_PROC_PAGE_MONITOR is not set
CONFIG_ROMFS_FS=y
CONFIG_ROMFS_BACKED_BY_MTD=y
# CONFIG_SCHED_DEBUG is not set
CONFIG_BOOTPARAM=y
CONFIG_BOOTPARAM_STRING="root=/dev/mtdblock0"
```

## arch/microblaze/Kconfig.debug
```kconfig
/* bench 6081.1.0 a1b2a89114c5 */
/* bench 6081.1.1 5cf38e9c3526 */
/* bench 6081.1.2 8ad06dd06a56 */
/* bench 6081.1.3 fb56ba440119 */
/* bench 6081.1.4 6b23a97edb1b */
/* bench 6081.1.5 4e57f2af8977 */
/* bench 6081.1.6 38a21888d63a */
/* bench 6081.1.7 9a29fe91bdaf */
# see Documentation/kbuild/kconfig-language.rst.

config TRACE_IRQFLAGS_SUPPORT
	def_bool y
```
