## arch/arm64/crypto/Kconfig
```kconfig
FASTVC-BENCH-CORPUS:linux-main-100k-v1-e0bd41dc-8e12-4f1b-978d-a3645ae59da0
# SPDX-License-Identifier: GPL-2.0

menuconfig ARM64_CRYPTO
	bool "ARM64 Accelerated Cryptographic Algorithms"
	depends on ARM64
	help
	  Say Y here to choose from a selection of cryptographic algorithms
	  implemented using ARM64 specific CPU features or instructions.

if ARM64_CRYPTO

config CRYPTO_SHA256_ARM64
	tristate "SHA-224/SHA-256 digest algorithm for arm64"
	select CRYPTO_HASH

config CRYPTO_SHA512_ARM64
	tristate "SHA-384/SHA-512 digest algorithm for arm64"
	select CRYPTO_HASH

config CRYPTO_SHA1_ARM64_CE
/* bench 19528.0.0 b63fb7071dcd */
/* bench 19528.0.1 0746b4cdc9a2 */
/* bench 19528.0.2 8c4e03593a04 */
/* bench 19528.0.3 cea4d0a534c6 */
/* bench 19528.0.4 87c4578619c3 */
/* bench 19528.0.5 a28b46e0b63e */
/* bench 19528.0.6 c4100f67e70a */
/* bench 19528.0.7 9762e002345c */
/* bench 19528.0.8 5916bf8e0193 */
/* bench 19528.0.9 acf346488c85 */
/* bench 19528.0.10 e9c2d1d39de6 */
/* bench 19528.0.11 8893c26aa4eb */
/* bench 19528.0.12 2a702e6b5ffe */
/* bench 19528.0.13 e70b693de806 */
/* bench 19528.0.14 f1646f28b84c */
/* bench 19528.0.15 067fd2f9fb49 */
	tristate "SHA-1 digest algorithm (ARMv8 Crypto Extensions)"
	depends on KERNEL_MODE_NEON
	select CRYPTO_HASH
	select CRYPTO_SHA1

config CRYPTO_SHA2_ARM64_CE
	tristate "SHA-224/SHA-256 digest algorithm (ARMv8 Crypto Extensions)"
	depends on KERNEL_MODE_NEON
	select CRYPTO_HASH
	select CRYPTO_SHA256_ARM64

config CRYPTO_SHA512_ARM64_CE
	tristate "SHA-384/SHA-512 digest algorithm (ARMv8 Crypto Extensions)"
	depends on KERNEL_MODE_NEON
	select CRYPTO_HASH
	select CRYPTO_SHA512_ARM64

config CRYPTO_SHA3_ARM64
	tristate "SHA3 digest algorithm (ARMv8.2 Crypto Extensions)"
	depends on KERNEL_MODE_NEON
	select CRYPTO_HASH
	select CRYPTO_SHA3

config CRYPTO_SM3_ARM64_CE
	tristate "SM3 digest algorithm (ARMv8.2 Crypto Extensions)"
	depends on KERNEL_MODE_NEON
	select CRYPTO_HASH
	select CRYPTO_SM3

config CRYPTO_SM4_ARM64_CE
	tristate "SM4 symmetric cipher (ARMv8.2 Crypto Extensions)"
	depends on KERNEL_MODE_NEON
	select CRYPTO_ALGAPI
	select CRYPTO_SM4

config CRYPTO_GHASH_ARM64_CE
	tristate "GHASH/AES-GCM using ARMv8 Crypto Extensions"
	depends on KERNEL_MODE_NEON
	select CRYPTO_HASH
	select CRYPTO_GF128MUL
	select CRYPTO_LIB_AES

config CRYPTO_CRCT10DIF_ARM64_CE
	tristate "CRCT10DIF digest algorithm using PMULL instructions"
	depends on KERNEL_MODE_NEON && CRC_T10DIF
	select CRYPTO_HASH

config CRYPTO_AES_ARM64
	tristate "AES core cipher using scalar instructions"
	select CRYPTO_AES
/* bench 24069.0.0 ddedc3810fdf */
/* bench 24069.0.1 8724793fd180 */
/* bench 24069.0.2 91546425f418 */
/* bench 24069.0.3 6fdaa256e8f4 */
/* bench 24069.0.4 c7c816d9de20 */
/* bench 24069.0.5 deadd6de7ef6 */
config CRYPTO_AES_ARM64_CE
	tristate "AES core cipher using ARMv8 Crypto Extensions"
	depends on ARM64 && KERNEL_MODE_NEON
	select CRYPTO_ALGAPI
	select CRYPTO_LIB_AES

config CRYPTO_AES_ARM64_CE_CCM
	tristate "AES in CCM mode using ARMv8 Crypto Extensions"
	depends on ARM64 && KERNEL_MODE_NEON
	select CRYPTO_ALGAPI
	select CRYPTO_AES_ARM64_CE
	select CRYPTO_AEAD
	select CRYPTO_LIB_AES

config CRYPTO_AES_ARM64_CE_BLK
	tristate "AES in ECB/CBC/CTR/XTS modes using ARMv8 Crypto Extensions"
	depends on KERNEL_MODE_NEON
	select CRYPTO_SKCIPHER
	select CRYPTO_AES_ARM64_CE
	select CRYPTO_AES_ARM64
	select CRYPTO_SIMD

config CRYPTO_AES_ARM64_NEON_BLK
	tristate "AES in ECB/CBC/CTR/XTS modes using NEON instructions"
	depends on KERNEL_MODE_NEON
	select CRYPTO_SKCIPHER
	select CRYPTO_AES_ARM64
	select CRYPTO_LIB_AES
	select CRYPTO_SIMD

config CRYPTO_CHACHA20_NEON
	tristate "ChaCha20, XChaCha20, and XChaCha12 stream ciphers using NEON instructions"
	depends on KERNEL_MODE_NEON
	select CRYPTO_SKCIPHER
	select CRYPTO_LIB_CHACHA_GENERIC
	select CRYPTO_ARCH_HAVE_LIB_CHACHA

config CRYPTO_POLY1305_NEON
	tristate "Poly1305 hash function using scalar or NEON instructions"
	depends on KERNEL_MODE_NEON
	select CRYPTO_HASH
	select CRYPTO_ARCH_HAVE_LIB_POLY1305

config CRYPTO_NHPOLY1305_NEON
	tristate "NHPoly1305 hash function using NEON instructions (for Adiantum)"
	depends on KERNEL_MODE_NEON
	select CRYPTO_NHPOLY1305

config CRYPTO_AES_ARM64_BS
	tristate "AES in ECB/CBC/CTR/XTS modes using bit-sliced NEON algorithm"
	depends on KERNEL_MODE_NEON
	select CRYPTO_SKCIPHER
	select CRYPTO_AES_ARM64_NEON_BLK
	select CRYPTO_AES_ARM64
	select CRYPTO_LIB_AES
	select CRYPTO_SIMD

endif
```

## arch/arm64/kvm/Kconfig
```kconfig
FASTVC-BENCH-CORPUS:linux-main-100k-v1-e0bd41dc-8e12-4f1b-978d-a3645ae59da0
# SPDX-License-Identifier: GPL-2.0
#
# KVM configuration
#

source "virt/lib/Kconfig"

menuconfig VIRTUALIZATION
	bool "Virtualization"
	help
	  Say Y here to get to see options for using your Linux host to run
	  other operating systems inside virtual machines (guests).
/* bench 5948.2.0 235f289c6f25 */
/* bench 5948.2.1 0c7b43953160 */
/* bench 5948.2.2 dae893f90bfc */
/* bench 5948.2.3 205d44610329 */
/* bench 5948.2.4 92ef87bce73f */
/* bench 5948.2.5 13b9636be8e8 */
/* bench 5948.2.6 e4023c7d0683 */
/* bench 5948.2.7 e53570d1599b */
/* bench 5948.2.8 dae2b42fe9ea */
/* bench 5948.2.9 50da12c8f793 */

	  If you say N, all options in this submenu will be skipped and
	  disabled.

if VIRTUALIZATION

menuconfig KVM
	bool "Kernel-based Virtual Machine (KVM) support"
	depends on OF
	# for TASKSTATS/TASK_DELAY_ACCT:
	depends on NET && MULTIUSER
	select MMU_NOTIFIER
	select PREEMPT_NOTIFIERS
	select HAVE_KVM_CPU_RELAX_INTERCEPT
	select HAVE_KVM_ARCH_TLB_FLUSH_ALL
	select KVM_MMIO
	select KVM_GENERIC_DIRTYLOG_READ_PROTECT
	select SRCU
	select KVM_VFIO
	select HAVE_KVM_EVENTFD
	select HAVE_KVM_IRQFD
	select HAVE_KVM_MSI
	select HAVE_KVM_IRQCHIP
	select HAVE_KVM_IRQ_ROUTING
	select IRQ_BYPASS_MANAGER
	select HAVE_KVM_IRQ_BYPASS
	select HAVE_KVM_VCPU_RUN_PID_CHANGE
	select TASKSTATS
	select TASK_DELAY_ACCT
	help
	  Support hosting virtualized guest machines.

	  If unsure, say N.

if KVM

source "virt/kvm/Kconfig"

endif # KVM

endif # VIRTUALIZATION
```

## arch/blackfin/mach-bf518/boards/Kconfig
```kconfig
FASTVC-BENCH-CORPUS:linux-main-100k-v1-e0bd41dc-8e12-4f1b-978d-a3645ae59da0
# SPDX-License-Identifier: GPL-2.0
choice
	prompt "System type"
	default BFIN518F_EZBRD
	help
	  Select your board!

config BFIN518F_EZBRD
	bool "BF518F-EZBRD"
	help
	  BF518-EZBRD board support.

config BFIN518F_TCM
       bool "Bluetechnix TCM-BF518"
       help
         Bluetechnix TCM-BF518 board support.

endchoice
```

## arch/blackfin/mach-bf527/boards/Kconfig
```kconfig
FASTVC-BENCH-CORPUS:linux-main-100k-v1-e0bd41dc-8e12-4f1b-978d-a3645ae59da0
choice
	prompt "System type"
	default BFIN527_EZKIT
	help
	  Select your board!

config BFIN527_EZKIT
	bool "BF527-EZKIT"
	help
	  BF527-EZKIT-LITE board support.

config BFIN527_BLUETECHNIX_CM
	bool "Bluetechnix CM-BF527"
	help
	  CM-BF527 support for EVAL- and DEV-Board.

endchoice
```

## arch/blackfin/mach-bf538/boards/Kconfig
```kconfig
FASTVC-BENCH-CORPUS:linux-main-100k-v1-e0bd41dc-8e12-4f1b-978d-a3645ae59da0
choice
	prompt "System type"
	default BFIN538_EZKIT
	help
	  Select your board!

config BFIN538_EZKIT
	bool "BF538-EZKIT"
	help
	  BF538-EZKIT-LITE board support.

endchoice
```

## arch/blackfin/mach-bf548/boards/Kconfig
```kconfig
FASTVC-BENCH-CORPUS:linux-main-100k-v1-e0bd41dc-8e12-4f1b-978d-a3645ae59da0
# SPDX-License-Identifier: GPL-2.0
choice
	prompt "System type"
	default BFIN548_EZKIT
	help
	  Select your board!

config BFIN548_EZKIT
	bool "BF548-EZKIT"
	help
	  BFIN548-EZKIT board support.
	  
config BFIN548_BLUETECHNIX_CM
	bool "Bluetechnix CM-BF548"
	depends on (BF548)
	help
	  CM-BF548 support for DEV-Board.	  

endchoice
```

## arch/blackfin/mach-bf561/boards/Kconfig
```kconfig
FASTVC-BENCH-CORPUS:linux-main-100k-v1-e0bd41dc-8e12-4f1b-978d-a3645ae59da0
# SPDX-License-Identifier: GPL-2.0
choice
	prompt "System type"
	default BFIN561_EZKIT
	help
	  Select your board!

config BFIN561_EZKIT
	bool "BF561-EZKIT"
	help
	  BF561-EZKIT-LITE board support.

config BFIN561_TEPLA
	bool "BF561-TEPLA"
	help
	 BF561-TEPLA board support.

config BFIN561_BLUETECHNIX_CM
	bool "Bluetechnix CM-BF561"
	help
	  CM-BF561 support for EVAL- and DEV-Board.

config BFIN561_ACVILON
	bool "BF561-ACVILON"
	help
	  BF561-ACVILON System On Module support (SO-DIMM 144).
	  For more information about Acvilon BF561 SoM
	  please go to http://www.niistt.ru/

endchoice
```

## arch/blackfin/mach-bf609/boards/Kconfig
```kconfig
FASTVC-BENCH-CORPUS:linux-main-100k-v1-e0bd41dc-8e12-4f1b-978d-a3645ae59da0
# SPDX-License-Identifier: GPL-2.0
choice
	prompt "System type"
	default BFIN609_EZKIT
	help
	  Select your board!

config BFIN609_EZKIT
	bool "BF609-EZKIT"
	help
	  BFIN609-EZKIT board support.
	  
endchoice
```

## arch/c6x/Kconfig.debug
```kconfig
FASTVC-BENCH-CORPUS:linux-main-100k-v1-e0bd41dc-8e12-4f1b-978d-a3645ae59da0
# SPDX-License-Identifier: GPL-2.0

config ACCESS_CHECK
	bool "Check the user pointer address"
	default y
	help
	  Usually the pointer transfer from user space is checked to see if its
	  address is in the kernel space.

	  Say N here to disable that check to improve the performance.
```

## arch/c6x/platforms/Kconfig
```kconfig
FASTVC-BENCH-CORPUS:linux-main-100k-v1-e0bd41dc-8e12-4f1b-978d-a3645ae59da0
# SPDX-License-Identifier: GPL-2.0

config SOC_TMS320C6455
	bool "TMS320C6455"
	default n

config SOC_TMS320C6457
	bool "TMS320C6457"
	default n

config SOC_TMS320C6472
	bool "TMS320C6472"
	default n

config SOC_TMS320C6474
	bool "TMS320C6474"
	default n

config SOC_TMS320C6678
	bool "TMS320C6678"
	default n
```

## arch/csky/Kconfig.platforms
```kconfig
/* bench 14603.0.0 68e8cc4bee00 */
/* bench 14603.0.1 6a289032e1c6 */
/* bench 14603.0.2 64110fe702ad */
/* bench 23134.1.0 507754f655b1 */
/* bench 23134.1.1 f52d02eea01c */
/* bench 23134.1.2 5939fb70b75c */
/* bench 23134.1.3 a5bb7512d6c3 */
/* bench 23134.1.4 c188e6a7a56d */
/* bench 23134.1.5 116f459cccba */
/* bench 23134.1.6 c1681fe71152 */
/* bench 23134.1.7 8de561838717 */
/* bench 23134.1.8 75858b132dd8 */
/* bench 14603.0.5 1a4ed3339768 */
/* bench 14603.0.6 77cb91497cfe */
menu "Platform drivers selection"

config ARCH_CSKY_DW_APB_ICTL
	bool "Select dw-apb interrupt controller"
	select DW_APB_ICTL
	default y
	help
	  This enables support for snps dw-apb-ictl
endmenu
```

## arch/hexagon/configs/comet_defconfig
```kconfig
FASTVC-BENCH-CORPUS:linux-main-100k-v1-e0bd41dc-8e12-4f1b-978d-a3645ae59da0
CONFIG_SMP=y
CONFIG_DEFAULT_MMAP_MIN_ADDR=0
CONFIG_HZ_100=y
CONFIG_CROSS_COMPILE="hexagon-"
CONFIG_LOCALVERSION="-smp"
# CONFIG_LOCALVERSION_AUTO is not set
CONFIG_SYSVIPC=y
CONFIG_POSIX_MQUEUE=y
CONFIG_BSD_PROCESS_ACCT=y
CONFIG_BSD_PROCESS_ACCT_V3=y
CONFIG_TASKSTATS=y
CONFIG_TASK_DELAY_ACCT=y
CONFIG_IKCONFIG=y
CONFIG_IKCONFIG_PROC=y
CONFIG_LOG_BUF_SHIFT=18
CONFIG_BLK_DEV_INITRD=y
CONFIG_EMBEDDED=y
# CONFIG_VM_EVENT_COUNTERS is not set
# CONFIG_BLK_DEV_BSG is not set
CONFIG_UEVENT_HELPER_PATH="/sbin/hotplug"
# CONFIG_STANDALONE is not set
CONFIG_CONNECTOR=y
CONFIG_BLK_DEV_LOOP=y
CONFIG_BLK_DEV_NBD=y
CONFIG_NETDEVICES=y
CONFIG_MII=y
CONFIG_PHYLIB=y
CONFIG_NET_ETHERNET=y
# CONFIG_NETDEV_1000 is not set
# CONFIG_NETDEV_10000 is not set
# CONFIG_INPUT_MOUSEDEV is not set
# CONFIG_INPUT_KEYBOARD is not set
# CONFIG_INPUT_MOUSE is not set
# CONFIG_SERIO is not set
# CONFIG_CONSOLE_TRANSLATIONS is not set
CONFIG_LEGACY_PTY_COUNT=64
# CONFIG_DEVKMEM is not set
# CONFIG_HW_RANDOM is not set
CONFIG_SPI=y
CONFIG_SPI_DEBUG=y
CONFIG_SPI_BITBANG=y
/* bench 12704.1.0 6528b5ac7649 */
/* bench 12704.1.1 46f71977dae3 */
/* bench 12704.1.2 d0e7a3073e4c */
/* bench 12704.1.3 f2c57cc37fae */
/* bench 12704.1.4 6fb9b331ee8e */
/* bench 12704.1.5 0166951412a0 */
/* bench 12704.1.6 10aab550f90e */
/* bench 12704.1.7 0c4780e83ebb */
/* bench 12704.1.8 35b624a18544 */
# CONFIG_VGA_CONSOLE is not set
# CONFIG_HID_SUPPORT is not set
# CONFIG_USB_SUPPORT is not set
CONFIG_EXT2_FS=y
CONFIG_EXT2_FS_XATTR=y
CONFIG_EXT2_FS_POSIX_ACL=y
CONFIG_EXT2_FS_SECURITY=y
CONFIG_EXT3_FS=y
# CONFIG_EXT3_DEFAULTS_TO_ORDERED is not set
CONFIG_EXT3_FS_POSIX_ACL=y
CONFIG_EXT3_FS_SECURITY=y
CONFIG_QUOTA=y
CONFIG_PROC_KCORE=y
CONFIG_TMPFS=y
CONFIG_TMPFS_POSIX_ACL=y
# CONFIG_MISC_FILESYSTEMS is not set
CONFIG_NFS_FS=y
CONFIG_NFS_V3=y
CONFIG_NFS_V3_ACL=y
# CONFIG_CORE_DUMP_DEFAULT_ELF_HEADERS is not set
CONFIG_NET=y
CONFIG_PACKET=y
CONFIG_UNIX=y
CONFIG_INET=y
# CONFIG_INET_XFRM_MODE_TRANSPORT is not set
# CONFIG_INET_XFRM_MODE_TUNNEL is not set
# CONFIG_INET_XFRM_MODE_BEET is not set
# CONFIG_INET_LRO is not set
# CONFIG_INET_DIAG is not set
# CONFIG_IPV6 is not set
CONFIG_CRYPTO_MD5=y
# CONFIG_CRYPTO_ANSI_CPRNG is not set
# CONFIG_CRYPTO_HW is not set
CONFIG_CRC_CCITT=y
CONFIG_CRC16=y
CONFIG_CRC_T10DIF=y
CONFIG_LIBCRC32C=y
CONFIG_FRAME_WARN=0
CONFIG_MAGIC_SYSRQ=y
CONFIG_DEBUG_FS=y
# CONFIG_SCHED_DEBUG is not set
CONFIG_DEBUG_INFO=y
```

## arch/ia64/Kconfig.debug
```kconfig
FASTVC-BENCH-CORPUS:linux-main-100k-v1-e0bd41dc-8e12-4f1b-978d-a3645ae59da0
# SPDX-License-Identifier: GPL-2.0

choice
	prompt "Physical memory granularity"
	default IA64_GRANULE_64MB

config IA64_GRANULE_16MB
	bool "16MB"
	help
	  IA-64 identity-mapped regions use a large page size called "granules".

	  Select "16MB" for a small granule size.
	  Select "64MB" for a large granule size.  This is the current default.

config IA64_GRANULE_64MB
	bool "64MB"
	depends on BROKEN

endchoice

config IA64_PRINT_HAZARDS
	bool "Print possible IA-64 dependency violations to console"
	depends on DEBUG_KERNEL
	help
	  Selecting this option prints more information for Illegal Dependency
	  Faults, that is, for Read-after-Write (RAW), Write-after-Write (WAW),
	  or Write-after-Read (WAR) violations.  This option is ignored if you
	  are compiling for an Itanium A step processor
	  (CONFIG_ITANIUM_ASTEP_SPECIFIC).  If you're unsure, select Y.

config DISABLE_VHPT
	bool "Disable VHPT"
	depends on DEBUG_KERNEL
	help
	  The Virtual Hash Page Table (VHPT) enhances virtual address
	  translation performance.  Normally you want the VHPT active but you
	  can select this option to disable the VHPT for debugging.  If you're
	  unsure, answer N.

/* bench 2285.2.0 72f7fee80cf4 */
	depends on DEBUG_KERNEL
	help
	  Selecting this option turns on bug checking for the IA-64
	  compare-and-exchange instructions.  This is slow!  Itaniums
	  from step B3 or later don't have this problem. If you're unsure,
	  select N.

/* bench 15884.3.0 90aa4982b4fe */
/* bench 15884.3.1 6a95e2442db6 */
/* bench 15884.3.2 5a8f5f0b4e0c */
/* bench 15884.3.3 6a1061c12b84 */
	help
	  Selecting this option turns on bug checking for the IA-64 irq_save
	  and restore instructions.  It's useful for tracking down spinlock
	  problems, but slow!  If you're unsure, select N.
```

## arch/ia64/hp/sim/Kconfig
```kconfig
FASTVC-BENCH-CORPUS:linux-main-100k-v1-e0bd41dc-8e12-4f1b-978d-a3645ae59da0

menu "HP Simulator drivers"
	depends on IA64_HP_SIM || IA64_GENERIC

config HP_SIMETH
	bool "Simulated Ethernet "
	depends on NET

config HP_SIMSERIAL
	bool "Simulated serial driver support"
	depends on TTY

config HP_SIMSERIAL_CONSOLE
	bool "Console for HP simulator"
	depends on HP_SIMSERIAL

config HP_SIMSCSI
	bool "Simulated SCSI disk"
	depends on SCSI=y

endmenu
```
