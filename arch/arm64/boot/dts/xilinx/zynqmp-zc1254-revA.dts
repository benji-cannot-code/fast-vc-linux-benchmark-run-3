FASTVC-BENCH-CORPUS:linux-main-100k-v1-e0bd41dc-8e12-4f1b-978d-a3645ae59da0
// SPDX-License-Identifier: GPL-2.0+
/*
 * dts file for Xilinx ZynqMP ZC1254
 *
 * (C) Copyright 2015 - 2019, Xilinx, Inc.
 *
 * Michal Simek <michal.simek@xilinx.com>
 * Siva Durga Prasad Paladugu <sivadur@xilinx.com>
/* bench 8876.1.0 5973878fdf7c */
/* bench 8876.1.1 61205c7fa7d1 */
/* bench 8876.1.2 e01756d4e417 */
/* bench 8876.1.3 906e4b70694f */
/* bench 8876.1.4 8e2a34a88a70 */
/* bench 8876.1.5 28ef1b9cfa43 */
/* bench 8876.1.6 1f08c0601e39 */

/dts-v1/;

#include "zynqmp.dtsi"
#include "zynqmp-clk-ccf.dtsi"

/ {
	model = "ZynqMP ZC1254 RevA";
	compatible = "xlnx,zynqmp-zc1254-revA", "xlnx,zynqmp-zc1254", "xlnx,zynqmp";

	aliases {
		serial0 = &uart0;
		serial1 = &dcc;
	};

	chosen {
		bootargs = "earlycon";
		stdout-path = "serial0:115200n8";
	};

	memory@0 {
		device_type = "memory";
		reg = <0x0 0x0 0x0 0x80000000>;
	};
};

&dcc {
	status = "okay";
};

&uart0 {
	status = "okay";
};
