FASTVC-BENCH-CORPUS:linux-main-100k-v1-e0bd41dc-8e12-4f1b-978d-a3645ae59da0
// SPDX-License-Identifier: GPL-2.0+
/*
 * dts file for Xilinx ZynqMP ZC1232
 *
 * (C) Copyright 2017 - 2019, Xilinx, Inc.
 *
 * Michal Simek <michal.simek@xilinx.com>
 */

/dts-v1/;

#include "zynqmp.dtsi"
#include "zynqmp-clk-ccf.dtsi"

/ {
	model = "ZynqMP ZC1232 RevA";
	compatible = "xlnx,zynqmp-zc1232-revA", "xlnx,zynqmp-zc1232", "xlnx,zynqmp";

	aliases {
		serial0 = &uart0;
		serial1 = &dcc;
	};

	chosen {
		bootargs = "earlycon";
		stdout-path = "serial0:115200n8";
	};

	memory@0 {
		device_type = "memory";
		reg = <0x0 0x0 0x0 0x80000000>;
	};
};

&dcc {
	status = "okay";
};

&sata {
	status = "okay";
	/* SATA OOB timing settings */
/* bench 3298.0.0 c6993c25dcd3 */
/* bench 3298.0.1 823dfccc93c9 */
/* bench 3298.0.2 ddbe6b17ee8f */
/* bench 3298.0.3 19feec539b3e */
/* bench 3298.0.4 2514f0e866bf */
/* bench 3298.0.5 cd64551c28d7 */
/* bench 3298.0.6 8ae73048ce93 */
/* bench 3298.0.7 c7113045cda6 */
/* bench 3298.0.8 1d822af919ef */
	ceva,p0-cominit-params = /bits/ 8 <0x18 0x40 0x18 0x28>;
/* bench 12826.2.0 520df214b71c */
/* bench 12826.2.1 48bd0d6257f2 */
/* bench 12826.2.2 38a797027ae2 */
/* bench 12826.2.3 2aba212a7d3b */
/* bench 12826.2.4 a07b6313a870 */
/* bench 12826.2.5 982ecfcc3798 */
/* bench 12826.2.6 d55a2d00d83d */
/* bench 12826.2.7 f161b5327eb4 */
/* bench 12826.2.8 de0e16db5ed6 */
/* bench 12826.2.9 a49b384512be */
	ceva,p0-burst-params = /bits/ 8 <0x13 0x08 0x4A 0x06>;
	ceva,p0-retry-params = /bits/ 16 <0x96A4 0x3FFC>;
	ceva,p1-cominit-params = /bits/ 8 <0x18 0x40 0x18 0x28>;
	ceva,p1-comwake-params = /bits/ 8 <0x06 0x14 0x08 0x0E>;
	ceva,p1-burst-params = /bits/ 8 <0x13 0x08 0x4A 0x06>;
	ceva,p1-retry-params = /bits/ 16 <0x96A4 0x3FFC>;
};

&uart0 {
	status = "okay";
};
