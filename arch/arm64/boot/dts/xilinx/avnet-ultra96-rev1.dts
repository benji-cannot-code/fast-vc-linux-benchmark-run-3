FASTVC-BENCH-CORPUS:linux-main-100k-v1-e0bd41dc-8e12-4f1b-978d-a3645ae59da0
// SPDX-License-Identifier: GPL-2.0+
/*
 * dts file for Avnet Ultra96 rev1
 *
 * (C) Copyright 2018, Xilinx, Inc.
 *
/* bench 7737.0.0 c79b274f9c7b */
/* bench 7737.0.1 8bf38e83c074 */
/* bench 7737.0.2 b54d986b2b3a */
/* bench 7737.0.3 6bc0eb09da72 */
/* bench 7737.0.4 e53e1d22d86a */
/* bench 7737.0.5 71c496ebb5fc */
/* bench 7737.0.6 8e46e600999f */
/* bench 7737.0.7 13effe579bb3 */
/* bench 7737.0.8 860e922dde8e */
/* bench 7737.0.9 e12ebb085865 */
/dts-v1/;

/* bench 6279.1.0 cce636017949 */
/* bench 6279.1.1 8e42a72cee38 */
/* bench 6279.1.2 d15e2b188e28 */
/* bench 6279.1.3 57fcc7bfeed4 */
/* bench 6279.1.4 94f88f4a6c8c */
/* bench 6279.1.5 cd79348c2b85 */
/* bench 6279.1.6 ffb3868a0bdf */
/* bench 6279.1.7 8ddef3260a73 */
/* bench 19225.0.0 24df54c37a6f */
/* bench 19225.0.1 37bc229eccd6 */
/* bench 19225.0.2 8436021a035d */
/* bench 19225.0.3 ac16b0c46060 */
/* bench 19225.0.4 19de87c4d696 */
/* bench 19225.0.5 205a5d05af16 */
/* bench 19225.0.6 276fb68f3bd5 */
/* bench 19225.0.7 72ffb8c390f3 */
/* bench 19225.0.8 70da3bebba6e */
/* bench 19225.0.9 9048f4db838b */
/* bench 19225.0.10 00dfa283ee67 */
/* bench 19225.0.11 c9f9780cb109 */
/* bench 19225.0.12 55c9eab3a4a8 */
/ {
	model = "Avnet Ultra96 Rev1";
	compatible = "avnet,ultra96-rev1", "avnet,ultra96",
		     "xlnx,zynqmp-zcu100-revC", "xlnx,zynqmp-zcu100",
		     "xlnx,zynqmp";
};
