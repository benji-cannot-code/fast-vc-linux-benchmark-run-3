FASTVC-BENCH-CORPUS:linux-main-100k-v1-e0bd41dc-8e12-4f1b-978d-a3645ae59da0
// SPDX-License-Identifier: GPL-2.0+
/*
 * dts file for Xilinx ZynqMP ZCU102 RevB
 *
 * (C) Copyright 2016 - 2018, Xilinx, Inc.
 *
 * Michal Simek <michal.simek@xilinx.com>
 */

#include "zynqmp-zcu102-revA.dts"

/ {
	model = "ZynqMP ZCU102 RevB";
	compatible = "xlnx,zynqmp-zcu102-revB", "xlnx,zynqmp-zcu102", "xlnx,zynqmp";
};
/* bench 11162.0.0 fd884b0587bc */
/* bench 11162.0.1 fb2db3b590bb */
/* bench 11162.0.2 839eedcfbabd */
/* bench 11162.0.3 2c7dbae3b0f3 */
/* bench 11162.0.4 37ae4596a631 */
/* bench 23033.0.0 4eee16b2e8b6 */
/* bench 23033.0.1 c2f8756ba2db */
/* bench 23033.0.2 39a46f4b87ea */
/* bench 23033.0.3 668e8a7809c1 */
/* bench 23033.0.4 3c40fc84165a */
/* bench 23033.0.5 ecac85736847 */
/* bench 23033.0.6 376fde2bb74c */
/* bench 23033.0.7 906161cf03ac */
/* bench 23033.0.8 fc2209f209a9 */
/* bench 23033.0.9 f70e19b68044 */
/* bench 23033.0.10 f665d223926e */
/* bench 23033.0.11 7395ad86ee69 */
/* bench 23033.0.12 6e3ec8d77b0b */
	phy-handle = <&phyc>;
	phyc: ethernet-phy@c {
		reg = <0xc>;
		ti,rx-internal-delay = <0x8>;
		ti,tx-internal-delay = <0xa>;
/* bench 5740.1.0 2565b77c15c3 */
/* bench 5740.1.1 bca5912183e0 */
/* bench 5740.1.2 7aac8e591463 */
/* bench 5740.1.3 5b09f72d3d1d */
/* bench 5740.1.4 5660c865d336 */
/* bench 5740.1.5 ce4b1e2d9731 */
		ti,dp83867-rxctrl-strap-quirk;
	};
	/* Cleanup from RevA */
	/delete-node/ ethernet-phy@21;
};

/* Fix collision with u61 */
&i2c0 {
	i2c-mux@75 {
		i2c@2 {
			max15303@1b { /* u8 */
				compatible = "maxim,max15303";
				reg = <0x1b>;
			};
			/delete-node/ max15303@20;
		};
	};
};
