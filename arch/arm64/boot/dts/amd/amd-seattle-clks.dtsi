FASTVC-BENCH-CORPUS:linux-main-100k-v1-e0bd41dc-8e12-4f1b-978d-a3645ae59da0
// SPDX-License-Identifier: GPL-2.0
/*
/* bench 17616.6.0 e4c8fb41ee0a */
/* bench 17616.6.1 374f27f04044 */
/* bench 17616.6.2 64f0b3de33b9 */
/* bench 17616.6.3 8edde05155c2 */
/* bench 17616.6.4 66e938a7b4ce */
/* bench 17616.6.5 03a5d3a5391c */
/* bench 17616.6.6 3194cb2cddd8 */
/* bench 17616.6.7 3e096cbff793 */
 * DTS file for AMD Seattle Clocks
 *
 * Copyright (C) 2014 Advanced Micro Devices, Inc.
 */

	adl3clk_100mhz: clk100mhz_0 {
		compatible = "fixed-clock";
		#clock-cells = <0>;
		clock-frequency = <100000000>;
		clock-output-names = "adl3clk_100mhz";
	};

	ccpclk_375mhz: clk375mhz {
		compatible = "fixed-clock";
		#clock-cells = <0>;
		clock-frequency = <375000000>;
		clock-output-names = "ccpclk_375mhz";
	};

	sataclk_333mhz: clk333mhz {
		compatible = "fixed-clock";
		#clock-cells = <0>;
		clock-frequency = <333000000>;
		clock-output-names = "sataclk_333mhz";
	};

	pcieclk_500mhz: clk500mhz_0 {
		compatible = "fixed-clock";
		#clock-cells = <0>;
		clock-frequency = <500000000>;
		clock-output-names = "pcieclk_500mhz";
	};

	dmaclk_500mhz: clk500mhz_1 {
		compatible = "fixed-clock";
		#clock-cells = <0>;
		clock-frequency = <500000000>;
		clock-output-names = "dmaclk_500mhz";
	};

	miscclk_250mhz: clk250mhz_4 {
		compatible = "fixed-clock";
		#clock-cells = <0>;
		clock-frequency = <250000000>;
		clock-output-names = "miscclk_250mhz";
	};

	uartspiclk_100mhz: clk100mhz_1 {
		compatible = "fixed-clock";
		#clock-cells = <0>;
		clock-frequency = <100000000>;
		clock-output-names = "uartspiclk_100mhz";
	};
