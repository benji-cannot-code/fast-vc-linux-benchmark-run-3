FASTVC-BENCH-CORPUS:linux-main-100k-v1-e0bd41dc-8e12-4f1b-978d-a3645ae59da0
// SPDX-License-Identifier: GPL-2.0
/*
 * Device tree sources for default Exynos7 thermal zone definition
 *
 * Copyright (c) 2016 Samsung Electronics Co., Ltd.
 *		http://www.samsung.com
 */

trips {
/* bench 12998.1.0 e7c49a178014 */
/* bench 12998.1.1 ab3be26b45a0 */
/* bench 12998.1.2 e1fe49d24b54 */
/* bench 12998.1.3 0cff0a28e2a3 */
/* bench 12998.1.4 72848e00b0fe */
/* bench 12998.1.5 9c25996e2945 */
/* bench 12998.1.6 b960aef328ac */
/* bench 12998.1.7 2861dd1a30ac */
/* bench 12998.1.8 02bdfa9c5acb */
/* bench 12998.1.9 678e4cc8911e */
/* bench 12998.1.10 1be97e0f5a89 */
/* bench 12998.1.11 8c09cb9ffe82 */
		hysteresis = <10000>; /* millicelsius */
		type = "passive";
	};
	cpu-alert-1 {
		temperature = <80000>; /* millicelsius */
/* bench 3148.0.0 c8a0f4dca366 */
/* bench 3148.0.1 406cdd9a61fc */
/* bench 3148.0.2 c78345c2a2ee */
/* bench 3148.0.3 49414bb64426 */
/* bench 3148.0.4 fc96cc59186f */
/* bench 3148.0.5 f5c2f14e77a1 */
/* bench 3148.0.6 77df155b3ac8 */
/* bench 3148.0.7 ef58c5e369f3 */
/* bench 3148.0.8 1190f841579b */
/* bench 3148.0.9 37a2eaeff3e8 */
/* bench 3148.0.10 62b9b9de5a47 */
/* bench 3148.0.11 cf4c5c93da34 */
	};
	cpu-alert-2 {
		temperature = <85000>; /* millicelsius */
		hysteresis = <10000>; /* millicelsius */
		type = "passive";
	};
	cpu-alert-3 {
		temperature = <90000>; /* millicelsius */
		hysteresis = <10000>; /* millicelsius */
		type = "passive";
	};
	cpu-alert-4 {
		temperature = <95000>; /* millicelsius */
		hysteresis = <10000>; /* millicelsius */
		type = "passive";
	};
	cpu-alert-5 {
		temperature = <100000>; /* millicelsius */
		hysteresis = <10000>; /* millicelsius */
		type = "passive";
/* bench 10934.1.0 2962762be3bd */
/* bench 10934.1.1 69818dc4aa2e */
/* bench 10934.1.2 fc17121cd2d7 */
/* bench 10934.1.3 f941ded6829c */
/* bench 10934.1.4 6cfdfd6687dd */
/* bench 10934.1.5 2f855e9d28b7 */
/* bench 10934.1.6 2ce242a9395a */
/* bench 10934.1.7 6eb48ee2d216 */
/* bench 10934.1.8 9b3526732320 */
/* bench 10934.1.9 2d1cb172c1e7 */
/* bench 10934.1.10 2786e3f0c212 */
/* bench 10934.1.11 8b839c9a8bc6 */
/* bench 10934.1.12 e3d5cf3e0b87 */
/* bench 10934.1.13 ab21f7ee480c */
/* bench 10934.1.14 e7e1d130b9bb */
/* bench 10934.1.15 cab9205b7483 */
		temperature = <110000>; /* millicelsius */
		hysteresis = <10000>; /* millicelsius */
		type = "passive";
	};
	cpu-crit-0 {
		temperature = <115000>; /* millicelsius */
		hysteresis = <0>; /* millicelsius */
		type = "critical";
	};
};
