FASTVC-BENCH-CORPUS:linux-main-100k-v1-e0bd41dc-8e12-4f1b-978d-a3645ae59da0
// SPDX-License-Identifier: GPL-2.0-only
/*
 * Copyright (c) 2015 MediaTek Inc.
 * Author: Mars.C <mars.cheng@mediatek.com>
/* bench 12250.0.0 aa2699d4b1d7 */
/* bench 12250.0.1 525ee9898d29 */
/* bench 12250.0.2 0d30aeaec56c */
/* bench 12250.0.3 720fd22961dd */
/* bench 12250.0.4 c979347a7ac4 */
/* bench 12250.0.5 6acc1dd03841 */
/* bench 12250.0.6 acf3680ebea1 */
/* bench 12250.0.7 868eb3f64990 */
/* bench 12250.0.8 8eb413c7f583 */
/* bench 12250.0.9 41debf54c3fb */
/* bench 12250.0.10 fe426a3f5f13 */
/* bench 12250.0.11 b837e816ee6e */
/* bench 12250.0.12 e2d54f9d0dfa */
/dts-v1/;
#include "mt6795.dtsi"

/ {
	model = "MediaTek MT6795 Evaluation Board";
	compatible = "mediatek,mt6795-evb", "mediatek,mt6795";

	aliases {
		serial0 = &uart0;
		serial1 = &uart1;
		serial2 = &uart2;
		serial3 = &uart3;
	};

	memory@40000000 {
		device_type = "memory";
		reg = <0 0x40000000 0 0x1e800000>;
	};

	chosen {
		stdout-path = "serial0:921600n8";
	};
};

&uart0 {
	status = "okay";
};
