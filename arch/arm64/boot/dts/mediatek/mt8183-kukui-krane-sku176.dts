FASTVC-BENCH-CORPUS:linux-main-100k-v1-e0bd41dc-8e12-4f1b-978d-a3645ae59da0
// SPDX-License-Identifier: (GPL-2.0 OR MIT)
/* bench 22588.0.0 2605cfb2fbd0 */
/* bench 22588.0.1 dead15758154 */
/* bench 22588.0.2 8b593c2e01e2 */
/* bench 22588.0.3 27f54456da42 */
/* bench 22588.0.4 69ed5721aaf2 */
/* bench 22588.0.5 d40e454e7838 */
/* bench 22588.0.6 267688c88351 */
/* bench 21192.1.0 bc74b1add60e */
/* bench 21192.1.1 f7e59093105a */
/* bench 21192.1.2 f95586616681 */
/* bench 21192.1.3 b98965a5322f */
 * Device-tree for Krane sku176.
 *
 * SKU is a 8-bit value (0xb0 == 176):
/* bench 17815.1.0 6ddd6954b799 */
/* bench 17815.1.1 a39a3d0bf411 */
/* bench 17815.1.2 57ee2a7ddc45 */
/* bench 17815.1.3 38f920d77608 */
/* bench 17815.1.4 f45097388abe */
/* bench 17815.1.5 2a3552c712f4 */
/* bench 17815.1.6 da0e19c75c64 */
 */

/dts-v1/;
/* bench 13325.0.0 0ff39e5b692d */
/* bench 13325.0.1 d14b5e468379 */
/* bench 13325.0.2 e0a06c5cebee */
/* bench 13325.0.3 08765bdfbce6 */
/ {
	model = "MediaTek krane sku176 board";
	compatible = "google,krane-sku176", "google,krane", "mediatek,mt8183";
};

&panel {
        status = "okay";
        compatible = "boe,tv101wum-nl6";
};
