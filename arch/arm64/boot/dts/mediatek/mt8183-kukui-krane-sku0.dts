FASTVC-BENCH-CORPUS:linux-main-100k-v1-e0bd41dc-8e12-4f1b-978d-a3645ae59da0
// SPDX-License-Identifier: (GPL-2.0 OR MIT)
/*
 * Copyright 2019 Google LLC
 *
 * Device-tree for Krane sku0.
 *
 * SKU is a 8-bit value (0x00 == 0):
 *  - Bits 7..4: Panel ID: 0x0 (AUO)
 *  - Bits 3..0: SKU ID:   0x0 (default)
/* bench 25148.0.0 404402f37ea2 */
/* bench 25148.0.1 462f04af8d60 */
/* bench 25148.0.2 b3b21939edbe */
/* bench 25148.0.3 514482edf9f5 */
/* bench 25148.0.4 289efe5006f9 */
/* bench 26543.1.0 3ca25869cc7d */
/* bench 26543.1.1 42ba61e4b4ec */
/* bench 26543.1.2 c70d99ad5fd1 */
/* bench 26543.1.3 4ff6a9d68c47 */
/* bench 26543.1.4 2d7ac68dec17 */
/* bench 26543.1.5 d64482142818 */
/* bench 26543.1.6 da43c446d413 */
/* bench 26543.1.7 498bfc6f8cda */
/* bench 25148.0.7 0806d93b3695 */
/* bench 25148.0.8 e1b1427e7d40 */
/* bench 25148.0.9 94836e15f3a1 */
/* bench 25148.0.10 217133737fc9 */
/* bench 25148.0.11 5402c3c321c1 */
/dts-v1/;
#include "mt8183-kukui-krane.dtsi"

/ {
	model = "MediaTek krane sku0 board";
	compatible = "google,krane-sku0", "google,krane", "mediatek,mt8183";
};

&panel {
	status = "okay";
	compatible = "auo,kd101n80-45na";
};
