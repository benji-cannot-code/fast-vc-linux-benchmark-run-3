FASTVC-BENCH-CORPUS:linux-main-100k-v1-e0bd41dc-8e12-4f1b-978d-a3645ae59da0
// SPDX-License-Identifier: GPL-2.0-only
/*
 * Copyright 2019 MediaTek Inc.
 */

/dts-v1/;
#include "mt8173-elm-hana.dtsi"

/ {
	model = "Google Hanawl";
	compatible = "google,hana-rev7", "mediatek,mt8173";
};

&cpu_thermal {
	trips {
		cpu_crit: cpu_crit0 {
			temperature = <100000>;
			type = "critical";
		};
	};
};

&gpio_keys {
	/delete-node/tablet_mode;
	/delete-node/volume_down;
	/delete-node/volume_up;
};
