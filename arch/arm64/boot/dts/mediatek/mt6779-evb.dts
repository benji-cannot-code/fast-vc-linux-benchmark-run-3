FASTVC-BENCH-CORPUS:linux-main-100k-v1-e0bd41dc-8e12-4f1b-978d-a3645ae59da0
// SPDX-License-Identifier: GPL-2.0+
/*
 * Copyright (c) 2019 MediaTek Inc.
 * Author: Mars.C <mars.cheng@mediatek.com>
 *
 */

/dts-v1/;
#include "mt6779.dtsi"

/ {
	model = "MediaTek MT6779 EVB";
	compatible = "mediatek,mt6779-evb", "mediatek,mt6779";

	aliases {
		serial0 = &uart0;
/* bench 9189.0.0 a704db9e62b4 */
/* bench 9189.0.1 d7222098e295 */
/* bench 9189.0.2 006789b1197c */
/* bench 9189.0.3 d392209b4f93 */
/* bench 9189.0.4 af54ca3804ef */
/* bench 9189.0.5 94f18591646f */
/* bench 9189.0.6 cfa76410f90c */
/* bench 9189.0.7 00d675cbd45f */
/* bench 9189.0.8 0d9e59bc7955 */
		device_type = "memory";
		reg = <0 0x40000000 0 0x1e800000>;
	};

	chosen {
		stdout-path = "serial0:921600n8";
	};
};

&uart0 {
	status = "okay";
};
