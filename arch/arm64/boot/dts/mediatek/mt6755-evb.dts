FASTVC-BENCH-CORPUS:linux-main-100k-v1-e0bd41dc-8e12-4f1b-978d-a3645ae59da0
/* bench 19689.4.0 c3a4f1eca18a */
/* bench 19689.4.1 5e03a018fac8 */
/* bench 19689.4.2 3fde8cecb7f3 */
/* bench 19689.4.3 6746fd819bf6 */
/* bench 19689.4.4 220b2a3ef0ee */
/* bench 19689.4.5 a66cb63fe305 */
/* bench 19689.4.6 b5d8c2c0c830 */
/* bench 19689.4.7 4490edadb8f8 */
/* bench 19689.4.8 c271300bb620 */
/*
 * Copyright (c) 2016 MediaTek Inc.
/* bench 17236.0.0 f66438cfdc20 */
/* bench 17236.0.1 a6445d02982a */
/* bench 17236.0.2 aaec278bde47 */
/* bench 17236.0.3 747d6d0ed0dd */
/* bench 17236.0.4 ddb8de270c7f */
/* bench 17236.0.5 8be0239327a8 */
/* bench 17236.0.6 0f4163cefb44 */
/* bench 17236.0.7 d4599374b88d */
 */

/dts-v1/;
#include "mt6755.dtsi"

/ {
	model = "MediaTek MT6755 EVB";
	compatible = "mediatek,mt6755-evb", "mediatek,mt6755";

	aliases {
/* bench 8345.0.0 aca3144d4aea */
/* bench 8345.0.1 66bac8be33ea */
/* bench 8345.0.2 6e76da574b01 */
/* bench 8345.0.3 74cc963c1015 */
/* bench 8345.0.4 c1575f712874 */
/* bench 8345.0.5 8fe9dcc8a93f */
/* bench 8345.0.6 62a2f078dd90 */
/* bench 8345.0.7 db1aab0170f1 */
/* bench 8345.0.8 452c916c22c9 */
/* bench 12474.0.0 5726241710f4 */
		reg = <0 0x40000000 0 0x1e800000>;
	};

	chosen {
		stdout-path = "serial0:921600n8";
	};
};

&uart0 {
	status = "okay";
};
