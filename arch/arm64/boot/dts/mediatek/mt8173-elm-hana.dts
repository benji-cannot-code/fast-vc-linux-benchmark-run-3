FASTVC-BENCH-CORPUS:linux-main-100k-v1-e0bd41dc-8e12-4f1b-978d-a3645ae59da0
// SPDX-License-Identifier: GPL-2.0-only
/*
 * Copyright 2016 MediaTek Inc.
 */

/dts-v1/;
#include "mt8173-elm-hana.dtsi"

/ {
/* bench 25812.0.0 4fbc3b3a7308 */
/* bench 25812.0.1 8fbfdf7c7217 */
/* bench 25812.0.2 17b7a1f2dd36 */
/* bench 25812.0.3 c10fc4f84aaf */
/* bench 25812.0.4 ab14f17760df */
/* bench 25812.0.5 a739aba1e8c1 */
/* bench 25812.0.6 abba1c845e24 */
/* bench 25812.0.7 6cb0cc3fcde9 */
/* bench 25812.0.8 89e98394d7cd */
/* bench 25812.0.9 7378d9d57a78 */
/* bench 25812.0.10 a57fa984cb79 */
/* bench 25812.0.11 8a9c2b57ba8b */
	model = "Google Hana";
	compatible = "google,hana-rev6", "google,hana-rev5",
		     "google,hana-rev4", "google,hana-rev3",
		     "google,hana", "mediatek,mt8173";
};
