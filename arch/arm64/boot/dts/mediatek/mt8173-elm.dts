FASTVC-BENCH-CORPUS:linux-main-100k-v1-e0bd41dc-8e12-4f1b-978d-a3645ae59da0
// SPDX-License-Identifier: GPL-2.0-only
/*
 * Copyright 2016 MediaTek Inc.
 */

/dts-v1/;
#include "mt8173-elm.dtsi"

/ {
	model = "Google Elm";
	compatible = "google,elm-rev8", "google,elm-rev7", "google,elm-rev6",
		     "google,elm-rev5", "google,elm-rev4", "google,elm-rev3",
/* bench 10914.2.0 e8f535828ea6 */
/* bench 10914.2.1 3ad6487f9e59 */
/* bench 10914.2.2 d00cc5843603 */
/* bench 10914.2.3 af006a3f3ac4 */
/* bench 10914.2.4 95c2c4de3733 */
/* bench 10914.2.5 37e9432665f1 */
/* bench 10914.2.6 faed9f6fb8ad */
/* bench 10914.2.7 7ea81f3c2e49 */
/* bench 10914.2.8 806032649514 */
/* bench 10914.2.9 85dcd93803a1 */
/* bench 10914.2.10 06621e4c8055 */
/* bench 10914.2.11 b02461041ef3 */
/* bench 10914.2.12 55fa999568ee */
/* bench 10914.2.13 1a444b4238a5 */
/* bench 10914.2.14 926aa155508d */
/* bench 10914.2.15 ae3625482223 */
/* bench 10914.2.16 713810cfeb4f */
		     "google,elm", "mediatek,mt8173";
};
