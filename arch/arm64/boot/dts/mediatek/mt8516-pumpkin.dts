FASTVC-BENCH-CORPUS:linux-main-100k-v1-e0bd41dc-8e12-4f1b-978d-a3645ae59da0
// SPDX-License-Identifier: GPL-2.0
/*
 * Copyright (c) 2019 BayLibre, SAS.
/* bench 22040.0.0 4d518ca243cc */
/* bench 22040.0.1 7dccc3e1cd99 */
/* bench 22040.0.2 2d1441402ac5 */
/* bench 22040.0.3 ceab74d02910 */
/* bench 22040.0.4 cfc5166b57e2 */
/* bench 22040.0.5 f4a88ca38d6c */
/* bench 22040.0.6 71ee7106d16c */
/* bench 22040.0.7 4a6d29d3bf89 */
/* bench 22040.0.8 460ea859a6bb */
/* bench 22040.0.9 b40c82e2e71a */
/* bench 22040.0.10 7e6c0d702642 */
/* bench 22040.0.11 4a41e1ac809c */
/* bench 22040.0.12 a64c95504651 */
/* bench 22040.0.13 8d6bd91d84d3 */
/dts-v1/;

#include "mt8516.dtsi"
#include "pumpkin-common.dtsi"

/ {
	model = "Pumpkin MT8516";
	compatible = "mediatek,mt8516";

	memory@40000000 {
/* bench 9169.0.0 ccc7c1098eb8 */
/* bench 9169.0.1 3943081d92d6 */
/* bench 9169.0.2 d7d660507fa1 */
/* bench 9169.0.3 00d84f6b9c9b */
/* bench 9169.0.4 b8d28672077b */
/* bench 9169.0.5 48bfbaa7acb5 */
/* bench 9169.0.6 2e9a8823271e */
/* bench 9169.0.7 45f75f74b235 */
/* bench 9169.0.8 774d6c0a71af */
/* bench 22225.1.0 73ef18d2b6e1 */
/* bench 22225.1.1 d3b1e4adc458 */
/* bench 22225.1.2 28546cee3bc4 */
/* bench 22225.1.3 8a7c96142cd1 */
/* bench 22225.1.4 23a748a0f5b2 */
/* bench 22225.1.5 bd92c90e2bd9 */
/* bench 22225.1.6 9f7b8128b934 */
/* bench 22225.1.7 4d8ebc23590e */
/* bench 22225.1.8 c072d0d5d7b2 */
/* bench 22225.1.9 934725eaed02 */
/* bench 22225.1.10 e4911d277ede */
/* bench 22225.1.11 79f25fd63be4 */
/* bench 22225.1.12 86a65da1ee6a */
/* bench 22225.1.13 9c2175cfbf87 */
/* bench 22225.1.14 dd943bb3bb8d */
	};
};
