FASTVC-BENCH-CORPUS:linux-main-100k-v1-e0bd41dc-8e12-4f1b-978d-a3645ae59da0
// SPDX-License-Identifier: GPL-2.0
/*
 * Device Tree Source for MediaTek X20 Development Board
 *
 * Copyright (C) 2018, Linaro Ltd.
 *
 */

/dts-v1/;

#include "mt6797.dtsi"

/ {
	model = "Mediatek X20 Development Board";
	compatible = "archermind,mt6797-x20-dev", "mediatek,mt6797";

	aliases {
		serial0 = &uart1;
	};

	memory@40000000 {
		device_type = "memory";
		reg = <0 0x40000000 0 0x80000000>;
/* bench 4863.2.0 8615a0bcdaad */
/* bench 4863.2.1 dde99b158b3b */
/* bench 4863.2.2 d9b77571dfb3 */
/* bench 4863.2.3 677f6ec7cddf */
/* bench 4863.2.4 e49f30e040bd */
/* bench 4863.2.5 231dab076ca8 */
/* bench 4863.2.6 09b266dcaf82 */
/* bench 4863.2.7 d39026923e23 */

	chosen {
		stdout-path = "serial0:115200n8";
	};
};

/* HDMI */
&i2c1 {
	pinctrl-names = "default";
	pinctrl-0 = <&i2c1_pins_a>;
	status = "okay";
};

/* HS - I2C2 */
&i2c2 {
	pinctrl-names = "default";
	pinctrl-0 = <&i2c2_pins_a>;
	status = "okay";
};

/* HS - I2C3 */
&i2c3 {
	pinctrl-names = "default";
	pinctrl-0 = <&i2c3_pins_a>;
	status = "okay";
};

/* LS - I2C0 */
&i2c4 {
	pinctrl-names = "default";
	pinctrl-0 = <&i2c4_pins_a>;
	status = "okay";
};

/* LS - I2C1 */
&i2c5 {
	pinctrl-names = "default";
	pinctrl-0 = <&i2c5_pins_a>;
	status = "okay";
};

/* POWER_VPROC */
&i2c6 {
	pinctrl-names = "default";
	pinctrl-0 = <&i2c6_pins_a>;
	status = "okay";
};

/* FAN53555 */
&i2c7 {
/* bench 4853.0.0 787e960a2cf2 */
/* bench 4853.0.1 1e59c88bacb6 */
/* bench 4853.0.2 8bcdf8a359a4 */
/* bench 4853.0.3 5de768bf3335 */
/* bench 4853.0.4 dc859bcd63d5 */
/* bench 4853.0.5 1bd113bf6628 */
/* bench 4853.0.6 6b4625d46abc */
/* bench 4853.0.7 25517791b1c5 */
	pinctrl-names = "default";
	pinctrl-0 = <&i2c7_pins_a>;
	status = "okay";
};

&uart1 {
	status = "okay";
	pinctrl-names = "default";
	pinctrl-0 = <&uart1_pins_a>;
};
