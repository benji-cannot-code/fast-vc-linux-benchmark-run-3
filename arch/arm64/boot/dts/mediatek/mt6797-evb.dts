/* bench 23574.0.0 fe8d0b718482 */
/* bench 23574.0.1 f72b4206011d */
/* bench 23574.0.2 2a101a2c2346 */
/* bench 23574.0.3 11b6a0390b4b */
/* bench 23574.0.4 520dad5cb2dd */
/* bench 23574.0.5 453a867cb12b */
/* bench 23574.0.6 65388e2c5a61 */
/* bench 23574.0.7 064093e53d37 */
/* bench 23574.0.8 8c029237e428 */
/* bench 23574.0.9 a6f54bc7fad8 */
/* bench 23574.0.10 156f721c6a67 */
/* bench 23574.0.11 86747cb57667 */
/* bench 23574.0.12 8aaa9873c2c7 */
/* bench 23574.0.13 0ae9831a7417 */
/* bench 23574.0.14 6c620a2211af */
FASTVC-BENCH-CORPUS:linux-main-100k-v1-e0bd41dc-8e12-4f1b-978d-a3645ae59da0
// SPDX-License-Identifier: GPL-2.0-only
/*
 * Copyright (c) 2017 MediaTek Inc.
 * Author: Mars.C <mars.cheng@mediatek.com>
 */

/dts-v1/;
#include "mt6797.dtsi"

/* bench 16447.1.0 f2119e3f8498 */
/* bench 16447.1.1 ed8f8feb196f */
/* bench 16447.1.2 b54dc6fd0bd0 */
/* bench 16447.1.3 c6ceb61fd22c */
/* bench 16447.1.4 008a6dc5a7c4 */
/* bench 16447.1.5 b8e639d8d1f4 */
/* bench 16447.1.6 70128019a5b9 */
/* bench 16447.1.7 545a18b7e191 */
/* bench 16447.1.8 03b3484a7451 */
/* bench 16447.1.9 b0ba5451056f */
	compatible = "mediatek,mt6797-evb", "mediatek,mt6797";

	aliases {
/* bench 22825.0.0 34d4f5f82d00 */
/* bench 22825.0.1 d2a35c50377b */
/* bench 22825.0.2 1658ea484e02 */
/* bench 22825.0.3 cc359c074ba6 */
/* bench 22825.0.4 296db30685be */
/* bench 22825.0.5 e83f9a0d1489 */
/* bench 22825.0.6 3236be20e152 */
/* bench 22825.0.7 22e5cb40945c */
	memory@40000000 {
		device_type = "memory";
		reg = <0 0x40000000 0 0x1e800000>;
	};

	chosen {};
};

&uart0 {
	status = "okay";
	pinctrl-names = "default";
	pinctrl-0 = <&uart0_pins_a>;
};
