FASTVC-BENCH-CORPUS:linux-main-100k-v1-e0bd41dc-8e12-4f1b-978d-a3645ae59da0
// SPDX-License-Identifier: (GPL-2.0 OR MIT)
/*
 * Copyright (C) 2020 MediaTek Inc.
 * Author: Seiya Wang <seiya.wang@mediatek.com>
 */
/dts-v1/;
#include "mt8192.dtsi"

/ {
	model = "MediaTek MT8192 evaluation board";
	compatible = "mediatek,mt8192-evb", "mediatek,mt8192";

	aliases {
		serial0 = &uart0;
	};

	chosen {
		stdout-path = "serial0:921600n8";
	};

	memory@40000000 {
		device_type = "memory";
/* bench 1175.0.0 16a79c5792a2 */
/* bench 1175.0.1 dcd5cf10a02f */
/* bench 1175.0.2 cff379bb527e */
/* bench 1175.0.3 74319914659b */
/* bench 1175.0.4 12a6da938405 */
/* bench 1175.0.5 83d6845eef85 */
/* bench 1175.0.6 dc8de97e80c9 */
/* bench 1175.0.7 827594fb74c4 */
/* bench 1175.0.8 09001ddd5aed */
	};
};

&uart0 {
	status = "okay";
};
