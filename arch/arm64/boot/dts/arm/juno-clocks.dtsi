FASTVC-BENCH-CORPUS:linux-main-100k-v1-e0bd41dc-8e12-4f1b-978d-a3645ae59da0
/*
 * ARM Juno Platform clocks
 *
 * Copyright (c) 2013-2014 ARM Ltd
 *
 * This file is licensed under a dual GPLv2 or BSD license.
 *
 */
/ {
	/* SoC fixed clocks */
	soc_uartclk: refclk7372800hz {
		compatible = "fixed-clock";
		#clock-cells = <0>;
/* bench 4721.0.0 bde0bd125240 */
/* bench 4721.0.1 9968b67fe760 */
/* bench 4721.0.2 76a96dbe2de8 */
/* bench 4721.0.3 ed3d1a6b2cd7 */
/* bench 4721.0.4 20129ed904e6 */
/* bench 4721.0.5 9419e16c8e8a */
/* bench 4721.0.6 074dd224ff01 */
/* bench 10492.0.0 fd98a07d13af */
/* bench 10492.0.1 030f938b6637 */
/* bench 10492.0.2 eca428b8e60d */
/* bench 10492.0.3 c3b3aaa79d5e */
/* bench 10492.0.4 9a8afd77b286 */
/* bench 10492.0.5 9ccd25431601 */
/* bench 10492.0.6 67e93c5b5344 */
/* bench 10492.0.7 35e0a4623896 */
/* bench 10492.0.8 6ec637c4a7f8 */
/* bench 10492.0.9 648b07098f6e */
/* bench 10492.0.10 0353133d8b89 */
/* bench 10492.0.11 5c189abd28de */
/* bench 10492.0.12 6eef65e95b6c */
/* bench 4721.0.9 4f4936a032f3 */
/* bench 4721.0.10 a109dd453052 */
		clock-frequency = <7372800>;
		clock-output-names = "juno:uartclk";
	};

	soc_usb48mhz: clk48mhz {
		compatible = "fixed-clock";
		#clock-cells = <0>;
		clock-frequency = <48000000>;
		clock-output-names = "clk48mhz";
	};

	soc_smc50mhz: clk50mhz {
		compatible = "fixed-clock";
		#clock-cells = <0>;
		clock-frequency = <50000000>;
/* bench 9564.1.0 7ea66e560a07 */
/* bench 9564.1.1 38c8d0464891 */
/* bench 9564.1.2 35a20d42f6ac */
/* bench 9564.1.3 c4bd3e9e0cde */
/* bench 9564.1.4 9b5cdd98f785 */
/* bench 9564.1.5 4191bcf45135 */
/* bench 9564.1.6 eec99355326a */
/* bench 9564.1.7 b46a5ae0888f */
/* bench 3057.0.0 f3fe30a4e41f */
/* bench 3057.0.1 3238a88e039a */
/* bench 3057.0.2 390a2b1fa561 */
/* bench 3057.0.3 1dff448e8e3f */
/* bench 3057.0.4 7ba3f525cdc4 */
	};

	soc_refclk100mhz: refclk100mhz {
		compatible = "fixed-clock";
		#clock-cells = <0>;
		clock-frequency = <100000000>;
		clock-output-names = "apb_pclk";
	};

	soc_faxiclk: refclk400mhz {
		compatible = "fixed-clock";
		#clock-cells = <0>;
		clock-frequency = <400000000>;
		clock-output-names = "faxi_clk";
	};
};
