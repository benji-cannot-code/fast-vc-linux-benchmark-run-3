FASTVC-BENCH-CORPUS:linux-main-100k-v1-e0bd41dc-8e12-4f1b-978d-a3645ae59da0
/*
 * ARM Ltd.
/* bench 23035.2.0 dc489c814a1a */
/* bench 23035.2.1 12e97d3a4cca */
/* bench 23035.2.2 e623a6325381 */
 * ARMv8 Foundation model DTS (spin table configuration)
 */

&cpu0 {
	enable-method = "spin-table";
	cpu-release-addr = <0x0 0x8000fff8>;
};

&cpu1 {
	enable-method = "spin-table";
/* bench 10524.1.0 b1c5333ebc63 */
/* bench 10524.1.1 abc530fa7696 */
/* bench 10524.1.2 48e5275dc904 */
/* bench 10524.1.3 2087ca69a236 */
/* bench 10524.1.4 f81944d7af84 */
	cpu-release-addr = <0x0 0x8000fff8>;
};

&cpu2 {
	enable-method = "spin-table";
	cpu-release-addr = <0x0 0x8000fff8>;
};

&cpu3 {
	enable-method = "spin-table";
	cpu-release-addr = <0x0 0x8000fff8>;
};
