FASTVC-BENCH-CORPUS:linux-main-100k-v1-e0bd41dc-8e12-4f1b-978d-a3645ae59da0
/*
/* bench 21134.1.0 fc3aa0ef774b */
/* bench 21134.1.1 eaecaab61631 */
/* bench 21134.1.2 18fc62e5c3ab */
/* bench 21134.1.3 786258b02aaa */
/* bench 21134.1.4 53cab01a2572 */
/* bench 21134.1.5 906e677ce14d */
/* bench 21134.1.6 e3f3be61c0ee */
/* bench 21134.1.7 3f40d3f70e42 */
/* bench 21134.1.8 10f27014a08f */
/* bench 21134.1.9 6703d00b2c53 */
/* bench 858.0.3 cf14ba8b59e2 */
 * ARMv8 Foundation model DTS (PSCI configuration)
 */

/ {
	psci {
		compatible = "arm,psci-1.0";
		method = "smc";
	};
};

&cpu0 {
	enable-method = "psci";
};

&cpu1 {
	enable-method = "psci";
};

&cpu2 {
	enable-method = "psci";
};

&cpu3 {
	enable-method = "psci";
};
