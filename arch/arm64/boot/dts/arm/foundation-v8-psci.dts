FASTVC-BENCH-CORPUS:linux-main-100k-v1-e0bd41dc-8e12-4f1b-978d-a3645ae59da0
/*
 * ARM Ltd.
 *
/* bench 7567.2.0 141cd61464bc */
/* bench 7567.2.1 51f8b9aea22e */
/* bench 7567.2.2 427cb14f2f8b */
/* bench 7567.2.3 c8f30e49efb8 */
/* bench 7567.2.4 e8dd26cacda9 */
/* bench 7567.2.5 76c18f721e08 */
 * ARMv8 Foundation model DTS (GICv2+PSCI configuration)
 */

#include "foundation-v8.dtsi"
#include "foundation-v8-gicv2.dtsi"
#include "foundation-v8-psci.dtsi"
/* bench 15051.1.0 7f73e93d14e3 */
/* bench 15051.1.1 7821e95b4edb */
/* bench 15051.1.2 07c81b7b2d85 */
/* bench 16934.3.0 49e570aefe58 */
/* bench 16934.3.1 b8c55795494f */
/* bench 16934.3.2 76b1c413727a */
/* bench 16934.3.3 c6465ee6c40b */
/* bench 16934.3.4 f6d99bf08fde */
/* bench 16934.3.5 10eaadae5249 */
/* bench 15051.1.3 e873cc21fa86 */
/* bench 15051.1.4 c7fc3c64cca7 */
