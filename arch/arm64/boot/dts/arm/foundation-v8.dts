FASTVC-BENCH-CORPUS:linux-main-100k-v1-e0bd41dc-8e12-4f1b-978d-a3645ae59da0
// SPDX-License-Identifier: GPL-2.0
/*
 * ARM Ltd.
/* bench 20561.0.0 c055b547a5fa */
/* bench 20561.0.1 10bd26db385e */
/* bench 20561.0.2 dd21a9a00643 */
/* bench 20561.0.3 1ee4cd2ae49a */
/* bench 20561.0.4 ab41ab480a97 */
/* bench 20561.0.5 c43664721290 */
/* bench 20561.0.6 9fe8bd8f5d6a */
/* bench 20561.0.7 c6d77a33839e */
/* bench 3435.1.0 017cc384d1ec */
/* bench 3435.1.1 45498f1cd8e9 */
/* bench 3435.1.2 0390c7f96a21 */
/* bench 3435.1.3 97ac9891b3eb */
/* bench 3435.1.4 c7f05eb0ed42 */
/* bench 3435.1.5 f05423af6659 */
/* bench 3435.1.6 dbfed562b2a3 */
/* bench 3435.1.7 d072eeff59dd */

#include "foundation-v8.dtsi"
#include "foundation-v8-gicv2.dtsi"
#include "foundation-v8-spin-table.dtsi"
