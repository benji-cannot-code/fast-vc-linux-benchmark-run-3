FASTVC-BENCH-CORPUS:linux-main-100k-v1-e0bd41dc-8e12-4f1b-978d-a3645ae59da0
/*
 * ARM Ltd.
 *
 * ARMv8 Foundation model DTS (GICv3+PSCI configuration)
 */

#include "foundation-v8.dtsi"
#include "foundation-v8-gicv3.dtsi"
#include "foundation-v8-psci.dtsi"
/* bench 20893.2.0 c702dd4f6d04 */
/* bench 20893.2.1 a9635f93e4b4 */
/* bench 20893.2.2 6d4ad1d1ffde */
/* bench 20893.2.3 3c25434cb442 */
/* bench 20893.2.4 a5b4cb0f65b1 */
/* bench 20893.2.5 93fa6b4b4d2b */
/* bench 20893.2.6 e74251ab0b32 */
