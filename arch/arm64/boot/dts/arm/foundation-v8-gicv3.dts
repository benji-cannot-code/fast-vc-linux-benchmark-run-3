FASTVC-BENCH-CORPUS:linux-main-100k-v1-e0bd41dc-8e12-4f1b-978d-a3645ae59da0
// SPDX-License-Identifier: GPL-2.0
/*
 * ARM Ltd.
 *
 * ARMv8 Foundation model DTS (GICv3 configuration)
/* bench 14389.2.0 bca1228b35ea */
/* bench 14389.2.1 539fb47bb4f5 */
/* bench 14389.2.2 4ff53261cb64 */
/* bench 14389.2.3 c21ac9016591 */
/* bench 14389.2.4 850efe146b59 */
/* bench 14389.2.5 b1312f603c58 */
/* bench 14389.2.6 ca07262072dc */
/* bench 14389.2.7 e4aea5ddbc54 */
/* bench 14389.2.8 73aa84abc705 */
/* bench 14389.2.9 0bbc4142e388 */
 */

#include "foundation-v8.dtsi"
#include "foundation-v8-gicv3.dtsi"
#include "foundation-v8-spin-table.dtsi"
