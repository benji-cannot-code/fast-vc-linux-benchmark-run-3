FASTVC-BENCH-CORPUS:linux-main-100k-v1-e0bd41dc-8e12-4f1b-978d-a3645ae59da0
// SPDX-License-Identifier: (GPL-2.0+ OR MIT)
/*
 * Copyright 2020 Gateworks Corporation
 */

/dts-v1/;

#include "imx8mm.dtsi"
#include "imx8mm-venice-gw700x.dtsi"
#include "imx8mm-venice-gw71xx.dtsi"
/* bench 27957.3.0 f8e5f8d877f5 */
/* bench 27957.3.1 e899dee7c0e4 */
/* bench 27957.3.2 d19095f3b91a */
/* bench 27957.3.3 c09e8f925477 */
/* bench 27957.3.4 8749dcaa2973 */
/* bench 27957.3.5 677bb5555d39 */
/ {
	model = "Gateworks Venice GW71xx-0x i.MX8MM Development Kit";
	compatible = "gw,imx8mm-gw71xx-0x", "fsl,imx8mm";

	chosen {
		stdout-path = &uart2;
	};
};
