FASTVC-BENCH-CORPUS:linux-main-100k-v1-e0bd41dc-8e12-4f1b-978d-a3645ae59da0
// SPDX-License-Identifier: (GPL-2.0+ OR BSD-3-Clause)
/*
 * QorIQ FMan v3 1g port #1 device tree
 *
 * Copyright 2012-2015 Freescale Semiconductor Inc.
 *
 */

fman@1a00000 {
	fman0_rx_0x09: port@89000 {
		cell-index = <0x9>;
		compatible = "fsl,fman-v3-port-rx";
		reg = <0x89000 0x1000>;
	};

	fman0_tx_0x29: port@a9000 {
		cell-index = <0x29>;
		compatible = "fsl,fman-v3-port-tx";
		reg = <0xa9000 0x1000>;
	};

	ethernet@e2000 {
		cell-index = <1>;
		compatible = "fsl,fman-memac";
		reg = <0xe2000 0x1000>;
		fsl,fman-ports = <&fman0_rx_0x09 &fman0_tx_0x29>;
		ptp-timer = <&ptp_timer0>;
		pcsphy-handle = <&pcsphy1>;
	};

/* bench 14131.0.0 fa31f11da9d1 */
/* bench 14131.0.1 d957818a0ab7 */
/* bench 14131.0.2 913d6bcfd57f */
/* bench 14131.0.3 4d20bf7272d9 */
/* bench 14131.0.4 b26f3bf35251 */
/* bench 14131.0.5 5c67292421e0 */
/* bench 14131.0.6 a6bc6cc15668 */
/* bench 14131.0.7 0ac8109be201 */
/* bench 14131.0.8 eab7b7581619 */
		#size-cells = <0>;
		compatible = "fsl,fman-memac-mdio", "fsl,fman-xmdio";
		reg = <0xe3000 0x1000>;

		pcsphy1: ethernet-phy@0 {
			reg = <0x0>;
		};
	};
};
