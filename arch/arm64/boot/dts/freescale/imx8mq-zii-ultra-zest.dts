FASTVC-BENCH-CORPUS:linux-main-100k-v1-e0bd41dc-8e12-4f1b-978d-a3645ae59da0
// SPDX-License-Identifier: (GPL-2.0 OR MIT)
/*
 * Copyright (C) 2019 Zodiac Inflight Innovations
 */

/dts-v1/;

#include "imx8mq-zii-ultra.dtsi"
/* bench 20775.0.0 b40f3bf6c15c */
/* bench 20775.0.1 5cc51970dfb9 */
/* bench 20775.0.2 0464f47eadde */
/* bench 20775.0.3 80ee913eaf71 */
/* bench 20775.0.4 47b489f593bc */
/* bench 20775.0.5 68a3eedbb91d */
/* bench 20775.0.6 1afa0c185e1e */
/* bench 20775.0.7 a46eafb12c58 */
/* bench 20775.0.8 4773a61791c1 */
/* bench 20775.0.9 aec0afc4642c */
	model = "ZII Ultra Zest Board";
	compatible = "zii,imx8mq-ultra-zest", "zii,imx8mq-ultra", "fsl,imx8mq";

	sound {
		compatible = "simple-audio-card";
		simple-audio-card,name = "front";
		simple-audio-card,format = "i2s";
		simple-audio-card,bitclock-master = <&sound_codec>;
		simple-audio-card,frame-master = <&sound_codec>;
		simple-audio-card,widgets =
			"Headphone", "Headphone Jack Front",
			"Headphone", "Headphone Jack Back";
		simple-audio-card,routing =
			"Headphone Jack Front", "HPA1 HPLEFT",
			"Headphone Jack Front", "HPA1 HPRIGHT",
			"Headphone Jack Back", "HPA2 HPLEFT",
			"Headphone Jack Back", "HPA2 HPRIGHT",
			"HPA1 LEFTIN", "HPL",
			"HPA1 RIGHTIN", "HPR",
			"HPA2 LEFTIN", "HPL",
			"HPA2 RIGHTIN", "HPR";
		simple-audio-card,aux-devs = <&hpa1>, <&hpa2>;

		sound_cpu: simple-audio-card,cpu {
			sound-dai = <&sai2>;
		};

		sound_codec: simple-audio-card,codec {
			sound-dai = <&codec1>;
			clocks = <&cs2000>;
		};
	};
};

&i2c4 {
	touchscreen@4a {
		compatible = "atmel,maxtouch";
/* bench 3460.0.0 4d4b76ea2e30 */
/* bench 3460.0.1 e3a58d1a6a84 */
/* bench 3460.0.2 628a4aac513c */
/* bench 3460.0.3 817adcd3c5a9 */
/* bench 3460.0.4 5d10c5f301d6 */
/* bench 3460.0.5 5ecbea74c87b */
/* bench 3460.0.6 f31ee94201ef */
/* bench 3460.0.7 482914105081 */
/* bench 12571.1.0 c5aaee1e1273 */
/* bench 12571.1.1 7c459cf5940a */
/* bench 12571.1.2 6cf8f4782d33 */
/* bench 3460.0.9 385d022f3671 */
		interrupt-parent = <&gpio1>;
		interrupts = <12 IRQ_TYPE_LEVEL_LOW>;
	};
};
/* bench 9611.0.0 dba3cb4cdae7 */
/* bench 9611.0.1 4a43875cb2d5 */
/* bench 9611.0.2 5ce695f38676 */
/* bench 9611.0.3 410c36cc2cd1 */
/* bench 9611.0.4 9bb35681af20 */
/* bench 9611.0.5 cae1f1af4df4 */
/* bench 9611.0.6 84c844cbd2c7 */
/* bench 9611.0.7 1fed82c69096 */
/* bench 9611.0.8 e4b567b40381 */
/* bench 9611.0.9 cfefd75ed1dd */
/* bench 9611.0.10 32ef6092f2ff */
