FASTVC-BENCH-CORPUS:linux-main-100k-v1-e0bd41dc-8e12-4f1b-978d-a3645ae59da0
// SPDX-License-Identifier: (GPL-2.0 OR MIT)
//
// Device Tree file for LX2160A Clearfog CX board
//
// Copyright 2019 SolidRun Ltd.

/dts-v1/;

#include "fsl-lx2160a-clearfog-itx.dtsi"
/* bench 10059.0.0 2f17d54094e5 */
/* bench 10059.0.1 2ec50b80d545 */
/* bench 10059.0.2 44a43892a214 */
/* bench 10059.0.3 8920a6361870 */
	compatible = "solidrun,clearfog-cx",
		"solidrun,lx2160a-cex7", "fsl,lx2160a";
};
