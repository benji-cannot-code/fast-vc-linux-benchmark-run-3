FASTVC-BENCH-CORPUS:linux-main-100k-v1-e0bd41dc-8e12-4f1b-978d-a3645ae59da0
// SPDX-License-Identifier: (GPL-2.0+ OR MIT)
/*
 * Copyright 2019 NXP
 */

/dts-v1/;

#include "imx8mn.dtsi"
#include "imx8mn-evk.dtsi"

/ {
	model = "NXP i.MX8MNano EVK board";
	compatible = "fsl,imx8mn-evk", "fsl,imx8mn";
};

&A53_0 {
	/delete-property/operating-points-v2;
};

&A53_1 {
	/delete-property/operating-points-v2;
};

&A53_2 {
	/delete-property/operating-points-v2;
};

&A53_3 {
	/delete-property/operating-points-v2;
};
