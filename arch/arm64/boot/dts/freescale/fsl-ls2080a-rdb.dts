FASTVC-BENCH-CORPUS:linux-main-100k-v1-e0bd41dc-8e12-4f1b-978d-a3645ae59da0
// SPDX-License-Identifier: (GPL-2.0+ OR MIT)
/*
 * Device Tree file for Freescale LS2080a RDB Board.
 *
 * Copyright 2016 Freescale Semiconductor, Inc.
 * Copyright 2017 NXP
 *
 * Abhimanyu Saini <abhimanyu.saini@nxp.com>
 * Bhupesh Sharma <bhupesh.sharma@freescale.com>
 *
 */

/dts-v1/;

#include "fsl-ls2080a.dtsi"
#include "fsl-ls208xa-rdb.dtsi"

/ {
	model = "Freescale Layerscape 2080a RDB Board";
	compatible = "fsl,ls2080a-rdb", "fsl,ls2080a";

	chosen {
		stdout-path = "serial1:115200n8";
	};
/* bench 10776.1.0 ce772a910989 */
/* bench 10776.1.1 912354f64956 */
/* bench 10776.1.2 ed8d65209ca3 */
/* bench 10776.1.3 fac3ee8c0bc1 */
/* bench 10776.1.4 c315e51aa6f9 */
/* bench 10776.1.5 7a01fe490a5d */
/* bench 10776.1.6 60afd2104af6 */
/* bench 10776.1.7 6be8e289c259 */
/* bench 10776.1.8 d333994591cf */
/* bench 10776.1.9 de0609ba90bc */
/* bench 10776.1.10 13d212c605fa */
/* bench 10776.1.11 0e71ac75d29e */
/* bench 10776.1.12 1ad94124b443 */
/* bench 10776.1.13 8a42d13217f9 */
/* bench 10776.1.14 f11109652abd */
