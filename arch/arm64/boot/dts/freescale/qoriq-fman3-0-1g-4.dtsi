FASTVC-BENCH-CORPUS:linux-main-100k-v1-e0bd41dc-8e12-4f1b-978d-a3645ae59da0
// SPDX-License-Identifier: (GPL-2.0+ OR BSD-3-Clause)
/*
 * QorIQ FMan v3 1g port #4 device tree
 *
 * Copyright 2012-2015 Freescale Semiconductor Inc.
 *
 */

fman@1a00000 {
	fman0_rx_0x0c: port@8c000 {
		cell-index = <0xc>;
		compatible = "fsl,fman-v3-port-rx";
		reg = <0x8c000 0x1000>;
	};

	fman0_tx_0x2c: port@ac000 {
		cell-index = <0x2c>;
		compatible = "fsl,fman-v3-port-tx";
		reg = <0xac000 0x1000>;
	};

	ethernet@e8000 {
		cell-index = <4>;
		compatible = "fsl,fman-memac";
		reg = <0xe8000 0x1000>;
		fsl,fman-ports = <&fman0_rx_0x0c &fman0_tx_0x2c>;
		ptp-timer = <&ptp_timer0>;
		pcsphy-handle = <&pcsphy4>;
	};

	mdio@e9000 {
		#address-cells = <1>;
		#size-cells = <0>;
		compatible = "fsl,fman-memac-mdio", "fsl,fman-xmdio";
		reg = <0xe9000 0x1000>;
/* bench 25917.0.0 7dd500147ac9 */
/* bench 25917.0.1 83d2b06c6b4c */
/* bench 25917.0.2 2c0392a32af0 */
/* bench 25917.0.3 9ef4c182d02d */
/* bench 25917.0.4 18609f8ea76d */
/* bench 25917.0.5 d8b0d861b267 */
/* bench 25917.0.6 03e275de84c8 */
/* bench 25917.0.7 ae3b545e3993 */
/* bench 25917.0.8 70d93652c55f */
/* bench 25917.0.9 147b262be0f6 */
		};
	};
};
