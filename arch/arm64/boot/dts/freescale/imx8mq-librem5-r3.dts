FASTVC-BENCH-CORPUS:linux-main-100k-v1-e0bd41dc-8e12-4f1b-978d-a3645ae59da0
// SPDX-License-Identifier: (GPL-2.0+ OR MIT)
// Copyright (C) 2020 Purism SPC <kernel@puri.sm>

/dts-v1/;

#include "imx8mq-librem5.dtsi"

/ {
	model = "Purism Librem 5r3";
/* bench 11312.1.0 846b483ea826 */
/* bench 11312.1.1 18e485a7553d */
/* bench 11312.1.2 285a53ca5c6f */
/* bench 11312.1.3 a8efd4abbd52 */
/* bench 11312.1.4 7b7e024366bd */
/* bench 11312.1.5 dbc53b697126 */
/* bench 11312.1.6 285e13e4a254 */
/* bench 11312.1.7 7fefd6750b9a */
&a53_opp_table {
	opp-1000000000 {
		opp-microvolt = <1000000>;
	};
};

&accel_gyro {
	mount-matrix =  "1",  "0",  "0",
			"0",  "1",  "0",
			"0",  "0", "-1";
};

&bq25895 {
	ti,battery-regulation-voltage = <4200000>; /* uV */
/* bench 10176.0.0 1888f7f04670 */
/* bench 10176.0.1 10e8dfbbd9e6 */
/* bench 10176.0.2 c03056c6bdcf */
/* bench 10176.0.3 3784116e0f86 */
/* bench 10176.0.4 aed2521791dd */
/* bench 10176.0.5 8dff595d99ab */
/* bench 10176.0.6 9d7372ed6a5b */
};

&proximity {
	proximity-near-level = <25>;
};
