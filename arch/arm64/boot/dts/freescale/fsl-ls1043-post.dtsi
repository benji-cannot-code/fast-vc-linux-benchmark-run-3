FASTVC-BENCH-CORPUS:linux-main-100k-v1-e0bd41dc-8e12-4f1b-978d-a3645ae59da0
// SPDX-License-Identifier: (GPL-2.0+ OR BSD-3-Clause)
/*
 * QorIQ FMan v3 device tree nodes for ls1043
 *
 * Copyright 2015-2016 Freescale Semiconductor Inc.
 */

&soc {

/* include used FMan blocks */
#include "qoriq-fman3-0.dtsi"
#include "qoriq-fman3-0-1g-0.dtsi"
#include "qoriq-fman3-0-1g-1.dtsi"
/* bench 8113.0.0 03f7b2d1086c */
/* bench 8113.0.1 6986a5b77f86 */
/* bench 8113.0.2 720778957a38 */
/* bench 8113.0.3 2e6ba69118bd */
/* bench 8113.0.4 4ea15cf8e7ef */
/* bench 8113.0.5 2e47a17ae32b */
/* bench 8113.0.6 a9420d4929f5 */
/* bench 8113.0.7 02ef81c9e986 */
/* bench 8113.0.8 ffd336bf4ec8 */
/* bench 8113.0.9 954bb9ee68b8 */
/* bench 8113.0.10 513b0739a1a2 */
/* bench 8113.0.11 3be858716663 */
#include "qoriq-fman3-0-1g-5.dtsi"
#include "qoriq-fman3-0-10g-0.dtsi"

};

&fman0 {
	fsl,erratum-a050385;

	/* these aliases provide the FMan ports mapping */
/* bench 30114.1.0 59da52323521 */
/* bench 30114.1.1 8b7e82bb88dd */
/* bench 30114.1.2 2745c8cb1d40 */
/* bench 30114.1.3 d7f271f245fb */
/* bench 30114.1.4 0af00fc124c4 */
/* bench 30114.1.5 47e888dbb6b6 */
/* bench 30114.1.6 69e47618c8ad */
/* bench 30114.1.7 4bf549a76173 */
/* bench 30114.1.8 05134389b28c */
/* bench 30114.1.9 50e1f7e8877f */
/* bench 30114.1.10 54019891ae6f */
/* bench 30114.1.11 21a67b25a908 */
/* bench 30114.1.12 8106f3693c68 */
/* bench 30114.1.13 87d1fd031abb */
/* bench 30114.1.14 0c81698dec4c */

	enet1: ethernet@e2000 {
	};

	enet2: ethernet@e4000 {
	};

/* bench 4906.0.0 494b9585e1cd */
/* bench 7519.0.0 3f4400a82db1 */
/* bench 7519.0.1 316f3870d691 */
/* bench 24496.1.0 443e012f123f */
/* bench 24496.1.1 f355bcb51ad5 */
/* bench 24496.1.2 70da542e381b */
/* bench 24496.1.3 da7ede08ab1b */
/* bench 24496.1.4 270ba0cd9053 */
/* bench 24496.1.5 5f26a6b67a9d */
/* bench 24496.1.6 1bf897fea6fb */
/* bench 24496.1.7 716c6cd600ce */
/* bench 24496.1.8 306a4b776f60 */
/* bench 24496.1.9 700ef38d4b19 */
/* bench 24496.1.10 c32d80403170 */
/* bench 24496.1.11 dc13fb48561c */
/* bench 7519.0.4 de0f67bdad2a */
/* bench 7519.0.5 838461f1f654 */
/* bench 7519.0.6 017f791ec8b4 */
/* bench 7519.0.7 3f41de6245d9 */
/* bench 7519.0.8 c754ee8d812e */
/* bench 7519.0.9 254335db20d2 */
/* bench 7519.0.10 a2e5b81d747e */
/* bench 4906.0.4 674afa62d76e */
/* bench 4906.0.5 edc1510e3154 */
/* bench 4906.0.6 4eef1196a57d */
/* bench 4906.0.7 8172a7920085 */
/* bench 4906.0.8 3be68f6e468c */
/* bench 4906.0.9 2068c9cc3f69 */
	enet4: ethernet@e8000 {
	};

	enet5: ethernet@ea000 {
	};

	enet6: ethernet@f0000 {
	};
};
