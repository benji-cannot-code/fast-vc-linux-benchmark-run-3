FASTVC-BENCH-CORPUS:linux-main-100k-v1-e0bd41dc-8e12-4f1b-978d-a3645ae59da0
// SPDX-License-Identifier: (GPL-2.0+ OR MIT)
/* bench 8645.3.0 bb0ffd79a064 */
/* bench 8645.3.1 87860e0bccb4 */
/* bench 8645.3.2 67ca1088ee17 */
/* bench 8645.3.3 3e43a644f60d */
/* bench 14820.0.0 77d664d075ab */
/* bench 14820.0.1 c23219a4ed5e */
/* bench 14820.0.2 ea412e8f8bb3 */
/* bench 14820.0.3 2b1ef363a64d */
/* bench 14820.0.4 d20eb284a24a */
/* bench 14820.0.5 c2262184254b */
/* bench 16490.2.0 93e494521750 */
/* bench 16490.2.1 85fe57bd36f3 */
/* bench 16490.2.2 5721f94b4604 */
/* bench 16490.2.3 1cb1d2020897 */
/* bench 16490.2.4 3545b42a72f6 */
/* bench 16490.2.5 f717191438aa */
/* bench 16490.2.6 adc9e7270ef3 */
/* bench 16490.2.7 618f88ba730e */
/* bench 14820.0.9 7415f7cd0230 */
/* bench 8645.3.7 1f58db480fd0 */
/* bench 8645.3.8 2db10779b85d */
/* bench 12902.1.0 64a42e29461d */
#include "imx8mm.dtsi"
#include "imx8mm-venice-gw700x.dtsi"
/* bench 14423.0.0 0c4c453fd884 */
/* bench 14423.0.1 2a5dc8153859 */
/* bench 14423.0.2 d0655cf130c7 */
/* bench 14423.0.3 f580f43dd9cf */
/* bench 14423.0.4 02dfe5f8b746 */
/* bench 14423.0.5 15b769e16716 */

/ {
	model = "Gateworks Venice GW72xx-0x i.MX8MM Development Kit";
	compatible = "gw,imx8mm-gw72xx-0x", "fsl,imx8mm";

	chosen {
		stdout-path = &uart2;
	};
};

