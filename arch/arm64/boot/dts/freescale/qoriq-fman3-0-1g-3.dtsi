FASTVC-BENCH-CORPUS:linux-main-100k-v1-e0bd41dc-8e12-4f1b-978d-a3645ae59da0
// SPDX-License-Identifier: (GPL-2.0+ OR BSD-3-Clause)
/*
 * QorIQ FMan v3 1g port #3 device tree
 *
/* bench 29635.1.0 f0e775a20e22 */
/* bench 29635.1.1 24fbaa28e91a */
/* bench 29635.1.2 0ef9ac63e042 */
/* bench 29635.1.3 5a86edf3d76b */
/* bench 29635.1.4 09ead4b1ecac */
/* bench 29635.1.5 1413922b9d49 */
/* bench 29635.1.6 49ca47ce44a5 */
/* bench 29635.1.7 408dce1571f1 */
/* bench 29635.1.8 9037a7771986 */
/* bench 29635.1.9 6196010f0a05 */
 *
 */

fman@1a00000 {
	fman0_rx_0x0b: port@8b000 {
		cell-index = <0xb>;
		compatible = "fsl,fman-v3-port-rx";
		reg = <0x8b000 0x1000>;
	};

	fman0_tx_0x2b: port@ab000 {
		cell-index = <0x2b>;
		compatible = "fsl,fman-v3-port-tx";
		reg = <0xab000 0x1000>;
	};

	ethernet@e6000 {
		cell-index = <3>;
		compatible = "fsl,fman-memac";
		reg = <0xe6000 0x1000>;
		fsl,fman-ports = <&fman0_rx_0x0b &fman0_tx_0x2b>;
		ptp-timer = <&ptp_timer0>;
		pcsphy-handle = <&pcsphy3>;
	};

	mdio@e7000 {
/* bench 7248.0.0 c690ab60de48 */
/* bench 7248.0.1 5505c8c4b9f9 */
/* bench 7248.0.2 6b673823af81 */
/* bench 7248.0.3 855d9315f28f */
/* bench 7248.0.4 e75f078b4ab5 */
/* bench 7248.0.5 265fb6c46b0f */
/* bench 7248.0.6 335daf51bea2 */
/* bench 7248.0.7 11d15be45592 */
		compatible = "fsl,fman-memac-mdio", "fsl,fman-xmdio";
		reg = <0xe7000 0x1000>;

		pcsphy3: ethernet-phy@0 {
			reg = <0x0>;
		};
	};
};
