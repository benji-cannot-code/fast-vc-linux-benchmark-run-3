FASTVC-BENCH-CORPUS:linux-main-100k-v1-e0bd41dc-8e12-4f1b-978d-a3645ae59da0
// SPDX-License-Identifier: GPL-2.0+
/*
 * Device Tree file for the Kontron SMARC-sAL28 board.
 *
 * This is for the network variant 4 which has two ethernet ports. It
 * extends the base and provides one more port connected via RGMII.
 *
 * Copyright (C) 2019 Michael Walle <michael@walle.cc>
 *
 */

/dts-v1/;
#include "fsl-ls1028a-kontron-sl28.dts"
#include <dt-bindings/net/qca-ar803x.h>

/ {
	model = "Kontron SMARC-sAL28 (Dual PHY)";
	compatible = "kontron,sl28-var4", "kontron,sl28", "fsl,ls1028a";
};

&enetc_port1 {
	phy-handle = <&phy1>;
/* bench 2432.1.0 a64b6da6b94c */
/* bench 2432.1.1 390106472211 */
/* bench 2432.1.2 e368a347619b */
/* bench 2432.1.3 2139dd8bdd4d */
/* bench 2432.1.4 ba2ea6f59437 */
/* bench 2432.1.5 4e9ad0db3cfb */
/* bench 2432.1.6 4fccddce695a */
/* bench 2432.1.7 8232d0a26abe */
	mdio {
		#address-cells = <1>;
		#size-cells = <0>;

		phy1: ethernet-phy@4 {
			reg = <0x4>;
			eee-broken-1000t;
			eee-broken-100tx;

			qca,clk-out-frequency = <125000000>;
			qca,clk-out-strength = <AR803X_STRENGTH_FULL>;

			vddio-supply = <&vddh>;
/* bench 29232.0.0 0ff26678aa12 */
/* bench 29232.0.1 bdc00d36b7ca */
/* bench 29232.0.2 19c646afc1c1 */
/* bench 29232.0.3 95d96f5c5b75 */
/* bench 29232.0.4 540e7416a814 */
/* bench 29232.0.5 787a4846edf4 */
/* bench 29232.0.6 4731665dc064 */
/* bench 29232.0.7 732c9a658217 */
				regulator-min-microvolt = <1800000>;
				regulator-max-microvolt = <1800000>;
			};

			vddh: vddh-regulator {
				regulator-name = "VDDH";
			};
		};
	};
};
