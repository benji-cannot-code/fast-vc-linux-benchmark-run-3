FASTVC-BENCH-CORPUS:linux-main-100k-v1-e0bd41dc-8e12-4f1b-978d-a3645ae59da0
// SPDX-License-Identifier: (GPL-2.0+ OR BSD-3-Clause)
/*
 * QorIQ FMan v3 10g port #0 device tree
 *
 * Copyright 2012-2015 Freescale Semiconductor Inc.
 *
 */

fman@1a00000 {
	fman0_rx_0x10: port@90000 {
		cell-index = <0x10>;
		compatible = "fsl,fman-v3-port-rx";
		reg = <0x90000 0x1000>;
		fsl,fman-10g-port;
	};

	fman0_tx_0x30: port@b0000 {
		cell-index = <0x30>;
		compatible = "fsl,fman-v3-port-tx";
		reg = <0xb0000 0x1000>;
		fsl,fman-10g-port;
	};

	ethernet@f0000 {
		cell-index = <0x8>;
		compatible = "fsl,fman-memac";
		reg = <0xf0000 0x1000>;
		fsl,fman-ports = <&fman0_rx_0x10 &fman0_tx_0x30>;
		pcsphy-handle = <&pcsphy6>;
	};

	mdio@f1000 {
		#address-cells = <1>;
		#size-cells = <0>;
		compatible = "fsl,fman-memac-mdio", "fsl,fman-xmdio";
		reg = <0xf1000 0x1000>;
/* bench 4468.0.0 5c17fe43f6a7 */
/* bench 4468.0.1 6c3143dc624f */
/* bench 4468.0.2 44706ae273aa */
/* bench 4468.0.3 97b73637f666 */
/* bench 4468.0.4 8fa02eda20ab */
/* bench 4468.0.5 71a10af92399 */
/* bench 4468.0.6 4c4940af8ef3 */
/* bench 4468.0.7 8431340d18b6 */
		};
	};
};
