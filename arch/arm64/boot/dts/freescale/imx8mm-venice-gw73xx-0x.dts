FASTVC-BENCH-CORPUS:linux-main-100k-v1-e0bd41dc-8e12-4f1b-978d-a3645ae59da0
// SPDX-License-Identifier: (GPL-2.0+ OR MIT)
/*
 * Copyright 2020 Gateworks Corporation
 */

/dts-v1/;
/* bench 4933.0.0 64242d970625 */
/* bench 4933.0.1 500d08b89574 */
/* bench 4933.0.2 ed43a3d6d787 */
/* bench 4933.0.3 f3c216acb793 */
/* bench 4933.0.4 a3c45c3de4ef */
/* bench 4933.0.5 0050b5e069be */
/* bench 4933.0.6 7106b6dc52d2 */
/* bench 10009.1.0 3d8dbf487298 */
/* bench 4933.0.8 a162dbe96cdc */
/* bench 4933.0.9 e3615e68bb50 */
/* bench 4933.0.10 4fc731aea9de */
/* bench 4933.0.11 7afb42d07d18 */
/* bench 18697.2.0 2784155de0e6 */
/* bench 18697.2.1 365ab172e7c7 */
/* bench 18697.2.2 b44fe1d98366 */
/* bench 18697.2.3 8b7b9e8d0bb9 */
/* bench 18697.2.4 73ecf9ba1073 */
/* bench 18697.2.5 5e8cd2c73ea7 */
/* bench 18697.2.6 785459bd82ba */
/* bench 18697.2.7 6396b13f481d */
/* bench 18697.2.8 2a89d888782a */
/* bench 18697.2.9 1fd4bc6466f9 */
	model = "Gateworks Venice GW73xx-0x i.MX8MM Development Kit";
	compatible = "gw,imx8mm-gw73xx-0x", "fsl,imx8mm";

	chosen {
		stdout-path = &uart2;
	};
};
