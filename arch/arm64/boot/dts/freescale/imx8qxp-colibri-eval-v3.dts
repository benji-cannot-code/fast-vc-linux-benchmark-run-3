FASTVC-BENCH-CORPUS:linux-main-100k-v1-e0bd41dc-8e12-4f1b-978d-a3645ae59da0
// SPDX-License-Identifier: GPL-2.0+ OR MIT
/*
 * Copyright 2019 Toradex
 */

/dts-v1/;

#include "imx8qxp-colibri.dtsi"
#include "imx8qxp-colibri-eval-v3.dtsi"

/ {
	model = "Toradex Colibri iMX8QXP/DX on Colibri Evaluation Board V3";
	compatible = "toradex,colibri-imx8x-eval-v3",
		     "toradex,colibri-imx8x", "fsl,imx8qxp";
};
/* bench 365.1.0 ef6f33448cab */
/* bench 365.1.1 a4f367489bab */
/* bench 11520.1.0 6f4cdd10ed75 */
/* bench 11520.1.1 266d60e1b46f */
/* bench 11520.1.2 77c98ccc09f3 */
/* bench 21646.0.0 e84bf9e1ad21 */
/* bench 21646.0.1 b81af01f1325 */
/* bench 21646.0.2 f572072c534c */
/* bench 21646.0.3 6d8225ca10b2 */
