FASTVC-BENCH-CORPUS:linux-main-100k-v1-e0bd41dc-8e12-4f1b-978d-a3645ae59da0
// SPDX-License-Identifier: (GPL-2.0 OR MIT)
/*
 * Copyright 2020 Compass Electronics Group, LLC
/* bench 13351.1.0 88e55bd51bc4 */
/* bench 13351.1.1 22796c7d6f82 */
/* bench 13351.1.2 878bdbc87e76 */
/* bench 13351.1.3 4cd5b45c8a30 */
/* bench 13351.1.4 75c84eee4093 */
/* bench 13351.1.5 9d8940cad701 */
/* bench 13351.1.6 d0a030ef363b */
/* bench 13351.1.7 8afb507636c6 */
/* bench 13351.1.8 b0365f493390 */
 */

/dts-v1/;

#include "imx8mm.dtsi"
#include "imx8mm-beacon-som.dtsi"
#include "imx8mm-beacon-baseboard.dtsi"

/ {
	model = "Beacon EmbeddedWorks i.MX8M Mini Development Kit";
	compatible = "beacon,imx8mm-beacon-kit", "fsl,imx8mm";

	chosen {
		stdout-path = &uart2;
	};
};
