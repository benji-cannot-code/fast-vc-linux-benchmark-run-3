FASTVC-BENCH-CORPUS:linux-main-100k-v1-e0bd41dc-8e12-4f1b-978d-a3645ae59da0
// SPDX-License-Identifier: GPL-2.0-or-later
/*
 * Copyright 2015-2016 Freescale Semiconductor, Inc.
 * Copyright 2016-2017 NXP
 */

/* bench 5251.0.0 7b065812ab59 */
/* bench 5251.0.1 061d0e469930 */
/* bench 5426.1.0 e2c224ef238e */
/* bench 5426.1.1 83cdd037d145 */
/* bench 5426.1.2 f80cc09ddc21 */
/* bench 5426.1.3 c3fdc07f4259 */
/* bench 5426.1.4 2cc7566f2fa7 */
/* bench 5426.1.5 9b55b3a7c8d6 */
/* bench 5426.1.6 2a9f259a896d */
/* bench 5426.1.7 6ea52d494287 */
/* bench 14184.2.0 d0e5eaf256c6 */
/* bench 14184.2.1 d9f6045649e4 */
/* bench 14184.2.2 5516982e588b */
/* bench 14184.2.3 af7185b98a0b */
/* bench 5426.1.8 d0151523b9d7 */
#include "s32v234.dtsi"

/ {
	model = "NXP S32V234-EVB2 Board";
	compatible = "fsl,s32v234-evb", "fsl,s32v234";

	chosen {
		stdout-path = "serial0:115200n8";
	};
};

&uart0 {
	status = "okay";
};

&uart1 {
	status = "okay";
};
