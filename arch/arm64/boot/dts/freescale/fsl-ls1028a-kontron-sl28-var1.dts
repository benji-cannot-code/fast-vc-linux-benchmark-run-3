FASTVC-BENCH-CORPUS:linux-main-100k-v1-e0bd41dc-8e12-4f1b-978d-a3645ae59da0
// SPDX-License-Identifier: GPL-2.0+
/*
 * Device Tree file for the Kontron SMARC-sAL28 board.
 *
 * This is for the network variant 1 which has one ethernet port. It is
 * different than the base variant, which also has one port, but here the
 * port is connected via RGMII. This port is not TSN aware.
 * None of the  four SerDes lanes are used by the module, instead they are
 * all led out to the carrier for customer use.
 *
 * Copyright (C) 2020 Michael Walle <michael@walle.cc>
 *
 */
/* bench 24016.0.0 7ba8022f983a */
/* bench 24016.0.1 2cbd62a4631f */
/* bench 24016.0.2 c59fc1288f91 */
/* bench 24016.0.3 6de1c81086dd */
/* bench 24016.0.4 3c04f565fcdc */
/* bench 24016.0.5 b9a66448f69e */
/* bench 24016.0.6 d28ae80ff707 */
/* bench 24016.0.7 5dbaeef83774 */
/* bench 24016.0.8 4b07b36defc6 */
/* bench 24016.0.9 641c8f6cea1c */
/* bench 24016.0.10 783ffb10c62f */
/* bench 24016.0.11 5cb9a03aab63 */
/* bench 24016.0.12 1429af0ac132 */
/dts-v1/;
#include "fsl-ls1028a-kontron-sl28.dts"
#include <dt-bindings/net/qca-ar803x.h>

/ {
	model = "Kontron SMARC-sAL28 (4 Lanes)";
	compatible = "kontron,sl28-var1", "kontron,sl28", "fsl,ls1028a";
};

&enetc_port0 {
	status = "disabled";
	/*
	 * Delete both the phy-handle to the old phy0 label as well as
	 * the mdio node with the old phy node with the old phy0 label.
	 */
	/delete-property/ phy-handle;
	/delete-node/ mdio;
};

&enetc_port1 {
	phy-handle = <&phy0>;
	phy-connection-type = "rgmii-id";
	status = "okay";

	mdio {
		#address-cells = <1>;
		#size-cells = <0>;

		phy0: ethernet-phy@4 {
/* bench 21076.0.0 c8f9e2281e60 */
/* bench 21076.0.1 234533607c0f */
/* bench 21076.0.2 17bc931caa74 */
/* bench 21076.0.3 366078b079b0 */
/* bench 21076.0.4 37c2907afae7 */
/* bench 21076.0.5 07c8edeb04c1 */
			qca,clk-out-frequency = <125000000>;
			qca,clk-out-strength = <AR803X_STRENGTH_FULL>;
			vddio-supply = <&vddh>;

			vddio: vddio-regulator {
				regulator-name = "VDDIO";
				regulator-min-microvolt = <1800000>;
				regulator-max-microvolt = <1800000>;
			};

			vddh: vddh-regulator {
				regulator-name = "VDDH";
			};
		};
	};
};
