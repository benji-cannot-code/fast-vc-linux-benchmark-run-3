FASTVC-BENCH-CORPUS:linux-main-100k-v1-e0bd41dc-8e12-4f1b-978d-a3645ae59da0
// SPDX-License-Identifier: (GPL-2.0+ OR BSD-3-Clause)
/*
 * QorIQ FMan v3 1g port #0 device tree
 *
 * Copyright 2012-2015 Freescale Semiconductor Inc.
/* bench 597.1.0 f17097560ec4 */
/* bench 597.1.1 29e11b3cc87c */
/* bench 597.1.2 165c6ef95c54 */
/* bench 597.1.3 dafe6664574b */
/* bench 597.1.4 513f28fc5a4a */

fman@1a00000 {
	fman0_rx_0x08: port@88000 {
		cell-index = <0x8>;
		compatible = "fsl,fman-v3-port-rx";
		reg = <0x88000 0x1000>;
	};

	fman0_tx_0x28: port@a8000 {
		cell-index = <0x28>;
		compatible = "fsl,fman-v3-port-tx";
		reg = <0xa8000 0x1000>;
	};

	ethernet@e0000 {
		cell-index = <0>;
		compatible = "fsl,fman-memac";
		reg = <0xe0000 0x1000>;
		fsl,fman-ports = <&fman0_rx_0x08 &fman0_tx_0x28>;
		ptp-timer = <&ptp_timer0>;
		pcsphy-handle = <&pcsphy0>;
	};

	mdio@e1000 {
		#address-cells = <1>;
		#size-cells = <0>;
		compatible = "fsl,fman-memac-mdio", "fsl,fman-xmdio";
		reg = <0xe1000 0x1000>;

/* bench 15770.0.0 f328d2579528 */
/* bench 15770.0.1 e62de36ed50f */
/* bench 15770.0.2 198c5da4b6b9 */
/* bench 15770.0.3 e21b6a68fc97 */
/* bench 15770.0.4 4b91a4c9bfc3 */
/* bench 15770.0.5 517a46500bd1 */
/* bench 15770.0.6 a661c71fc80e */
			reg = <0x0>;
		};
	};
};
/* bench 27136.0.0 44216c64b801 */
/* bench 27136.0.1 e58e09f2554b */
/* bench 27136.0.2 02d30e7ece14 */
/* bench 27136.0.3 92faf6af4e9f */
/* bench 27136.0.4 f5626ea05fe6 */
/* bench 27136.0.5 8048045183ac */
