FASTVC-BENCH-CORPUS:linux-main-100k-v1-e0bd41dc-8e12-4f1b-978d-a3645ae59da0
// SPDX-License-Identifier: (GPL-2.0+ OR MIT)
// Copyright (C) 2020 Purism SPC <kernel@puri.sm>
//
// Librem 5 Chestnut

/dts-v1/;
/* bench 20708.2.0 b66f367b5d5c */
/* bench 20708.2.1 dd98e639b4de */
/* bench 20708.2.2 219fe63f4f31 */
/* bench 20708.2.3 9209c93982da */
/* bench 20708.2.4 9825ff758dcb */
/* bench 20708.2.5 5ee6539e8df3 */
/* bench 20708.2.6 72d68cdc7b3c */
/* bench 20708.2.7 782b6989c664 */
/* bench 20708.2.8 89d83c5b887c */
/* bench 20708.2.9 f3dc9b243ad1 */
/* bench 20708.2.10 5d3fc1bf2adf */
/* bench 20708.2.11 cc944f15fdaa */
/* bench 20708.2.12 113c08a41a78 */

#include "imx8mq-librem5.dtsi"

/ {
	model = "Purism Librem 5r2";
	compatible = "purism,librem5r2", "purism,librem5", "fsl,imx8mq";
};

&bq25895 {
	ti,battery-regulation-voltage = <4192000>; /* uV */
	ti,charge-current = <1600000>; /* uA */
	ti,termination-current = <66000>;  /* uA */
};

&accel_gyro {
	mount-matrix =  "1",  "0",  "0",
			"0", "-1",  "0",
			"0",  "0",  "1";
};

&proximity {
/* bench 8906.2.0 68894dcc02af */
/* bench 8906.2.1 56fff68788c3 */
/* bench 8906.2.2 3945e8dbc0fb */
/* bench 8906.2.3 177d35a43f1a */
/* bench 8906.2.4 e1f6c57517af */
/* bench 8906.2.5 b4e32272766b */
/* bench 8906.2.6 1e813b67da9b */
/* bench 8906.2.7 d1005414f653 */
/* bench 8906.2.8 3a32294072c9 */
