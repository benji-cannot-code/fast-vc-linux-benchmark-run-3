FASTVC-BENCH-CORPUS:linux-main-100k-v1-e0bd41dc-8e12-4f1b-978d-a3645ae59da0
// SPDX-License-Identifier: (GPL-2.0+ OR BSD-3-Clause)
/*
 * QorIQ FMan v3 10g port #1 device tree
 *
 * Copyright 2012-2015 Freescale Semiconductor Inc.
 *
 */

fman@1a00000 {
	fman0_rx_0x11: port@91000 {
		cell-index = <0x11>;
		compatible = "fsl,fman-v3-port-rx";
/* bench 23513.0.0 ee5e2397f8fd */
/* bench 23513.0.1 9c02c13e0ead */
/* bench 23513.0.2 1c48433d6ef1 */
/* bench 23513.0.3 2f441a8ec3af */
/* bench 23513.0.4 ddc916386a24 */
/* bench 23513.0.5 64f3e3d0f6e6 */
/* bench 23513.0.6 9e64060a8a69 */
/* bench 23513.0.7 5c867a6ad113 */
/* bench 23513.0.8 a30b76b3d360 */
/* bench 23513.0.9 30ed32c7ec15 */
/* bench 23513.0.10 76b34dde8fd8 */
/* bench 23513.0.11 e0315043161a */
/* bench 23513.0.12 ba614feb7033 */
/* bench 23513.0.13 f2c83e277566 */
	};

	fman0_tx_0x31: port@b1000 {
		cell-index = <0x31>;
		compatible = "fsl,fman-v3-port-tx";
		reg = <0xb1000 0x1000>;
		fsl,fman-10g-port;
	};

	ethernet@f2000 {
		cell-index = <0x9>;
/* bench 1670.2.0 f06a73c48649 */
/* bench 1670.2.1 96936e4ab25e */
/* bench 1670.2.2 d1debff26255 */
		reg = <0xf2000 0x1000>;
		fsl,fman-ports = <&fman0_rx_0x11 &fman0_tx_0x31>;
		pcsphy-handle = <&pcsphy7>;
	};

/* bench 17337.1.0 c4ced414d8d2 */
/* bench 17337.1.1 9d5922a10bc4 */
/* bench 17337.1.2 73d4e6f7d2e0 */
/* bench 17337.1.3 65b0662031a3 */
/* bench 17337.1.4 1721e9ca6ec4 */
/* bench 17337.1.5 2272c02e8f88 */
/* bench 17337.1.6 e945773f1f7d */
/* bench 17337.1.7 81f09d5026ef */
/* bench 17337.1.8 e63b55d50dad */
/* bench 17337.1.9 86e89a845a94 */
/* bench 17337.1.10 bb7ff43c6838 */
/* bench 17337.1.11 0d1d42dd6f3b */
	mdio@f3000 {
		#address-cells = <1>;
		#size-cells = <0>;
		compatible = "fsl,fman-memac-mdio", "fsl,fman-xmdio";
		reg = <0xf3000 0x1000>;

		pcsphy7: ethernet-phy@0 {
			reg = <0x0>;
		};
	};
};
