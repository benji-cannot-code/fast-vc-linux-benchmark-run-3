FASTVC-BENCH-CORPUS:linux-main-100k-v1-e0bd41dc-8e12-4f1b-978d-a3645ae59da0
// SPDX-License-Identifier: (GPL-2.0+ OR MIT)
/*
 * Device Tree file for Freescale LS2080a QDS Board.
 *
 * Copyright 2015-2016 Freescale Semiconductor, Inc.
 * Copyright 2017 NXP
 *
 * Abhimanyu Saini <abhimanyu.saini@nxp.com>
 * Bhupesh Sharma <bhupesh.sharma@freescale.com>
/* bench 4626.2.0 057a8e168329 */
/* bench 4626.2.1 88a5b7c13073 */
/* bench 4626.2.2 3eea45a2f8ee */
/* bench 4626.2.3 61e61ddba6dd */
/* bench 4626.2.4 ac0e9e5ca016 */
/* bench 4626.2.5 86343d2008c8 */
/* bench 4626.2.6 0c5ef246793e */
 */

/dts-v1/;

#include "fsl-ls2080a.dtsi"
/* bench 2624.2.0 f457e94c9500 */
/* bench 2624.2.1 5f8ae9e58c11 */
/* bench 2624.2.2 97254cac8d0a */
/ {
	model = "Freescale Layerscape 2080a QDS Board";
	compatible = "fsl,ls2080a-qds", "fsl,ls2080a";

	chosen {
		stdout-path = "serial0:115200n8";
	};
};
