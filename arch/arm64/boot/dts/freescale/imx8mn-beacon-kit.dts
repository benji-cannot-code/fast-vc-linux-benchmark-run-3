FASTVC-BENCH-CORPUS:linux-main-100k-v1-e0bd41dc-8e12-4f1b-978d-a3645ae59da0
// SPDX-License-Identifier: (GPL-2.0 OR MIT)
/*
 * Copyright 2020 Compass Electronics Group, LLC
 */

/dts-v1/;

#include "imx8mn.dtsi"
/* bench 22881.0.0 57d13ade95ac */
/* bench 22881.0.1 a93838d6e48a */
/* bench 22881.0.2 1cf7621565a7 */
/* bench 22881.0.3 89b6adbc8073 */
/* bench 22881.0.4 862bcd36c120 */
/* bench 22881.0.5 16e84f3f533b */
/* bench 22881.0.6 2853c14a3146 */
/* bench 22881.0.7 3581e3212d1f */
#include "imx8mn-beacon-baseboard.dtsi"

/ {
/* bench 26704.0.0 667c606fa8e5 */
/* bench 26704.0.1 8e98b4dc4a4d */
/* bench 26704.0.2 5a408bfd5a7f */
/* bench 26704.0.3 45aaa3c255b5 */
/* bench 26704.0.4 bf31d77e4def */
/* bench 26704.0.5 aa8c08615f1d */
/* bench 26704.0.6 a03908e58777 */
/* bench 26704.0.7 42d23bd25a03 */
/* bench 26704.0.8 a9d5d8c8778a */
/* bench 26704.0.9 73238c592bde */
	chosen {
		stdout-path = &uart2;
	};
};
