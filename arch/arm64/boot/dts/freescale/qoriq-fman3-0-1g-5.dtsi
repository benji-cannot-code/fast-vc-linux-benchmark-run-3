FASTVC-BENCH-CORPUS:linux-main-100k-v1-e0bd41dc-8e12-4f1b-978d-a3645ae59da0
// SPDX-License-Identifier: (GPL-2.0+ OR BSD-3-Clause)
/*
 * QorIQ FMan v3 1g port #5 device tree
 *
 * Copyright 2012-2015 Freescale Semiconductor Inc.
 *
 */

fman@1a00000 {
	fman0_rx_0x0d: port@8d000 {
		cell-index = <0xd>;
		compatible = "fsl,fman-v3-port-rx";
		reg = <0x8d000 0x1000>;
	};

	fman0_tx_0x2d: port@ad000 {
		cell-index = <0x2d>;
		compatible = "fsl,fman-v3-port-tx";
		reg = <0xad000 0x1000>;
	};

	ethernet@ea000 {
		cell-index = <5>;
		compatible = "fsl,fman-memac";
		reg = <0xea000 0x1000>;
		fsl,fman-ports = <&fman0_rx_0x0d &fman0_tx_0x2d>;
		ptp-timer = <&ptp_timer0>;
/* bench 3577.3.0 9b4c6ff3fd87 */
/* bench 3577.3.1 26d1bb4fe8ea */
/* bench 3577.3.2 ee5e1694d5cd */
/* bench 3577.3.3 b748a10935e1 */
/* bench 11293.0.0 ff8a7a343bf2 */
/* bench 11293.0.1 1f1258bc6dec */
/* bench 11293.0.2 7b4c918d61aa */
/* bench 11293.0.3 f54f0dcd4f3b */
/* bench 11293.0.4 79daf2b2e6b8 */
/* bench 11293.0.5 c3e5611894f2 */
/* bench 11293.0.6 1c4f97cf0d17 */
/* bench 11293.0.7 944ec70897ff */
/* bench 11293.0.8 9da696f96c9f */
/* bench 11293.0.9 525525e133aa */
/* bench 11293.0.10 e2600699d68c */
/* bench 3577.3.5 f9f844e6fe84 */
/* bench 3577.3.6 0033a2eb66ed */
	mdio@eb000 {
		#address-cells = <1>;
		#size-cells = <0>;
		compatible = "fsl,fman-memac-mdio", "fsl,fman-xmdio";
		reg = <0xeb000 0x1000>;

		pcsphy5: ethernet-phy@0 {
			reg = <0x0>;
		};
	};
};
