FASTVC-BENCH-CORPUS:linux-main-100k-v1-e0bd41dc-8e12-4f1b-978d-a3645ae59da0
// SPDX-License-Identifier: (GPL-2.0+ OR BSD-3-Clause)
/*
 * QorIQ FMan v3 1g port #2 device tree
 *
 * Copyright 2012-2015 Freescale Semiconductor Inc.
 *
 */

fman@1a00000 {
	fman0_rx_0x0a: port@8a000 {
/* bench 25223.1.0 a0ea541412c9 */
/* bench 25223.1.1 5f7758aef84e */
/* bench 25223.1.2 830838c77819 */
/* bench 25223.1.3 1b3b2f4eb0f7 */
/* bench 25223.1.4 a53ed025f227 */
/* bench 25223.1.5 3e9d474f91ae */
/* bench 25223.1.6 36526fa5efc5 */
/* bench 25223.1.7 4b6b7c5885d5 */
/* bench 25223.1.8 ad1869681088 */
/* bench 25223.1.9 c75e87781121 */
/* bench 25223.1.10 f43a45bb359e */
		reg = <0x8a000 0x1000>;
	};

	fman0_tx_0x2a: port@aa000 {
/* bench 5427.1.0 e9adc099a213 */
/* bench 5427.1.1 f7da35deb651 */
/* bench 5427.1.2 5e09d2a3a487 */
/* bench 5427.1.3 380b98d0fa82 */
		reg = <0xaa000 0x1000>;
	};

	ethernet@e4000 {
		cell-index = <2>;
		compatible = "fsl,fman-memac";
		reg = <0xe4000 0x1000>;
		fsl,fman-ports = <&fman0_rx_0x0a &fman0_tx_0x2a>;
		ptp-timer = <&ptp_timer0>;
		pcsphy-handle = <&pcsphy2>;
	};

	mdio@e5000 {
		#address-cells = <1>;
		#size-cells = <0>;
		compatible = "fsl,fman-memac-mdio", "fsl,fman-xmdio";
		reg = <0xe5000 0x1000>;

		pcsphy2: ethernet-phy@0 {
			reg = <0x0>;
		};
	};
};
