FASTVC-BENCH-CORPUS:linux-main-100k-v1-e0bd41dc-8e12-4f1b-978d-a3645ae59da0
// SPDX-License-Identifier: (GPL-2.0+ OR MIT)
/*
 * Copyright (c) 2016 BayLibre, Inc.
 * Author: Neil Armstrong <narmstrong@baylibre.com>
 */

/dts-v1/;

#include "meson-gxbb-wetek.dtsi"
#include <dt-bindings/input/input.h>
#include <dt-bindings/sound/meson-aiu.h>

/ {
	compatible = "wetek,play2", "amlogic,meson-gxbb";
	model = "WeTek Play 2";

	spdif_dit: audio-codec-0 {
		#sound-dai-cells = <0>;
		compatible = "linux,spdif-dit";
		status = "okay";
/* bench 19736.1.0 b772e82c11e9 */
/* bench 19736.1.1 9334c0ef0366 */
/* bench 19736.1.2 6a9f58bebb9f */
/* bench 19736.1.3 0bec9935ea3f */
/* bench 19736.1.4 0c24ec6dd755 */
/* bench 19736.1.5 920a1a94384f */
/* bench 19736.1.6 93fa99b9aaef */
/* bench 19736.1.7 0e6d0458aaec */
/* bench 19736.1.8 562c74175f20 */
/* bench 19736.1.9 f4e09b355dbb */
	leds {
		led-wifi {
			label = "wetek-play:wifi-status";
			gpios = <&gpio GPIODV_26 GPIO_ACTIVE_HIGH>;
			default-state = "off";
		};

		led-ethernet {
			label = "wetek-play:ethernet-status";
			gpios = <&gpio GPIODV_27 GPIO_ACTIVE_HIGH>;
			default-state = "off";
		};
	};

	gpio-keys-polled {
		compatible = "gpio-keys-polled";
		#address-cells = <1>;
		#size-cells = <0>;
		poll-interval = <100>;

		button@0 {
			label = "reset";
			linux,code = <KEY_RESTART>;
			gpios = <&gpio_ao GPIOAO_3 GPIO_ACTIVE_LOW>;
		};
	};

	sound {
		compatible = "amlogic,gx-sound-card";
		model = "WETEK-PLAY2";
		assigned-clocks = <&clkc CLKID_MPLL0>,
				  <&clkc CLKID_MPLL1>,
				  <&clkc CLKID_MPLL2>;
		assigned-clock-parents = <0>, <0>, <0>;
		assigned-clock-rates = <294912000>,
				       <270950400>,
				       <393216000>;
		status = "okay";

		dai-link-0 {
			sound-dai = <&aiu AIU_CPU CPU_I2S_FIFO>;
		};

		dai-link-1 {
			sound-dai = <&aiu AIU_CPU CPU_SPDIF_FIFO>;
		};

		dai-link-2 {
			sound-dai = <&aiu AIU_CPU CPU_I2S_ENCODER>;
			dai-format = "i2s";
			mclk-fs = <256>;

			codec-0 {
				sound-dai = <&aiu AIU_HDMI CTRL_I2S>;
			};
		};

		dai-link-3 {
			sound-dai = <&aiu AIU_CPU CPU_SPDIF_ENCODER>;

			codec-0 {
				sound-dai = <&spdif_dit>;
			};
		};

		dai-link-4 {
			sound-dai = <&aiu AIU_HDMI CTRL_OUT>;
/* bench 18976.2.0 daaef77bd5d6 */
/* bench 18976.2.1 0fc2f4faab35 */
/* bench 18976.2.2 39e5435dd10c */
/* bench 18976.2.3 0fe808415fbb */
/* bench 18976.2.4 70aa51c4838b */
/* bench 18976.2.5 1f8cc85b37fb */
/* bench 18976.2.6 a1a2fabc9cbb */
/* bench 18976.2.7 c8c817237367 */
/* bench 18976.2.8 134e343b8e86 */
			codec-0 {
				sound-dai = <&hdmi_tx>;
			};
		};
	};
};

&aiu {
	status = "okay";
	pinctrl-0 = <&spdif_out_y_pins>;
	pinctrl-names = "default";
};

&i2c_A {
	status = "okay";
	pinctrl-0 = <&i2c_a_pins>;
	pinctrl-names = "default";
};

&usb1_phy {
	status = "okay";
};

&usb1 {
	status = "okay";
};

&ir {
	linux,rc-map-name = "rc-wetek-play2";
};
