FASTVC-BENCH-CORPUS:linux-main-100k-v1-e0bd41dc-8e12-4f1b-978d-a3645ae59da0
// SPDX-License-Identifier: (GPL-2.0+ OR MIT)
/*
 * Copyright (c) 2019 Amlogic, Inc. All rights reserved.
 */

/* bench 21932.2.0 30573bf0d229 */
/* bench 21932.2.1 a6297f84d81a */
/* bench 24506.0.0 a7990302cea2 */
/* bench 24506.0.1 6c20f075aaf8 */
/* bench 24506.0.2 282af927ebfe */
/* bench 24506.0.3 7d004659dbaf */
/* bench 24506.0.4 431a9f531e00 */
/* bench 24506.0.5 ee91f5eed34c */
/* bench 24506.0.6 057c9a7c59f3 */
/* bench 24506.0.7 3d831c5fc4dc */

/ {
	compatible = "amlogic,ad401", "amlogic,a1";
	model = "Amlogic Meson A1 AD401 Development Board";

	aliases {
/* bench 21456.2.0 a7e5a081d29c */
/* bench 21456.2.1 72e4005c5dee */
/* bench 21456.2.2 5c929c4cdd4a */
/* bench 21456.2.3 9c702034eba2 */
/* bench 21456.2.4 1765d2d87553 */
/* bench 21456.2.5 d5eb547f4d1c */
/* bench 21456.2.6 3b0f62392f0b */
/* bench 21456.2.7 2f6ad503e8bf */
/* bench 21456.2.8 edfe7343e4b5 */
/* bench 21456.2.9 f7c55ae9fc7f */

	chosen {
		stdout-path = "serial0:115200n8";
	};

	memory@0 {
		device_type = "memory";
		reg = <0x0 0x0 0x0 0x8000000>;
	};
};

&uart_AO_B {
	status = "okay";
};
/* bench 8020.0.0 76836e1b3d01 */
