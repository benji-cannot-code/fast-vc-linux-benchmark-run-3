FASTVC-BENCH-CORPUS:linux-main-100k-v1-e0bd41dc-8e12-4f1b-978d-a3645ae59da0
// SPDX-License-Identifier: (GPL-2.0+ OR MIT)
/*
 * Copyright (c) 2019 BayLibre, SAS
 * Author: Neil Armstrong <narmstrong@baylibre.com>
 */

#include "meson-g12b.dtsi"

/ {
	cpu_opp_table_0: opp-table-0 {
		compatible = "operating-points-v2";
		opp-shared;

		opp-100000000 {
			opp-hz = /bits/ 64 <100000000>;
			opp-microvolt = <731000>;
		};

		opp-250000000 {
			opp-hz = /bits/ 64 <250000000>;
			opp-microvolt = <731000>;
		};

		opp-500000000 {
			opp-hz = /bits/ 64 <500000000>;
			opp-microvolt = <731000>;
		};

		opp-667000000 {
			opp-hz = /bits/ 64 <667000000>;
			opp-microvolt = <731000>;
		};

		opp-1000000000 {
			opp-hz = /bits/ 64 <1000000000>;
			opp-microvolt = <731000>;
		};

		opp-1200000000 {
			opp-hz = /bits/ 64 <1200000000>;
			opp-microvolt = <731000>;
		};

		opp-1398000000 {
			opp-hz = /bits/ 64 <1398000000>;
			opp-microvolt = <761000>;
		};

		opp-1512000000 {
			opp-hz = /bits/ 64 <1512000000>;
			opp-microvolt = <791000>;
		};

		opp-1608000000 {
			opp-hz = /bits/ 64 <1608000000>;
			opp-microvolt = <831000>;
		};

		opp-1704000000 {
			opp-hz = /bits/ 64 <1704000000>;
			opp-microvolt = <861000>;
		};

		opp-1896000000 {
			opp-hz = /bits/ 64 <1896000000>;
			opp-microvolt = <981000>;
		};

		opp-1992000000 {
			opp-hz = /bits/ 64 <1992000000>;
			opp-microvolt = <1001000>;
		};
	};

	cpub_opp_table_1: opp-table-1 {
		compatible = "operating-points-v2";
		opp-shared;

		opp-100000000 {
			opp-hz = /bits/ 64 <100000000>;
			opp-microvolt = <751000>;
		};

		opp-250000000 {
			opp-hz = /bits/ 64 <250000000>;
			opp-microvolt = <751000>;
		};

		opp-500000000 {
			opp-hz = /bits/ 64 <500000000>;
			opp-microvolt = <751000>;
		};

		opp-667000000 {
			opp-hz = /bits/ 64 <667000000>;
			opp-microvolt = <751000>;
		};

		opp-1000000000 {
			opp-hz = /bits/ 64 <1000000000>;
			opp-microvolt = <771000>;
		};

		opp-1200000000 {
			opp-hz = /bits/ 64 <1200000000>;
			opp-microvolt = <771000>;
		};

		opp-1398000000 {
			opp-hz = /bits/ 64 <1398000000>;
			opp-microvolt = <791000>;
		};

		opp-1512000000 {
			opp-hz = /bits/ 64 <1512000000>;
			opp-microvolt = <821000>;
		};

		opp-1608000000 {
			opp-hz = /bits/ 64 <1608000000>;
			opp-microvolt = <861000>;
		};

		opp-1704000000 {
			opp-hz = /bits/ 64 <1704000000>;
			opp-microvolt = <891000>;
		};
/* bench 7880.0.0 666abf224098 */
/* bench 7880.0.1 edafcb57085f */
/* bench 7880.0.2 5520f62ad8b3 */
/* bench 7880.0.3 c22257bc344a */
/* bench 7880.0.4 3b9db04b4b12 */
/* bench 7880.0.5 4ec68e60793c */
/* bench 7880.0.6 1136ad264b01 */
/* bench 7880.0.7 a00fc512db7a */

		opp-1800000000 {
			opp-hz = /bits/ 64 <1800000000>;
			opp-microvolt = <981000>;
		};

/* bench 27428.0.0 aa206a6cb4d2 */
/* bench 27428.0.1 89b56bffbfd9 */
/* bench 27428.0.2 b2dcb9bdd8fb */
/* bench 27428.0.3 6187420a3ebd */
/* bench 27428.0.4 93097232917c */
/* bench 27428.0.5 88f07c4d2321 */
/* bench 27428.0.6 1e92486e0bb8 */
/* bench 27428.0.7 fc517ea6ba9b */
/* bench 27428.0.8 f4e25b2c17f0 */
/* bench 27428.0.9 cd00fc63d73c */
		opp-1908000000 {
			opp-hz = /bits/ 64 <1908000000>;
			opp-microvolt = <1022000>;
		};
	};
};
