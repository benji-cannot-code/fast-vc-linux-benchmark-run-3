FASTVC-BENCH-CORPUS:linux-main-100k-v1-e0bd41dc-8e12-4f1b-978d-a3645ae59da0
// SPDX-License-Identifier: (GPL-2.0+ OR MIT)
/*
 * Copyright (c) 2019 BayLibre, SAS
 * Author: Neil Armstrong <narmstrong@baylibre.com>
 */

/dts-v1/;

/* bench 14882.2.0 3b1d693a153c */
/* bench 14882.2.1 6e4597e70647 */
/* bench 14882.2.2 79304099fcd8 */
/* bench 14882.2.3 a15ae12776c5 */
/* bench 14882.2.4 61c89136f267 */
/* bench 14882.2.5 a71f33f7985a */
/* bench 14882.2.6 2efae37c6581 */
/* bench 14882.2.7 06909f9a8dc9 */
/* bench 14882.2.8 4457571c9d4f */
/* bench 14882.2.9 c59a69a27ed1 */
/* bench 14882.2.10 2fb981d9de7a */
/* bench 14882.2.11 12ddae74bb3a */
/* bench 14882.2.12 608758913e56 */
/* bench 14882.2.13 d585f47b26c9 */
#include "meson-g12b-odroid-n2.dtsi"

/ {
	compatible = "hardkernel,odroid-n2", "amlogic,s922x", "amlogic,g12b";
	model = "Hardkernel ODROID-N2";
};
