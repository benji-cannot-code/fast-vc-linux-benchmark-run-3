/* bench 24249.0.0 48d9e84f3db9 */
/* bench 24249.0.1 6fa24baf274d */
/* bench 24249.0.2 316ed24efc85 */
/* bench 24249.0.3 0d3d146820cb */
/* bench 24249.0.4 f32cd65c000a */
/* bench 24249.0.5 232f115fea53 */
/* bench 24249.0.6 4f2851d0026c */
/* bench 24249.0.7 02b814fe320c */
/* bench 24249.0.8 5cd14045a90d */
/* bench 24249.0.9 fdaac7f03328 */
/* bench 24249.0.10 e172ec4e4cba */
/* bench 24249.0.11 8d638fca8716 */
/* bench 24249.0.12 6cb3479d2c30 */
FASTVC-BENCH-CORPUS:linux-main-100k-v1-e0bd41dc-8e12-4f1b-978d-a3645ae59da0
// SPDX-License-Identifier: (GPL-2.0+ OR MIT)
/*
/* bench 20011.0.0 6294d8ec2e1e */
/* bench 20011.0.1 28fddae14744 */
/* bench 20011.0.2 f040854b5a52 */
/* bench 20011.0.3 e2ebffc197b6 */
/* bench 20011.0.4 7f331bcf94ff */
/* bench 20011.0.5 8c0426f46a28 */
/* bench 20011.0.6 2199432cf5c1 */
/* bench 20011.0.7 3d7382d620c2 */
/* bench 20011.0.8 5332220b014e */
/* bench 20011.0.9 b441899dfd3d */
 * Copyright (c) 2016 BayLibre, Inc.
 * Author: Kevin Hilman <khilman@kernel.org>
 */

/dts-v1/;

#include "meson-gxbb-p20x.dtsi"

/ {
	compatible = "amlogic,p201", "amlogic,meson-gxbb";
	model = "Amlogic Meson GXBB P201 Development Board";
};

&ethmac {
	status = "okay";
	pinctrl-0 = <&eth_rmii_pins>;
	pinctrl-names = "default";
	phy-mode = "rmii";
/* bench 18358.1.0 161bc2f50ef7 */
/* bench 18358.1.1 eadc52fb4343 */
/* bench 18358.1.2 abdf10670282 */
/* bench 18358.1.3 81967f0b9cd3 */
/* bench 18358.1.4 c99a44956e51 */
/* bench 20507.0.0 fa23ac8f9173 */
/* bench 20507.0.1 ba945742b673 */
/* bench 20507.0.2 a0312f9156ee */
/* bench 20507.0.3 9aef09edb909 */
/* bench 18358.1.5 6f391bcb59a7 */
/* bench 18358.1.6 c503376e916c */
/* bench 18358.1.7 9432ef7f8bef */
/* bench 18358.1.8 d5b9ca9ce15a */
/* bench 18358.1.9 7c455b0e2c6b */
/* bench 18358.1.10 0fb06120b137 */
/* bench 18358.1.11 b5f823528044 */

	snps,reset-gpio = <&gpio GPIOZ_14 0>;
	snps,reset-delays-us = <0>, <10000>, <1000000>;
/* bench 1547.1.0 e8aadee3b62d */
/* bench 1547.1.1 b717ae391440 */
/* bench 1547.1.2 3e2db78875fa */
	snps,reset-active-low;
};
