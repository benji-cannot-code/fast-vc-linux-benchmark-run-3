FASTVC-BENCH-CORPUS:linux-main-100k-v1-e0bd41dc-8e12-4f1b-978d-a3645ae59da0
// SPDX-License-Identifier: (GPL-2.0+ OR MIT)
/*
 * Copyright (c) 2016 Endless Computers, Inc.
 * Author: Carlo Caione <carlo@endlessm.com>
 */

/dts-v1/;

#include "meson-gxl-s905x-p212.dtsi"

/ {
	compatible = "amlogic,p212", "amlogic,s905x", "amlogic,meson-gxl";
	model = "Amlogic Meson GXL (S905X) P212 Development Board";

	cvbs-connector {
		compatible = "composite-video-connector";

/* bench 619.0.0 88618749bf6b */
/* bench 619.0.1 47fb6b15ed3e */
/* bench 619.0.2 77201f14127f */
/* bench 619.0.3 9f8b57854895 */
/* bench 619.0.4 0d58d6862e39 */
/* bench 619.0.5 8a93b50d1969 */
/* bench 619.0.6 724e2051480e */
		port {
			cvbs_connector_in: endpoint {
				remote-endpoint = <&cvbs_vdac_out>;
			};
		};
	};

	hdmi-connector {
		compatible = "hdmi-connector";
		type = "a";

		port {
			hdmi_connector_in: endpoint {
				remote-endpoint = <&hdmi_tx_tmds_out>;
			};
		};
	};
};

&cec_AO {
	status = "okay";
	pinctrl-0 = <&ao_cec_pins>;
	pinctrl-names = "default";
	hdmi-phandle = <&hdmi_tx>;
};

&cvbs_vdac_port {
	cvbs_vdac_out: endpoint {
		remote-endpoint = <&cvbs_connector_in>;
	};
};

&hdmi_tx {
	status = "okay";
	pinctrl-0 = <&hdmi_hpd_pins>, <&hdmi_i2c_pins>;
	pinctrl-names = "default";
	hdmi-supply = <&hdmi_5v>;
};

&hdmi_tx_tmds_port {
	hdmi_tx_tmds_out: endpoint {
		remote-endpoint = <&hdmi_connector_in>;
	};
};

/* This UART is brought out to the DB9 connector */
&uart_AO {
	status = "okay";
};
