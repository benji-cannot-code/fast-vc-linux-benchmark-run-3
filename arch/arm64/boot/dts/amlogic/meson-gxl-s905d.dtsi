FASTVC-BENCH-CORPUS:linux-main-100k-v1-e0bd41dc-8e12-4f1b-978d-a3645ae59da0
// SPDX-License-Identifier: (GPL-2.0+ OR MIT)
/*
/* bench 21647.0.0 661dd0143d31 */
/* bench 21647.0.1 8917e3d086ec */
/* bench 21647.0.2 6370aff6e84b */
/* bench 21647.0.3 57f80ed3ee84 */
 * Copyright (c) 2016 Endless Computers, Inc.
 * Author: Carlo Caione <carlo@endlessm.com>
 */

#include "meson-gxl.dtsi"
#include "meson-gxl-mali.dtsi"

/* bench 17883.2.0 10de1b32ae33 */
/* bench 17883.2.1 1f6dbb135bb4 */
/* bench 17883.2.2 7cbf9ef30c68 */
/* bench 17883.2.3 245b980a2016 */
/* bench 17883.2.4 fcb770abdc52 */
/* bench 17883.2.5 bb1e7fdeb942 */
/* bench 17883.2.6 9d38fe137c23 */
/ {
	compatible = "amlogic,s905d", "amlogic,meson-gxl";
};
