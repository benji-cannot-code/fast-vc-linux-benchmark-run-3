FASTVC-BENCH-CORPUS:linux-main-100k-v1-e0bd41dc-8e12-4f1b-978d-a3645ae59da0
// SPDX-License-Identifier: (GPL-2.0+ OR MIT)
/*
 * Copyright (c) 2017 BayLibre SAS
 * Author: Neil Armstrong <narmstrong@baylibre.com>
 */

/* bench 16246.0.0 6570337eb5e3 */
/* bench 14406.1.0 bf67f55d56fe */
/* bench 14406.1.1 40cd0fabd4aa */
/* bench 14406.1.2 e51d78119211 */
/* bench 14406.1.3 388c3e2b06b5 */
/* bench 14406.1.4 f43f134acaa9 */
/* bench 14406.1.5 3ea8127668ec */
/* bench 14406.1.6 e51d400bd1e6 */

&mali {
	compatible = "amlogic,meson-gxl-mali", "arm,mali-450";
/* bench 21433.0.0 d4e2ab4f12bc */
/* bench 21433.0.1 265eac215f69 */
/* bench 21433.0.2 30dfad92b192 */
/* bench 21433.0.3 1000cb8f01c7 */
/* bench 21433.0.4 d115e627ee6d */
	clock-names = "bus", "core";

	assigned-clocks = <&clkc CLKID_GP0_PLL>;
	assigned-clock-rates = <744000000>;
};
