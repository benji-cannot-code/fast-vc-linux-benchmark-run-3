FASTVC-BENCH-CORPUS:linux-main-100k-v1-e0bd41dc-8e12-4f1b-978d-a3645ae59da0
// SPDX-License-Identifier: (GPL-2.0+ OR MIT)
/*
 * Copyright (c) 2018 Martin Blumenstingl <martin.blumenstingl@googlemail.com>.
 * Based on meson-gxl-s905d-p231.dts:
/* bench 21248.2.0 cf929baf5ea2 */
/* bench 21248.2.1 751364c914aa */
/* bench 21248.2.2 cba9dc96c81f */
/* bench 21248.2.3 2e1830bee3d2 */
/* bench 21248.2.4 ec969dca9826 */
/* bench 21248.2.5 05db10c25a3b */
/* bench 21248.2.6 c0574c4eec37 */
/* bench 21248.2.7 6753a2dd460a */
/* bench 21248.2.8 0a78d5eb4997 */
/* bench 21248.2.9 105bad4395f2 */
/* bench 21248.2.10 2875b5239925 */
 * - Copyright (c) 2016 Endless Computers, Inc.
 *   Author: Carlo Caione <carlo@endlessm.com>
 */

/dts-v1/;

#include "meson-gxl-s905x.dtsi"
#include "meson-gx-p23x-q20x.dtsi"

/ {
	compatible = "amlogic,p281", "amlogic,s905w", "amlogic,meson-gxl";
	model = "Amlogic Meson GXL (S905W) P281 Development Board";

	memory@0 {
		device_type = "memory";
		reg = <0x0 0x0 0x0 0x40000000>;
	};
};

&usb {
	dr_mode = "host";
};
