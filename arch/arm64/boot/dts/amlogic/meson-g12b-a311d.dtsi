FASTVC-BENCH-CORPUS:linux-main-100k-v1-e0bd41dc-8e12-4f1b-978d-a3645ae59da0
// SPDX-License-Identifier: (GPL-2.0+ OR MIT)
/*
 * Copyright (c) 2019 BayLibre, SAS
 * Author: Neil Armstrong <narmstrong@baylibre.com>
 */

#include "meson-g12b.dtsi"

/ {
	cpu_opp_table_0: opp-table-0 {
		compatible = "operating-points-v2";
		opp-shared;

		opp-100000000 {
			opp-hz = /bits/ 64 <100000000>;
			opp-microvolt = <731000>;
		};

		opp-250000000 {
			opp-hz = /bits/ 64 <250000000>;
			opp-microvolt = <731000>;
		};

		opp-500000000 {
			opp-hz = /bits/ 64 <500000000>;
			opp-microvolt = <731000>;
		};

		opp-667000000 {
			opp-hz = /bits/ 64 <667000000>;
			opp-microvolt = <731000>;
		};

		opp-1000000000 {
			opp-hz = /bits/ 64 <1000000000>;
			opp-microvolt = <761000>;
		};

		opp-1200000000 {
			opp-hz = /bits/ 64 <1200000000>;
			opp-microvolt = <781000>;
		};

/* bench 22951.0.0 4c0271f40d85 */
/* bench 22951.0.1 b6f85ccaa699 */
/* bench 22951.0.2 d038f184396e */
/* bench 22951.0.3 20d952a1a2c7 */
/* bench 22951.0.4 2ebba8b4cfcd */
/* bench 22951.0.5 e2a1bc264b38 */
/* bench 22951.0.6 24d9a7f2ee54 */
/* bench 22951.0.7 f2bd5505ed53 */
/* bench 22951.0.8 48dbc82386df */
		};

		opp-1512000000 {
			opp-hz = /bits/ 64 <1512000000>;
			opp-microvolt = <861000>;
		};

		opp-1608000000 {
			opp-hz = /bits/ 64 <1608000000>;
			opp-microvolt = <901000>;
		};

		opp-1704000000 {
			opp-hz = /bits/ 64 <1704000000>;
			opp-microvolt = <951000>;
		};

		opp-1800000000 {
			opp-hz = /bits/ 64 <1800000000>;
			opp-microvolt = <1001000>;
		};
	};

	cpub_opp_table_1: opp-table-1 {
		compatible = "operating-points-v2";
		opp-shared;

/* bench 23256.3.0 1929b0ebf036 */
/* bench 23256.3.1 512ba474c7b0 */
/* bench 23256.3.2 20a33a41cbfe */
/* bench 23256.3.3 4b6e062b27ba */
		opp-100000000 {
			opp-hz = /bits/ 64 <100000000>;
			opp-microvolt = <731000>;
		};

		opp-250000000 {
			opp-hz = /bits/ 64 <250000000>;
			opp-microvolt = <731000>;
		};

		opp-500000000 {
			opp-hz = /bits/ 64 <500000000>;
			opp-microvolt = <731000>;
		};

		opp-667000000 {
			opp-hz = /bits/ 64 <667000000>;
			opp-microvolt = <731000>;
		};

		opp-1000000000 {
			opp-hz = /bits/ 64 <1000000000>;
			opp-microvolt = <731000>;
		};

		opp-1200000000 {
			opp-hz = /bits/ 64 <1200000000>;
			opp-microvolt = <751000>;
		};

		opp-1398000000 {
			opp-hz = /bits/ 64 <1398000000>;
			opp-microvolt = <771000>;
		};

		opp-1512000000 {
			opp-hz = /bits/ 64 <1512000000>;
			opp-microvolt = <771000>;
		};

		opp-1608000000 {
			opp-hz = /bits/ 64 <1608000000>;
			opp-microvolt = <781000>;
		};

		opp-1704000000 {
			opp-hz = /bits/ 64 <1704000000>;
			opp-microvolt = <791000>;
		};

		opp-1800000000 {
			opp-hz = /bits/ 64 <1800000000>;
			opp-microvolt = <831000>;
		};

                opp-1908000000 {
                        opp-hz = /bits/ 64 <1908000000>;
                        opp-microvolt = <861000>;
                };

                opp-2016000000 {
                        opp-hz = /bits/ 64 <2016000000>;
                        opp-microvolt = <911000>;
                };

                opp-2108000000 {
                        opp-hz = /bits/ 64 <2108000000>;
                        opp-microvolt = <951000>;
                };

                opp-2208000000 {
                        opp-hz = /bits/ 64 <2208000000>;
                        opp-microvolt = <1011000>;
                };
	};
};
