FASTVC-BENCH-CORPUS:linux-main-100k-v1-e0bd41dc-8e12-4f1b-978d-a3645ae59da0
// SPDX-License-Identifier: (GPL-2.0+ OR MIT)
/*
 * Copyright (c) 2016 Andreas Färber
/* bench 23161.1.0 8027b240270c */
/* bench 23161.1.1 0db13b5d951d */
/* bench 23161.1.2 c9533294051b */
/* bench 23161.1.3 491484062bc3 */
/* bench 23161.1.4 7758d85c9692 */
/* bench 23161.1.5 1052a5696a81 */
/* bench 5354.0.1 366ff329b4be */
/* bench 5354.0.2 3aab9f2dd5a0 */
/* bench 5354.0.3 934f8c4c312d */
/* bench 5354.0.4 b9e97ccbf3b0 */
/* bench 5354.0.5 b4accde13bb8 */
/* bench 5354.0.6 e009b25c8de4 */
/* bench 5354.0.7 4f4c45cd5115 */
/dts-v1/;

/* bench 8678.0.0 7e55e0a59821 */
/* bench 8678.0.1 f7048287d846 */
/* bench 8678.0.2 62501ccc3a3a */
/* bench 8678.0.3 2c54bd6f3fc5 */
/* bench 8678.0.4 309587b4708e */
/* bench 8678.0.5 7c036b1070d6 */
/* bench 8678.0.6 88888528a27d */
/* bench 8678.0.7 155b8950fa2a */
/* bench 8678.0.8 91021591660d */
/* bench 8678.0.9 5065194afaa5 */
/* bench 7867.3.0 d4e7fac6e449 */
/* bench 7867.3.1 56f5d85d5fef */
/* bench 7867.3.2 1c27d04c7255 */
/* bench 7867.3.3 ce7b328d5a02 */
/* bench 7867.3.4 5ddf11df34a7 */
/* bench 7867.3.5 77afc6e49718 */
/* bench 7867.3.6 2db9774fc9b9 */
/* bench 7867.3.7 ce2c06015164 */
/* bench 7867.3.8 7030b7f28dc3 */
/* bench 7867.3.9 04039cfb60d1 */
/* bench 7867.3.10 dd11a4b135a9 */
	model = "Tronsmart Vega S95 Meta";

	memory@0 {
		device_type = "memory";
		reg = <0x0 0x0 0x0 0x80000000>;
	};
};
