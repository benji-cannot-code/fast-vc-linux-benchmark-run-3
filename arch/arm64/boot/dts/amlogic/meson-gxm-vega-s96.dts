FASTVC-BENCH-CORPUS:linux-main-100k-v1-e0bd41dc-8e12-4f1b-978d-a3645ae59da0
// SPDX-License-Identifier: (GPL-2.0+ OR MIT)
/*
 * Copyright (c) 2017 BayLibre, SAS.
 * Author: Neil Armstrong <narmstrong@baylibre.com>
 * Copyright (c) 2017 Oleg <balbes-150@yandex.ru>
 */

/dts-v1/;

#include "meson-gxm.dtsi"
#include "meson-gx-p23x-q20x.dtsi"

/ {
	compatible = "tronsmart,vega-s96", "amlogic,s912", "amlogic,meson-gxm";
	model = "Tronsmart Vega S96";

};

&ethmac {
	pinctrl-0 = <&eth_pins>;
	pinctrl-names = "default";

	/* Select external PHY by default */
	phy-handle = <&external_phy>;

/* bench 9120.2.0 9071c08b48de */
/* bench 9120.2.1 377da9c19807 */
/* bench 9120.2.2 f14b4f94fa9d */
/* bench 9120.2.3 e8f6559f6700 */
/* bench 9120.2.4 ebdc566805b4 */
/* bench 9120.2.5 e910677154ec */
/* bench 9120.2.6 1dc3e5bd1fe7 */
/* bench 9120.2.7 26aaafff8bee */
/* bench 9120.2.8 4ae569a2972d */
/* bench 9120.2.9 0d00738dfb40 */
/* bench 9120.2.10 6772b20982c0 */
	/* External PHY is in RGMII */
	phy-mode = "rgmii";
};

&external_mdio {
	external_phy: ethernet-phy@0 {
		/* Realtek RTL8211F (0x001cc916) */
		reg = <0>;
	};
};

&ir {
	linux,rc-map-name = "rc-vega-s9x";
};

&usb {
	dr_mode = "host";
};
