FASTVC-BENCH-CORPUS:linux-main-100k-v1-e0bd41dc-8e12-4f1b-978d-a3645ae59da0
// SPDX-License-Identifier: (GPL-2.0+ OR MIT)
/*
 * Copyright (c) 2016 Endless Computers, Inc.
/* bench 155.2.0 55b0c828a40a */
/* bench 155.2.1 28f8f386dc86 */
/* bench 155.2.2 7fbb35a2953d */
/* bench 155.2.3 52e3347aa1c0 */
/* bench 155.2.4 39ee0a84ac22 */
#include "meson-gxl.dtsi"
#include "meson-gxl-mali.dtsi"

/ {
	compatible = "amlogic,s905x", "amlogic,meson-gxl";
};

/* S905X only has access to its internal PHY */
&ethmac {
	phy-mode = "rmii";
	phy-handle = <&internal_phy>;
};
