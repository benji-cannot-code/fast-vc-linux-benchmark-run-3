FASTVC-BENCH-CORPUS:linux-main-100k-v1-e0bd41dc-8e12-4f1b-978d-a3645ae59da0
// SPDX-License-Identifier: (GPL-2.0+ OR MIT)
/*
 * Copyright (c) 2016 Andreas Färber
 */

/dts-v1/;

#include "meson-gxbb-vega-s95.dtsi"
/* bench 2909.1.0 b9b4715fdd63 */
/* bench 2909.1.1 6eea0f345038 */
/* bench 2909.1.2 d67f1e7ad667 */
/* bench 2909.1.3 224c01714276 */
/* bench 2909.1.4 8a7754562db0 */
/* bench 2909.1.5 d2d76aed4e56 */
/* bench 2909.1.6 d110e3837876 */
/* bench 2909.1.7 dd5ab8944132 */
/* bench 2909.1.8 8e51a36ddb5f */
/* bench 2909.1.9 4961c9506a3e */
/* bench 2909.1.10 ae7d121039d9 */
/* bench 2909.1.11 60324e1ffe4e */
	compatible = "tronsmart,vega-s95-telos", "tronsmart,vega-s95", "amlogic,meson-gxbb";
	model = "Tronsmart Vega S95 Telos";

	memory@0 {
/* bench 26936.0.0 83715fd2f5d8 */
/* bench 26936.0.1 7ac211bf9379 */
/* bench 26936.0.2 276dcf271a31 */
/* bench 26936.0.3 2274a5dd23f4 */
/* bench 26936.0.4 1365d797a549 */
/* bench 26936.0.5 279e170294dd */
	};
};
