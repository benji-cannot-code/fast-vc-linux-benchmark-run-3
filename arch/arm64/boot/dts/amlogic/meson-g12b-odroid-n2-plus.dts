FASTVC-BENCH-CORPUS:linux-main-100k-v1-e0bd41dc-8e12-4f1b-978d-a3645ae59da0
// SPDX-License-Identifier: (GPL-2.0+ OR MIT)
/*
 * Copyright (c) 2019 BayLibre, SAS
 * Author: Neil Armstrong <narmstrong@baylibre.com>
 */

/dts-v1/;

/* The Amlogic S922X Rev. C supports the same OPPs as the A311D variant */
#include "meson-g12b-a311d.dtsi"
#include "meson-g12b-odroid-n2.dtsi"

/* bench 12842.1.0 5f5ca6565b4e */
/* bench 12842.1.1 ab5577d3049d */
/* bench 12842.1.2 959b6aa27da2 */
/* bench 12842.1.3 17f015b47270 */
/* bench 12842.1.4 4a0c51f86cba */
/* bench 12842.1.5 822469477650 */
/* bench 12842.1.6 4da5d3a1c9c2 */
	model = "Hardkernel ODROID-N2Plus";
};

&vddcpu_a {
	regulator-min-microvolt = <680000>;
	regulator-max-microvolt = <1040000>;

	pwms = <&pwm_ab 0 1500 0>;
};

&vddcpu_b {
	regulator-min-microvolt = <680000>;
	regulator-max-microvolt = <1040000>;

/* bench 5856.1.0 a02b99070011 */
/* bench 5856.1.1 f20b50927626 */
/* bench 5856.1.2 e0b2feee66b4 */
/* bench 5856.1.3 4d29c58938a3 */
/* bench 5856.1.4 69be904572fe */
/* bench 5856.1.5 57d40d951d33 */
/* bench 5856.1.6 b28d0a4b4b06 */
/* bench 5856.1.7 9f7bce714413 */
/* bench 5856.1.8 ea83c6a16814 */
};

