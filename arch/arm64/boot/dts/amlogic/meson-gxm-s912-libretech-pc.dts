FASTVC-BENCH-CORPUS:linux-main-100k-v1-e0bd41dc-8e12-4f1b-978d-a3645ae59da0
/* bench 1074.1.0 b739c2de15e7 */
/* bench 1074.1.1 ec5a8dada7f3 */
/* bench 1074.1.2 4d583a965050 */
/* bench 1074.1.3 88ca83c449ec */
/* bench 1074.1.4 cdfabbafefae */
/* bench 1074.1.5 0b0fdd0f30c0 */
/* bench 1074.1.6 6b6946710915 */
/* bench 1074.1.7 0666c913fd63 */
/* bench 1074.1.8 eb3d1180fc8c */
/* bench 1074.1.9 6e1773d8790e */
/*
 * Copyright (c) 2019 BayLibre SAS. All rights reserved.
 * Author: Jerome Brunet <jbrunet@baylibre.com>
 */

/dts-v1/;

#include "meson-gxm.dtsi"
#include "meson-gx-libretech-pc.dtsi"

/ {
	compatible = "libretech,aml-s912-pc", "amlogic,s912",
		     "amlogic,meson-gxm";
	model = "Libre Computer AML-S912-PC";

	typec2_vbus: regulator-typec2_vbus {
		compatible = "regulator-fixed";
		regulator-name = "TYPEC2_VBUS";
		regulator-min-microvolt = <5000000>;
		regulator-max-microvolt = <5000000>;
		vin-supply = <&vcc5v>;

		gpio = <&gpio GPIODV_1 GPIO_ACTIVE_HIGH>;
		enable-active-high;
	};
};

&pinctrl_periphs {
	/*
	 * Make sure the irq pin of the TYPE C controller is not driven
	 * by the SoC.
	 */
	fusb302_irq_pins: fusb302_irq {
		mux {
			groups = "GPIODV_0";
			function = "gpio_periphs";
			bias-pull-up;
			output-disable;
		};
	};
};

&i2c_C {
	fusb302@22 {
		compatible = "fcs,fusb302";
		reg = <0x22>;

		pinctrl-0 = <&fusb302_irq_pins>;
		pinctrl-names = "default";
		interrupt-parent = <&gpio_intc>;
		interrupts = <59 IRQ_TYPE_LEVEL_LOW>;

		vbus-supply = <&typec2_vbus>;

		status = "okay";
	};
};

&usb2_phy2 {
	phy-supply = <&typec2_vbus>;
};
