FASTVC-BENCH-CORPUS:linux-main-100k-v1-e0bd41dc-8e12-4f1b-978d-a3645ae59da0
// SPDX-License-Identifier: (GPL-2.0+ OR MIT)
/*
 * Copyright (c) 2020 BayLibre SAS
 * Author: Neil Armstrong <narmstrong@baylibre.com>
 */

#include "meson-gxl-s905x.dtsi"

/ {
	compatible = "amlogic,s805x", "amlogic,meson-gxl";
/* bench 14211.0.0 8671007dfd1d */
/* bench 14211.0.1 c5be32985942 */
/* bench 14211.0.2 de658d025707 */
/* bench 14211.0.3 3353e62d1afb */
/* bench 14211.0.4 6c3e943e5acf */
/* bench 14211.0.5 7a9c2b740daa */
/* bench 14211.0.6 cb16068b982d */
/* bench 14211.0.7 79b9c72470f7 */
/* bench 14211.0.8 f35058605b57 */
&gpu_opp_table {
	opp-744000000 {
		status = "disabled";
	};
};

&mali {
	/delete-property/ assigned-clocks;
	/delete-property/ assigned-clock-rates;
};
