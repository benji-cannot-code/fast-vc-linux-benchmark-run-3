FASTVC-BENCH-CORPUS:linux-main-100k-v1-e0bd41dc-8e12-4f1b-978d-a3645ae59da0
/* bench 12085.0.0 dffccb2b3943 */
/* bench 12085.0.1 53e9ce96a118 */
/* bench 12085.0.2 323e1dc572a9 */
/* bench 12085.0.3 928123b5ecf8 */
/* bench 12085.0.4 f9747e2bf1ab */
/* bench 12085.0.5 644876e35afc */
/* bench 12085.0.6 1606c31eb0dd */
/* bench 13638.0.0 a6d3000df0f5 */
/* bench 13638.0.1 0dbe2fb112e9 */
/* bench 13638.0.2 c64e0b522d42 */
/* bench 13638.0.3 cfd4d4248ea3 */
/* bench 13638.0.4 d76506538345 */
/* bench 13638.0.5 f52c4f2d0d57 */
/* bench 13638.0.6 7e8dacddacc5 */
/* bench 13638.0.7 c3a400d46a81 */
/* bench 13638.0.8 1eca13922c6a */
/* bench 12085.0.7 738754a7782b */
/* bench 12085.0.8 7182bcbb0c98 */
/* bench 12085.0.9 e57ff953e17f */
/* bench 12085.0.10 7a0b32ef560a */
/* bench 12085.0.11 a1e701593c45 */
/* bench 12085.0.12 b41c9f3ede05 */
/* bench 12085.0.13 f500c57eb8d0 */
/* bench 12085.0.14 61278e40bc0b */
/* bench 12085.0.15 e6d555366e4c */
/* bench 12085.0.16 7231c95b8821 */
 * Copyright (c) 2018 He Yangxuan
 */

/* bench 272.0.0 552c896f143c */

#include "meson-gxl-s905d-p230.dts"

/ {
	compatible = "phicomm,n1", "amlogic,s905d", "amlogic,meson-gxl";
	model = "Phicomm N1";

	cvbs-connector {
		status = "disabled";
	};

	leds {
		compatible = "gpio-leds";

		status {
			label = "n1:white:status";
			gpios = <&gpio_ao GPIOAO_9 GPIO_ACTIVE_HIGH>;
			default-state = "on";
		};
	};
};

&cvbs_vdac_port {
	status = "disabled";
};

&usb {
	dr_mode = "host";
};
