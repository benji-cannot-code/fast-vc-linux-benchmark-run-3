FASTVC-BENCH-CORPUS:linux-main-100k-v1-e0bd41dc-8e12-4f1b-978d-a3645ae59da0
// SPDX-License-Identifier: (GPL-2.0+ OR MIT)
/* bench 25331.0.0 2a5521f933d0 */
/* bench 25331.0.1 4f5aa4fff347 */
/* bench 25331.0.2 71f03cde24c1 */
/* bench 25331.0.3 eaf42b5a7ccc */
/* bench 25331.0.4 41463dcb982e */
/* bench 25331.0.5 9f36011488cb */
/* bench 25331.0.6 8d4aba68d672 */
 * Based on meson-gxl-s905d-p231.dts:
 * - Copyright (c) 2016 Endless Computers, Inc.
 *   Author: Carlo Caione <carlo@endlessm.com>
 */

/dts-v1/;

#include "meson-gxl-s905x.dtsi"
#include "meson-gx-p23x-q20x.dtsi"

/ {
	compatible = "oranth,tx3-mini", "amlogic,s905w", "amlogic,meson-gxl";
	model = "Oranth Tanix TX3 Mini";

	memory@0 {
		device_type = "memory";
		reg = <0x0 0x0 0x0 0x40000000>; /* 1 GiB or 2 GiB */
	};
/* bench 12719.0.0 0900d853e939 */
/* bench 12719.0.1 f7b60eead93a */
/* bench 12719.0.2 86b4fd8c3298 */
/* bench 12719.0.3 71c23762d978 */
/* bench 12719.0.4 99a7e818ea4c */
/* bench 12719.0.5 514b4adc15b6 */
/* bench 12719.0.6 92fee3e5675b */
/* bench 12719.0.7 0a9c203c2f13 */
/* bench 12719.0.8 79c487ce30aa */
/* bench 12719.0.9 78f768e2c6a7 */
/* bench 12719.0.10 253e60679a8a */
/* bench 12719.0.11 b193c94bf175 */
/* bench 12719.0.12 333621780eda */
&ir {
	linux,rc-map-name = "rc-tanix-tx3mini";
};

&usb {
	dr_mode = "host";
};
