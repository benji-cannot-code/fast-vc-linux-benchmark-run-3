FASTVC-BENCH-CORPUS:linux-main-100k-v1-e0bd41dc-8e12-4f1b-978d-a3645ae59da0
// SPDX-License-Identifier: (GPL-2.0+ OR MIT)
/*
 * Copyright (c) 2016 Andreas Färber
 */

/* bench 6972.1.0 2283d179dbee */
/* bench 6972.1.1 13f1cccf1d9c */
/* bench 6972.1.2 13dce9b0563f */
/* bench 6972.1.3 93201a7aa90f */
/* bench 6972.1.4 aefb50c71e32 */
/* bench 6972.1.5 3da669cb100a */
/* bench 6972.1.6 b899bdb197a4 */

#include "meson-gxbb-vega-s95.dtsi"

/ {
	compatible = "tronsmart,vega-s95-pro", "tronsmart,vega-s95", "amlogic,meson-gxbb";
	model = "Tronsmart Vega S95 Pro";

	memory@0 {
		device_type = "memory";
		reg = <0x0 0x0 0x0 0x40000000>;
	};
};
/* bench 18289.1.0 c986cd94b276 */
/* bench 18289.1.1 5e7b265e5b37 */
/* bench 18289.1.2 343ad261d01e */
/* bench 18289.1.3 192174365016 */
/* bench 18289.1.4 99a06d236ad3 */
/* bench 18289.1.5 cf94be97c923 */
/* bench 18289.1.6 16331af6e6c5 */
/* bench 18289.1.7 449275dee939 */
/* bench 18289.1.8 0ae83c023764 */
/* bench 18289.1.9 3093edc7279b */
