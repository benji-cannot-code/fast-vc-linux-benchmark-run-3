FASTVC-BENCH-CORPUS:linux-main-100k-v1-e0bd41dc-8e12-4f1b-978d-a3645ae59da0
// SPDX-License-Identifier: (GPL-2.0+ OR MIT)
/*
 * Copyright (c) 2018 BayLibre SAS. All rights reserved.
 */

/dts-v1/;

#include "meson-g12a.dtsi"

/ {
	compatible = "amediatech,x96-max", "amlogic,u200", "amlogic,g12a";
	model = "Shenzhen Amediatech Technology Co., Ltd X96 Max";

	aliases {
		serial0 = &uart_AO;
	};
	chosen {
		stdout-path = "serial0:115200n8";
	};
	memory@0 {
		device_type = "memory";
		reg = <0x0 0x0 0x0 0x40000000>;
	};
};

&uart_AO {
	status = "okay";
};
