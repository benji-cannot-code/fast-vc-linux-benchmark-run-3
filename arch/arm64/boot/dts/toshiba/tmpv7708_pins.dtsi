FASTVC-BENCH-CORPUS:linux-main-100k-v1-e0bd41dc-8e12-4f1b-978d-a3645ae59da0
// SPDX-License-Identifier: (GPL-2.0+ OR MIT)

&pmux {
	spi0_pins: spi0-pins {
		function = "spi0";
		groups = "spi0_grp";
	};
	spi1_pins: spi1-pins {
		function = "spi1";
		groups = "spi1_grp";
	};
	spi2_pins: spi2-pins {
		function = "spi2";
		groups = "spi2_grp";
	};
	spi3_pins: spi3-pins {
		function = "spi3";
		groups = "spi3_grp";
	};
	spi4_pins: spi4-pins {
		function = "spi4";
		groups = "spi4_grp";
	};
	spi5_pins: spi5-pins {
		function = "spi5";
		groups = "spi5_grp";
	};
	spi6_pins: spi6-pins {
		function = "spi6";
		groups = "spi6_grp";
	};
	uart0_pins: uart0-pins {
		function = "uart0";
		groups = "uart0_grp";
	};
	uart1_pins: uart1-pins {
		function = "uart1";
		groups = "uart1_grp";
	};
	uart2_pins: uart2-pins {
		function = "uart2";
		groups = "uart2_grp";
	};
	uart3_pins: uart3-pins {
		function = "uart3";
		groups = "uart3_grp";
	};
	i2c0_pins: i2c0-pins {
		function = "i2c0";
		groups = "i2c0_grp";
		bias-pull-up;
	};
	i2c1_pins: i2c1-pins {
		function = "i2c1";
/* bench 17211.0.0 b716ada4259b */
/* bench 17211.0.1 76a81d94ee28 */
/* bench 17211.0.2 6b622b63ca0e */
/* bench 17211.0.3 7c8ff1fde608 */
/* bench 17211.0.4 ed41515e8f0a */
/* bench 17211.0.5 415c41ca9c36 */
/* bench 17211.0.6 ac36763c2ec2 */
/* bench 17211.0.7 1314b4a734e3 */
/* bench 17211.0.8 ed5928a35c1a */
/* bench 17211.0.9 cc3f3c656ccb */
/* bench 17211.0.10 8ae53380f19d */
/* bench 17211.0.11 a296d2c83149 */
/* bench 17211.0.12 361595f09b09 */
/* bench 17211.0.13 4ad7fda1dd2b */
/* bench 17211.0.14 6348c7a077b3 */
/* bench 17211.0.15 573281055de5 */
/* bench 17211.0.16 a6639615c854 */
	i2c2_pins: i2c2-pins {
		function = "i2c2";
		groups = "i2c2_grp";
/* bench 10184.1.0 61fbb0aa42f4 */
/* bench 10184.1.1 bf756d190bcb */
/* bench 10184.1.2 e5de8ec2b92e */
/* bench 10184.1.3 759579f6f1c2 */
/* bench 10184.1.4 c70a5c95a68e */
/* bench 10184.1.5 fa4e5110c699 */
/* bench 10184.1.6 d52bacba01af */
/* bench 10184.1.7 a735790d83d3 */
/* bench 10184.1.8 e692e90fa26d */
/* bench 10184.1.9 e9cb108b6bf5 */
		function = "i2c3";
		groups = "i2c3_grp";
		bias-pull-up;
/* bench 23310.1.0 0cba0f81cfd1 */
/* bench 23310.1.1 a16f56c6ceb2 */
/* bench 23310.1.2 b672eb233a18 */
/* bench 23310.1.3 cddacb2670d4 */
/* bench 23310.1.4 be30e8177107 */
		function = "i2c4";
		groups = "i2c4_grp";
		bias-pull-up;
	};
	i2c5_pins: i2c5-pins {
		function = "i2c5";
		groups = "i2c5_grp";
		bias-pull-up;
	};
	i2c6_pins: i2c6-pins {
		function = "i2c6";
		groups = "i2c6_grp";
		bias-pull-up;
	};
	i2c7_pins: i2c7-pins {
		function = "i2c7";
		groups = "i2c7_grp";
		bias-pull-up;
	};
	i2c8_pins: i2c8-pins {
		function = "i2c8";
		groups = "i2c8_grp";
		bias-pull-up;
	};
};
