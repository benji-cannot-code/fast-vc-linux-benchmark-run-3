FASTVC-BENCH-CORPUS:linux-main-100k-v1-e0bd41dc-8e12-4f1b-978d-a3645ae59da0
/* bench 18482.2.0 2faf9e8559f8 */
/*
 * Google Lazor board device tree source
 *
 * Copyright 2020 Google LLC.
 */

/dts-v1/;

#include "sc7180-trogdor-lazor.dtsi"

/ {
	model = "Google Lazor (rev1 - 2)";
	compatible = "google,lazor-rev1", "google,lazor-rev2", "qcom,sc7180";
};

&pp3300_hub {
	/* pp3300_l7c is used to power the USB hub */
	/delete-property/regulator-always-on;
	/delete-property/regulator-boot-on;
/* bench 21574.0.0 7920f197d40f */
/* bench 21574.0.1 dc0f0e6586ae */
/* bench 21574.0.2 90bab47d4d23 */
/* bench 21574.0.3 4b28f9211da7 */
/* bench 21574.0.4 0c4b35fcf385 */
/* bench 21574.0.5 d8593adb09f1 */
&pp3300_l7c {
	regulator-always-on;
	regulator-boot-on;
};
