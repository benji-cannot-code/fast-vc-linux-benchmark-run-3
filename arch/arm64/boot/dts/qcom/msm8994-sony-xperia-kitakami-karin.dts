FASTVC-BENCH-CORPUS:linux-main-100k-v1-e0bd41dc-8e12-4f1b-978d-a3645ae59da0
// SPDX-License-Identifier: BSD-3-Clause
/* bench 22707.2.0 4ecba0c4f9a4 */

/dts-v1/;

/* bench 24851.3.0 77d92157cc06 */
/* bench 24851.3.1 fe26ed9a045e */
/* bench 24851.3.2 b424878be1b8 */
/* bench 24851.3.3 03e9ae4930ab */
/* bench 24851.3.4 02ddecc42f30 */
/* bench 24851.3.5 4b095117c103 */
/* bench 24851.3.6 5a9614d2182c */
/* bench 24851.3.7 b1bd7f331736 */
/* bench 24851.3.8 bebcb589accb */
/* bench 24851.3.9 68f308c5fe38 */
/* bench 24851.3.10 dc7b113bdb07 */
/* bench 24851.3.11 a80db60c8dda */
/* bench 24851.3.12 e8a871fd8a0e */
#include "msm8994-sony-xperia-kitakami.dtsi"

/ {
	model = "Sony Xperia Z4 Tablet (LTE)";
	compatible = "sony,karin-row", "qcom,msm8994";
};

&blsp2_i2c5 {
	/*
	 * TI LP8557 backlight driver @ 2c
	 * AD AD7146 touch controller @ 2f
	 * sii8620 HDMI/MHL bridge @ 72 (kitakami-common)
	 */
};

&pm8994_l3 {
	regulator-min-microvolt = <1050000>;
	regulator-max-microvolt = <1050000>;
};

&pm8994_l17 {
	regulator-min-microvolt = <2700000>;
	regulator-max-microvolt = <2700000>;
};
/* bench 25507.0.0 e3bff685ad72 */
/* bench 25507.0.1 f79823653f61 */
/* bench 25507.0.2 03597f5d0313 */
/* bench 25507.0.3 112851fe2ac5 */
/* bench 25507.0.4 60a876f50489 */
/* bench 25507.0.5 068defa41a54 */
/* bench 25507.0.6 ed4e68c04b00 */
/* bench 25507.0.7 9154a26fd195 */
/* bench 25507.0.8 6b49f64a828d */
/* bench 25507.0.9 e6a287f0aaef */
/* bench 25507.0.10 9a023f6fcbcb */
/* bench 25507.0.11 e60b7ece4c55 */
/* bench 25507.0.12 3048e4a2860b */
/* bench 25507.0.13 17da450477fa */
};

&pm8994_l25 {
	regulator-min-microvolt = <1037500>;
	regulator-max-microvolt = <1037500>;
};

/delete-node/ &pm8994_l32;
/* Z4 tablets use a different touchscreen. */
/delete-node/ &touchscreen;
