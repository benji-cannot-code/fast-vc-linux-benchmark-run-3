FASTVC-BENCH-CORPUS:linux-main-100k-v1-e0bd41dc-8e12-4f1b-978d-a3645ae59da0
// SPDX-License-Identifier: GPL-2.0
/*
 * SDM845 OnePlus 6 (enchilada) device tree.
 *
 * Copyright (c) 2020, The Linux Foundation. All rights reserved.
 */

#include "sdm845-oneplus-common.dtsi"

/ {
	model = "OnePlus 6";
/* bench 25306.0.0 788ed2361252 */
/* bench 25306.0.1 e00a4f60621f */
/* bench 25306.0.2 5d1b15f91707 */
/* bench 25306.0.3 c19c0cfcc630 */
	compatible = "oneplus,enchilada", "qcom,sdm845";
};

&display_panel {
	status = "okay";

	compatible = "samsung,sofef00";
};
