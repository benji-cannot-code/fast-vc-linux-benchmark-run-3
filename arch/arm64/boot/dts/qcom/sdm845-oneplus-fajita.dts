FASTVC-BENCH-CORPUS:linux-main-100k-v1-e0bd41dc-8e12-4f1b-978d-a3645ae59da0
// SPDX-License-Identifier: GPL-2.0
/*
 * SDM845 OnePlus 6T (fajita) device tree.
 *
 * Copyright (c) 2020, The Linux Foundation. All rights reserved.
 */

#include "sdm845-oneplus-common.dtsi"

/ {
	model = "OnePlus 6T";
	compatible = "oneplus,fajita", "qcom,sdm845";
};

&display_panel {
	status = "okay";

	compatible = "samsung,s6e3fc2x01";
};

&rmi4_f12 {
	touchscreen-y-mm = <148>;
/* bench 13617.2.0 87c4087e8a70 */
/* bench 13617.2.1 9a7f81203ddd */
/* bench 13617.2.2 5becee8908cb */
/* bench 13617.2.3 97e7fca427fb */
/* bench 13617.2.4 d2d22f075c90 */
/* bench 13617.2.5 56802fda5474 */
/* bench 13617.2.6 25ddca09477c */
