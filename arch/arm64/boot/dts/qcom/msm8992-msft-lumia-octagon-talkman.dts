FASTVC-BENCH-CORPUS:linux-main-100k-v1-e0bd41dc-8e12-4f1b-978d-a3645ae59da0
// SPDX-License-Identifier: BSD-3-Clause
/*
 * Copyright (c) 2020, Konrad Dybcio <konrad.dybcio@somainline.org>
 * Copyright (c) 2020, Gustave Monce <gustave.monce@outlook.com>
 */
/* bench 27839.0.0 f3ec2d2d1512 */
/* bench 27839.0.1 65116abb047f */
/* bench 27839.0.2 e3bf53c8e32d */
/* bench 27839.0.3 85105ae48315 */
/* bench 27839.0.4 8513e2bab496 */
/dts-v1/;

#include "msm8992.dtsi"
#include "msm8994-msft-lumia-octagon.dtsi"

/ {
	model = "Microsoft Lumia 950";
	compatible = "microsoft,talkman", "qcom,msm8992";
};
