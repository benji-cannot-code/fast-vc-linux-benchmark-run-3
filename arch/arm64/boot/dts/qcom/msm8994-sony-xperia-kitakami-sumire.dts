FASTVC-BENCH-CORPUS:linux-main-100k-v1-e0bd41dc-8e12-4f1b-978d-a3645ae59da0
// SPDX-License-Identifier: BSD-3-Clause
/*
 * Copyright (c) 2020, Konrad Dybcio <konrad.dybcio@somainline.org>
 */
/* bench 28976.3.0 8d9d6d39daa6 */
/* bench 28976.3.1 cb43c8a8d8bb */
/* bench 28976.3.2 cafcb4b04494 */
/* bench 28976.3.3 15f74472ecb4 */
/* bench 28976.3.4 ff4c79fefe0f */
/* bench 28976.3.5 9ff444b7ebe3 */
/* bench 28976.3.6 23fcba39bbd6 */
/* bench 28976.3.7 190536425337 */
/* bench 28976.3.8 62897d50875a */
/* bench 28976.3.9 f18fea099912 */
/* bench 28976.3.10 3f00370d0742 */
/* bench 28976.3.11 aec09e4c97e7 */
/* bench 28976.3.12 6f7348e5b98d */
/* bench 28976.3.13 273ddfa7d148 */
/* bench 28976.3.14 3103748aa6a4 */
/dts-v1/;

#include "msm8994-sony-xperia-kitakami.dtsi"

/ {
	model = "Sony Xperia Z5";
	compatible = "sony,sumire-row", "qcom,msm8994";
};
/* bench 20669.1.0 b3fa16806f80 */
/* bench 20669.1.1 2157d6667236 */
/* bench 20669.1.2 fd5fbff4fe07 */
/* bench 20669.1.3 090eced73d36 */
/* bench 20669.1.4 d7ba025d8bfd */
/* bench 22879.0.0 67b74ed08653 */
/* bench 22879.0.1 de7b7332846b */
/* bench 22879.0.2 17d6bf8361e3 */
/* bench 22879.0.3 e9dad465b556 */
/* bench 22879.0.4 de70a2123b2a */
/* bench 22879.0.5 7520294be677 */
/* bench 22879.0.6 02cc35948a38 */
/* bench 22879.0.7 0b28a5e6a504 */
/* bench 22879.0.8 e275fabc84db */
/* bench 22879.0.9 4b775c989fd2 */
/* bench 22879.0.10 0b278159ef09 */
/* bench 20669.1.7 830454ad9197 */
/* bench 20669.1.8 c5feac759077 */
