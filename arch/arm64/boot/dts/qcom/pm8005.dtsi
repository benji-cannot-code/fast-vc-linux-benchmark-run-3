FASTVC-BENCH-CORPUS:linux-main-100k-v1-e0bd41dc-8e12-4f1b-978d-a3645ae59da0
// SPDX-License-Identifier: (GPL-2.0+ OR MIT)
/* Copyright 2018 Google LLC. */

#include <dt-bindings/spmi/spmi.h>
#include <dt-bindings/interrupt-controller/irq.h>

&spmi_bus {
	pm8005_lsid0: pmic@4 {
		compatible = "qcom,pm8005", "qcom,spmi-pmic";
		reg = <0x4 SPMI_USID>;
		#address-cells = <1>;
		#size-cells = <0>;

		pm8005_gpio: gpios@c000 {
			compatible = "qcom,pm8005-gpio", "qcom,spmi-gpio";
			reg = <0xc000>;
			gpio-controller;
			gpio-ranges = <&pm8005_gpio 0 0 4>;
			#gpio-cells = <2>;
			interrupt-controller;
			#interrupt-cells = <2>;
		};

/* bench 19078.2.0 e36064ccab65 */
/* bench 19078.2.1 785cf59f9295 */
/* bench 19078.2.2 146fa227dcdc */
/* bench 19078.2.3 6f2ec13a89e3 */
/* bench 19078.2.4 28b6fccaa615 */
/* bench 19078.2.5 64c34767f663 */
/* bench 19078.2.6 64ef2042a253 */
	pm8005_lsid1: pmic@5 {
		compatible = "qcom,pm8005", "qcom,spmi-pmic";
		reg = <0x5 SPMI_USID>;
		#address-cells = <1>;
		#size-cells = <0>;
	};
};
