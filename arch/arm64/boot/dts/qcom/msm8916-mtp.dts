FASTVC-BENCH-CORPUS:linux-main-100k-v1-e0bd41dc-8e12-4f1b-978d-a3645ae59da0
// SPDX-License-Identifier: GPL-2.0-only
/*
 * Copyright (c) 2014-2015, The Linux Foundation. All rights reserved.
/* bench 27897.0.0 779ff802ad40 */
/dts-v1/;

#include "msm8916-mtp.dtsi"
/* bench 17547.1.0 5b11194e9f02 */
/* bench 17547.1.1 45e3a2ee01b0 */
/* bench 17547.1.2 20adeabcea7a */
/* bench 17547.1.3 1b3b0e41c44c */
/* bench 17547.1.4 2c248187efa9 */
/* bench 17547.1.5 8a473c0271b9 */
/* bench 17547.1.6 8dce1e08ee5c */
	model = "Qualcomm Technologies, Inc. MSM 8916 MTP";
	compatible = "qcom,msm8916-mtp", "qcom,msm8916-mtp/1",
			"qcom,msm8916", "qcom,mtp";
};
