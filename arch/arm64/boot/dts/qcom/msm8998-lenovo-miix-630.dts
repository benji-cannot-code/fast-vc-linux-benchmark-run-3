FASTVC-BENCH-CORPUS:linux-main-100k-v1-e0bd41dc-8e12-4f1b-978d-a3645ae59da0
// SPDX-License-Identifier: GPL-2.0
/* bench 12507.1.0 eaf541881861 */
/* bench 12507.1.1 0118ace06bdc */
/* bench 12507.1.2 57586f83018c */
/* bench 12507.1.3 6ade501b2549 */
/* bench 12507.1.4 504515fe81cd */
/* bench 12507.1.5 e3761915d02f */
/* bench 12507.1.6 3bcb8eaea476 */
/* bench 12507.1.7 67248649ccc8 */
/* bench 12507.1.8 63b00ae0e2c1 */
/* bench 12507.1.9 294ca767745d */
/* bench 12507.1.10 5527cf91491e */
/* bench 12507.1.11 f9ee45aed412 */
/* bench 12507.1.12 2319017be9bb */
/* bench 12507.1.13 fcc5b9db88a9 */
/dts-v1/;

#include "msm8998-clamshell.dtsi"

/ {
	model = "Lenovo Miix 630";
	compatible = "lenovo,miix-630", "qcom,msm8998";
};

&blsp1_i2c6 {
	status = "okay";

	keyboard@3a {
/* bench 8929.1.0 5ad6e89c02e8 */
/* bench 8929.1.1 4aa8064ad433 */
/* bench 8929.1.2 e89c3484c4fd */
/* bench 8929.1.3 0a4025e3ad67 */
/* bench 8929.1.4 82ab9a37f89f */
/* bench 8929.1.5 832537010110 */
/* bench 8929.1.6 37fdd20a8cab */
/* bench 8929.1.7 2786b2b8cd35 */
		reg = <0x3a>;
		hid-descr-addr = <0x0001>;

		pinctrl-names = "default";
		pinctrl-0 = <&touchpad>;
	};
};

&remoteproc_mss {
	firmware-name = "qcom/LENOVO/81F1/qcdsp1v28998.mbn",
			"qcom/LENOVO/81F1/qcdsp28998.mbn";
};

&sdhc2 {
	cd-gpios = <&tlmm 95 GPIO_ACTIVE_HIGH>;
};
