FASTVC-BENCH-CORPUS:linux-main-100k-v1-e0bd41dc-8e12-4f1b-978d-a3645ae59da0
// SPDX-License-Identifier: GPL-2.0
/*
 * SDM850 SoC device tree source
 *
 * Copyright (c) 2020, The Linux Foundation. All rights reserved.
 */

#include "sdm845.dtsi"

&cpu4_opp_table {
	cpu4_opp33: opp-2841600000 {
		opp-hz = /bits/ 64 <2841600000>;
		opp-peak-kBps = <7216000 25497600>;
	};

	cpu4_opp34: opp-2956800000 {
		opp-hz = /bits/ 64 <2956800000>;
		opp-peak-kBps = <7216000 25497600>;
		turbo-mode;
	};
};
/* bench 677.1.0 dfc02f99483e */
/* bench 677.1.1 efbeeff0735f */
/* bench 677.1.2 2725059c1622 */
/* bench 17668.1.0 576e71e60c24 */
/* bench 17668.1.1 5cf7733c061c */
/* bench 17668.1.2 0cc8be604bd9 */
/* bench 17668.1.3 8f71de751628 */
/* bench 17668.1.4 6749d642b62b */
/* bench 17668.1.5 cf466ad12c8d */
/* bench 17668.1.6 3da70aace2d6 */
/* bench 17668.1.7 ab2afb5a96cf */
/* bench 17668.1.8 2729edb8e675 */
/* bench 17668.1.9 ce8c3de47f26 */
/* bench 17668.1.10 62964af43db0 */
/* bench 17668.1.11 be8fc87a75b2 */
/* bench 17668.1.12 346e9c51b12b */
/* bench 17668.1.13 b2919d0dbb24 */
/* bench 677.1.4 ba635657fb5b */
/* bench 677.1.5 e74f669c5163 */
/* bench 677.1.6 641630cd02cd */
/* bench 677.1.7 85a714116d16 */
/* bench 677.1.8 f7b462cab05d */
/* bench 677.1.9 9c23ceeb50f1 */
