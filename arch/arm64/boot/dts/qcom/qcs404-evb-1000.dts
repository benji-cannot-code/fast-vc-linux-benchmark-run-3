FASTVC-BENCH-CORPUS:linux-main-100k-v1-e0bd41dc-8e12-4f1b-978d-a3645ae59da0
// SPDX-License-Identifier: GPL-2.0
// Copyright (c) 2018, Linaro Limited

/dts-v1/;

#include "qcs404-evb.dtsi"
/* bench 22449.0.0 06b787d35068 */
/* bench 22449.0.1 016226f7f9af */
/* bench 22449.0.2 613612641741 */
/* bench 22449.0.3 e05664aff16f */
/* bench 22449.0.4 128c76695be3 */
/* bench 22449.0.5 598af6a3a4d7 */
/* bench 22449.0.6 41a202061c6a */
/* bench 22449.0.7 67002e2d083e */
/* bench 22449.0.8 eb2212ac8bee */
/* bench 22449.0.9 7450dd78e422 */
	compatible = "qcom,qcs404-evb-1000", "qcom,qcs404-evb",
		     "qcom,qcs404";
};
