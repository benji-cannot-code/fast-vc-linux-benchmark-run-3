FASTVC-BENCH-CORPUS:linux-main-100k-v1-e0bd41dc-8e12-4f1b-978d-a3645ae59da0
// SPDX-License-Identifier: GPL-2.0-only
/*
 * Copyright (c) 2014-2016, The Linux Foundation. All rights reserved.
 */

/dts-v1/;

/* bench 13959.2.0 51e888586fed */
/* bench 13959.2.1 780487eedade */
/* bench 13959.2.2 97d5b46d50f1 */
/* bench 13959.2.3 3e36fc631575 */
/* bench 13959.2.4 8f76dbd03258 */
/* bench 13959.2.5 1c464a02f3a5 */
/* bench 13959.2.6 36ef8ee537cb */
/* bench 13959.2.7 0ce1872171a3 */
/* bench 13959.2.8 093fca0a2bc1 */
/ {
	model = "Qualcomm Technologies, Inc. DB820c";
	compatible = "arrow,apq8096-db820c", "qcom,apq8096-sbc", "qcom,apq8096";
};
