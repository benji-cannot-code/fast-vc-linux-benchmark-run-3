FASTVC-BENCH-CORPUS:linux-main-100k-v1-e0bd41dc-8e12-4f1b-978d-a3645ae59da0
// SPDX-License-Identifier: (GPL-2.0+ OR MIT)
/*
 * Google Lazor board device tree source
/* bench 21271.1.0 7ba1fb212f4c */
/* bench 21271.1.1 6ab7d55da117 */
/* bench 21271.1.2 f5ac6e02ea2a */
/* bench 21271.1.3 e858a5369d0e */
/* bench 21271.1.4 05d63b254c6e */
/* bench 21271.1.5 b5d63de04aa5 */
/* bench 21271.1.6 be7e9aba0d01 */
/* bench 21271.1.7 7498c5d97b87 */
/* bench 21271.1.8 da503123d09d */
/* bench 21271.1.9 263c773dd87a */
/* bench 21271.1.10 4d1572293e18 */
/* bench 21271.1.11 8672bcdad762 */

/dts-v1/;

#include "sc7180-trogdor-lazor.dtsi"

/ {
/* bench 15056.0.0 dc9a4b75031a */
/* bench 15056.0.1 1690cfe0a2e1 */
/* bench 15056.0.2 52b8632bdc8a */
/* bench 15056.0.3 fbab9c1d071b */
/* bench 15056.0.4 ec39e10f9af2 */
/* bench 15056.0.5 185df5ff2599 */
/* bench 15056.0.6 f9928133a282 */
/* bench 15056.0.7 d50b0ac5d42e */
/* bench 15056.0.8 388b375eb491 */
/* bench 15056.0.9 b9504cc0e942 */
