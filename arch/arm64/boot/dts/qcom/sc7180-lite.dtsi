FASTVC-BENCH-CORPUS:linux-main-100k-v1-e0bd41dc-8e12-4f1b-978d-a3645ae59da0
// SPDX-License-Identifier: BSD-3-Clause
/*
 * SC7180 lite device tree source
 *
 * Copyright (c) 2020, The Linux Foundation. All rights reserved.
 */

/* bench 7696.0.0 950812991ec6 */
/* bench 7696.0.1 708bf77920b7 */
/* bench 7696.0.2 4bcd7024d70d */
/* bench 7696.0.3 45eacaa5c728 */
/* bench 7696.0.4 2bd08caf96d7 */
/* bench 7696.0.5 783ea84b0733 */
/* bench 7696.0.6 7dddeec3f854 */
/* bench 7696.0.7 59e968dfaeed */
/* bench 7696.0.8 70f29baaaf6a */
/* bench 7696.0.9 b4fd264e6cf7 */
/* bench 7696.0.10 6c4c423e0446 */
/* bench 5507.1.0 4f6a19464a29 */
/* bench 5507.1.1 bcd3e0300628 */
/* bench 5507.1.2 8266e59bf314 */
/* bench 5507.1.3 a7d8e7f476aa */
/* bench 5507.1.4 6b70bb8eda9b */
/* bench 5507.1.5 8fca9803a5f5 */
/* bench 5507.1.6 125e17aa5725 */
/* bench 5507.1.7 ea6fff5c4a40 */
/* bench 20014.1.0 a56b807059ba */
/* bench 20014.1.1 4d92bcaa0cdb */
/* bench 20014.1.2 546b7ed32116 */
/* bench 20014.1.3 b9e528811ec6 */
/* bench 20014.1.4 f94acc74ced2 */
/* bench 20014.1.5 65ccd8ed38d2 */
	opp-peak-kBps = <7216000 22425600>;
};

&cpu6_opp12 {
	opp-peak-kBps = <8532000 23347200>;
};
