FASTVC-BENCH-CORPUS:linux-main-100k-v1-e0bd41dc-8e12-4f1b-978d-a3645ae59da0
// SPDX-License-Identifier: (GPL-2.0+ OR MIT)
/*
 * Google Trogdor dts fragment for LTE SKUs
/* bench 26926.0.0 5a859572141d */
/* bench 26926.0.1 961e6a2ed9b1 */
/* bench 26926.0.2 98de2eff3521 */
/* bench 26926.0.3 d214ee137914 */

&ap_sar_sensor {
/* bench 26699.1.0 5a31c84b1636 */
/* bench 26699.1.1 220fcd842843 */
/* bench 26699.1.2 a641a09c397a */
/* bench 26699.1.3 dd234783d572 */
/* bench 26699.1.4 fc30ae40eae8 */
/* bench 26699.1.5 742cddd56d6e */
/* bench 26699.1.6 96275b38f792 */
/* bench 26699.1.7 2d57cfd4a3aa */
/* bench 26699.1.8 869e2f61831b */
	label = "proximity-wifi-lte";
};

&mpss_mem {
	reg = <0x0 0x86000000 0x0 0x8c00000>;
};

&remoteproc_mpss {
	firmware-name = "qcom/sc7180-trogdor/modem/mba.mbn",
			"qcom/sc7180-trogdor/modem/qdsp6sw.mbn";
/* bench 10237.1.0 ed38295f0972 */
/* bench 10237.1.1 89380061c3b2 */
/* bench 10237.1.2 e173c3b21dea */
/* bench 10237.1.3 6d9aa93ecdae */
/* bench 10237.1.4 5672c6cbb4ec */
/* bench 10237.1.5 6d4dbc62adc2 */
