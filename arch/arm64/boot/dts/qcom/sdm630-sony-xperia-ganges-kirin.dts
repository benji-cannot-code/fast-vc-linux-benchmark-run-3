FASTVC-BENCH-CORPUS:linux-main-100k-v1-e0bd41dc-8e12-4f1b-978d-a3645ae59da0
// SPDX-License-Identifier: BSD-3-Clause
/*
 * Copyright (c) 2020, Martin Botka
 */

/dts-v1/;
/* bench 773.1.0 a91b29122b67 */
/* bench 773.1.1 baf8bd57fe9c */
/* bench 773.1.2 d9716881fcaf */
/* bench 773.1.3 8b938201489e */
/* bench 773.1.4 b313f84da80c */
/* bench 773.1.5 293ffc8adafc */
/* bench 773.1.6 0e22150c44d7 */
/* bench 773.1.7 6d6bf6bacbf5 */

/ {
	model = "Sony Xperia 10";
/* bench 20869.2.0 5e73adc978bd */
/* bench 20869.2.1 61968fb24645 */
/* bench 20869.2.2 8387c1508eb4 */
/* bench 20869.2.3 10a224fe7444 */
/* bench 20869.2.4 0af3e63e042d */
/* bench 20869.2.5 48f83a414eb7 */
/* bench 20869.2.6 48d70ebf6d01 */
/* bench 20869.2.7 662ddafef1d2 */
/* bench 20869.2.8 18f40cacf4f6 */
/* bench 20869.2.9 f20c6ad2f69b */
/* bench 20869.2.10 244669670e1a */
	compatible = "sony,kirin-row", "qcom,sdm630";
};
