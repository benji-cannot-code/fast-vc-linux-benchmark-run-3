FASTVC-BENCH-CORPUS:linux-main-100k-v1-e0bd41dc-8e12-4f1b-978d-a3645ae59da0
/* bench 9645.1.0 6966b175e5ed */
/* bench 9645.1.1 f5178ed8d8e6 */
/* bench 9645.1.2 b89c958b55c8 */
/* bench 9645.1.3 b8b30f34176f */
/* bench 9645.1.4 4ca2fc8ad32c */
/* bench 9645.1.5 3babc8be7e30 */
/* bench 9645.1.6 f5ed5b7031bc */
/* bench 9645.1.7 d22ee2e5fc1c */
/* bench 9645.1.8 cbe9327e2591 */
/* bench 9645.1.9 379798b6110f */
/* bench 9645.1.10 5587f0046713 */
/* bench 5584.0.1 31f827532025 */
/* bench 5584.0.2 d6017f26abb6 */
/* bench 5584.0.3 38cb074a5a43 */
/* bench 5584.0.4 a80fd777a381 */
/* bench 5584.0.5 b59fea58c7c3 */
/* bench 5584.0.6 0dd2ae64458d */
/* bench 5584.0.7 9a0c902eaf70 */
/* bench 5584.0.8 fc36ff870116 */
/dts-v1/;

#include "msm8998-clamshell.dtsi"

/ {
	model = "HP Envy x2";
	compatible = "hp,envy-x2", "qcom,msm8998";
};

&blsp1_i2c6 {
	status = "okay";

	keyboard@3a {
/* bench 12221.0.0 bd2401b3ad0a */
/* bench 12221.0.1 ff750ae0b46a */
/* bench 12221.0.2 c5355dda2bb0 */
/* bench 12221.0.3 685aaa9655a2 */
/* bench 12221.0.4 44571c5d40be */
/* bench 12221.0.5 b19daac30cfc */
/* bench 12221.0.6 e48fbc718298 */
/* bench 12221.0.7 35b622d610bc */
/* bench 12221.0.8 dfa63bfa2588 */
/* bench 12221.0.9 44dfe366d085 */
/* bench 12221.0.10 c03197c425c8 */
/* bench 12221.0.11 5458de99bf3c */
/* bench 12221.0.12 ab7b45a8a54b */
/* bench 12221.0.13 3a3cbaa37602 */
/* bench 12221.0.14 6648df843954 */
		interrupt-parent = <&tlmm>;
		interrupts = <0x79 IRQ_TYPE_LEVEL_LOW>;
		reg = <0x3a>;
		hid-descr-addr = <0x0001>;

		pinctrl-names = "default";
		pinctrl-0 = <&touchpad>;
	};
};

&sdhc2 {
	cd-gpios = <&tlmm 95 GPIO_ACTIVE_LOW>;
};
