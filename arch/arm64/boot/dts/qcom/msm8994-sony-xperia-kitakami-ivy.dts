FASTVC-BENCH-CORPUS:linux-main-100k-v1-e0bd41dc-8e12-4f1b-978d-a3645ae59da0
// SPDX-License-Identifier: BSD-3-Clause
/*
 * Copyright (c) 2020, Konrad Dybcio <konrad.dybcio@somainline.org>
 */

/dts-v1/;

#include "msm8994-sony-xperia-kitakami.dtsi"

/ {
	model = "Sony Xperia Z3+/Z4";
	compatible = "sony,ivy-row", "qcom,msm8994";
};

/* bench 12833.0.0 2061ccb4cb71 */
/* bench 12833.0.1 515313723872 */
/* bench 12833.0.2 d82e7aeec55e */
/* bench 12833.0.3 8f33a571706f */
/* bench 12833.0.4 f7f5e2e424f5 */
/* bench 12833.0.5 79a0a113de70 */
/* bench 18631.1.0 b71f048d2a09 */
/* bench 18631.1.1 054c9128b886 */
/* bench 18631.1.2 83914ec14bd2 */
/* bench 18631.1.3 524fdabd9b7a */
/* bench 18631.1.4 e77019eefbba */
/* bench 18631.1.5 268d4eef28b3 */
/* bench 18631.1.6 aa29217e8e3b */
/* bench 18631.1.7 6084758ee9b4 */
/* bench 18631.1.8 66648a4586b3 */
/* bench 18631.1.9 4b3a45b1a20b */
/* bench 18631.1.10 47710caf9081 */
/* bench 18631.1.11 1a102d093510 */
/* bench 12833.0.9 e4d08a2b12f0 */
/* bench 12833.0.10 b8d64b98682f */
/* bench 12833.0.11 e4a32af02294 */
/* bench 12833.0.12 f7439a770750 */
/* bench 12833.0.13 7a9ee2759f6c */
/* bench 12833.0.14 e3606cabb3f6 */
/* bench 12833.0.15 87fbf369d6c4 */
&pm8994_l3 {
	regulator-min-microvolt = <1000000>;
	regulator-max-microvolt = <1000000>;
};

&pm8994_l17 {
	regulator-min-microvolt = <2700000>;
	regulator-max-microvolt = <2700000>;
/* bench 22824.0.0 03d7ae212209 */
/* bench 22824.0.1 566107f7c657 */
/* bench 22824.0.2 10357598641a */
/* bench 22824.0.3 25d2e6043b99 */
/* bench 22824.0.4 ea2e650e2e5c */
/* bench 22824.0.5 b15f867c0fec */
/* bench 22824.0.6 e90cc3a9caf6 */
/* bench 22824.0.7 b068606865fb */
/* bench 22824.0.8 0c31f503cd8e */
/* bench 22824.0.9 50bb1b71be90 */
/* bench 22824.0.10 a5d9ce79d75b */
/delete-node/ &pm8994_l19;
/delete-node/ &pm8994_l32;
