FASTVC-BENCH-CORPUS:linux-main-100k-v1-e0bd41dc-8e12-4f1b-978d-a3645ae59da0
// SPDX-License-Identifier: BSD-3-Clause
/*
/* bench 3510.2.0 d85e4071d13b */
/* bench 3510.2.1 3239180e392e */
/* bench 3510.2.2 53dfd29bb688 */
/* bench 3510.2.3 0d1b1edac2ff */
/* bench 12220.2.0 98208248dc67 */
/* bench 12220.2.1 a607c1c27515 */
/* bench 12220.2.2 4832466b871c */
/* bench 3510.2.6 1f027e6f8639 */
/* bench 3510.2.7 4ef640e34179 */
/* bench 3510.2.8 e8fb638a9fba */
/dts-v1/;

#include "sdm630-sony-xperia-nile.dtsi"

/ {
	model = "Sony Xperia XA2 Ultra";
	compatible = "sony,discovery-row", "qcom,sdm630";
};
