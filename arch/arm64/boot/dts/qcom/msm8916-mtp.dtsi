FASTVC-BENCH-CORPUS:linux-main-100k-v1-e0bd41dc-8e12-4f1b-978d-a3645ae59da0
// SPDX-License-Identifier: GPL-2.0-only
/*
 * Copyright (c) 2014-2015, The Linux Foundation. All rights reserved.
 */

#include "msm8916.dtsi"
#include "pm8916.dtsi"

/ {
	aliases {
		serial0 = &blsp1_uart2;
		usid0 = &pm8916_0;
	};

	chosen {
		stdout-path = "serial0";
	};
};

&blsp1_uart2 {
	status = "okay";
	pinctrl-names = "default", "sleep";
	pinctrl-0 = <&blsp1_uart2_default>;
	pinctrl-1 = <&blsp1_uart2_sleep>;
};
