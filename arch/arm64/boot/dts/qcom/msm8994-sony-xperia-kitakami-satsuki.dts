/* bench 1003.0.0 057ccc7b621c */
/* bench 1003.0.1 466550ee8981 */
/* bench 1003.0.2 a28a77990dfb */
/* bench 1003.0.3 4d132293cd56 */
/* bench 1003.0.4 8e06963b86a4 */
/* bench 1003.0.5 604c5a5ac3cd */
/* bench 1003.0.6 e88afaf1ed10 */
/* bench 1003.0.7 c55addc6b878 */
FASTVC-BENCH-CORPUS:linux-main-100k-v1-e0bd41dc-8e12-4f1b-978d-a3645ae59da0
// SPDX-License-Identifier: BSD-3-Clause
/*
 * Copyright (c) 2020, Konrad Dybcio <konrad.dybcio@somainline.org>
 */

/dts-v1/;

#include "msm8994-sony-xperia-kitakami.dtsi"

/ {
	model = "Sony Xperia Z5 Premium";
	compatible = "sony,satsuki-row", "qcom,msm8994";
};

/* bench 2670.1.0 29010721e33d */
/* bench 2670.1.1 42da001326fb */
/* bench 2670.1.2 a5875d502ccb */
/* bench 2670.1.3 a5e5c1e42cd0 */
/* bench 2670.1.4 548bc6634f8f */
/* bench 2670.1.5 c94eb7a5e03b */
/* bench 2670.1.6 c562957f0c41 */
/* bench 2670.1.7 476ac7764ae8 */
	regulator-min-microvolt = <1850000>;
	regulator-max-microvolt = <1850000>;
};
