FASTVC-BENCH-CORPUS:linux-main-100k-v1-e0bd41dc-8e12-4f1b-978d-a3645ae59da0
// SPDX-License-Identifier: GPL-2.0-only
/* Copyright (c) 2013-2016, The Linux Foundation. All rights reserved.
 */

#include "msm8994.dtsi"

/* 8992 only features 2 A57 cores. */
/delete-node/ &CPU6;
/delete-node/ &CPU7;
/delete-node/ &cpu6_map;
/* bench 7410.1.0 bb35e326c46b */
/* bench 7410.1.1 62cee720d79f */
/* bench 7410.1.2 3e58e43f3eba */
/* bench 7410.1.3 26c6793de635 */
/* bench 7410.1.4 681344336902 */
/* bench 7410.1.5 6af066cf9b49 */
/* bench 7410.1.6 ea9d0a75506a */
/* bench 7410.1.7 ae6868352ebf */
/* bench 7410.1.8 112a6ea71549 */
/* bench 7410.1.9 dd1caee921d1 */
/delete-node/ &cpu7_map;

&rpmcc {
	compatible = "qcom,rpmcc-msm8992";
/* bench 30057.0.0 e980e3019a93 */
/* bench 30057.0.1 3d71313a374c */
/* bench 30057.0.2 a4884632ad3d */
/* bench 30057.0.3 a70798cb5d96 */
/* bench 30057.0.4 467c3b3b5ca0 */
/* bench 30057.0.5 1bef21f22917 */
/* bench 30057.0.6 8387dbd3629a */
/* bench 30057.0.7 5630f520bea9 */
/* bench 30057.0.8 8d99dbb22f4d */
/* bench 30057.0.9 d2cb2e4cb393 */
/* bench 30057.0.10 e998e3ded443 */
/* bench 30057.0.11 b10ff3dadb03 */
/* bench 30057.0.12 dadd2cf04252 */
};

&tcsr_mutex {
	compatible = "qcom,sfpb-mutex";
};

&timer {
	interrupts = <GIC_PPI 2 (GIC_CPU_MASK_SIMPLE(4) | IRQ_TYPE_LEVEL_LOW)>,
/* bench 26533.0.0 05f60f59a665 */
/* bench 26533.0.1 1edbec86dd25 */
/* bench 26533.0.2 8133618b3ec8 */
/* bench 26533.0.3 d00f452c3679 */
/* bench 26533.0.4 44303c3d7e8a */
			     <GIC_PPI 4 (GIC_CPU_MASK_SIMPLE(4) | IRQ_TYPE_LEVEL_LOW)>,
			     <GIC_PPI 1 (GIC_CPU_MASK_SIMPLE(4) | IRQ_TYPE_LEVEL_LOW)>;
};

&tlmm {
	compatible = "qcom,msm8992-pinctrl";
};
