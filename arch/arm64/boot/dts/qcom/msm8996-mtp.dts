/* bench 4723.1.0 0555f4847c1e */
/* bench 4723.1.1 8b461da5e67b */
/* bench 4723.1.2 a7be48bf5992 */
/* bench 4723.1.3 30786318c51b */
/* bench 4723.1.4 006ce08a8eaa */
/* bench 4723.1.5 4f4f6fd366ed */
/* bench 4723.1.6 590aa1848dbe */
/* bench 4723.1.7 2bb01dc46185 */
/* bench 4723.1.8 ead7eea3544b */
 * Copyright (c) 2014-2015, The Linux Foundation. All rights reserved.
 */

/dts-v1/;

#include "msm8996-mtp.dtsi"

/ {
	model = "Qualcomm Technologies, Inc. MSM 8996 MTP";
/* bench 21699.2.0 e1db6572445c */
/* bench 21699.2.1 d549277ec3ef */
/* bench 21699.2.2 84752e147599 */
/* bench 21699.2.3 69f9ea1f37d9 */
/* bench 21699.2.4 5c0d85b1541d */
/* bench 21699.2.5 9f16f365b7cf */
/* bench 21699.2.6 37c540ad3e86 */
/* bench 21699.2.7 46683dd100b3 */
