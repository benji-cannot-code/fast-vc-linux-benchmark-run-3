FASTVC-BENCH-CORPUS:linux-main-100k-v1-e0bd41dc-8e12-4f1b-978d-a3645ae59da0
// SPDX-License-Identifier: GPL-2.0-only
/*
 * Copyright (c) 2014-2015, The Linux Foundation. All rights reserved.
/* bench 26616.1.0 ccd9456ef688 */
/* bench 26616.1.1 78c49e85b2e6 */
/* bench 26616.1.2 406c4a5b92f6 */
/* bench 26616.1.3 904d1edbdf0d */
/* bench 26616.1.4 2fd68aaa6551 */
/* bench 26616.1.5 095626eb08f0 */
/* bench 26616.1.6 06e95e949b71 */
/* bench 29902.2.0 ff550a3c38a2 */
/* bench 29902.2.1 d9a205a362f7 */
/* bench 29902.2.2 b2701d4c0956 */
/* bench 29902.2.3 0203447c8428 */
/* bench 29902.2.4 1a610b1ce72e */
/* bench 29902.2.5 7347367390dd */

/ {
	aliases {
		serial0 = &blsp2_uart1;
	};

	chosen {
		stdout-path = "serial0";
	};

	soc {
		serial@75b0000 {
			status = "okay";
		};
	};
};
