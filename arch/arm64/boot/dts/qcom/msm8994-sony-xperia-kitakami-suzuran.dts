FASTVC-BENCH-CORPUS:linux-main-100k-v1-e0bd41dc-8e12-4f1b-978d-a3645ae59da0
// SPDX-License-Identifier: BSD-3-Clause
/* bench 14428.2.0 b4121dfa2c7f */
/* bench 14428.2.1 8e653255cf2e */
/* bench 14428.2.2 ca21e4108ad1 */
/* bench 14428.2.3 a33237085fec */
/* bench 14428.2.4 971ee235333e */
/* bench 14428.2.5 335ca0a8cc73 */
/* bench 14428.2.6 c3fdbb159a3c */
/* bench 14428.2.7 d18d4953d320 */
/*
 * Copyright (c) 2020, Konrad Dybcio <konrad.dybcio@somainline.org>
 */

/dts-v1/;

#include "msm8994-sony-xperia-kitakami.dtsi"

/ {
	model = "Sony Xperia Z5 Compact";
	compatible = "sony,suzuran-row", "qcom,msm8994";
};

&pm8994_l14 {
	regulator-min-microvolt = <2000000>;
	regulator-max-microvolt = <2000000>;
};

/delete-node/ &pm8994_l19;
