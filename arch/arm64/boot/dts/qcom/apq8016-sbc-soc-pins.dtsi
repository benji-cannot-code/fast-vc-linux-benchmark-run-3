FASTVC-BENCH-CORPUS:linux-main-100k-v1-e0bd41dc-8e12-4f1b-978d-a3645ae59da0

#include <dt-bindings/gpio/gpio.h>

&msmgpio {

	msmgpio_leds: msmgpio_leds {
		pinconf {
			pins = "gpio21", "gpio120";
			function = "gpio";
			output-low;
		};
	};
};
