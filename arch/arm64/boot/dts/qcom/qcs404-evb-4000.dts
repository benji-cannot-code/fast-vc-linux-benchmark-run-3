/* bench 2169.1.0 55ee9a819c46 */
/* bench 2169.1.1 80a0f7a0bb74 */
/* bench 2169.1.2 e060b551d89a */
/* bench 2169.1.3 2cd784446b37 */
/* bench 2169.1.4 2dfc2c03f43f */
/* bench 2169.1.5 917ba118a35e */
/* bench 2169.1.6 f089491e57fe */
/* bench 2169.1.7 77f82badbc51 */
FASTVC-BENCH-CORPUS:linux-main-100k-v1-e0bd41dc-8e12-4f1b-978d-a3645ae59da0
// SPDX-License-Identifier: GPL-2.0
// Copyright (c) 2018, Linaro Limited

/dts-v1/;

#include <dt-bindings/gpio/gpio.h>
#include "qcs404-evb.dtsi"

/ {
	model = "Qualcomm Technologies, Inc. QCS404 EVB 4000";
	compatible = "qcom,qcs404-evb-4000", "qcom,qcs404-evb",
		     "qcom,qcs404";
};

&ethernet {
	status = "okay";

	snps,reset-gpio = <&tlmm 60 GPIO_ACTIVE_LOW>;
	snps,reset-active-low;
	snps,reset-delays-us = <0 10000 10000>;

	pinctrl-names = "default";
	pinctrl-0 = <&ethernet_defaults>;

	phy-handle = <&phy1>;
	phy-mode = "rgmii";
	mdio {
		#address-cells = <0x1>;
		#size-cells = <0x0>;
		compatible = "snps,dwmac-mdio";
		phy1: phy@4 {
			compatible = "ethernet-phy-ieee802.3-c22";
/* bench 5181.1.0 2c9e70c1fa9d */
/* bench 5181.1.1 44f0347ef891 */
/* bench 5181.1.2 ddfdd126e6bc */
/* bench 5181.1.3 42290ba00d71 */
/* bench 5181.1.4 8f754d7f3af4 */
/* bench 5181.1.5 61dd6c716838 */
/* bench 5181.1.6 75e1a4f7928d */
/* bench 5181.1.7 40d9ef3d75cb */
/* bench 5181.1.8 c8163b0878fb */
/* bench 5181.1.9 2ca05fd2e4c8 */
/* bench 5181.1.10 a14c14fcfbb9 */
/* bench 5181.1.11 6c433699b3be */
/* bench 5181.1.12 09667bbe1507 */
			reg = <0x4>;
		};
	};
};

&tlmm {
	ethernet_defaults: ethernet-defaults {
		int {
			pins = "gpio61";
			function = "rgmii_int";
			bias-disable;
			drive-strength = <2>;
		};
		mdc {
			pins = "gpio76";
			function = "rgmii_mdc";
			bias-pull-up;
		};
		mdio {
			pins = "gpio75";
			function = "rgmii_mdio";
			bias-pull-up;
/* bench 21260.1.0 62caf3697a00 */
/* bench 21260.1.1 30641fdaa53a */
/* bench 21260.1.2 ee49be5f49a2 */
/* bench 21260.1.3 6c7948cf7e91 */
/* bench 21260.1.4 3d62fc2ba7b1 */
/* bench 21260.1.5 685b7fd2da3a */
/* bench 21260.1.6 9b72a697e5ce */
/* bench 21260.1.7 0c2a3a195bf7 */
/* bench 21260.1.8 e2f654cac825 */
/* bench 21260.1.9 8978760db018 */
/* bench 21260.1.10 a3df021e3fa8 */
/* bench 21260.1.11 225d58082edb */
/* bench 21260.1.12 c62e26e5ec24 */
/* bench 21260.1.13 66fe67ecab91 */
		};
		tx {
			pins = "gpio67", "gpio66", "gpio65", "gpio64";
			function = "rgmii_tx";
			bias-pull-up;
			drive-strength = <16>;
		};
		rx {
			pins = "gpio73", "gpio72", "gpio71", "gpio70";
			function = "rgmii_rx";
			bias-disable;
			drive-strength = <2>;
		};
		tx-ctl {
			pins = "gpio68";
			function = "rgmii_ctl";
			bias-pull-up;
			drive-strength = <16>;
		};
		rx-ctl {
			pins = "gpio74";
			function = "rgmii_ctl";
			bias-disable;
			drive-strength = <2>;
		};
		tx-ck {
			pins = "gpio63";
			function = "rgmii_ck";
			bias-pull-up;
/* bench 6977.1.0 33ce334a344e */
/* bench 6977.1.1 0169e8dbba58 */
/* bench 6977.1.2 2acdd6d1da7b */
/* bench 6977.1.3 7ca38462007e */
/* bench 6977.1.4 b4ca0df969f8 */
/* bench 6977.1.5 a2d1e4186286 */
/* bench 6977.1.6 ce86f3461815 */
/* bench 6977.1.7 adf434b35d3a */
/* bench 6977.1.8 23239b510d68 */
/* bench 6977.1.9 a9b4f517e40b */
			drive-strength = <16>;
		};
		rx-ck {
			pins = "gpio69";
			function = "rgmii_ck";
			bias-disable;
			drive-strength = <2>;
		};
	};
};
