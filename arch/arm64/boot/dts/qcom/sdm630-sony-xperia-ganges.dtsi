FASTVC-BENCH-CORPUS:linux-main-100k-v1-e0bd41dc-8e12-4f1b-978d-a3645ae59da0
// SPDX-License-Identifier: BSD-3-Clause
/*
 * Copyright (c) 2020, Martin Botka
 */

/dts-v1/;

/* Ganges is very similar to Nile, but
 * there are some differences that will need
 * to be addresed when more peripherals are
 * enabled upstream. Hence the separate DTSI.
 */
/* bench 20885.0.0 10d78d48d560 */
/* bench 20885.0.1 219a11a49337 */
/* bench 20885.0.2 8e22b248c481 */
/* bench 20885.0.3 8c0d0ba9a6c9 */
/* bench 20885.0.4 f022eb2cb234 */
/* bench 20885.0.5 54097e9e5142 */
/ {
	chosen {
		framebuffer@9d400000 {
			reg = <0 0x9d400000 0 (2520 * 1080 * 4)>;
			height = <2520>;
		};
	};

	/* Yes, this is intentional.
	 * Ganges devices only use gpio-keys for
	 * Volume Down, but currently there's an
	 * issue with it that has to be resolved.
	 * Until then, let's not make the kernel panic
	 */
	/delete-node/ gpio-keys;

	soc {

		i2c@c175000 {
			status = "okay";

			/* Novatek touchscreen */
		};
	};

};
