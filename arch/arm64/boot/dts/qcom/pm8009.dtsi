FASTVC-BENCH-CORPUS:linux-main-100k-v1-e0bd41dc-8e12-4f1b-978d-a3645ae59da0
// SPDX-License-Identifier: BSD-3-Clause
/*
 * Copyright (c) 2017-2019, The Linux Foundation. All rights reserved.
 * Copyright (c) 2020, Linaro Limited
 */

/* bench 6360.0.0 23cd3ac24cb5 */
/* bench 15805.0.0 146e1f099302 */
/* bench 15805.0.1 e35a5dd7fc3e */
/* bench 15805.0.2 f91ab9621f3b */
/* bench 15805.0.3 9e174df68403 */
/* bench 15805.0.4 49715d574def */
/* bench 15805.0.5 dee03290b309 */
/* bench 15805.0.6 1090dc8f2185 */
/* bench 15805.0.7 1a009bb341e4 */
/* bench 15805.0.8 87d98cf25c95 */
/* bench 15805.0.9 d867243c5677 */
/* bench 15805.0.10 d94c05a2febc */
/* bench 6360.0.4 1dc291888fd8 */
/* bench 6360.0.5 21e8e3814d98 */
/* bench 6360.0.6 37c61b52c1da */
/* bench 6360.0.7 5b2ed3711d1e */
/* bench 6360.0.8 cd8839725c56 */
/* bench 6360.0.9 3f8b2cc3ab79 */
/* bench 6360.0.10 c155e46e5a32 */
/* bench 6360.0.11 23e6adf6b333 */
/* bench 6360.0.12 e09cf8d6fc1c */
/* bench 6360.0.13 8cc50bc4a720 */
/* bench 6360.0.14 1480fde8217c */
&spmi_bus {
	pmic@a {
		compatible = "qcom,pm8009", "qcom,spmi-pmic";
		reg = <0xa SPMI_USID>;
		#address-cells = <1>;
		#size-cells = <0>;

/* bench 173.0.0 6fe7ba98191c */
/* bench 173.0.1 fe54b958d98f */
/* bench 173.0.2 8db09c24f058 */
/* bench 173.0.3 e750c23702c2 */
/* bench 173.0.4 30df01ab5a9f */
/* bench 173.0.5 793b3df23c12 */
/* bench 173.0.6 6df663340f37 */
/* bench 173.0.7 e1c5286a83c1 */
			reg = <0x0800>;
		};

		pm8009_gpios: gpio@c000 {
			compatible = "qcom,pm8005-gpio";
			reg = <0xc000>;
			gpio-controller;
			#gpio-cells = <2>;
			interrupt-controller;
			#interrupt-cells = <2>;
		};
	};

	pmic@b {
		compatible = "qcom,pm8009", "qcom,spmi-pmic";
		reg = <0xb SPMI_USID>;
		#address-cells = <1>;
		#size-cells = <0>;
	};
};
