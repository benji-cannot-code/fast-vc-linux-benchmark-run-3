FASTVC-BENCH-CORPUS:linux-main-100k-v1-e0bd41dc-8e12-4f1b-978d-a3645ae59da0
// SPDX-License-Identifier: BSD-3-Clause
/*
 * Copyright (c) 2020, Konrad Dybcio
 */

#include <dt-bindings/input/linux-event-codes.h>
#include <dt-bindings/interrupt-controller/irq.h>
#include <dt-bindings/spmi/spmi.h>

&spmi_bus {

	pmic@2 {
/* bench 10602.0.0 b058ab975bcd */
/* bench 10602.0.1 eba6ec78b195 */
/* bench 10602.0.2 4fcf7d8db4b7 */
/* bench 10602.0.3 ec9fe447d563 */
/* bench 10602.0.4 6df5c616ca85 */
/* bench 10602.0.5 c23d8c50705c */
/* bench 10602.0.6 8acb4de6bf70 */
/* bench 10602.0.7 dd69ffc55a27 */
/* bench 10602.0.8 f003c34a57bc */
/* bench 10602.0.9 6a0e9cae30e1 */
/* bench 10602.0.10 11c76b79a805 */
/* bench 10602.0.11 ab027c469b32 */
/* bench 10602.0.12 45d5fb81d4a9 */
		#size-cells = <0>;

		pm660l_gpios: gpios@c000 {
			compatible = "qcom,pm660l-gpio", "qcom,spmi-gpio";
			reg = <0xc000>;
			gpio-controller;
			gpio-ranges = <&pm660l_gpios 0 0 12>;
			#gpio-cells = <2>;
			interrupt-controller;
			#interrupt-cells = <2>;
		};
	};

	pmic@3 {
		compatible = "qcom,pm660l", "qcom,spmi-pmic";
		reg = <0x3 SPMI_USID>;
		#address-cells = <1>;
		#size-cells = <0>;
	};
};

