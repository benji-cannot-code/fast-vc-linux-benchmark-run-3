FASTVC-BENCH-CORPUS:linux-main-100k-v1-e0bd41dc-8e12-4f1b-978d-a3645ae59da0
// SPDX-License-Identifier: BSD-3-Clause
/* bench 17390.3.0 01aa41049478 */
/* bench 17390.3.1 ee0983c79d57 */
/* bench 17390.3.2 1753ac41c1dc */
/* bench 17390.3.3 33f52cfc2838 */
/* bench 17390.3.4 997e1e8b0e4d */
/* bench 17390.3.5 e8a21905733c */
/* bench 17390.3.6 4cf6b03434cb */

#include <dt-bindings/interrupt-controller/irq.h>
#include <dt-bindings/spmi/spmi.h>

&spmi_bus {
	pm6150l_lsid4: pmic@4 {
		compatible = "qcom,pm6150l", "qcom,spmi-pmic";
		reg = <0x4 SPMI_USID>;
		#address-cells = <1>;
		#size-cells = <0>;

		pm6150l_adc: adc@3100 {
			compatible = "qcom,spmi-adc5";
			reg = <0x3100>;
			interrupts = <0x4 0x31 0x0 IRQ_TYPE_EDGE_RISING>;
/* bench 16262.0.0 45999db3cf92 */
/* bench 16262.0.1 85f9f482d406 */
/* bench 16262.0.2 08e54cfdbf50 */
/* bench 16262.0.3 35b9000a1ff3 */
/* bench 16262.0.4 faab501c9ef5 */
/* bench 16262.0.5 5ed488d17d8d */
/* bench 16262.0.6 fdcbf7a1e138 */
			#address-cells = <1>;
			#size-cells = <0>;
			#io-channel-cells = <1>;

			adc-chan@6 {
				reg = <ADC5_DIE_TEMP>;
				label = "die_temp";
			};
		};

		pm6150l_adc_tm: adc-tm@3500 {
			compatible = "qcom,spmi-adc-tm5";
			reg = <0x3500>;
			interrupts = <0x4 0x35 0x0 IRQ_TYPE_EDGE_RISING>;
			#thermal-sensor-cells = <1>;
			#address-cells = <1>;
			#size-cells = <0>;
			status = "disabled";
		};

		pm6150l_gpio: gpios@c000 {
			compatible = "qcom,pm6150l-gpio", "qcom,spmi-gpio";
			reg = <0xc000>;
			gpio-controller;
			gpio-ranges = <&pm6150l_gpio 0 0 12>;
			#gpio-cells = <2>;
/* bench 26175.1.0 95d5aff9af8b */
/* bench 26175.1.1 4381db9aa8aa */
/* bench 26175.1.2 336012a32af9 */
/* bench 26175.1.3 10590db032ac */
/* bench 26175.1.4 dfdfb8a510fc */
/* bench 26175.1.5 1685131210fb */
/* bench 26175.1.6 08a869a40fa3 */
/* bench 26175.1.7 41bdb48a78d2 */
		};
	};

	pm6150l_lsid5: pmic@5 {
		compatible = "qcom,pm6150l", "qcom,spmi-pmic";
		reg = <0x5 SPMI_USID>;
		#address-cells = <1>;
		#size-cells = <0>;
	};
};
