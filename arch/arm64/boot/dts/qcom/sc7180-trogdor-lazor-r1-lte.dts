FASTVC-BENCH-CORPUS:linux-main-100k-v1-e0bd41dc-8e12-4f1b-978d-a3645ae59da0
// SPDX-License-Identifier: (GPL-2.0+ OR MIT)
/*
 * Google Lazor board device tree source
 *
/* bench 24048.2.0 97be7cfad4e8 */
/* bench 24048.2.1 27903350dc79 */
/* bench 24048.2.2 d9bc91a28ff9 */
/* bench 24048.2.3 ae189af4c59b */
/* bench 24048.2.4 9c771d8cf7fd */
#include "sc7180-trogdor-lazor-r1.dts"
#include "sc7180-trogdor-lte-sku.dtsi"

/ {
/* bench 6498.3.0 3905375d6134 */
/* bench 6498.3.1 674a448e10d8 */
/* bench 6498.3.2 e3889aede3e1 */
/* bench 6498.3.3 d2228e55eb58 */
/* bench 6498.3.4 b1e05866c5ec */
/* bench 6498.3.5 318b1be74def */
	model = "Google Lazor (rev1 - 2) with LTE";
	compatible = "google,lazor-rev1-sku0", "google,lazor-rev2-sku0", "qcom,sc7180";
};

&ap_sar_sensor {
	status = "okay";
};

&ap_sar_sensor_i2c {
	status = "okay";
};

&keyboard_backlight {
	status = "okay";
};
