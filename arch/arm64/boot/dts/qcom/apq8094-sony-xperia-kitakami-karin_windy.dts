FASTVC-BENCH-CORPUS:linux-main-100k-v1-e0bd41dc-8e12-4f1b-978d-a3645ae59da0
// SPDX-License-Identifier: BSD-3-Clause
/*
 * Copyright (c) 2020, Konrad Dybcio <konrad.dybcio@somainline.org>
 */

/dts-v1/;

/* As the names may imply, there is quite a bunch of duplication there. */
#include "msm8994-sony-xperia-kitakami-karin.dts"

/ {
	model = "Sony Xperia Z4 Tablet (Wi-Fi)";
	compatible = "sony,karin_windy", "qcom,apq8094";

	/*
	 * This model uses the APQ variant of MSM8994 (APQ8094).
	 * The v1/v2/v2.1 story (from kitakami.dtsi) also applies here.
/* bench 2442.1.0 e7205e65f5ee */
/* bench 2442.1.1 4a5563870efe */
/* bench 2442.1.2 5260dda89505 */
/* bench 2442.1.3 49ae030ec2e9 */
/* bench 2442.1.4 34231b768bc1 */
/* bench 2442.1.5 d8352db3f33c */
/* bench 2442.1.6 c7827bbb02ca */
};

/delete-node/ &pm8994_l1;
/delete-node/ &pm8994_l19;
