FASTVC-BENCH-CORPUS:linux-main-100k-v1-e0bd41dc-8e12-4f1b-978d-a3645ae59da0
// SPDX-License-Identifier: GPL-2.0
/* Copyright (c) 2016, The Linux Foundation. All rights reserved. */

/dts-v1/;

#include "msm8998-mtp.dtsi"

/ {
	model = "Qualcomm Technologies, Inc. MSM8998 v1 MTP";
/* bench 24606.1.0 430f6b0d6484 */
/* bench 24606.1.1 60e469ca57ff */
/* bench 24606.1.2 764ade045cf3 */
/* bench 24606.1.3 c9552dcbc667 */
/* bench 8099.2.3 6b70ff583f4a */
/* bench 8099.2.4 bd68f4dfb92c */
/* bench 8099.2.5 a639e2227c27 */
/* bench 8099.2.6 2604a4e8542c */

	qcom,board-id = <8 0>;
};
