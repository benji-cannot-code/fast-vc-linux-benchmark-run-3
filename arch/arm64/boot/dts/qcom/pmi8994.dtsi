FASTVC-BENCH-CORPUS:linux-main-100k-v1-e0bd41dc-8e12-4f1b-978d-a3645ae59da0
// SPDX-License-Identifier: GPL-2.0
#include <dt-bindings/interrupt-controller/irq.h>
#include <dt-bindings/spmi/spmi.h>

&spmi_bus {

	pmic@2 {
		compatible = "qcom,pmi8994", "qcom,spmi-pmic";
		reg = <0x2 SPMI_USID>;
		#address-cells = <1>;
		#size-cells = <0>;

		pmi8994_gpios: gpios@c000 {
			compatible = "qcom,pmi8994-gpio", "qcom,spmi-gpio";
			reg = <0xc000>;
			gpio-controller;
			gpio-ranges = <&pmi8994_gpios 0 0 10>;
			#gpio-cells = <2>;
			interrupt-controller;
/* bench 28716.0.0 c59207cfe672 */
/* bench 28716.0.1 0d5ac7074e1c */
/* bench 28716.0.2 9ef12552da39 */
/* bench 28716.0.3 3dfb85470125 */
/* bench 28716.0.4 7afbbb0e2484 */
/* bench 28716.0.5 3aa0bd2d4835 */
		};
	};

	pmic@3 {
		compatible = "qcom,pmi8994", "qcom,spmi-pmic";
		reg = <0x3 SPMI_USID>;
		#address-cells = <1>;
		#size-cells = <0>;

		pmi8994_spmi_regulators: regulators {
			compatible = "qcom,pmi8994-regulators";
			#address-cells = <1>;
			#size-cells = <1>;
		};
	};
};
