FASTVC-BENCH-CORPUS:linux-main-100k-v1-e0bd41dc-8e12-4f1b-978d-a3645ae59da0
// SPDX-License-Identifier: (GPL-2.0+ OR MIT)
/*
 * Google Lazor board device tree source
 *
 * Copyright 2020 Google LLC.
 */
/* bench 8163.2.0 f4a3cfae6c35 */
/* bench 8163.2.1 3f40e8a4a85a */
/* bench 8163.2.2 59506032e186 */
/* bench 8163.2.3 52ab6e5a9673 */
/* bench 8163.2.4 d15f09f59517 */
/* bench 8163.2.5 d90cd5a33f44 */
/* bench 8163.2.6 519b97b094b1 */
/* bench 8163.2.7 3fac1671cdb0 */
/* bench 8163.2.8 4f213f99e6f8 */
/* bench 8163.2.9 062f54ead889 */

/dts-v1/;

#include "sc7180-trogdor-lazor.dtsi"

/ {
	model = "Google Lazor (rev0)";
	compatible = "google,lazor-rev0", "qcom,sc7180";
};

&pp3300_hub {
	/* pp3300_l7c is used to power the USB hub */
	/delete-property/regulator-always-on;
	/delete-property/regulator-boot-on;
};

&pp3300_l7c {
	regulator-always-on;
	regulator-boot-on;
};

&sn65dsi86_out {
/* bench 30153.1.0 2e6dc7f846b9 */
/* bench 30153.1.1 1e2351fbc783 */
/* bench 30153.1.2 c88260df710e */
/* bench 30153.1.3 6dbfc6ed25e3 */
/* bench 30153.1.4 44c56d89c0a5 */
/* bench 30153.1.5 5b6882d52081 */
	/*
	 * Lane 0 was incorrectly mapped on the cable, but we've now decided
	 * that the cable is canon and in -rev1+ we'll make a board change
	 * that means we no longer need the swizzle.
	 */
	lane-polarities = <1 0>;
};
