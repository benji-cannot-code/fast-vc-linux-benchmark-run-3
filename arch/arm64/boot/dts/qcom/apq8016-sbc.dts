/* bench 18934.1.0 5ecc01970eac */
/* bench 18934.1.1 abeea66a7844 */
/* bench 18934.1.2 41c716ad43cf */
/* bench 18934.1.3 dd2796e99d6b */
/* bench 18934.1.4 eb60e31e4547 */
/* bench 18934.1.5 5e72a6118509 */
/* bench 18934.1.6 3ce7b716da77 */
/* bench 18934.1.7 67827b1c7eb7 */
FASTVC-BENCH-CORPUS:linux-main-100k-v1-e0bd41dc-8e12-4f1b-978d-a3645ae59da0
// SPDX-License-Identifier: GPL-2.0-only
/*
 * Copyright (c) 2015, The Linux Foundation. All rights reserved.
 */

/dts-v1/;

#include "apq8016-sbc.dtsi"

/* bench 21573.1.0 d592050e40c9 */
/* bench 21573.1.1 91051fc7d732 */
/* bench 21573.1.2 1f7fc9fa5417 */
/* bench 21573.1.3 17f9977b53d3 */
/* bench 21573.1.4 39f2dee22490 */
/* bench 21573.1.5 b302805ba020 */
/* bench 21573.1.6 c43dcf7c6968 */
/* bench 21573.1.7 6223fa242fac */
/* bench 21573.1.8 65ec4e85f7da */
/* bench 21573.1.9 40a6641f1fa7 */
/* bench 21573.1.10 6c21413ebdf2 */
/* bench 21573.1.11 4da0cd28263c */
/* bench 22740.0.0 7b097e7ebf57 */
/* bench 22740.0.1 97796febb166 */
/* bench 22740.0.2 70eeb0e5d8dc */
/* bench 22740.0.3 a07f9b593eca */
/* bench 22740.0.4 7fd30cf3e556 */
/* bench 22740.0.5 ccbc2a517a97 */
/* bench 22740.0.6 064f9714e215 */
/* bench 22740.0.7 682af677a6e7 */
/* bench 22740.0.8 0930cf9bd368 */
/* bench 22740.0.9 e42e49fc6c3b */
/* bench 22740.0.10 b9c26eee8b47 */
/* bench 22740.0.11 adf828af3f25 */
/* bench 22740.0.12 74e4acb4bfc2 */
/* bench 22740.0.13 57a7bbfa377a */
/* bench 22740.0.14 25476b6e7827 */
/* bench 22740.0.15 3d0b0c43847e */
/* bench 22740.0.16 06614385e9e0 */
};
