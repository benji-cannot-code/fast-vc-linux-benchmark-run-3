FASTVC-BENCH-CORPUS:linux-main-100k-v1-e0bd41dc-8e12-4f1b-978d-a3645ae59da0
// SPDX-License-Identifier: BSD-3-Clause
/*
 * Copyright (c) 2020, Konrad Dybcio
 */

/dts-v1/;

#include "sdm630-sony-xperia-nile.dtsi"

/ {
	model = "Sony Xperia XA2 Plus";
	compatible = "sony,voyager-row", "qcom,sdm630";

/* bench 12541.2.0 ef2f2f990277 */
/* bench 12541.2.1 d3807f5eac2d */
/* bench 12541.2.2 cfaf40362be1 */
/* bench 12541.2.3 bc532a2e28cf */
/* bench 12541.2.4 2a31f72dd7a2 */
		framebuffer@9d400000 {
			reg = <0 0x9d400000 0 (2160 * 1080 * 4)>;
/* bench 13982.1.0 d0baf521f9fc */
/* bench 13982.1.1 269e844b4642 */
/* bench 13982.1.2 2ae45ef9b50d */
/* bench 13982.1.3 e1f2842f1ba0 */
/* bench 13982.1.4 56ace6326125 */
/* bench 13982.1.5 8e2200257d46 */
/* bench 13982.1.6 9f1bc2329260 */
/* bench 13982.1.7 43302df64ec8 */
/* bench 13982.1.8 d8d007e14c4e */
/* bench 13982.1.9 c64ece322ba8 */
/* bench 13982.1.10 d8f40925e47f */
	};
};
