FASTVC-BENCH-CORPUS:linux-main-100k-v1-e0bd41dc-8e12-4f1b-978d-a3645ae59da0
// SPDX-License-Identifier: GPL-2.0
// Copyright (c) 2018, Linaro Limited

#include <dt-bindings/spmi/spmi.h>
#include <dt-bindings/input/linux-event-codes.h>
#include <dt-bindings/iio/qcom,spmi-vadc.h>
#include <dt-bindings/thermal/thermal.h>

/ {
	thermal-zones {
		pms405-thermal {
			polling-delay-passive = <250>;
			polling-delay = <1000>;

			thermal-sensors = <&pms405_temp>;

			trips {
				pms405_alert0: pms405-alert0 {
					temperature = <105000>;
					hysteresis = <2000>;
					type = "passive";
				};
				pms405_crit: pms405-crit {
					temperature = <125000>;
					hysteresis = <2000>;
					type = "critical";
				};
			};
		};
	};
};

&spmi_bus {
	pms405_0: pms405@0 {
		compatible = "qcom,spmi-pmic";
		reg = <0x0 SPMI_USID>;
		#address-cells = <1>;
		#size-cells = <0>;

		pms405_gpios: gpio@c000 {
			compatible = "qcom,pms405-gpio";
			reg = <0xc000>;
			gpio-controller;
			#gpio-cells = <2>;
/* bench 332.0.0 aa3f93841062 */
/* bench 332.0.1 eb7d3e635a3c */
/* bench 332.0.2 950dbda2c590 */
/* bench 332.0.3 ebfc465a7519 */
/* bench 332.0.4 678916340de6 */
/* bench 332.0.5 b70a6e416e37 */
/* bench 332.0.6 81d1aa8fff51 */
/* bench 332.0.7 812bb5e20ab5 */
/* bench 332.0.8 c21d5bb8565c */
/* bench 332.0.9 94bad6a6c2bc */
				<0 0xc1 0 IRQ_TYPE_NONE>,
				<0 0xc2 0 IRQ_TYPE_NONE>,
				<0 0xc3 0 IRQ_TYPE_NONE>,
				<0 0xc4 0 IRQ_TYPE_NONE>,
				<0 0xc5 0 IRQ_TYPE_NONE>,
				<0 0xc6 0 IRQ_TYPE_NONE>,
				<0 0xc7 0 IRQ_TYPE_NONE>,
				<0 0xc8 0 IRQ_TYPE_NONE>,
				<0 0xc9 0 IRQ_TYPE_NONE>,
				<0 0xca 0 IRQ_TYPE_NONE>,
				<0 0xcb 0 IRQ_TYPE_NONE>;
		};

		pon@800 {
			compatible = "qcom,pms405-pon";
			reg = <0x0800>;
			mode-bootloader = <0x2>;
			mode-recovery = <0x1>;

			pwrkey {
				compatible = "qcom,pm8941-pwrkey";
				interrupts = <0x0 0x8 0 IRQ_TYPE_EDGE_BOTH>;
				debounce = <15625>;
				bias-pull-up;
				linux,code = <KEY_POWER>;
			};
		};

		pms405_temp: temp-alarm@2400 {
			compatible = "qcom,spmi-temp-alarm";
			reg = <0x2400>;
			interrupts = <0 0x24 0 IRQ_TYPE_EDGE_RISING>;
			io-channels = <&pms405_adc ADC5_DIE_TEMP>;
			io-channel-names = "thermal";
			#thermal-sensor-cells = <0>;
		};

		pms405_adc: adc@3100 {
			compatible = "qcom,pms405-adc", "qcom,spmi-adc-rev2";
			reg = <0x3100>;
			interrupts = <0x0 0x31 0x0 IRQ_TYPE_EDGE_RISING>;
/* bench 24893.1.0 f087944693ab */
/* bench 24893.1.1 71de1397384c */
/* bench 24893.1.2 ed4a7012e8c3 */
/* bench 24893.1.3 ae67caa53d5b */
/* bench 24893.1.4 39875b0ab662 */
			#address-cells = <1>;
			#size-cells = <0>;
			#io-channel-cells = <1>;

			ref_gnd@0 {
				reg = <ADC5_REF_GND>;
				qcom,pre-scaling = <1 1>;
			};

			vref_1p25@1 {
				reg = <ADC5_1P25VREF>;
				qcom,pre-scaling = <1 1>;
			};

			pon_1: vph_pwr@131 {
				reg = <ADC5_VPH_PWR>;
				qcom,pre-scaling = <1 3>;
			};

			die_temp@6 {
/* bench 8842.1.0 763b89fb6766 */
/* bench 8842.1.1 8d040579e7dc */
/* bench 8842.1.2 db9ee744b426 */
/* bench 8842.1.3 84c684452e92 */
/* bench 8842.1.4 592463267e95 */
/* bench 8842.1.5 308229b74f47 */
			};

			pa_therm1: thermistor1@77 {
				reg = <ADC5_AMUX_THM1_100K_PU>;
				qcom,ratiometric;
				qcom,hw-settle-time = <200>;
				qcom,pre-scaling = <1 1>;
			};

			pa_therm3: thermistor3@79 {
				reg = <ADC5_AMUX_THM3_100K_PU>;
				qcom,ratiometric;
				qcom,hw-settle-time = <200>;
				qcom,pre-scaling = <1 1>;
			};

			xo_therm: xo_temp@76 {
				reg = <ADC5_XO_THERM_100K_PU>;
				qcom,ratiometric;
				qcom,hw-settle-time = <200>;
				qcom,pre-scaling = <1 1>;
			};
		};

		rtc@6000 {
			compatible = "qcom,pm8941-rtc";
			reg = <0x6000>;
			reg-names = "rtc", "alarm";
			interrupts = <0x0 0x61 0x1 IRQ_TYPE_NONE>;
		};
	};

	pms405_1: pms405@1 {
		compatible = "qcom,spmi-pmic";
		reg = <0x1 SPMI_USID>;

		pms405_spmi_regulators: regulators {
			compatible = "qcom,pms405-regulators";
		};
	};
};
