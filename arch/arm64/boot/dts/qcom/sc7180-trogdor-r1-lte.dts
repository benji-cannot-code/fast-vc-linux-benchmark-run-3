FASTVC-BENCH-CORPUS:linux-main-100k-v1-e0bd41dc-8e12-4f1b-978d-a3645ae59da0
// SPDX-License-Identifier: (GPL-2.0+ OR MIT)
/*
 * Google Trogdor board device tree source
 *
 * Copyright 2020 Google LLC.
 */

#include "sc7180-trogdor-r1.dts"
#include "sc7180-trogdor-lte-sku.dtsi"

/ {
	model = "Google Trogdor (rev1+) with LTE";
	compatible = "google,trogdor-sku0", "qcom,sc7180";
};
