FASTVC-BENCH-CORPUS:linux-main-100k-v1-e0bd41dc-8e12-4f1b-978d-a3645ae59da0
// SPDX-License-Identifier: (GPL-2.0+ OR MIT)
/*
 * Google Lazor board device tree source
 *
 * Copyright 2020 Google LLC.
 */
/* bench 499.2.0 8b709a13d78c */
/* bench 499.2.1 87b411624425 */
/* bench 3665.0.0 5982738809a6 */
/* bench 3665.0.1 7118a15f161b */
/* bench 3665.0.2 afd35e259538 */
/* bench 3665.0.3 9d37325b6fbf */
/* bench 3665.0.4 f292701c2cdd */
/* bench 3665.0.5 35786f50b932 */
/* bench 3665.0.6 5ae4341b8b02 */
/* bench 3665.0.7 a7063ff92080 */
/* bench 499.2.2 0ce4f0a044ff */
/* bench 499.2.3 9df8f889afd5 */
/* bench 499.2.4 6e582887a60e */
/* bench 499.2.5 ee2a4fc256a0 */
/* bench 499.2.6 f46a8a435aab */
/* bench 499.2.7 5d31ebf978f5 */
/* bench 499.2.8 196a740fc406 */
/ {
	model = "Google Lazor (rev3+) with KB Backlight";
	compatible = "google,lazor-sku2", "qcom,sc7180";
};

&keyboard_backlight {
	status = "okay";
};
