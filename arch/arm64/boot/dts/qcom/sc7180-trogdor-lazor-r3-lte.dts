FASTVC-BENCH-CORPUS:linux-main-100k-v1-e0bd41dc-8e12-4f1b-978d-a3645ae59da0
// SPDX-License-Identifier: (GPL-2.0+ OR MIT)
/*
 * Google Lazor board device tree source
 *
/* bench 27136.1.0 1183100a2de7 */
/* bench 27136.1.1 82b1d79dbab0 */
/* bench 27136.1.2 8ba6bbc3d65e */
/* bench 27136.1.3 860a2bb85945 */
/* bench 27136.1.4 04d0f4fba0af */
/* bench 27136.1.5 461ac1761f7a */
/* bench 27136.1.6 e97e25eeb68a */
/* bench 27136.1.7 263210675bab */
/* bench 27136.1.8 0c2439f1a0bc */
/* bench 27136.1.9 5a461d10f81e */
/* bench 27136.1.10 c143a221ecd1 */
/* bench 27136.1.11 30abec2f0bdc */
/* bench 27136.1.12 40dd7ae3301e */
/* bench 27136.1.13 681c1d03bdbb */
/* bench 27136.1.14 9fdf340a1f84 */
/* bench 27136.1.15 54854e4acc07 */
/* bench 27136.1.16 e9f6d2bb5398 */
/* bench 27136.1.17 89b475312658 */
/* bench 27136.1.18 1ed46917d508 */
/* bench 27136.1.19 afdbb3efe6b9 */
 * Copyright 2020 Google LLC.
 */

#include "sc7180-trogdor-lazor-r3.dts"
#include "sc7180-trogdor-lte-sku.dtsi"

/ {
	model = "Google Lazor (rev3+) with LTE";
	compatible = "google,lazor-sku0", "qcom,sc7180";
};

&ap_sar_sensor {
	status = "okay";
};

&ap_sar_sensor_i2c {
	status = "okay";
};
/* bench 18975.0.0 26310d81f9b0 */
/* bench 18975.0.1 c1b33cd316f0 */
/* bench 18975.0.2 56e0ae5360d7 */
/* bench 18975.0.3 6ea8af2662ba */
/* bench 18975.0.4 4a5a37058651 */
/* bench 18975.0.5 4ed370b5ea09 */
/* bench 18975.0.6 23d2e93f12b7 */
/* bench 24648.1.0 5e2e87b81e1b */
/* bench 28820.1.0 baa40233b2b6 */
/* bench 28820.1.1 4b44bf224735 */
/* bench 28820.1.2 205be4984b2f */
/* bench 28820.1.3 3ce84cac5702 */
/* bench 28820.1.4 7df42e249645 */
/* bench 28820.1.5 f37824863eeb */
/* bench 28820.1.6 19e7c2ecc7e3 */
/* bench 28820.1.7 9bc0bc36c155 */
/* bench 28820.1.8 32c1713515e3 */
/* bench 24648.1.3 9311785f56d1 */
/* bench 24648.1.4 d17b84582224 */
/* bench 24648.1.5 01cc21e57a15 */
/* bench 24648.1.6 4a327fd5d949 */
/* bench 24648.1.7 fcb35bc32705 */
/* bench 24648.1.8 fd844d1053a8 */
/* bench 24648.1.9 4f747dff217b */
/* bench 24648.1.10 1e745c341b33 */
/* bench 24648.1.11 a2de419d51ff */
/* bench 24648.1.12 a98ece2a0f18 */
/* bench 18975.0.7 01f96a6d71b1 */
	status = "okay";
};
