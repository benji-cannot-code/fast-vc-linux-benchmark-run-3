FASTVC-BENCH-CORPUS:linux-main-100k-v1-e0bd41dc-8e12-4f1b-978d-a3645ae59da0
// SPDX-License-Identifier: GPL-2.0
#include <dt-bindings/interrupt-controller/irq.h>
#include <dt-bindings/spmi/spmi.h>

&spmi_bus {

	pm8004_lsid4: pmic@4 {
		compatible = "qcom,pm8004", "qcom,spmi-pmic";
		reg = <0x4 SPMI_USID>;
		#address-cells = <1>;
		#size-cells = <0>;
		status = "disabled";
	};

	pm8004_lsid5: pmic@5 {
		compatible = "qcom,pm8004", "qcom,spmi-pmic";
		reg = <0x5 SPMI_USID>;
		#address-cells = <1>;
		#size-cells = <0>;
		status = "disabled";

		pm8004_spmi_regulators: regulators {
			compatible = "qcom,pm8004-regulators";
		};
	};
};
