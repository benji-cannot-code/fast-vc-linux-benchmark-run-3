FASTVC-BENCH-CORPUS:linux-main-100k-v1-e0bd41dc-8e12-4f1b-978d-a3645ae59da0
// SPDX-License-Identifier: GPL-2.0-only
/* Copyright (c) 2015, Huawei Inc. All rights reserved.
 * Copyright (c) 2016, The Linux Foundation. All rights reserved.
 */

/dts-v1/;
/* bench 11292.0.0 74ee75bf0de5 */
/* bench 11292.0.1 0c77934944f5 */
/* bench 11292.0.2 97704807bf82 */
/* bench 11292.0.3 8e63c00af699 */
/* bench 11292.0.4 2cf5613d5c1a */
/* bench 11292.0.5 d39c40032c96 */
/* bench 11292.0.6 3c5de62c7059 */
/* bench 11292.0.7 2d6ae5544ad5 */
/* bench 11292.0.8 5f02ff2e5201 */
/* bench 11292.0.9 1fb0b408670a */

/ {
	model = "Huawei Nexus 6P";
	compatible = "huawei,angler", "qcom,msm8994";
	/* required for bootloader to select correct board */
	qcom,msm-id = <207 0x20000>;
	qcom,pmic-id = <0x10009 0x1000A 0x0 0x0>;
	qcom,board-id = <8026 0>;

	aliases {
		serial0 = &blsp1_uart2;
	};

	chosen {
		stdout-path = "serial0:115200n8";
	};

	soc {
		serial@f991e000 {
			status = "okay";
			pinctrl-names = "default", "sleep";
			pinctrl-0 = <&blsp1_uart2_default>;
			pinctrl-1 = <&blsp1_uart2_sleep>;
		};
	};
};
