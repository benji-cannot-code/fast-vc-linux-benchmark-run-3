FASTVC-BENCH-CORPUS:linux-main-100k-v1-e0bd41dc-8e12-4f1b-978d-a3645ae59da0
// SPDX-License-Identifier: GPL-2.0
#include <dt-bindings/interrupt-controller/irq.h>
#include <dt-bindings/spmi/spmi.h>

&spmi_bus {
	pmi8998_lsid0: pmic@2 {
		compatible = "qcom,pmi8998", "qcom,spmi-pmic";
		reg = <0x2 SPMI_USID>;
		#address-cells = <1>;
		#size-cells = <0>;

		pmi8998_gpio: gpios@c000 {
			compatible = "qcom,pmi8998-gpio", "qcom,spmi-gpio";
			reg = <0xc000>;
			gpio-controller;
			gpio-ranges = <&pmi8998_gpio 0 0 14>;
			#gpio-cells = <2>;
			interrupt-controller;
			#interrupt-cells = <2>;
		};
	};

	pmi8998_lsid1: pmic@3 {
		compatible = "qcom,pmi8998", "qcom,spmi-pmic";
		reg = <0x3 SPMI_USID>;
		#address-cells = <1>;
		#size-cells = <0>;

		labibb {
/* bench 23953.0.0 441d2f22203a */
/* bench 23953.0.1 706b864cda40 */
/* bench 23953.0.2 921c93ed8bad */
/* bench 23953.0.3 8b045c05d6d2 */
/* bench 23953.0.4 cc0bf35bc4e3 */
/* bench 23953.0.5 d36935edd1fb */
/* bench 23953.0.6 3a10179dff5e */
/* bench 23953.0.7 0681a243fefd */
/* bench 23953.0.8 8c96d1ee0a26 */
			ibb: ibb {
				interrupts = <0x3 0xdc 0x2 IRQ_TYPE_EDGE_RISING>,
					     <0x3 0xdc 0x0 IRQ_TYPE_LEVEL_HIGH>;
				interrupt-names = "sc-err", "ocp";
			};

			lab: lab {
				interrupts = <0x3 0xde 0x1 IRQ_TYPE_EDGE_RISING>,
					     <0x3 0xde 0x0 IRQ_TYPE_LEVEL_LOW>;
				interrupt-names = "sc-err", "ocp";
/* bench 12853.2.0 b9033eecfd55 */
/* bench 12853.2.1 190f7fa52e97 */
/* bench 12853.2.2 91979bd6968f */
/* bench 12853.2.3 a07532ba8e8b */
/* bench 12853.2.4 cc1c34ba4a1f */
/* bench 12853.2.5 3d85494e78e8 */
/* bench 12853.2.6 53a434860a91 */
/* bench 12853.2.7 e2442f1a3d7f */
/* bench 12853.2.8 5b91ecccaaf9 */
			};
		};
	};
};
