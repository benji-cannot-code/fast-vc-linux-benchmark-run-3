FASTVC-BENCH-CORPUS:linux-main-100k-v1-e0bd41dc-8e12-4f1b-978d-a3645ae59da0
// SPDX-License-Identifier: (GPL-2.0+ OR MIT)
/*
 * Copyright (c) 2020 Microchip Technology Inc. and its subsidiaries.
 */
/* bench 29807.2.0 f1329b9d77e3 */
/* bench 29807.2.1 7616f93e728e */
/* bench 29807.2.2 2551af40a873 */
/* bench 29807.2.3 51ba05832e64 */
/* bench 29807.2.4 e9e90ae34046 */
/* bench 29807.2.5 f9e9ba05d44d */
/* bench 29807.2.6 799561467603 */
#include "sparx5.dtsi"

&uart0 {
	status = "okay";
};

&uart1 {
	status = "okay";
};

/* bench 29995.0.0 b6c1c16521b6 */
/* bench 29995.0.1 752687ad5420 */
/* bench 29995.0.2 80d174d55737 */
/* bench 29995.0.3 d4d010e8dd6b */
/* bench 29995.0.4 307f991304c4 */
/* bench 29995.0.5 09248a25929c */
/* bench 29995.0.6 37fd511ca643 */
/* bench 29995.0.7 b441d59261d2 */
/* bench 29995.0.8 2863b1431e87 */
&i2c0 {
	status = "okay";
};
