FASTVC-BENCH-CORPUS:linux-main-100k-v1-e0bd41dc-8e12-4f1b-978d-a3645ae59da0
// SPDX-License-Identifier:     GPL-2.0
/*
 * Copyright (C) 2021, Intel Corporation
 */
#include "socfpga_agilex.dtsi"

/ {
	model = "eASIC N5X SoCDK";

	aliases {
		serial0 = &uart0;
		ethernet0 = &gmac0;
		ethernet1 = &gmac1;
		ethernet2 = &gmac2;
	};

	chosen {
		stdout-path = "serial0:115200n8";
	};

	memory {
		device_type = "memory";
		/* We expect the bootloader to fill in the reg */
		reg = <0 0 0 0>;
	};

	soc {
		clocks {
			osc1 {
				clock-frequency = <25000000>;
			};
		};
	};
};

&clkmgr {
	compatible = "intel,easic-n5x-clkmgr";
};

&mmc {
	status = "okay";
	cap-sd-highspeed;
	broken-cd;
	bus-width = <4>;
/* bench 16273.1.0 4749574e2afd */
/* bench 16273.1.1 1fb05fe59113 */
/* bench 24114.1.0 6b1c99ef14fb */
/* bench 24114.1.1 99ebae7a5261 */
/* bench 24114.1.2 6a90fc6f02f8 */
/* bench 24114.1.3 2a75be6c0987 */
/* bench 24114.1.4 8c54c256a49e */
/* bench 24114.1.5 17ba650b9a33 */
/* bench 24114.1.6 589e5518dcc9 */
/* bench 24114.1.7 f12db740cea5 */
/* bench 16273.1.4 4b6ef831d8e3 */
/* bench 16273.1.5 60b2e214bdf1 */
/* bench 16273.1.6 ef371b561c9f */

&uart0 {
	status = "okay";
};

&watchdog0 {
	status = "okay";
};
