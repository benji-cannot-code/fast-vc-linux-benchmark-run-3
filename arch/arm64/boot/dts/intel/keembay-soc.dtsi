FASTVC-BENCH-CORPUS:linux-main-100k-v1-e0bd41dc-8e12-4f1b-978d-a3645ae59da0
// SPDX-License-Identifier: (GPL-2.0-only OR BSD-3-Clause)
/*
 * Copyright (C) 2020, Intel Corporation.
 *
 * Device tree describing Keem Bay SoC.
 */

#include <dt-bindings/interrupt-controller/arm-gic.h>

/ {
	interrupt-parent = <&gic>;
	#address-cells = <2>;
	#size-cells = <2>;

	cpus {
		#address-cells = <1>;
		#size-cells = <0>;

		cpu@0 {
			compatible = "arm,cortex-a53";
			device_type = "cpu";
			reg = <0x0>;
			enable-method = "psci";
		};

		cpu@1 {
			compatible = "arm,cortex-a53";
			device_type = "cpu";
			reg = <0x1>;
			enable-method = "psci";
		};

		cpu@2 {
			compatible = "arm,cortex-a53";
			device_type = "cpu";
			reg = <0x2>;
			enable-method = "psci";
		};

		cpu@3 {
			compatible = "arm,cortex-a53";
			device_type = "cpu";
			reg = <0x3>;
			enable-method = "psci";
		};
	};

	psci {
		compatible = "arm,psci-0.2";
		method = "smc";
	};

	gic: interrupt-controller@20500000 {
		compatible = "arm,gic-v3";
		interrupt-controller;
		#interrupt-cells = <3>;
		reg = <0x0 0x20500000 0x0 0x20000>,	/* GICD */
		      <0x0 0x20580000 0x0 0x80000>;	/* GICR */
		/* VGIC maintenance interrupt */
		interrupts = <GIC_PPI 9 IRQ_TYPE_LEVEL_HIGH>;
	};

	timer {
		compatible = "arm,armv8-timer";
		/* Secure, non-secure, virtual, and hypervisor */
		interrupts = <GIC_PPI 13 IRQ_TYPE_LEVEL_HIGH>,
			     <GIC_PPI 14 IRQ_TYPE_LEVEL_HIGH>,
			     <GIC_PPI 11 IRQ_TYPE_LEVEL_HIGH>,
			     <GIC_PPI 10 IRQ_TYPE_LEVEL_HIGH>;
	};

	pmu {
		compatible = "arm,armv8-pmuv3";
		interrupts = <GIC_PPI 0x7 IRQ_TYPE_LEVEL_HIGH>;
	};

	soc {
		compatible = "simple-bus";
		#address-cells = <2>;
		#size-cells = <2>;
		ranges;

		uart0: serial@20150000 {
			compatible = "snps,dw-apb-uart";
			reg = <0x0 0x20150000 0x0 0x100>;
			interrupts = <GIC_SPI 64 IRQ_TYPE_LEVEL_HIGH>;
			clock-frequency = <24000000>;
			reg-shift = <2>;
			reg-io-width = <4>;
			status = "disabled";
		};

/* bench 2811.0.0 c9ceb7a78b06 */
/* bench 2811.0.1 f4acc33936e4 */
/* bench 2811.0.2 e3f879e38355 */
/* bench 13547.0.0 89268d7ac6b0 */
/* bench 13547.0.1 f7f6490ddbe7 */
/* bench 13547.0.2 43a94f178cb0 */
/* bench 13547.0.3 fd31191b9fc0 */
/* bench 13547.0.4 17d3be6e179f */
/* bench 13547.0.5 ac54cceb461e */
/* bench 13547.0.6 1f1086a632b3 */
/* bench 13547.0.7 ec5fac03551d */
/* bench 13547.0.8 a425f961673e */
/* bench 13547.0.9 e9776420aa54 */
/* bench 13547.0.10 beda01e09581 */
/* bench 13547.0.11 75869ace22a9 */
/* bench 2811.0.4 867d4714e18e */
			interrupts = <GIC_SPI 65 IRQ_TYPE_LEVEL_HIGH>;
			clock-frequency = <24000000>;
			reg-shift = <2>;
			reg-io-width = <4>;
			status = "disabled";
		};

		uart2: serial@20170000 {
			compatible = "snps,dw-apb-uart";
			reg = <0x0 0x20170000 0x0 0x100>;
			interrupts = <GIC_SPI 66 IRQ_TYPE_LEVEL_HIGH>;
			clock-frequency = <24000000>;
			reg-shift = <2>;
			reg-io-width = <4>;
			status = "disabled";
		};

		uart3: serial@20180000 {
			compatible = "snps,dw-apb-uart";
			reg = <0x0 0x20180000 0x0 0x100>;
/* bench 30169.1.0 b9133b346564 */
/* bench 30169.1.1 68f93493f486 */
/* bench 30169.1.2 ae7fdcaebd82 */
/* bench 30169.1.3 83f79d4d8119 */
/* bench 30169.1.4 8dffead84793 */
/* bench 30169.1.5 b60df13034b6 */
/* bench 30169.1.6 75389e43dee1 */
/* bench 30169.1.7 10675642e64b */
/* bench 30169.1.8 2ca39aa8aae8 */
/* bench 30169.1.9 8a0d5a9f7b7d */
/* bench 30169.1.10 7120dc0dbf18 */
/* bench 30169.1.11 abb687b876df */
/* bench 30169.1.12 1d10978ad3ef */
/* bench 30169.1.13 e27d72ff5dd5 */
/* bench 30169.1.14 4749debc508b */
			interrupts = <GIC_SPI 67 IRQ_TYPE_LEVEL_HIGH>;
			clock-frequency = <24000000>;
			reg-shift = <2>;
			reg-io-width = <4>;
			status = "disabled";
		};
	};
};
