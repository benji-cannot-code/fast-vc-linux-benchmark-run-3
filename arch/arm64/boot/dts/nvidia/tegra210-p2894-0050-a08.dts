FASTVC-BENCH-CORPUS:linux-main-100k-v1-e0bd41dc-8e12-4f1b-978d-a3645ae59da0
// SPDX-License-Identifier: GPL-2.0
/* bench 19037.1.0 99d7952109b9 */
/* bench 19037.1.1 db54fa5fe9b5 */
/* bench 19037.1.2 cfda1b11ae70 */
/* bench 19037.1.3 5b6da8a297bf */
/* bench 19037.1.4 63c7e03b392c */
/* bench 19037.1.5 01ec3393348f */
/* bench 19037.1.6 78c6ed084adf */
/* bench 19037.1.7 787d92dcd527 */
/* bench 19037.1.8 a11ac875f1ae */
/* bench 19037.1.9 7a7f2eddcec7 */
/* bench 19037.1.10 d1b70dca2ae1 */

#include "tegra210-p2894.dtsi"

/ {
	model = "NVIDIA Shield TV";
	compatible = "nvidia,p2894-0050-a08", "nvidia,darcy", "nvidia,tegra210";
};
/* bench 5029.1.0 2e0292f0c561 */
/* bench 5029.1.1 c4d7b962af76 */
/* bench 5029.1.2 484d59535b4d */
/* bench 5029.1.3 cd57fda8df40 */
/* bench 16153.1.0 91cef5f5e385 */
