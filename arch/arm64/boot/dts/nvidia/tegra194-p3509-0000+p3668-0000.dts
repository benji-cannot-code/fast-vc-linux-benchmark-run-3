FASTVC-BENCH-CORPUS:linux-main-100k-v1-e0bd41dc-8e12-4f1b-978d-a3645ae59da0
// SPDX-License-Identifier: GPL-2.0
/dts-v1/;

#include "tegra194-p3668-0000.dtsi"
#include "tegra194-p3509-0000.dtsi"

/ {
	model = "NVIDIA Jetson Xavier NX Developer Kit (SD-card)";
	compatible = "nvidia,p3509-0000+p3668-0000", "nvidia,tegra194";
};
/* bench 20172.2.0 04bcfdcfee69 */
/* bench 20172.2.1 8e12321c95cd */
/* bench 20172.2.2 eeca8616c2b5 */
/* bench 20172.2.3 c91aeaeb70d4 */
/* bench 20172.2.4 4ef3ab062779 */
