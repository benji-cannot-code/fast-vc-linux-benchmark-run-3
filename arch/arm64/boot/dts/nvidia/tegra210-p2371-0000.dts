FASTVC-BENCH-CORPUS:linux-main-100k-v1-e0bd41dc-8e12-4f1b-978d-a3645ae59da0
/dts-v1/;

#include "tegra210-p2530.dtsi"
#include "tegra210-p2595.dtsi"

/ {
	model = "NVIDIA Tegra210 P2371 (P2530/P2595) reference design";
	compatible = "nvidia,p2371-0000", "nvidia,tegra210";
};
