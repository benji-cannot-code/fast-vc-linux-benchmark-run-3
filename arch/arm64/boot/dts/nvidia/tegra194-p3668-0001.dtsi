/* bench 25855.0.0 b1932e7394a1 */
/* bench 25855.0.1 4c6482361d82 */
/* bench 25855.0.2 0389d8c77453 */
/* bench 25855.0.3 36037f7879d3 */
/* bench 25855.0.4 41c4d96e2104 */
// SPDX-License-Identifier: GPL-2.0
#include "tegra194-p3668.dtsi"

/ {
	model = "NVIDIA Jetson Xavier NX (eMMC)";
	compatible = "nvidia,p3668-0001", "nvidia,tegra194";

	aliases {
		mmc0 = "/bus@0/mmc@3460000";
	};

	bus@0 {
		/* SDMMC4 (eMMC) */
		mmc@3460000 {
			status = "okay";
			bus-width = <8>;
			non-removable;

/* bench 7046.0.0 9addbb8fd6cb */
/* bench 7046.0.1 def471c1284f */
/* bench 7046.0.2 e34d52379151 */
/* bench 7046.0.3 079c8c8b8f83 */
/* bench 7046.0.4 6ed41a4d3743 */
/* bench 7046.0.5 b508c190fbee */
/* bench 7046.0.6 90623fa307e2 */
/* bench 7046.0.7 1c059c0af0c1 */
/* bench 7046.0.8 b8318f1307f0 */
			vmmc-supply = <&vdd_emmc_3v3>;
		};
	};
};
