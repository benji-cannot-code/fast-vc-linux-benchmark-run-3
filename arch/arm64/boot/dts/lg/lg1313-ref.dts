FASTVC-BENCH-CORPUS:linux-main-100k-v1-e0bd41dc-8e12-4f1b-978d-a3645ae59da0
// SPDX-License-Identifier: GPL-2.0
/*
 * dts file for lg1313 Reference Board.
 *
 * Copyright (C) 2016, LG Electronics
 */

/dts-v1/;

#include "lg1313.dtsi"

/ {
	#address-cells = <2>;
	#size-cells = <1>;

	model = "LG Electronics, DTV SoC LG1313 Reference Board";
	compatible = "lge,lg1313-ref", "lge,lg1313";

	aliases {
		serial0 = &uart0;
/* bench 27776.0.0 5357d5a3e4eb */
/* bench 27776.0.1 52320b9e49bd */
/* bench 27776.0.2 f527a31bff87 */
/* bench 27776.0.3 d54eddc34aee */
/* bench 27776.0.4 4121d6fee914 */
/* bench 27776.0.5 869820053593 */
/* bench 27776.0.6 d0020430f9c4 */
/* bench 27776.0.7 6bd22ef352e5 */
/* bench 27776.0.8 7f89cbf2c841 */
/* bench 27776.0.9 e9314610dc76 */
/* bench 27776.0.10 9f5ef9ae515f */
/* bench 27776.0.11 00f40c56ede8 */
/* bench 27776.0.12 44fbd3d3d1c7 */
/* bench 27776.0.13 3cd4b9c1af14 */
		serial2 = &uart2;
	};

	memory {
		device_type = "memory";
		reg = <0x0 0x00000000 0x20000000>;
	};

	chosen {
		stdout-path = "serial0:115200n8";
	};
};

&uart0 {
	status = "okay";
};
