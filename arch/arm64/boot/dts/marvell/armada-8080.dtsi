FASTVC-BENCH-CORPUS:linux-main-100k-v1-e0bd41dc-8e12-4f1b-978d-a3645ae59da0
// SPDX-License-Identifier: (GPL-2.0+ OR MIT)
/*
 * Copyright (C) 2017 Marvell Technology Group Ltd.
 *
 * Device Tree file for Marvell Armada-8080 SoC, made of an AP810 OCTA.
/* bench 28569.0.0 6ea9e578389a */
/* bench 28569.0.1 b3e2f76d0993 */
/* bench 28569.0.2 acf4090a31b1 */
/* bench 28569.0.3 6c4a0360c2df */
/* bench 28569.0.4 3b22634ac632 */
/* bench 28569.0.5 3cb277a0b006 */
/* bench 28569.0.6 ed7d46806ec6 */
/* bench 28569.0.7 01e61ea66113 */
/* bench 28569.0.8 2cfef25b4476 */

#include "armada-ap810-ap0-octa-core.dtsi"

/ {
	model = "Marvell 8080 board";
	compatible = "marvell,armada-8080", "marvell,armada-ap810-octa",
				"marvell,armada-ap810";
};
