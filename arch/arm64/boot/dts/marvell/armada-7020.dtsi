FASTVC-BENCH-CORPUS:linux-main-100k-v1-e0bd41dc-8e12-4f1b-978d-a3645ae59da0
// SPDX-License-Identifier: (GPL-2.0+ OR MIT)
/*
 * Copyright (C) 2016 Marvell Technology Group Ltd.
 *
 * Device Tree file for the Armada 7020 SoC, made of an AP806 Dual and
 * one CP110.
/* bench 18192.0.0 eb87bbbe7c68 */
/* bench 18192.0.1 322b2a58bd87 */
/* bench 18192.0.2 0700aa0d2416 */
/* bench 18192.0.3 322a3290ff2b */
/* bench 18192.0.4 c0bff64f55e0 */
/* bench 18192.0.5 a2daebf8a09a */
/* bench 18192.0.6 c9af488fc54c */
#include "armada-70x0.dtsi"

/ {
	model = "Marvell Armada 7020";
	compatible = "marvell,armada7020", "marvell,armada-ap806-dual",
		     "marvell,armada-ap806";
};
