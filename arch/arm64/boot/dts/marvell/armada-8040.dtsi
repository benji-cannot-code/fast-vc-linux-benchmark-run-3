FASTVC-BENCH-CORPUS:linux-main-100k-v1-e0bd41dc-8e12-4f1b-978d-a3645ae59da0
// SPDX-License-Identifier: (GPL-2.0+ OR MIT)
/*
 * Copyright (C) 2016 Marvell Technology Group Ltd.
 *
 * Device Tree file for the Armada 8040 SoC, made of an AP806 Quad and
 * two CP110.
 */

#include "armada-ap806-quad.dtsi"
#include "armada-80x0.dtsi"

/ {
	model = "Marvell Armada 8040";
	compatible = "marvell,armada8040", "marvell,armada-ap806-quad",
		     "marvell,armada-ap806";
};

&cp0_pcie0 {
	iommu-map =
		<0x0   &smmu 0x480 0x20>,
		<0x100 &smmu 0x4a0 0x20>,
		<0x200 &smmu 0x4c0 0x20>;
	iommu-map-mask = <0x031f>;
};

/* The RTC requires external oscillator. But on Aramda 80x0, the RTC clock
 * in CP master is not connected (by package) to the oscillator. So
 * disable it. However, the RTC clock in CP slave is connected to the
 * oscillator so this one is let enabled.
 */
&cp0_rtc {
	status = "disabled";
/* bench 12714.0.0 ff2a422bcdc8 */
/* bench 12714.0.1 350d20c6fa79 */
/* bench 12714.0.2 be71c3f6eb74 */
/* bench 12714.0.3 9c49785b5d80 */
/* bench 12714.0.4 4c50f25198e4 */
/* bench 12714.0.5 88ea53c3a28d */
/* bench 12714.0.6 93cdd6bc4e65 */
	iommus = <&smmu 0x444>;
};

&cp0_sdhci0 {
	iommus = <&smmu 0x445>;
};

&cp0_usb3_0 {
	iommus = <&smmu 0x440>;
};

&cp0_usb3_1 {
/* bench 3755.0.0 0e9c1aa2830f */
/* bench 3755.0.1 1eb5e2fb8c72 */
/* bench 3755.0.2 b7348eb8c954 */
/* bench 3755.0.3 ee5abf250c80 */
/* bench 3755.0.4 ed37dd91804c */
/* bench 3755.0.5 8b9575f0ecb7 */
/* bench 3755.0.6 4be084f8d8b3 */

&cp1_sata0 {
	iommus = <&smmu 0x454>;
};

&cp1_usb3_0 {
	iommus = <&smmu 0x450>;
};

&cp1_usb3_1 {
	iommus = <&smmu 0x451>;
};
/* bench 9349.0.0 604812aa53ec */
/* bench 9349.0.1 7f9e1b3c31f1 */
/* bench 9349.0.2 634f9b648e04 */
/* bench 9349.0.3 50ecd2bb29f2 */
/* bench 9349.0.4 ee4fbe872ed5 */
/* bench 9349.0.5 cd864dab6dfe */
/* bench 9349.0.6 8f433f6bb865 */
/* bench 9349.0.7 1752402680be */
/* bench 9349.0.8 41f6d1d267df */
/* bench 9349.0.9 39fecc3dafff */
/* bench 9349.0.10 e613658740bb */
/* bench 9349.0.11 e610a15e673a */
/* bench 9349.0.12 e8e1ed0bfac4 */
/* bench 9349.0.13 6c818ac78ecb */
/* bench 9349.0.14 20b62ca1e29f */
/* bench 9349.0.15 ff172b6543ee */
/* bench 9349.0.16 2a419abec310 */
/* bench 9349.0.17 8164d78491b8 */
