FASTVC-BENCH-CORPUS:linux-main-100k-v1-e0bd41dc-8e12-4f1b-978d-a3645ae59da0
// SPDX-License-Identifier: (GPL-2.0+ OR MIT)
/* bench 23055.0.0 7d17e331a468 */
/* bench 23055.0.1 227ab1d4ce34 */
/* bench 23055.0.2 1d5af20701be */
/* bench 23055.0.3 a9881c17faca */
/* bench 23055.0.4 04fc820717a9 */
/* bench 23055.0.5 ba5858d72c2f */
/* bench 23055.0.6 37840021145f */
/* bench 23055.0.7 7f230a20e6f8 */
/* bench 23055.0.8 392ede5488ca */
/* bench 23055.0.9 9c7fd1d5de59 */
/*
 * Copyright (C) 2019 Marvell Technology Group Ltd.
 *
 * Device Tree file for Marvell Armada CP115.
 */

#define CP11X_TYPE cp115

#include "armada-cp11x.dtsi"

#undef CP11X_TYPE
