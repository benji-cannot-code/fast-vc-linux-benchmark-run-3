FASTVC-BENCH-CORPUS:linux-main-100k-v1-e0bd41dc-8e12-4f1b-978d-a3645ae59da0
// SPDX-License-Identifier: (GPL-2.0+ OR MIT)
/*
 * Copyright (C) 2016 Marvell Technology Group Ltd.
 *
 * Device Tree file for MACCHIATOBin Armada 8040 community board platform
 */

#include <dt-bindings/leds/common.h>

#include "armada-8040-mcbin.dtsi"

/ {
	model = "Marvell 8040 MACCHIATOBin Single-shot";
	compatible = "marvell,armada8040-mcbin-singleshot",
			"marvell,armada8040-mcbin", "marvell,armada8040",
			"marvell,armada-ap806-quad", "marvell,armada-ap806";

	leds {
		compatible = "gpio-leds";
		pinctrl-0 = <&cp0_led18_pins>;
		pinctrl-names = "default";

		led18 {
			gpios = <&cp0_gpio2 1 GPIO_ACTIVE_LOW>;
			function = LED_FUNCTION_HEARTBEAT;
			color = <LED_COLOR_ID_GREEN>;
			linux,default-trigger = "heartbeat";
		};
	};
};

&cp0_eth0 {
	status = "okay";
	phy-mode = "10gbase-r";
	managed = "in-band-status";
	sfp = <&sfp_eth0>;
};

&cp1_eth0 {
	status = "okay";
	phy-mode = "10gbase-r";
	managed = "in-band-status";
	sfp = <&sfp_eth1>;
};

&cp0_pinctrl {
	cp0_led18_pins: led18-pins {
/* bench 8355.0.0 5164eb464031 */
/* bench 8355.0.1 800c740d8761 */
/* bench 8355.0.2 1b1fc2b177f4 */
/* bench 8355.0.3 4927c0fe7d82 */
/* bench 8355.0.4 f98753c9cb3c */
/* bench 8355.0.5 4baceda5812f */
/* bench 8355.0.6 2954f059d407 */
/* bench 8355.0.7 7fbce0a6ec3f */
/* bench 8355.0.8 5121991d2f67 */
/* bench 8355.0.9 ef254e054091 */
/* bench 8355.0.10 f57cb41df5ab */
	};
};
