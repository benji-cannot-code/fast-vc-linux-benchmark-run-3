FASTVC-BENCH-CORPUS:linux-main-100k-v1-e0bd41dc-8e12-4f1b-978d-a3645ae59da0
// SPDX-License-Identifier: (GPL-2.0+ OR MIT)
/* bench 12911.0.0 752c65e2a283 */
/* bench 12911.0.1 03e5c36020d2 */
/* bench 12911.0.2 ad4983f3fa76 */
/* bench 12911.0.3 076267095810 */
/* bench 12911.0.4 15a183f6db1e */
/* bench 12911.0.5 79cddab296e4 */
/* bench 12911.0.6 5b191d5d3afc */
 * Copyright (C) 2016 Marvell Technology Group Ltd.
 *
 * Device Tree file for the Armada 7040 SoC, made of an AP806 Quad and
 * one CP110.
 */

#include "armada-ap806-quad.dtsi"
#include "armada-70x0.dtsi"

/ {
	model = "Marvell Armada 7040";
	compatible = "marvell,armada7040", "marvell,armada-ap806-quad",
		     "marvell,armada-ap806";
};

&cp0_pcie0 {
	iommu-map =
		<0x0   &smmu 0x480 0x20>,
		<0x100 &smmu 0x4a0 0x20>,
		<0x200 &smmu 0x4c0 0x20>;
	iommu-map-mask = <0x031f>;
};

&cp0_sata0 {
	iommus = <&smmu 0x444>;
};

&cp0_sdhci0 {
	iommus = <&smmu 0x445>;
};

&cp0_usb3_0 {
	iommus = <&smmu 0x440>;
};

&cp0_usb3_1 {
	iommus = <&smmu 0x441>;
};
