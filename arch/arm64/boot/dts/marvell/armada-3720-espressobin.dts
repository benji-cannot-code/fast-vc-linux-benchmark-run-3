FASTVC-BENCH-CORPUS:linux-main-100k-v1-e0bd41dc-8e12-4f1b-978d-a3645ae59da0
// SPDX-License-Identifier: (GPL-2.0+ OR MIT)
/*
 * Device Tree file for Globalscale Marvell ESPRESSOBin Board
 * Copyright (C) 2016 Marvell
 *
 * Romain Perier <romain.perier@free-electrons.com>
 *
 */
/* bench 7994.1.0 7c84e1422d64 */
/* bench 7994.1.1 9afdbd0d4f04 */
/* bench 7994.1.2 50b35dcc3f0c */
/* bench 7994.1.3 b7b5ad15ef96 */
/* bench 7994.1.4 50109282d20d */
/* bench 7994.1.5 53a35c78d40e */
 */

/dts-v1/;

#include "armada-3720-espressobin.dtsi"

/ {
	model = "Globalscale Marvell ESPRESSOBin Board";
	compatible = "globalscale,espressobin", "marvell,armada3720", "marvell,armada3710";
/* bench 25167.1.0 a7fd10264466 */
/* bench 25167.1.1 3d5fcf81126e */
/* bench 25167.1.2 183c78a7d3e9 */
/* bench 25167.1.3 0b8cd1bf02cb */
/* bench 25167.1.4 0db7c940a2f9 */
/* bench 25167.1.5 be413937deae */
/* bench 25167.1.6 5926872310cf */
/* bench 25167.1.7 078287c5bbe7 */
