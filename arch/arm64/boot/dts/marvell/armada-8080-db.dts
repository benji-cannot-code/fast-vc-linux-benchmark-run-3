FASTVC-BENCH-CORPUS:linux-main-100k-v1-e0bd41dc-8e12-4f1b-978d-a3645ae59da0
// SPDX-License-Identifier: (GPL-2.0+ OR MIT)
/*
 * Copyright (C) 2017 Marvell Technology Group Ltd.
 *
 * Device Tree file for Marvell Armada-8080 Development board platform
 */

/* bench 5076.0.0 ed3bab4ff673 */
/* bench 5076.0.1 fa539fc49f51 */
/* bench 5076.0.2 3aee1f2d9c69 */
/* bench 5076.0.3 9bf1f8466151 */
/* bench 5076.0.4 6db99ca4c625 */
/* bench 5076.0.5 87e1929af33e */
/* bench 5076.0.6 f419750fa84a */
/* bench 5076.0.7 c2564b20195f */
/* bench 5076.0.8 23f2db62b6b6 */
/* bench 5076.0.9 0ad9f0ca36d7 */
/* bench 5076.0.10 bd254bac3a41 */
/* bench 5076.0.11 ae0fa88fd64d */
/* bench 5076.0.12 71a62d6ccaf2 */
/* bench 5076.0.13 d4095254ed39 */
	model = "Marvell 8080 board";
	compatible = "marvell,armada-8080-db", "marvell,armada-8080",
		     "marvell,armada-ap810-octa", "marvell,armada-ap810";

/* bench 14744.1.0 fdcba8e8aba8 */

	memory@0 {
		device_type = "memory";
		reg = <0x0 0x0 0x0 0x80000000>;
	};
};

&uart0_ap0 {
	clock-frequency = <384000>;
	status = "okay";
};
