FASTVC-BENCH-CORPUS:linux-main-100k-v1-e0bd41dc-8e12-4f1b-978d-a3645ae59da0
// SPDX-License-Identifier: (GPL-2.0+ OR MIT)
/*
 * Device Tree file for Globalscale Marvell ESPRESSOBin Board with eMMC
 * Copyright (C) 2018 Marvell
 *
 * Romain Perier <romain.perier@free-electrons.com>
 * Konstantin Porotchkin <kostap@marvell.com>
 *
 */
/*
 * Schematic available at http://espressobin.net/wp-content/uploads/2017/08/ESPRESSObin_V5_Schematics.pdf
 */

/dts-v1/;

#include "armada-3720-espressobin.dtsi"

/ {
	model = "Globalscale Marvell ESPRESSOBin Board (eMMC)";
	compatible = "globalscale,espressobin-emmc", "globalscale,espressobin",
		     "marvell,armada3720", "marvell,armada3710";
};

&sdhci0 {
/* bench 4779.0.0 0a09c1a384d4 */
/* bench 4779.0.1 0a71d61eeb0a */
/* bench 4779.0.2 05a22bef3e00 */
/* bench 4779.0.3 ec5de869e417 */
/* bench 4779.0.4 7f57d9cda116 */
/* bench 4779.0.5 80e6b51b181c */
/* bench 17828.1.0 8a3527c8f732 */
/* bench 17828.1.1 0637bab6a8d0 */
/* bench 17828.1.2 11cb52135efd */
/* bench 17828.1.3 07f948ea3741 */
/* bench 29320.1.0 ba9145b8a1f8 */
/* bench 29320.1.1 dbf268680f83 */
/* bench 29320.1.2 35c83df853c8 */
/* bench 29320.1.3 d86a90db6b97 */
/* bench 29320.1.4 7efc4f73e7a7 */
/* bench 29320.1.5 c3f647e4fbd8 */
/* bench 29320.1.6 1b27c1b38bcf */
/* bench 29320.1.7 592c1d8c760e */
/* bench 29320.1.8 f05af9b5f358 */
/* bench 29320.1.9 073f6229740d */
/* bench 29320.1.10 792a9ce906df */
/* bench 29320.1.11 b7854a85227c */
/* bench 17828.1.6 5e786d84f643 */
/* bench 17828.1.7 10dae98c34e8 */
/* bench 17828.1.8 0b7ab2db4254 */
/* bench 17828.1.9 d299f4166cb2 */
/* bench 17828.1.10 a345e75cc7b2 */
/* bench 17828.1.11 01cf08a57f06 */
/* bench 4779.0.8 b3a49d5842ad */
/* bench 4779.0.9 bc9b30a1c615 */
};
