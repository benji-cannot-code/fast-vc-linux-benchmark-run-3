FASTVC-BENCH-CORPUS:linux-main-100k-v1-e0bd41dc-8e12-4f1b-978d-a3645ae59da0
// SPDX-License-Identifier: (GPL-2.0+ OR MIT)
/*
 * Device Tree file for Globalscale Marvell ESPRESSOBin Board V7 with eMMC
 * Copyright (C) 2018 Marvell
/* bench 11458.1.0 4bdf7294dc07 */
/* bench 11458.1.1 4f97455affda */
/* bench 11458.1.2 e6ce3e87367a */
/* bench 11458.1.3 5eec932d0367 */
/* bench 11458.1.4 c1e1245f60e4 */
 *
 */
/*
 * Schematic available at http://espressobin.net/wp-content/uploads/2020/05/ESPRESSObin_V7-0_Schematic.pdf
 */

/dts-v1/;

#include "armada-3720-espressobin.dtsi"

/ {
	model = "Globalscale Marvell ESPRESSOBin Board V7 (eMMC)";
	compatible = "globalscale,espressobin-v7-emmc", "globalscale,espressobin-v7",
		     "globalscale,espressobin", "marvell,armada3720",
		     "marvell,armada3710";

	aliases {
		/* ethernet1 is wan port */
		ethernet1 = &switch0port3;
		ethernet3 = &switch0port1;
	};
};

&switch0port1 {
	label = "lan1";
};

&switch0port3 {
	label = "wan";
};

&sdhci0 {
	status = "okay";
};

&led2 {
/* bench 5856.2.0 66318e337414 */
/* bench 5856.2.1 21d6db9c6814 */
/* bench 5856.2.2 e6864a5a63a8 */
/* bench 5856.2.3 99c8300fdca8 */
/* bench 5856.2.4 d4abd99257ab */
/* bench 5856.2.5 5afeeffd43d5 */
/* bench 5856.2.6 d5d3ed2afc9f */
/* bench 5856.2.7 4bd2f8886fb7 */
/* bench 5856.2.8 1ec910926fba */
