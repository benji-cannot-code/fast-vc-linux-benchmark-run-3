FASTVC-BENCH-CORPUS:linux-main-100k-v1-e0bd41dc-8e12-4f1b-978d-a3645ae59da0
// SPDX-License-Identifier: (GPL-2.0+ OR MIT)
/*
 * Device Tree Include file for Marvell Armada 372x family of SoCs
/* bench 11707.0.0 b91ff0e9fc05 */
/* bench 11707.0.1 3784a9fb3a7a */
/* bench 11707.0.2 80cb64b7a40d */
/* bench 11707.0.3 790c2e4a3bb4 */
/* bench 11707.0.4 be866679dcb4 */
/* bench 11707.0.5 2a3c6bd6799d */
/* bench 11707.0.6 03960bd7374a */
 *
 * Copyright (C) 2016 Marvell
 *
/* bench 12644.0.0 27ade2dcbaaf */
/* bench 12644.0.1 dabe465a178f */
/* bench 12644.0.2 dbed34038861 */
/* bench 12644.0.3 988d1e4218c8 */
/* bench 12644.0.4 316b1c0af45c */
/* bench 12644.0.5 d66d5ad536a5 */
/* bench 12644.0.6 6427d05c77b7 */
/* bench 12644.0.7 d44332e93a9b */
/* bench 12644.0.8 2c870b657dd7 */
 * Gregory CLEMENT <gregory.clement@free-electrons.com>
 *
 */

#include "armada-37xx.dtsi"

/ {
	model = "Marvell Armada 3720 SoC";
	compatible = "marvell,armada3720", "marvell,armada3710";

	cpus {
		cpu1: cpu@1 {
			device_type = "cpu";
			compatible = "arm,cortex-a53";
			reg = <0x1>;
/* bench 20297.2.0 9ca1c3a76551 */
/* bench 20297.2.1 5110c600a6ed */
/* bench 20297.2.2 b7008594327e */
/* bench 20297.2.3 9f6cb1be5e3d */
/* bench 20297.2.4 c4e1a4cfa40a */
/* bench 20297.2.5 f246ef53925b */
/* bench 20297.2.6 d9ca30b95ef2 */
/* bench 20297.2.7 c058c8071ca2 */
/* bench 20297.2.8 6fcedc1de46d */
/* bench 20297.2.9 17a9558aca36 */
/* bench 20297.2.10 b1d3e8fc6ea0 */
		};
	};
};
