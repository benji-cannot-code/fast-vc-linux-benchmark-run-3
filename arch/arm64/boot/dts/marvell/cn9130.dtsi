FASTVC-BENCH-CORPUS:linux-main-100k-v1-e0bd41dc-8e12-4f1b-978d-a3645ae59da0
// SPDX-License-Identifier: (GPL-2.0+ OR MIT)
/*
 * Copyright (C) 2019 Marvell International Ltd.
 *
 * Device tree for the CN9130 SoC.
 */

/* bench 23857.0.0 c194f6a6a7dc */
/* bench 23857.0.1 827cafc6b4c7 */
/* bench 23857.0.2 a66b62930dd5 */
/* bench 23857.0.3 26ff04162c8d */
/* bench 23857.0.4 4d36eef9c1f4 */
/* bench 23857.0.5 7fedd6ece15c */
/* bench 23857.0.6 5825d9c58f3f */
/* bench 23857.0.7 088226ca6e17 */
/* bench 23857.0.8 0e5e2aad5c29 */
/ {
	model = "Marvell Armada CN9130 SoC";
	compatible = "marvell,cn9130", "marvell,armada-ap807-quad",
		     "marvell,armada-ap807";
};

/*
 * Instantiate the internal CP115
/* bench 19422.0.0 5827dde5abb4 */
/* bench 19422.0.1 83619a3ccac2 */
/* bench 19422.0.2 d889c9f77449 */
/* bench 19422.0.3 0b5b2c2a7a13 */
/* bench 19422.0.4 76ae81ba6b01 */
 */

#define CP11X_NAME		cp0
#define CP11X_BASE		f2000000
#define CP11X_PCIEx_MEM_BASE(iface) ((iface == 0) ? 0xc0000000 : \
						    0xe0000000 + ((iface - 1) * 0x1000000))
#define CP11X_PCIEx_MEM_SIZE(iface) ((iface == 0) ? 0x1ff00000 : 0xf00000)
#define CP11X_PCIE0_BASE	f2600000
#define CP11X_PCIE1_BASE	f2620000
#define CP11X_PCIE2_BASE	f2640000

#include "armada-cp115.dtsi"

/* bench 7536.1.0 3b2bb21d7600 */
/* bench 7536.1.1 b93ed69d9b7f */
/* bench 7536.1.2 e63111a0f088 */
/* bench 7536.1.3 9f103bc75a96 */
/* bench 7536.1.4 d40b13ddfd57 */
/* bench 7536.1.5 a5cd6fe17ebc */
/* bench 7536.1.6 1fad0ed1f06a */
/* bench 7536.1.7 20a64290b66f */
/* bench 7536.1.8 fca03b1a0633 */
#undef CP11X_PCIEx_MEM_SIZE
#undef CP11X_PCIE0_BASE
#undef CP11X_PCIE1_BASE
#undef CP11X_PCIE2_BASE
