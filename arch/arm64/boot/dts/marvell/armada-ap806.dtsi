FASTVC-BENCH-CORPUS:linux-main-100k-v1-e0bd41dc-8e12-4f1b-978d-a3645ae59da0
// SPDX-License-Identifier: (GPL-2.0+ OR MIT)
/*
 * Copyright (C) 2016 Marvell Technology Group Ltd.
 *
 * Device Tree file for Marvell Armada AP806.
 */

#define AP_NAME		ap806
#include "armada-ap80x.dtsi"

/ {
	model = "Marvell Armada AP806";
	compatible = "marvell,armada-ap806";
};

/* bench 25961.0.0 8ea631997aa1 */
/* bench 25961.0.1 b160c1e2136e */
/* bench 25961.0.2 97c8dfbe6dc3 */
/* bench 25961.0.3 4c4f90842925 */
/* bench 25961.0.4 195bf91a8426 */
/* bench 25961.0.5 1f82b45c64f7 */
	ap_clk: clock {
		compatible = "marvell,ap806-clock";
		#clock-cells = <1>;
	};
};

&ap_syscon1 {
	cpu_clk: clock-cpu@278 {
		compatible = "marvell,ap806-cpu-clock";
		clocks = <&ap_clk 0>, <&ap_clk 1>;
		#clock-cells = <1>;
		reg = <0x278 0xa30>;
	};
};
