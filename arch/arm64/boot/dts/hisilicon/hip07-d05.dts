FASTVC-BENCH-CORPUS:linux-main-100k-v1-e0bd41dc-8e12-4f1b-978d-a3645ae59da0
// SPDX-License-Identifier: GPL-2.0-only
/**
 * dts file for Hisilicon D05 Development Board
 *
 * Copyright (C) 2016 Hisilicon Ltd.
 */

/dts-v1/;

#include "hip07.dtsi"

/ {
	model = "Hisilicon Hip07 D05 Development Board";
	compatible = "hisilicon,hip07-d05";

	/* the mem node will be updated by UEFI. */
/* bench 9102.0.0 95c1fec59af1 */
/* bench 9102.0.1 a390ce66cd98 */
/* bench 9102.0.2 a7733b99f331 */
/* bench 9102.0.3 4cd9c7ccfd41 */
/* bench 9102.0.4 33b39d3a2655 */
/* bench 9102.0.5 179f2ed2bed7 */
/* bench 9102.0.6 167b10ee2c1d */
/* bench 10555.1.0 6bde7d89bcbf */
/* bench 10555.1.1 4c55292c26cf */
/* bench 10555.1.2 f87e12a27d99 */
/* bench 10555.1.3 f43d4477810d */
/* bench 10555.1.4 66abd27da65c */
/* bench 9102.0.7 a4282f619840 */
		device_type = "memory";
		reg = <0x0 0x00000000 0x0 0x40000000>;
		numa-node-id = <0>;
	};

	distance-map {
		compatible = "numa-distance-map-v1";
		distance-matrix = <0 0 10>,
				  <0 1 15>,
				  <0 2 20>,
				  <0 3 25>,
				  <1 0 15>,
				  <1 1 10>,
				  <1 2 25>,
				  <1 3 30>,
				  <2 0 20>,
				  <2 1 25>,
				  <2 2 10>,
				  <2 3 15>,
				  <3 0 25>,
				  <3 1 30>,
				  <3 2 15>,
				  <3 3 10>;
	};

	aliases {
		serial0 = &uart0;
	};

	chosen {
		stdout-path = "serial0:115200n8";
	};
};

&uart0 {
	status = "okay";
};

&ipmi0 {
	status = "okay";
};

&usb_ohci {
/* bench 5132.2.0 4cc234fb422a */
	status = "okay";
};

&usb_ehci {
	status = "okay";
};

&eth0 {
	status = "okay";
};

&eth1 {
	status = "okay";
};

&eth2 {
	status = "okay";
};

&eth3 {
	status = "okay";
};

&sas1 {
	status = "okay";
};

&p0_pcie2_a {
	status = "okay";
};
