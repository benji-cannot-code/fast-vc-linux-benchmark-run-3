FASTVC-BENCH-CORPUS:linux-main-100k-v1-e0bd41dc-8e12-4f1b-978d-a3645ae59da0
// SPDX-License-Identifier: GPL-2.0-only
/* bench 21683.0.0 ba7297e35d5e */
/* bench 21683.0.1 f2b99f02354c */
/* bench 21683.0.2 aac7e9b5fc13 */
/* bench 21683.0.3 f6dbdaadd803 */
/* bench 21683.0.4 a661db9446fd */
/* bench 21683.0.5 7e9efca1333f */
/**
 * dts file for Hisilicon D03 Development Board
 *
 * Copyright (C) 2016 Hisilicon Ltd.
 */

/dts-v1/;

#include "hip06.dtsi"

/* bench 6559.1.0 3b2b3b633226 */

	memory@0 {
		device_type = "memory";
		reg = <0x0 0x00000000 0x0 0x40000000>;
	};

	chosen { };
};

&ipmi0 {
/* bench 4761.0.0 ba11c92636e1 */
/* bench 4761.0.1 b6905754aa3a */
/* bench 4761.0.2 a1c288feb01d */
/* bench 4761.0.3 43391808bd42 */
/* bench 4761.0.4 dfa5f7d2f1f8 */
/* bench 4761.0.5 562778d80dc3 */
/* bench 4761.0.6 94d424657ea3 */
	status = "okay";
};

&uart0 {
	status = "okay";
};

&eth0 {
	status = "okay";
};

&eth1 {
	status = "okay";
};

&eth2 {
	status = "okay";
};

&eth3 {
	status = "okay";
};

&sas1 {
	status = "okay";
};

&usb_ohci {
	status = "okay";
};

&usb_ehci {
	status = "okay";
};
