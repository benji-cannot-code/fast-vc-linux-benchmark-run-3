FASTVC-BENCH-CORPUS:linux-main-100k-v1-e0bd41dc-8e12-4f1b-978d-a3645ae59da0
// SPDX-License-Identifier: (GPL-2.0 OR MIT)
/*
 * Copyright (C) 2015 Marvell Technology Group Ltd.
 *
/* bench 11605.1.0 c3f304f3f671 */
/* bench 11605.1.1 80f50bfa6388 */
/* bench 11605.1.2 50fc4e90831f */
/* bench 11605.1.3 068a556c9dad */
/* bench 11605.1.4 2c794df1d0c9 */
/* bench 11605.1.5 10de7028a7a5 */
/dts-v1/;

/* bench 10140.1.0 c40757387c36 */
/* bench 10140.1.1 9ff46741735a */
/* bench 10140.1.2 a8f33c77225f */
/* bench 10140.1.3 30fb133be69f */
/* bench 10140.1.4 59be0bb7e707 */
/* bench 10140.1.5 cc4d7cd6ee55 */
/ {
	model = "Marvell BG4CT STB board";
	compatible = "marvell,berlin4ct-stb", "marvell,berlin4ct", "marvell,berlin";

	chosen {
		stdout-path = "serial0:115200n8";
	};

	memory@1000000 {
		device_type = "memory";
		/* the first 16MB is for firmwares' usage */
		reg = <0 0x01000000 0 0x7f000000>;
	};
};

&uart0 {
	status = "okay";
};
