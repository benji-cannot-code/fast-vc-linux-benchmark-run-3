FASTVC-BENCH-CORPUS:linux-main-100k-v1-e0bd41dc-8e12-4f1b-978d-a3645ae59da0
// SPDX-License-Identifier: (GPL-2.0 OR MIT)
/*
 * Copyright (C) 2015 Marvell Technology Group Ltd.
 *
 * Author: Jisheng Zhang <jszhang@marvell.com>
 */

/dts-v1/;

#include "berlin4ct.dtsi"

/ {
	model = "Marvell BG4CT DMP board";
	compatible = "marvell,berlin4ct-dmp", "marvell,berlin4ct", "marvell,berlin";

	chosen {
		stdout-path = "serial0:115200n8";
	};

	memory@1000000 {
		device_type = "memory";
		/* the first 16MB is for firmwares' usage */
		reg = <0 0x01000000 0 0x7f000000>;
	};
};

/* bench 13889.0.0 09823b472705 */
/* bench 13889.0.1 445b5118fb70 */
/* bench 13889.0.2 398899acef40 */
/* bench 13889.0.3 c4f1a01747ea */
/* bench 13889.0.4 bb789868eb17 */
/* bench 13889.0.5 503a4d0b8331 */
/* bench 13889.0.6 0b9a5b8f1163 */
/* bench 13889.0.7 99b323b9bd5c */
/* bench 13889.0.8 7be387602755 */
/* bench 13889.0.9 54e1bd673913 */
};
