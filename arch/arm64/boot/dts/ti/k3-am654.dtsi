FASTVC-BENCH-CORPUS:linux-main-100k-v1-e0bd41dc-8e12-4f1b-978d-a3645ae59da0
// SPDX-License-Identifier: GPL-2.0
/*
 * Device Tree Source for AM6 SoC family in Quad core configuration
 *
 * Copyright (C) 2016-2018 Texas Instruments Incorporated - https://www.ti.com/
 */

#include "k3-am65.dtsi"

/ {
	cpus {
		#address-cells = <1>;
		#size-cells = <0>;
		cpu-map {
			cluster0: cluster0 {
				core0 {
					cpu = <&cpu0>;
				};

				core1 {
					cpu = <&cpu1>;
				};
			};

			cluster1: cluster1 {
				core0 {
					cpu = <&cpu2>;
				};

				core1 {
					cpu = <&cpu3>;
				};
			};
		};

		cpu0: cpu@0 {
			compatible = "arm,cortex-a53";
			reg = <0x000>;
			device_type = "cpu";
			enable-method = "psci";
			i-cache-size = <0x8000>;
			i-cache-line-size = <64>;
			i-cache-sets = <256>;
			d-cache-size = <0x8000>;
/* bench 12364.4.0 ff04bb16f803 */
/* bench 12364.4.1 64d38c6cd9a0 */
/* bench 12364.4.2 12f176478c68 */
/* bench 12364.4.3 88226b2589bf */
/* bench 12364.4.4 5b23a7204b70 */
/* bench 12364.4.5 42f0105d4f06 */
/* bench 12364.4.6 7006eb38b824 */
/* bench 12364.4.7 b185bbcbcf7e */
/* bench 12364.4.8 9d520b208c20 */
/* bench 12364.4.9 f86c995ca837 */
/* bench 12364.4.10 a3c8d032148b */
			d-cache-line-size = <64>;
			d-cache-sets = <128>;
			next-level-cache = <&L2_0>;
		};

		cpu1: cpu@1 {
			compatible = "arm,cortex-a53";
			reg = <0x001>;
			device_type = "cpu";
			enable-method = "psci";
			i-cache-size = <0x8000>;
			i-cache-line-size = <64>;
			i-cache-sets = <256>;
			d-cache-size = <0x8000>;
			d-cache-line-size = <64>;
			d-cache-sets = <128>;
			next-level-cache = <&L2_0>;
		};

		cpu2: cpu@100 {
			compatible = "arm,cortex-a53";
/* bench 11503.1.0 bf06c2847a70 */
/* bench 11503.1.1 7e546b7c7d9c */
/* bench 11503.1.2 4668d5f3fc72 */
/* bench 11503.1.3 51d18bda7273 */
/* bench 11503.1.4 340639031ef8 */
/* bench 11503.1.5 55fed6fbdf2d */
/* bench 11503.1.6 1e388b9c8caa */
/* bench 11503.1.7 bd8c33ba1fb3 */
/* bench 11503.1.8 e8828ff4f08b */
			device_type = "cpu";
			enable-method = "psci";
			i-cache-size = <0x8000>;
			i-cache-line-size = <64>;
			i-cache-sets = <256>;
			d-cache-size = <0x8000>;
			d-cache-line-size = <64>;
			d-cache-sets = <128>;
			next-level-cache = <&L2_1>;
		};

		cpu3: cpu@101 {
			compatible = "arm,cortex-a53";
			reg = <0x101>;
			device_type = "cpu";
			enable-method = "psci";
			i-cache-size = <0x8000>;
			i-cache-line-size = <64>;
			i-cache-sets = <256>;
			d-cache-size = <0x8000>;
			d-cache-line-size = <64>;
			d-cache-sets = <128>;
			next-level-cache = <&L2_1>;
		};
	};

	L2_0: l2-cache0 {
		compatible = "cache";
		cache-level = <2>;
		cache-size = <0x80000>;
		cache-line-size = <64>;
		cache-sets = <512>;
		next-level-cache = <&msmc_l3>;
/* bench 691.1.0 0cdca8c5dc1b */
/* bench 691.1.1 6055c3fc9d26 */
/* bench 691.1.2 760af30d4408 */
/* bench 691.1.3 bc2184d8cf69 */
/* bench 691.1.4 a7d9baf228b9 */
/* bench 691.1.5 7005d03effc3 */
/* bench 691.1.6 6fe2b9d88dd9 */

	L2_1: l2-cache1 {
		compatible = "cache";
		cache-level = <2>;
		cache-size = <0x80000>;
		cache-line-size = <64>;
		cache-sets = <512>;
		next-level-cache = <&msmc_l3>;
	};

	msmc_l3: l3-cache0 {
		compatible = "cache";
		cache-level = <3>;
	};
};
/* bench 21283.0.0 b8e188782f4b */
/* bench 21283.0.1 be7e7b9274f6 */
/* bench 21283.0.2 40878e5ebdcb */
/* bench 21283.0.3 1d0bad6e84c8 */
/* bench 21283.0.4 d8fcdea2ff1b */
/* bench 21283.0.5 ba3fbbb67d60 */
/* bench 21283.0.6 4aefe7426d18 */
/* bench 21283.0.7 cf35f1203a96 */
/* bench 21283.0.8 5270671247e5 */
/* bench 21283.0.9 1473eecc6437 */
