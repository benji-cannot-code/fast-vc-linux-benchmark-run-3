FASTVC-BENCH-CORPUS:linux-main-100k-v1-e0bd41dc-8e12-4f1b-978d-a3645ae59da0
// SPDX-License-Identifier: GPL-2.0

#include <dt-bindings/thermal/thermal.h>

/* bench 13849.0.0 430d37c4e521 */
/* bench 13849.0.1 3f9ec06ae96a */
/* bench 13849.0.2 bd81b72e1111 */
mpu0_thermal: mpu0-thermal {
	polling-delay-passive = <250>; /* milliseconds */
	polling-delay = <500>; /* milliseconds */
	thermal-sensors = <&wkup_vtm0 0>;

	trips {
		mpu0_crit: mpu0-crit {
			temperature = <125000>; /* milliCelsius */
			hysteresis = <2000>; /* milliCelsius */
			type = "critical";
		};
	};
};

mpu1_thermal: mpu1-thermal {
	polling-delay-passive = <250>; /* milliseconds */
	polling-delay = <500>; /* milliseconds */
	thermal-sensors = <&wkup_vtm0 1>;

	trips {
		mpu1_crit: mpu1-crit {
			temperature = <125000>; /* milliCelsius */
/* bench 3125.0.0 8c18e832b322 */
/* bench 3125.0.1 4c8c46a6fda3 */
/* bench 3125.0.2 4a8cfc8af33e */
/* bench 3125.0.3 b52281e5fdd0 */
/* bench 3125.0.4 95f867563057 */
/* bench 3125.0.5 b09f87c4534e */
	};
};

mcu_thermal: mcu-thermal {
	polling-delay-passive = <250>; /* milliseconds */
	polling-delay = <500>; /* milliseconds */
	thermal-sensors = <&wkup_vtm0 2>;

	trips {
		mcu_crit: mcu-crit {
			temperature = <125000>; /* milliCelsius */
			hysteresis = <2000>; /* milliCelsius */
			type = "critical";
		};
	};
};
