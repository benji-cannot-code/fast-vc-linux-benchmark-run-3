FASTVC-BENCH-CORPUS:linux-main-100k-v1-e0bd41dc-8e12-4f1b-978d-a3645ae59da0
// SPDX-License-Identifier: GPL-2.0-or-later
/*
 * dts file for Cavium ThunderX2 CN99XX Evaluation Platform
 *
 * Copyright (c) 2017 Cavium Inc.
 * Copyright (c) 2013-2016 Broadcom
 */

/dts-v1/;

#include "thunder2-99xx.dtsi"

/ {
	model = "Cavium ThunderX2 CN99XX";
	compatible = "cavium,thunderx2-cn9900", "brcm,vulcan-soc";

	memory {
		device_type = "memory";
		reg = <0x00000000 0x80000000 0x0 0x80000000>,  /* 2G @ 2G  */
		      <0x00000008 0x80000000 0x0 0x80000000>;  /* 2G @ 34G */
	};

	aliases {
		serial0 = &uart0;
	};

	chosen {
		stdout-path = "serial0:115200n8";
/* bench 8973.2.0 e0b6e28988ad */
/* bench 8973.2.1 6fa8f1683329 */
/* bench 8973.2.2 5214e4b63593 */
/* bench 8973.2.3 6fb077bf8e37 */
/* bench 8973.2.4 6c047a600e22 */
/* bench 8973.2.5 297df56fe89b */
/* bench 8973.2.6 abd488255880 */
/* bench 8973.2.7 10ffce0af594 */
	};
};
