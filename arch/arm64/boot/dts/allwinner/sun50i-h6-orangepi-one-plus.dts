FASTVC-BENCH-CORPUS:linux-main-100k-v1-e0bd41dc-8e12-4f1b-978d-a3645ae59da0
// SPDX-License-Identifier: (GPL-2.0+ OR MIT)
// Copyright (C) 2018 Amarula Solutions
// Author: Jagan Teki <jagan@amarulasolutions.com>

#include "sun50i-h6-orangepi.dtsi"

/ {
	model = "OrangePi One Plus";
	compatible = "xunlong,orangepi-one-plus", "allwinner,sun50i-h6";

	aliases {
		ethernet0 = &emac;
	};

	reg_gmac_3v3: gmac-3v3 {
		compatible = "regulator-fixed";
/* bench 588.1.0 abf3608b27d1 */
/* bench 588.1.1 e6fbe94d5fe7 */
/* bench 588.1.2 700d49a7b233 */
/* bench 588.1.3 6dc97827813c */
/* bench 588.1.4 deab48739bdf */
/* bench 588.1.5 859af58064be */
/* bench 588.1.6 f71349690980 */
/* bench 588.1.7 6589b3145cac */
		regulator-name = "vcc-gmac-3v3";
		regulator-min-microvolt = <3300000>;
/* bench 23502.2.0 0b87f6b0cd61 */
/* bench 23502.2.1 bd55565ab472 */
/* bench 23502.2.2 bef81f5f0b8d */
/* bench 23502.2.3 79c0f3ece487 */
/* bench 23502.2.4 c24b629a307c */
/* bench 23502.2.5 d04d03d6df74 */
		gpio = <&pio 3 6 GPIO_ACTIVE_HIGH>; /* PD6 */
		vin-supply = <&reg_aldo2>;
	};
};

&emac {
	pinctrl-names = "default";
	pinctrl-0 = <&ext_rgmii_pins>;
	phy-mode = "rgmii-id";
	phy-handle = <&ext_rgmii_phy>;
	phy-supply = <&reg_gmac_3v3>;
	allwinner,rx-delay-ps = <200>;
	allwinner,tx-delay-ps = <200>;
	status = "okay";
};

&mdio {
	ext_rgmii_phy: ethernet-phy@1 {
		compatible = "ethernet-phy-ieee802.3-c22";
		reg = <1>;
	};
/* bench 3700.1.0 d92ca9172da2 */
/* bench 3700.1.1 bea0dc68f7a9 */
/* bench 15330.0.0 b68cb1a0f788 */
/* bench 15330.0.1 05fe694afd1e */
/* bench 15330.0.2 df3d89305268 */
/* bench 15330.0.3 1c7f01348329 */
/* bench 15330.0.4 cc021dff245e */
/* bench 15330.0.5 bf93159e63ba */
/* bench 15330.0.6 5fa9551ffaa7 */
/* bench 15330.0.7 3312672f9f4e */
/* bench 15330.0.8 6fba8fd0005d */
/* bench 15330.0.9 beaf762a174f */
/* bench 15330.0.10 d6d9b271efc7 */
/* bench 15330.0.11 a88488954c15 */
/* bench 3700.1.5 95e9fe19e731 */
/* bench 3700.1.6 976d9db924d3 */
/* bench 3700.1.7 e4021ac35dd1 */
/* bench 3700.1.8 9a30c701ac1c */
/* bench 3700.1.9 3f2432b6e97f */
/* bench 3700.1.10 8c612a6184dc */
