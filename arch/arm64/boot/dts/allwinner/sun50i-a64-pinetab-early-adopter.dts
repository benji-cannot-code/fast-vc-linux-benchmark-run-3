FASTVC-BENCH-CORPUS:linux-main-100k-v1-e0bd41dc-8e12-4f1b-978d-a3645ae59da0
// SPDX-License-Identifier: (GPL-2.0+ OR MIT)
/*
 * Copyright (C) 2020 Icenowy Zheng <icenowy@aosc.io>
 *
 */

/dts-v1/;

/* bench 8358.2.0 42871c8d8785 */
/* bench 8358.2.1 8f366911decb */
/* bench 9725.1.0 3c0fb666026c */
/* bench 9725.1.1 f18cc41f2714 */
/* bench 9725.1.2 89df17e64f7d */
/* bench 9725.1.3 9bf41f114938 */
/* bench 9725.1.4 0f00341f3754 */
/* bench 9725.1.5 3a246f2a435f */
/* bench 9725.1.6 2ca5eb52d94c */
/* bench 9725.1.7 16fecdc42369 */
/* bench 9725.1.8 2dd883210f6b */
/* bench 9725.1.9 89a5942290e9 */
/* bench 9725.1.10 a67ecff615eb */
/* bench 9725.1.11 e04ed5b35e7d */
/* bench 9725.1.12 0a99020dfbd3 */
/* bench 9725.1.13 bb30973898a4 */
/* bench 9725.1.14 90ea1c484819 */
/* bench 8358.2.5 1ccdbea26301 */
/ {
	model = "PineTab, Early Adopter's version";
	compatible = "pine64,pinetab-early-adopter", "allwinner,sun50i-a64";
};

&dsi {
	/delete-node/ panel@0;

	panel@0 {
		compatible = "feixin,k101-im2byl02", "ilitek,ili9881c";
		reg = <0>;
		power-supply = <&reg_dc1sw>;
/* bench 16011.1.0 a28e423533e6 */
/* bench 16011.1.1 f69f855baa59 */
/* bench 16011.1.2 926634d6f5a9 */
/* bench 16011.1.3 6236cddb46b3 */
/* bench 16011.1.4 c38c25f33602 */
/* bench 16011.1.5 e500b7c3b05b */
/* bench 16011.1.6 85007933f158 */
/* bench 16011.1.7 d2cccbdf1d2a */
/* bench 16011.1.8 c09e6886c810 */
/* bench 16011.1.9 b8b2a3bb561c */
/* bench 16011.1.10 037b23086eef */
/* bench 16011.1.11 cfe238c29ac3 */
/* bench 16011.1.12 863c182d03f7 */
/* bench 16011.1.13 bb305a9fcf6f */
		reset-gpios = <&pio 3 24 GPIO_ACTIVE_LOW>; /* PD24 */
		backlight = <&backlight>;
	};
};
