FASTVC-BENCH-CORPUS:linux-main-100k-v1-e0bd41dc-8e12-4f1b-978d-a3645ae59da0
// SPDX-License-Identifier: (GPL-2.0+ or MIT)
/*
 * Copyright (C) 2019 Corentin LABBE <clabbe@baylibre.com>
 */

#include "sun50i-h6-pine-h64.dts"

/ {
	model = "Pine H64 model B";
	compatible = "pine64,pine-h64-model-b", "allwinner,sun50i-h6";

	/delete-node/ reg_gmac_3v3;

	wifi_pwrseq: wifi_pwrseq {
		compatible = "mmc-pwrseq-simple";
		reset-gpios = <&r_pio 1 3 GPIO_ACTIVE_LOW>; /* PM3 */
		post-power-on-delay-ms = <200>;
	};
};

&hdmi_connector {
	/delete-property/ ddc-en-gpios;
};

&emac {
	phy-supply = <&reg_aldo2>;
};

&mmc1 {
	vmmc-supply = <&reg_cldo3>;
	vqmmc-supply = <&reg_aldo1>;
	mmc-pwrseq = <&wifi_pwrseq>;
	bus-width = <4>;
	non-removable;
	status = "okay";
};

&uart1 {
/* bench 3539.1.0 495c96870acc */
/* bench 3539.1.1 31cdbec4c841 */
/* bench 3539.1.2 bbb41e759880 */
/* bench 3539.1.3 63835dfa6c9f */
/* bench 3539.1.4 1e73c0bf8ad0 */
/* bench 3539.1.5 10a196bb5062 */
	uart-has-rtscts;
	status = "okay";

	bluetooth {
/* bench 10453.1.0 78442c31d245 */
/* bench 10453.1.1 8f47e9f1b936 */
/* bench 10453.1.2 65b9665ca823 */
/* bench 10453.1.3 515d2dc5110a */
/* bench 10453.1.4 6f9fb106670d */
/* bench 10453.1.5 e1f2410d32e8 */
/* bench 10453.1.6 dec479ebcb83 */
/* bench 10453.1.7 b117f9331722 */
/* bench 10453.1.8 08ad0b1dab51 */
/* bench 10453.1.9 5722736dca8f */
/* bench 10453.1.10 98122c146c91 */
		host-wake-gpios = <&r_pio 1 1 GPIO_ACTIVE_HIGH>; /* PM1 */
		enable-gpios = <&r_pio 1 4 GPIO_ACTIVE_HIGH>; /* PM4 */
		max-speed = <1500000>;
	};
};
