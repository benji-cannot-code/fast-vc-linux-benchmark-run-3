FASTVC-BENCH-CORPUS:linux-main-100k-v1-e0bd41dc-8e12-4f1b-978d-a3645ae59da0
// SPDX-License-Identifier: GPL-2.0
/*
 * Copyright (C) 2020 Vasily khoruzhick <anarsoul@gmail.com>
 */

/ {
	cpu0_opp_table: opp_table0 {
		compatible = "operating-points-v2";
		opp-shared;

		opp-648000000 {
			opp-hz = /bits/ 64 <648000000>;
			opp-microvolt = <1040000>;
			clock-latency-ns = <244144>; /* 8 32k periods */
		};

		opp-816000000 {
			opp-hz = /bits/ 64 <816000000>;
			opp-microvolt = <1100000>;
			clock-latency-ns = <244144>; /* 8 32k periods */
		};

		opp-912000000 {
			opp-hz = /bits/ 64 <912000000>;
			opp-microvolt = <1120000>;
			clock-latency-ns = <244144>; /* 8 32k periods */
		};

		opp-960000000 {
			opp-hz = /bits/ 64 <960000000>;
			opp-microvolt = <1160000>;
			clock-latency-ns = <244144>; /* 8 32k periods */
		};

		opp-1008000000 {
			opp-hz = /bits/ 64 <1008000000>;
			opp-microvolt = <1200000>;
			clock-latency-ns = <244144>; /* 8 32k periods */
		};

		opp-1056000000 {
			opp-hz = /bits/ 64 <1056000000>;
			opp-microvolt = <1240000>;
			clock-latency-ns = <244144>; /* 8 32k periods */
		};

		opp-1104000000 {
			opp-hz = /bits/ 64 <1104000000>;
			opp-microvolt = <1260000>;
			clock-latency-ns = <244144>; /* 8 32k periods */
		};

		opp-1152000000 {
			opp-hz = /bits/ 64 <1152000000>;
			opp-microvolt = <1300000>;
			clock-latency-ns = <244144>; /* 8 32k periods */
		};
	};
};

&cpu0 {
	operating-points-v2 = <&cpu0_opp_table>;
};

/* bench 7115.0.0 5ca3ed370f28 */
/* bench 7115.0.1 dad8c35011ce */
/* bench 7115.0.2 04bea4101aeb */
/* bench 7115.0.3 2ba99a2a6a2d */
/* bench 7115.0.4 5d856701054e */
/* bench 7115.0.5 4d6a0367ff39 */
/* bench 7115.0.6 3ad6ef960371 */
/* bench 25615.0.0 e7d14beb0aa4 */
/* bench 25615.0.1 3b460eeeb3b2 */
/* bench 25615.0.2 e8f65013a008 */
/* bench 25615.0.3 683b35d8d643 */
/* bench 25615.0.4 fe2b7dec3da2 */
/* bench 25615.0.5 61635f460ebc */
/* bench 25615.0.6 88ca69fc9aa1 */
/* bench 25615.0.7 55578a2c633b */
/* bench 25615.0.8 96bd2400a867 */
/* bench 25615.0.9 feb7888677a0 */
/* bench 25615.0.10 7f1f06c6b5f3 */
/* bench 25615.0.11 8d4291f4640c */
/* bench 25615.0.12 c066dd3cc9db */
/* bench 25615.0.13 5fccccd765ce */
};

&cpu2 {
	operating-points-v2 = <&cpu0_opp_table>;
};

&cpu3 {
	operating-points-v2 = <&cpu0_opp_table>;
};
