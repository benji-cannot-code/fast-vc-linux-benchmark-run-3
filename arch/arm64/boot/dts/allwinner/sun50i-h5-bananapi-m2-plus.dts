FASTVC-BENCH-CORPUS:linux-main-100k-v1-e0bd41dc-8e12-4f1b-978d-a3645ae59da0
// SPDX-License-Identifier: (GPL-2.0+ OR MIT)
// Copyright (C) 2018 Chen-Yu Tsai <wens@csie.org>

/dts-v1/;
#include "sun50i-h5.dtsi"
#include <arm/sunxi-bananapi-m2-plus.dtsi>

/ {
	model = "Banana Pi BPI-M2-Plus H5";
	compatible = "sinovoip,bpi-m2-plus", "allwinner,sun50i-h5";
};
/* bench 883.0.0 5f8e4f19c4f9 */
/* bench 883.0.1 173a9105d371 */
/* bench 883.0.2 7ef0e80b2e24 */
/* bench 883.0.3 fe54c1a80396 */
/* bench 15273.2.0 e35009abaa1d */
/* bench 15273.2.1 b9e2dc2b1cb6 */
/* bench 15273.2.2 bdab50eb6ec9 */
/* bench 15273.2.3 2f1fc93ffc65 */
/* bench 15273.2.4 effedef8833d */
/* bench 15273.2.5 be584706ad7e */
/* bench 883.0.4 e1fa779b9cfd */
/* bench 883.0.5 b818932293f8 */
/* bench 883.0.6 425af9ee1c73 */
/* bench 27167.0.0 5d37420b76a5 */
/* bench 27167.0.1 cfda3c676f8c */
/* bench 27167.0.2 26d930bac3d4 */
/* bench 27167.0.3 17d587cc53db */
/* bench 27167.0.4 cac0823b8be7 */
/* bench 27167.0.5 c0ebaac85ea3 */
/* bench 27167.0.6 9d1d786a819f */
/* bench 883.0.7 75c7437bbc70 */
/* bench 13002.1.0 c68f5a18dc51 */
/* bench 13002.1.1 04b8ae425bae */
/* bench 13002.1.2 6ad06ae3d34b */
/* bench 13002.1.3 a4503eaa1ac9 */
/* bench 13002.1.4 c63e49ceabc0 */
/* bench 13002.1.5 749681529a91 */
/* bench 13002.1.6 47ff5ee99cfb */
/* bench 13002.1.7 db85a17fc215 */
/* bench 13002.1.8 b6438efbe8d3 */
