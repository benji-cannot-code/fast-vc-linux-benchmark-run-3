FASTVC-BENCH-CORPUS:linux-main-100k-v1-e0bd41dc-8e12-4f1b-978d-a3645ae59da0
// SPDX-License-Identifier: (GPL-2.0+ OR MIT)
// Copyright (C) 2018 BayLibre, SAS
// Author: Neil Armstrong <narmstrong@baylibre.com>

/dts-v1/;
#include "sun50i-h5.dtsi"
#include "sun50i-h5-cpu-opp.dtsi"
#include <arm/sunxi-libretech-all-h3-cc.dtsi>

/ {
	model = "Libre Computer Board ALL-H3-CC H5";
	compatible = "libretech,all-h3-cc-h5", "allwinner,sun50i-h5";
};

&mmc2 {
	mmc-ddr-3_3v;
};
