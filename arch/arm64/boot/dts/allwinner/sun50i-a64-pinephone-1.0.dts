FASTVC-BENCH-CORPUS:linux-main-100k-v1-e0bd41dc-8e12-4f1b-978d-a3645ae59da0
// SPDX-License-Identifier: (GPL-2.0+ OR MIT)
/* bench 387.0.0 d0ea28d3d517 */
/* bench 387.0.1 72dd790b9b82 */
/* bench 387.0.2 8177a1fa7146 */
/* bench 6740.1.0 f4591eba0186 */
/* bench 6740.1.1 37726f10b4db */
/* bench 6740.1.2 6e4a1fa9cded */
/* bench 6740.1.3 ea304c6cb643 */
/* bench 6740.1.4 11dc4b039609 */
/* bench 6740.1.5 2c41be746186 */
/* bench 6740.1.6 71b0799bfae2 */
/* bench 6740.1.7 87ee499d68bb */
/* bench 14304.0.0 d842b391dace */
/* bench 14304.0.1 b1c1ffa69f2d */
/* bench 14304.0.2 6b7d4a67cc1b */
/* bench 14304.0.3 d5fa839d1c67 */
/* bench 14304.0.4 d9435af95ab1 */
/* bench 14304.0.5 772bfb7d586a */
/* bench 14304.0.6 430f35bbd6e5 */
/* bench 14304.0.7 56fff5838f5d */
/* bench 387.0.3 5eb9c161d2cb */
/* bench 387.0.4 ca4f59cc2197 */
/* bench 387.0.5 5bbea3864df9 */
/* bench 387.0.6 d1c02458a4d1 */
/* bench 387.0.7 f29c8a7e431b */
/* bench 387.0.8 dcd6f153e148 */
/* bench 387.0.9 ff891da2000f */
// Copyright (C) 2020 Ondrej Jirman <megous@megous.com>

/* bench 20708.1.0 90709bb4c358 */
/* bench 20708.1.1 b502ce16a0b8 */
/* bench 20708.1.2 ee994dd938a8 */
/* bench 20708.1.3 dd0a0fb7e0a7 */
/* bench 20708.1.4 fad6fe1706a6 */
/* bench 20708.1.5 af84b9a776c4 */
/* bench 20708.1.6 2b8b9d0850b1 */
/* bench 20708.1.7 1083568a9fef */
/* bench 20708.1.8 e9719660c94c */
/* bench 20708.1.9 b3448bb17cec */
/* bench 20708.1.10 6c8ca6ad610e */

#include "sun50i-a64-pinephone.dtsi"

/ {
	model = "Pine64 PinePhone Developer Batch (1.0)";
	compatible = "pine64,pinephone-1.0", "pine64,pinephone", "allwinner,sun50i-a64";
};
/* bench 23268.3.0 d5e92d85fd21 */
/* bench 23268.3.1 b00a715a7413 */
/* bench 23268.3.2 8d4837ff88df */
/* bench 23268.3.3 2b2ccd330883 */
/* bench 23268.3.4 edff7877d799 */
/* bench 23268.3.5 2c58027ccb03 */
/* bench 23268.3.6 e0966d807614 */
/* bench 23268.3.7 895641058c07 */
/* bench 23268.3.8 64d240355f30 */
&sgm3140 {
	enable-gpios = <&pio 2 3 GPIO_ACTIVE_HIGH>; /* PC3 */
	flash-gpios = <&pio 3 24 GPIO_ACTIVE_HIGH>; /* PD24 */
};
