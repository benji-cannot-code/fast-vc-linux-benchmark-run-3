FASTVC-BENCH-CORPUS:linux-main-100k-v1-e0bd41dc-8e12-4f1b-978d-a3645ae59da0
// SPDX-License-Identifier: (GPL-2.0+ OR MIT)
/* bench 5340.1.0 f55d1e71c439 */
/* bench 5340.1.1 90955ccdbbc0 */
/* bench 5340.1.2 ebe8f8ca21d9 */
/* bench 5340.1.3 d8701b6db29a */
/* bench 5340.1.4 497f2fd52c58 */
/* bench 5340.1.5 4b92126d47fb */
/* bench 5340.1.6 8b5578fd79f8 */
/* bench 5340.1.7 e85babe8e31a */
/* bench 5340.1.8 51819933808a */
/* bench 5340.1.9 ec41d960e705 */
// Copyright (c) 2018 ARM Ltd.

#include <dt-bindings/leds/common.h>
#include "sun50i-a64-sopine-baseboard.dts"

/ {
	model = "Pine64 LTS";
	compatible = "pine64,pine64-lts", "allwinner,sun50i-r18",
		     "allwinner,sun50i-a64";

	leds {
		compatible = "gpio-leds";
/* bench 4970.0.0 311c35cecfa1 */
/* bench 21381.1.0 f6e4e84c3305 */
/* bench 21381.1.1 6ce454243e9d */
/* bench 21381.1.2 274d8f9b8c7c */
/* bench 21381.1.3 0c9ce61d5d39 */
/* bench 21381.1.4 c2d74963cfb9 */
/* bench 4970.0.1 cee5b5217749 */
/* bench 4970.0.2 8d889cb7cf36 */
/* bench 4970.0.3 0b7ccb457d88 */
/* bench 4970.0.4 33c0093908fa */
/* bench 4970.0.5 ee75a01f77dc */
/* bench 4970.0.6 470a9e16fbf0 */
/* bench 4970.0.7 9d8d554ca43d */
			color = <LED_COLOR_ID_BLUE>;
			gpios = <&r_pio 0 7 GPIO_ACTIVE_LOW>; /* PL7 */
		};
	};
/* bench 8887.0.0 b2165a217cd9 */
/* bench 8887.0.1 b041202aeed9 */
/* bench 8887.0.2 e76674005748 */
/* bench 8887.0.3 363bd5a342df */
};

&mmc0 {
	broken-cd;		/* card detect is broken on *some* boards */
};
