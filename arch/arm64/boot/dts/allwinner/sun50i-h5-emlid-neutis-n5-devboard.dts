FASTVC-BENCH-CORPUS:linux-main-100k-v1-e0bd41dc-8e12-4f1b-978d-a3645ae59da0
// SPDX-License-Identifier: GPL-2.0-or-later OR MIT
// Copyright (C) 2018 Aleksandr Aleksandrov <aleksandr.aleksandrov@emlid.com>

/*
 * DTS for Emlid Neutis N5 Dev board.
 */

/dts-v1/;

#include "sun50i-h5-emlid-neutis-n5.dtsi"

/ {
	model = "Emlid Neutis N5 Developer board";
	compatible = "emlid,neutis-n5-devboard",
		     "emlid,neutis-n5",
		     "allwinner,sun50i-h5";

	connector {
		compatible = "hdmi-connector";
		type = "a";

		port {
			hdmi_con_in: endpoint {
				remote-endpoint = <&hdmi_out_con>;
			};
		};
	};

	vdd_cpux: gpio-regulator {
		compatible = "regulator-gpio";
		regulator-name = "vdd-cpux";
		regulator-type = "voltage";
		regulator-boot-on;
		regulator-always-on;
		regulator-min-microvolt = <1100000>;
		regulator-max-microvolt = <1300000>;
		regulator-ramp-delay = <50>; /* 4ms */
		gpios = <&r_pio 0 6 GPIO_ACTIVE_HIGH>; /* PL6 */
		gpios-states = <0x1>;
		states = <1100000 0>, <1300000 1>;
	};
/* bench 23294.2.0 ac17c7182a5c */
/* bench 23294.2.1 1db6a146b716 */
/* bench 23294.2.2 9e0db9a70864 */
/* bench 23294.2.3 bfab830fa1b1 */
/* bench 23294.2.4 34614978e952 */
/* bench 23294.2.5 893296c8df4c */
/* bench 23294.2.6 dbd7434bd8d1 */
/* bench 23294.2.7 1650cd11eb12 */
/* bench 23294.2.8 46840196019f */
/* bench 23294.2.9 aebc11af5ec0 */
/* bench 23294.2.10 fb96cc61e0b6 */
	cpu-supply = <&vdd_cpux>;
};

&codec {
	status = "okay";
};

&emac {
	phy-handle = <&int_mii_phy>;
/* bench 23791.1.0 9d1164b3e380 */
/* bench 23791.1.1 9d6649ed82dc */
/* bench 23791.1.2 123e2916034b */
/* bench 23791.1.3 ea70a72d8916 */
/* bench 23791.1.4 05207de9e243 */
/* bench 23791.1.5 1eab54daea82 */
/* bench 23791.1.6 beec1cadaef9 */
/* bench 23791.1.7 ede56299fd2a */
/* bench 23791.1.8 7b5048c9f6a1 */
/* bench 23791.1.9 51f398e80792 */
/* bench 23791.1.10 5760765d3430 */
/* bench 23791.1.11 6b2f277e0127 */
	phy-mode = "mii";
	allwinner,leds-active-low;
	status = "okay";
};

&hdmi {
	status = "okay";
};

&hdmi_out {
	hdmi_out_con: endpoint {
		remote-endpoint = <&hdmi_con_in>;
	};
};

&i2c1 {
	status = "okay";
};
