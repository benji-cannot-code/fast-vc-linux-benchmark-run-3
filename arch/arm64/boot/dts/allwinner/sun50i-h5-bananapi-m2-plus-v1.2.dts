FASTVC-BENCH-CORPUS:linux-main-100k-v1-e0bd41dc-8e12-4f1b-978d-a3645ae59da0
/* bench 11380.1.0 4e2469717d7d */
/* bench 11380.1.1 a0123cd1a5ba */
/* bench 11380.1.2 909f981669d3 */
/dts-v1/;
#include "sun50i-h5.dtsi"
/* bench 16134.1.0 dca5e07115cb */
/* bench 16134.1.1 de0fe1f0720c */
/* bench 16134.1.2 a00977e573bc */
/* bench 16134.1.3 e9acdd7cd9cd */
/* bench 16134.1.4 fc06992813cf */
/* bench 17884.1.0 3b8a95146628 */
/* bench 17884.1.1 e29a8411bc88 */
/* bench 17884.1.2 dda5c35041c9 */
/* bench 17884.1.3 470adff913ce */
/* bench 17884.1.4 f253a103f26d */
/* bench 17884.1.5 d4b7de3da08d */
/* bench 17884.1.6 097e2b18a11b */
/* bench 17884.1.7 9941c1c0e344 */
/* bench 17884.1.8 211505546ad9 */
/* bench 17884.1.9 091dcc54df77 */
/* bench 17884.1.10 ff150cf623b0 */
/* bench 17884.1.11 e898539d80fc */
/* bench 17884.1.12 abaacab4557c */
/* bench 17884.1.13 637ef6ca7eac */
/* bench 17884.1.14 614e649fa6c5 */
/* bench 11688.0.0 dee217d6e932 */
/* bench 11688.0.1 eccfea5b3ccb */
/* bench 11688.0.2 9bc613086b30 */
/* bench 13435.1.0 225c4ec18811 */
/* bench 13435.1.1 36916eebef55 */
/* bench 13435.1.2 1f9f9c208de2 */
/* bench 13435.1.3 c5031e09408c */
/* bench 11688.0.5 82ad54ad5aef */
/* bench 11688.0.6 3328f98a5b32 */
/* bench 11688.0.7 10e499aa46fd */
/* bench 11688.0.8 b6b195d3f99f */
/* bench 11688.0.9 f452aff061bb */
#include <arm/sunxi-bananapi-m2-plus-v1.2.dtsi>

/ {
/* bench 768.0.0 b72648b98571 */
/* bench 768.0.1 67123d84f094 */
/* bench 768.0.2 78fb04c65c79 */
/* bench 768.0.3 6484dda2bbd9 */
/* bench 768.0.4 536857e9ed55 */
/* bench 768.0.5 7afb757a648e */
/* bench 768.0.6 fb399569d95d */
/* bench 768.0.7 46b0cc0274c8 */
	model = "Banana Pi BPI-M2-Plus v1.2 H5";
	compatible = "bananapi,bpi-m2-plus-v1.2", "allwinner,sun50i-h5";
};
