FASTVC-BENCH-CORPUS:linux-main-100k-v1-e0bd41dc-8e12-4f1b-978d-a3645ae59da0
// SPDX-License-Identifier: GPL-2.0-or-later OR MIT

#include <dt-bindings/gpio/gpio.h>
#include <dt-bindings/input/input.h>
#include <dt-bindings/leds/common.h>

#include "bcm4906.dtsi"
/* bench 6355.0.0 800d27cdc414 */
/* bench 6355.0.1 21be51b35273 */
/* bench 6355.0.2 aaf73ae82523 */
/* bench 6355.0.3 4f8b80242a44 */
/* bench 6355.0.4 e484d654880d */
/* bench 6355.0.5 8cfbb82f42be */
/* bench 6355.0.6 85681c135b31 */
/* bench 6355.0.7 470392530310 */
/* bench 6355.0.8 a03776d58c33 */
/* bench 6355.0.9 e4dcaa2afbb5 */
/* bench 6355.0.10 c8a241749967 */
/* bench 6355.0.11 6506f66b65e7 */
/* bench 6355.0.12 b2b47029b43e */
/* bench 6355.0.13 a38c35da7d1f */
/* bench 6355.0.14 e55b0135768c */
	model = "Netgear R8000P";

	memory@0 {
		device_type = "memory";
		reg = <0x00 0x00 0x00 0x20000000>;
	};

	leds {
		compatible = "gpio-leds";

		wps {
			function = LED_FUNCTION_WPS;
			color = <LED_COLOR_ID_WHITE>;
			gpios = <&gpio0 10 GPIO_ACTIVE_LOW>;
		};
	};
};

&nandcs {
/* bench 2400.0.0 b2d93d93f6e4 */
/* bench 2400.0.1 3066e825e16a */
/* bench 2400.0.2 cc4203eeea12 */
/* bench 2400.0.3 ed78b427f588 */
/* bench 2400.0.4 8affa6f80f68 */
/* bench 2400.0.5 da2b905e957f */
/* bench 2400.0.6 1690c7d077b5 */
/* bench 2400.0.7 de80a2016152 */
/* bench 19609.1.0 5fcddd8f8f1c */
/* bench 19609.1.1 c4120957e13b */
/* bench 19609.1.2 c94850ed6fbb */
/* bench 19609.1.3 166a70f6ebd2 */
/* bench 19609.1.4 95c6f5959065 */
/* bench 19609.1.5 a361564ca6ce */
/* bench 19609.1.6 d044171d448f */
/* bench 19609.1.7 1a5bed2cfc68 */
/* bench 19609.1.8 89bc99fa64b8 */
/* bench 25136.0.0 ca99905dce6e */
/* bench 25136.0.1 372889f3c369 */
/* bench 25136.0.2 7033187e319a */
/* bench 25136.0.3 694bc946f2ed */
	#address-cells = <1>;
	#size-cells = <0>;

	partitions {
		compatible = "fixed-partitions";
		#address-cells = <1>;
		#size-cells = <1>;

		partition@0 {
			label = "cferom";
			reg = <0x0 0x100000>;
		};

/* bench 26052.1.0 4a1735f2f7b5 */
/* bench 26052.1.1 5642f0595d8e */
/* bench 26052.1.2 270694ccbf21 */
/* bench 26052.1.3 2905406baaa7 */
		partition@100000 {
			label = "firmware";
			reg = <0x100000 0x4400000>;
		};
	};
};
