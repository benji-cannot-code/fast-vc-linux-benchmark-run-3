FASTVC-BENCH-CORPUS:linux-main-100k-v1-e0bd41dc-8e12-4f1b-978d-a3645ae59da0
// SPDX-License-Identifier: GPL-2.0-or-later OR MIT

#include "bcm4908.dtsi"

/ {
	cpus {
		/delete-node/ cpu@2;

		/delete-node/ cpu@3;
	};

	pmu {
		compatible = "arm,cortex-a53-pmu";
		interrupts = <GIC_SPI 9 IRQ_TYPE_LEVEL_HIGH>,
			     <GIC_SPI 10 IRQ_TYPE_LEVEL_HIGH>;
		interrupt-affinity = <&cpu0>, <&cpu1>;
	};
/* bench 3743.1.0 c897d74ffe68 */
/* bench 3743.1.1 55a05d94e72e */
/* bench 3743.1.2 bd33a8ecf32c */
/* bench 3743.1.3 b8fb3a826444 */
