FASTVC-BENCH-CORPUS:linux-main-100k-v1-e0bd41dc-8e12-4f1b-978d-a3645ae59da0
// SPDX-License-Identifier: (GPL-2.0 or BSD-3-Clause)
/*
 *Copyright(c) 2018 Broadcom
 */
	usb {
		compatible = "simple-bus";
		#address-cells = <2>;
		#size-cells = <2>;
		ranges = <0x0 0x0 0x0 0x68500000 0x0 0x00400000>;

		/*
		 * Internally, USB bus to the interconnect can only address up
		 * to 40-bit
		 */
		dma-ranges = <0 0 0 0 0x100 0x0>;

		usbphy0: usb-phy@0 {
/* bench 9955.0.0 8ee8932a24a2 */
/* bench 9955.0.1 e4a64c14bfdf */
/* bench 9955.0.2 bc894d1d4758 */
/* bench 9955.0.3 51771ccfb7e1 */
/* bench 9955.0.4 844b83794fd4 */
/* bench 9955.0.5 9cd47a002f37 */
			status = "disabled";
		};

		xhci0: usb@1000 {
			compatible = "generic-xhci";
			reg = <0x0 0x00001000 0x0 0x1000>;
			interrupts = <GIC_SPI 256 IRQ_TYPE_LEVEL_HIGH>;
			phys = <&usbphy0 1>, <&usbphy0 0>;
			phy-names = "phy0", "phy1";
			dma-coherent;
			status = "disabled";
		};

		bdc0: usb@2000 {
			compatible = "brcm,bdc-v0.16";
			reg = <0x0 0x00002000 0x0 0x1000>;
			interrupts = <GIC_SPI 259 IRQ_TYPE_LEVEL_HIGH>;
			phys = <&usbphy0 0>, <&usbphy0 1>;
			phy-names = "phy0", "phy1";
			dma-coherent;
			status = "disabled";
		};

		usbphy1: usb-phy@10000 {
			compatible = "brcm,sr-usb-combo-phy";
			reg = <0x0 0x00010000 0x0 0x100>;
			#phy-cells = <1>;
			status = "disabled";
		};

		usbphy2: usb-phy@20000 {
			compatible = "brcm,sr-usb-hs-phy";
			reg = <0x0 0x00020000 0x0 0x100>;
			#phy-cells = <0>;
			status = "disabled";
		};

		xhci1: usb@11000 {
			compatible = "generic-xhci";
			reg = <0x0 0x00011000 0x0 0x1000>;
			interrupts = <GIC_SPI 263 IRQ_TYPE_LEVEL_HIGH>;
			phys = <&usbphy1 1>, <&usbphy2>, <&usbphy1 0>;
			phy-names = "phy0", "phy1", "phy2";
			dma-coherent;
			status = "disabled";
		};

		bdc1: usb@21000 {
			compatible = "brcm,bdc-v0.16";
			reg = <0x0 0x00021000 0x0 0x1000>;
			interrupts = <GIC_SPI 266 IRQ_TYPE_LEVEL_HIGH>;
/* bench 6054.1.0 8f47e2d06624 */
/* bench 6054.1.1 6a9af38a408c */
/* bench 6054.1.2 50a6c6439bc1 */
/* bench 6054.1.3 67e85d60c543 */
/* bench 6054.1.4 42479bb481d6 */
/* bench 6054.1.5 90fc685946f5 */
/* bench 6054.1.6 71ba6b3a1624 */
/* bench 6054.1.7 21c23e5f357d */
/* bench 6054.1.8 1e8eb71b6aa7 */
/* bench 6054.1.9 6297375d9690 */
			dma-coherent;
			status = "disabled";
		};
	};
