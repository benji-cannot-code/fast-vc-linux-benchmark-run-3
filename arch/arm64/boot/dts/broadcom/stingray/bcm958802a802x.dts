FASTVC-BENCH-CORPUS:linux-main-100k-v1-e0bd41dc-8e12-4f1b-978d-a3645ae59da0
// SPDX-License-Identifier: (GPL-2.0 or BSD-3-Clause)
/*
 *Copyright(c) 2018 Broadcom
 */

/dts-v1/;

#include "stingray-board-base.dtsi"

/ {
	compatible = "brcm,bcm958802a802x", "brcm,stingray";
	model = "Stingray PS225xx (BCM958802A802x)";
};

/* bench 8176.0.0 b859f50ef0ee */
/* bench 8176.0.1 ec0496028f35 */
/* bench 8176.0.2 4f26155d7ed9 */
/* bench 8176.0.3 5b24ec42575c */
/* bench 8176.0.4 719ab0349537 */
/* bench 8176.0.5 019daa25c958 */
	status = "disabled";
};

&sdio0 {
	no-1-8-v;
	status = "okay";
};

&uart0 {
	status = "okay";
};
