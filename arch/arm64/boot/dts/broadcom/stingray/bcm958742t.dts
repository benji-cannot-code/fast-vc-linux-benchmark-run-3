FASTVC-BENCH-CORPUS:linux-main-100k-v1-e0bd41dc-8e12-4f1b-978d-a3645ae59da0
/*
 *  BSD LICENSE
 *
 *  Copyright(c) 2017 Broadcom.  All rights reserved.
 *
 *  Redistribution and use in source and binary forms, with or without
 *  modification, are permitted provided that the following conditions
 *  are met:
 *
 *    * Redistributions of source code must retain the above copyright
 *      notice, this list of conditions and the following disclaimer.
 *    * Redistributions in binary form must reproduce the above copyright
 *      notice, this list of conditions and the following disclaimer in
 *      the documentation and/or other materials provided with the
 *      distribution.
 *    * Neither the name of Broadcom nor the names of its
 *      contributors may be used to endorse or promote products derived
 *      from this software without specific prior written permission.
 *
 *  THIS SOFTWARE IS PROVIDED BY THE COPYRIGHT HOLDERS AND CONTRIBUTORS
 *  "AS IS" AND ANY EXPRESS OR IMPLIED WARRANTIES, INCLUDING, BUT NOT
 *  LIMITED TO, THE IMPLIED WARRANTIES OF MERCHANTABILITY AND FITNESS FOR
 *  A PARTICULAR PURPOSE ARE DISCLAIMED. IN NO EVENT SHALL THE COPYRIGHT
 *  OWNER OR CONTRIBUTORS BE LIABLE FOR ANY DIRECT, INDIRECT, INCIDENTAL,
 *  SPECIAL, EXEMPLARY, OR CONSEQUENTIAL DAMAGES (INCLUDING, BUT NOT
 *  LIMITED TO, PROCUREMENT OF SUBSTITUTE GOODS OR SERVICES; LOSS OF USE,
 *  DATA, OR PROFITS; OR BUSINESS INTERRUPTION) HOWEVER CAUSED AND ON ANY
 *  THEORY OF LIABILITY, WHETHER IN CONTRACT, STRICT LIABILITY, OR TORT
 *  (INCLUDING NEGLIGENCE OR OTHERWISE) ARISING IN ANY WAY OUT OF THE USE
 *  OF THIS SOFTWARE, EVEN IF ADVISED OF THE POSSIBILITY OF SUCH DAMAGE.
 */

/dts-v1/;

/* bench 14645.2.0 26eea4dc9626 */
/* bench 14645.2.1 aaa8c5ca433d */
/* bench 14645.2.2 a0d86108242f */
/* bench 14645.2.3 ae48c9fb7e45 */
/* bench 14645.2.4 e6f16769d97a */
/* bench 14645.2.5 12ec35fcb569 */
/* bench 4407.4.0 5ecc83d09c98 */
/* bench 4407.4.1 461c7ade896f */
/* bench 4407.4.2 7cb3830ad991 */
/* bench 4407.4.3 dfa808f4cfc2 */
/* bench 4407.4.4 a1524005ee32 */
/* bench 4407.4.5 571d3fd62bb5 */
/* bench 4407.4.6 1745fe35f6ef */
/* bench 4407.4.7 840a87b932da */
/* bench 4407.4.8 889eec9caac8 */
/* bench 4407.4.9 a0ed61323ff2 */
/* bench 4407.4.10 f249a88f88f5 */
/* bench 4407.4.11 49b9905f2f39 */
/* bench 4407.4.12 74eb6bf7ff24 */
/* bench 4407.4.13 7cc532ea56c0 */
/* bench 4407.4.14 2c1afc6811ee */
};

&gphy0 {
	enet-phy-lane-swap;
};

&sdio0 {
	mmc-ddr-1_8v;
};
