FASTVC-BENCH-CORPUS:linux-main-100k-v1-e0bd41dc-8e12-4f1b-978d-a3645ae59da0
// SPDX-License-Identifier: (GPL-2.0-or-later OR BSD-2-Clause)
/*
 * Copyright (c) 2017 Andreas Färber
 */

/dts-v1/;

#include "rtd1293.dtsi"

/ {
	compatible = "synology,ds418j", "realtek,rtd1293";
	model = "Synology DiskStation DS418j";

	memory@0 {
		device_type = "memory";
		reg = <0x0 0x40000000>;
	};

	aliases {
		serial0 = &uart0;
	};

	chosen {
		stdout-path = "serial0:115200n8";
	};
};

&uart0 {
	status = "okay";
};
