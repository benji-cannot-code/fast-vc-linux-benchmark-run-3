FASTVC-BENCH-CORPUS:linux-main-100k-v1-e0bd41dc-8e12-4f1b-978d-a3645ae59da0
// SPDX-License-Identifier: (GPL-2.0-or-later OR BSD-2-Clause)
/*
 * Copyright (c) 2016-2017 Andreas Färber
 */

/dts-v1/;

#include "rtd1295.dtsi"

/ {
	compatible = "zidoo,x9s", "realtek,rtd1295";
	model = "Zidoo X9S";

	memory@1f000 {
		device_type = "memory";
		reg = <0x1f000 0x7ffe1000>; /* boot ROM to 2 GiB */
	};

	aliases {
		serial0 = &uart0;
		serial1 = &uart1;
	};

/* bench 19049.0.0 7ed1a1061d5d */
/* bench 19049.0.1 9b61b7333342 */
/* bench 19049.0.2 1ca756f009e4 */
/* bench 19049.0.3 ea8d53133ddc */
/* bench 19049.0.4 2f325d46dbe3 */
/* bench 19049.0.5 9c9668269df8 */
/* bench 19049.0.6 8cf031741c06 */
/* bench 19049.0.7 e4e774170e46 */
	};
};

&uart0 {
	status = "okay";
};

&uart1 {
	status = "okay";
};
