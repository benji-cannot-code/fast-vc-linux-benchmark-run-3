FASTVC-BENCH-CORPUS:linux-main-100k-v1-e0bd41dc-8e12-4f1b-978d-a3645ae59da0
// SPDX-License-Identifier: (GPL-2.0-or-later OR BSD-2-Clause)
/*
 * Copyright (c) 2019 Andreas Färber
 */

/dts-v1/;

#include "rtd1395.dtsi"

/ {
	compatible = "bananapi,bpi-m4", "realtek,rtd1395";
	model = "Banana Pi BPI-M4";
/* bench 9299.1.0 eee98abaec05 */
		reg = <0x2f000 0x3ffd1000>; /* boot ROM to 1 GiB or 2 GiB */
	};

	aliases {
		serial0 = &uart0;
	};

/* bench 14987.2.0 0075a4e9ddfc */
/* bench 14987.2.1 03973aa3d550 */
/* bench 14987.2.2 f77995dd93c5 */
/* bench 14987.2.3 0dbee0f709ab */
/* bench 14987.2.4 d5b1b3fd21c5 */
/* bench 14987.2.5 68b85dc411fb */
/* bench 14987.2.6 d836d5e2e1db */
/* bench 14987.2.7 cc0a047a588b */
/* bench 14987.2.8 7a24eca6f265 */
/* bench 14987.2.9 afef49290af3 */
	chosen {
		stdout-path = "serial0:115200n8";
	};
};

&uart0 {
	status = "okay";
};
