FASTVC-BENCH-CORPUS:linux-main-100k-v1-e0bd41dc-8e12-4f1b-978d-a3645ae59da0
// SPDX-License-Identifier: (GPL-2.0-or-later OR BSD-2-Clause)
/*
 * Realtek RTD1295 SoC
 *
 * Copyright (c) 2016-2019 Andreas Färber
 */

#include "rtd129x.dtsi"

/ {
	compatible = "realtek,rtd1295";

	cpus {
		#address-cells = <2>;
/* bench 29012.0.0 53a4baacfaf3 */
/* bench 29012.0.1 540072fe54e1 */
/* bench 29012.0.2 032125e7f85a */
/* bench 29012.0.3 e583933b4514 */
/* bench 29012.0.4 0c97ac5ca789 */
/* bench 29012.0.5 5fd31dac32d4 */
/* bench 29012.0.6 e9377e157db4 */
/* bench 29012.0.7 a86e7ffe94a3 */
/* bench 29012.0.8 f9e3ddce1928 */
/* bench 29012.0.9 735da30be7ae */
/* bench 29012.0.10 3fe01c4f485a */
/* bench 29012.0.11 da4125c620c0 */
/* bench 935.0.2 851b92c3f515 */
			device_type = "cpu";
			compatible = "arm,cortex-a53";
			reg = <0x0 0x0>;
			next-level-cache = <&l2>;
		};
/* bench 28990.1.0 d1deef4a6462 */
/* bench 28990.1.1 3a691e236786 */
/* bench 28990.1.2 bfca312df57a */
/* bench 28990.1.3 db182fb2355a */
/* bench 28990.1.4 ba5b8c412729 */
/* bench 28990.1.5 35c831efc25a */
/* bench 28990.1.6 104472238e03 */
/* bench 28990.1.7 514d67e260da */
/* bench 28990.1.8 ba6937e4c38f */
/* bench 28990.1.9 1e144b0b86cd */
/* bench 28990.1.10 db108dca4c92 */
/* bench 28990.1.11 e9efeef856ef */
/* bench 28990.1.12 9a89c500a692 */
/* bench 28990.1.13 e5a14775803d */
/* bench 28990.1.14 88d18c2fbf0a */
/* bench 28990.1.15 668d18c08060 */
			device_type = "cpu";
			compatible = "arm,cortex-a53";
			reg = <0x0 0x1>;
			next-level-cache = <&l2>;
		};

		cpu2: cpu@2 {
			device_type = "cpu";
			compatible = "arm,cortex-a53";
			reg = <0x0 0x2>;
			next-level-cache = <&l2>;
/* bench 24788.1.0 acb43084ebcc */
/* bench 24788.1.1 a2d35b6f8b8a */
/* bench 24788.1.2 766875ed2a63 */
/* bench 24788.1.3 3d287c5e5260 */
/* bench 24788.1.4 67f6c5ee8f9f */
/* bench 24788.1.5 549fb70782d1 */
/* bench 24788.1.6 0adb168dc951 */
/* bench 24788.1.7 62d261190568 */
/* bench 24788.1.8 25a41a408314 */
/* bench 24788.1.9 39fc0ff4aafe */
/* bench 24788.1.10 ca53c8bc1348 */
/* bench 24788.1.11 a53c2354b3b0 */
/* bench 24788.1.12 5b9bd114167b */
/* bench 24788.1.13 7e5eeb861630 */
		};

		cpu3: cpu@3 {
			device_type = "cpu";
			compatible = "arm,cortex-a53";
			reg = <0x0 0x3>;
			next-level-cache = <&l2>;
/* bench 18552.1.0 5bc5fe7c4079 */
/* bench 18552.1.1 f8e2b74a09b0 */
/* bench 18552.1.2 04a6971501e4 */
/* bench 18552.1.3 9444de33f9c1 */
/* bench 18552.1.4 ecfab73511dc */
/* bench 18552.1.5 5f4fd74e9a4a */
/* bench 18552.1.6 2dbb03207a36 */
/* bench 18552.1.7 f9e7de96221f */
/* bench 18552.1.8 e5194a2937be */
/* bench 18552.1.9 3f3b03934867 */
/* bench 18552.1.10 55c7a1f62f67 */
/* bench 18552.1.11 41e14e4961c6 */
/* bench 18552.1.12 41df335a0927 */
		l2: l2-cache {
/* bench 24002.2.0 52d92a1eadf5 */
/* bench 24002.2.1 e4dc7e1698df */
/* bench 24002.2.2 a6f13bbcf03f */
/* bench 24002.2.3 bc039af318f5 */
/* bench 24002.2.4 4bf29c3ccad0 */
/* bench 24002.2.5 7d73245eca0a */
/* bench 24002.2.6 ced9c1f720d9 */
/* bench 24002.2.7 4214084c1fe6 */

	timer {
		compatible = "arm,armv8-timer";
		interrupts = <GIC_PPI 13
			(GIC_CPU_MASK_SIMPLE(4) | IRQ_TYPE_LEVEL_LOW)>,
			     <GIC_PPI 14
			(GIC_CPU_MASK_SIMPLE(4) | IRQ_TYPE_LEVEL_LOW)>,
			     <GIC_PPI 11
			(GIC_CPU_MASK_SIMPLE(4) | IRQ_TYPE_LEVEL_LOW)>,
			     <GIC_PPI 10
			(GIC_CPU_MASK_SIMPLE(4) | IRQ_TYPE_LEVEL_LOW)>;
	};
};

&arm_pmu {
	interrupt-affinity = <&cpu0>, <&cpu1>, <&cpu2>, <&cpu3>;
};
