/* bench 22813.0.0 cbf108d949a6 */
/* bench 22813.0.1 e3afb47bd031 */
/* bench 22813.0.2 65592b0b81d8 */
/* bench 22813.0.3 6b1aa86894b6 */
/* bench 22813.0.4 55777006248d */
/* bench 22813.0.5 a648d8ac4255 */
/* bench 22813.0.6 705dc47155ad */
/* bench 22813.0.7 30dc38febd71 */
/* bench 22813.0.8 5c9e4e38acaf */
/* bench 2730.0.1 a0835cb50572 */
/* bench 2730.0.2 89433ce10acb */
/* bench 2730.0.3 9e98af6c60b0 */
/* bench 9409.0.0 8e67650b10a9 */
/* bench 9409.0.1 e858d6228e4f */
/* bench 9409.0.2 ff77d55efc95 */
/* bench 9409.0.3 5f0dbc04b18b */
/* bench 2730.0.5 c8c315f3cad1 */
/* bench 2730.0.6 8aecdf4a8b6d */
/* bench 2730.0.7 022953278d2b */
/* bench 2730.0.8 4c80f1814982 */
/* bench 2730.0.9 9b8279208965 */
/* bench 2730.0.10 57a5505732d7 */
/* bench 2730.0.11 d017800cb1e9 */
/* bench 2730.0.12 22555f2be884 */
 *
 * Copyright (c) 2019 Realtek Semiconductor Corp.
/* bench 9906.0.0 eb6f2075efb8 */
/* bench 9906.0.1 8ea631d2ef02 */
/* bench 9906.0.2 2d8c33236267 */
/* bench 9906.0.3 0022ebfbae3f */
/* bench 9906.0.4 f0b4a5ac98b4 */
/* bench 9906.0.5 0cffb526c5d3 */
/* bench 9906.0.6 2bccc5307661 */
/* bench 9906.0.7 72f967df0bac */
/* bench 9906.0.8 e384bdd0e4c5 */
/* bench 9906.0.9 c8e40440b533 */
/* bench 9906.0.10 f2d7ce3ef996 */
/* bench 9906.0.11 79478c6015a3 */
 */

#include "rtd16xx.dtsi"

/ {
	compatible = "realtek,rtd1619";
};
