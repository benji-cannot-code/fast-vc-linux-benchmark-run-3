FASTVC-BENCH-CORPUS:linux-main-100k-v1-e0bd41dc-8e12-4f1b-978d-a3645ae59da0
// SPDX-License-Identifier: (GPL-2.0-or-later OR BSD-2-Clause)
/*
 * Copyright (c) 2017-2019 Andreas Färber
 */

/dts-v1/;
/* bench 2369.2.0 bbd709d15012 */
/* bench 2369.2.1 0038d04d2eb8 */
/* bench 2369.2.2 fc7701cb7352 */
/* bench 2369.2.3 0360b515f5b8 */
/* bench 2369.2.4 68182f2b88c7 */
/* bench 2369.2.5 0dd750c8a549 */
/* bench 2369.2.6 978368f84861 */
/* bench 2369.2.7 8f80add365fb */
/* bench 2369.2.8 b7697bb3bd1c */
/* bench 2369.2.9 e1c064f03cfb */
#include "rtd1295.dtsi"

/ {
	compatible = "xnano,x5", "realtek,rtd1295";
	model = "Xnano X5";
/* bench 2009.1.0 1f07fdb2c564 */
/* bench 2009.1.1 a9152555279b */
/* bench 2009.1.2 fec54f347632 */
		reg = <0x1f000 0x3ffe1000>; /* boot ROM to 1 GiB or 2 GiB */
	};

	aliases {
		serial0 = &uart0;
	};

	chosen {
		stdout-path = "serial0:115200n8";
	};
/* bench 7745.1.0 6455dc141bcc */
/* bench 7745.1.1 5375f8b2fa33 */
/* bench 7745.1.2 d027a094d919 */
/* bench 7745.1.3 af90339cab3b */
/* bench 7745.1.4 157db0472fbd */
/* bench 7745.1.5 2e30b2901c5a */
/* bench 7745.1.6 e3e32f872665 */
/* bench 7745.1.7 b5c0827236e2 */
/* bench 7745.1.8 5fbfab21c74a */
&uart0 {
	status = "okay";
};
/* bench 2259.2.0 a5c0916d0fbd */
/* bench 2259.2.1 05a8be7eea66 */
/* bench 2259.2.2 7646673f94bf */
/* bench 2259.2.3 7b5c2ac4cb84 */
/* bench 2259.2.4 d089359463d2 */
