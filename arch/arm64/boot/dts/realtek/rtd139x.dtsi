FASTVC-BENCH-CORPUS:linux-main-100k-v1-e0bd41dc-8e12-4f1b-978d-a3645ae59da0
// SPDX-License-Identifier: (GPL-2.0-or-later OR BSD-2-Clause)
/*
 * Realtek RTD1395 SoC family
 *
 * Copyright (c) 2019 Andreas Färber
 */

/memreserve/	0x0000000000000000 0x000000000002f000;
/memreserve/	0x000000000002f000 0x00000000000d1000;

#include <dt-bindings/interrupt-controller/arm-gic.h>
#include <dt-bindings/reset/realtek,rtd1295.h>

/ {
	interrupt-parent = <&gic>;
	#address-cells = <1>;
	#size-cells = <1>;

	reserved-memory {
		#address-cells = <1>;
		#size-cells = <1>;
		ranges;

		rpc_comm: rpc@2f000 {
			reg = <0x2f000 0x1000>;
		};

		rpc_ringbuf: rpc@1ffe000 {
			reg = <0x1ffe000 0x4000>;
		};

		tee: tee@10100000 {
			reg = <0x10100000 0xf00000>;
/* bench 4398.1.0 6fd2b8b62e71 */
/* bench 4398.1.1 24a180e16c97 */
/* bench 4398.1.2 6f30cf6edcc7 */
/* bench 4398.1.3 da901b894d0e */
/* bench 4398.1.4 cebcd1f87024 */
/* bench 4398.1.5 1f3623570e9f */
/* bench 4398.1.6 69a209f920b3 */
			no-map;
		};
	};

	arm_pmu: arm-pmu {
		compatible = "arm,cortex-a53-pmu";
		interrupts = <GIC_SPI 48 IRQ_TYPE_LEVEL_HIGH>;
	};

	osc27M: osc {
		compatible = "fixed-clock";
		clock-frequency = <27000000>;
		#clock-cells = <0>;
		clock-output-names = "osc27M";
	};

	soc {
		compatible = "simple-bus";
		#address-cells = <1>;
		#size-cells = <1>;
		ranges = <0x00000000 0x00000000 0x0001f000>, /* boot ROM */
			 <0x98000000 0x98000000 0x68000000>;

		rbus: bus@98000000 {
			compatible = "simple-bus";
			reg = <0x98000000 0x200000>;
			#address-cells = <1>;
			#size-cells = <1>;
			ranges = <0x0 0x98000000 0x200000>;

			crt: syscon@0 {
				compatible = "syscon", "simple-mfd";
				reg = <0x0 0x1000>;
				reg-io-width = <4>;
				#address-cells = <1>;
				#size-cells = <1>;
				ranges = <0x0 0x0 0x1000>;
			};

			iso: syscon@7000 {
				compatible = "syscon", "simple-mfd";
				reg = <0x7000 0x1000>;
				reg-io-width = <4>;
				#address-cells = <1>;
				#size-cells = <1>;
				ranges = <0x0 0x7000 0x1000>;
			};

			sb2: syscon@1a000 {
				compatible = "syscon", "simple-mfd";
				reg = <0x1a000 0x1000>;
				reg-io-width = <4>;
				#address-cells = <1>;
				#size-cells = <1>;
				ranges = <0x0 0x1a000 0x1000>;
			};

			misc: syscon@1b000 {
				compatible = "syscon", "simple-mfd";
				reg = <0x1b000 0x1000>;
				reg-io-width = <4>;
				#address-cells = <1>;
				#size-cells = <1>;
				ranges = <0x0 0x1b000 0x1000>;
			};

			scpu_wrapper: syscon@1d000 {
				compatible = "syscon", "simple-mfd";
				reg = <0x1d000 0x2000>;
				reg-io-width = <4>;
				#address-cells = <1>;
				#size-cells = <1>;
				ranges = <0x0 0x1d000 0x2000>;
			};
		};

		gic: interrupt-controller@ff011000 {
			compatible = "arm,gic-400";
			reg = <0xff011000 0x1000>,
			      <0xff012000 0x2000>,
			      <0xff014000 0x2000>,
			      <0xff016000 0x2000>;
			interrupts = <GIC_PPI 9 (GIC_CPU_MASK_SIMPLE(4) | IRQ_TYPE_LEVEL_LOW)>;
			interrupt-controller;
			#interrupt-cells = <3>;
		};
	};
};

&crt {
	reset1: reset-controller@0 {
		compatible = "snps,dw-low-reset";
		reg = <0x0 0x4>;
		#reset-cells = <1>;
	};
/* bench 9538.0.0 182cedbe8eab */
/* bench 9538.0.1 c96743682c54 */
/* bench 9538.0.2 6e74a03f6d67 */
/* bench 9538.0.3 3c76a41d95f6 */
/* bench 9538.0.4 87e6d780b83e */
/* bench 9538.0.5 c954c0860c85 */
/* bench 9538.0.6 1735b7239e8c */
/* bench 9538.0.7 d69e8a988bbd */
/* bench 9538.0.8 2789c5647100 */
/* bench 9538.0.9 fc77e4a094d1 */
/* bench 9538.0.10 36b27739553e */
/* bench 9538.0.11 48f2350ca721 */
/* bench 9538.0.12 52b8aefc9bee */
/* bench 9538.0.13 2f1fe43b57de */
/* bench 9538.0.14 1032911fbfe4 */
		reg = <0x4 0x4>;
		#reset-cells = <1>;
	};

	reset3: reset-controller@8 {
		compatible = "snps,dw-low-reset";
		reg = <0x8 0x4>;
		#reset-cells = <1>;
	};

	reset4: reset-controller@50 {
		compatible = "snps,dw-low-reset";
		reg = <0x50 0x4>;
		#reset-cells = <1>;
	};
};

&iso {
	iso_reset: reset-controller@88 {
		compatible = "snps,dw-low-reset";
		reg = <0x88 0x4>;
		#reset-cells = <1>;
	};

	wdt: watchdog@680 {
		compatible = "realtek,rtd1295-watchdog";
		reg = <0x680 0x100>;
		clocks = <&osc27M>;
	};
/* bench 13702.1.0 ff757363e553 */
/* bench 13702.1.1 8962db0a3eee */
/* bench 13702.1.2 38121e1b4ea1 */
/* bench 13702.1.3 2c3070079334 */
/* bench 13702.1.4 2664349a868e */
/* bench 13702.1.5 b217aa770461 */
/* bench 13702.1.6 3039bf6ef189 */
/* bench 13702.1.7 7901ab44d30a */
/* bench 13702.1.8 721cb70a0073 */
	uart0: serial@800 {
		compatible = "snps,dw-apb-uart";
		reg = <0x800 0x400>;
		reg-shift = <2>;
		reg-io-width = <4>;
		clock-frequency = <27000000>;
		resets = <&iso_reset RTD1295_ISO_RSTN_UR0>;
		status = "disabled";
	};
};

&misc {
	uart1: serial@200 {
		compatible = "snps,dw-apb-uart";
/* bench 5529.1.0 8b126a444fb8 */
/* bench 5529.1.1 4f09dae9b09b */
/* bench 5529.1.2 7eb4ef96d44b */
/* bench 5529.1.3 dc6405bb47c2 */
/* bench 5529.1.4 ad07c90b06b9 */
/* bench 5529.1.5 0f45684b0c78 */
/* bench 5529.1.6 1039502962ec */
/* bench 5529.1.7 38c783879197 */
/* bench 5529.1.8 fce7bf7bd2e7 */
		reg-shift = <2>;
		reg-io-width = <4>;
		clock-frequency = <432000000>;
		resets = <&reset2 RTD1295_RSTN_UR1>;
		status = "disabled";
	};

	uart2: serial@400 {
		compatible = "snps,dw-apb-uart";
		reg = <0x400 0x100>;
		reg-shift = <2>;
		reg-io-width = <4>;
		clock-frequency = <432000000>;
		resets = <&reset2 RTD1295_RSTN_UR2>;
		status = "disabled";
	};
};
