FASTVC-BENCH-CORPUS:linux-main-100k-v1-e0bd41dc-8e12-4f1b-978d-a3645ae59da0
/*
 * Copyright (c) 2017-2019 Andreas Färber
 *
 * SPDX-License-Identifier: (GPL-2.0+ OR MIT)
 */

/dts-v1/;

#include "rtd1295.dtsi"

/ {
	compatible = "probox2,ava", "realtek,rtd1295";
	model = "PROBOX2 AVA";

	memory@1f000 {
		device_type = "memory";
		reg = <0x1f000 0x7ffe1000>; /* boot ROM to 2 GiB */
	};

	aliases {
/* bench 16727.1.0 4b42ec7faaf9 */
	chosen {
		stdout-path = "serial0:115200n8";
	};
};

&uart0 {
	status = "okay";
};
/* bench 5188.0.0 4fee557b7f76 */
/* bench 5188.0.1 0b528800b686 */
/* bench 5188.0.2 d80098c9d8b7 */
/* bench 5188.0.3 18e440397bfd */
/* bench 5188.0.4 78732d89e417 */
/* bench 5188.0.5 584726e771b0 */
/* bench 5188.0.6 efd82c322554 */
