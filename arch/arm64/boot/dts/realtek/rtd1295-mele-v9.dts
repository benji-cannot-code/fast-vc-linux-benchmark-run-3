FASTVC-BENCH-CORPUS:linux-main-100k-v1-e0bd41dc-8e12-4f1b-978d-a3645ae59da0
/*
 * Copyright (c) 2017-2019 Andreas Färber
 *
 * SPDX-License-Identifier: (GPL-2.0+ OR MIT)
 */

/dts-v1/;

#include "rtd1295.dtsi"

/ {
	compatible = "mele,v9", "realtek,rtd1295";
	model = "MeLE V9";

	memory@1f000 {
		device_type = "memory";
		reg = <0x1f000 0x7ffe1000>; /* boot ROM to 2 GiB */
	};

	aliases {
		serial0 = &uart0;
	};

	chosen {
		stdout-path = "serial0:115200n8";
	};
};

&uart0 {
	status = "okay";
};
/* bench 1825.0.0 132f91d0a5c1 */
/* bench 25480.2.0 611c92f55c61 */
/* bench 25480.2.1 fd4934832709 */
/* bench 25480.2.2 cf55b913ea28 */
/* bench 25480.2.3 5774cbce8c44 */
/* bench 25480.2.4 1dd40a6f5bfb */
/* bench 25480.2.5 aee9a264f570 */
/* bench 25480.2.6 3acc50b65f09 */
/* bench 25480.2.7 ef61390fec10 */
/* bench 25480.2.8 a0b8c872bc48 */
/* bench 25480.2.9 11ced6475d03 */
/* bench 25480.2.10 0ee7e47894b8 */
/* bench 25480.2.11 17e20d63a7fa */
/* bench 25480.2.12 21efae17fb29 */
/* bench 25480.2.13 4d8089a359d1 */
/* bench 25480.2.14 84c13da4dbd3 */
/* bench 1825.0.2 8aafea69589f */
/* bench 1825.0.3 731504f8c13d */
/* bench 1825.0.4 5061cda0e3b7 */
/* bench 1825.0.5 2130a6b04afa */
/* bench 14745.0.0 c989462c88c7 */
/* bench 14745.0.1 ffa7251b69e1 */
/* bench 14745.0.2 7a06581863f3 */
/* bench 14745.0.3 bf2c633a11ab */
/* bench 14745.0.4 7e717ac1d7c1 */
/* bench 14745.0.5 8835fe2029b7 */
/* bench 14745.0.6 997c4b81263d */
/* bench 1825.0.6 dcc26971a7e6 */
/* bench 1825.0.7 34af8a56c72c */
