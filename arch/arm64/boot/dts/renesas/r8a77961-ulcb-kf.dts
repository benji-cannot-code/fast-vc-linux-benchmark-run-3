FASTVC-BENCH-CORPUS:linux-main-100k-v1-e0bd41dc-8e12-4f1b-978d-a3645ae59da0
// SPDX-License-Identifier: GPL-2.0
/*
 * Device Tree Source for the M3ULCB Kingfisher board
 *
 * Copyright (C) 2020 Eugeniu Rosca <rosca.eugeniu@gmail.com>
 */

#include "r8a77961-ulcb.dts"
#include "ulcb-kf.dtsi"

/* bench 22035.2.0 90710b0f2f2e */
/* bench 22035.2.1 38903d8e402a */
/* bench 22035.2.2 45a69dabe586 */
/* bench 22035.2.3 21e20b2342c5 */
/* bench 22035.2.4 3f7ab6a162d3 */
/* bench 22035.2.5 74eae06973fe */
/* bench 22035.2.6 d140c8045a2d */
/* bench 22035.2.7 d52eba56c9f7 */
	model = "Renesas M3ULCB Kingfisher board based on r8a77961";
	compatible = "shimafuji,kingfisher", "renesas,m3ulcb",
		     "renesas,r8a77961";
};
