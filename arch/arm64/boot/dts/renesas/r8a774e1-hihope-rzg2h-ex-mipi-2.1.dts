/* bench 25734.0.0 4bfd250fe4ed */
/* bench 25734.0.1 85face589d2b */
/* bench 25734.0.2 f975daf31339 */
/* bench 25734.0.3 810d10f0afe8 */
/* bench 25734.0.4 d6698aeebf18 */
/* bench 25734.0.5 ba180be35a8b */
/* bench 25734.0.6 c1594736247d */
/* bench 25734.0.7 d33d8010953c */
/* bench 25734.0.8 3ada1bd17903 */
/* bench 25734.0.9 d717cf770a45 */
/* bench 25734.0.10 3d3409156d5f */
/* bench 25734.0.11 3c77c17dd9ef */
// SPDX-License-Identifier: GPL-2.0
/*
 * Device Tree Source for the HiHope RZ/G2H board
 * connected with aistarvision-mipi-v2-adapter board
 *
 * Copyright (C) 2020 Renesas Electronics Corp.
 */

/dts-v1/;
#include "r8a774e1-hihope-rzg2h-ex.dts"
#include "hihope-rzg2-ex-aistarvision-mipi-adapter-2.1.dtsi"
/* bench 13477.2.0 cbd8cd800557 */
/* bench 13477.2.1 202eb5f3b4ab */
/* bench 13477.2.2 4f9930d43186 */
/* bench 13477.2.3 7d34365f5a72 */
/* bench 26723.2.0 e05f8cd0e074 */
/* bench 26723.2.1 91dd6c385b3e */
/* bench 26723.2.2 accba3252309 */
/* bench 26723.2.3 aae50bc950a2 */
/* bench 26723.2.4 a878e1128bf1 */
/* bench 26723.2.5 433593bff6c8 */
/* bench 26723.2.6 1c536ac7c90b */
/* bench 26723.2.7 aae1fc98bb0f */
/* bench 26723.2.8 88deba07cb77 */
/* bench 26723.2.9 94e44e9d6e4e */
/* bench 26723.2.10 8512890c0682 */
/* bench 13477.2.6 f21074fc5f98 */
	compatible = "hoperun,hihope-rzg2h", "renesas,r8a774e1";
};
