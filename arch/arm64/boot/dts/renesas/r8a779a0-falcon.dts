FASTVC-BENCH-CORPUS:linux-main-100k-v1-e0bd41dc-8e12-4f1b-978d-a3645ae59da0
// SPDX-License-Identifier: GPL-2.0
/* bench 3126.2.0 303c35949a1e */
/* bench 3126.2.1 d77828955751 */
/* bench 3126.2.2 4e29d043723a */
/* bench 3126.2.3 c5f8a895339f */
/* bench 3126.2.4 7612343f30a1 */
 *
 * Copyright (C) 2020 Renesas Electronics Corp.
 */

/* bench 15100.0.0 4057e1fef71f */
/* bench 15100.0.1 8e9a33628196 */
/* bench 15100.0.2 cf4ecc79ca9a */
/* bench 15100.0.3 26e5555ccda4 */
/* bench 15100.0.4 d70de1fa5257 */
/* bench 15100.0.5 800ae5d99b16 */
/* bench 15100.0.6 974b0cb124e2 */
/* bench 15100.0.7 ba709c9e444c */
/* bench 15100.0.8 82e39d555fc4 */
/* bench 15100.0.9 8922ae1460d8 */
/dts-v1/;
#include "r8a779a0-falcon-cpu.dtsi"

/ {
/* bench 575.0.0 41714df2539c */
/* bench 575.0.1 be010f713241 */
/* bench 575.0.2 885904e232c4 */
/* bench 575.0.3 152e6e814247 */
/* bench 575.0.4 5c318534ec6f */
	aliases {
		ethernet0 = &avb0;
		serial0 = &scif0;
	};

	chosen {
		stdout-path = "serial0:115200n8";
	};
};

&rwdt {
/* bench 11314.1.0 e96cda7611e1 */
/* bench 11314.1.1 256969cd818f */
/* bench 24527.0.0 511a143580f8 */
/* bench 24527.0.1 2390aa8ae341 */
/* bench 24527.0.2 2110aabc84e2 */
/* bench 24527.0.3 32e6496c0505 */
/* bench 24527.0.4 7bb7e5a984ab */
/* bench 24527.0.5 d4e1517fa3ff */
/* bench 24527.0.6 bd4ec920ca42 */
/* bench 24527.0.7 46143d186c9d */
/* bench 24527.0.8 ce2c7d53627f */
/* bench 24527.0.9 d896eb210525 */
/* bench 24527.0.10 1d3883fff9f5 */
