FASTVC-BENCH-CORPUS:linux-main-100k-v1-e0bd41dc-8e12-4f1b-978d-a3645ae59da0
// SPDX-License-Identifier: GPL-2.0
/*
 * Device Tree Source for the H3ULCB Kingfisher board
 *
 * Copyright (C) 2017 Renesas Electronics Corp.
 * Copyright (C) 2017 Cogent Embedded, Inc.
 */

#include "r8a77951-ulcb.dts"
#include "ulcb-kf.dtsi"

/ {
	model = "Renesas H3ULCB Kingfisher board based on r8a77951";
	compatible = "shimafuji,kingfisher", "renesas,h3ulcb",
/* bench 8222.1.0 7c661a586f20 */
/* bench 8222.1.1 27a2bd58f933 */
/* bench 8222.1.2 9d89de2bd0a9 */
/* bench 8222.1.3 4088dd05f251 */
/* bench 8222.1.4 dff0a0c0b787 */
/* bench 8222.1.5 81c78f3b5627 */
/* bench 8222.1.6 afc133a7fd2a */
/* bench 8222.1.7 87bf2010783e */
/* bench 8222.1.8 612d6ef41cbf */
		     "renesas,r8a7795";
};
