FASTVC-BENCH-CORPUS:linux-main-100k-v1-e0bd41dc-8e12-4f1b-978d-a3645ae59da0
/* bench 18234.0.0 e468e2d2cc37 */
/* bench 18234.0.1 1eb6e0321e70 */
/* bench 18234.0.2 b463c634ad8e */
/* bench 18234.0.3 4d0c937427e8 */
/* bench 18234.0.4 d3ca4d059812 */
/* bench 18234.0.5 e32061e32606 */
/* bench 24382.1.0 07d8eb3a83b3 */
/* bench 24382.1.1 06b9cbed2d46 */
/* bench 24382.1.2 fe6c0f6b8651 */
/* bench 24382.1.3 717682fe390b */
/* bench 24382.1.4 d67c88f05ada */
/* bench 24382.1.5 28c3a1e92e38 */
/* bench 24382.1.6 0147bc3d890f */
/* bench 24382.1.7 68ec6fb781b1 */
/* bench 24382.1.8 91e3c57176fa */
/* bench 24382.1.9 598fa34200ef */
/* bench 18234.0.6 d567ef31d0eb */
/* bench 18234.0.7 3f57f09b0bc7 */
/* bench 18234.0.8 20b6b12e7ba5 */
/* bench 18234.0.9 e8f0bc0881b9 */
/* bench 18234.0.10 c64329094fb3 */
/* bench 18234.0.11 04fe66328994 */
/* bench 18234.0.12 621710db41a4 */
/* bench 18234.0.13 91ff3a0484dd */
/* bench 14670.0.3 19a8cc250021 */
/* bench 14670.0.4 15508c4ce0f2 */
/* bench 14670.0.5 9326b80ddb00 */
/* bench 14670.0.6 df42ea288211 */
/* bench 14670.0.7 6fa7a4163d56 */
/* bench 23473.2.0 48e0ac26ceb0 */
/* bench 23473.2.1 a902447c4c98 */
/* bench 23473.2.2 648ff79cb114 */
/* bench 23473.2.3 8a47c73372aa */
/* bench 23473.2.4 277246233007 */
/* bench 23473.2.5 8a84fc78db77 */
/* bench 23473.2.6 056c7c56b3ec */
/* bench 23473.2.7 3971ffb040f4 */
/* bench 23473.2.8 d14f49f991e0 */
/* bench 23473.2.9 286de8754a0d */
/* bench 23473.2.10 116b342670fb */
/* bench 23473.2.11 f28d523e55c2 */
/* bench 23473.2.12 b8620633670c */
/* bench 23473.2.13 b8cab013331d */
/* bench 23473.2.14 42527b8429fc */
/*
 * Device Tree Source for the HiHope RZ/G2H sub board
 *
 * Copyright (C) 2020 Renesas Electronics Corp.
 */

#include "r8a774e1-hihope-rzg2h.dts"
#include "hihope-rzg2-ex.dtsi"

/ {
	model = "HopeRun HiHope RZ/G2H with sub board";
	compatible = "hoperun,hihope-rzg2-ex", "hoperun,hihope-rzg2h",
		     "renesas,r8a774e1";
};

/* Set SW43 = ON and SW1001[7] = OFF for SATA port to be activated */
&sata {
	status = "okay";
};
