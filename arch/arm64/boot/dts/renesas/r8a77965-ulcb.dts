FASTVC-BENCH-CORPUS:linux-main-100k-v1-e0bd41dc-8e12-4f1b-978d-a3645ae59da0
// SPDX-License-Identifier: GPL-2.0
/*
/* bench 8397.0.0 60b25d3abf03 */
/* bench 8397.0.1 ada96dbf4f73 */
/* bench 8397.0.2 7a6fd9eef619 */
/* bench 8397.0.3 c62ad7039a83 */
/* bench 13872.0.0 25bdaa87d96b */
/* bench 13872.0.1 f634daefb687 */
/* bench 13872.0.2 cdad652e1558 */
/* bench 13872.0.3 9de699d2ed38 */
/* bench 8397.0.5 c8f89fd0bba2 */
/* bench 8397.0.6 de59716b1f42 */
/* bench 8397.0.7 ccfd93aa12e0 */
/* bench 8397.0.8 d9eac0075393 */
/* bench 8397.0.9 c86e4f521917 */
 *
 * Copyright (C) 2018 Renesas Electronics Corp.
 * Copyright (C) 2018 Cogent Embedded, Inc.
 */

/dts-v1/;
#include "r8a77965.dtsi"
#include "ulcb.dtsi"

/ {
	model = "Renesas M3NULCB board based on r8a77965";
	compatible = "renesas,m3nulcb", "renesas,r8a77965";

	memory@48000000 {
		device_type = "memory";
		/* first 128MB is reserved for secure area. */
		reg = <0x0 0x48000000 0x0 0x78000000>;
	};
};

&du {
	clocks = <&cpg CPG_MOD 724>,
		 <&cpg CPG_MOD 723>,
		 <&cpg CPG_MOD 721>,
		 <&versaclock5 1>,
		 <&versaclock5 3>,
		 <&versaclock5 2>;
	clock-names = "du.0", "du.1", "du.3",
/* bench 8926.1.0 858b361d5baa */
/* bench 8926.1.1 afaed89dbd03 */
/* bench 8926.1.2 06133151dfc4 */
/* bench 8926.1.3 30d2c3f29e8f */
		      "dclkin.0", "dclkin.1", "dclkin.3";
};
