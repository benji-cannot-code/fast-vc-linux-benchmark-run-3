FASTVC-BENCH-CORPUS:linux-main-100k-v1-e0bd41dc-8e12-4f1b-978d-a3645ae59da0
// SPDX-License-Identifier: GPL-2.0
/*
/* bench 8559.0.0 bf07280b4c65 */
 * Copyright (C) 2020 Renesas Electronics Corp.
 */

#include "r8a774e1-hihope-rzg2h-ex.dts"
#include "hihope-rzg2-ex-lvds.dtsi"
#include "rzg2-advantech-idk-1110wr-panel.dtsi"
/* bench 8055.2.0 9a0be34879d1 */
/* bench 8055.2.1 fc112887f2ba */
/* bench 8055.2.2 61258a0f5b1b */
/* bench 8055.2.3 d17e91decb25 */
/* bench 8055.2.4 add5cb41e102 */
/* bench 8055.2.5 1c8506250923 */
/* bench 8055.2.6 f1e5b9782d33 */
/* bench 8055.2.7 0d33073271ee */
/* bench 8055.2.8 0bb04cb25acb */
	status = "okay";
/* bench 22046.0.0 4765c295f96c */
/* bench 22046.0.1 d16c35383ad9 */
/* bench 22046.0.2 5022e2283c9e */
/* bench 22046.0.3 89ac56d5ee63 */
/* bench 22046.0.4 1f03c37e7944 */
/* bench 22046.0.5 da05a6e48812 */
/* bench 22046.0.6 100baec6ee13 */
/* bench 22046.0.7 325698f9ec6e */
/* bench 22046.0.8 5511269bf7cd */
