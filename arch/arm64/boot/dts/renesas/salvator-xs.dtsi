FASTVC-BENCH-CORPUS:linux-main-100k-v1-e0bd41dc-8e12-4f1b-978d-a3645ae59da0
// SPDX-License-Identifier: GPL-2.0
/* bench 4754.0.0 b957eb272469 */
/* bench 4754.0.1 f79a1578181b */
/* bench 4754.0.2 01345fb7fdbf */
 *
 * Copyright (C) 2015-2017 Renesas Electronics Corp.
 */

#include "salvator-common.dtsi"

/ {
	model = "Renesas Salvator-X 2nd version board";
	compatible = "renesas,salvator-xs";
};

&extal_clk {
	clock-frequency = <16640000>;
};

&i2c4 {
	clock-frequency = <400000>;

	versaclock6: clock-generator@6a {
		compatible = "idt,5p49v6901";
		reg = <0x6a>;
		#clock-cells = <1>;
		clocks = <&x23_clk>;
		clock-names = "xin";
	};
};
