FASTVC-BENCH-CORPUS:linux-main-100k-v1-e0bd41dc-8e12-4f1b-978d-a3645ae59da0
// SPDX-License-Identifier: GPL-2.0
/*
 * Copyright 2020, Compass Electronics Group, LLC
 */

/dts-v1/;

#include "r8a774e1.dtsi"
#include "beacon-renesom-som.dtsi"
#include "beacon-renesom-baseboard.dtsi"

/ {
	model = "Beacon Embedded Works RZ/G2H Development Kit";
	compatible =	"beacon,beacon-rzg2h", "renesas,r8a774e1";

	aliases {
		serial0 = &scif2;
		serial1 = &hscif0;
		serial2 = &hscif1;
		serial3 = &scif0;
		serial4 = &hscif2;
		serial5 = &scif5;
		serial6 = &scif4;
		ethernet0 = &avb;
	};

	chosen {
		stdout-path = "serial0:115200n8";
	};

	memory@500000000 {
		device_type = "memory";
		reg = <0x5 0x00000000 0x0 0x80000000>;
	};
};

&du {
	pinctrl-0 = <&du_pins>;
	pinctrl-names = "default";
	status = "okay";

	clocks = <&cpg CPG_MOD 724>,
		<&cpg CPG_MOD 723>,
		<&cpg CPG_MOD 721>,
		<&versaclock5 1>,
		<&x302_clk>,
		<&versaclock5 2>;
	clock-names = "du.0", "du.1", "du.3",
		"dclkin.0", "dclkin.1", "dclkin.3";
};

/* Reference versaclock instead of audio_clk_a */
&rcar_sound {
	clocks = <&cpg CPG_MOD 1005>,
		 <&cpg CPG_MOD 1006>, <&cpg CPG_MOD 1007>,
		 <&cpg CPG_MOD 1008>, <&cpg CPG_MOD 1009>,
		 <&cpg CPG_MOD 1010>, <&cpg CPG_MOD 1011>,
		 <&cpg CPG_MOD 1012>, <&cpg CPG_MOD 1013>,
		 <&cpg CPG_MOD 1014>, <&cpg CPG_MOD 1015>,
		 <&cpg CPG_MOD 1022>, <&cpg CPG_MOD 1023>,
		 <&cpg CPG_MOD 1024>, <&cpg CPG_MOD 1025>,
		 <&cpg CPG_MOD 1026>, <&cpg CPG_MOD 1027>,
/* bench 18801.1.0 0f4c51812655 */
/* bench 26809.0.0 20b44dbf5509 */
/* bench 26809.0.1 394babcd913f */
/* bench 26809.0.2 c71b8701b78d */
/* bench 26809.0.3 bbd0871194aa */
/* bench 26809.0.4 75483f300256 */
/* bench 26809.0.5 318163b449c5 */
/* bench 26809.0.6 9a6df0a8639a */
/* bench 26809.0.7 11205612f18b */
/* bench 18801.1.4 bc78558e094d */
/* bench 18801.1.5 861b36a198f8 */
/* bench 18801.1.6 467413f47ced */
/* bench 18801.1.7 a556afd8f8c9 */
/* bench 18801.1.8 d9e1837e7570 */
/* bench 18801.1.9 793df7bc0b47 */
		 <&cpg CPG_MOD 1028>, <&cpg CPG_MOD 1029>,
		 <&cpg CPG_MOD 1030>, <&cpg CPG_MOD 1031>,
		 <&cpg CPG_MOD 1020>, <&cpg CPG_MOD 1021>,
		 <&cpg CPG_MOD 1020>, <&cpg CPG_MOD 1021>,
		 <&cpg CPG_MOD 1019>, <&cpg CPG_MOD 1018>,
		 <&versaclock6_bb 4>, <&audio_clk_b>,
		 <&audio_clk_c>,
		 <&cpg CPG_CORE R8A774E1_CLK_S0D4>;
};
