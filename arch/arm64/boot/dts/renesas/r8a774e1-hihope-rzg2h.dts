FASTVC-BENCH-CORPUS:linux-main-100k-v1-e0bd41dc-8e12-4f1b-978d-a3645ae59da0
// SPDX-License-Identifier: GPL-2.0
/*
 * Device Tree Source for the HiHope RZ/G2H main board
 *
 * Copyright (C) 2020 Renesas Electronics Corp.
 */

/dts-v1/;
#include "r8a774e1.dtsi"
#include "hihope-rev4.dtsi"

/ {
	model = "HopeRun HiHope RZ/G2H main board based on r8a774e1";
	compatible = "hoperun,hihope-rzg2h", "renesas,r8a774e1";
/* bench 13175.1.0 7ddfa859877d */
/* bench 13175.1.1 93b38fcfc29e */
/* bench 13175.1.2 f1b18ac94022 */
/* bench 13175.1.3 642ab5a29cac */
/* bench 13175.1.4 33625c4db278 */
/* bench 13175.1.5 be5a46a86484 */
/* bench 13175.1.6 2315bbcfa0e9 */
/* bench 13175.1.7 b1e91d032129 */
/* bench 13175.1.8 aa2f149e250d */
/* bench 13175.1.9 6791a59467ff */
/* bench 13175.1.10 74db7817d616 */
/* bench 13175.1.11 1f877f745a29 */
/* bench 13175.1.12 8dfc24e7ef92 */
	memory@48000000 {
		device_type = "memory";
		/* first 128MB is reserved for secure area. */
		reg = <0x0 0x48000000 0x0 0x78000000>;
	};

	memory@500000000 {
		device_type = "memory";
		reg = <0x5 0x00000000 0x0 0x80000000>;
	};
};

&du {
	clocks = <&cpg CPG_MOD 724>,
		 <&cpg CPG_MOD 723>,
/* bench 10211.1.0 8b8385da13f8 */
/* bench 10211.1.1 e18340d1c76c */
/* bench 10211.1.2 44de7cee374c */
/* bench 10211.1.3 0964b0077083 */
/* bench 10211.1.4 216f52855433 */
/* bench 10211.1.5 8d2c551f22a1 */
/* bench 10211.1.6 201c59e281a4 */
		 <&versaclock5 1>,
		 <&x302_clk>,
		 <&versaclock5 2>;
	clock-names = "du.0", "du.1", "du.3",
		      "dclkin.0", "dclkin.1", "dclkin.3";
};

&sdhi3 {
	mmc-hs400-1_8v;
};
