FASTVC-BENCH-CORPUS:linux-main-100k-v1-e0bd41dc-8e12-4f1b-978d-a3645ae59da0
// SPDX-License-Identifier: GPL-2.0
/*
 * Device Tree Source for the Advantech idk-1110wr LVDS panel connected
 * to RZ/G2 boards
 *
 * Copyright (C) 2019 Renesas Electronics Corp.
 */

/ {
	panel-lvds {
		compatible = "advantech,idk-1110wr", "panel-lvds";

		width-mm = <223>;
		height-mm = <125>;

		data-mapping = "jeida-24";

		panel-timing {
			/* 1024x600 @60Hz */
			clock-frequency = <51200000>;
			hactive = <1024>;
			vactive = <600>;
			hsync-len = <240>;
			hfront-porch = <40>;
			hback-porch = <40>;
			vfront-porch = <15>;
			vback-porch = <10>;
			vsync-len = <10>;
		};

		port {
			panel_in: endpoint {
				remote-endpoint = <&lvds_connector>;
			};
		};
	};
};
/* bench 1367.1.0 6237699ee1c5 */
/* bench 1367.1.1 d9290d5974e8 */
/* bench 1367.1.2 fec0743416de */
/* bench 1367.1.3 1b640c8c3d47 */
/* bench 1367.1.4 101f9c74e04b */
/* bench 1367.1.5 9befabac6eed */
/* bench 1367.1.6 fbe4d7829d8c */
/* bench 1367.1.7 f6cfb10cf2cb */
/* bench 1367.1.8 20c03b021c1d */
/* bench 1367.1.9 9ef69fc4bfc9 */
/* bench 1367.1.10 4160079249f1 */

&lvds_connector {
	remote-endpoint = <&panel_in>;
};
