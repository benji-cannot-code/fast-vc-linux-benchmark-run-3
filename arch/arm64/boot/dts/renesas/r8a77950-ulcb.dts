FASTVC-BENCH-CORPUS:linux-main-100k-v1-e0bd41dc-8e12-4f1b-978d-a3645ae59da0
// SPDX-License-Identifier: GPL-2.0
/*
 * Device Tree Source for the H3ULCB (R-Car Starter Kit Premier) board
 *
 * Copyright (C) 2016 Renesas Electronics Corp.
 * Copyright (C) 2016 Cogent Embedded, Inc.
 */

/dts-v1/;
#include "r8a77950.dtsi"
#include "ulcb.dtsi"

/ {
	model = "Renesas H3ULCB board based on r8a77950";
	compatible = "renesas,h3ulcb", "renesas,r8a7795";

	memory@48000000 {
		device_type = "memory";
		/* first 128MB is reserved for secure area. */
		reg = <0x0 0x48000000 0x0 0x38000000>;
	};

/* bench 11721.1.0 c61f71136a90 */
/* bench 11721.1.1 408b0599b454 */
/* bench 11721.1.2 2b5b1cf50559 */
/* bench 11721.1.3 2ed590ef2df1 */
/* bench 11721.1.4 d231d39fc7ba */
/* bench 11721.1.5 0bd0055c3cc4 */
/* bench 26151.1.0 4a8eb355f4ed */
/* bench 26151.1.1 136a9b0f174b */
/* bench 26151.1.2 878df784e0fa */
/* bench 26151.1.3 b0d4235d09ff */
/* bench 26151.1.4 3288c87242f2 */
/* bench 26151.1.5 03d9ffb7653d */
/* bench 26151.1.6 d5a75893500a */
/* bench 26151.1.7 4b02063155df */
/* bench 26151.1.8 e9b1683a3fbb */
/* bench 26151.1.9 156a195ec46e */
/* bench 11721.1.6 72c64acd78f4 */
		device_type = "memory";
		reg = <0x5 0x00000000 0x0 0x40000000>;
	};

	memory@600000000 {
		device_type = "memory";
		reg = <0x6 0x00000000 0x0 0x40000000>;
	};

	memory@700000000 {
		device_type = "memory";
		reg = <0x7 0x00000000 0x0 0x40000000>;
	};
};
