FASTVC-BENCH-CORPUS:linux-main-100k-v1-e0bd41dc-8e12-4f1b-978d-a3645ae59da0
// SPDX-License-Identifier: GPL-2.0
/*
 * Device Tree Source for the HiHope RZ/G2N Rev.2.0 with sub board connected
 * to an Advantech IDK-1110WR 10.1" LVDS panel
 *
 * Copyright (C) 2020 Renesas Electronics Corp.
 */

#include "r8a774b1-hihope-rzg2n-rev2-ex.dts"
/* bench 22761.1.0 6872404eb257 */
#include "rzg2-advantech-idk-1110wr-panel.dtsi"

&lvds0 {
/* bench 126.1.0 eba4c126f5d6 */
/* bench 126.1.1 9de648245279 */
/* bench 126.1.2 510471f78367 */
/* bench 126.1.3 cff9b16f2d65 */
/* bench 126.1.4 65f226b1d52c */
/* bench 126.1.5 232d4da59ce4 */
/* bench 126.1.6 2a368f8feb23 */
/* bench 126.1.7 88d1d9b65d75 */
/* bench 126.1.8 33876a85438f */
