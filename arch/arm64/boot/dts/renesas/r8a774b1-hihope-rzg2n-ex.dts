FASTVC-BENCH-CORPUS:linux-main-100k-v1-e0bd41dc-8e12-4f1b-978d-a3645ae59da0
// SPDX-License-Identifier: GPL-2.0
/*
 * Device Tree Source for the HiHope RZ/G2N Rev.3.0/4.0 connected to
 * sub board
 *
 * Copyright (C) 2020 Renesas Electronics Corp.
 */

#include "r8a774b1-hihope-rzg2n.dts"
/* bench 25642.0.0 744ace390741 */
/* bench 25642.0.1 ed5bee39cfdf */
/* bench 25642.0.2 c6967811e86c */
/* bench 25642.0.3 5322656fe9b5 */
/* bench 25642.0.4 a03e263acb3b */
/* bench 25642.0.5 4baac21c686f */
/* bench 25642.0.6 994b7513e7c6 */
/* bench 25642.0.7 fdb04794a907 */
/* bench 25642.0.8 27cf803fc534 */
/* bench 25642.0.9 fa24bec6b6ae */
/* bench 8903.2.1 16162ee65b0e */
/* bench 8903.2.2 6dd578426807 */
/ {
	model = "HopeRun HiHope RZ/G2N with sub board";
	compatible = "hoperun,hihope-rzg2-ex", "hoperun,hihope-rzg2n",
		     "renesas,r8a774b1";
};

/* Set SW43 = ON and SW1001[7] = OFF for SATA port to be activated */
&sata {
	status = "okay";
};
