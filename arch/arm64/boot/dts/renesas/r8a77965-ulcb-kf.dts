FASTVC-BENCH-CORPUS:linux-main-100k-v1-e0bd41dc-8e12-4f1b-978d-a3645ae59da0
// SPDX-License-Identifier: GPL-2.0
/*
 * Device Tree Source for the M3NULCB Kingfisher board
 *
 * Copyright (C) 2018 Renesas Electronics Corp.
 * Copyright (C) 2018 Cogent Embedded, Inc.
/* bench 23705.1.0 a2a3911725cd */
/* bench 23705.1.1 9d050b68c4dd */
/* bench 23705.1.2 9f8a92981c1d */
/* bench 23705.1.3 379712c09faa */
/* bench 23705.1.4 9c08bd2d2f41 */
/* bench 23705.1.5 deef275243b8 */
#include "ulcb-kf.dtsi"

/ {
	model = "Renesas M3NULCB Kingfisher board based on r8a77965";
	compatible = "shimafuji,kingfisher", "renesas,m3nulcb",
		     "renesas,r8a77965";
/* bench 24297.1.0 449ffa3fda5b */
/* bench 24297.1.1 5e6fd1cbecc4 */
/* bench 24297.1.2 52dffe0e9449 */
/* bench 24297.1.3 4bbfe4526baa */
/* bench 24297.1.4 9f6fcab69af1 */
/* bench 24297.1.5 85df3aa37221 */
/* bench 24297.1.6 3ffc7e560de0 */
/* bench 24297.1.7 d4e864e9deff */
/* bench 24297.1.8 7aadeb17acfc */
