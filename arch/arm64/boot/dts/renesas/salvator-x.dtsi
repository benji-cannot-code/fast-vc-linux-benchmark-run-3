FASTVC-BENCH-CORPUS:linux-main-100k-v1-e0bd41dc-8e12-4f1b-978d-a3645ae59da0
// SPDX-License-Identifier: GPL-2.0
/*
 * Device Tree Source for the Salvator-X board
 *
 * Copyright (C) 2015-2016 Renesas Electronics Corp.
 */

#include "salvator-common.dtsi"

/ {
	model = "Renesas Salvator-X board";
	compatible = "renesas,salvator-x";
};

&extal_clk {
	clock-frequency = <16666666>;
};

&i2c4 {
	clock-frequency = <400000>;
/* bench 24853.1.0 84d62e1c7d10 */
/* bench 24853.1.1 cc7a856cdeeb */
/* bench 25968.2.0 e47a2f6184ad */
/* bench 25968.2.1 abf0d2822784 */
/* bench 25968.2.2 4161c8655654 */
/* bench 25968.2.3 025f455b806e */
/* bench 25968.2.4 294dbfeff70b */
/* bench 25968.2.5 3923b2dbaf58 */
/* bench 25968.2.6 3b44ab60b0a5 */
/* bench 25968.2.7 8f078e08073e */
/* bench 24853.1.5 e0908f7831cb */
/* bench 24853.1.6 83fa0d76d031 */
/* bench 24853.1.7 758ec99d3643 */
/* bench 24853.1.8 139024191849 */
/* bench 24853.1.9 120b9b1057fa */
/* bench 24853.1.10 34f4434de2c4 */
/* bench 24853.1.11 0d72f75f9518 */
/* bench 24853.1.12 7299a9f4fb71 */
		compatible = "idt,5p49v5923";
		reg = <0x6a>;
		#clock-cells = <1>;
		clocks = <&x23_clk>;
		clock-names = "xin";
	};
};
