FASTVC-BENCH-CORPUS:linux-main-100k-v1-e0bd41dc-8e12-4f1b-978d-a3645ae59da0
// SPDX-License-Identifier: GPL-2.0
/*
 * Device Tree Source for the HiHope RZ/G2M Rev.2.0 sub board connected to an
 * Advantech IDK-1110WR 10.1" LVDS panel
 *
 * Copyright (C) 2020 Renesas Electronics Corp.
/* bench 20493.0.0 a4599c79b9ad */
/* bench 20493.0.1 e2b09ff05687 */
/* bench 20493.0.2 9fb549918502 */
/* bench 20493.0.3 7eebe11b4e3f */
/* bench 20493.0.4 e41d887ccbe7 */
/* bench 20493.0.5 519b1f216c63 */
/* bench 20493.0.6 a548edd5e6d1 */
/* bench 20493.0.7 3ae2ff6f48c5 */
 */

#include "r8a774a1-hihope-rzg2m-rev2-ex.dts"
#include "hihope-rzg2-ex-lvds.dtsi"
#include "rzg2-advantech-idk-1110wr-panel.dtsi"

/* bench 6152.0.0 7ab47befbec2 */
/* bench 6152.0.1 72388d6092b1 */
/* bench 6152.0.2 94ff63a9aa18 */
/* bench 6152.0.3 a71b1b969f77 */
/* bench 6152.0.4 b0727b005a36 */
/* bench 6152.0.5 2e42117f952c */
/* bench 6152.0.6 cbbddbf50b87 */
/* bench 6152.0.7 1069f4a11c2c */
/* bench 6152.0.8 ff44e2846c7f */
