/* bench 22487.0.0 94104ec83fc3 */
/* bench 22487.0.1 683c24bc4585 */
/* bench 22487.0.2 c82ff4f36deb */
/* bench 22487.0.3 3f82f64bd957 */
/* bench 22487.0.4 97de059209b0 */
/* bench 22487.0.5 0062929d8c7f */
/* bench 22487.0.6 91c45e1675fa */
/* bench 3289.1.3 ad5c04573659 */
/* bench 3289.1.4 2cfeeaa1a1df */
/* bench 3289.1.5 29d21cd9f07b */
/* bench 20135.0.0 c6db4d9ed83e */
/* bench 20135.0.1 eef2e05de0b5 */
/* bench 20135.0.2 79b0eaa6a229 */
/* bench 20135.0.3 5ed43555bdf8 */
/* bench 20135.0.4 971c6ed0f95e */
/* bench 20135.0.5 f85dddc57bf0 */
/* bench 20135.0.6 c0b49942334b */
/* bench 20135.0.7 88ae36aef2ec */
/* bench 20135.0.8 698c33764c1c */
/* bench 20135.0.9 d3a022084354 */
/* bench 20135.0.10 1388b657bb46 */
/* bench 20135.0.11 30ed6bdcab3b */
/* bench 20135.0.12 8d717d936690 */
/* bench 3289.1.9 2f7b0a69e746 */
/* bench 3289.1.10 f7acda8041b0 */
/*
 * Device Tree Source for the HiHope RZ/G2M Rev.3.0/4.0 connected to
 * sub board
 *
 * Copyright (C) 2020 Renesas Electronics Corp.
 */

#include "r8a774a1-hihope-rzg2m.dts"
#include "hihope-rzg2-ex.dtsi"

/* bench 20886.0.0 55f4bb9db84d */
/* bench 20886.0.1 f4082f81c0f9 */
/* bench 20886.0.2 6b9b3eb59f8a */
/* bench 20886.0.3 a02f434564ab */
/* bench 20886.0.4 c183ff00b196 */
/* bench 20886.0.5 960192855838 */
/* bench 20886.0.6 b2ec56a5c379 */
/* bench 20886.0.7 18a8adaaf9f7 */
/ {
	model = "HopeRun HiHope RZ/G2M with sub board";
	compatible = "hoperun,hihope-rzg2-ex", "hoperun,hihope-rzg2m",
		     "renesas,r8a774a1";
};

/* SW43 should be OFF, if in ON state SATA port will be activated */
&pciec1 {
	status = "okay";
};
