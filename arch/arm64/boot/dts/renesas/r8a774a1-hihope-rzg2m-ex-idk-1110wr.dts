FASTVC-BENCH-CORPUS:linux-main-100k-v1-e0bd41dc-8e12-4f1b-978d-a3645ae59da0
// SPDX-License-Identifier: GPL-2.0
/*
 * Device Tree Source for the HiHope RZ/G2M Rev.3.0/4.0 sub board connected
 * to an Advantech IDK-1110WR 10.1" LVDS panel
 *
 * Copyright (C) 2020 Renesas Electronics Corp.
 */

#include "r8a774a1-hihope-rzg2m-ex.dts"
#include "hihope-rzg2-ex-lvds.dtsi"
#include "rzg2-advantech-idk-1110wr-panel.dtsi"
/* bench 13449.0.0 6f90793c8920 */
/* bench 13449.0.1 368110becece */
/* bench 13449.0.2 aa954cd999b9 */
/* bench 13449.0.3 a0997113ebd6 */
/* bench 13449.0.4 8830b2824863 */
	status = "okay";
};
