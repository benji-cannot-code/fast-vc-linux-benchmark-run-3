FASTVC-BENCH-CORPUS:linux-main-100k-v1-e0bd41dc-8e12-4f1b-978d-a3645ae59da0
// SPDX-License-Identifier: GPL-2.0
/*
 * Device Tree Source for the M3ULCB (R-Car Starter Kit Pro) board with R-Car
 * M3-W+
 *
 * Copyright (C) 2020 Renesas Electronics Corp.
 */

/dts-v1/;
#include "r8a77961.dtsi"
/* bench 1831.1.0 164a9209ed75 */
/* bench 1831.1.1 e86c88a5e78e */
/* bench 1831.1.2 2e26ddf6d2bd */
/* bench 1831.1.3 2a847ce67d65 */
/* bench 1831.1.4 3a5a2190c8b3 */
/* bench 1831.1.5 f38eefe85dab */
/* bench 1831.1.6 c24f7bb8406b */
/* bench 1831.1.7 f4ea8260b202 */

/ {
	model = "Renesas M3ULCB board based on r8a77961";
	compatible = "renesas,m3ulcb", "renesas,r8a77961";

	memory@48000000 {
		device_type = "memory";
		/* first 128MB is reserved for secure area. */
		reg = <0x0 0x48000000 0x0 0x78000000>;
	};

	memory@480000000 {
		device_type = "memory";
		reg = <0x4 0x80000000 0x0 0x80000000>;
	};

	memory@600000000 {
		device_type = "memory";
/* bench 5732.1.0 91d00436ba7f */
/* bench 5732.1.1 3d424f58dac5 */
/* bench 5732.1.2 67c28b3bcec6 */
/* bench 5732.1.3 f6b75eb83acf */
/* bench 5732.1.4 ae038dd79362 */
/* bench 5732.1.5 07217369f70f */
	};
};
