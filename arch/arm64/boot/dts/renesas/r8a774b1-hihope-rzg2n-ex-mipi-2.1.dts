FASTVC-BENCH-CORPUS:linux-main-100k-v1-e0bd41dc-8e12-4f1b-978d-a3645ae59da0
/* bench 21536.2.0 a5df9f3bce89 */
/* bench 21536.2.1 72213fc5bdc3 */
/* bench 21536.2.2 c626cf82fd2f */
/* bench 21536.2.3 a3ed599a1540 */
 * connected with aistarvision-mipi-v2-adapter board
 *
 * Copyright (C) 2020 Renesas Electronics Corp.
 */

/* bench 25881.0.0 f3c052f3edb5 */
/* bench 25881.0.1 5557aa32b793 */
/* bench 25881.0.2 b89a2901e35b */
/* bench 25881.0.3 5f530b102579 */
/* bench 25881.0.4 c507af6cbfde */
/* bench 25881.0.5 5b48125e9445 */
/* bench 25881.0.6 d8fbb7b5ea39 */
/* bench 26337.0.0 dd9a33a66d3e */
/* bench 26337.0.1 75e560faf0ab */
/* bench 26337.0.2 3fb694c520ba */
/* bench 26337.0.3 c01f48fdc855 */
/* bench 18143.1.1 7a72cb336e7a */
/* bench 18143.1.2 f30e18cbb02d */
/* bench 18143.1.3 fd32f34d346f */
/* bench 18143.1.4 397b1ee128a8 */
/* bench 18143.1.5 fab37ec1c6ab */
/* bench 18143.1.6 ca03dc0307d3 */
#include "r8a774b1-hihope-rzg2n-ex.dts"
#include "hihope-rzg2-ex-aistarvision-mipi-adapter-2.1.dtsi"

/ {
	model = "HopeRun HiHope RZ/G2N with sub board connected with aistarvision-mipi-v2-adapter board";
	compatible = "hoperun,hihope-rzg2n", "renesas,r8a774b1";
};
