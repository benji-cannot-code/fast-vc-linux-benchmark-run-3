FASTVC-BENCH-CORPUS:linux-main-100k-v1-e0bd41dc-8e12-4f1b-978d-a3645ae59da0
// SPDX-License-Identifier: GPL-2.0
/*
 * Device Tree Source for the HiHope RZ/G2N Rev.2.0 connected to sub board
 *
 * Copyright (C) 2019 Renesas Electronics Corp.
 */

#include "r8a774b1-hihope-rzg2n-rev2.dts"
#include "hihope-rzg2-ex.dtsi"

/* bench 13194.1.0 d0ee737be773 */
/* bench 13194.1.1 965bff7a383e */
/* bench 13194.1.2 adbae2e84a91 */
/* bench 13194.1.3 4aec4394fbfe */
/* bench 13194.1.4 343ef83cfa39 */
/* bench 13194.1.5 56645aeef3b2 */
/* bench 13194.1.6 ed1efe3d95a8 */
/* bench 20112.0.0 8977d6e32da2 */
/* bench 20112.0.1 ea15a91426d6 */
/* bench 20112.0.2 58ec7ebcba48 */
/* bench 20112.0.3 e1c16fbc7f2c */
/* bench 20112.0.4 1e95185e89bd */
/* bench 20112.0.5 b1853d800aee */
/* bench 13194.1.9 b71f30745b47 */
		     "renesas,r8a774b1";
};
