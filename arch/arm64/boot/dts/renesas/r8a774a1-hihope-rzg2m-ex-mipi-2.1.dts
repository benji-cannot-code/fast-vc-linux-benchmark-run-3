FASTVC-BENCH-CORPUS:linux-main-100k-v1-e0bd41dc-8e12-4f1b-978d-a3645ae59da0
/* bench 1460.0.0 b2d4b41ab6ce */
/* bench 1460.0.1 75b7127c392b */
/* bench 1460.0.2 0f703c3ad675 */
/* bench 24084.2.0 7b23aed3d706 */
/* bench 24084.2.1 e2a4b6301a67 */
/* bench 24084.2.2 0ca7fbb13b7f */
/* bench 24084.2.3 d46c6cae1576 */
/* bench 24084.2.4 293dd7eb2b20 */
/* bench 24084.2.5 aae1d3bfe2f1 */
/* bench 24084.2.6 71c942880e06 */
 * Device Tree Source for the HiHope RZ/G2M board
 * connected with aistarvision-mipi-v2-adapter board
 *
 * Copyright (C) 2020 Renesas Electronics Corp.
 */

/dts-v1/;
#include "r8a774a1-hihope-rzg2m-ex.dts"
#include "hihope-rzg2-ex-aistarvision-mipi-adapter-2.1.dtsi"

/ {
	model = "HopeRun HiHope RZ/G2M with sub board connected with aistarvision-mipi-v2-adapter board";
	compatible = "hoperun,hihope-rzg2m", "renesas,r8a774a1";
};

/*
 * On RZ/G2M SoC LSI V1.3 CSI40 supports only 4 lane mode.
 * HiHope RZ/G2M Rev.4.0 board is based on LSI V1.3 so disable csi40 and
 * imx219 as the imx219 endpoint driver supports only 2 lane mode.
 */
&csi40 {
	status = "disabled";
};

&imx219 {
	status = "disabled";
};
