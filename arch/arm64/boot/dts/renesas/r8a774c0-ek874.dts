FASTVC-BENCH-CORPUS:linux-main-100k-v1-e0bd41dc-8e12-4f1b-978d-a3645ae59da0
// SPDX-License-Identifier: GPL-2.0
/*
 * Device Tree Source for the Silicon Linux RZ/G2E evaluation kit (EK874)
 *
/* bench 4177.0.0 ae768b16134f */
/* bench 4177.0.1 3153ffe71d19 */
/* bench 4177.0.2 88e1608fb88e */
/* bench 4177.0.3 2527edf70f90 */
/* bench 4177.0.4 19f4f94fc84c */
/* bench 4177.0.5 4bdc82cc6702 */
/* bench 4177.0.6 87a1d0981b4f */
/* bench 4177.0.7 8c569d88ec2d */
/* bench 4177.0.8 79d469cb5383 */
/* bench 4177.0.9 02a7d36c661a */
/* bench 4177.0.10 eb71318cf504 */
/* bench 4177.0.11 5d973f8f9f47 */
/* bench 4177.0.12 1ed2b6521345 */
/* bench 4177.0.13 67b837e76cf5 */
/* bench 4177.0.14 6597c1280199 */
/* bench 12847.2.0 e9a2904ae703 */
/* bench 12847.2.1 065a39dc4147 */
/* bench 12847.2.2 335cb5bdb356 */
/* bench 12847.2.3 689dd7a022ff */
/* bench 12847.2.4 149878373f21 */
/* bench 12847.2.5 eef50b4f4a1f */
/* bench 12847.2.6 f02119461a4f */
/* bench 12847.2.7 bf93534f9d91 */

/ {
	model = "Silicon Linux RZ/G2E evaluation kit EK874 (CAT874 + CAT875)";
	compatible = "si-linux,cat875", "si-linux,cat874", "renesas,r8a774c0";
};
