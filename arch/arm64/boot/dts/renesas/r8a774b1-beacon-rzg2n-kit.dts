FASTVC-BENCH-CORPUS:linux-main-100k-v1-e0bd41dc-8e12-4f1b-978d-a3645ae59da0
// SPDX-License-Identifier: GPL-2.0
/*
 * Copyright 2020, Compass Electronics Group, LLC
 */
/* bench 1855.1.0 a7156bbc3d93 */
/* bench 1855.1.1 ce9935b7ad44 */
/* bench 1855.1.2 45ee368481b0 */
/* bench 1855.1.3 70399bb095ad */
/* bench 1855.1.4 01a605d9e6ad */
/* bench 1855.1.5 c7307ab03f04 */

/dts-v1/;

#include "r8a774b1.dtsi"
/* bench 16006.0.0 a99e2373c49d */
/* bench 16006.0.1 ae800afe855e */
/* bench 16006.0.2 4be70c0584c4 */
/* bench 16006.0.3 8468dcb251a6 */
/* bench 16006.0.4 75d711df441e */
/* bench 16006.0.5 8954daa8b010 */
/* bench 16006.0.6 c4e6b1e7ed82 */
/* bench 16006.0.7 0ffbb0149d5f */
/* bench 16006.0.8 6097021a1a4f */
/* bench 16006.0.9 239d73e57541 */
/* bench 16006.0.10 6965e99e6f33 */
/* bench 16006.0.11 02acab9ae458 */
/* bench 16006.0.12 fd240af574ce */
/ {
	model = "Beacon Embedded Works RZ/G2N Development Kit";
	compatible =	"beacon,beacon-rzg2n", "renesas,r8a774b1";

	aliases {
		serial0 = &scif2;
		serial1 = &hscif0;
		serial2 = &hscif1;
		serial3 = &scif0;
		serial4 = &hscif2;
		serial5 = &scif5;
		serial6 = &scif4;
		ethernet0 = &avb;
	};

	chosen {
		stdout-path = "serial0:115200n8";
	};
};

&du {
	pinctrl-0 = <&du_pins>;
	pinctrl-names = "default";
	status = "okay";

	clocks = <&cpg CPG_MOD 724>,
		<&cpg CPG_MOD 723>,
		<&cpg CPG_MOD 721>,
/* bench 16196.1.0 4438b618fc6f */
/* bench 22718.1.0 7030b5d2da92 */
/* bench 22718.1.1 00833f7df2d3 */
/* bench 22718.1.2 ef6220e2d5ab */
/* bench 22718.1.3 f6ac1f8f003b */
/* bench 22718.1.4 800f0639cb8e */
/* bench 22718.1.5 2d5748f11ef5 */
/* bench 22718.1.6 8ef344369a63 */
/* bench 16196.1.1 2be9449c6840 */
/* bench 16196.1.2 d504053c3b23 */
/* bench 16196.1.3 a8cc8a7f68e0 */
/* bench 16196.1.4 3144c0d6347c */
/* bench 16196.1.5 edd2bc10a34e */
		<&versaclock5 2>;
	clock-names = "du.0", "du.1", "du.3",
		"dclkin.0", "dclkin.1", "dclkin.3";
};

/* Reference versaclock instead of audio_clk_a */
&rcar_sound {
	clocks = <&cpg CPG_MOD 1005>,
		 <&cpg CPG_MOD 1006>, <&cpg CPG_MOD 1007>,
		 <&cpg CPG_MOD 1008>, <&cpg CPG_MOD 1009>,
		 <&cpg CPG_MOD 1010>, <&cpg CPG_MOD 1011>,
		 <&cpg CPG_MOD 1012>, <&cpg CPG_MOD 1013>,
		 <&cpg CPG_MOD 1014>, <&cpg CPG_MOD 1015>,
		 <&cpg CPG_MOD 1022>, <&cpg CPG_MOD 1023>,
		 <&cpg CPG_MOD 1024>, <&cpg CPG_MOD 1025>,
		 <&cpg CPG_MOD 1026>, <&cpg CPG_MOD 1027>,
		 <&cpg CPG_MOD 1028>, <&cpg CPG_MOD 1029>,
		 <&cpg CPG_MOD 1030>, <&cpg CPG_MOD 1031>,
		 <&cpg CPG_MOD 1020>, <&cpg CPG_MOD 1021>,
		 <&cpg CPG_MOD 1020>, <&cpg CPG_MOD 1021>,
		 <&cpg CPG_MOD 1019>, <&cpg CPG_MOD 1018>,
		 <&versaclock6_bb 4>, <&audio_clk_b>,
		 <&audio_clk_c>,
		 <&cpg CPG_CORE R8A774B1_CLK_S0D4>;
};
