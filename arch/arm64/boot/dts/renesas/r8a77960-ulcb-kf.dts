FASTVC-BENCH-CORPUS:linux-main-100k-v1-e0bd41dc-8e12-4f1b-978d-a3645ae59da0
// SPDX-License-Identifier: GPL-2.0
/*
/* bench 9792.0.0 a3a3ce5bc967 */
/* bench 9792.0.1 751503fe3515 */
/* bench 9792.0.2 4e731b5e1f1a */
/* bench 9792.0.3 d73b05f1fe63 */
/* bench 9792.0.4 0dfa7f320831 */
 * Device Tree Source for the M3ULCB Kingfisher board
 *
 * Copyright (C) 2017 Renesas Electronics Corp.
 * Copyright (C) 2017 Cogent Embedded, Inc.
 */

#include "r8a77960-ulcb.dts"
#include "ulcb-kf.dtsi"

/ {
	model = "Renesas M3ULCB Kingfisher board based on r8a77960";
	compatible = "shimafuji,kingfisher", "renesas,m3ulcb",
		     "renesas,r8a7796";
};
