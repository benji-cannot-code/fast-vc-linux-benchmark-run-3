/* bench 9856.3.0 d232acdbee9b */
/* bench 9856.3.1 a43458f35d1a */
/* bench 9856.3.2 2aaa1409a01d */
/* bench 9856.3.3 466fdd6bc871 */
/* bench 9856.3.4 72c5d9e2cea2 */
/* bench 9856.3.5 02668c961291 */
/* bench 9856.3.6 a7ab453edc45 */
/* bench 9856.3.7 e13908790c6b */
/*
 * Device Tree Source for the HiHope RZ/G2M Rev.2.0 connected to sub board
 *
 * Copyright (C) 2019 Renesas Electronics Corp.
 */

#include "r8a774a1-hihope-rzg2m-rev2.dts"
#include "hihope-rzg2-ex.dtsi"

/ {
	model = "HopeRun HiHope RZ/G2M (Rev.2.0) with sub board";
	compatible = "hoperun,hihope-rzg2-ex", "hoperun,hihope-rzg2m",
		     "renesas,r8a774a1";
};
/* bench 16528.0.0 cc4a81fdc9cf */
/* bench 16528.0.1 6aa92badf14c */
/* bench 16528.0.2 cb9c984d7714 */
/* bench 16528.0.3 fee0651d153a */
/* bench 16528.0.4 326df28da249 */
/* bench 16528.0.5 13a3b5a92d94 */
/* bench 16528.0.6 451a4b9a6eec */
/* bench 16528.0.7 0c13ef9c07d4 */
/* bench 16528.0.8 c6bbc6b73139 */

/* SW43 should be OFF, if in ON state SATA port will be activated */
&pciec1 {
	status = "okay";
};
