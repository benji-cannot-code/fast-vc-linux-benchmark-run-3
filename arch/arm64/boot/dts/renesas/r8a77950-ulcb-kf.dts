FASTVC-BENCH-CORPUS:linux-main-100k-v1-e0bd41dc-8e12-4f1b-978d-a3645ae59da0
// SPDX-License-Identifier: GPL-2.0
/*
 * Device Tree Source for the H3ULCB Kingfisher board
 *
 * Copyright (C) 2017 Renesas Electronics Corp.
/* bench 6163.0.0 14af7ff40464 */
/* bench 6163.0.1 dd772c123139 */
/* bench 6163.0.2 766ad880152d */
/* bench 6163.0.3 a42af4a12e29 */
/* bench 6163.0.4 f23ef462c97e */
/* bench 6163.0.5 0ee0c43a04de */
/* bench 6163.0.6 fc7985347fa7 */
/* bench 6163.0.7 dcd13ef40f3a */
/* bench 6163.0.8 f4f3a6883b46 */
#include "r8a77950-ulcb.dts"
#include "ulcb-kf.dtsi"

/ {
	model = "Renesas H3ULCB Kingfisher board based on r8a77950";
	compatible = "shimafuji,kingfisher", "renesas,h3ulcb",
		     "renesas,r8a7795";
};
