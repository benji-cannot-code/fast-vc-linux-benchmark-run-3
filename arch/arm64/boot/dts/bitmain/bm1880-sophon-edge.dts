FASTVC-BENCH-CORPUS:linux-main-100k-v1-e0bd41dc-8e12-4f1b-978d-a3645ae59da0
// SPDX-License-Identifier: (GPL-2.0+ OR MIT)
/*
 * Copyright (c) 2019 Linaro Ltd.
 * Author: Manivannan Sadhasivam <manivannan.sadhasivam@linaro.org>
 */

/dts-v1/;

#include "bm1880.dtsi"

/ {
	compatible = "bitmain,sophon-edge", "bitmain,bm1880";
	model = "Sophon Edge";

	aliases {
		serial0 = &uart0;
		serial1 = &uart2;
		serial2 = &uart1;
	};

	chosen {
		stdout-path = "serial0:115200n8";
	};

	memory@0 {
		device_type = "memory";
		reg = <0x1 0x00000000 0x0 0x40000000>; // 1GB
	};

	uart_clk: uart-clk {
		compatible = "fixed-clock";
		clock-frequency = <500000000>;
		#clock-cells = <0>;
	};
};

&uart0 {
	status = "okay";
	clocks = <&uart_clk>;
};

&uart1 {
	status = "okay";
	clocks = <&uart_clk>;
};

&uart2 {
	status = "okay";
	clocks = <&uart_clk>;
};
