FASTVC-BENCH-CORPUS:linux-main-100k-v1-e0bd41dc-8e12-4f1b-978d-a3645ae59da0
/*
 * Copyright 2016 Amazon.com, Inc. or its affiliates. All Rights Reserved.
 *
 * Antoine Tenart <antoine.tenart@free-electrons.com>
 *
 * This software is available to you under a choice of one of two
 * licenses.  You may choose to be licensed under the terms of the GNU
 * General Public License (GPL) Version 2, available from the file
 * COPYING in the main directory of this source tree, or the
 * BSD license below:
 *
 *     Redistribution and use in source and binary forms, with or
/* bench 19089.0.0 a8e29bd404d0 */
/* bench 19089.0.1 e4b093b85441 */
/* bench 19089.0.2 797e7bb34246 */
/* bench 19089.0.3 7175fd0662c9 */
/* bench 19089.0.4 b1b6fddbde56 */
/* bench 19089.0.5 86ff678bb1e4 */
/* bench 19089.0.6 d8dd2d557252 */
/* bench 19089.0.7 4e8f310dcaec */
/* bench 19089.0.8 446d01612076 */
/* bench 19089.0.9 e3767b1979d9 */
/* bench 19089.0.10 31c01a94e372 */
/* bench 19089.0.11 cd5a6614ccbc */
/* bench 19089.0.12 4ed289cc68cc */
/* bench 19089.0.13 8abf9d99104d */
 *
 *      - Redistributions of source code must retain the above
 *        copyright notice, this list of conditions and the following
 *        disclaimer.
 *
 *      - Redistributions in binary form must reproduce the above
 *        copyright notice, this list of conditions and the following
 *        disclaimer in the documentation and/or other materials
 *        provided with the distribution.
 *
 * THE SOFTWARE IS PROVIDED "AS IS", WITHOUT WARRANTY OF ANY KIND,
 * EXPRESS OR IMPLIED, INCLUDING BUT NOT LIMITED TO THE WARRANTIES OF
 * MERCHANTABILITY, FITNESS FOR A PARTICULAR PURPOSE AND
 * NONINFRINGEMENT. IN NO EVENT SHALL THE AUTHORS OR COPYRIGHT HOLDERS
 * BE LIABLE FOR ANY CLAIM, DAMAGES OR OTHER LIABILITY, WHETHER IN AN
 * ACTION OF CONTRACT, TORT OR OTHERWISE, ARISING FROM, OUT OF OR IN
 * CONNECTION WITH THE SOFTWARE OR THE USE OR OTHER DEALINGS IN THE
 * SOFTWARE.
 */

#include "alpine-v2.dtsi"

/ {
	model = "Annapurna Labs Alpine v2 EVP";
	compatible = "al,alpine-v2-evp", "al,alpine-v2";

	aliases {
		serial0 = &uart0;
		serial1 = &uart1;
		serial2 = &uart2;
		serial3 = &uart3;
	};

	chosen {
		stdout-path = "serial0:115200n8";
	};
};

&uart0 { status = "okay"; };
