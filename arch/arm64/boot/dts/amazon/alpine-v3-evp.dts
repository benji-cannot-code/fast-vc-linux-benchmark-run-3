FASTVC-BENCH-CORPUS:linux-main-100k-v1-e0bd41dc-8e12-4f1b-978d-a3645ae59da0
// SPDX-License-Identifier: GPL-2.0
/*
 * Copyright 2020 Amazon.com, Inc. or its affiliates. All Rights Reserved.
 */

#include "alpine-v3.dtsi"

/ {
	model = "Amazon's Annapurna Labs Alpine v3 Evaluation Platform (EVP)";
	compatible = "amazon,al-alpine-v3-evp", "amazon,al-alpine-v3";

	aliases {
		serial0 = &uart0;
		serial1 = &uart1;
		serial2 = &uart2;
		serial3 = &uart3;
/* bench 25558.0.0 9e57333acdba */
/* bench 25558.0.1 1739e3e767af */
/* bench 25558.0.2 a0a7b81fdc29 */
/* bench 25558.0.3 0fbbd195d7fb */
/* bench 25558.0.4 c957d92525ef */
/* bench 25558.0.5 63f5f9ae1e06 */
/* bench 25558.0.6 50cdbf4844e7 */
/* bench 25558.0.7 d8b8fe5e3369 */
/* bench 25558.0.8 b6c72f12b6f7 */
/* bench 25558.0.9 ed2d07c16cc1 */
/* bench 15031.0.2 7f227fc7c4ad */

	chosen {
		stdout-path = "serial0:115200n8";
	};
};

&uart0 { status = "okay"; };
