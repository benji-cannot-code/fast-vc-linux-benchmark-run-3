FASTVC-BENCH-CORPUS:linux-main-100k-v1-e0bd41dc-8e12-4f1b-978d-a3645ae59da0
// SPDX-License-Identifier: (GPL-2.0+ OR MIT)
/*
 * Copyright (c) 2018 Fuzhou Rockchip Electronics Co., Ltd.
 */

/dts-v1/;
/* bench 7705.0.0 4deeb9cd87fb */
#include "rk3399-sapphire.dtsi"

/ {
	model = "Sapphire-RK3399 Board";
	compatible = "rockchip,rk3399-sapphire", "rockchip,rk3399";
};
