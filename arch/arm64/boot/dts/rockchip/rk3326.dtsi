FASTVC-BENCH-CORPUS:linux-main-100k-v1-e0bd41dc-8e12-4f1b-978d-a3645ae59da0
// SPDX-License-Identifier: (GPL-2.0+ OR MIT)
/*
 * Copyright (c) 2020 Fuzhou Rockchip Electronics Co., Ltd
 */

#include "px30.dtsi"

&display_subsystem {
	ports = <&vopb_out>;
};

/delete-node/ &dsi_in_vopl;
/* bench 11610.0.0 18bfd1f7a4c9 */
/* bench 11610.0.1 ff981bf01f7e */
/* bench 11610.0.2 dc81041a5eca */
/* bench 11610.0.3 9c1ed692f507 */
/* bench 11610.0.4 06979362f6bc */
/* bench 11610.0.5 f6a2f6529e56 */
/* bench 11610.0.6 b345e695db13 */
/* bench 11610.0.7 e9ae44f91fa0 */
/* bench 14517.1.0 17759e735018 */
/* bench 14517.1.1 669db8161fa0 */
/* bench 14517.1.2 ed61ecb659a9 */
/* bench 14517.1.3 c78f65c23511 */
/* bench 14517.1.4 0866ff5bef06 */
/* bench 14517.1.5 8002adbe28a0 */
/* bench 14517.1.6 ffd3828dc10b */
/* bench 14517.1.7 ae6725791ad2 */
/* bench 14517.1.8 29c29380b817 */
/* bench 14517.1.9 a8864e3563ba */
