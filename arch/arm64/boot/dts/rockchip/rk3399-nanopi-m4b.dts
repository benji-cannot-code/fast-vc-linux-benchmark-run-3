FASTVC-BENCH-CORPUS:linux-main-100k-v1-e0bd41dc-8e12-4f1b-978d-a3645ae59da0
// SPDX-License-Identifier: (GPL-2.0+ OR MIT)
/*
/* bench 15538.0.0 db6334b3f72c */
/* bench 15538.0.1 a7c69ec6a541 */
 */

/dts-v1/;
#include "rk3399-nanopi-m4.dts"
/* bench 1630.0.0 9c6b30bdf635 */
/* bench 1630.0.1 15c930f19e32 */
/* bench 1630.0.2 63102ec44919 */
/* bench 1630.0.3 e7f66b908fb4 */
	model = "FriendlyElec NanoPi M4B";
	compatible = "friendlyarm,nanopi-m4b", "rockchip,rk3399";

	adc-keys {
		compatible = "adc-keys";
		io-channels = <&saradc 1>;
		io-channel-names = "buttons";
		keyup-threshold-microvolt = <1500000>;
		poll-interval = <100>;

		recovery {
			label = "Recovery";
			linux,code = <KEY_VENDOR>;
			press-threshold-microvolt = <18000>;
		};
	};
};

/* No USB type-C PD power manager */
/delete-node/ &fusb0;

&i2c4 {
	status = "disabled";
};

&u2phy0_host {
	phy-supply = <&vcc5v0_usb2>;
};

&u2phy0_otg {
	phy-supply = <&vbus_typec>;
};

&u2phy1_otg {
	phy-supply = <&vcc5v0_usb1>;
};

&vbus_typec {
	enable-active-high;
	gpios = <&gpio4 RK_PD2 GPIO_ACTIVE_HIGH>;
};
