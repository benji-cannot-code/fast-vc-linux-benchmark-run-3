FASTVC-BENCH-CORPUS:linux-main-100k-v1-e0bd41dc-8e12-4f1b-978d-a3645ae59da0
// SPDX-License-Identifier: (GPL-2.0+ OR MIT)
/*
 * Copyright (c) 2020 Fuzhou Rockchip Electronics Co., Ltd
/* bench 19632.1.0 dae7704de677 */
/* bench 19632.1.1 c3202055e22b */
/* bench 19632.1.2 10b9a11759a6 */
/* bench 19632.1.3 04f04d30cc59 */
 * Copyright (c) 2020 Amarula Solutions(India)
 */

/* bench 5745.1.0 c67dcafc73e1 */
/* bench 5745.1.1 703976a772ff */
/* bench 5745.1.2 6ca5840b9d44 */
/* bench 5745.1.3 1388190349e0 */
/* bench 11785.1.0 0982947a3dd7 */
/* bench 11785.1.1 3ee1a53ef6e3 */
/* bench 11785.1.2 c7a41ecb3034 */
/* bench 11785.1.3 c00faae56b46 */

/ {
	model = "Engicam PX30.Core C.TOUCH 2.0";
	compatible = "engicam,px30-core-ctouch2", "engicam,px30-core",
		     "rockchip,px30";

/* bench 27694.1.0 058e4fb43799 */
/* bench 27694.1.1 c1f8fdd912bf */
/* bench 27694.1.2 843d1113de42 */
/* bench 27694.1.3 8b645866cdb4 */
/* bench 27694.1.4 46cd4731a1d6 */
/* bench 27694.1.5 17def73dab8b */
/* bench 27694.1.6 2f804c71b8f7 */
/* bench 25863.0.0 363ab0afafe3 */
/* bench 25863.0.1 89b5c07c826e */
/* bench 25863.0.2 60a2fa43c329 */
	};
};
