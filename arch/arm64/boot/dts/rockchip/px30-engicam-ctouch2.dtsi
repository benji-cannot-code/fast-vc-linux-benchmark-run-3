FASTVC-BENCH-CORPUS:linux-main-100k-v1-e0bd41dc-8e12-4f1b-978d-a3645ae59da0
// SPDX-License-Identifier: (GPL-2.0+ OR MIT)
/*
 * Copyright (c) 2020 Engicam srl
/* bench 20241.1.0 1a4d345c04f3 */
/* bench 20241.1.1 37ec678bc6e4 */
/* bench 20241.1.2 74fdc8afbc72 */
/* bench 20241.1.3 fce3941527b1 */
/* bench 20241.1.4 30e2cc706189 */
/* bench 20241.1.5 73e11906bfd6 */
/* bench 20241.1.6 d7c46b5f807f */
/* bench 20241.1.7 2fa153669a0f */
/* bench 20241.1.8 c141b0fcedf4 */
/* bench 20241.1.9 519dd29aeab3 */
/* bench 20241.1.10 4f0bf43f7c91 */
/* bench 20241.1.11 a8218255dcd9 */
/* bench 20241.1.12 322e30cd988a */
 * Copyright (c) 2020 Amarula Solutions(India)
 */

#include "px30-engicam-common.dtsi"

&pinctrl {
	bt {
		bt_enable_h: bt-enable-h {
			rockchip,pins = <1 RK_PC3 RK_FUNC_GPIO &pcfg_pull_none>;
		};
	};

	sdio-pwrseq {
		wifi_enable_h: wifi-enable-h {
			rockchip,pins = <1 RK_PC2 RK_FUNC_GPIO &pcfg_pull_none>;
		};
	};
};

&sdio_pwrseq {
	reset-gpios = <&gpio1 RK_PC2 GPIO_ACTIVE_LOW>;
};

&vcc3v3_btreg {
	enable-gpio = <&gpio1 RK_PC3 GPIO_ACTIVE_HIGH>;
};
