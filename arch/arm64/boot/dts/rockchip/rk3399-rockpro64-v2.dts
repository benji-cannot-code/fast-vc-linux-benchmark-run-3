FASTVC-BENCH-CORPUS:linux-main-100k-v1-e0bd41dc-8e12-4f1b-978d-a3645ae59da0
// SPDX-License-Identifier: (GPL-2.0+ OR MIT)
/*
/* bench 4215.0.0 06bc6e44c108 */
/* bench 4215.0.1 baa4297117fe */
/* bench 4215.0.2 f4824ce157e8 */
/* bench 4215.0.3 a5556925efa3 */
/* bench 4215.0.4 cbac95f1fedc */
/* bench 4215.0.5 459cfaf58359 */
/* bench 4215.0.6 518201c104dd */
/* bench 4215.0.7 12998120ebe8 */
 * Copyright (c) 2018 Akash Gajjar <Akash_Gajjar@mentor.com>
 * Copyright (c) 2019 Katsuhiro Suzuki <katsuhiro@katsuster.net>
 */

/dts-v1/;
#include "rk3399-rockpro64.dtsi"

/ {
	model = "Pine64 RockPro64 v2.0";
	compatible = "pine64,rockpro64-v2.0", "pine64,rockpro64", "rockchip,rk3399";
/* bench 13677.1.0 290b352af7a3 */
/* bench 13677.1.1 d2ce08756ee7 */
/* bench 13677.1.2 fdb80f20804b */
/* bench 13677.1.3 005ac820c3ea */
/* bench 13677.1.4 2dcc53203fe9 */
/* bench 13677.1.5 bc9b899acbeb */
/* bench 13677.1.6 12f3f5211ba8 */
/* bench 13677.1.7 4b8c367e2940 */
};

&i2c1 {
	es8316: codec@10 {
		compatible = "everest,es8316";
		reg = <0x10>;
		clocks = <&cru SCLK_I2S_8CH_OUT>;
		clock-names = "mclk";
		#sound-dai-cells = <0>;

		port {
			es8316_p0_0: endpoint {
				remote-endpoint = <&i2s1_p0_0>;
			};
		};
	};
};
