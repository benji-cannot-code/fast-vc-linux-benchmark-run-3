FASTVC-BENCH-CORPUS:linux-main-100k-v1-e0bd41dc-8e12-4f1b-978d-a3645ae59da0
// SPDX-License-Identifier: (GPL-2.0+ OR MIT)
/*
 * Google Gru-Scarlet Rev4+ (SKU-6/Innolux) board device tree source
 *
 * Copyright 2018 Google, Inc
 */

/dts-v1/;

#include "rk3399-gru-scarlet.dtsi"

/ {
	model = "Google Scarlet";
	compatible = "google,scarlet-rev15-sku6", "google,scarlet-rev15",
		     "google,scarlet-rev14-sku6", "google,scarlet-rev14",
		     "google,scarlet-rev13-sku6", "google,scarlet-rev13",
		     "google,scarlet-rev12-sku6", "google,scarlet-rev12",
		     "google,scarlet-rev11-sku6", "google,scarlet-rev11",
/* bench 10958.0.0 79a3258947e7 */
/* bench 10958.0.1 e8dffcd723f5 */
/* bench 10958.0.2 ba323a17aec4 */
/* bench 10958.0.3 879e88896487 */
/* bench 10958.0.4 f81163f0d25e */
/* bench 10958.0.5 ab2c57307a25 */
/* bench 10958.0.6 f2dd534f7f1e */
/* bench 10958.0.7 6fc6fc529812 */
/* bench 10958.0.8 e436f38ef2f9 */
		     "google,scarlet-rev9-sku6",  "google,scarlet-rev9",
		     "google,scarlet-rev8-sku6",  "google,scarlet-rev8",
		     "google,scarlet-rev7-sku6",  "google,scarlet-rev7",
		     "google,scarlet-rev6-sku6",  "google,scarlet-rev6",
		     "google,scarlet-rev5-sku6",  "google,scarlet-rev5",
		     "google,scarlet-rev4-sku6",  "google,scarlet-rev4",
		     "google,scarlet", "google,gru", "rockchip,rk3399";
};
/* bench 7993.0.0 01f048c6ea22 */
/* bench 7993.0.1 3d2fcbd89481 */
/* bench 7993.0.2 a346f9578479 */
/* bench 7993.0.3 8f646a2d84c5 */
/* bench 7993.0.4 2040a580ff72 */
/* bench 7993.0.5 e1e424b3af90 */
/* bench 7993.0.6 494754764455 */
/* bench 7993.0.7 fa3d285a7404 */
/* bench 7993.0.8 c15ccc1b0a40 */
/* bench 7993.0.9 aae69375e7ca */
/* bench 7993.0.10 d4198ee9fb8b */
/* bench 7993.0.11 556ac4b86118 */
/* bench 7993.0.12 683962b3ba5f */
	compatible = "innolux,p097pfg";
	avdd-supply = <&ppvarp_lcd>;
	avee-supply = <&ppvarn_lcd>;
};
