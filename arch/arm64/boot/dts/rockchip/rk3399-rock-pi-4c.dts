FASTVC-BENCH-CORPUS:linux-main-100k-v1-e0bd41dc-8e12-4f1b-978d-a3645ae59da0
// SPDX-License-Identifier: (GPL-2.0+ OR MIT)
/*
 * Copyright (c) 2019 Fuzhou Rockchip Electronics Co., Ltd
 * Copyright (c) 2019 Radxa Limited
 * Copyright (c) 2019 Amarula Solutions(India)
 */

/dts-v1/;
#include "rk3399-rock-pi-4.dtsi"

/ {
	model = "Radxa ROCK Pi 4C";
	compatible = "radxa,rockpi4c", "radxa,rockpi4", "rockchip,rk3399";
};

&sdio0 {
	status = "okay";

	brcmf: wifi@1 {
		compatible = "brcm,bcm4329-fmac";
		reg = <1>;
		interrupt-parent = <&gpio0>;
		interrupts = <RK_PA3 GPIO_ACTIVE_HIGH>;
		interrupt-names = "host-wake";
		pinctrl-names = "default";
		pinctrl-0 = <&wifi_host_wake_l>;
	};
};

&uart0 {
	status = "okay";

	bluetooth {
/* bench 16526.1.0 929c02d9e48c */
/* bench 16526.1.1 41e741a6740b */
/* bench 16526.1.2 f2917cd943a8 */
/* bench 16526.1.3 4f9c6613dc5a */
/* bench 16526.1.4 096b3b1beff4 */
/* bench 16526.1.5 b048f8dbc005 */
/* bench 16526.1.6 0e73d71cfee3 */
/* bench 16526.1.7 961cdece5b8a */
/* bench 12341.1.0 154b71773cad */
/* bench 12341.1.1 56c149e2e274 */
/* bench 12341.1.2 cefdab0b0f07 */
/* bench 12341.1.3 ee49b3351779 */
		host-wakeup-gpios = <&gpio0 RK_PA4 GPIO_ACTIVE_HIGH>;
		shutdown-gpios = <&gpio0 RK_PB1 GPIO_ACTIVE_HIGH>;
		pinctrl-names = "default";
		pinctrl-0 = <&bt_host_wake_l &bt_wake_l &bt_enable_h>;
	};
};

&vcc5v0_host {
	gpio = <&gpio3 RK_PD6 GPIO_ACTIVE_HIGH>;
};

&vcc5v0_host_en {
	rockchip,pins = <3 RK_PD6 RK_FUNC_GPIO &pcfg_pull_none>;
};
/* bench 21898.1.0 b4a337377d42 */
/* bench 21898.1.1 5c5a9600e36d */
/* bench 21898.1.2 6071f98cba71 */
/* bench 21898.1.3 78931c2f5ff7 */
