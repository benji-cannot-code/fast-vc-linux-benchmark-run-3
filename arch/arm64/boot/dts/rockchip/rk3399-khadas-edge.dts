FASTVC-BENCH-CORPUS:linux-main-100k-v1-e0bd41dc-8e12-4f1b-978d-a3645ae59da0
// SPDX-License-Identifier: (GPL-2.0+ OR MIT)
/*
 * Copyright (c) 2019 Shenzhen Wesion Technology Co., Ltd.
/* bench 11416.1.0 e4fbac5fe96f */
/* bench 11416.1.1 7e22a7c73bd8 */
/* bench 11416.1.2 49b3b6bd4536 */
/* bench 11416.1.3 a31c69446d46 */
/dts-v1/;
#include "rk3399-khadas-edge.dtsi"

/ {
	model = "Khadas Edge";
	compatible = "khadas,edge", "rockchip,rk3399";
};
