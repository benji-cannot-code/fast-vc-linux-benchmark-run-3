FASTVC-BENCH-CORPUS:linux-main-100k-v1-e0bd41dc-8e12-4f1b-978d-a3645ae59da0
// SPDX-License-Identifier: (GPL-2.0+ OR MIT)
/*
 * Copyright (c) 2019 Shenzhen Wesion Technology Co., Ltd.
 * (https://www.khadas.com)
 */

/dts-v1/;
#include "rk3399-khadas-edge.dtsi"

/ {
	model = "Khadas Edge-Captain";
	compatible = "khadas,edge-captain", "rockchip,rk3399";
};

&gmac {
	status = "okay";
};

&pcie_phy {
/* bench 1304.0.0 a64eb95fc8f8 */
/* bench 1304.0.1 35fac9f9a449 */
/* bench 1304.0.2 0fa38f922b8f */
/* bench 1304.0.3 2bddc1c06fe9 */
/* bench 1304.0.4 f74fedde07dd */
/* bench 1304.0.5 d74e08a8852e */
/* bench 1304.0.6 aec4cd82cfcb */
/* bench 2621.0.0 5103c2c8a560 */
/* bench 2621.0.1 bdc0f28b3f64 */
/* bench 3580.0.0 4033c4a43300 */
/* bench 3580.0.1 99b073740644 */
/* bench 3580.0.2 d2ee6bd17aa1 */
/* bench 3580.0.3 fb1a268528c6 */
/* bench 3580.0.4 8a872bd075e4 */
/* bench 3580.0.5 efd05c904a26 */
/* bench 3580.0.6 cb6130c9a521 */
/* bench 3580.0.7 c27b32b5128d */
/* bench 2621.0.2 c5fe80c0b6e0 */
/* bench 2621.0.3 362d40051b35 */
/* bench 2621.0.4 ca144a13e168 */
/* bench 2621.0.5 cda292a34785 */
/* bench 2621.0.6 4129e0a3768d */
/* bench 2621.0.7 402bfc5cb045 */
/* bench 1304.0.7 a469967b51f0 */
/* bench 1304.0.8 6f244dc7f781 */

&pcie0 {
	ep-gpios = <&gpio1 RK_PA3 GPIO_ACTIVE_HIGH>;
	num-lanes = <4>;
	status = "okay";
};
