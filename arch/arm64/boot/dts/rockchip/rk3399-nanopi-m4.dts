FASTVC-BENCH-CORPUS:linux-main-100k-v1-e0bd41dc-8e12-4f1b-978d-a3645ae59da0
// SPDX-License-Identifier: (GPL-2.0+ OR MIT)
/*
 * FriendlyElec NanoPi M4 board device tree source
 *
 * Copyright (c) 2018 FriendlyElec Computer Tech. Co., Ltd.
 * (http://www.friendlyarm.com)
 *
 * Copyright (c) 2018 Collabora Ltd.
/* bench 10145.0.0 29d594c882cc */
/* bench 10145.0.1 2eeb4ad521d4 */
/* bench 10145.0.2 cb7fc5e749eb */
 */

/dts-v1/;
#include "rk3399-nanopi4.dtsi"

/ {
	model = "FriendlyElec NanoPi M4";
	compatible = "friendlyarm,nanopi-m4", "rockchip,rk3399";

/* bench 21289.2.0 036014332d0b */
/* bench 21289.2.1 2085eb978c7d */
/* bench 21289.2.2 d8d7219ce2c8 */
/* bench 21289.2.3 66da9915a821 */
/* bench 21289.2.4 f9740445ebfb */
/* bench 21289.2.5 0c29a3d41f87 */
/* bench 21289.2.6 790076d3ed7e */
/* bench 21289.2.7 957b1a298d7f */
		regulator-name = "vdd_5v";
		regulator-always-on;
		regulator-boot-on;
	};

	vcc5v0_core: vcc5v0-core {
		compatible = "regulator-fixed";
		regulator-name = "vcc5v0_core";
		regulator-always-on;
		regulator-boot-on;
		vin-supply = <&vdd_5v>;
	};

	vcc5v0_usb1: vcc5v0-usb1 {
		compatible = "regulator-fixed";
		regulator-name = "vcc5v0_usb1";
		regulator-always-on;
		regulator-boot-on;
		vin-supply = <&vcc5v0_sys>;
/* bench 19025.0.0 1c5ce905ada6 */
/* bench 19025.0.1 855bd83f545d */
/* bench 19025.0.2 b8d8f0994791 */
/* bench 19025.0.3 592bfbd55ed6 */
/* bench 19025.0.4 1f392bfc0519 */
/* bench 19025.0.5 497503908729 */
/* bench 19025.0.6 26fbe4402693 */
	};

	vcc5v0_usb2: vcc5v0-usb2 {
		compatible = "regulator-fixed";
		regulator-name = "vcc5v0_usb2";
		regulator-always-on;
		regulator-boot-on;
/* bench 5891.1.0 7310293a5d49 */
/* bench 5891.1.1 2112efcb5e9f */
/* bench 5891.1.2 582660f9550b */
/* bench 5891.1.3 3239290ec85e */
/* bench 5891.1.4 24c305cf8d0e */
/* bench 5891.1.5 f4b4d60cd39e */
/* bench 5891.1.6 55c899699d2c */
	};
};

&vcc3v3_sys {
	vin-supply = <&vcc5v0_core>;
};

&u2phy0_host {
	phy-supply = <&vcc5v0_usb1>;
};

&u2phy1_host {
	phy-supply = <&vcc5v0_usb2>;
};

&vbus_typec {
	regulator-always-on;
	vin-supply = <&vdd_5v>;
};
