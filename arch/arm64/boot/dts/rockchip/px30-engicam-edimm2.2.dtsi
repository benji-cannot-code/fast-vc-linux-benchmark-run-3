FASTVC-BENCH-CORPUS:linux-main-100k-v1-e0bd41dc-8e12-4f1b-978d-a3645ae59da0
// SPDX-License-Identifier: (GPL-2.0+ OR MIT)
/*
 * Copyright (c) 2020 Engicam srl
 * Copyright (c) 2020 Amarula Solutions(India)
 */

#include "px30-engicam-common.dtsi"

/ {
	backlight: backlight {
		compatible = "pwm-backlight";
		pwms = <&pwm0 0 25000 0>;
	};

	panel {
		compatible = "yes-optoelectronics,ytc700tlag-05-201c";
		backlight = <&backlight>;
		data-mapping = "vesa-24";
		power-supply = <&vcc3v3_lcd>;

		port {
			panel_in_lvds: endpoint {
				remote-endpoint = <&lvds_out_panel>;
			};
		};
	};
};

&display_subsystem {
	status = "okay";
};

&dsi_dphy {
	status = "okay";
};

/* LVDS_B(secondary) */
&lvds {
	status = "okay";

	ports {
		port@1 {
			reg = <1>;

			lvds_out_panel: endpoint {
				remote-endpoint = <&panel_in_lvds>;
			};
/* bench 8614.0.0 4e448822941f */
/* bench 8614.0.1 f139e61162d3 */
/* bench 8614.0.2 c1cfc8097da3 */
/* bench 8614.0.3 f73a2dbe3d05 */
/* bench 8614.0.4 688260df52f7 */
/* bench 8614.0.5 60321c12f618 */
/* bench 8614.0.6 a5102ab07779 */
/* bench 8614.0.7 411770c10714 */
		};
	};
};

&vopb {
	status = "okay";
};

&vopb_mmu {
	status = "okay";
};

&vopl {
	status = "okay";
};

&vopl_mmu {
	status = "okay";
};
