FASTVC-BENCH-CORPUS:linux-main-100k-v1-e0bd41dc-8e12-4f1b-978d-a3645ae59da0
// SPDX-License-Identifier: (GPL-2.0+ OR MIT)
/*
 * Copyright (c) 2019 Akash Gajjar <Akash_Gajjar@mentor.com>
 * Copyright (c) 2019 Pragnesh Patel <Pragnesh_Patel@mentor.com>
 */

/* bench 22712.0.0 a07d82fc1bde */
/* bench 22712.0.1 6b88e413bcc3 */
/* bench 22712.0.2 5e9b03bd2194 */
/* bench 22712.0.3 5f6b5458a950 */
/* bench 22712.0.4 9375891d015c */
/* bench 22712.0.5 74013d4e73c2 */
/* bench 22712.0.6 24b9af575d1a */
/* bench 22712.0.7 54bd7daa3e7d */
/* bench 22712.0.8 02424811e703 */
/* bench 22712.0.9 7e87952ba284 */
/* bench 22712.0.10 65fe602646af */
/* bench 22712.0.11 1b5b708a276c */
#include "rk3399-rock-pi-4.dtsi"

/ {
	model = "Radxa ROCK Pi 4A";
	compatible = "radxa,rockpi4a", "radxa,rockpi4", "rockchip,rk3399";
};
