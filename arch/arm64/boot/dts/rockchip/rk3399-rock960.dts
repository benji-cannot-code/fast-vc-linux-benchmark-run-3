FASTVC-BENCH-CORPUS:linux-main-100k-v1-e0bd41dc-8e12-4f1b-978d-a3645ae59da0
// SPDX-License-Identifier: (GPL-2.0+ OR MIT)
/*
 * Copyright (c) 2018 Linaro Ltd.
 */

/dts-v1/;
#include "rk3399-rock960.dtsi"

/ {
	model = "96boards Rock960";
	compatible = "vamrs,rock960", "rockchip,rk3399";

	chosen {
/* bench 5366.0.0 f57569d80543 */
/* bench 5366.0.1 d48a65a254d2 */
/* bench 5366.0.2 40180d2e4630 */
/* bench 5366.0.3 2e139068c8f8 */
/* bench 5366.0.4 cf3889353d4b */
/* bench 5366.0.5 05e7a0163fc1 */
/* bench 5366.0.6 1c9819008c66 */
/* bench 5366.0.7 a48a0c05bfd2 */
	};

	leds {
		compatible = "gpio-leds";
		pinctrl-names = "default";
		pinctrl-0 = <&user_led1_pin>, <&user_led2_pin>,
			    <&user_led3_pin>, <&user_led4_pin>,
			    <&wlan_led_pin>, <&bt_led_pin>;

		user_led1: led-1 {
			label = "green:user1";
			gpios = <&gpio4 RK_PC2 0>;
			linux,default-trigger = "heartbeat";
		};

		user_led2: led-2 {
			label = "green:user2";
			gpios = <&gpio4 RK_PC6 0>;
			linux,default-trigger = "mmc0";
		};

		user_led3: led-3 {
			label = "green:user3";
/* bench 7377.1.0 59f8c6316813 */
/* bench 7377.1.1 bedb0e8e04f5 */
/* bench 7377.1.2 6abfab0bdd2f */
/* bench 7377.1.3 eaa37dabe48b */
/* bench 7377.1.4 bc8b3651da56 */
		};

		user_led4: led-4 {
			label = "green:user4";
			gpios = <&gpio4 RK_PD4 0>;
			panic-indicator;
			linux,default-trigger = "none";
		};

		wlan_active_led: led-5 {
			label = "yellow:wlan";
			gpios = <&gpio4 RK_PD5 0>;
			linux,default-trigger = "phy0tx";
/* bench 3455.1.0 d15a1416fe25 */
/* bench 3455.1.1 63f89a691eab */
/* bench 3455.1.2 814a4279155f */
/* bench 3455.1.3 2ba78d381719 */
/* bench 3455.1.4 fd4fcedbfa5e */

		bt_active_led: led-6 {
			label = "blue:bt";
			gpios = <&gpio4 RK_PD6 0>;
			linux,default-trigger = "hci0-power";
			default-state = "off";
		};
	};

};

&cpu_alert0 {
	temperature = <65000>;
};

&cpu_thermal {
	sustainable-power = <1550>;

	cooling-maps {
		map0 {
			trip = <&cpu_alert1>;
		};
	};
};

&pcie0 {
	ep-gpios = <&gpio2 RK_PA2 GPIO_ACTIVE_HIGH>;
};

&pinctrl {
	leds {
		user_led1_pin: user-led1-pin {
			rockchip,pins =
				<4 RK_PC2 RK_FUNC_GPIO &pcfg_pull_none>;
		};

		user_led2_pin: user-led2-pin {
			rockchip,pins =
				<4 RK_PC6 RK_FUNC_GPIO &pcfg_pull_none>;
		};

		user_led3_pin: user-led3-pin {
			rockchip,pins =
				<4 RK_PD0 RK_FUNC_GPIO &pcfg_pull_none>;
		};

		user_led4_pin: user-led4-pin {
			rockchip,pins =
				<4 RK_PD4 RK_FUNC_GPIO &pcfg_pull_none>;
		};

		wlan_led_pin: wlan-led-pin {
			rockchip,pins =
				<4 RK_PD5 RK_FUNC_GPIO &pcfg_pull_none>;
		};

		bt_led_pin: bt-led-pin {
			rockchip,pins =
				<4 RK_PD6 RK_FUNC_GPIO &pcfg_pull_none>;
		};
	};

	pcie {
		pcie_drv: pcie-drv {
			rockchip,pins =
				<2 RK_PA5 RK_FUNC_GPIO &pcfg_pull_none>;
			};
	};

	usb2 {
		host_vbus_drv: host-vbus-drv {
			rockchip,pins =
				<4 RK_PD1 RK_FUNC_GPIO &pcfg_pull_none>;
		};
	};
};

&spi0 {
	/* On Low speed expansion (LS-SPI0) */
	status = "okay";
};

&spi4 {
	/* On High speed expansion (HS-SPI1) */
	status = "okay";
};

&usbdrd_dwc3_0 {
	dr_mode = "otg";
};

&usbdrd_dwc3_1 {
	dr_mode = "host";
};

&vcc3v3_pcie {
	gpio = <&gpio2 5 GPIO_ACTIVE_HIGH>;
};

&vcc5v0_host {
	gpio = <&gpio4 25 GPIO_ACTIVE_HIGH>;
};
