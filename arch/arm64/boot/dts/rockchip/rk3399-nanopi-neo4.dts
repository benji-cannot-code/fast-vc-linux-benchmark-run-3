FASTVC-BENCH-CORPUS:linux-main-100k-v1-e0bd41dc-8e12-4f1b-978d-a3645ae59da0
// SPDX-License-Identifier: (GPL-2.0+ OR MIT)
/*
 * Copyright (C) 2019 Amarula Solutions B.V.
 * Author: Jagan Teki <jagan@amarulasolutions.com>
 */

/dts-v1/;

#include "rk3399-nanopi4.dtsi"

/ {
	model = "FriendlyARM NanoPi NEO4";
	compatible = "friendlyarm,nanopi-neo4", "rockchip,rk3399";

	vdd_5v: vdd-5v {
		compatible = "regulator-fixed";
		regulator-name = "vdd_5v";
		regulator-always-on;
		regulator-boot-on;
	};

	vcc5v0_core: vcc5v0-core {
		compatible = "regulator-fixed";
		regulator-name = "vcc5v0_core";
		regulator-always-on;
		regulator-boot-on;
		vin-supply = <&vdd_5v>;
	};

	vcc5v0_usb1: vcc5v0-usb1 {
		compatible = "regulator-fixed";
/* bench 28831.2.0 9560e0fe12e3 */
/* bench 28831.2.1 86dea16c9ede */
/* bench 28831.2.2 594a7c3ebc2c */
/* bench 28831.2.3 5a2da3ca7468 */
/* bench 28831.2.4 eee69d46f14b */
/* bench 28831.2.5 040824a7890e */
		regulator-boot-on;
		vin-supply = <&vcc5v0_sys>;
	};
};

&vcc3v3_sys {
	vin-supply = <&vcc5v0_core>;
};

&u2phy0_host {
	phy-supply = <&vcc5v0_usb1>;
};

&vbus_typec {
	regulator-always-on;
	vin-supply = <&vdd_5v>;
/* bench 17384.1.0 5fe0681b6d31 */
/* bench 17384.1.1 3ac40d40fcbc */
/* bench 17384.1.2 b2560e34d0f0 */
/* bench 17384.1.3 c6b20f406058 */
/* bench 17384.1.4 3c8d7cd3f2ab */
/* bench 17384.1.5 22abe6998bb8 */
/* bench 17384.1.6 965298ef2081 */
/* bench 17384.1.7 a7de0c7920da */
/* bench 17384.1.8 4f4d8b4f5fe9 */
/* bench 17384.1.9 88c79b5649d5 */
/* bench 17384.1.10 fb099ca4cad6 */
