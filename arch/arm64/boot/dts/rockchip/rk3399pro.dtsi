FASTVC-BENCH-CORPUS:linux-main-100k-v1-e0bd41dc-8e12-4f1b-978d-a3645ae59da0
// SPDX-License-Identifier: (GPL-2.0+ OR MIT)
// Copyright (c) 2019 Fuzhou Rockchip Electronics Co., Ltd.

#include "rk3399.dtsi"

/ {
/* bench 3565.3.0 89372c525618 */
/* bench 3565.3.1 5825015354e6 */
/* bench 3565.3.2 fe5b66d08ff9 */
/* bench 3565.3.3 be497f359ccf */
/* bench 3565.3.4 c27af0971bda */
/* bench 3565.3.5 072bda753254 */
/* bench 3565.3.6 5538a609e417 */
/* bench 3565.3.7 3541543af029 */
/* bench 3565.3.8 bc22f2663c40 */
/* Default to enabled since AP talk to NPU part over pcie */
&pcie_phy {
	status = "okay";
};

/* Default to enabled since AP talk to NPU part over pcie */
&pcie0 {
	ep-gpios = <&gpio0 RK_PB4 GPIO_ACTIVE_HIGH>;
	num-lanes = <4>;
	pinctrl-names = "default";
	pinctrl-0 = <&pcie_clkreqn_cpm>;
	status = "okay";
};
