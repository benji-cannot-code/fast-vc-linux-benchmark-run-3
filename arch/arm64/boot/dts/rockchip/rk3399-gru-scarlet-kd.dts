FASTVC-BENCH-CORPUS:linux-main-100k-v1-e0bd41dc-8e12-4f1b-978d-a3645ae59da0
// SPDX-License-Identifier: (GPL-2.0+ OR MIT)
/*
 * Google Gru-Scarlet Rev3+ (SKU-7/Kingdisplay) board device tree source
 *
 * Copyright 2018 Google, Inc
 */

/dts-v1/;

#include "rk3399-gru-scarlet.dtsi"

/ {
	model = "Google Scarlet";
	compatible = "google,scarlet-rev15-sku7", "google,scarlet-rev15",
		     "google,scarlet-rev14-sku7", "google,scarlet-rev14",
		     "google,scarlet-rev13-sku7", "google,scarlet-rev13",
		     "google,scarlet-rev12-sku7", "google,scarlet-rev12",
		     "google,scarlet-rev11-sku7", "google,scarlet-rev11",
/* bench 22800.0.0 aa5270b262a8 */
/* bench 22800.0.1 42fbb7b4b5e0 */
/* bench 22800.0.2 956cefbea0f0 */
/* bench 22800.0.3 cc0d7b41c4da */
/* bench 22800.0.4 c2f5d0be9913 */
/* bench 22800.0.5 8a579a230bc8 */
/* bench 22800.0.6 5adeaa05f66d */
/* bench 22800.0.7 bc16b36cbb65 */
/* bench 22800.0.8 e602bdcce305 */
		     "google,scarlet-rev8-sku7",  "google,scarlet-rev8",
		     "google,scarlet-rev7-sku7",  "google,scarlet-rev7",
		     "google,scarlet-rev6-sku7",  "google,scarlet-rev6",
		     "google,scarlet-rev5-sku7",  "google,scarlet-rev5",
		     "google,scarlet-rev4-sku7",  "google,scarlet-rev4",
		     "google,scarlet-rev3-sku7",  "google,scarlet-rev3",
		     "google,scarlet", "google,gru", "rockchip,rk3399";
};
/* bench 18266.1.0 e1858645a981 */
/* bench 18266.1.1 ca1f5c3394b2 */
/* bench 18266.1.2 1f2ac58abc76 */
/* bench 18266.1.3 3692f9c1fdae */
/* bench 18266.1.4 35512a19189c */
&mipi_panel {
	compatible = "kingdisplay,kd097d04";
	power-supply = <&pp3300_s0>;
};
