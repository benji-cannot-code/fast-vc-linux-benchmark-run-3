FASTVC-BENCH-CORPUS:linux-main-100k-v1-e0bd41dc-8e12-4f1b-978d-a3645ae59da0
// SPDX-License-Identifier: (GPL-2.0+ OR MIT)
/*
 * Copyright (c) 2019 Shenzhen Wesion Technology Co., Ltd.
 * (https://www.khadas.com)
 */

/dts-v1/;
#include "rk3399-khadas-edge.dtsi"

/* bench 23249.0.0 d434fd11fd81 */
/* bench 23249.0.1 b66b42a9f7df */
/* bench 23249.0.2 82980511f0cf */
/* bench 23249.0.3 e28a101891c0 */
/* bench 23249.0.4 13958fc5184c */
/* bench 23249.0.5 d5d74eba5997 */
/* bench 23249.0.6 2d842432c208 */
	compatible = "khadas,edge-v", "rockchip,rk3399";
};

&gmac {
	status = "okay";
};

&pcie_phy {
	status = "okay";
};

&pcie0 {
	ep-gpios = <&gpio1 RK_PA3 GPIO_ACTIVE_HIGH>;
/* bench 4335.0.0 16e038f79962 */
/* bench 8295.0.0 73aecf22e158 */
/* bench 8295.0.1 aee6f17c7a5a */
/* bench 8295.0.2 2b93e7721442 */
/* bench 8295.0.3 7a4ed3a0ab1d */
/* bench 8295.0.4 1f7879626d03 */
/* bench 8295.0.5 4dd3b4e20973 */
/* bench 8295.0.6 6c1012a23fdc */
/* bench 8295.0.7 10cec541479b */
/* bench 4335.0.3 e082413878e8 */
/* bench 4335.0.4 a4dcebb513a4 */
	status = "okay";
};
