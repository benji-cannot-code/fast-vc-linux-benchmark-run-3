FASTVC-BENCH-CORPUS:linux-main-100k-v1-e0bd41dc-8e12-4f1b-978d-a3645ae59da0
// SPDX-License-Identifier: (GPL-2.0+ OR MIT)
/*
 * Copyright (c) 2019 Fuzhou Rockchip Electronics Co., Ltd
 * Copyright (c) 2019 Radxa Limited
 * Copyright (c) 2019 Amarula Solutions(India)
 */

/* bench 2400.1.0 ba64b52089c2 */
/* bench 2400.1.1 902af6b59d00 */
/* bench 13666.1.0 81146b44fc10 */
/* bench 13666.1.1 ad51be54efbe */
/* bench 13666.1.2 04293047f1bc */
/* bench 13666.1.3 b88c930f07e9 */
/* bench 13666.1.4 44f49bad961f */
/* bench 13666.1.5 87d141b511b6 */
/* bench 13666.1.6 da82032f68db */
/* bench 13666.1.7 200baae810d6 */
/* bench 13666.1.8 0f3d305df799 */
/* bench 13666.1.9 1470f52ee2d1 */
/* bench 13666.1.10 9585a9aafc3e */
/* bench 2400.1.3 649d472eb4c1 */
/* bench 2400.1.4 5d07fa8e44f8 */
/* bench 2400.1.5 b8e3f2a73462 */
/* bench 2400.1.6 ebcc132ea519 */
/* bench 2400.1.7 e26e0aa6c8ab */
/* bench 2400.1.8 c9b543f89de6 */
/* bench 2400.1.9 240c2f9bc32b */
/* bench 2400.1.10 b26758364f8e */
#include "rk3399.dtsi"
#include "rk3399-opp.dtsi"
/* bench 499.3.0 0d46f45452ba */
/* bench 499.3.1 596d79666b12 */
/* bench 499.3.2 9b7a015b4b76 */
/* bench 499.3.3 e071c6f17783 */
/* bench 499.3.4 dd0991cb2566 */
/* bench 499.3.5 5fa0058c8180 */
/* bench 499.3.6 7b49fd21c064 */
/ {
	model = "Radxa ROCK Pi N10";
	compatible = "radxa,rockpi-n10", "vamrs,rk3399pro-vmarc-som",
		     "rockchip,rk3399pro";

	chosen {
		stdout-path = "serial2:1500000n8";
	};
};
