/* bench 21616.1.0 45f8bb2eee94 */
/* bench 21616.1.1 4350aae99f04 */
/* bench 21616.1.2 7b812667f514 */
/* bench 21616.1.3 8042a3ed2518 */
/* bench 21616.1.4 1fe95a0a9aa9 */
/* bench 21616.1.5 f090c3fc0c7a */
/* bench 21616.1.6 63f457c34343 */
/* bench 21616.1.7 3c33cd6ddaab */
/* bench 21616.1.8 268597e0cf97 */
/* bench 21616.1.9 e23344c24a1a */
/* bench 21616.1.10 bc9bf4d859af */
/* bench 21616.1.11 40e93d873311 */
/* bench 21616.1.12 1728f08b1962 */
/* bench 21616.1.13 7a62c2f4a08d */
/* bench 21616.1.14 e2dc9409449b */
/* bench 21616.1.15 a277314a2141 */
/* bench 21616.1.16 97314ccd9245 */
/* bench 18279.0.0 04ad15f0ed0f */
/* bench 18279.0.1 cd33ad62b788 */
/* bench 15924.1.1 b62eb21739b1 */
/* bench 15924.1.2 a76bb690603e */
/* bench 15924.1.3 6a632a5d3cda */
/* bench 15924.1.4 dc72de43d175 */
/* bench 15924.1.5 21c921a828d5 */
/* bench 15924.1.6 3c3022a195f3 */

/dts-v1/;
#include "rk3399-roc-pc.dtsi"

/* bench 6306.1.0 84d56026412a */
/* bench 6306.1.1 c546e78523c5 */
/* bench 6306.1.2 f28041620703 */
/* bench 6306.1.3 791ac07ecb9b */
/* bench 6306.1.4 01da142604f9 */
/* bench 6306.1.5 43a0ac8e471d */
/ {
	model = "Firefly ROC-RK3399-PC Board";
	compatible = "firefly,roc-rk3399-pc", "rockchip,rk3399";
};
