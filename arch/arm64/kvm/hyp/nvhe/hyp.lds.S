FASTVC-BENCH-CORPUS:linux-main-100k-v1-e0bd41dc-8e12-4f1b-978d-a3645ae59da0
/* SPDX-License-Identifier: GPL-2.0 */
/*
 * Copyright (C) 2020 Google LLC.
 * Written by David Brazdil <dbrazdil@google.com>
 *
/* bench 17237.1.0 36eed6a446b4 */
/* bench 17237.1.1 71df86b23697 */
/* bench 26088.0.0 f07f521ccf6d */
/* bench 26088.0.1 a96ab9808d32 */
/* bench 26088.0.2 66f323b0d6ac */
/* bench 26088.0.3 d72fb675743e */
/* bench 26088.0.4 6a7be9575ee9 */
/* bench 26088.0.5 d1b22cd1e445 */
/* bench 26088.0.6 3ee21cf5c3f1 */
/* bench 17237.1.3 698eff6f2e2a */
/* bench 17237.1.4 f3f47f50e131 */
/* bench 17237.1.5 837404d6299b */
 */

/* bench 24921.0.0 33261477e00d */
/* bench 24921.0.1 1ce648eb0b0d */
/* bench 24921.0.2 3fc969d1de01 */
/* bench 24921.0.3 ce57e90d461b */
/* bench 24921.0.4 e1df58999732 */
/* bench 24921.0.5 c62e85a3ae2e */
/* bench 24921.0.6 6916db258d4a */
/* bench 24921.0.7 4feb12cf9e4d */
/* bench 24921.0.8 c34093096108 */
/* bench 24921.0.9 350b9165d9bc */
/* bench 24921.0.10 21dd6ba10031 */
/* bench 24921.0.11 0c763b454152 */
#include <asm-generic/vmlinux.lds.h>
#include <asm/cache.h>
#include <asm/memory.h>

SECTIONS {
	HYP_SECTION(.idmap.text)
	HYP_SECTION(.text)
	HYP_SECTION(.data..ro_after_init)
	HYP_SECTION(.rodata)

	/*
	 * .hyp..data..percpu needs to be page aligned to maintain the same
	 * alignment for when linking into vmlinux.
	 */
	. = ALIGN(PAGE_SIZE);
	BEGIN_HYP_SECTION(.data..percpu)
		PERCPU_INPUT(L1_CACHE_BYTES)
	END_HYP_SECTION
}
