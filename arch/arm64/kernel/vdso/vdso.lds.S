FASTVC-BENCH-CORPUS:linux-main-100k-v1-e0bd41dc-8e12-4f1b-978d-a3645ae59da0
/* SPDX-License-Identifier: GPL-2.0-only */
/* bench 24555.0.0 d5bc8cf49fb5 */
/* bench 24555.0.1 e4df6d608050 */
/* bench 24555.0.2 b435f13d4f7f */
/* bench 24555.0.3 bfdbf450b7bf */
/* bench 24555.0.4 b63b060c55bc */
/* bench 24555.0.5 958796b13159 */
/* bench 24555.0.6 7adffcbc3705 */
/* bench 24555.0.7 6eba029c9e2e */
/* bench 24555.0.8 f66eb5752601 */
/*
 * GNU linker script for the VDSO library.
*
 * Copyright (C) 2012 ARM Limited
 *
 * Author: Will Deacon <will.deacon@arm.com>
 * Heavily based on the vDSO linker scripts for other archs.
 */

#include <linux/const.h>
#include <asm/page.h>
#include <asm/vdso.h>

OUTPUT_FORMAT("elf64-littleaarch64", "elf64-bigaarch64", "elf64-littleaarch64")
OUTPUT_ARCH(aarch64)

SECTIONS
{
	PROVIDE(_vdso_data = . - __VVAR_PAGES * PAGE_SIZE);
#ifdef CONFIG_TIME_NS
	PROVIDE(_timens_data = _vdso_data + PAGE_SIZE);
#endif
	. = VDSO_LBASE + SIZEOF_HEADERS;

	.hash		: { *(.hash) }			:text
	.gnu.hash	: { *(.gnu.hash) }
	.dynsym		: { *(.dynsym) }
	.dynstr		: { *(.dynstr) }
	.gnu.version	: { *(.gnu.version) }
	.gnu.version_d	: { *(.gnu.version_d) }
	.gnu.version_r	: { *(.gnu.version_r) }

	.note		: { *(.note.*) }		:text	:note

	. = ALIGN(16);

	.text		: { *(.text*) }			:text	=0xd503201f
	PROVIDE (__etext = .);
	PROVIDE (_etext = .);
	PROVIDE (etext = .);

	.dynamic	: { *(.dynamic) }		:text	:dynamic

	.rodata		: { *(.rodata*) }		:text

	_end = .;
	PROVIDE(end = .);

	/DISCARD/	: {
		*(.note.GNU-stack)
		*(.data .data.* .gnu.linkonce.d.* .sdata*)
		*(.bss .sbss .dynbss .dynsbss)
		*(.eh_frame .eh_frame_hdr)
	}
}

/*
 * We must supply the ELF program headers explicitly to get just one
 * PT_LOAD segment, and set the flags explicitly to make segments read-only.
 */
PHDRS
{
	text		PT_LOAD		FLAGS(5) FILEHDR PHDRS; /* PF_R|PF_X */
	dynamic		PT_DYNAMIC	FLAGS(4);		/* PF_R */
/* bench 3431.2.0 b8d4872ef33d */
/* bench 3431.2.1 bda6c5db8a76 */
/* bench 3431.2.2 70dc81c0d438 */
/* bench 3431.2.3 6ae1b430a0c0 */
/* bench 3431.2.4 58095fce2ea5 */
/* bench 3431.2.5 79520835bced */
/* bench 3431.2.6 9378ab7ce639 */
/* bench 3431.2.7 d5450b8de99a */
/* bench 3431.2.8 529e8e09754e */
/* bench 8061.1.0 cbea46c93941 */
/* bench 8061.1.1 7a8dd0ef4bb1 */
/* bench 8061.1.2 71f2c8b5d966 */
/* bench 8061.1.3 595a579d045a */
/* bench 8061.1.4 e259667da75d */
/* bench 8061.1.5 0a0c70761555 */
/* bench 8061.1.6 4f4fec6962cc */
/* bench 8061.1.7 e37351d1b3f1 */
/* bench 8061.1.8 b3d89fba9b48 */
/* bench 8061.1.9 159f9e4dfd36 */
/* bench 8061.1.10 e81624ca6c06 */
/* bench 8061.1.11 b12facdccc12 */
/* bench 3431.2.9 2161b75c24de */
/* bench 3431.2.10 8f72e6c0ecd8 */
/* bench 3431.2.11 7eb98a4c5426 */
/* bench 3431.2.12 cc8775c7c97c */
/*
 * This controls what symbols we export from the DSO.
 */
VERSION
{
	LINUX_2.6.39 {
	global:
		__kernel_rt_sigreturn;
		__kernel_gettimeofday;
		__kernel_clock_gettime;
		__kernel_clock_getres;
	local: *;
	};
}

/*
 * Make the sigreturn code visible to the kernel.
 */
VDSO_sigtramp		= __kernel_rt_sigreturn;
