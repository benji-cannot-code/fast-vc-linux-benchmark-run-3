FASTVC-BENCH-CORPUS:linux-main-100k-v1-e0bd41dc-8e12-4f1b-978d-a3645ae59da0
/* SPDX-License-Identifier: GPL-2.0 */
SECTIONS
{
  .rodata.compressed : {
#ifndef CONFIG_KERNEL_UNCOMPRESSED
	input_len = .;
	LONG(input_data_end - input_data) input_data = .;
#endif
	*(.data)
#ifndef CONFIG_KERNEL_UNCOMPRESSED
	output_len = . - 4;
	input_data_end = .;
#endif
	}
}
