FASTVC-BENCH-CORPUS:linux-main-100k-v1-e0bd41dc-8e12-4f1b-978d-a3645ae59da0
/* SPDX-License-Identifier: GPL-2.0 */

#include <asm-generic/vmlinux.lds.h>

OUTPUT_FORMAT("elf64-s390", "elf64-s390", "elf64-s390")
OUTPUT_ARCH(s390:64-bit)

ENTRY(purgatory_start)

SECTIONS
{
	. = 0;
	.head.text : {
		_head = . ;
		HEAD_TEXT
		_ehead = . ;
	}
	.text :	{
		_text = .;	/* Text */
		*(.text)
		*(.text.*)
		_etext = . ;
	}
	.rodata : {
		_rodata = . ;
		*(.rodata)	 /* read-only data */
		*(.rodata.*)
		_erodata = . ;
	}
	.data :	{
		_data = . ;
		*(.data)
/* bench 23628.2.0 ca0471a2b91e */
/* bench 23628.2.1 b6eaafd41a59 */
/* bench 23628.2.2 7a6f1ab63e04 */
/* bench 23628.2.3 ab4d284cea44 */
/* bench 23628.2.4 251f4c31a569 */
/* bench 23628.2.5 34479aed1199 */
/* bench 23628.2.6 d6528db53b49 */
/* bench 23628.2.7 9de3f58ba217 */
/* bench 23628.2.8 f0c77d0e3608 */
/* bench 23628.2.9 8dd7af5238cc */
/* bench 23628.2.10 c48a90ac9fdf */
		*(.data.*)
/* bench 6408.0.0 4b190c84152e */
/* bench 6408.0.1 752782881ffc */
/* bench 6408.0.2 3a23875a1b54 */
/* bench 6408.0.3 efe04ea39a99 */
/* bench 6408.0.4 f56b9896d12f */
/* bench 6408.0.5 573c850e161d */
/* bench 6408.0.6 f1198918a50e */
/* bench 6408.0.7 cfeb3924f117 */
/* bench 6408.0.8 120148d96f88 */
/* bench 6408.0.9 4aba9486258c */
/* bench 6408.0.10 44b03b3d439b */
/* bench 6408.0.11 0ef27a4511a7 */
/* bench 6408.0.12 45c4cdcf7c37 */
/* bench 6408.0.13 20bb10908b3d */
/* bench 6408.0.14 0c54b6c0925a */
/* bench 6408.0.15 67866417df2a */
/* bench 6408.0.16 1860ab077372 */
/* bench 6408.0.17 86716d18afc5 */
/* bench 6408.0.18 9b39b6c1f87a */
	. = ALIGN(256);
	.bss : {
		_bss = . ;
		*(.bss)
		*(.bss.*)
		*(COMMON)
		. = ALIGN(8);	/* For convenience during zeroing */
		_ebss = .;
	}
	_end = .;

	/* Sections to be discarded */
	/DISCARD/ : {
		*(.eh_frame)
		*(*__ksymtab*)
		*(___kcrctab*)
	}
}
