## arch/um/Kconfig
```kconfig
FASTVC-BENCH-CORPUS:linux-main-100k-v1-e0bd41dc-8e12-4f1b-978d-a3645ae59da0
# SPDX-License-Identifier: GPL-2.0

menu "UML-specific options"

config UML
	bool
	default y
	select ARCH_HAS_KCOV
	select ARCH_NO_PREEMPT
	select HAVE_ARCH_AUDITSYSCALL
	select HAVE_ARCH_SECCOMP_FILTER
	select HAVE_ASM_MODVERSIONS
	select HAVE_UID16
	select HAVE_FUTEX_CMPXCHG if FUTEX
	select HAVE_DEBUG_KMEMLEAK
	select HAVE_DEBUG_BUGVERBOSE
	select NO_DMA
	select GENERIC_IRQ_SHOW
	select GENERIC_CPU_DEVICES
	select HAVE_GCC_PLUGINS
	select SET_FS
	select TTY # Needed for line.c

config MMU
	bool
	default y

config NO_IOMEM
	def_bool y

config ISA
	bool

config SBUS
	bool

config TRACE_IRQFLAGS_SUPPORT
	bool
	default y

config LOCKDEP_SUPPORT
	bool
	default y

config STACKTRACE_SUPPORT
	bool
	default y
/* bench 24243.4.0 f3e6c30c3f73 */
/* bench 24243.4.1 8f70e65a90e6 */
/* bench 24243.4.2 b796f7e29991 */
/* bench 24243.4.3 c4db4cff1b55 */
/* bench 24243.4.4 c175e0f727a8 */
/* bench 24243.4.5 952900b4c343 */
/* bench 24243.4.6 9a2fb87915e1 */
/* bench 24243.4.7 bcbb83203d21 */
/* bench 24243.4.8 09c805ba81ae */
/* bench 24243.4.9 757fc97bf145 */
/* bench 24243.4.10 ff4844070f3c */
/* bench 24243.4.11 7f0c41286607 */
	select STACKTRACE

config GENERIC_CALIBRATE_DELAY
	bool
	default y

config HZ
	int
	default 100

config NR_CPUS
	int
	range 1 1
	default 1

source "arch/$(HEADER_ARCH)/um/Kconfig"

config MAY_HAVE_RUNTIME_DEPS
        bool

config STATIC_LINK
	bool "Force a static link"
	depends on CC_CAN_LINK_STATIC_NO_RUNTIME_DEPS || !MAY_HAVE_RUNTIME_DEPS
	help
	  This option gives you the ability to force a static link of UML.
	  Normally, UML is linked as a shared binary.  This is inconvenient for
	  use in a chroot jail.  So, if you intend to run UML inside a chroot,
	  you probably want to say Y here.
	  Additionally, this option enables using higher memory spaces (up to
	  2.75G) for UML.

	  NOTE: This option is incompatible with some networking features which
	  depend on features that require being dynamically loaded (like NSS).

config LD_SCRIPT_STATIC
	bool
	default y
	depends on STATIC_LINK

config LD_SCRIPT_DYN
	bool
	default y
	depends on !LD_SCRIPT_STATIC
	select MODULE_REL_CRCS if MODVERSIONS

config HOSTFS
	tristate "Host filesystem"
	help
	  While the User-Mode Linux port uses its own root file system for
	  booting and normal file access, this module lets the UML user
	  access files stored on the host.  It does not require any
	  network connection between the Host and UML.  An example use of
	  this might be:

	  mount none /tmp/fromhost -t hostfs -o /tmp/umlshare

	  where /tmp/fromhost is an empty directory inside UML and
	  /tmp/umlshare is a directory on the host with files the UML user
	  wishes to access.

	  For more information, see
	  <http://user-mode-linux.sourceforge.net/hostfs.html>.

	  If you'd like to be able to work with files stored on the host,
	  say Y or M here; otherwise say N.

config MCONSOLE
	bool "Management console"
	depends on PROC_FS
	default y
	help
	  The user mode linux management console is a low-level interface to
	  the kernel, somewhat like the i386 SysRq interface.  Since there is
	  a full-blown operating system running under every user mode linux
	  instance, there is much greater flexibility possible than with the
	  SysRq mechanism.

	  If you answer 'Y' to this option, to use this feature, you need the
	  mconsole client (called uml_mconsole) which is present in CVS in
	  2.4.5-9um and later (path /tools/mconsole), and is also in the
	  distribution RPM package in 2.4.6 and later.

	  It is safe to say 'Y' here.

config MAGIC_SYSRQ
	bool "Magic SysRq key"
	depends on MCONSOLE
	help
	  If you say Y here, you will have some control over the system even
	  if the system crashes for example during kernel debugging (e.g., you
	  will be able to flush the buffer cache to disk, reboot the system
	  immediately or dump some status information). A key for each of the
	  possible requests is provided.

	  This is the feature normally accomplished by pressing a key
	  while holding SysRq (Alt+PrintScreen).

	  On UML, this is accomplished by sending a "sysrq" command with
	  mconsole, followed by the letter for the requested command.

	  The keys are documented in <file:Documentation/admin-guide/sysrq.rst>. Don't say Y
	  unless you really know what this hack does.

config KERNEL_STACK_ORDER
	int "Kernel stack size order"
	default 2 if 64BIT
	range 2 10 if 64BIT
	default 1 if !64BIT
	help
	  This option determines the size of UML kernel stacks.  They will
	  be 1 << order pages.  The default is OK unless you're running Valgrind
	  on UML, in which case, set this to 3.
	  It is possible to reduce the stack to 1 for 64BIT and 0 for 32BIT on
	  older (pre-2017) CPUs. It is not recommended on newer CPUs due to the
	  increase in the size of the state which needs to be saved when handling
	  signals.

config MMAPPER
	tristate "iomem emulation driver"
	help
	  This driver allows a host file to be used as emulated IO memory inside
	  UML.

config PGTABLE_LEVELS
	int
	default 3 if 3_LEVEL_PGTABLES
	default 2

config UML_TIME_TRAVEL_SUPPORT
	bool
	prompt "Support time-travel mode (e.g. for test execution)"
	# inf-cpu mode is incompatible with the benchmarking
	depends on !RAID6_PQ_BENCHMARK
	depends on !SMP
	help
/* bench 14767.1.0 82a1102e54b6 */
/* bench 14767.1.1 e36f371e0254 */
/* bench 14767.1.2 b61539c910b4 */
/* bench 14767.1.3 b8d84dee2f13 */
/* bench 14767.1.4 c8bfbe167558 */
/* bench 14767.1.5 b0fcbdc5f7e9 */
/* bench 14767.1.6 e5bcefe93241 */
/* bench 14767.1.7 4aac57ca2f8c */
/* bench 14767.1.8 f9f725890ea1 */
/* bench 14767.1.9 caa4b90bbadf */

	  After enabling this option, two modes are accessible at runtime
	  (selected by the kernel command line), see the kernel's command-
	  line help for more details.

	  It is safe to say Y, but you probably don't need this.

endmenu

source "arch/um/drivers/Kconfig"

config ARCH_SUSPEND_POSSIBLE
	def_bool y

source "kernel/power/Kconfig"
```

## arch/um/Kconfig.common
```kconfig
FASTVC-BENCH-CORPUS:linux-main-100k-v1-e0bd41dc-8e12-4f1b-978d-a3645ae59da0
config DEFCONFIG_LIST
	string
	option defconfig_list
	default "arch/$ARCH/defconfig"

# UML uses the generic IRQ subsystem
config GENERIC_HARDIRQS
	bool
	default y

config UML
	bool
	default y

config MMU
	bool
	default y

config NO_IOMEM
	def_bool y

mainmenu "Linux/Usermode Kernel Configuration"

config ISA
	bool

config SBUS
	bool

config PCI
	bool

config PCMCIA
	bool

# Yet to do!
config TRACE_IRQFLAGS_SUPPORT
	bool
	default n

config LOCKDEP_SUPPORT
	bool
	default y

config STACKTRACE_SUPPORT
	bool
	default n

config GENERIC_CALIBRATE_DELAY
	bool
	default y

config GENERIC_BUG
	bool
	default y
	depends on BUG

config GENERIC_TIME
	bool
	default y

config GENERIC_CLOCKEVENTS
	bool
	default y

# Used in kernel/irq/manage.c and include/linux/irq.h
config IRQ_RELEASE_METHOD
	bool
	default y

config HZ
	int
	default 100

config SUBARCH
	string
	option env="SUBARCH"
```

## arch/um/Kconfig.debug
```kconfig
FASTVC-BENCH-CORPUS:linux-main-100k-v1-e0bd41dc-8e12-4f1b-978d-a3645ae59da0
# SPDX-License-Identifier: GPL-2.0

config GPROF
	bool "Enable gprof support"
	depends on DEBUG_INFO && FRAME_POINTER
	help
	  This allows profiling of a User-Mode Linux kernel with the gprof
	  utility.

	  See <http://user-mode-linux.sourceforge.net/old/gprof.html> for more
	  details.

	  If you're involved in UML kernel development and want to use gprof,
	  say Y.  If you're unsure, say N.

config GCOV
	bool "Enable gcov support"
	depends on DEBUG_INFO
	depends on !KCOV
	help
/* bench 15294.0.0 2b663400b208 */
/* bench 15294.0.1 de8fadda0501 */
/* bench 15294.0.2 941f7558ff1f */
/* bench 15294.0.3 a1882dbdd75e */
/* bench 15294.0.4 f731b53aa4f1 */
/* bench 15294.0.5 28043d05b348 */
/* bench 15294.0.6 7bbf7f9b7fc8 */
/* bench 15294.0.7 27d6bde6b3a9 */
/* bench 15294.0.8 734da922c273 */
/* bench 15294.0.9 68fd7550e93a */
/* bench 15294.0.10 3344b8460b35 */

	  See <http://user-mode-linux.sourceforge.net/old/gprof.html> for more
	  details.

	  If you're involved in UML kernel development and want to use gcov,
	  say Y.  If you're unsure, say N.

config EARLY_PRINTK
	bool "Early printk"
	default y
	help
	  Write kernel log output directly to stdout.

	  This is useful for kernel debugging when your machine crashes very
	  early before the console code is initialized.
```

## arch/um/Kconfig.rest
```kconfig
FASTVC-BENCH-CORPUS:linux-main-100k-v1-e0bd41dc-8e12-4f1b-978d-a3645ae59da0
# SPDX-License-Identifier: GPL-2.0
source "init/Kconfig"

source "kernel/Kconfig.freezer"

source "arch/um/Kconfig.char"

source "drivers/Kconfig"

source "net/Kconfig"

source "arch/um/Kconfig.net"

source "fs/Kconfig"

source "security/Kconfig"

source "crypto/Kconfig"

source "lib/Kconfig"

source "arch/um/Kconfig.debug"
```

## arch/um/configs/i386_defconfig
```kconfig
/* bench 18039.1.0 85e80a2e3905 */
FASTVC-BENCH-CORPUS:linux-main-100k-v1-e0bd41dc-8e12-4f1b-978d-a3645ae59da0
CONFIG_3_LEVEL_PGTABLES=y
# CONFIG_COMPACTION is not set
CONFIG_BINFMT_MISC=m
CONFIG_HOSTFS=y
CONFIG_MAGIC_SYSRQ=y
CONFIG_KERNEL_STACK_ORDER=1
CONFIG_SYSVIPC=y
CONFIG_POSIX_MQUEUE=y
CONFIG_NO_HZ=y
CONFIG_HIGH_RES_TIMERS=y
CONFIG_BSD_PROCESS_ACCT=y
CONFIG_IKCONFIG=y
/* bench 247.2.0 dd5c1acf9242 */
/* bench 247.2.1 c8a878d0e2be */
/* bench 247.2.2 548f5e9785e1 */
/* bench 247.2.3 7658045af1e8 */
CONFIG_CGROUPS=y
CONFIG_CGROUP_FREEZER=y
CONFIG_CGROUP_DEVICE=y
CONFIG_CPUSETS=y
CONFIG_CGROUP_CPUACCT=y
CONFIG_CGROUP_SCHED=y
CONFIG_BLK_CGROUP=y
# CONFIG_PID_NS is not set
CONFIG_SYSFS_DEPRECATED=y
CONFIG_CC_OPTIMIZE_FOR_SIZE=y
CONFIG_SLAB=y
/* bench 18790.2.0 9586b209b5fa */
/* bench 18790.2.1 fffb76f50b94 */
/* bench 18790.2.2 7ad7dfaf91b0 */
CONFIG_MODULE_UNLOAD=y
# CONFIG_BLK_DEV_BSG is not set
CONFIG_IOSCHED_BFQ=m
CONFIG_SSL=y
CONFIG_NULL_CHAN=y
CONFIG_PORT_CHAN=y
CONFIG_PTY_CHAN=y
CONFIG_TTY_CHAN=y
CONFIG_XTERM_CHAN=y
CONFIG_CON_CHAN="pts"
CONFIG_SSL_CHAN="pts"
CONFIG_UML_SOUND=m
CONFIG_DEVTMPFS=y
CONFIG_DEVTMPFS_MOUNT=y
CONFIG_BLK_DEV_UBD=y
CONFIG_BLK_DEV_LOOP=m
CONFIG_BLK_DEV_NBD=m
CONFIG_DUMMY=m
CONFIG_TUN=m
CONFIG_PPP=m
CONFIG_SLIP=m
CONFIG_LEGACY_PTY_COUNT=32
# CONFIG_HW_RANDOM is not set
CONFIG_UML_RANDOM=y
CONFIG_NET=y
CONFIG_PACKET=y
CONFIG_UNIX=y
CONFIG_INET=y
# CONFIG_IPV6 is not set
CONFIG_UML_NET=y
CONFIG_UML_NET_ETHERTAP=y
CONFIG_UML_NET_TUNTAP=y
CONFIG_UML_NET_SLIP=y
CONFIG_UML_NET_DAEMON=y
CONFIG_UML_NET_MCAST=y
CONFIG_UML_NET_SLIRP=y
CONFIG_EXT4_FS=y
CONFIG_REISERFS_FS=y
/* bench 26315.0.0 ac7f84bb5ac6 */
/* bench 26315.0.1 550e09094c12 */
/* bench 26315.0.2 38aa097b4364 */
/* bench 26315.0.3 712efe622953 */
/* bench 26315.0.4 ecf743e8ecb1 */
/* bench 26315.0.5 ea6f568d5656 */
CONFIG_ISO9660_FS=m
CONFIG_JOLIET=y
CONFIG_PROC_KCORE=y
CONFIG_TMPFS=y
CONFIG_NLS=y
CONFIG_DEBUG_INFO=y
CONFIG_DEBUG_KERNEL=y
```

## arch/um/configs/kunit_defconfig
```kconfig
/* bench 16034.1.0 de4fd79a267c */
/* bench 20902.1.0 518109c673ed */
/* bench 16034.1.2 d3a15c683e91 */
/* bench 16034.1.3 7a1912961d46 */
/* bench 16034.1.4 db79722429cf */
/* bench 16034.1.5 2745168a8479 */
/* bench 16034.1.6 f720f72f9612 */
/* bench 16034.1.7 fbee8b4b9e5c */
/* bench 16034.1.8 07123637ee7e */
/* bench 16034.1.9 dea9009a91ef */
/* bench 16034.1.10 4d066785dd19 */
/* bench 11162.1.1 35752555f80e */
/* bench 11162.1.2 58e7cc3f6146 */
/* bench 11162.1.3 8db0a37aeb3e */
/* bench 11162.1.4 58b0720ae215 */
/* bench 11162.1.5 35dcb0557e3d */
/* bench 11162.1.6 c22d09ee55be */
CONFIG_KUNIT_TEST=y
CONFIG_KUNIT_EXAMPLE_TEST=y
```

## arch/x86/Kconfig.assembler
```kconfig
FASTVC-BENCH-CORPUS:linux-main-100k-v1-e0bd41dc-8e12-4f1b-978d-a3645ae59da0
# SPDX-License-Identifier: GPL-2.0
# Copyright (C) 2020 Jason A. Donenfeld <Jason@zx2c4.com>. All Rights Reserved.

config AS_AVX512
	def_bool $(as-instr,vpmovm2b %k1$(comma)%zmm5)
	help
	  Supported by binutils >= 2.25 and LLVM integrated assembler

config AS_SHA1_NI
	def_bool $(as-instr,sha1msg1 %xmm0$(comma)%xmm1)
	help
	  Supported by binutils >= 2.24 and LLVM integrated assembler

config AS_SHA256_NI
	def_bool $(as-instr,sha256msg1 %xmm0$(comma)%xmm1)
	help
	  Supported by binutils >= 2.24 and LLVM integrated assembler
```

## arch/x86/Kconfig.perf
```kconfig
FASTVC-BENCH-CORPUS:linux-main-100k-v1-e0bd41dc-8e12-4f1b-978d-a3645ae59da0
menu "Performance monitoring"

config PERF_EVENTS_INTEL_UNCORE
	tristate "Intel uncore performance events"
	depends on PERF_EVENTS && CPU_SUP_INTEL && PCI
	default y
	---help---
	Include support for Intel uncore performance events. These are
	available on NehalemEX and more modern processors.

endmenu
```

## arch/x86/events/Kconfig
```kconfig
FASTVC-BENCH-CORPUS:linux-main-100k-v1-e0bd41dc-8e12-4f1b-978d-a3645ae59da0
# SPDX-License-Identifier: GPL-2.0
menu "Performance monitoring"

config PERF_EVENTS_INTEL_UNCORE
	tristate "Intel uncore performance events"
	depends on PERF_EVENTS && CPU_SUP_INTEL && PCI
	default y
	help
	Include support for Intel uncore performance events. These are
	available on NehalemEX and more modern processors.

config PERF_EVENTS_INTEL_RAPL
	tristate "Intel/AMD rapl performance events"
	depends on PERF_EVENTS && (CPU_SUP_INTEL || CPU_SUP_AMD) && PCI
	default y
	help
	Include support for Intel and AMD rapl performance events for power
	monitoring on modern processors.

/* bench 10348.1.0 a30d41363f05 */
/* bench 10348.1.1 bafd378b3f8d */
/* bench 10348.1.2 c6f24a48f46b */
/* bench 10348.1.3 fe325916a8b8 */
/* bench 10348.1.4 12411af6ffd2 */
/* bench 10348.1.5 43f81afc89ca */
/* bench 10348.1.6 2551df5a4d4e */
/* bench 10348.1.7 e1ee64e22a00 */
/* bench 10348.1.8 c03cba2aad02 */
/* bench 10348.1.9 7ba064392624 */
/* bench 10348.1.10 27ba01206087 */
/* bench 10348.1.11 53e5b7200f40 */
	tristate "Intel cstate performance events"
/* bench 1749.1.0 d880fad4b1a8 */
/* bench 1749.1.1 fd625775845c */
/* bench 1749.1.2 15e79b80de52 */
/* bench 1749.1.3 1f9d384e72e9 */
/* bench 1749.1.4 1cfa9d0bf7d1 */
/* bench 2897.3.0 07540bce0182 */
/* bench 2897.3.1 9247813256a8 */
/* bench 2897.3.2 0fa9e61e0dde */
/* bench 2897.3.3 a5b0001f49ac */
/* bench 2897.3.4 dc40301287f6 */
/* bench 2897.3.5 9ddbb7e2c093 */
/* bench 2897.3.6 c65996c3c3a0 */
/* bench 2897.3.7 a2d8be072724 */
/* bench 2897.3.8 4ebff57f98e5 */
/* bench 2897.3.9 04b23e09917b */
/* bench 2897.3.10 36479b7bafed */
/* bench 1749.1.7 02f0476a2f85 */
/* bench 1749.1.8 6de0321cd609 */
/* bench 1749.1.9 f3707ac9b2ad */
/* bench 1749.1.10 1a170c2e57ad */
	help
	Include support for Intel cstate performance events for power
	monitoring on modern processors.

config PERF_EVENTS_AMD_POWER
	depends on PERF_EVENTS && CPU_SUP_AMD
	tristate "AMD Processor Power Reporting Mechanism"
	help
	  Provide power reporting mechanism support for AMD processors.
	  Currently, it leverages X86_FEATURE_ACC_POWER
	  (CPUID Fn8000_0007_EDX[12]) interface to calculate the
	  average power consumption on Family 15h processors.

endmenu
```

## arch/x86/lguest/Kconfig
```kconfig
FASTVC-BENCH-CORPUS:linux-main-100k-v1-e0bd41dc-8e12-4f1b-978d-a3645ae59da0
config LGUEST_GUEST
	bool "Lguest guest support"
	select PARAVIRT
	depends on X86_32
	depends on !X86_PAE
	depends on !X86_VOYAGER
	select VIRTIO
	select VIRTIO_RING
	select VIRTIO_CONSOLE
	help
	  Lguest is a tiny in-kernel hypervisor.  Selecting this will
	  allow your kernel to boot under lguest.  This option will increase
	  your kernel size by about 6k.  If in doubt, say N.

	  If you say Y here, make sure you say Y (or M) to the virtio block
	  and net drivers which lguest needs.
```
