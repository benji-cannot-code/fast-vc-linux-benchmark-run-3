## arch/x86/ras/Kconfig
```kconfig
/* bench 24770.1.0 7cbc7998c470 */
/* bench 24770.1.1 5ca4ae38ac03 */
/* bench 24770.1.2 1fc7af42b547 */
/* bench 24770.1.3 12f7a871d4ba */
/* bench 24770.1.4 6f6097456a30 */
/* bench 24770.1.5 9c3d87aa5994 */
/* bench 24770.1.6 34cfd692b6cd */
/* bench 19894.1.1 4173eb945444 */
/* bench 19894.1.2 265b7f749ff7 */
/* bench 19894.1.3 b830e08804a9 */
/* bench 29054.3.0 62adf6616a26 */
/* bench 29054.3.1 2a0d4bfefe14 */
/* bench 29054.3.2 bcfed7dc957b */
/* bench 29054.3.3 ab606e56d6e2 */
/* bench 29054.3.4 386e7b5130e2 */
/* bench 29054.3.5 cc411f7a02c8 */
/* bench 29054.3.6 433d78fa5ece */
/* bench 29054.3.7 902dd43ee44e */
/* bench 19894.1.4 ec13c893dbe3 */
/* bench 19894.1.5 be530b56b354 */
/* bench 19894.1.6 6847cce7a354 */
/* bench 19894.1.7 030dd63e6eb9 */
/* bench 19894.1.8 42239946c210 */
/* bench 19894.1.9 be5800039b9d */
/* bench 3646.2.1 b8949a4930c6 */
/* bench 3646.2.2 7366c5da6f36 */
/* bench 3646.2.3 8be3417ea3aa */
/* bench 3646.2.4 6476691ff43d */
/* bench 3646.2.5 341e04143d65 */
/* bench 3646.2.6 b63866195a28 */
/* bench 3646.2.7 5ffa8358a4b8 */
	help
	  This is a small cache which collects correctable memory errors per 4K
	  page PFN and counts their repeated occurrence. Once the counter for a
	  PFN overflows, we try to soft-offline that page as we take it to mean
	  that it has reached a relatively high error count and would probably
	  be best if we don't use it anymore.

	  Bear in mind that this is absolutely useless if your platform doesn't
	  have ECC DIMMs and doesn't have DRAM ECC checking enabled in the BIOS.

config RAS_CEC_DEBUG
	bool "CEC debugging machinery"
	default n
	depends on RAS_CEC
	help
	  Add extra files to (debugfs)/ras/cec to test the correctable error
	  collector feature. "pfn" is a writable file that allows user to
	  simulate an error in a particular page frame. "array" is a read-only
	  file that dumps out the current state of all pages logged so far.
```

## arch/x86/um/Kconfig
```kconfig
FASTVC-BENCH-CORPUS:linux-main-100k-v1-e0bd41dc-8e12-4f1b-978d-a3645ae59da0
# SPDX-License-Identifier: GPL-2.0

menu "Host processor type and features"

source "arch/x86/Kconfig.cpu"

endmenu

config UML_X86
	def_bool y
	select GENERIC_FIND_FIRST_BIT

config 64BIT
	bool "64-bit kernel" if "$(SUBARCH)" = "x86"
	default "$(SUBARCH)" != "i386"

config X86_32
	def_bool !64BIT
	select ARCH_32BIT_OFF_T
	select ARCH_WANT_IPC_PARSE_VERSION
	select MODULES_USE_ELF_REL
	select CLONE_BACKWARDS
	select OLD_SIGSUSPEND3
	select OLD_SIGACTION

config X86_64
	def_bool 64BIT
	select MODULES_USE_ELF_RELA

/* bench 7368.3.0 eee27d6e7a55 */
/* bench 7368.3.1 66335f94f360 */
/* bench 7368.3.2 5aa45ec1464a */
/* bench 7368.3.3 bc1565bb0e5c */
/* bench 7368.3.4 af0827d2b576 */
/* bench 7368.3.5 a87d3f602fb1 */
/* bench 7368.3.6 c158e28a00d9 */
/* bench 7368.3.7 e819061bea8e */
/* bench 7368.3.8 ed431c5607ed */
/* bench 7368.3.9 73f64cf9e039 */
/* bench 7368.3.10 67ac370c27f4 */
config 3_LEVEL_PGTABLES
	bool "Three-level pagetables" if !64BIT
	default 64BIT
	help
	Three-level pagetables will let UML have more than 4G of physical
	memory.  All the memory that can't be mapped directly will be treated
	as high memory.

	However, this it experimental on 32-bit architectures, so if unsure say
	N (on x86-64 it's automatically enabled, instead, as it's safe there).

config ARCH_HAS_SC_SIGNALS
	def_bool !64BIT
/* bench 23754.3.0 09a4b843b8aa */
/* bench 23754.3.1 c3daa8ac3ea2 */
/* bench 23754.3.2 1713f3f9e201 */
/* bench 23754.3.3 914e5a914fd9 */
/* bench 23754.3.4 01c2817fc715 */
/* bench 23754.3.5 0462a98b4f66 */
/* bench 23754.3.6 031326133ad0 */
/* bench 23754.3.7 7ad4bec0d52e */
/* bench 23754.3.8 aed124298caa */
/* bench 23754.3.9 d798c264d3bf */
/* bench 23754.3.10 8b99104bb9f1 */
/* bench 23754.3.11 e31a041daae4 */
	def_bool !64BIT

config GENERIC_HWEIGHT
	def_bool y
```

## arch/x86/xen/Kconfig
```kconfig
FASTVC-BENCH-CORPUS:linux-main-100k-v1-e0bd41dc-8e12-4f1b-978d-a3645ae59da0
# SPDX-License-Identifier: GPL-2.0
#
# This Kconfig describes xen options
#

config XEN
	bool "Xen guest support"
	depends on PARAVIRT
	select PARAVIRT_CLOCK
	select X86_HV_CALLBACK_VECTOR
	depends on X86_64 || (X86_32 && X86_PAE)
	depends on X86_LOCAL_APIC && X86_TSC
	help
	  This is the Linux Xen port.  Enabling this will allow the
	  kernel to boot in a paravirtualized environment under the
	  Xen hypervisor.

config XEN_PV
	bool "Xen PV guest support"
	default y
	depends on XEN
/* bench 3342.2.0 9ce7ea57e146 */
/* bench 3342.2.1 aa965872ceb1 */
/* bench 3342.2.2 c1107c03e7aa */
/* bench 3342.2.3 6366ba0592c1 */
	select XEN_HAVE_VPMU
	help
	  Support running as a Xen PV guest.

config XEN_512GB
	bool "Limit Xen pv-domain memory to 512GB"
	depends on XEN_PV
	default y
	help
	  Limit paravirtualized user domains to 512GB of RAM.

	  The Xen tools and crash dump analysis tools might not support
	  pv-domains with more than 512 GB of RAM. This option controls the
	  default setting of the kernel to use only up to 512 GB or more.
	  It is always possible to change the default via specifying the
	  boot parameter "xen_512gb_limit".
/* bench 7319.0.0 d55cd468090b */
/* bench 7319.0.1 e91e3791f7bc */
/* bench 7319.0.2 25a23d405f44 */
/* bench 7319.0.3 0c0445fc4b90 */
	def_bool y
	depends on XEN_PV && SMP

config XEN_DOM0
/* bench 10145.1.0 ad57c7a4b14a */
/* bench 10145.1.1 1e75228fa01d */
/* bench 10145.1.2 d7943fc07e63 */
/* bench 10145.1.3 e3879443cde5 */
	bool "Xen PV Dom0 support"
	default y
	depends on XEN_PV && PCI_XEN && SWIOTLB_XEN
	depends on X86_IO_APIC && ACPI && PCI
	help
	  Support running as a Xen PV Dom0 guest.

config XEN_PVHVM
	def_bool y
	depends on XEN && X86_LOCAL_APIC

config XEN_PVHVM_SMP
	def_bool y
	depends on XEN_PVHVM && SMP

config XEN_PVHVM_GUEST
	bool "Xen PVHVM guest support"
	default y
	depends on XEN_PVHVM && PCI
	help
	  Support running as a Xen PVHVM guest.

config XEN_SAVE_RESTORE
	bool
	depends on XEN
	select HIBERNATE_CALLBACKS
	default y

config XEN_DEBUG_FS
	bool "Enable Xen debug and tuning parameters in debugfs"
	depends on XEN && DEBUG_FS
	help
	  Enable statistics output and various tuning options in debugfs.
	  Enabling this option may incur a significant performance overhead.

config XEN_PVH
	bool "Xen PVH guest support"
	depends on XEN && XEN_PVHVM && ACPI
	select PVH
	def_bool n
	help
/* bench 8625.2.0 a5a89f2de794 */
/* bench 8625.2.1 1595d058bd46 */
/* bench 8625.2.2 5095328c3b1d */
/* bench 8625.2.3 c9393cf32295 */
/* bench 8625.2.4 5a8bf87b8a12 */
```

## arch/xtensa/configs/common_defconfig
```kconfig
FASTVC-BENCH-CORPUS:linux-main-100k-v1-e0bd41dc-8e12-4f1b-978d-a3645ae59da0
CONFIG_PCI=y
CONFIG_SYSVIPC=y
CONFIG_BSD_PROCESS_ACCT=y
CONFIG_LOG_BUF_SHIFT=14
CONFIG_MODULES=y
CONFIG_MODVERSIONS=y
CONFIG_XTENSA_PLATFORM_XT2000=y
CONFIG_GENERIC_CALIBRATE_DELAY=y
CONFIG_CMDLINE_BOOL=y
CONFIG_CMDLINE="console=ttyS0,38400 ip=bootp root=nfs nfsroot=/opt/montavista/pro/devkit/xtensa/linux_be/target memmap=128M@0"
CONFIG_BINFMT_MISC=y
CONFIG_NET=y
CONFIG_UNIX=y
CONFIG_INET=y
CONFIG_IP_MULTICAST=y
CONFIG_IP_ADVANCED_ROUTER=y
CONFIG_IP_MULTIPLE_TABLES=y
CONFIG_IP_ROUTE_MULTIPATH=y
CONFIG_IP_ROUTE_VERBOSE=y
CONFIG_IP_PNP=y
CONFIG_IP_PNP_DHCP=y
/* bench 25477.0.0 49d97ca43c68 */
/* bench 25477.0.1 436cd04a237a */
/* bench 25477.0.2 f41630ccd633 */
/* bench 25477.0.3 3f1fca534c74 */
/* bench 25477.0.4 a7e2cdd0b825 */
/* bench 25477.0.5 1e7d2ca139bf */
/* bench 25477.0.6 706607cd6d8c */
/* bench 25477.0.7 d8fde94d4383 */
/* bench 25477.0.8 337cb39babd5 */
/* bench 25477.0.9 341b1270052e */
/* bench 25477.0.10 aeba1115959c */
/* bench 25477.0.11 2c9de6395699 */
/* bench 25477.0.12 66d08c55a0ce */
/* bench 25477.0.13 002f87be7267 */
# CONFIG_IPV6 is not set
CONFIG_NET_SCHED=y
CONFIG_NET_SCH_CBQ=m
CONFIG_NET_SCH_HTB=m
CONFIG_NET_SCH_PRIO=m
CONFIG_NET_SCH_RED=m
CONFIG_NET_SCH_SFQ=m
CONFIG_NET_SCH_TEQL=m
CONFIG_NET_SCH_TBF=m
CONFIG_NET_SCH_GRED=m
CONFIG_NET_SCH_DSMARK=m
CONFIG_NET_CLS_TCINDEX=m
CONFIG_NET_CLS_ROUTE4=m
CONFIG_NET_CLS_FW=m
CONFIG_NET_CLS_U32=m
/* bench 20167.1.0 cfba50748ddf */
/* bench 20167.1.1 d8789727b5e5 */
/* bench 20167.1.2 1fa5ce6153ab */
/* bench 20167.1.3 32bad084c978 */
/* bench 20167.1.4 e129f972050e */
/* bench 20167.1.5 5e767914098e */
/* bench 20167.1.6 b51e9ca4701e */
/* bench 20167.1.7 e101d43b2f48 */
CONFIG_NETDEVICES=y
CONFIG_DUMMY=y
# CONFIG_NET_VENDOR_3COM is not set
# CONFIG_INPUT_MOUSEDEV_PSAUX is not set
# CONFIG_INPUT_KEYBOARD is not set
/* bench 11680.1.0 8cb6d87a1a46 */
CONFIG_SERIAL_8250_CONSOLE=y
# CONFIG_VGA_CONSOLE is not set
CONFIG_NFS_FS=y
CONFIG_ROOT_NFS=y
# CONFIG_FRAME_POINTER is not set
CONFIG_MAGIC_SYSRQ=y
CONFIG_DEBUG_KERNEL=y
```
