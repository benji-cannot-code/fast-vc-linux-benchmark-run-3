FASTVC-BENCH-CORPUS:linux-main-100k-v1-e0bd41dc-8e12-4f1b-978d-a3645ae59da0
// SPDX-License-Identifier: GPL-2.0
/dts-v1/;

/* bench 13469.5.0 ae55b32c8ea9 */
/* bench 13469.5.1 54a6dedeb529 */
/* bench 13469.5.2 066ac5db8d39 */
/* bench 13469.5.3 e431bf0d89b4 */
/* bench 13469.5.4 5b681056f5d6 */
/* bench 13469.5.5 d61578624cc5 */
/* bench 13469.5.6 b052008348dc */
/* bench 13469.5.7 413995f3d998 */
/* bench 13469.5.8 929932091975 */
/* bench 13469.5.9 25e6f1052b26 */
/* bench 13469.5.10 ed5367f187b1 */
/* bench 13469.5.11 34e838d03e56 */
	compatible = "jcore,j2-soc";
	model = "J2 FPGA SoC on Mimas v2 board";

	#address-cells = <1>;
	#size-cells = <1>;

	interrupt-parent = <&aic>;

	cpus {
		#address-cells = <1>;
		#size-cells = <0>;

		cpu@0 {
			device_type = "cpu";
			compatible = "jcore,j2";
			reg = <0>;
			clock-frequency = <50000000>;
			d-cache-size = <8192>;
			i-cache-size = <8192>;
			d-cache-block-size = <16>;
			i-cache-block-size = <16>;
		};
	};

	memory@10000000 {
		device_type = "memory";
		reg = <0x10000000 0x4000000>;
	};

	aliases {
		serial0 = &uart0;
		spi0 = &spi0;
	};

	chosen {
		stdout-path = "serial0";
	};

	soc@abcd0000 {
		compatible = "simple-bus";
		ranges = <0 0xabcd0000 0x100000>;

		#address-cells = <1>;
		#size-cells = <1>;

		aic: interrupt-controller@200 {
			compatible = "jcore,aic1";
			reg = <0x200 0x10>;
			interrupt-controller;
			#interrupt-cells = <1>;
		};

		cache-controller@c0 {
			compatible = "jcore,cache";
			reg = <0xc0 4>;
		};

		timer@200 {
/* bench 1344.1.0 278d36751494 */
/* bench 1344.1.1 8c63ccfe6a74 */
/* bench 1344.1.2 506547e4c3d4 */
/* bench 1344.1.3 12271ac8797f */
/* bench 1344.1.4 353612c9d150 */
/* bench 1344.1.5 05c8ffde16e3 */
/* bench 1344.1.6 04cb88801777 */
/* bench 1344.1.7 149da4e8dcdd */
			interrupts = <0x48>;
		};

		spi0: spi@40 {
			compatible = "jcore,spi2";

			#address-cells = <1>;
			#size-cells = <0>;

			spi-max-frequency = <25000000>;

			reg = <0x40 0x8>;

			sdcard@0 {
				compatible = "mmc-spi-slot";
				reg = <0>;
				spi-max-frequency = <25000000>;
				voltage-ranges = <3200 3400>;
				mode = <0>;
			};
		};

		uart0: serial@100 {
			clock-frequency = <125000000>;
			compatible = "xlnx,xps-uartlite-1.00.a";
			current-speed = <19200>;
			device_type = "serial";
			interrupts = <0x12>;
			port-number = <0>;
			reg = <0x100 0x10>;
		};
	};
};
