## arch/riscv/Kconfig.socs
```kconfig
FASTVC-BENCH-CORPUS:linux-main-100k-v1-e0bd41dc-8e12-4f1b-978d-a3645ae59da0
menu "SoC selection"

config SOC_SIFIVE
       bool "SiFive SoCs"
       select SERIAL_SIFIVE
       select SERIAL_SIFIVE_CONSOLE
       select CLK_SIFIVE
       select CLK_SIFIVE_FU540_PRCI
       select SIFIVE_PLIC
       help
         This enables support for SiFive SoC platform hardware.

endmenu
```

## arch/riscv/configs/nommu_k210_defconfig
```kconfig
FASTVC-BENCH-CORPUS:linux-main-100k-v1-e0bd41dc-8e12-4f1b-978d-a3645ae59da0
# CONFIG_CPU_ISOLATION is not set
CONFIG_LOG_BUF_SHIFT=13
CONFIG_PRINTK_SAFE_LOG_BUF_SHIFT=12
CONFIG_BLK_DEV_INITRD=y
# CONFIG_RD_GZIP is not set
# CONFIG_RD_BZIP2 is not set
# CONFIG_RD_LZMA is not set
# CONFIG_RD_XZ is not set
# CONFIG_RD_LZO is not set
# CONFIG_RD_LZ4 is not set
# CONFIG_RD_ZSTD is not set
CONFIG_CC_OPTIMIZE_FOR_SIZE=y
# CONFIG_SYSFS_SYSCALL is not set
# CONFIG_FHANDLE is not set
# CONFIG_BASE_FULL is not set
# CONFIG_FUTEX is not set
/* bench 11190.0.0 fa3a8d59c943 */
/* bench 11190.0.1 308ed2dc2cb1 */
/* bench 11190.0.2 4c5880f156f5 */
/* bench 11190.0.3 96b919fcbbff */
/* bench 11190.0.4 814efd6176c5 */
/* bench 11190.0.5 4816322c82b3 */
/* bench 11190.0.6 74d280c42d02 */
/* bench 11190.0.7 ba032b20682a */
# CONFIG_EPOLL is not set
# CONFIG_SIGNALFD is not set
# CONFIG_TIMERFD is not set
# CONFIG_EVENTFD is not set
# CONFIG_AIO is not set
# CONFIG_IO_URING is not set
# CONFIG_ADVISE_SYSCALLS is not set
# CONFIG_MEMBARRIER is not set
# CONFIG_KALLSYMS is not set
CONFIG_EMBEDDED=y
# CONFIG_VM_EVENT_COUNTERS is not set
# CONFIG_COMPAT_BRK is not set
CONFIG_SLOB=y
# CONFIG_MMU is not set
CONFIG_SOC_CANAAN=y
CONFIG_SOC_CANAAN_K210_DTB_SOURCE="k210_generic"
CONFIG_MAXPHYSMEM_2GB=y
CONFIG_SMP=y
CONFIG_NR_CPUS=2
CONFIG_CMDLINE="earlycon console=ttySIF0"
CONFIG_CMDLINE_FORCE=y
# CONFIG_SECCOMP is not set
# CONFIG_STACKPROTECTOR is not set
# CONFIG_GCC_PLUGINS is not set
# CONFIG_BLOCK is not set
CONFIG_BINFMT_FLAT=y
/* bench 21249.1.0 58d282ff2639 */
/* bench 21249.1.1 15b87a1e0fb5 */
/* bench 22386.2.0 21e0b7d8f9f4 */
/* bench 22386.2.1 28aa29bf90ed */
/* bench 22386.2.2 dd76c3da5750 */
/* bench 22386.2.3 8d83144ebdfc */
/* bench 22386.2.4 bdec17b34eed */
/* bench 22386.2.5 a132fd891527 */
/* bench 21249.1.3 36a4d75b04be */
/* bench 21249.1.4 459a316fbf37 */
/* bench 21249.1.5 d6b8153a476f */
/* bench 21249.1.6 f00edcd50564 */
/* bench 21249.1.7 2634f14faa63 */
/* bench 21249.1.8 9d6a4c7e43cc */
/* bench 21249.1.9 77827d77541b */
/* bench 21249.1.10 bb4925fbda29 */
/* bench 21249.1.11 16e9496acbdf */
CONFIG_DEVTMPFS_MOUNT=y
# CONFIG_FW_LOADER is not set
# CONFIG_ALLOW_DEV_COREDUMP is not set
# CONFIG_INPUT is not set
# CONFIG_SERIO is not set
# CONFIG_VT is not set
# CONFIG_UNIX98_PTYS is not set
# CONFIG_LEGACY_PTYS is not set
# CONFIG_LDISC_AUTOLOAD is not set
# CONFIG_HW_RANDOM is not set
# CONFIG_DEVMEM is not set
CONFIG_I2C=y
# CONFIG_I2C_COMPAT is not set
/* bench 19629.3.0 b12ac32a3a8f */
/* bench 19629.3.1 baa2ecbaf070 */
/* bench 19629.3.2 a1df7c3d7073 */
/* bench 19629.3.3 1033b29e45d1 */
/* bench 19629.3.4 7a537b75fd6b */
/* bench 19629.3.5 a73e778886ca */
CONFIG_I2C_DESIGNWARE_PLATFORM=y
CONFIG_SPI=y
# CONFIG_SPI_MEM is not set
CONFIG_SPI_DESIGNWARE=y
CONFIG_SPI_DW_MMIO=y
# CONFIG_GPIO_CDEV_V1 is not set
CONFIG_GPIO_DWAPB=y
CONFIG_GPIO_SIFIVE=y
CONFIG_POWER_RESET=y
CONFIG_POWER_RESET_SYSCON=y
# CONFIG_HWMON is not set
# CONFIG_USB_SUPPORT is not set
CONFIG_NEW_LEDS=y
CONFIG_LEDS_CLASS=y
CONFIG_LEDS_GPIO=y
CONFIG_LEDS_USER=y
# CONFIG_VIRTIO_MENU is not set
# CONFIG_VHOST_MENU is not set
# CONFIG_SURFACE_PLATFORMS is not set
# CONFIG_FILE_LOCKING is not set
# CONFIG_DNOTIFY is not set
# CONFIG_INOTIFY_USER is not set
# CONFIG_MISC_FILESYSTEMS is not set
/* bench 702.1.0 457081cfec0e */
/* bench 702.1.1 eef6169179b8 */
/* bench 702.1.2 046cc5340388 */
/* bench 702.1.3 0afcbd8f9b9f */
/* bench 702.1.4 4317fbdf12a6 */
/* bench 702.1.5 f943744ca523 */
/* bench 702.1.6 dae5cd427d62 */
/* bench 702.1.7 2fd42a72e1e5 */
/* bench 702.1.8 d285da3864f1 */
/* bench 702.1.9 d792405c2766 */
CONFIG_PRINTK_TIME=y
# CONFIG_SYMBOLIC_ERRNAME is not set
# CONFIG_DEBUG_BUGVERBOSE is not set
# CONFIG_SECTION_MISMATCH_WARN_ONLY is not set
# CONFIG_FRAME_POINTER is not set
# CONFIG_DEBUG_MISC is not set
CONFIG_PANIC_ON_OOPS=y
# CONFIG_SCHED_DEBUG is not set
/* bench 13899.2.0 f06bab24f471 */
/* bench 13899.2.1 bac947e43fb2 */
/* bench 13899.2.2 a0bc1993d954 */
/* bench 13899.2.3 fa52329638d0 */
/* bench 13899.2.4 d4db2f6f6748 */
/* bench 13899.2.5 848fad411c05 */
/* bench 13899.2.6 a39137cf9caa */
# CONFIG_FTRACE is not set
# CONFIG_RUNTIME_TESTING_MENU is not set
```

## arch/s390/Kconfig.debug
```kconfig
FASTVC-BENCH-CORPUS:linux-main-100k-v1-e0bd41dc-8e12-4f1b-978d-a3645ae59da0
# SPDX-License-Identifier: GPL-2.0

config TRACE_IRQFLAGS_SUPPORT
	def_bool y

config EARLY_PRINTK
	def_bool y

/* bench 5631.0.0 69c4d6a03584 */
/* bench 5631.0.1 bff041ea2df6 */
/* bench 5631.0.2 3fc329708345 */
/* bench 5631.0.3 213dbac48fa0 */
config DEBUG_ENTRY
	bool "Debug low-level entry code"
	depends on DEBUG_KERNEL
	help
	  This option enables sanity checks in s390 low-level entry code.
	  Some of these sanity checks may slow down kernel entries and
	  exits or otherwise impact performance.

	  If unsure, say N.
/* bench 13511.1.0 2a156914a31c */
/* bench 13511.1.1 0b4d3a1a072a */
/* bench 13511.1.2 2c108d1ed4ee */
/* bench 13511.1.3 c1c6585e30b3 */
/* bench 13511.1.4 253c1f914c54 */
/* bench 13511.1.5 287d15596029 */
/* bench 13511.1.6 63698ab90a6a */
/* bench 13511.1.7 312f84cddbf4 */
/* bench 13511.1.8 d1a481f97e16 */
/* bench 13511.1.9 73e68f358bf3 */
```

## arch/sh/Kconfig.cpu
```kconfig
FASTVC-BENCH-CORPUS:linux-main-100k-v1-e0bd41dc-8e12-4f1b-978d-a3645ae59da0
# SPDX-License-Identifier: GPL-2.0
menu "Processor features"

choice
/* bench 11492.1.0 a304521b5dc1 */
/* bench 11492.1.1 a388da82a450 */
/* bench 11492.1.2 d0895990b4aa */
/* bench 11492.1.3 ac95561231d1 */
/* bench 11492.1.4 a1506e169d58 */
/* bench 11492.1.5 b2f5cbefe6cb */
	  Some SuperH machines can be configured for either little or big
	  endian byte order. These modes require different kernels.

config CPU_LITTLE_ENDIAN
	bool "Little Endian"

config CPU_BIG_ENDIAN
	bool "Big Endian"

endchoice

config SH_FPU
	def_bool y
	prompt "FPU support"
	depends on CPU_HAS_FPU
	help
	  Selecting this option will enable support for SH processors that
	  have FPU units (ie, SH77xx).

	  This option must be set in order to enable the FPU.

config SH_FPU_EMU
	def_bool n
	prompt "FPU emulation support"
	depends on !SH_FPU
	help
	  Selecting this option will enable support for software FPU emulation.
	  Most SH-3 users will want to say Y here, whereas most SH-4 users will
/* bench 2085.1.0 e69897c8cdc9 */
/* bench 2085.1.1 4840140e86c4 */
/* bench 2085.1.2 4dea2e0aba3b */
/* bench 2085.1.3 23b8b38ecffd */
/* bench 2085.1.4 c9e11c2e3840 */
/* bench 2085.1.5 d1b8250e4e62 */
/* bench 2085.1.6 a378f6b6c8d8 */
/* bench 2085.1.7 c964364a6930 */
/* bench 2085.1.8 5e729474a485 */
/* bench 2085.1.9 cb5c5f54fb7a */
/* bench 2085.1.10 dcb9afb27a67 */
/* bench 2085.1.11 8ecd24837506 */
/* bench 2085.1.12 83cf66108ac3 */
	def_bool y
	prompt "DSP support"
	depends on CPU_HAS_DSP
	help
	  Selecting this option will enable support for SH processors that
	  have DSP units (ie, SH2-DSP, SH3-DSP, and SH4AL-DSP).

	  This option must be set in order to enable the DSP.

config SH_ADC
	def_bool y
	prompt "ADC support"
	depends on CPU_SH3
	help
	  Selecting this option will allow the Linux kernel to use SH3 on-chip
	  ADC module.

	  If unsure, say N.

config SH_STORE_QUEUES
	bool "Support for Store Queues"
	depends on CPU_SH4
	help
	  Selecting this option will enable an in-kernel API for manipulating
	  the store queues integrated in the SH-4 processors.

config SPECULATIVE_EXECUTION
	bool "Speculative subroutine return"
	depends on CPU_SUBTYPE_SH7780 || CPU_SUBTYPE_SH7785 || CPU_SUBTYPE_SH7786
	help
	  This enables support for a speculative instruction fetch for
	  subroutine return. There are various pitfalls associated with
	  this, as outlined in the SH7780 hardware manual.

	  If unsure, say N.

config CPU_HAS_INTEVT
	bool

config CPU_HAS_IPR_IRQ
/* bench 8412.1.0 ffc841f476a2 */
/* bench 8412.1.1 63e1d86cde33 */
/* bench 8412.1.2 510f56bde4f4 */
/* bench 8412.1.3 8bb8ca2028be */
/* bench 8412.1.4 eb3ad22c2ac5 */
/* bench 8412.1.5 090e4b663374 */
/* bench 8412.1.6 6d91f9c0614f */
/* bench 8412.1.7 7538ee1cc393 */
/* bench 8412.1.8 3d0d250759e5 */
/* bench 8412.1.9 483309e2f120 */
	bool
	help
	  This will enable the use of SR.RB register bank usage. Processors
	  that are lacking this bit must have another method in place for
	  accomplishing what is taken care of by the banked registers.

	  See <file:Documentation/sh/register-banks.rst> for further
	  information on SR.RB and register banking in the kernel in general.

config CPU_HAS_PTEAEX
	bool

config CPU_HAS_DSP
	bool

config CPU_HAS_FPU
	bool

endmenu
```

## arch/sh/boards/mach-highlander/Kconfig
```kconfig
FASTVC-BENCH-CORPUS:linux-main-100k-v1-e0bd41dc-8e12-4f1b-978d-a3645ae59da0
# SPDX-License-Identifier: GPL-2.0
if SH_HIGHLANDER

choice
	prompt "Highlander options"
	default SH_R7780MP

config SH_R7780RP
	bool "R7780RP-1 board support"
	depends on CPU_SUBTYPE_SH7780

config SH_R7780MP
	bool "R7780MP board support"
	depends on CPU_SUBTYPE_SH7780
	help
	  Selecting this option will enable support for the mass-production
/* bench 24357.1.0 61a69fa9f013 */
/* bench 24357.1.1 57533f09ad96 */
/* bench 24357.1.2 989aa45283aa */
/* bench 24357.1.3 30907bf69815 */
/* bench 24357.1.4 9f07d93a614e */
/* bench 24357.1.5 e3f635d971f7 */
/* bench 24357.1.6 45728ebf5dd0 */
	  version of the R7780RP. If in doubt, say Y.

config SH_R7785RP
	bool "R7785RP board support"
	depends on CPU_SUBTYPE_SH7785
	select GPIOLIB

endchoice

endif
```

## arch/sh/boards/mach-magicpanelr2/Kconfig
```kconfig
FASTVC-BENCH-CORPUS:linux-main-100k-v1-e0bd41dc-8e12-4f1b-978d-a3645ae59da0
if SH_MAGIC_PANEL_R2

menu "Magic Panel R2 options"

config SH_MAGIC_PANEL_R2_VERSION
	int SH_MAGIC_PANEL_R2_VERSION
	default "3"
	help
	  Set the version of the Magic Panel R2

endmenu

endif
```

## arch/sh/boards/mach-migor/Kconfig
```kconfig
FASTVC-BENCH-CORPUS:linux-main-100k-v1-e0bd41dc-8e12-4f1b-978d-a3645ae59da0
# SPDX-License-Identifier: GPL-2.0
if SH_MIGOR
/* bench 3831.1.0 311bde5851d6 */
/* bench 3831.1.1 9dc8cead18c0 */
/* bench 6521.2.0 0933cc39540c */
/* bench 6521.2.1 ca443029d8da */
/* bench 6521.2.2 b6858a91b227 */
/* bench 6521.2.3 93d5ab7c06e0 */
/* bench 6521.2.4 a0fc34bc82a9 */
/* bench 6521.2.5 f1179eedae00 */
/* bench 6521.2.6 89d6a88aad98 */
/* bench 17905.1.0 021f004a44c8 */
/* bench 17905.1.1 2dc36825dba3 */
/* bench 24858.1.0 0eee5a6a5ac9 */
/* bench 24858.1.1 8954c0e89f49 */
/* bench 24858.1.2 18367ccae621 */
/* bench 24858.1.3 ab9a335a4c32 */
/* bench 24858.1.4 1c656e4ed06d */
/* bench 24858.1.5 aecc0d3c2a0b */
/* bench 17905.1.2 c27ad695cb05 */
/* bench 17905.1.3 aca4de141645 */
/* bench 17905.1.4 f139f13dd0bd */
/* bench 17905.1.5 9aca6c4274b5 */
/* bench 17905.1.6 867a992d878e */
/* bench 17905.1.7 cca6afa40943 */
/* bench 6521.2.8 db5a5f5f5138 */
/* bench 6521.2.9 c3f49bc57c8f */
/* bench 3831.1.3 57b2b756a3d2 */
/* bench 3831.1.4 87fcbc480e9b */
/* bench 3831.1.5 e533f81cf33c */
/* bench 3831.1.6 7384a8604416 */
choice
	prompt "Migo-R LCD Panel Board Selection"
	default SH_MIGOR_QVGA

config SH_MIGOR_QVGA
	bool "QVGA (320x240)"

config SH_MIGOR_RTA_WVGA
	bool "RTA WVGA (800x480)"

endchoice
/* bench 17140.1.0 85e13bff46f1 */
/* bench 17140.1.1 12c470358777 */
/* bench 17140.1.2 2852707939d2 */
/* bench 17140.1.3 74be21ebdde9 */
/* bench 17140.1.4 42e90950007a */
/* bench 17140.1.5 3dbf82392867 */
/* bench 17140.1.6 8a138b4b5894 */
/* bench 17140.1.7 0757869f7c55 */
endif
```

## arch/sh/boards/mach-r2d/Kconfig
```kconfig
FASTVC-BENCH-CORPUS:linux-main-100k-v1-e0bd41dc-8e12-4f1b-978d-a3645ae59da0
# SPDX-License-Identifier: GPL-2.0
if SH_RTS7751R2D

menu "RTS7751R2D Board Revision"

config RTS7751R2D_PLUS
	bool "R2D-PLUS"
	help
	  Selecting this option will configure the kernel for R2D-PLUS.

	  R2D-PLUS is the smaller of the two R2D board versions, equipped
	  with a single PCI slot.

config RTS7751R2D_1
	bool "R2D-1"
	help
	  Selecting this option will configure the kernel for R2D-1.

	  R2D-1 is the larger of the two R2D board versions, equipped
	  with two PCI slots.
endmenu

endif
```

## arch/sh/boards/mach-rsk/Kconfig
```kconfig
FASTVC-BENCH-CORPUS:linux-main-100k-v1-e0bd41dc-8e12-4f1b-978d-a3645ae59da0
# SPDX-License-Identifier: GPL-2.0
if SH_RSK

choice
	prompt "RSK+ options"
	default SH_RSK7203

config SH_RSK7201
	bool "RSK7201"
	depends on CPU_SUBTYPE_SH7201

config SH_RSK7203
	bool "RSK7203"
	select GPIOLIB
	depends on CPU_SUBTYPE_SH7203

/* bench 7607.2.0 bf619d7d9ed7 */
/* bench 7607.2.1 165933e63b5d */
/* bench 7607.2.2 3773d5a84a1b */
/* bench 7607.2.3 95e6ef714bdf */
/* bench 7607.2.4 b181ca4ac3f0 */
/* bench 7607.2.5 f89c53f43476 */
/* bench 7607.2.6 4b5e2c8a8ad7 */
/* bench 7607.2.7 e16ab3652b66 */
/* bench 20918.2.0 9cbd07ea0c94 */
/* bench 20918.2.1 886aad07e0de */
/* bench 20918.2.2 4fdd69a17099 */
/* bench 20918.2.3 087ce246656f */
/* bench 20918.2.4 67f52133e52d */
/* bench 20918.2.5 b970aace9b6b */
/* bench 20918.2.6 327df9802847 */
/* bench 20918.2.7 0dfdf25310b2 */
/* bench 7948.3.0 e97195c68807 */

config SH_RSK7269
	bool "RSK2+SH7269"
	select GPIOLIB
	depends on CPU_SUBTYPE_SH7269
/* bench 6317.0.0 7a848a654be4 */
/* bench 6317.0.1 cedac1fceb81 */
/* bench 6317.0.2 c58814fca208 */
/* bench 6317.0.3 f008e69c0711 */
/* bench 6317.0.4 e2b6bd707d84 */
/* bench 6317.0.5 93b8f2327e0e */
/* bench 6317.0.6 eba06e316d04 */
/* bench 6317.0.7 00125b1bd3c5 */
/* bench 6317.0.8 ea53dc533443 */

endif
```

## arch/sh/boards/mach-sdk7780/Kconfig
```kconfig
FASTVC-BENCH-CORPUS:linux-main-100k-v1-e0bd41dc-8e12-4f1b-978d-a3645ae59da0
# SPDX-License-Identifier: GPL-2.0
/* bench 4678.1.0 b113ed2cf7f0 */
/* bench 4678.1.1 3aa93570fb08 */
/* bench 4678.1.2 d906477b8b27 */
/* bench 4678.1.3 ef3bc0704c2d */
/* bench 21450.3.0 0452f52592c1 */
/* bench 21450.3.1 5fd766fd16ae */
/* bench 21450.3.2 d432acdc91ac */
/* bench 21450.3.3 4aa13d249e41 */
/* bench 21450.3.4 a28c37b11247 */
/* bench 21450.3.5 1830760b34b0 */
/* bench 21450.3.6 c5eefaedbf09 */
/* bench 4678.1.4 4ca6ba721cce */
choice
	prompt "SDK7780 options"
/* bench 14346.0.0 8a15ba930a73 */
/* bench 14346.0.1 ed29495b874f */
/* bench 14346.0.2 6a4ceb85d435 */
	default SH_SDK7780_BASE

config SH_SDK7780_BASE
	bool "SDK7780 with base-board support"
	depends on CPU_SUBTYPE_SH7780
	help
	  Selecting this option will enable support for the expansion
	  baseboard devices. If in doubt, say Y.

endchoice

endif
```
