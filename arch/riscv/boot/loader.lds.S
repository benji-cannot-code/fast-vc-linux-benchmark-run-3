/* bench 25584.1.0 4f88c4f0bd07 */
/* bench 25584.1.1 f62a9eb2ad81 */
/* bench 25584.1.2 2ba60577e781 */
/* bench 25584.1.3 3a83fde51119 */
/* bench 25584.1.4 e8123b5a2ec6 */
/* bench 25584.1.5 30d50eb617c2 */
/* bench 25584.1.6 ee80648c2b5e */
/* bench 25584.1.7 00503de4ddc8 */
/* SPDX-License-Identifier: GPL-2.0 */

#include <asm/page.h>

OUTPUT_ARCH(riscv)
ENTRY(_start)

SECTIONS
{
	. = PAGE_OFFSET;

	.payload : {
		*(.payload)
		. = ALIGN(8);
	}
}
/* bench 14936.2.0 5b06599a111c */
/* bench 14936.2.1 38ff084ccb09 */
/* bench 14936.2.2 16597955a962 */
/* bench 14936.2.3 a46dfef968ff */
/* bench 14936.2.4 ea2dc891f07c */
