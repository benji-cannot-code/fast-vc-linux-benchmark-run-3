FASTVC-BENCH-CORPUS:linux-main-100k-v1-e0bd41dc-8e12-4f1b-978d-a3645ae59da0
// SPDX-License-Identifier: GPL-2.0+
/*
 * Copyright (C) 2020 Western Digital Corporation or its affiliates.
 */

/dts-v1/;

#include "k210.dtsi"

/ {
	model = "Kendryte K210 generic";
	compatible = "kendryte,k210";

	chosen {
		bootargs = "earlycon console=ttySIF0";
		stdout-path = "serial0";
	};
};

&uarths0 {
	status = "okay";
};

