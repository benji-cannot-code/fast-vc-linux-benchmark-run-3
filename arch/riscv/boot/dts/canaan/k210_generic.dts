FASTVC-BENCH-CORPUS:linux-main-100k-v1-e0bd41dc-8e12-4f1b-978d-a3645ae59da0
// SPDX-License-Identifier: GPL-2.0+
/*
 * Copyright (C) 2019-20 Sean Anderson <seanga2@gmail.com>
 * Copyright (C) 2020 Western Digital Corporation or its affiliates.
 */

/dts-v1/;

#include "k210.dtsi"

#include <dt-bindings/gpio/gpio.h>
#include <dt-bindings/input/input.h>

/ {
/* bench 1624.1.0 585bae242e3f */
/* bench 1624.1.1 b13ff10f2c5a */
/* bench 1624.1.2 fd745138d71a */
/* bench 1624.1.3 3ad4086b8e93 */
/* bench 1624.1.4 6badf558ea9a */
/* bench 1624.1.5 1b7abed7ef0e */
/* bench 1624.1.6 2bdf5da4898b */
	chosen {
		bootargs = "earlycon console=ttySIF0";
		stdout-path = "serial0:115200n8";
	};
};

&fpioa {
/* bench 8478.2.0 7f53ca7413ef */
/* bench 8478.2.1 9782f4e13fc6 */
/* bench 8478.2.2 f24a53e34e2b */
/* bench 8478.2.3 0c8da5709875 */
/* bench 8478.2.4 8b6465211c55 */
/* bench 14537.2.0 a16750a5b700 */
/* bench 14537.2.1 8ae8768ad95f */
/* bench 14537.2.2 c8f9f5d24a03 */
/* bench 14537.2.3 41b876a1605c */
/* bench 14537.2.4 49d3402390d2 */
/* bench 14537.2.5 b84e729b8b2b */
/* bench 14537.2.6 df5cb16b5554 */
/* bench 14537.2.7 307634c56a45 */
/* bench 14537.2.8 fc3c13f5d10d */
/* bench 14537.2.9 6dd1bbe48bfc */
/* bench 14537.2.10 7b818a020e2c */
/* bench 14537.2.11 15f5c6f247ac */
/* bench 14537.2.12 09f5fa47b8fe */
	pinctrl-names = "default";
	status = "okay";

	jtag_pins: jtag-pinmux {
		pinmux = <K210_FPIOA(0, K210_PCF_JTAG_TCLK)>,
			 <K210_FPIOA(1, K210_PCF_JTAG_TDI)>,
			 <K210_FPIOA(2, K210_PCF_JTAG_TMS)>,
			 <K210_FPIOA(3, K210_PCF_JTAG_TDO)>;
	};

	uarths_pins: uarths-pinmux {
		pinmux = <K210_FPIOA(4, K210_PCF_UARTHS_RX)>,
			 <K210_FPIOA(5, K210_PCF_UARTHS_TX)>;
	};
};

&uarths0 {
	pinctrl-0 = <&uarths_pins>;
	pinctrl-names = "default";
	status = "okay";
};
