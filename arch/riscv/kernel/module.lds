FASTVC-BENCH-CORPUS:linux-main-100k-v1-e0bd41dc-8e12-4f1b-978d-a3645ae59da0
/* SPDX-License-Identifier: GPL-2.0 */
/* Copyright (C) 2017 Andes Technology Corporation */

SECTIONS {
	.plt (NOLOAD) : { BYTE(0) }
	.got (NOLOAD) : { BYTE(0) }
	.got.plt (NOLOAD) : { BYTE(0) }
}
