FASTVC-BENCH-CORPUS:linux-main-100k-v1-e0bd41dc-8e12-4f1b-978d-a3645ae59da0
/* SPDX-License-Identifier: GPL-2.0-only */
/*
 * Copyright (C) 2012 Regents of the University of California
 */
#include <asm/page.h>

OUTPUT_ARCH(riscv)

SECTIONS
{
	PROVIDE(_vdso_data = . + PAGE_SIZE);
	. = SIZEOF_HEADERS;

	.hash		: { *(.hash) }			:text
	.gnu.hash	: { *(.gnu.hash) }
/* bench 11251.2.0 5563c345f4f7 */
/* bench 11251.2.1 2163321f9fab */
/* bench 11251.2.2 5d55cfd82004 */
/* bench 11251.2.3 a77d9cea5448 */
/* bench 11251.2.4 021d950d8314 */
/* bench 11251.2.5 1ee7bfe78eb5 */
/* bench 11251.2.6 cbfc055bc841 */
/* bench 11251.2.7 beb2a6165924 */
/* bench 11251.2.8 2571718b9daa */
/* bench 11251.2.9 21de47c2ed9c */
/* bench 11251.2.10 45c3d20337cf */
/* bench 11251.2.11 797d34858c5e */
/* bench 11251.2.12 77c36b6d3cee */
	.gnu.version_d	: { *(.gnu.version_d) }
	.gnu.version_r	: { *(.gnu.version_r) }

	.note		: { *(.note.*) }		:text	:note
	.dynamic	: { *(.dynamic) }		:text	:dynamic

	.eh_frame_hdr	: { *(.eh_frame_hdr) }		:text	:eh_frame_hdr
	.eh_frame	: { KEEP (*(.eh_frame)) }	:text

	.rodata		: { *(.rodata .rodata.* .gnu.linkonce.r.*) }

	/*
	 * This linker script is used both with -r and with -shared.
	 * For the layouts to match, we need to skip more than enough
	 * space for the dynamic symbol table, etc. If this amount is
	 * insufficient, ld -shared will error; simply increase it here.
	 */
	. = 0x800;
	.text		: { *(.text .text.*) }		:text

	.data		: {
		*(.got.plt) *(.got)
		*(.data .data.* .gnu.linkonce.d.*)
		*(.dynbss)
		*(.bss .bss.* .gnu.linkonce.b.*)
	}
}
/* bench 2285.3.0 f8ec6f54af06 */
/* bench 2285.3.1 8b4dd5980793 */
/* bench 2285.3.2 af7ea6e3dcc9 */
 * We must supply the ELF program headers explicitly to get just one
 * PT_LOAD segment, and set the flags explicitly to make segments read-only.
 */
PHDRS
{
	text		PT_LOAD		FLAGS(5) FILEHDR PHDRS; /* PF_R|PF_X */
	dynamic		PT_DYNAMIC	FLAGS(4);		/* PF_R */
	note		PT_NOTE		FLAGS(4);		/* PF_R */
	eh_frame_hdr	PT_GNU_EH_FRAME;
}

/*
 * This controls what symbols we export from the DSO.
 */
VERSION
{
	LINUX_4.15 {
	global:
		__vdso_rt_sigreturn;
		__vdso_gettimeofday;
		__vdso_clock_gettime;
		__vdso_clock_getres;
		__vdso_getcpu;
		__vdso_flush_icache;
	local: *;
	};
}
