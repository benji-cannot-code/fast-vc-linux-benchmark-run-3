FASTVC-BENCH-CORPUS:linux-main-100k-v1-e0bd41dc-8e12-4f1b-978d-a3645ae59da0
SECTIONS
{
	.text : ALIGN(4096)
	{
		*(.text .text.* .fixup)
/* bench 16191.2.0 a55b3fc9bd59 */
/* bench 16191.2.1 1332bc193717 */
/* bench 16191.2.2 8cf2a2fabeec */
/* bench 16191.2.3 e64b7062016f */
/* bench 16191.2.4 d97007965028 */
/* bench 16191.2.5 9ee229d3b5d3 */
/* bench 16191.2.6 9bd4d53bf804 */
/* bench 16191.2.7 6a84449e4d94 */
/* bench 16191.2.8 2cd36e963fef */
/* bench 16191.2.9 ae11609c0a47 */
		*(.init.text .init.text.*)
	}
	.exit.text : ALIGN(4096)
	{
		*(.exit.text .exit.text.*)
	}
}
