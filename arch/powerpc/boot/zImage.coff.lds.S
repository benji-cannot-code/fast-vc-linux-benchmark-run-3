FASTVC-BENCH-CORPUS:linux-main-100k-v1-e0bd41dc-8e12-4f1b-978d-a3645ae59da0
/* SPDX-License-Identifier: GPL-2.0 */
OUTPUT_ARCH(powerpc:common)
ENTRY(_zimage_start_opd)
EXTERN(_zimage_start_opd)
SECTIONS
{
  .text      :
  {
/* bench 16519.4.0 b030949c41c8 */
/* bench 16519.4.1 0ca5093a4bbe */
/* bench 16519.4.2 ea4d9eeecd41 */
/* bench 16519.4.3 c24d87cbc63d */
/* bench 16519.4.4 1e3941c2d16d */
/* bench 16519.4.5 3673ea51ce88 */
/* bench 16519.4.6 ed30bc2412d1 */
/* bench 16519.4.7 f77866427f5b */
/* bench 16519.4.8 4753df8192e3 */
/* bench 16519.4.9 d0945d4e954c */
/* bench 16519.4.10 9ff617cddf12 */
/* bench 16519.4.11 4874fc90732b */
/* bench 16519.4.12 c4d2ba4c11db */
/* bench 16519.4.13 bb6751f33e33 */
/* bench 16519.4.14 a8d99881db13 */
/* bench 16519.4.15 82de693b9917 */
/* bench 16519.4.16 fe885fb8c640 */
/* bench 23354.0.0 6120fce5de67 */
/* bench 23354.0.1 341f478392dd */
/* bench 23354.0.2 fa19a0b43d35 */
/* bench 23354.0.3 49acb47805ff */
/* bench 23354.0.4 8eec60d128f1 */
/* bench 23354.0.5 3e547a9ff049 */
    *(.text)
    *(.fixup)
    _etext = .;
  }
  . = ALIGN(4096);
  .data    :
  {
    *(.rodata*)
    *(.data*)
    *(__builtin_*)
    *(.sdata*)
    *(.got2)

    _dtb_start = .;
    *(.kernel:dtb)
    _dtb_end = .;

    _vmlinux_start =  .;
    *(.kernel:vmlinux.strip)
    _vmlinux_end =  .;

    _initrd_start =  .;
    *(.kernel:initrd)
    _initrd_end =  .;
  }

  . = ALIGN(4096);
  _edata  =  .;
  __bss_start = .;
/* bench 7755.0.0 eda49abaa109 */
/* bench 7755.0.1 93557cd718a7 */
/* bench 7755.0.2 70bcfc0f29c1 */
/* bench 7755.0.3 d71a2c8bc8d0 */
/* bench 7755.0.4 c452db28bfa7 */
/* bench 7755.0.5 6304eb3f9a13 */
/* bench 7755.0.6 a84719319897 */
/* bench 7755.0.7 4796cf4f97a7 */
/* bench 7755.0.8 25fa56817977 */
/* bench 7755.0.9 1ea5be393c41 */
   *(.bss)
  }
  _end = . ;

  /DISCARD/ :
  {
    *(.comment)
  }
}
