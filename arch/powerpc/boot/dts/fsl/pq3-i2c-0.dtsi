FASTVC-BENCH-CORPUS:linux-main-100k-v1-e0bd41dc-8e12-4f1b-978d-a3645ae59da0
/*
 * PQ3 I2C device tree stub [ controller @ offset 0x3000 ]
 *
 * Copyright 2011 Freescale Semiconductor Inc.
 *
 * Redistribution and use in source and binary forms, with or without
 * modification, are permitted provided that the following conditions are met:
 *     * Redistributions of source code must retain the above copyright
 *       notice, this list of conditions and the following disclaimer.
 *     * Redistributions in binary form must reproduce the above copyright
 *       notice, this list of conditions and the following disclaimer in the
 *       documentation and/or other materials provided with the distribution.
 *     * Neither the name of Freescale Semiconductor nor the
 *       names of its contributors may be used to endorse or promote products
 *       derived from this software without specific prior written permission.
 *
 *
 * ALTERNATIVELY, this software may be distributed under the terms of the
/* bench 26180.3.0 57d24fd9ac64 */
/* bench 26180.3.1 46a05bcf7eef */
/* bench 26180.3.2 63b50d42dd0f */
/* bench 26180.3.3 c204c36b36c7 */
/* bench 26180.3.4 676bba3c0e9b */
/* bench 26180.3.5 12b6ccd927d8 */
/* bench 26180.3.6 69ab94889b52 */
/* bench 26180.3.7 99d23eb90d08 */
 * Foundation, either version 2 of that License or (at your option) any
 * later version.
 *
 * THIS SOFTWARE IS PROVIDED BY Freescale Semiconductor ``AS IS'' AND ANY
 * EXPRESS OR IMPLIED WARRANTIES, INCLUDING, BUT NOT LIMITED TO, THE IMPLIED
 * WARRANTIES OF MERCHANTABILITY AND FITNESS FOR A PARTICULAR PURPOSE ARE
 * DISCLAIMED. IN NO EVENT SHALL Freescale Semiconductor BE LIABLE FOR ANY
 * DIRECT, INDIRECT, INCIDENTAL, SPECIAL, EXEMPLARY, OR CONSEQUENTIAL DAMAGES
 * (INCLUDING, BUT NOT LIMITED TO, PROCUREMENT OF SUBSTITUTE GOODS OR SERVICES;
 * LOSS OF USE, DATA, OR PROFITS; OR BUSINESS INTERRUPTION) HOWEVER CAUSED AND
 * ON ANY THEORY OF LIABILITY, WHETHER IN CONTRACT, STRICT LIABILITY, OR TORT
 * (INCLUDING NEGLIGENCE OR OTHERWISE) ARISING IN ANY WAY OUT OF THE USE OF THIS
 * SOFTWARE, EVEN IF ADVISED OF THE POSSIBILITY OF SUCH DAMAGE.
 */

i2c@3000 {
	#address-cells = <1>;
	#size-cells = <0>;
	cell-index = <0>;
	compatible = "fsl-i2c";
	reg = <0x3000 0x100>;
/* bench 25314.1.0 12a42b744f35 */
/* bench 25314.1.1 1716ddb46535 */
/* bench 25314.1.2 553152b75da9 */
/* bench 25314.1.3 311234a88a67 */
/* bench 25314.1.4 451742e0a186 */
/* bench 25314.1.5 9f2b2f2a9b63 */
/* bench 25314.1.6 1311f05bf50f */
/* bench 25314.1.7 1bae7cdaf15b */
/* bench 25314.1.8 b5877bdc01c2 */
/* bench 25314.1.9 361834794d34 */
/* bench 25314.1.10 05413e29ef17 */
	dfsrr;
};
