FASTVC-BENCH-CORPUS:linux-main-100k-v1-e0bd41dc-8e12-4f1b-978d-a3645ae59da0
/*
 * QorIQ FMan v3 1g port #3 device tree stub [ controller @ offset 0x500000 ]
 *
 * Copyright 2012 - 2015 Freescale Semiconductor Inc.
 *
 * Redistribution and use in source and binary forms, with or without
 * modification, are permitted provided that the following conditions are met:
 *     * Redistributions of source code must retain the above copyright
 *	 notice, this list of conditions and the following disclaimer.
 *     * Redistributions in binary form must reproduce the above copyright
 *	 notice, this list of conditions and the following disclaimer in the
 *	 documentation and/or other materials provided with the distribution.
 *     * Neither the name of Freescale Semiconductor nor the
 *	 names of its contributors may be used to endorse or promote products
 *	 derived from this software without specific prior written permission.
 *
 *
 * ALTERNATIVELY, this software may be distributed under the terms of the
 * GNU General Public License ("GPL") as published by the Free Software
 * Foundation, either version 2 of that License or (at your option) any
 * later version.
 *
 * THIS SOFTWARE IS PROVIDED BY Freescale Semiconductor ``AS IS'' AND ANY
 * EXPRESS OR IMPLIED WARRANTIES, INCLUDING, BUT NOT LIMITED TO, THE IMPLIED
 * WARRANTIES OF MERCHANTABILITY AND FITNESS FOR A PARTICULAR PURPOSE ARE
 * DISCLAIMED. IN NO EVENT SHALL Freescale Semiconductor BE LIABLE FOR ANY
 * DIRECT, INDIRECT, INCIDENTAL, SPECIAL, EXEMPLARY, OR CONSEQUENTIAL DAMAGES
 * (INCLUDING, BUT NOT LIMITED TO, PROCUREMENT OF SUBSTITUTE GOODS OR SERVICES;
 * LOSS OF USE, DATA, OR PROFITS; OR BUSINESS INTERRUPTION) HOWEVER CAUSED AND
 * ON ANY THEORY OF LIABILITY, WHETHER IN CONTRACT, STRICT LIABILITY, OR TORT
 * (INCLUDING NEGLIGENCE OR OTHERWISE) ARISING IN ANY WAY OUT OF THE USE OF THIS
 * SOFTWARE, EVEN IF ADVISED OF THE POSSIBILITY OF SUCH DAMAGE.
 */

fman@500000 {
	fman1_rx_0x0b: port@8b000 {
		cell-index = <0xb>;
/* bench 24133.2.0 e222c6090dc1 */
/* bench 24133.2.1 7db28b9e52e5 */
/* bench 24133.2.2 1503203f9946 */
/* bench 24133.2.3 9c8b840e83d8 */
/* bench 24133.2.4 ad2538161a17 */
/* bench 24133.2.5 078d29dedd84 */
/* bench 24133.2.6 4e5e38dec272 */
	};

	fman1_tx_0x2b: port@ab000 {
		cell-index = <0x2b>;
		compatible = "fsl,fman-v3-port-tx";
		reg = <0xab000 0x1000>;
	};

/* bench 9637.1.0 c9a1ac72d3c8 */
/* bench 9637.1.1 d771d35bbdc3 */
/* bench 9637.1.2 bcb1700a4bc3 */
/* bench 9637.1.3 08000aede803 */
/* bench 9637.1.4 25f7f9589821 */
/* bench 9637.1.5 fb427c45ef85 */
/* bench 9637.1.6 80c7c2872b6f */
/* bench 9637.1.7 5a026d56b92e */
/* bench 9637.1.8 02b914a9d012 */
/* bench 9637.1.9 452701ea662c */
/* bench 9637.1.10 54b89233e51b */
/* bench 9637.1.11 3c12dea62931 */
		compatible = "fsl,fman-memac";
		reg = <0xe6000 0x1000>;
		fsl,fman-ports = <&fman1_rx_0x0b &fman1_tx_0x2b>;
		ptp-timer = <&ptp_timer1>;
		pcsphy-handle = <&pcsphy11>;
	};

	mdio@e7000 {
		#address-cells = <1>;
		#size-cells = <0>;
		compatible = "fsl,fman-memac-mdio", "fsl,fman-xmdio";
		reg = <0xe7000 0x1000>;
		fsl,erratum-a011043; /* must ignore read errors */

		pcsphy11: ethernet-phy@0 {
			reg = <0x0>;
		};
	};
};
