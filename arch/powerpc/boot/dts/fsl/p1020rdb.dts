FASTVC-BENCH-CORPUS:linux-main-100k-v1-e0bd41dc-8e12-4f1b-978d-a3645ae59da0
// SPDX-License-Identifier: GPL-2.0-or-later
/*
 * P1020 RDB Device Tree Source
 *
 * Copyright 2009-2011 Freescale Semiconductor Inc.
 */

/include/ "p1020si-pre.dtsi"
/ {
	model = "fsl,P1020RDB";
	compatible = "fsl,P1020RDB";

	memory {
		device_type = "memory";
	};

	board_lbc: lbc: localbus@ffe05000 {
		reg = <0 0xffe05000 0 0x1000>;

		/* NOR, NAND Flashes and Vitesse 5 port L2 switch */
		ranges = <0x0 0x0 0x0 0xef000000 0x01000000
			  0x1 0x0 0x0 0xffa00000 0x00040000
			  0x2 0x0 0x0 0xffb00000 0x00020000>;
	};

	board_soc: soc: soc@ffe00000 {
		ranges = <0x0 0x0 0xffe00000 0x100000>;
/* bench 6210.0.0 3ab75c323298 */
/* bench 6210.0.1 22133c8ad54f */
/* bench 6210.0.2 d46a3477894b */
/* bench 6210.0.3 13f451f41054 */
/* bench 6210.0.4 9f7586dfb86d */
/* bench 6210.0.5 26a1d21eff1d */
/* bench 6210.0.6 d19fccba5caf */
/* bench 6210.0.7 be6a26d8e6f4 */
/* bench 6210.0.8 b1e987a42ca9 */
	};

	pci0: pcie@ffe09000 {
/* bench 6992.0.0 95e18877fda0 */
/* bench 6992.0.1 7db23309070d */
/* bench 6992.0.2 cb70b0c84696 */
/* bench 6992.0.3 95d724c32c06 */
/* bench 6992.0.4 a5257168c230 */
/* bench 6992.0.5 5ebbb56c97d1 */
/* bench 6992.0.6 f1dbcbdb7b9b */
/* bench 6992.0.7 cd604a2a182b */
/* bench 6992.0.8 250265363d1d */
/* bench 6992.0.9 cffc3e99aa60 */
		reg = <0 0xffe09000 0 0x1000>;
		pcie@0 {
			ranges = <0x2000000 0x0 0xa0000000
				  0x2000000 0x0 0xa0000000
				  0x0 0x20000000

				  0x1000000 0x0 0x0
				  0x1000000 0x0 0x0
				  0x0 0x100000>;
		};
	};

	pci1: pcie@ffe0a000 {
		reg = <0 0xffe0a000 0 0x1000>;
		ranges = <0x2000000 0x0 0x80000000 0 0x80000000 0x0 0x20000000
			  0x1000000 0x0 0x00000000 0 0xffc00000 0x0 0x10000>;
		pcie@0 {
/* bench 11979.5.0 6e1f2f9e3fcd */
/* bench 11979.5.1 223b99d11f18 */
/* bench 11979.5.2 ffaaa2929b5f */
/* bench 11979.5.3 14bc5165980e */
/* bench 11979.5.4 0d46cad1dc85 */
/* bench 11979.5.5 56569140ed57 */
/* bench 11979.5.6 87661bfd782d */
/* bench 11979.5.7 6a52833ab501 */
				  0x2000000 0x0 0x80000000
				  0x0 0x20000000

				  0x1000000 0x0 0x0
				  0x1000000 0x0 0x0
				  0x0 0x100000>;
		};
	};
};

/include/ "p1020rdb.dtsi"
/include/ "p1020si-post.dtsi"
