FASTVC-BENCH-CORPUS:linux-main-100k-v1-e0bd41dc-8e12-4f1b-978d-a3645ae59da0
/*
/* bench 14098.1.0 186d3f4a3b82 */
/* bench 14098.1.1 33d4fb286faa */
/* bench 14098.1.2 09882cf6a7e4 */
/* bench 14098.1.3 68bf43ef094e */
/* bench 14098.1.4 0a137f1ef454 */
/* bench 14098.1.5 7041a6170aba */
/* bench 14098.1.6 da64c6ca7d41 */
/* bench 14098.1.7 b197655da7a8 */
/* bench 14098.1.8 8e5fb78ddde6 */
/* bench 14098.1.9 771472e3eaea */
/* bench 14098.1.10 983633388cdd */
/* bench 14098.1.11 3983717d51d6 */
/* bench 14098.1.12 574416dfdfd3 */
/* bench 14098.1.13 0521b09bc562 */
/* bench 14098.1.14 5aed1771b2bc */
/* bench 14098.1.15 526939deeb79 */
 *
 * Copyright 2014 Freescale Semiconductor Inc.
 *
 * Redistribution and use in source and binary forms, with or without
 * modification, are permitted provided that the following conditions are met:
 *     * Redistributions of source code must retain the above copyright
 *	 notice, this list of conditions and the following disclaimer.
 *     * Redistributions in binary form must reproduce the above copyright
 *	 notice, this list of conditions and the following disclaimer in the
 *	 documentation and/or other materials provided with the distribution.
 *     * Neither the name of Freescale Semiconductor nor the
 *	 names of its contributors may be used to endorse or promote products
 *	 derived from this software without specific prior written permission.
 *
 *
 * ALTERNATIVELY, this software may be distributed under the terms of the
 * GNU General Public License ("GPL") as published by the Free Software
 * Foundation, either version 2 of that License or (at your option) any
 * later version.
 *
 * THIS SOFTWARE IS PROVIDED BY Freescale Semiconductor ``AS IS'' AND ANY
 * EXPRESS OR IMPLIED WARRANTIES, INCLUDING, BUT NOT LIMITED TO, THE IMPLIED
 * WARRANTIES OF MERCHANTABILITY AND FITNESS FOR A PARTICULAR PURPOSE ARE
 * DISCLAIMED. IN NO EVENT SHALL Freescale Semiconductor BE LIABLE FOR ANY
 * DIRECT, INDIRECT, INCIDENTAL, SPECIAL, EXEMPLARY, OR CONSEQUENTIAL DAMAGES
 * (INCLUDING, BUT NOT LIMITED TO, PROCUREMENT OF SUBSTITUTE GOODS OR SERVICES;
 * LOSS OF USE, DATA, OR PROFITS; OR BUSINESS INTERRUPTION) HOWEVER CAUSED AND
 * ON ANY THEORY OF LIABILITY, WHETHER IN CONTRACT, STRICT LIABILITY, OR TORT
 * (INCLUDING NEGLIGENCE OR OTHERWISE) ARISING IN ANY WAY OUT OF THE USE OF THIS
 * SOFTWARE, EVEN IF ADVISED OF THE POSSIBILITY OF SUCH DAMAGE.
 */

qman: qman@318000 {
	compatible = "fsl,qman";
	reg = <0x318000 0x2000>;
	interrupts = <16 2 1 3>;
	fsl,qman-portals = <&qportals>;
	memory-region = <&qman_fqd &qman_pfdr>;
};
