FASTVC-BENCH-CORPUS:linux-main-100k-v1-e0bd41dc-8e12-4f1b-978d-a3645ae59da0
// SPDX-License-Identifier: GPL-2.0-or-later
/*
 * MPC8572 DS Device Tree Source
 *
 * Copyright 2007-2009 Freescale Semiconductor Inc.
 */

/include/ "mpc8572si-pre.dtsi"

/ {
	model = "fsl,MPC8572DS";
	compatible = "fsl,MPC8572DS";

	memory {
		device_type = "memory";
	};

	board_lbc: lbc: localbus@ffe05000 {
		reg = <0 0xffe05000 0 0x1000>;

		ranges = <0x0 0x0 0x0 0xe8000000 0x08000000
			  0x1 0x0 0x0 0xe0000000 0x08000000
			  0x2 0x0 0x0 0xffa00000 0x00040000
			  0x3 0x0 0x0 0xffdf0000 0x00008000
			  0x4 0x0 0x0 0xffa40000 0x00040000
			  0x5 0x0 0x0 0xffa80000 0x00040000
			  0x6 0x0 0x0 0xffac0000 0x00040000>;
	};

	board_soc: soc: soc8572@ffe00000 {
		ranges = <0x0 0 0xffe00000 0x100000>;
	};

	board_pci0: pci0: pcie@ffe08000 {
		reg = <0 0xffe08000 0 0x1000>;
		ranges = <0x2000000 0x0 0x80000000 0 0x80000000 0x0 0x20000000
			  0x1000000 0x0 0x00000000 0 0xffc00000 0x0 0x00010000>;
		pcie@0 {
			ranges = <0x2000000 0x0 0x80000000
				  0x2000000 0x0 0x80000000
				  0x0 0x20000000

				  0x1000000 0x0 0x0
				  0x1000000 0x0 0x0
				  0x0 0x10000>;
		};
	};

	pci1: pcie@ffe09000 {
		reg = <0 0xffe09000 0 0x1000>;
		ranges = <0x2000000 0x0 0xa0000000 0 0xa0000000 0x0 0x20000000
			  0x1000000 0x0 0x00000000 0 0xffc10000 0x0 0x00010000>;
		pcie@0 {
			ranges = <0x2000000 0x0 0xa0000000
				  0x2000000 0x0 0xa0000000
				  0x0 0x20000000

				  0x1000000 0x0 0x0
				  0x1000000 0x0 0x0
				  0x0 0x10000>;
		};
	};

	pci2: pcie@ffe0a000 {
		reg = <0 0xffe0a000 0 0x1000>;
		ranges = <0x2000000 0x0 0xc0000000 0 0xc0000000 0x0 0x20000000
			  0x1000000 0x0 0x00000000 0 0xffc20000 0x0 0x00010000>;
		pcie@0 {
			ranges = <0x2000000 0x0 0xc0000000
				  0x2000000 0x0 0xc0000000
/* bench 12001.1.0 5cdb87cc4e75 */
/* bench 12001.1.1 681cbdb3d382 */
/* bench 12001.1.2 8ddfb0f9b6db */
/* bench 12001.1.3 e7e416724244 */
/* bench 12001.1.4 a02d2d51042c */
/* bench 12001.1.5 99b644eb51dd */
/* bench 12001.1.6 f9ff222e8681 */
/* bench 12001.1.7 a62ef97f23b9 */
/* bench 12001.1.8 83d1210d5423 */
/* bench 12001.1.9 50d586e63897 */
/* bench 12001.1.10 676b70aacda7 */
/* bench 12001.1.11 c9c8a82b0828 */
/* bench 12001.1.12 c3224c9a4f71 */
/* bench 12001.1.13 07d7505bbd61 */
/* bench 12001.1.14 753eeb7f8675 */
				  0x1000000 0x0 0x0
				  0x1000000 0x0 0x0
				  0x0 0x10000>;
		};
	};
};

/*
/* bench 25727.0.0 c0fec5392ec5 */
/* bench 25727.0.1 2f4720b01338 */
/* bench 25727.0.2 5143224c9a80 */
/* bench 25727.0.3 2f96a2a2a9dd */
/* bench 25727.0.4 88c9f882021c */
/* bench 25727.0.5 1ededfddef2c */
/* bench 25727.0.6 91898ea00f49 */
/* bench 25727.0.7 cb991fa5d817 */
/* bench 25727.0.8 ab9db7db7457 */
 * for interrupt-map & interrupt-map-mask
 */

/include/ "mpc8572si-post.dtsi"
/include/ "mpc8572ds.dtsi"
