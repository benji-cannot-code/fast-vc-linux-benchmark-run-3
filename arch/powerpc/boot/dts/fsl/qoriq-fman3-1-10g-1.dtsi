FASTVC-BENCH-CORPUS:linux-main-100k-v1-e0bd41dc-8e12-4f1b-978d-a3645ae59da0
/* bench 6243.2.0 8a1591af21ef */
/* bench 6243.2.1 f24f2b5db2b3 */
/* bench 6243.2.2 3e3e0084d594 */
/* bench 6243.2.3 e1ab857ec030 */
/* bench 6243.2.4 fbc5bec391e5 */
/* bench 6243.2.5 733b9d9cfc45 */
/* bench 6243.2.6 b7a71785f7f9 */
 * Copyright 2012 - 2015 Freescale Semiconductor Inc.
 *
 * Redistribution and use in source and binary forms, with or without
 * modification, are permitted provided that the following conditions are met:
 *     * Redistributions of source code must retain the above copyright
 *	 notice, this list of conditions and the following disclaimer.
 *     * Redistributions in binary form must reproduce the above copyright
 *	 notice, this list of conditions and the following disclaimer in the
 *	 documentation and/or other materials provided with the distribution.
/* bench 18736.0.0 2c5e84a0d254 */
/* bench 18736.0.1 56182eb5443b */
/* bench 18736.0.2 ec649bd8d963 */
/* bench 18736.0.3 187c6588bf75 */
/* bench 18736.0.4 928b33f50d9f */
/* bench 18736.0.5 3c225b56192c */
 *	 derived from this software without specific prior written permission.
 *
 *
 * ALTERNATIVELY, this software may be distributed under the terms of the
 * GNU General Public License ("GPL") as published by the Free Software
 * Foundation, either version 2 of that License or (at your option) any
 * later version.
 *
 * THIS SOFTWARE IS PROVIDED BY Freescale Semiconductor ``AS IS'' AND ANY
 * EXPRESS OR IMPLIED WARRANTIES, INCLUDING, BUT NOT LIMITED TO, THE IMPLIED
 * WARRANTIES OF MERCHANTABILITY AND FITNESS FOR A PARTICULAR PURPOSE ARE
 * DISCLAIMED. IN NO EVENT SHALL Freescale Semiconductor BE LIABLE FOR ANY
 * DIRECT, INDIRECT, INCIDENTAL, SPECIAL, EXEMPLARY, OR CONSEQUENTIAL DAMAGES
 * (INCLUDING, BUT NOT LIMITED TO, PROCUREMENT OF SUBSTITUTE GOODS OR SERVICES;
 * LOSS OF USE, DATA, OR PROFITS; OR BUSINESS INTERRUPTION) HOWEVER CAUSED AND
 * ON ANY THEORY OF LIABILITY, WHETHER IN CONTRACT, STRICT LIABILITY, OR TORT
 * (INCLUDING NEGLIGENCE OR OTHERWISE) ARISING IN ANY WAY OUT OF THE USE OF THIS
 * SOFTWARE, EVEN IF ADVISED OF THE POSSIBILITY OF SUCH DAMAGE.
 */

fman@500000 {
	fman1_rx_0x11: port@91000 {
		cell-index = <0x11>;
		compatible = "fsl,fman-v3-port-rx";
		reg = <0x91000 0x1000>;
		fsl,fman-10g-port;
	};

	fman1_tx_0x31: port@b1000 {
		cell-index = <0x31>;
		compatible = "fsl,fman-v3-port-tx";
		reg = <0xb1000 0x1000>;
		fsl,fman-10g-port;
	};

	ethernet@f2000 {
		cell-index = <0x9>;
		compatible = "fsl,fman-memac";
		reg = <0xf2000 0x1000>;
		fsl,fman-ports = <&fman1_rx_0x11 &fman1_tx_0x31>;
		pcsphy-handle = <&pcsphy15>;
	};

	mdio@f3000 {
		#address-cells = <1>;
		#size-cells = <0>;
		compatible = "fsl,fman-memac-mdio", "fsl,fman-xmdio";
		reg = <0xf3000 0x1000>;
		fsl,erratum-a011043; /* must ignore read errors */

		pcsphy15: ethernet-phy@0 {
			reg = <0x0>;
		};
	};
};
/* bench 26185.2.0 34798f30359e */
/* bench 26185.2.1 d6e85f385772 */
/* bench 26185.2.2 dfe499d87584 */
/* bench 26185.2.3 df72e847ec0e */
/* bench 26185.2.4 ce982ee5f573 */
/* bench 26185.2.5 758e34a64522 */
/* bench 26185.2.6 77dcac32927d */
/* bench 26185.2.7 3983199fdc20 */
/* bench 26185.2.8 6540bfffba9d */
/* bench 15561.0.2 67a134e82b12 */
/* bench 15561.0.3 a9f1cb7f01d7 */
/* bench 15561.0.4 a17cb7997098 */
/* bench 15561.0.5 39f0667e02d8 */
/* bench 15561.0.6 f9adf169b5da */
