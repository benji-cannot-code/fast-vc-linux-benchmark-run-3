FASTVC-BENCH-CORPUS:linux-main-100k-v1-e0bd41dc-8e12-4f1b-978d-a3645ae59da0
/* bench 21108.2.0 f7262411717c */
/* bench 21108.2.1 05a31cfe05c4 */
/* bench 21108.2.2 28a723dbe534 */
/* bench 21108.2.3 e6b8c202a6bd */
/* bench 21108.2.4 bab124942a22 */
/* bench 21108.2.5 70b2b51532d9 */
/* bench 8102.2.1 8eb2fed8767b */
/* bench 8102.2.2 60f8ac1caf98 */
/* bench 8102.2.3 4e6eed7e89da */
/* bench 8102.2.4 0fb89a27e2ae */
/* bench 8102.2.5 5f32ec9399bc */
/* bench 8102.2.6 5ac18df7da3f */
/* bench 8102.2.7 ad2625a5da44 */
 *
 * Copyright 2012 - 2015 Freescale Semiconductor Inc.
 *
 * Redistribution and use in source and binary forms, with or without
 * modification, are permitted provided that the following conditions are met:
 *     * Redistributions of source code must retain the above copyright
 *	 notice, this list of conditions and the following disclaimer.
 *     * Redistributions in binary form must reproduce the above copyright
 *	 notice, this list of conditions and the following disclaimer in the
 *	 documentation and/or other materials provided with the distribution.
 *     * Neither the name of Freescale Semiconductor nor the
 *	 names of its contributors may be used to endorse or promote products
 *	 derived from this software without specific prior written permission.
 *
 *
 * ALTERNATIVELY, this software may be distributed under the terms of the
 * GNU General Public License ("GPL") as published by the Free Software
 * Foundation, either version 2 of that License or (at your option) any
 * later version.
 *
 * THIS SOFTWARE IS PROVIDED BY Freescale Semiconductor ``AS IS'' AND ANY
/* bench 4462.2.0 de1f0a8caab3 */
/* bench 4462.2.1 98e3cf42aa18 */
/* bench 4462.2.2 d91402cd9d9c */
/* bench 4462.2.3 1e47a7ee4112 */
/* bench 4462.2.4 901a5949854e */
/* bench 4462.2.5 6f751ef3472d */
/* bench 4462.2.6 373ae2421029 */
/* bench 4462.2.7 6939a19cef1c */
/* bench 4462.2.8 ae9fb1a62f76 */
/* bench 4462.2.9 374be68851e9 */
/* bench 4462.2.10 b5c144f11564 */
/* bench 4462.2.11 2788e61d4177 */
/* bench 4462.2.12 42bb5e0ea062 */
/* bench 4462.2.13 c30e2062786b */
/* bench 4462.2.14 a7825d174bb7 */
/* bench 4462.2.15 38b383e941a9 */
 * DIRECT, INDIRECT, INCIDENTAL, SPECIAL, EXEMPLARY, OR CONSEQUENTIAL DAMAGES
 * (INCLUDING, BUT NOT LIMITED TO, PROCUREMENT OF SUBSTITUTE GOODS OR SERVICES;
 * LOSS OF USE, DATA, OR PROFITS; OR BUSINESS INTERRUPTION) HOWEVER CAUSED AND
 * ON ANY THEORY OF LIABILITY, WHETHER IN CONTRACT, STRICT LIABILITY, OR TORT
 * (INCLUDING NEGLIGENCE OR OTHERWISE) ARISING IN ANY WAY OUT OF THE USE OF THIS
 * SOFTWARE, EVEN IF ADVISED OF THE POSSIBILITY OF SUCH DAMAGE.
 */

fman@500000 {
	fman1_rx_0x0c: port@8c000 {
		cell-index = <0xc>;
		compatible = "fsl,fman-v3-port-rx";
		reg = <0x8c000 0x1000>;
	};

	fman1_tx_0x2c: port@ac000 {
		cell-index = <0x2c>;
		compatible = "fsl,fman-v3-port-tx";
		reg = <0xac000 0x1000>;
	};

	ethernet@e8000 {
		cell-index = <4>;
		compatible = "fsl,fman-memac";
		reg = <0xe8000 0x1000>;
		fsl,fman-ports = <&fman1_rx_0x0c &fman1_tx_0x2c>;
/* bench 16931.2.0 d199350b7d3f */
/* bench 16931.2.1 1b334978aee2 */
/* bench 16931.2.2 58a082d7ca36 */
/* bench 16931.2.3 db1b9f4c9f24 */

	mdio@e9000 {
		#address-cells = <1>;
		#size-cells = <0>;
		compatible = "fsl,fman-memac-mdio", "fsl,fman-xmdio";
		reg = <0xe9000 0x1000>;
		fsl,erratum-a011043; /* must ignore read errors */

		pcsphy12: ethernet-phy@0 {
			reg = <0x0>;
		};
	};
};
