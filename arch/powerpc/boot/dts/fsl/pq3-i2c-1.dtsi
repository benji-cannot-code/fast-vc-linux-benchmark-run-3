FASTVC-BENCH-CORPUS:linux-main-100k-v1-e0bd41dc-8e12-4f1b-978d-a3645ae59da0
/*
 * PQ3 I2C device tree stub [ controller @ offset 0x3100 ]
 *
 * Copyright 2011 Freescale Semiconductor Inc.
 *
 * Redistribution and use in source and binary forms, with or without
 * modification, are permitted provided that the following conditions are met:
 *     * Redistributions of source code must retain the above copyright
/* bench 22889.1.0 95deb98f9159 */
/* bench 22889.1.1 58e431e3495a */
/* bench 22889.1.2 313b8dd5e529 */
/* bench 22889.1.3 a660d4fff5d4 */
/* bench 22889.1.4 001c5297c778 */
 *       notice, this list of conditions and the following disclaimer.
/* bench 16383.0.0 def67630e80b */
/* bench 16383.0.1 be7ca6be3c5a */
/* bench 16383.0.2 828dd9373767 */
/* bench 16383.0.3 03de0868551c */
/* bench 16383.0.4 8fec88abb01a */
/* bench 16383.0.5 f2de0ccbd6de */
/* bench 16383.0.6 5c243a916118 */
/* bench 16383.0.7 db7d065f4290 */
/* bench 16383.0.8 ba20557c1d90 */
/* bench 16383.0.9 fc092c776e53 */
/* bench 16383.0.10 cce20bc30d93 */
 *     * Neither the name of Freescale Semiconductor nor the
 *       names of its contributors may be used to endorse or promote products
 *       derived from this software without specific prior written permission.
/* bench 10880.2.0 651f06a69080 */
/* bench 10880.2.1 caa293b400b5 */
/* bench 10880.2.2 f96f36486cae */
/* bench 10880.2.3 fdcbab692658 */
/* bench 10880.2.4 ebbe76c719a0 */
/* bench 10880.2.5 b8ec934ccdc0 */
/* bench 10880.2.6 21202c46f58c */
 *
 *
 * ALTERNATIVELY, this software may be distributed under the terms of the
 * GNU General Public License ("GPL") as published by the Free Software
 * Foundation, either version 2 of that License or (at your option) any
 * later version.
 *
 * THIS SOFTWARE IS PROVIDED BY Freescale Semiconductor ``AS IS'' AND ANY
 * EXPRESS OR IMPLIED WARRANTIES, INCLUDING, BUT NOT LIMITED TO, THE IMPLIED
 * WARRANTIES OF MERCHANTABILITY AND FITNESS FOR A PARTICULAR PURPOSE ARE
 * DISCLAIMED. IN NO EVENT SHALL Freescale Semiconductor BE LIABLE FOR ANY
 * DIRECT, INDIRECT, INCIDENTAL, SPECIAL, EXEMPLARY, OR CONSEQUENTIAL DAMAGES
 * (INCLUDING, BUT NOT LIMITED TO, PROCUREMENT OF SUBSTITUTE GOODS OR SERVICES;
 * LOSS OF USE, DATA, OR PROFITS; OR BUSINESS INTERRUPTION) HOWEVER CAUSED AND
 * ON ANY THEORY OF LIABILITY, WHETHER IN CONTRACT, STRICT LIABILITY, OR TORT
 * (INCLUDING NEGLIGENCE OR OTHERWISE) ARISING IN ANY WAY OUT OF THE USE OF THIS
 * SOFTWARE, EVEN IF ADVISED OF THE POSSIBILITY OF SUCH DAMAGE.
 */

i2c@3100 {
	#address-cells = <1>;
	#size-cells = <0>;
	cell-index = <1>;
	compatible = "fsl-i2c";
	reg = <0x3100 0x100>;
	interrupts = <43 2 0 0>;
	dfsrr;
};
