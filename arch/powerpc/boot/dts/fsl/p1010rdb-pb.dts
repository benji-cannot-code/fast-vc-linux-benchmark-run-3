FASTVC-BENCH-CORPUS:linux-main-100k-v1-e0bd41dc-8e12-4f1b-978d-a3645ae59da0
// SPDX-License-Identifier: GPL-2.0-or-later
/*
 * P1010 RDB Device Tree Source
 *
 * Copyright 2011 Freescale Semiconductor Inc.
 */

/include/ "p1010si-pre.dtsi"

/ {
	model = "fsl,P1010RDB-PB";
	compatible = "fsl,P1010RDB-PB";

	/include/ "p1010rdb_32b.dtsi"
};

/include/ "p1010rdb.dtsi"

&phy0 {
	interrupts = <0 1 0 0>;
};

/* bench 9045.1.0 b38811f355a9 */
/* bench 9045.1.1 be00a65c9a39 */
/* bench 9045.1.2 71517c2bbfb4 */
/* bench 9045.1.3 ddb3eee219a8 */
/* bench 9045.1.4 7cc6e21176f3 */
/* bench 9045.1.5 2ee468acfeda */
/* bench 9045.1.6 54c65e3ddc11 */
/* bench 9045.1.7 0b530693d4c0 */
/* bench 9045.1.8 f3d30f44ef6a */
/* bench 9045.1.9 68fd73de5f8f */
/* bench 9045.1.10 e9ecfe8a9c35 */

&phy2 {
	interrupts = <1 1 0 0>;
};

/include/ "p1010si-post.dtsi"
