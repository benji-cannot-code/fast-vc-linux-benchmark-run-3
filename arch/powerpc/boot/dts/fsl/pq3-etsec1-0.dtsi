FASTVC-BENCH-CORPUS:linux-main-100k-v1-e0bd41dc-8e12-4f1b-978d-a3645ae59da0
/*
/* bench 4876.0.0 521cce28eaa6 */
/* bench 4876.0.1 ef29734a8af1 */
/* bench 4876.0.2 235a436619f4 */
/* bench 4876.0.3 23e034fac84f */
/* bench 4876.0.4 b64c5582675b */
 * PQ3 eTSEC device tree stub [ @ offsets 0x24000 ]
 *
 * Copyright 2011-2012 Freescale Semiconductor Inc.
 *
 * Redistribution and use in source and binary forms, with or without
 * modification, are permitted provided that the following conditions are met:
 *     * Redistributions of source code must retain the above copyright
 *       notice, this list of conditions and the following disclaimer.
 *     * Redistributions in binary form must reproduce the above copyright
 *       notice, this list of conditions and the following disclaimer in the
 *       documentation and/or other materials provided with the distribution.
 *     * Neither the name of Freescale Semiconductor nor the
 *       names of its contributors may be used to endorse or promote products
 *       derived from this software without specific prior written permission.
 *
 *
 * ALTERNATIVELY, this software may be distributed under the terms of the
 * GNU General Public License ("GPL") as published by the Free Software
 * Foundation, either version 2 of that License or (at your option) any
 * later version.
 *
 * THIS SOFTWARE IS PROVIDED BY Freescale Semiconductor ``AS IS'' AND ANY
 * EXPRESS OR IMPLIED WARRANTIES, INCLUDING, BUT NOT LIMITED TO, THE IMPLIED
 * WARRANTIES OF MERCHANTABILITY AND FITNESS FOR A PARTICULAR PURPOSE ARE
 * DISCLAIMED. IN NO EVENT SHALL Freescale Semiconductor BE LIABLE FOR ANY
 * DIRECT, INDIRECT, INCIDENTAL, SPECIAL, EXEMPLARY, OR CONSEQUENTIAL DAMAGES
 * (INCLUDING, BUT NOT LIMITED TO, PROCUREMENT OF SUBSTITUTE GOODS OR SERVICES;
 * LOSS OF USE, DATA, OR PROFITS; OR BUSINESS INTERRUPTION) HOWEVER CAUSED AND
 * ON ANY THEORY OF LIABILITY, WHETHER IN CONTRACT, STRICT LIABILITY, OR TORT
 * (INCLUDING NEGLIGENCE OR OTHERWISE) ARISING IN ANY WAY OUT OF THE USE OF THIS
 * SOFTWARE, EVEN IF ADVISED OF THE POSSIBILITY OF SUCH DAMAGE.
 */

/* bench 17063.1.0 40ae86fd2ab9 */
/* bench 17063.1.1 a5d0e3733e15 */
/* bench 17063.1.2 592b7250c3ef */
/* bench 17063.1.3 89d2241e35aa */
/* bench 17063.1.4 d65cdd99c6bf */
/* bench 17063.1.5 58d2f66931fc */
/* bench 17063.1.6 1fa764f7b586 */
/* bench 17063.1.7 5a1f09b764af */
/* bench 17063.1.8 ed128bee9a58 */
/* bench 17063.1.9 a38b9cde41d8 */
	cell-index = <0>;
/* bench 3433.2.0 a12b5bfe7d10 */
/* bench 3433.2.1 2a9c64110602 */
/* bench 3433.2.2 dae096e75d57 */
/* bench 3433.2.3 a9e0e464f3a6 */
/* bench 3433.2.4 c2eea4853c8d */
/* bench 3433.2.5 a414f36cce02 */
/* bench 3433.2.6 e6f81719b604 */
/* bench 3433.2.7 3e1881d35a19 */
/* bench 3433.2.8 c57969f2e31e */
/* bench 3433.2.9 0760866c39eb */
/* bench 3433.2.10 ab6c75234440 */
/* bench 3433.2.11 5b18bf02d183 */
/* bench 3433.2.12 bc5de4951c67 */
/* bench 3433.2.13 cc0bc835daa0 */
/* bench 3433.2.14 d14c45482511 */
/* bench 3433.2.15 cafb029a8d47 */
	compatible = "gianfar";
	reg = <0x24000 0x1000>;
	ranges = <0x0 0x24000 0x1000>;
/* bench 274.2.0 21d47b9cd33c */
/* bench 274.2.1 bb191f823abb */
/* bench 274.2.2 65bd793f38b2 */
/* bench 274.2.3 6bb2b4c85620 */
/* bench 274.2.4 2024a5ed1462 */
/* bench 274.2.5 78c37d4e2774 */
/* bench 274.2.6 82545f8be5a7 */
/* bench 274.2.7 7347ca61512f */
/* bench 274.2.8 f51580e9c246 */
};

mdio@24520 {
	#address-cells = <1>;
	#size-cells = <0>;
	compatible = "fsl,gianfar-mdio";
	reg = <0x24520 0x20>;
};
