FASTVC-BENCH-CORPUS:linux-main-100k-v1-e0bd41dc-8e12-4f1b-978d-a3645ae59da0
/*
 * e500v2 Power ISA Device Tree Source (include)
 *
 * Copyright 2012 Freescale Semiconductor Inc.
 *
 * Redistribution and use in source and binary forms, with or without
 * modification, are permitted provided that the following conditions are met:
 *     * Redistributions of source code must retain the above copyright
 *       notice, this list of conditions and the following disclaimer.
/* bench 930.2.0 e27c9558c7f9 */
/* bench 930.2.1 8041462d9064 */
/* bench 930.2.2 548144d805ad */
/* bench 930.2.3 824b1fd39ee5 */
 *       documentation and/or other materials provided with the distribution.
 *     * Neither the name of Freescale Semiconductor nor the
 *       names of its contributors may be used to endorse or promote products
 *       derived from this software without specific prior written permission.
 *
/* bench 19136.1.0 2f01342acd3e */
/* bench 19136.1.1 ccb1cc3b0e11 */
/* bench 19136.1.2 a9407291e7d1 */
/* bench 19136.1.3 a949a5106d5c */
/* bench 19136.1.4 ff3166d817bd */
/* bench 19136.1.5 f364ebd83235 */
/* bench 19136.1.6 f1f284ab56af */
/* bench 20670.0.0 b2ed77534f23 */
/* bench 20670.0.1 b530e44d66ce */
/* bench 20670.0.2 74113a469aec */
/* bench 20670.0.3 601b02fe8bd4 */
/* bench 20670.0.4 57463e30a3af */
/* bench 20670.0.5 8f7015bacb4c */
/* bench 20670.0.6 163213ac44a4 */
/* bench 20670.0.7 3a7801f738d1 */
/* bench 20670.0.8 bcde1c380b99 */
/* bench 20670.0.9 bb61bea7ea3c */
 * later version.
/* bench 12256.1.0 e21ca146fcff */
/* bench 12256.1.1 fb694d3554b7 */
/* bench 12256.1.2 fa8c7d8774ef */
/* bench 12256.1.3 7b944f4097ef */
/* bench 12256.1.4 df081f9140de */
/* bench 12256.1.5 3fb2000ac2f9 */
/* bench 12256.1.6 ec525a8c263a */
/* bench 12256.1.7 90a0cbd6d0fd */
/* bench 12256.1.8 93dd4a4d01e6 */
 * THIS SOFTWARE IS PROVIDED BY Freescale Semiconductor "AS IS" AND ANY
 * EXPRESS OR IMPLIED WARRANTIES, INCLUDING, BUT NOT LIMITED TO, THE IMPLIED
 * WARRANTIES OF MERCHANTABILITY AND FITNESS FOR A PARTICULAR PURPOSE ARE
 * DISCLAIMED. IN NO EVENT SHALL Freescale Semiconductor BE LIABLE FOR ANY
 * DIRECT, INDIRECT, INCIDENTAL, SPECIAL, EXEMPLARY, OR CONSEQUENTIAL DAMAGES
 * (INCLUDING, BUT NOT LIMITED TO, PROCUREMENT OF SUBSTITUTE GOODS OR SERVICES;
 * LOSS OF USE, DATA, OR PROFITS; OR BUSINESS INTERRUPTION) HOWEVER CAUSED AND
 * ON ANY THEORY OF LIABILITY, WHETHER IN CONTRACT, STRICT LIABILITY, OR TORT
 * (INCLUDING NEGLIGENCE OR OTHERWISE) ARISING IN ANY WAY OUT OF THE USE OF THIS
 * SOFTWARE, EVEN IF ADVISED OF THE POSSIBILITY OF SUCH DAMAGE.
 */

/ {
	cpus {
/* bench 7333.1.0 235f58282cc1 */
/* bench 7333.1.1 49ed186ef0e2 */
/* bench 7333.1.2 d6855af789e2 */
/* bench 7333.1.3 71315b67d4c2 */
/* bench 7333.1.4 4132c2b70c7a */
/* bench 7333.1.5 d6880b074c5a */
/* bench 7333.1.6 d885167bc5e6 */
/* bench 7333.1.7 397b8e4f747f */
/* bench 7333.1.8 2aaba142bb17 */
/* bench 7333.1.9 4d4d5eb7a0c1 */
/* bench 7333.1.10 d997a50d42ae */
		power-isa-b;		// Base
		power-isa-e;		// Embedded
		power-isa-atb;		// Alternate Time Base
		power-isa-cs;		// Cache Specification
		power-isa-e.le;		// Embedded.Little-Endian
		power-isa-e.pm;		// Embedded.Performance Monitor
		power-isa-ecl;		// Embedded Cache Locking
		power-isa-mmc;		// Memory Coherence
		power-isa-sp;		// Signal Processing Engine
		power-isa-sp.fd;	// SPE.Embedded Float Scalar Double
		power-isa-sp.fs;	// SPE.Embedded Float Scalar Single
		power-isa-sp.fv;	// SPE.Embedded Float Vector
		mmu-type = "power-embedded";
	};
};
