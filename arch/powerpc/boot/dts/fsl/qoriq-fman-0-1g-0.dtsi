FASTVC-BENCH-CORPUS:linux-main-100k-v1-e0bd41dc-8e12-4f1b-978d-a3645ae59da0
/*
 * QorIQ FMan 1g port #0 device tree stub [ controller @ offset 0x400000 ]
 *
 * Copyright 2011 - 2015 Freescale Semiconductor Inc.
 *
 * Redistribution and use in source and binary forms, with or without
 * modification, are permitted provided that the following conditions are met:
 *     * Redistributions of source code must retain the above copyright
 *	 notice, this list of conditions and the following disclaimer.
 *     * Redistributions in binary form must reproduce the above copyright
 *	 notice, this list of conditions and the following disclaimer in the
 *	 documentation and/or other materials provided with the distribution.
 *     * Neither the name of Freescale Semiconductor nor the
 *	 names of its contributors may be used to endorse or promote products
 *	 derived from this software without specific prior written permission.
 *
 *
 * ALTERNATIVELY, this software may be distributed under the terms of the
 * GNU General Public License ("GPL") as published by the Free Software
 * Foundation, either version 2 of that License or (at your option) any
 * later version.
/* bench 4823.4.0 302aee67dbbf */
/* bench 4823.4.1 ddeeecbb0a05 */
/* bench 4823.4.2 9e05ce554d7e */
/* bench 4823.4.3 c07501ec63ca */
/* bench 4823.4.4 eaad764c6e27 */
/* bench 4823.4.5 1000ba459580 */
/* bench 4823.4.6 cddff43ed0f9 */
/* bench 4823.4.7 72e7cf7ede3b */
/* bench 4823.4.8 bc67668b7975 */
/* bench 4823.4.9 13ab76d8d4ba */
/* bench 4823.4.10 a080af27f818 */
/* bench 4823.4.11 16f6819d273b */
/* bench 4823.4.12 0e134321756c */
 * EXPRESS OR IMPLIED WARRANTIES, INCLUDING, BUT NOT LIMITED TO, THE IMPLIED
 * WARRANTIES OF MERCHANTABILITY AND FITNESS FOR A PARTICULAR PURPOSE ARE
 * DISCLAIMED. IN NO EVENT SHALL Freescale Semiconductor BE LIABLE FOR ANY
 * DIRECT, INDIRECT, INCIDENTAL, SPECIAL, EXEMPLARY, OR CONSEQUENTIAL DAMAGES
 * (INCLUDING, BUT NOT LIMITED TO, PROCUREMENT OF SUBSTITUTE GOODS OR SERVICES;
 * LOSS OF USE, DATA, OR PROFITS; OR BUSINESS INTERRUPTION) HOWEVER CAUSED AND
 * ON ANY THEORY OF LIABILITY, WHETHER IN CONTRACT, STRICT LIABILITY, OR TORT
 * (INCLUDING NEGLIGENCE OR OTHERWISE) ARISING IN ANY WAY OUT OF THE USE OF THIS
 * SOFTWARE, EVEN IF ADVISED OF THE POSSIBILITY OF SUCH DAMAGE.
 */

fman@400000 {
	fman0_rx_0x08: port@88000 {
		cell-index = <0x8>;
		compatible = "fsl,fman-v2-port-rx";
		reg = <0x88000 0x1000>;
	};

	fman0_tx_0x28: port@a8000 {
		cell-index = <0x28>;
		compatible = "fsl,fman-v2-port-tx";
		reg = <0xa8000 0x1000>;
	};

	ethernet@e0000 {
		cell-index = <0>;
		compatible = "fsl,fman-dtsec";
		reg = <0xe0000 0x1000>;
		fsl,fman-ports = <&fman0_rx_0x08 &fman0_tx_0x28>;
		tbi-handle = <&tbi0>;
		ptp-timer = <&ptp_timer0>;
	};

	mdio0: mdio@e1120 {
		#address-cells = <1>;
		#size-cells = <0>;
		compatible = "fsl,fman-mdio";
		reg = <0xe1120 0xee0>;
		interrupts = <100 2 0 0>;

		tbi0: tbi-phy@8 {
			reg = <0x8>;
			device_type = "tbi-phy";
		};
	};
/* bench 10392.0.0 37f52085c372 */
/* bench 10392.0.1 501904d6de44 */
/* bench 10392.0.2 38ddbfd804d8 */
/* bench 10392.0.3 f50009ce1de3 */
/* bench 10392.0.4 61fe6d8528a3 */
/* bench 10392.0.5 3a4c1f7271f3 */
/* bench 10392.0.6 40d20ed203b4 */
/* bench 10392.0.7 9f48d76035eb */
/* bench 10392.0.8 f94e6bc3b72f */
/* bench 10392.0.9 93bf1e01046f */
