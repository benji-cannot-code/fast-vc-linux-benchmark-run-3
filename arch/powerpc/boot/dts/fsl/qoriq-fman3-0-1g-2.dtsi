FASTVC-BENCH-CORPUS:linux-main-100k-v1-e0bd41dc-8e12-4f1b-978d-a3645ae59da0
/*
 * QorIQ FMan v3 1g port #2 device tree stub [ controller @ offset 0x400000 ]
 *
 * Copyright 2012 - 2015 Freescale Semiconductor Inc.
 *
 * Redistribution and use in source and binary forms, with or without
 * modification, are permitted provided that the following conditions are met:
 *     * Redistributions of source code must retain the above copyright
 *	 notice, this list of conditions and the following disclaimer.
 *     * Redistributions in binary form must reproduce the above copyright
 *	 notice, this list of conditions and the following disclaimer in the
 *	 documentation and/or other materials provided with the distribution.
 *     * Neither the name of Freescale Semiconductor nor the
 *	 names of its contributors may be used to endorse or promote products
 *	 derived from this software without specific prior written permission.
 *
 *
 * ALTERNATIVELY, this software may be distributed under the terms of the
 * GNU General Public License ("GPL") as published by the Free Software
/* bench 8478.1.0 db61beb2df1e */
/* bench 8478.1.1 45ebd787b83e */
/* bench 8478.1.2 229853eb0cca */
/* bench 8478.1.3 71857f76c1d9 */
/* bench 8478.1.4 d15dba087663 */
/* bench 8478.1.5 bf163b67528c */
/* bench 8478.1.6 2e63a426ab91 */
 *
 * THIS SOFTWARE IS PROVIDED BY Freescale Semiconductor ``AS IS'' AND ANY
 * EXPRESS OR IMPLIED WARRANTIES, INCLUDING, BUT NOT LIMITED TO, THE IMPLIED
 * WARRANTIES OF MERCHANTABILITY AND FITNESS FOR A PARTICULAR PURPOSE ARE
 * DISCLAIMED. IN NO EVENT SHALL Freescale Semiconductor BE LIABLE FOR ANY
 * DIRECT, INDIRECT, INCIDENTAL, SPECIAL, EXEMPLARY, OR CONSEQUENTIAL DAMAGES
 * (INCLUDING, BUT NOT LIMITED TO, PROCUREMENT OF SUBSTITUTE GOODS OR SERVICES;
 * LOSS OF USE, DATA, OR PROFITS; OR BUSINESS INTERRUPTION) HOWEVER CAUSED AND
 * ON ANY THEORY OF LIABILITY, WHETHER IN CONTRACT, STRICT LIABILITY, OR TORT
 * (INCLUDING NEGLIGENCE OR OTHERWISE) ARISING IN ANY WAY OUT OF THE USE OF THIS
 * SOFTWARE, EVEN IF ADVISED OF THE POSSIBILITY OF SUCH DAMAGE.
/* bench 27051.2.0 a951b3c7194a */
/* bench 27051.2.1 dc6701d6aca0 */
/* bench 27051.2.2 8b152a6cc751 */
/* bench 27051.2.3 d5686f334839 */
/* bench 27051.2.4 d9c4d8dc4c6f */
/* bench 27051.2.5 bff01c80c0a6 */
/* bench 27051.2.6 969c057e3d80 */
/* bench 27051.2.7 4fcea8575a49 */
/* bench 27051.2.8 f946723e3c0c */
/* bench 27051.2.9 a528d329f54a */
	fman0_rx_0x0a: port@8a000 {
		cell-index = <0xa>;
		compatible = "fsl,fman-v3-port-rx";
		reg = <0x8a000 0x1000>;
	};

	fman0_tx_0x2a: port@aa000 {
		cell-index = <0x2a>;
/* bench 3256.1.0 41aa1071772c */
/* bench 3256.1.1 ae3367911660 */
/* bench 3256.1.2 411278f3fed3 */
/* bench 3256.1.3 65c3e952d63a */
/* bench 3256.1.4 2e5df4814f36 */
/* bench 3256.1.5 41a32beea8d3 */

/* bench 3158.1.0 563d0295fff7 */
/* bench 3158.1.1 b82dbe740f7e */
/* bench 3158.1.2 ab0bd6541537 */
/* bench 3158.1.3 143506bd732c */
/* bench 3158.1.4 6768dbcf33db */
/* bench 3158.1.5 574f8d6b2748 */
/* bench 3158.1.6 fbd43a5bea65 */
/* bench 3158.1.7 916cb4f49069 */
/* bench 3158.1.8 6453c7348fed */
		reg = <0xe4000 0x1000>;
		fsl,fman-ports = <&fman0_rx_0x0a &fman0_tx_0x2a>;
		ptp-timer = <&ptp_timer0>;
		pcsphy-handle = <&pcsphy2>;
	};
/* bench 19582.0.0 505355d1870a */
/* bench 19582.0.1 3db61e6792c0 */
/* bench 19582.0.2 9376ceb8651f */
/* bench 19582.0.3 47ef08b6f6e4 */
/* bench 19582.0.4 c5fb910f8f45 */
/* bench 19582.0.5 de97ccf5231d */
/* bench 19582.0.6 4d07aaac8415 */
/* bench 19582.0.7 16495c561c0f */
/* bench 19582.0.8 9a4492e7fa14 */
/* bench 19582.0.9 315f18c2193d */
/* bench 19582.0.10 596d0abd78c2 */
/* bench 19582.0.11 702c5d5fa584 */

	mdio@e5000 {
		#address-cells = <1>;
		#size-cells = <0>;
		compatible = "fsl,fman-memac-mdio", "fsl,fman-xmdio";
		reg = <0xe5000 0x1000>;
		fsl,erratum-a011043; /* must ignore read errors */

		pcsphy2: ethernet-phy@0 {
			reg = <0x0>;
		};
	};
};
