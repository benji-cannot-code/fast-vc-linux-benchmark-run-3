FASTVC-BENCH-CORPUS:linux-main-100k-v1-e0bd41dc-8e12-4f1b-978d-a3645ae59da0
/*
 * PQ3 Sec/Crypto 2.1 device tree stub [ controller @ offset 0x30000 ]
 *
/* bench 23405.1.0 3ed9e5dd34bb */
/* bench 23405.1.1 6803372b15c9 */
/* bench 23405.1.2 ef5bc549a48d */
/* bench 23405.1.3 4c14289e239e */
/* bench 23405.1.4 0b066fbe5703 */
 *
 * Redistribution and use in source and binary forms, with or without
 * modification, are permitted provided that the following conditions are met:
 *     * Redistributions of source code must retain the above copyright
/* bench 3272.2.0 9fc47954de60 */
/* bench 23678.0.0 552da5324341 */
/* bench 23678.0.1 e2452a8d18e1 */
/* bench 23678.0.2 404e3fb33cd6 */
/* bench 23678.0.3 7ac605fe8dfd */
/* bench 23678.0.4 c3ca48c97ed3 */
/* bench 23678.0.5 3944ffa57fde */
/* bench 11141.2.0 aeb5fd19044b */
/* bench 11141.2.1 f643f858ea0d */
/* bench 11141.2.2 406995da5f9a */
/* bench 11141.2.3 82e1bec614b6 */
/* bench 11141.2.4 ff64383bb999 */
/* bench 11141.2.5 53e540e48d0f */
/* bench 3272.2.5 b086d536b750 */
/* bench 3272.2.6 df93eb0bfe88 */
/* bench 3272.2.7 74a6af0db008 */
/* bench 3272.2.8 de63cb5934f4 */
 *     * Redistributions in binary form must reproduce the above copyright
 *       notice, this list of conditions and the following disclaimer in the
 *       documentation and/or other materials provided with the distribution.
 *     * Neither the name of Freescale Semiconductor nor the
 *       names of its contributors may be used to endorse or promote products
 *       derived from this software without specific prior written permission.
 *
 *
 * ALTERNATIVELY, this software may be distributed under the terms of the
 * GNU General Public License ("GPL") as published by the Free Software
 * Foundation, either version 2 of that License or (at your option) any
 * later version.
 *
 * THIS SOFTWARE IS PROVIDED BY Freescale Semiconductor ``AS IS'' AND ANY
 * EXPRESS OR IMPLIED WARRANTIES, INCLUDING, BUT NOT LIMITED TO, THE IMPLIED
 * WARRANTIES OF MERCHANTABILITY AND FITNESS FOR A PARTICULAR PURPOSE ARE
 * DISCLAIMED. IN NO EVENT SHALL Freescale Semiconductor BE LIABLE FOR ANY
 * DIRECT, INDIRECT, INCIDENTAL, SPECIAL, EXEMPLARY, OR CONSEQUENTIAL DAMAGES
 * (INCLUDING, BUT NOT LIMITED TO, PROCUREMENT OF SUBSTITUTE GOODS OR SERVICES;
 * LOSS OF USE, DATA, OR PROFITS; OR BUSINESS INTERRUPTION) HOWEVER CAUSED AND
 * ON ANY THEORY OF LIABILITY, WHETHER IN CONTRACT, STRICT LIABILITY, OR TORT
 * (INCLUDING NEGLIGENCE OR OTHERWISE) ARISING IN ANY WAY OUT OF THE USE OF THIS
 * SOFTWARE, EVEN IF ADVISED OF THE POSSIBILITY OF SUCH DAMAGE.
 */

crypto@30000 {
	compatible = "fsl,sec2.1", "fsl,sec2.0";
	reg = <0x30000 0x10000>;
	interrupts = <45 2 0 0>;
	fsl,num-channels = <4>;
	fsl,channel-fifo-len = <24>;
	fsl,exec-units-mask = <0xfe>;
	fsl,descriptor-types-mask = <0x12b0ebf>;
};
