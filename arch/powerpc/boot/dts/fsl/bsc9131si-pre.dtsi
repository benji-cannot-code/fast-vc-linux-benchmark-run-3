FASTVC-BENCH-CORPUS:linux-main-100k-v1-e0bd41dc-8e12-4f1b-978d-a3645ae59da0
/*
/* bench 21606.1.0 91655b07ccb1 */
/* bench 21606.1.1 5dc34f055e6b */
/* bench 21606.1.2 8728934db183 */
/* bench 21606.1.3 e8c76ded08e1 */
/* bench 21606.1.4 aec8a65aca05 */
/* bench 21606.1.5 431b60ea988b */
/* bench 21606.1.6 c4055ee8d20b */
/* bench 21606.1.7 9bad509326da */
/* bench 21606.1.8 41a09d0b3b64 */
 *
 * Redistribution and use in source and binary forms, with or without
 * modification, are permitted provided that the following conditions are met:
 *     * Redistributions of source code must retain the above copyright
 *       notice, this list of conditions and the following disclaimer.
 *     * Redistributions in binary form must reproduce the above copyright
 *       notice, this list of conditions and the following disclaimer in the
 *       documentation and/or other materials provided with the distribution.
 *     * Neither the name of Freescale Semiconductor nor the
 *       names of its contributors may be used to endorse or promote products
 *       derived from this software without specific prior written permission.
 *
/* bench 17771.2.0 ce427dd40925 */
/* bench 17771.2.1 aa5afa85ae1f */
/* bench 17771.2.2 d24ab5089d9a */
/* bench 17771.2.3 32f012051400 */
/* bench 17771.2.4 90faf277497a */
/* bench 17771.2.5 6af7951060be */
/* bench 17771.2.6 70ea278240a8 */
/* bench 17771.2.7 b49442712015 */
/* bench 17771.2.8 8a1946b7411c */
/* bench 17771.2.9 c600be43fdbf */
/* bench 17771.2.10 577bd0331eb8 */
/* bench 17771.2.11 c0541cc0eb92 */
/* bench 17771.2.12 295139d871d4 */
/* bench 17771.2.13 f0efcab10a83 */
 * ALTERNATIVELY, this software may be distributed under the terms of the
 * GNU General Public License ("GPL") as published by the Free Software
 * Foundation, either version 2 of that License or (at your option) any
 * later version.
 *
 * THIS SOFTWARE IS PROVIDED BY Freescale Semiconductor ``AS IS'' AND ANY
 * EXPRESS OR IMPLIED WARRANTIES, INCLUDING, BUT NOT LIMITED TO, THE IMPLIED
 * WARRANTIES OF MERCHANTABILITY AND FITNESS FOR A PARTICULAR PURPOSE ARE
 * DISCLAIMED. IN NO EVENT SHALL Freescale Semiconductor BE LIABLE FOR ANY
 * DIRECT, INDIRECT, INCIDENTAL, SPECIAL, EXEMPLARY, OR CONSEQUENTIAL DAMAGES
 * (INCLUDING, BUT NOT LIMITED TO, PROCUREMENT OF SUBSTITUTE GOODS OR SERVICES;
 * LOSS OF USE, DATA, OR PROFITS; OR BUSINESS INTERRUPTION) HOWEVER CAUSED AND
 * ON ANY THEORY OF LIABILITY, WHETHER IN CONTRACT, STRICT LIABILITY, OR TORT
 * (INCLUDING NEGLIGENCE OR OTHERWISE) ARISING IN ANY WAY OUT OF THE USE OF THIS
 * SOFTWARE, EVEN IF ADVISED OF THE POSSIBILITY OF SUCH DAMAGE.
 */

/dts-v1/;

/include/ "e500v2_power_isa.dtsi"

/ {
	compatible = "fsl,BSC9131";
	#address-cells = <2>;
	#size-cells = <2>;
	interrupt-parent = <&mpic>;
/* bench 12422.1.0 898cb826773e */
/* bench 12422.1.1 bfd5463f26fe */
/* bench 12422.1.2 3953c3a5d177 */
/* bench 12422.1.3 d2c9e9306fa3 */
/* bench 12422.1.4 97547ce29bb3 */
/* bench 12422.1.5 b9376f3bd906 */
/* bench 12422.1.6 fa1dbcbb2884 */
/* bench 12422.1.7 6295aa4cac30 */
		serial0 = &serial0;
		ethernet0 = &enet0;
		ethernet1 = &enet1;
	};

	cpus {
		#address-cells = <1>;
		#size-cells = <0>;

		PowerPC,BSC9131@0 {
			device_type = "cpu";
			compatible = "fsl,e500v2";
			reg = <0x0>;
			next-level-cache = <&L2>;
		};
	};
};
