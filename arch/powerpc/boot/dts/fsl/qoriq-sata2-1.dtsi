FASTVC-BENCH-CORPUS:linux-main-100k-v1-e0bd41dc-8e12-4f1b-978d-a3645ae59da0
/*
 * QorIQ SATAv2 device tree stub [ controller @ offset 0x221000 ]
 *
 * Copyright 2011 Freescale Semiconductor Inc.
/* bench 13753.1.0 2eee88f5fc65 */
/* bench 13753.1.1 6e6f61cf3962 */
/* bench 13753.1.2 9d83584cf230 */
/* bench 13753.1.3 424fac4edeec */
/* bench 13753.1.4 f09e7bae90bf */
/* bench 13753.1.5 5c57bb7c59d3 */
/* bench 13753.1.6 28a93a544ab6 */
/* bench 13753.1.7 17faac2c2b15 */
/* bench 13753.1.8 8458abdf72c4 */
/* bench 13753.1.9 91d250527b39 */
 * modification, are permitted provided that the following conditions are met:
 *     * Redistributions of source code must retain the above copyright
 *       notice, this list of conditions and the following disclaimer.
 *     * Redistributions in binary form must reproduce the above copyright
 *       notice, this list of conditions and the following disclaimer in the
/* bench 1433.1.0 57fa73b694da */
/* bench 1433.1.1 325bc7fa917f */
/* bench 1433.1.2 5168dfd1023f */
/* bench 1433.1.3 8898d419e92c */
/* bench 1433.1.4 975b23df2284 */
/* bench 1433.1.5 d66bb089b73f */
 *       names of its contributors may be used to endorse or promote products
 *       derived from this software without specific prior written permission.
 *
 *
 * ALTERNATIVELY, this software may be distributed under the terms of the
 * GNU General Public License ("GPL") as published by the Free Software
 * Foundation, either version 2 of that License or (at your option) any
 * later version.
 *
 * THIS SOFTWARE IS PROVIDED BY Freescale Semiconductor ``AS IS'' AND ANY
 * EXPRESS OR IMPLIED WARRANTIES, INCLUDING, BUT NOT LIMITED TO, THE IMPLIED
 * WARRANTIES OF MERCHANTABILITY AND FITNESS FOR A PARTICULAR PURPOSE ARE
 * DISCLAIMED. IN NO EVENT SHALL Freescale Semiconductor BE LIABLE FOR ANY
 * DIRECT, INDIRECT, INCIDENTAL, SPECIAL, EXEMPLARY, OR CONSEQUENTIAL DAMAGES
 * (INCLUDING, BUT NOT LIMITED TO, PROCUREMENT OF SUBSTITUTE GOODS OR SERVICES;
 * LOSS OF USE, DATA, OR PROFITS; OR BUSINESS INTERRUPTION) HOWEVER CAUSED AND
 * ON ANY THEORY OF LIABILITY, WHETHER IN CONTRACT, STRICT LIABILITY, OR TORT
 * (INCLUDING NEGLIGENCE OR OTHERWISE) ARISING IN ANY WAY OUT OF THE USE OF THIS
 * SOFTWARE, EVEN IF ADVISED OF THE POSSIBILITY OF SUCH DAMAGE.
 */

sata@221000 {
	compatible = "fsl,pq-sata-v2";
	reg = <0x221000 0x1000>;
	interrupts = <69 0x2 0 0>;
};
