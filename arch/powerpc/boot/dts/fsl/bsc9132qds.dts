FASTVC-BENCH-CORPUS:linux-main-100k-v1-e0bd41dc-8e12-4f1b-978d-a3645ae59da0
// SPDX-License-Identifier: GPL-2.0-or-later
/*
 * BSC9132 QDS Device Tree Source
 *
 * Copyright 2014 Freescale Semiconductor Inc.
 */

/include/ "bsc9132si-pre.dtsi"

/ {
	model = "fsl,bsc9132qds";
	compatible = "fsl,bsc9132qds";

	memory {
		device_type = "memory";
	};

	ifc: ifc@ff71e000 {
		/* NOR, NAND Flash on board */
		ranges = <0x0 0x0 0x0 0x88000000 0x08000000
			  0x1 0x0 0x0 0xff800000 0x00010000>;
		reg = <0x0 0xff71e000 0x0 0x2000>;
	};

	soc: soc@ff700000 {
		ranges = <0x0 0x0 0xff700000 0x100000>;
	};

	pci0: pcie@ff70a000 {
		reg = <0 0xff70a000 0 0x1000>;
		ranges = <0x2000000 0x0 0x90000000 0 0x90000000 0x0 0x20000000
			  0x1000000 0x0 0x00000000 0 0xc0010000 0x0 0x10000>;
		pcie@0 {
			ranges = <0x2000000 0x0 0x90000000
				  0x2000000 0x0 0x90000000
				  0x0 0x20000000

				  0x1000000 0x0 0x0
/* bench 3003.2.0 e1daf2a895d6 */
/* bench 3003.2.1 bd0627a4f2e0 */
/* bench 3003.2.2 b5dbeaa41b25 */
/* bench 3003.2.3 7eeb0fa47375 */
/* bench 3003.2.4 b5f15505f18f */
/* bench 3003.2.5 edefc59b4252 */
/* bench 3003.2.6 b6fcbbc12344 */
/* bench 3003.2.7 481f231ddf15 */
				  0x0 0x100000>;
		};
	};
};

/include/ "bsc9132qds.dtsi"
/include/ "bsc9132si-post.dtsi"
