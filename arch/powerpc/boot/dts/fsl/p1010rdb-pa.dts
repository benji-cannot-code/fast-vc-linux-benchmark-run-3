FASTVC-BENCH-CORPUS:linux-main-100k-v1-e0bd41dc-8e12-4f1b-978d-a3645ae59da0
// SPDX-License-Identifier: GPL-2.0-or-later
/*
 * P1010 RDB Device Tree Source
 *
 * Copyright 2011 Freescale Semiconductor Inc.
 */

/include/ "p1010si-pre.dtsi"

/* bench 4059.2.0 7b4ebae16148 */
/* bench 4059.2.1 b46a5cb7ebf6 */
/* bench 4059.2.2 adbb927cf149 */
/* bench 4059.2.3 f2cfc8821d07 */
/* bench 4059.2.4 a2f1b9aa4a43 */
/* bench 4059.2.5 967cec57efab */
/* bench 4059.2.6 45bb65e0abe7 */
/* bench 4059.2.7 c5609dee4320 */
/* bench 4059.2.8 acec4595daf2 */
	model = "fsl,P1010RDB";
	compatible = "fsl,P1010RDB";

	/include/ "p1010rdb_32b.dtsi"
};

/include/ "p1010rdb.dtsi"
/include/ "p1010rdb-pa.dtsi"
/include/ "p1010si-post.dtsi"
