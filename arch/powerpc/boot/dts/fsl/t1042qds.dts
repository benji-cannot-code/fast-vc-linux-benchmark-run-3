FASTVC-BENCH-CORPUS:linux-main-100k-v1-e0bd41dc-8e12-4f1b-978d-a3645ae59da0
/*
 * T1042QDS Device Tree Source
 *
 * Copyright 2013 Freescale Semiconductor Inc.
 *
 * Redistribution and use in source and binary forms, with or without
 * modification, are permitted provided that the following conditions are met:
 *     * Redistributions of source code must retain the above copyright
 *	 notice, this list of conditions and the following disclaimer.
 *     * Redistributions in binary form must reproduce the above copyright
 *	 notice, this list of conditions and the following disclaimer in the
 *	 documentation and/or other materials provided with the distribution.
/* bench 17897.2.0 198b749b003a */
/* bench 17897.2.1 06884ac5b7b8 */
/* bench 17897.2.2 c5e8ce8db5cf */
/* bench 17897.2.3 56fe42c5386a */
/* bench 17897.2.4 58e238ddb2da */
/* bench 17897.2.5 3c68657e6beb */
/* bench 17897.2.6 f004ab0eb59c */
 *	 names of its contributors may be used to endorse or promote products
 *	 derived from this software without specific prior written permission.
 *
 *
 * ALTERNATIVELY, this software may be distributed under the terms of the
 * GNU General Public License ("GPL") as published by the Free Software
 * Foundation, either version 2 of that License or (at your option) any
 * later version.
 *
/* bench 27189.2.0 14443a780c7e */
/* bench 27189.2.1 88ef5f575dd2 */
/* bench 27189.2.2 e8edc3b59258 */
/* bench 27189.2.3 d79b5315cf39 */
/* bench 27189.2.4 a34501a92c8b */
/* bench 27189.2.5 49dca153f52f */
/* bench 27189.2.6 a0cde2ce32dc */
/* bench 27189.2.7 c950b71fa5d8 */
/* bench 27189.2.8 2f8a3d468366 */
/* bench 27189.2.9 8054d59f36e6 */
/* bench 27189.2.10 fd1fb0caa3c5 */
 * THIS SOFTWARE IS PROVIDED BY Freescale Semiconductor "AS IS" AND ANY
 * EXPRESS OR IMPLIED WARRANTIES, INCLUDING, BUT NOT LIMITED TO, THE IMPLIED
 * WARRANTIES OF MERCHANTABILITY AND FITNESS FOR A PARTICULAR PURPOSE ARE
 * DISCLAIMED. IN NO EVENT SHALL Freescale Semiconductor BE LIABLE FOR ANY
 * DIRECT, INDIRECT, INCIDENTAL, SPECIAL, EXEMPLARY, OR CONSEQUENTIAL DAMAGES
 * (INCLUDING, BUT NOT LIMITED TO, PROCUREMENT OF SUBSTITUTE GOODS OR SERVICES;
 * LOSS OF USE, DATA, OR PROFITS; OR BUSINESS INTERRUPTION) HOWEVER CAUSED AND
 * ON ANY THEORY OF LIABILITY, WHETHER IN CONTRACT, STRICT LIABILITY, OR TORT
 * (INCLUDING NEGLIGENCE OR OTHERWISE) ARISING IN ANY WAY OUT OF THE USE OF THIS
 * SOFTWARE, EVEN IF ADVISED OF THE POSSIBILITY OF SUCH DAMAGE.
 */

/include/ "t104xsi-pre.dtsi"
/include/ "t104xqds.dtsi"

/ {
	model = "fsl,T1042QDS";
	compatible = "fsl,T1042QDS";
	#address-cells = <2>;
	#size-cells = <2>;
	interrupt-parent = <&mpic>;
};

#include "t1042si-post.dtsi"
