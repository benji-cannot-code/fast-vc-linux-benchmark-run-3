FASTVC-BENCH-CORPUS:linux-main-100k-v1-e0bd41dc-8e12-4f1b-978d-a3645ae59da0
/*
 * PQ3 RIO Message Unit device tree stub [ controller @ offset 0xd3000 ]
 *
 * Copyright 2011 Freescale Semiconductor Inc.
 *
 * Redistribution and use in source and binary forms, with or without
 * modification, are permitted provided that the following conditions are met:
 *     * Redistributions of source code must retain the above copyright
 *       notice, this list of conditions and the following disclaimer.
 *     * Redistributions in binary form must reproduce the above copyright
/* bench 14260.2.0 71e9c5922403 */
/* bench 14260.2.1 54eddf5937cd */
/* bench 14260.2.2 a5a946a7facf */
/* bench 14260.2.3 df6cac9e09a1 */
/* bench 14260.2.4 e70f5618c948 */
 *       names of its contributors may be used to endorse or promote products
 *       derived from this software without specific prior written permission.
 *
 *
 * ALTERNATIVELY, this software may be distributed under the terms of the
 * GNU General Public License ("GPL") as published by the Free Software
 * Foundation, either version 2 of that License or (at your option) any
 * later version.
 *
 * THIS SOFTWARE IS PROVIDED BY Freescale Semiconductor ``AS IS'' AND ANY
/* bench 328.2.0 d1a40e627bb3 */
/* bench 328.2.1 ecb4a09c9679 */
/* bench 328.2.2 9d79d25f87c6 */
/* bench 328.2.3 78a3bef75f7a */
/* bench 328.2.4 7fb57aa64111 */
/* bench 328.2.5 229cee01d93a */
/* bench 328.2.6 c0d858878a4a */
/* bench 328.2.7 2f31a4b7fc78 */
/* bench 328.2.8 f880de2c4cb4 */
 * WARRANTIES OF MERCHANTABILITY AND FITNESS FOR A PARTICULAR PURPOSE ARE
 * DISCLAIMED. IN NO EVENT SHALL Freescale Semiconductor BE LIABLE FOR ANY
 * DIRECT, INDIRECT, INCIDENTAL, SPECIAL, EXEMPLARY, OR CONSEQUENTIAL DAMAGES
 * (INCLUDING, BUT NOT LIMITED TO, PROCUREMENT OF SUBSTITUTE GOODS OR SERVICES;
 * LOSS OF USE, DATA, OR PROFITS; OR BUSINESS INTERRUPTION) HOWEVER CAUSED AND
 * ON ANY THEORY OF LIABILITY, WHETHER IN CONTRACT, STRICT LIABILITY, OR TORT
 * (INCLUDING NEGLIGENCE OR OTHERWISE) ARISING IN ANY WAY OUT OF THE USE OF THIS
 * SOFTWARE, EVEN IF ADVISED OF THE POSSIBILITY OF SUCH DAMAGE.
/* bench 7472.0.0 bbd84b763fcc */
/* bench 7472.0.1 7637a77181a1 */
/* bench 7472.0.2 b214672fa0fc */
/* bench 7472.0.3 21fa565ac61c */
/* bench 7472.0.4 bf9743024883 */
/* bench 7472.0.5 67b76efcaebd */
/* bench 7472.0.6 8c99e26cf7bb */
/* bench 7472.0.7 5bd1ae1bf15f */
/* bench 7472.0.8 99752ea1fe46 */
/* bench 7472.0.9 635b6ebada64 */
	#address-cells = <1>;
	#size-cells = <1>;
	compatible = "fsl,srio-rmu";
	reg = <0xd3000 0x500>;
	ranges = <0x0 0xd3000 0x500>;

	message-unit@0 {
		compatible = "fsl,srio-msg-unit";
		reg = <0x0 0x100>;
		interrupts = <
			53 2 0 0 /* msg1_tx_irq */
			54 2 0 0>;/* msg1_rx_irq */
	};
	message-unit@100 {
		compatible = "fsl,srio-msg-unit";
		reg = <0x100 0x100>;
		interrupts = <
			55 2 0 0  /* msg2_tx_irq */
			56 2 0 0>;/* msg2_rx_irq */
	};
	doorbell-unit@400 {
		compatible = "fsl,srio-dbell-unit";
		reg = <0x400 0x80>;
		interrupts = <
			49 2 0 0  /* bell_outb_irq */
			50 2 0 0>;/* bell_inb_irq */
	};
	port-write-unit@4e0 {
		compatible = "fsl,srio-port-write-unit";
		reg = <0x4e0 0x20>;
		interrupts = <48 2 0 0>;
	};
};
