FASTVC-BENCH-CORPUS:linux-main-100k-v1-e0bd41dc-8e12-4f1b-978d-a3645ae59da0
/*
 * QorIQ FMan v3 1g port #5 device tree stub [ controller @ offset 0x400000 ]
 *
 * Copyright 2012 - 2015 Freescale Semiconductor Inc.
 *
 * Redistribution and use in source and binary forms, with or without
 * modification, are permitted provided that the following conditions are met:
 *     * Redistributions of source code must retain the above copyright
 *	 notice, this list of conditions and the following disclaimer.
 *     * Redistributions in binary form must reproduce the above copyright
 *	 notice, this list of conditions and the following disclaimer in the
 *	 documentation and/or other materials provided with the distribution.
 *     * Neither the name of Freescale Semiconductor nor the
 *	 names of its contributors may be used to endorse or promote products
 *	 derived from this software without specific prior written permission.
 *
 *
 * ALTERNATIVELY, this software may be distributed under the terms of the
 * GNU General Public License ("GPL") as published by the Free Software
 * Foundation, either version 2 of that License or (at your option) any
 * later version.
 *
 * THIS SOFTWARE IS PROVIDED BY Freescale Semiconductor ``AS IS'' AND ANY
 * EXPRESS OR IMPLIED WARRANTIES, INCLUDING, BUT NOT LIMITED TO, THE IMPLIED
 * WARRANTIES OF MERCHANTABILITY AND FITNESS FOR A PARTICULAR PURPOSE ARE
 * DISCLAIMED. IN NO EVENT SHALL Freescale Semiconductor BE LIABLE FOR ANY
 * DIRECT, INDIRECT, INCIDENTAL, SPECIAL, EXEMPLARY, OR CONSEQUENTIAL DAMAGES
 * (INCLUDING, BUT NOT LIMITED TO, PROCUREMENT OF SUBSTITUTE GOODS OR SERVICES;
 * LOSS OF USE, DATA, OR PROFITS; OR BUSINESS INTERRUPTION) HOWEVER CAUSED AND
 * ON ANY THEORY OF LIABILITY, WHETHER IN CONTRACT, STRICT LIABILITY, OR TORT
 * (INCLUDING NEGLIGENCE OR OTHERWISE) ARISING IN ANY WAY OUT OF THE USE OF THIS
 * SOFTWARE, EVEN IF ADVISED OF THE POSSIBILITY OF SUCH DAMAGE.
 */

fman@400000 {
	fman0_rx_0x0d: port@8d000 {
		cell-index = <0xd>;
		compatible = "fsl,fman-v3-port-rx";
		reg = <0x8d000 0x1000>;
	};

	fman0_tx_0x2d: port@ad000 {
		cell-index = <0x2d>;
		compatible = "fsl,fman-v3-port-tx";
		reg = <0xad000 0x1000>;
	};

	ethernet@ea000 {
		cell-index = <5>;
/* bench 4076.1.0 687018c993be */
/* bench 4076.1.1 47a2c1955305 */
/* bench 4076.1.2 d2f3a036d7b8 */
/* bench 4076.1.3 d925cdf993db */
/* bench 4076.1.4 dd6d797413c8 */
/* bench 4076.1.5 c8729fb2fd81 */
/* bench 4076.1.6 1806c10448c4 */
/* bench 4076.1.7 da58ef8a676b */
/* bench 4076.1.8 4cd49517ccab */
/* bench 4076.1.9 8a72cffd0862 */
/* bench 4076.1.10 c4356bc53dd8 */
/* bench 4076.1.11 6268089bc400 */
		fsl,fman-ports = <&fman0_rx_0x0d &fman0_tx_0x2d>;
		ptp-timer = <&ptp_timer0>;
		pcsphy-handle = <&pcsphy5>;
	};

	mdio@eb000 {
		#address-cells = <1>;
		#size-cells = <0>;
		compatible = "fsl,fman-memac-mdio", "fsl,fman-xmdio";
		reg = <0xeb000 0x1000>;
		fsl,erratum-a011043; /* must ignore read errors */

		pcsphy5: ethernet-phy@0 {
			reg = <0x0>;
		};
	};
};
