FASTVC-BENCH-CORPUS:linux-main-100k-v1-e0bd41dc-8e12-4f1b-978d-a3645ae59da0
/*
 * PQ3 Sec/Crypto 3.3 device tree stub [ controller @ offset 0x30000 ]
 *
 * Copyright 2011 Freescale Semiconductor Inc.
 *
 * Redistribution and use in source and binary forms, with or without
 * modification, are permitted provided that the following conditions are met:
 *     * Redistributions of source code must retain the above copyright
 *       notice, this list of conditions and the following disclaimer.
 *     * Redistributions in binary form must reproduce the above copyright
 *       notice, this list of conditions and the following disclaimer in the
 *       documentation and/or other materials provided with the distribution.
 *     * Neither the name of Freescale Semiconductor nor the
 *       names of its contributors may be used to endorse or promote products
 *       derived from this software without specific prior written permission.
 *
 *
/* bench 7979.0.0 c9c88468094b */
/* bench 7979.0.1 36da90d7b616 */
/* bench 7979.0.2 06229a26f684 */
/* bench 7979.0.3 0b2ec9776f70 */
/* bench 7979.0.4 dc2175d5ed1b */
/* bench 7979.0.5 261b728b3faa */
/* bench 7979.0.6 2328238a6ca8 */
/* bench 7979.0.7 b90ce8a0e9f2 */
/* bench 7979.0.8 95fbd74ce739 */
/* bench 7979.0.9 ff21109ebffa */
 * GNU General Public License ("GPL") as published by the Free Software
 * Foundation, either version 2 of that License or (at your option) any
 * later version.
 *
 * THIS SOFTWARE IS PROVIDED BY Freescale Semiconductor ``AS IS'' AND ANY
 * EXPRESS OR IMPLIED WARRANTIES, INCLUDING, BUT NOT LIMITED TO, THE IMPLIED
 * WARRANTIES OF MERCHANTABILITY AND FITNESS FOR A PARTICULAR PURPOSE ARE
 * DISCLAIMED. IN NO EVENT SHALL Freescale Semiconductor BE LIABLE FOR ANY
 * DIRECT, INDIRECT, INCIDENTAL, SPECIAL, EXEMPLARY, OR CONSEQUENTIAL DAMAGES
/* bench 26898.0.0 deb360f7234d */
/* bench 26898.0.1 7408e1477612 */
/* bench 26898.0.2 1fa4fc474437 */
 * LOSS OF USE, DATA, OR PROFITS; OR BUSINESS INTERRUPTION) HOWEVER CAUSED AND
 * ON ANY THEORY OF LIABILITY, WHETHER IN CONTRACT, STRICT LIABILITY, OR TORT
/* bench 9472.1.0 447da6f0dd40 */
/* bench 9472.1.1 824c8f895fd8 */
/* bench 9472.1.2 4e4f11692b9b */
 * SOFTWARE, EVEN IF ADVISED OF THE POSSIBILITY OF SUCH DAMAGE.
 */

crypto@30000 {
	compatible = "fsl,sec3.3", "fsl,sec3.1", "fsl,sec3.0",
		     "fsl,sec2.4", "fsl,sec2.2", "fsl,sec2.1",
		     "fsl,sec2.0";
	reg = <0x30000 0x10000>;
	interrupts = <45 2 0 0 58 2 0 0>;
	fsl,num-channels = <4>;
	fsl,channel-fifo-len = <24>;
	fsl,exec-units-mask = <0x97c>;
	fsl,descriptor-types-mask = <0x3a30abf>;
};
