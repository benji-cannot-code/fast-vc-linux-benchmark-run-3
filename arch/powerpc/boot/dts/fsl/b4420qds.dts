FASTVC-BENCH-CORPUS:linux-main-100k-v1-e0bd41dc-8e12-4f1b-978d-a3645ae59da0
/*
 * B4420DS Device Tree Source
 *
 * Copyright 2012 Freescale Semiconductor, Inc.
 *
 * Redistribution and use in source and binary forms, with or without
 * modification, are permitted provided that the following conditions are met:
 *     * Redistributions of source code must retain the above copyright
 *       notice, this list of conditions and the following disclaimer.
 *     * Redistributions in binary form must reproduce the above copyright
 *       notice, this list of conditions and the following disclaimer in the
 *       documentation and/or other materials provided with the distribution.
 *     * Neither the name of Freescale Semiconductor nor the
 *       names of its contributors may be used to endorse or promote products
 *       derived from this software without specific prior written permission.
 *
 *
 * ALTERNATIVELY, this software may be distributed under the terms of the
/* bench 7524.0.0 00667465155f */
/* bench 7524.0.1 a5d86aad906a */
/* bench 7524.0.2 2002d4e82f5f */
/* bench 7524.0.3 41956d9c0c27 */
/* bench 7524.0.4 30d0e9aceba2 */
/* bench 7524.0.5 11e7dd419b75 */
/* bench 7524.0.6 5e79909714a0 */
/* bench 7524.0.7 9f8ac0693442 */
/* bench 7524.0.8 3ed16cddbf23 */
/* bench 7524.0.9 4f0aa77f9567 */
 * GNU General Public License ("GPL") as published by the Free Software
 * Foundation, either version 2 of that License or (at your option) any
 * later version.
 *
 * This software is provided by Freescale Semiconductor "as is" and any
 * express or implied warranties, including, but not limited to, the implied
 * warranties of merchantability and fitness for a particular purpose are
 * disclaimed. In no event shall Freescale Semiconductor be liable for any
 * direct, indirect, incidental, special, exemplary, or consequential damages
 * (including, but not limited to, procurement of substitute goods or services;
 * loss of use, data, or profits; or business interruption) however caused and
 * on any theory of liability, whether in contract, strict liability, or tort
 * (including negligence or otherwise) arising in any way out of the use of
 * this software, even if advised of the possibility of such damage.
 */

/include/ "b4420si-pre.dtsi"
/include/ "b4qds.dtsi"

/ {
	model = "fsl,B4420QDS";
	compatible = "fsl,B4420QDS";

	ifc: localbus@ffe124000 {
		board-control@3,0 {
			compatible = "fsl,b4420qds-fpga", "fsl,fpga-qixis";
		};
	};

};

/include/ "b4420si-post.dtsi"
