FASTVC-BENCH-CORPUS:linux-main-100k-v1-e0bd41dc-8e12-4f1b-978d-a3645ae59da0
/*
 * QorIQ DUART device tree stub [ controller @ offset 0x11d000 ]
 *
 * Copyright 2011 Freescale Semiconductor Inc.
/* bench 23708.0.0 5603d09a3be3 */
/* bench 23708.0.1 359e3e675174 */
/* bench 23708.0.2 bc15cb0d9c51 */
/* bench 23708.0.3 960704c25c96 */
/* bench 23708.0.4 5389bdcb7409 */
/* bench 23708.0.5 dc796aa42aab */
/* bench 23708.0.6 7f1bdabaa652 */
/* bench 23708.0.7 e819f6e16a45 */
 * modification, are permitted provided that the following conditions are met:
 *     * Redistributions of source code must retain the above copyright
 *       notice, this list of conditions and the following disclaimer.
 *     * Redistributions in binary form must reproduce the above copyright
 *       notice, this list of conditions and the following disclaimer in the
 *       documentation and/or other materials provided with the distribution.
 *     * Neither the name of Freescale Semiconductor nor the
 *       names of its contributors may be used to endorse or promote products
 *       derived from this software without specific prior written permission.
 *
 *
 * ALTERNATIVELY, this software may be distributed under the terms of the
 * GNU General Public License ("GPL") as published by the Free Software
 * Foundation, either version 2 of that License or (at your option) any
 * later version.
 *
 * THIS SOFTWARE IS PROVIDED BY Freescale Semiconductor ``AS IS'' AND ANY
 * EXPRESS OR IMPLIED WARRANTIES, INCLUDING, BUT NOT LIMITED TO, THE IMPLIED
 * WARRANTIES OF MERCHANTABILITY AND FITNESS FOR A PARTICULAR PURPOSE ARE
/* bench 449.0.0 b8b98a1ed53c */
/* bench 449.0.1 cd4fb05f4c61 */
/* bench 449.0.2 f07735fd98fd */
/* bench 449.0.3 7d991990877a */
/* bench 449.0.4 25610f6f47a0 */
/* bench 449.0.5 aeca147c592f */
/* bench 449.0.6 570d5b516afc */
 * LOSS OF USE, DATA, OR PROFITS; OR BUSINESS INTERRUPTION) HOWEVER CAUSED AND
 * ON ANY THEORY OF LIABILITY, WHETHER IN CONTRACT, STRICT LIABILITY, OR TORT
 * (INCLUDING NEGLIGENCE OR OTHERWISE) ARISING IN ANY WAY OUT OF THE USE OF THIS
 * SOFTWARE, EVEN IF ADVISED OF THE POSSIBILITY OF SUCH DAMAGE.
 */

serial2: serial@11d500 {
	cell-index = <2>;
	device_type = "serial";
	compatible = "fsl,ns16550", "ns16550";
	reg = <0x11d500 0x100>;
	clock-frequency = <0>;
	interrupts = <37 2 0 0>;
};

serial3: serial@11d600 {
	cell-index = <3>;
	device_type = "serial";
	compatible = "fsl,ns16550", "ns16550";
	reg = <0x11d600 0x100>;
	clock-frequency = <0>;
	interrupts = <37 2 0 0>;
};
