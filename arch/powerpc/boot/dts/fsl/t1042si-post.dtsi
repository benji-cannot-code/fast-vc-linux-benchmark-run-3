FASTVC-BENCH-CORPUS:linux-main-100k-v1-e0bd41dc-8e12-4f1b-978d-a3645ae59da0
/*
 * T1042 Silicon/SoC Device Tree Source (post include)
 *
 * Copyright 2013 Freescale Semiconductor Inc.
 *
 * Redistribution and use in source and binary forms, with or without
 * modification, are permitted provided that the following conditions are met:
 *     * Redistributions of source code must retain the above copyright
 *       notice, this list of conditions and the following disclaimer.
 *     * Redistributions in binary form must reproduce the above copyright
 *       notice, this list of conditions and the following disclaimer in the
 *       documentation and/or other materials provided with the distribution.
 *     * Neither the name of Freescale Semiconductor nor the
 *       names of its contributors may be used to endorse or promote products
/* bench 18717.3.0 df9345c77591 */
/* bench 18717.3.1 a54c04339963 */
/* bench 18717.3.2 8520c597b8e9 */
/* bench 18717.3.3 342a15e0dda2 */
/* bench 25214.3.0 cc7983d19d4e */
/* bench 25214.3.1 ae99477c5483 */
/* bench 25214.3.2 dabb7aace823 */
/* bench 25214.3.3 7c6ef250ba8c */
/* bench 25214.3.4 16499512d0f2 */
/* bench 25214.3.5 e66903053284 */
/* bench 25214.3.6 f81a0b355070 */
/* bench 25214.3.7 b08ff8154adf */
/* bench 25214.3.8 da893cda8850 */
/* bench 25214.3.9 7010f5ee5f28 */
/* bench 25214.3.10 3735adfdf103 */
 *
 * ALTERNATIVELY, this software may be distributed under the terms of the
 * GNU General Public License ("GPL") as published by the Free Software
 * Foundation, either version 2 of that License or (at your option) any
 * later version.
/* bench 13804.2.0 dc1b497dbcba */
/* bench 15243.1.0 10e989e63199 */
/* bench 15243.1.1 c2681d79a013 */
/* bench 15243.1.2 3f1db8ef509f */
/* bench 15243.1.3 c585ca0448e1 */
/* bench 15243.1.4 2ab6f0df3d73 */
/* bench 15243.1.5 27d6fe559635 */
/* bench 15243.1.6 43bc916b64f6 */
/* bench 15243.1.7 f8c056428fc7 */
/* bench 15243.1.8 6f127fe17ffd */
/* bench 15243.1.9 ac3b93d55493 */
/* bench 15243.1.10 81fa432a7d54 */
/* bench 13804.2.4 8885515da264 */
/* bench 13804.2.5 365696b9a5f7 */
/* bench 13804.2.6 15578ac636ac */
/* bench 13804.2.7 3911223df1c9 */
/* bench 13804.2.8 ec978cad794a */
/* bench 13804.2.9 4d6c1a608b99 */
/* bench 13804.2.10 4beced621fe1 */
/* bench 13804.2.11 792e5595afee */
/* bench 13804.2.12 99d9489ee542 */
/* bench 13804.2.13 1f2f4f58d758 */
/* bench 13804.2.14 d91f7b8c73f8 */
/* bench 13804.2.15 c1b4415c0e89 */
/* bench 13804.2.16 c518e3ee4105 */
 * EXPRESS OR IMPLIED WARRANTIES, INCLUDING, BUT NOT LIMITED TO, THE IMPLIED
 * WARRANTIES OF MERCHANTABILITY AND FITNESS FOR A PARTICULAR PURPOSE ARE
 * DISCLAIMED. IN NO EVENT SHALL Freescale Semiconductor BE LIABLE FOR ANY
 * DIRECT, INDIRECT, INCIDENTAL, SPECIAL, EXEMPLARY, OR CONSEQUENTIAL DAMAGES
 * (INCLUDING, BUT NOT LIMITED TO, PROCUREMENT OF SUBSTITUTE GOODS OR SERVICES;
 * LOSS OF USE, DATA, OR PROFITS; OR BUSINESS INTERRUPTION) HOWEVER CAUSED AND
 * ON ANY THEORY OF LIABILITY, WHETHER IN CONTRACT, STRICT LIABILITY, OR TORT
 * (INCLUDING NEGLIGENCE OR OTHERWISE) ARISING IN ANY WAY OUT OF THE USE OF THIS
 * SOFTWARE, EVEN IF ADVISED OF THE POSSIBILITY OF SUCH DAMAGE.
 */

#include "t1040si-post.dtsi"

/* Place holder for ethernet related device tree nodes */
