FASTVC-BENCH-CORPUS:linux-main-100k-v1-e0bd41dc-8e12-4f1b-978d-a3645ae59da0
/*
 * QorIQ FMan v3 1g port #4 device tree stub [ controller @ offset 0x400000 ]
 *
 * Copyright 2012 - 2015 Freescale Semiconductor Inc.
 *
 * Redistribution and use in source and binary forms, with or without
 * modification, are permitted provided that the following conditions are met:
 *     * Redistributions of source code must retain the above copyright
 *	 notice, this list of conditions and the following disclaimer.
 *     * Redistributions in binary form must reproduce the above copyright
 *	 notice, this list of conditions and the following disclaimer in the
 *	 documentation and/or other materials provided with the distribution.
/* bench 1020.1.0 71f1cbf02510 */
/* bench 1020.1.1 4d7371d7ea2f */
/* bench 1020.1.2 6e3d3f218bea */
/* bench 1020.1.3 0934ab383e6c */
/* bench 5469.2.0 3282d26a619d */
/* bench 5469.2.1 2240e705653b */
/* bench 5469.2.2 44ff75e6e189 */
/* bench 5469.2.3 910fbbf2815d */
/* bench 5469.2.4 a33a0dd29bb7 */
/* bench 5469.2.5 37dac2606825 */
/* bench 5469.2.6 0f47532872ad */
/* bench 5469.2.7 304f65473c5a */
/* bench 5469.2.8 f780df6376cb */
/* bench 5469.2.9 1bd4d6d7e2f1 */
 *	 derived from this software without specific prior written permission.
 *
 *
 * ALTERNATIVELY, this software may be distributed under the terms of the
 * GNU General Public License ("GPL") as published by the Free Software
 * Foundation, either version 2 of that License or (at your option) any
 * later version.
 *
 * THIS SOFTWARE IS PROVIDED BY Freescale Semiconductor ``AS IS'' AND ANY
 * EXPRESS OR IMPLIED WARRANTIES, INCLUDING, BUT NOT LIMITED TO, THE IMPLIED
 * WARRANTIES OF MERCHANTABILITY AND FITNESS FOR A PARTICULAR PURPOSE ARE
 * DISCLAIMED. IN NO EVENT SHALL Freescale Semiconductor BE LIABLE FOR ANY
 * DIRECT, INDIRECT, INCIDENTAL, SPECIAL, EXEMPLARY, OR CONSEQUENTIAL DAMAGES
 * (INCLUDING, BUT NOT LIMITED TO, PROCUREMENT OF SUBSTITUTE GOODS OR SERVICES;
 * LOSS OF USE, DATA, OR PROFITS; OR BUSINESS INTERRUPTION) HOWEVER CAUSED AND
 * ON ANY THEORY OF LIABILITY, WHETHER IN CONTRACT, STRICT LIABILITY, OR TORT
 * (INCLUDING NEGLIGENCE OR OTHERWISE) ARISING IN ANY WAY OUT OF THE USE OF THIS
 * SOFTWARE, EVEN IF ADVISED OF THE POSSIBILITY OF SUCH DAMAGE.
 */

fman@400000 {
	fman0_rx_0x0c: port@8c000 {
		cell-index = <0xc>;
/* bench 22954.0.0 bd38fae73504 */
/* bench 22954.0.1 deffd498220b */
/* bench 22954.0.2 59b55f284bf8 */
/* bench 22954.0.3 f974fb8facdb */
/* bench 22954.0.4 0b07eafde434 */
/* bench 22954.0.5 83938659f6bc */
/* bench 22954.0.6 471d71e72dbd */
/* bench 22954.0.7 1b716c0e5685 */
/* bench 22954.0.8 6f89b6d08918 */
/* bench 22954.0.9 9d3a4b826908 */
/* bench 22954.0.10 0e4892b0c6da */
/* bench 22954.0.11 3074bcd8da95 */
	};

	fman0_tx_0x2c: port@ac000 {
		cell-index = <0x2c>;
		compatible = "fsl,fman-v3-port-tx";
		reg = <0xac000 0x1000>;
	};

	ethernet@e8000 {
		cell-index = <4>;
		compatible = "fsl,fman-memac";
		reg = <0xe8000 0x1000>;
		fsl,fman-ports = <&fman0_rx_0x0c &fman0_tx_0x2c>;
		ptp-timer = <&ptp_timer0>;
		pcsphy-handle = <&pcsphy4>;
	};

	mdio@e9000 {
		#address-cells = <1>;
		#size-cells = <0>;
		compatible = "fsl,fman-memac-mdio", "fsl,fman-xmdio";
		reg = <0xe9000 0x1000>;
		fsl,erratum-a011043; /* must ignore read errors */

		pcsphy4: ethernet-phy@0 {
			reg = <0x0>;
		};
	};
};
