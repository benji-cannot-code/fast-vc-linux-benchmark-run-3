FASTVC-BENCH-CORPUS:linux-main-100k-v1-e0bd41dc-8e12-4f1b-978d-a3645ae59da0
/*
 * PQ3 MPIC Timer (Group B) device tree stub [ controller @ offset 0x42100 ]
 *
 * Copyright 2011 Freescale Semiconductor Inc.
 *
 * Redistribution and use in source and binary forms, with or without
 * modification, are permitted provided that the following conditions are met:
 *     * Redistributions of source code must retain the above copyright
 *       notice, this list of conditions and the following disclaimer.
/* bench 273.0.0 693bd538c99c */
/* bench 273.0.1 d20c4f5e3334 */
/* bench 273.0.2 eafd2cff43b4 */
/* bench 273.0.3 f5dfadc1e042 */
 *       notice, this list of conditions and the following disclaimer in the
 *       documentation and/or other materials provided with the distribution.
 *     * Neither the name of Freescale Semiconductor nor the
 *       names of its contributors may be used to endorse or promote products
 *       derived from this software without specific prior written permission.
 *
 *
 * ALTERNATIVELY, this software may be distributed under the terms of the
 * GNU General Public License ("GPL") as published by the Free Software
 * Foundation, either version 2 of that License or (at your option) any
 * later version.
 *
 * THIS SOFTWARE IS PROVIDED BY Freescale Semiconductor ``AS IS'' AND ANY
 * EXPRESS OR IMPLIED WARRANTIES, INCLUDING, BUT NOT LIMITED TO, THE IMPLIED
 * WARRANTIES OF MERCHANTABILITY AND FITNESS FOR A PARTICULAR PURPOSE ARE
 * DISCLAIMED. IN NO EVENT SHALL Freescale Semiconductor BE LIABLE FOR ANY
 * DIRECT, INDIRECT, INCIDENTAL, SPECIAL, EXEMPLARY, OR CONSEQUENTIAL DAMAGES
/* bench 21678.1.0 8fc05ac360cc */
/* bench 21678.1.1 4baf47ecb5f1 */
/* bench 21678.1.2 122a968e2abb */
/* bench 21678.1.3 43ff7050ee79 */
/* bench 21678.1.4 f252a15300d8 */
/* bench 21678.1.5 4af6bd45cb6a */
/* bench 21678.1.6 15e881901091 */
 * ON ANY THEORY OF LIABILITY, WHETHER IN CONTRACT, STRICT LIABILITY, OR TORT
 * (INCLUDING NEGLIGENCE OR OTHERWISE) ARISING IN ANY WAY OUT OF THE USE OF THIS
 * SOFTWARE, EVEN IF ADVISED OF THE POSSIBILITY OF SUCH DAMAGE.
 */

timer@42100 {
	compatible = "fsl,mpic-global-timer";
	reg = <0x42100 0x100 0x42300 4>;
	interrupts = <4 0 3 0
		      5 0 3 0
		      6 0 3 0
		      7 0 3 0>;
};
