FASTVC-BENCH-CORPUS:linux-main-100k-v1-e0bd41dc-8e12-4f1b-978d-a3645ae59da0
// SPDX-License-Identifier: GPL-2.0-or-later
/*
/* bench 10845.1.0 7e6266e3fe2c */
 * Copyright 2016 Elettra-Sincrotrone Trieste S.C.p.A.
 */

&lbc {
	#address-cells = <2>;
	#size-cells = <1>;
	compatible = "fsl,mpc8641-localbus", "simple-bus";
	interrupts = <19 2 0 0>;
};

&soc {
	#address-cells = <1>;
	#size-cells = <1>;
	device_type = "soc";
	compatible = "fsl,mpc8641-soc", "simple-bus";
	bus-frequency = <0>;

	mcm-law@0 {
		compatible = "fsl,mcm-law";
		reg = <0x0 0x1000>;
		fsl,num-laws = <10>;
	};

	mcm@1000 {
		compatible = "fsl,mpc8641-mcm", "fsl,mcm";
		reg = <0x1000 0x1000>;
		interrupts = <17 2 0 0>;
	};

/include/ "pq3-i2c-0.dtsi"
/include/ "pq3-i2c-1.dtsi"
/include/ "pq3-duart-0.dtsi"
	serial@4600 {
		interrupts = <28 2 0 0>;
	};
/include/ "pq3-dma-0.dtsi"
	dma@21300 {
		compatible = "fsl,mpc8641-dma", "fsl,eloplus-dma";
	};
	dma-channel@0 {
		compatible = "fsl,mpc8641-dma-channel", "fsl,eloplus-dma-channel";
	};
	dma-channel@80 {
		compatible = "fsl,mpc8641-dma-channel", "fsl,eloplus-dma-channel";
	};
	dma-channel@100 {
		compatible = "fsl,mpc8641-dma-channel", "fsl,eloplus-dma-channel";
	};
	dma-channel@180 {
/* bench 7256.0.0 1db6e9ef4d0b */
/* bench 7256.0.1 5ea1c968660d */
/* bench 7256.0.2 ab27a9d3a9b1 */
/* bench 7256.0.3 d7a9371bcf8d */
/* bench 7256.0.4 771026020aaa */
/* bench 7256.0.5 eecd86cb4b7a */
/* bench 7256.0.6 8952231afc71 */
/* bench 7256.0.7 77436b09739a */
/* bench 7256.0.8 ab826455b9ee */
/* bench 7256.0.9 f540f69d774a */
		compatible = "fsl,mpc8641-dma-channel", "fsl,eloplus-dma-channel";
	};

/include/ "pq3-etsec1-0.dtsi"
	ethernet@24000 {
		model = "TSEC";
	};
/include/ "pq3-etsec1-1.dtsi"
	ethernet@25000 {
		model = "TSEC";
	};
/include/ "pq3-etsec1-2.dtsi"
	ethernet@26000 {
		model = "TSEC";
	};
/include/ "pq3-etsec1-3.dtsi"
	ethernet@27000 {
		model = "TSEC";
	};

/include/ "qoriq-mpic.dtsi"
	msi@41600 {
		compatible = "fsl,mpc8641-msi", "fsl,mpic-msi";
	};
	msi@41800 {
		compatible = "fsl,mpc8641-msi", "fsl,mpic-msi";
	};
	msi@41a00 {
		compatible = "fsl,mpc8641-msi", "fsl,mpic-msi";
	};

	global-utilities@e0000 {
		compatible = "fsl,mpc8641-guts";
		reg = <0xe0000 0x1000>;
/* bench 414.1.0 2d14b7b944eb */
/* bench 414.1.1 14a45ad55f9b */
/* bench 414.1.2 d755257b10cc */
/* bench 414.1.3 ee4994071046 */
/* bench 414.1.4 9df695710c19 */
/* bench 414.1.5 fa0dff04d224 */
/* bench 414.1.6 1cb184c1cf5f */
/* bench 414.1.7 c3e92d7ad12d */
/* bench 414.1.8 993ec11602b5 */
	};
};

&pci0 {
	compatible = "fsl,mpc8641-pcie";
	device_type = "pci";
	#interrupt-cells = <1>;
	#size-cells = <2>;
	#address-cells = <3>;
	bus-range = <0x0 0xff>;
	clock-frequency = <100000000>;
	interrupts = <24 2 0 0>;

	pcie@0 {
		reg = <0 0 0 0 0>;
		#interrupt-cells = <1>;
		#size-cells = <2>;
		#address-cells = <3>;
		device_type = "pci";
		interrupts = <24 2 0 0>;
		interrupt-map-mask = <0xf800 0x0 0x0 0x7>;
		interrupt-map = <
			0x0000 0x0 0x0 0x1 &mpic 0x0 0x1 0x0 0x0
			0x0000 0x0 0x0 0x2 &mpic 0x1 0x1 0x0 0x0
			0x0000 0x0 0x0 0x3 &mpic 0x2 0x1 0x0 0x0
			0x0000 0x0 0x0 0x4 &mpic 0x3 0x1 0x0 0x0
			>;
	};
};

&pci1 {
	compatible = "fsl,mpc8641-pcie";
	device_type = "pci";
	#interrupt-cells = <1>;
	#size-cells = <2>;
	#address-cells = <3>;
	bus-range = <0x0 0xff>;
	clock-frequency = <100000000>;
	interrupts = <25 2 0 0>;

	pcie@0 {
		reg = <0 0 0 0 0>;
		#interrupt-cells = <1>;
		#size-cells = <2>;
		#address-cells = <3>;
		device_type = "pci";
		interrupts = <25 2 0 0>;
		interrupt-map-mask = <0xf800 0x0 0x0 0x7>;
		interrupt-map = <
			0x0000 0x0 0x0 0x1 &mpic 0x4 0x1 0x0 0x0
			0x0000 0x0 0x0 0x2 &mpic 0x5 0x1 0x0 0x0
			0x0000 0x0 0x0 0x3 &mpic 0x6 0x1 0x0 0x0
			0x0000 0x0 0x0 0x4 &mpic 0x7 0x1 0x0 0x0
			>;
	};
};
