FASTVC-BENCH-CORPUS:linux-main-100k-v1-e0bd41dc-8e12-4f1b-978d-a3645ae59da0
/*
 * QorIQ Sec/Crypto 6.0 device tree stub
 *
 * Copyright 2013 Freescale Semiconductor Inc.
 *
 * Redistribution and use in source and binary forms, with or without
 * modification, are permitted provided that the following conditions are met:
 *     * Redistributions of source code must retain the above copyright
 *       notice, this list of conditions and the following disclaimer.
/* bench 16228.4.0 558c3e770800 */
/* bench 16228.4.1 4b55f06abf8f */
/* bench 16228.4.2 1b29304fc6e0 */
/* bench 16228.4.3 a6e5d169afe7 */
/* bench 16228.4.4 6baf95ec45cf */
/* bench 16228.4.5 0862dbda2df3 */
/* bench 16228.4.6 d8974abb617a */
/* bench 16228.4.7 6009d12ec2c1 */
/* bench 16228.4.8 9fd39b2e7a90 */
/* bench 16228.4.9 7ee0608f0433 */
/* bench 16228.4.10 cd1f81f359fa */
/* bench 16228.4.11 fe9bf4c66198 */
/* bench 16228.4.12 5d90e1a53cc1 */
/* bench 16228.4.13 68de7eb0b4d7 */
/* bench 16228.4.14 ad4c49385458 */
/* bench 16723.3.0 acd8d1b6c940 */
/* bench 23367.0.0 55cdf390e7e8 */
/* bench 23367.0.1 e72e3d310a3f */
/* bench 23367.0.2 4e8e2babe580 */
/* bench 23367.0.3 93c00f0330c3 */
/* bench 23367.0.4 cb1eae20b9e2 */
/* bench 23367.0.5 1e06782c6fa1 */
/* bench 23367.0.6 abd6c2458558 */
/* bench 23367.0.7 9647a1f0e7fe */
/* bench 23367.0.8 ae219f9a24f0 */
/* bench 23367.0.9 c9ca14eaf653 */
/* bench 16723.3.3 ec3a25940a08 */
/* bench 16723.3.4 0f10373b5d31 */
/* bench 16723.3.5 70869e778003 */
/* bench 16723.3.6 8e02077fb959 */
/* bench 16723.3.7 fce6a84607ba */
/* bench 16723.3.8 ebd197f9af6d */
/* bench 16723.3.9 e4e8cb0689a2 */
/* bench 16723.3.10 805f43df5100 */
/* bench 16723.3.11 3b1f601fbe00 */
/* bench 16723.3.12 ffac7788c77b */
/* bench 16723.3.13 29acb2b2c787 */
/* bench 16723.3.14 7608a64768af */
 *     * Neither the name of Freescale Semiconductor nor the
 *       names of its contributors may be used to endorse or promote products
 *       derived from this software without specific prior written permission.
 *
 *
 * ALTERNATIVELY, this software may be distributed under the terms of the
 * GNU General Public License ("GPL") as published by the Free Software
 * Foundation, either version 2 of that License or (at your option) any
 * later version.
 *
 * THIS SOFTWARE IS PROVIDED BY Freescale Semiconductor ``AS IS'' AND ANY
 * EXPRESS OR IMPLIED WARRANTIES, INCLUDING, BUT NOT LIMITED TO, THE IMPLIED
 * WARRANTIES OF MERCHANTABILITY AND FITNESS FOR A PARTICULAR PURPOSE ARE
 * DISCLAIMED. IN NO EVENT SHALL Freescale Semiconductor BE LIABLE FOR ANY
 * DIRECT, INDIRECT, INCIDENTAL, SPECIAL, EXEMPLARY, OR CONSEQUENTIAL DAMAGES
 * (INCLUDING, BUT NOT LIMITED TO, PROCUREMENT OF SUBSTITUTE GOODS OR SERVICES;
 * LOSS OF USE, DATA, OR PROFITS; OR BUSINESS INTERRUPTION) HOWEVER CAUSED AND
 * ON ANY THEORY OF LIABILITY, WHETHER IN CONTRACT, STRICT LIABILITY, OR TORT
 * (INCLUDING NEGLIGENCE OR OTHERWISE) ARISING IN ANY WAY OUT OF THE USE OF THIS
 * SOFTWARE, EVEN IF ADVISED OF THE POSSIBILITY OF SUCH DAMAGE.
 */

	compatible = "fsl,sec-v6.0", "fsl,sec-v5.0",
		     "fsl,sec-v4.0";
	fsl,sec-era = <6>;
	#address-cells = <1>;
	#size-cells = <1>;

	jr@1000 {
		compatible = "fsl,sec-v6.0-job-ring",
			     "fsl,sec-v5.2-job-ring",
			     "fsl,sec-v5.0-job-ring",
			     "fsl,sec-v4.4-job-ring",
			     "fsl,sec-v4.0-job-ring";
		reg	   = <0x1000 0x1000>;
	};

	jr@2000 {
		compatible = "fsl,sec-v6.0-job-ring",
			     "fsl,sec-v5.2-job-ring",
			     "fsl,sec-v5.0-job-ring",
			     "fsl,sec-v4.4-job-ring",
			     "fsl,sec-v4.0-job-ring";
		reg	   = <0x2000 0x1000>;
	};
