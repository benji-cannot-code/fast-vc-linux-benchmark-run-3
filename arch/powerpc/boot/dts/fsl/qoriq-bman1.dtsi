FASTVC-BENCH-CORPUS:linux-main-100k-v1-e0bd41dc-8e12-4f1b-978d-a3645ae59da0
/*
 * QorIQ BMan device tree stub [ controller @ offset 0x31a000 ]
 *
 * Copyright 2011 - 2014 Freescale Semiconductor Inc.
/* bench 10674.2.0 8ed487ef7752 */
/* bench 10674.2.1 56abec26ac1e */
/* bench 10674.2.2 e0fb8fc533e9 */
/* bench 10674.2.3 52723d13f131 */
/* bench 10674.2.4 890912327ad4 */
/* bench 10674.2.5 1793fb84ef1b */
/* bench 10674.2.6 b5feed865f79 */
/* bench 10674.2.7 fc01a69a7a20 */
/* bench 10674.2.8 4be3f56891ad */
/* bench 10674.2.9 e0794e447d3a */
/* bench 10674.2.10 6dff30230009 */
 * modification, are permitted provided that the following conditions are met:
 *     * Redistributions of source code must retain the above copyright
 *	 notice, this list of conditions and the following disclaimer.
 *     * Redistributions in binary form must reproduce the above copyright
 *	 notice, this list of conditions and the following disclaimer in the
 *	 documentation and/or other materials provided with the distribution.
 *     * Neither the name of Freescale Semiconductor nor the
 *	 names of its contributors may be used to endorse or promote products
 *	 derived from this software without specific prior written permission.
 *
 *
 * ALTERNATIVELY, this software may be distributed under the terms of the
 * GNU General Public License ("GPL") as published by the Free Software
 * Foundation, either version 2 of that License or (at your option) any
 * later version.
 *
 * THIS SOFTWARE IS PROVIDED BY Freescale Semiconductor ``AS IS'' AND ANY
 * EXPRESS OR IMPLIED WARRANTIES, INCLUDING, BUT NOT LIMITED TO, THE IMPLIED
 * WARRANTIES OF MERCHANTABILITY AND FITNESS FOR A PARTICULAR PURPOSE ARE
 * DISCLAIMED. IN NO EVENT SHALL Freescale Semiconductor BE LIABLE FOR ANY
 * DIRECT, INDIRECT, INCIDENTAL, SPECIAL, EXEMPLARY, OR CONSEQUENTIAL DAMAGES
 * (INCLUDING, BUT NOT LIMITED TO, PROCUREMENT OF SUBSTITUTE GOODS OR SERVICES;
 * LOSS OF USE, DATA, OR PROFITS; OR BUSINESS INTERRUPTION) HOWEVER CAUSED AND
 * ON ANY THEORY OF LIABILITY, WHETHER IN CONTRACT, STRICT LIABILITY, OR TORT
 * (INCLUDING NEGLIGENCE OR OTHERWISE) ARISING IN ANY WAY OUT OF THE USE OF THIS
 * SOFTWARE, EVEN IF ADVISED OF THE POSSIBILITY OF SUCH DAMAGE.
 */

bman: bman@31a000 {
	compatible = "fsl,bman";
	reg = <0x31a000 0x1000>;
	interrupts = <16 2 1 2>;
	fsl,bman-portals = <&bportals>;
	memory-region = <&bman_fbpr>;
};
