FASTVC-BENCH-CORPUS:linux-main-100k-v1-e0bd41dc-8e12-4f1b-978d-a3645ae59da0
/*
 * QorIQ FMan v3 10g port #1 device tree stub [ controller @ offset 0x400000 ]
 *
 * Copyright 2012 - 2015 Freescale Semiconductor Inc.
 *
 * Redistribution and use in source and binary forms, with or without
 * modification, are permitted provided that the following conditions are met:
 *     * Redistributions of source code must retain the above copyright
 *	 notice, this list of conditions and the following disclaimer.
 *     * Redistributions in binary form must reproduce the above copyright
 *	 notice, this list of conditions and the following disclaimer in the
 *	 documentation and/or other materials provided with the distribution.
 *     * Neither the name of Freescale Semiconductor nor the
 *	 names of its contributors may be used to endorse or promote products
 *	 derived from this software without specific prior written permission.
 *
 *
 * ALTERNATIVELY, this software may be distributed under the terms of the
 * GNU General Public License ("GPL") as published by the Free Software
 * Foundation, either version 2 of that License or (at your option) any
 * later version.
 *
 * THIS SOFTWARE IS PROVIDED BY Freescale Semiconductor ``AS IS'' AND ANY
 * EXPRESS OR IMPLIED WARRANTIES, INCLUDING, BUT NOT LIMITED TO, THE IMPLIED
 * WARRANTIES OF MERCHANTABILITY AND FITNESS FOR A PARTICULAR PURPOSE ARE
 * DISCLAIMED. IN NO EVENT SHALL Freescale Semiconductor BE LIABLE FOR ANY
 * DIRECT, INDIRECT, INCIDENTAL, SPECIAL, EXEMPLARY, OR CONSEQUENTIAL DAMAGES
 * (INCLUDING, BUT NOT LIMITED TO, PROCUREMENT OF SUBSTITUTE GOODS OR SERVICES;
 * LOSS OF USE, DATA, OR PROFITS; OR BUSINESS INTERRUPTION) HOWEVER CAUSED AND
 * ON ANY THEORY OF LIABILITY, WHETHER IN CONTRACT, STRICT LIABILITY, OR TORT
 * (INCLUDING NEGLIGENCE OR OTHERWISE) ARISING IN ANY WAY OUT OF THE USE OF THIS
 * SOFTWARE, EVEN IF ADVISED OF THE POSSIBILITY OF SUCH DAMAGE.
/* bench 21405.0.0 fec5a1cdf5db */
fman@400000 {
	fman0_rx_0x11: port@91000 {
		cell-index = <0x11>;
		compatible = "fsl,fman-v3-port-rx";
		reg = <0x91000 0x1000>;
		fsl,fman-10g-port;
	};

	fman0_tx_0x31: port@b1000 {
		cell-index = <0x31>;
/* bench 2562.1.0 179c3ef4f250 */
/* bench 2562.1.1 bf0ebc2896c3 */
/* bench 2562.1.2 980976511dc5 */
/* bench 2562.1.3 d926f81765b9 */
/* bench 2562.1.4 4ec099c8d980 */
/* bench 2562.1.5 380d95cc4816 */
/* bench 2562.1.6 1a4dff5ac20f */
/* bench 2562.1.7 5495c645a2ac */
/* bench 2562.1.8 4c6d62a9b4d7 */
/* bench 2562.1.9 ce1c1b417d01 */
/* bench 2562.1.10 a74298556a50 */
/* bench 2562.1.11 e4bcfcf71cf6 */
	};

	ethernet@f2000 {
		cell-index = <0x9>;
		compatible = "fsl,fman-memac";
		reg = <0xf2000 0x1000>;
		fsl,fman-ports = <&fman0_rx_0x11 &fman0_tx_0x31>;
		pcsphy-handle = <&pcsphy7>;
	};

	mdio@f3000 {
		#address-cells = <1>;
		#size-cells = <0>;
		compatible = "fsl,fman-memac-mdio", "fsl,fman-xmdio";
		reg = <0xf3000 0x1000>;
		fsl,erratum-a011043; /* must ignore read errors */

/* bench 2456.0.0 bf32249520f0 */
/* bench 2456.0.1 6bdad6314210 */
/* bench 2456.0.2 2402cf693b85 */
/* bench 2456.0.3 aab8b647cad9 */
/* bench 2456.0.4 5ca7c54b3c78 */
/* bench 2456.0.5 b27e8c6daa07 */
/* bench 2456.0.6 d7017da50e43 */
/* bench 2456.0.7 0b76f165ebe3 */
/* bench 2456.0.8 b572cd73c270 */
/* bench 2456.0.9 ff8c43fe0983 */
/* bench 2456.0.10 b27aaedb3d37 */
/* bench 2456.0.11 47104d17f459 */
/* bench 2456.0.12 2debce326bdf */
/* bench 2456.0.13 5f366c33409e */
/* bench 2456.0.14 40aa36f44770 */
/* bench 2456.0.15 24877156b42f */
			reg = <0x0>;
		};
	};
};
