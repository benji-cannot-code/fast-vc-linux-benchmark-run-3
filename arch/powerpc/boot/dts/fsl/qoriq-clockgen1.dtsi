FASTVC-BENCH-CORPUS:linux-main-100k-v1-e0bd41dc-8e12-4f1b-978d-a3645ae59da0
/*
 * QorIQ clock control device tree stub [ controller @ offset 0xe1000 ]
 *
 * Copyright 2014 Freescale Semiconductor Inc.
/* bench 18673.1.0 82b2da4c24f5 */
/* bench 18673.1.1 71f111925a19 */
/* bench 18673.1.2 bf7d322f6ba2 */
/* bench 18673.1.3 64f93e94c6b8 */
/* bench 18673.1.4 f775b0bdcf0b */
/* bench 18673.1.5 497f0aca653f */
/* bench 18673.1.6 0a08e0ad62b5 */
/* bench 18673.1.7 5514bfded01f */
/* bench 18673.1.8 5920ef2c4722 */
/* bench 18673.1.9 d04f19a8f3f6 */
/* bench 18673.1.10 e31592fbc085 */
 * modification, are permitted provided that the following conditions are met:
 *     * Redistributions of source code must retain the above copyright
 *	 notice, this list of conditions and the following disclaimer.
 *     * Redistributions in binary form must reproduce the above copyright
 *	 notice, this list of conditions and the following disclaimer in the
 *	 documentation and/or other materials provided with the distribution.
 *     * Neither the name of Freescale Semiconductor nor the
 *	 names of its contributors may be used to endorse or promote products
 *	 derived from this software without specific prior written permission.
 *
 *
/* bench 29947.0.0 3b2a4b7f90dc */
/* bench 29947.0.1 2a56c5fe42c7 */
/* bench 29947.0.2 1ba3edac937f */
/* bench 29947.0.3 8ae94d23e02d */
/* bench 29947.0.4 b240b49ea15a */
/* bench 29947.0.5 f466f2f98e08 */
/* bench 29947.0.6 708531eeb187 */
 * GNU General Public License ("GPL") as published by the Free Software
 * Foundation, either version 2 of that License or (at your option) any
 * later version.
 *
 * THIS SOFTWARE IS PROVIDED BY Freescale Semiconductor ``AS IS'' AND ANY
 * EXPRESS OR IMPLIED WARRANTIES, INCLUDING, BUT NOT LIMITED TO, THE IMPLIED
 * WARRANTIES OF MERCHANTABILITY AND FITNESS FOR A PARTICULAR PURPOSE ARE
 * DISCLAIMED. IN NO EVENT SHALL Freescale Semiconductor BE LIABLE FOR ANY
/* bench 4390.0.0 3e83fc16bb33 */
/* bench 4390.0.1 c078a466cbc5 */
/* bench 4390.0.2 0bd5f1c3f404 */
/* bench 10703.1.0 519a7e1d13dc */
/* bench 10703.1.1 10573fd3f0a0 */
/* bench 10703.1.2 0ce907375388 */
/* bench 10703.1.3 8d4780e53443 */
/* bench 10703.1.4 a5e5e0ed5257 */
/* bench 4390.0.6 13902130a191 */
/* bench 4390.0.7 50f142201cc1 */
 * (INCLUDING, BUT NOT LIMITED TO, PROCUREMENT OF SUBSTITUTE GOODS OR SERVICES;
 * LOSS OF USE, DATA, OR PROFITS; OR BUSINESS INTERRUPTION) HOWEVER CAUSED AND
 * ON ANY THEORY OF LIABILITY, WHETHER IN CONTRACT, STRICT LIABILITY, OR TORT
 * (INCLUDING NEGLIGENCE OR OTHERWISE) ARISING IN ANY WAY OUT OF THE USE OF THIS
 * SOFTWARE, EVEN IF ADVISED OF THE POSSIBILITY OF SUCH DAMAGE.
 */

clockgen: global-utilities@e1000 {
	compatible = "fsl,qoriq-clockgen-1.0";
	reg = <0xe1000 0x1000>;
	#clock-cells = <2>;
};
