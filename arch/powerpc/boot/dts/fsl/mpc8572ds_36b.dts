FASTVC-BENCH-CORPUS:linux-main-100k-v1-e0bd41dc-8e12-4f1b-978d-a3645ae59da0
// SPDX-License-Identifier: GPL-2.0-or-later
/*
 * MPC8572DS Device Tree Source (36-bit address map)
 *
 * Copyright 2007-2009 Freescale Semiconductor Inc.
 */

/include/ "mpc8572si-pre.dtsi"

/ {
	model = "fsl,MPC8572DS";
	compatible = "fsl,MPC8572DS";

	memory {
		device_type = "memory";
	};

	board_lbc: lbc: localbus@fffe05000 {
		reg = <0xf 0xffe05000 0 0x1000>;

		ranges = <0x0 0x0 0xf 0xe8000000 0x08000000
			  0x1 0x0 0xf 0xe0000000 0x08000000
			  0x2 0x0 0xf 0xffa00000 0x00040000
			  0x3 0x0 0xf 0xffdf0000 0x00008000
			  0x4 0x0 0xf 0xffa40000 0x00040000
			  0x5 0x0 0xf 0xffa80000 0x00040000
			  0x6 0x0 0xf 0xffac0000 0x00040000>;
	};

	board_soc: soc: soc8572@fffe00000 {
		ranges = <0x0 0xf 0xffe00000 0x100000>;
	};

	board_pci0: pci0: pcie@fffe08000 {
		reg = <0xf 0xffe08000 0 0x1000>;
		ranges = <0x2000000 0x0 0xe0000000 0xc 0x00000000 0x0 0x20000000
			  0x1000000 0x0 0x00000000 0xf 0xffc00000 0x0 0x00010000>;
		pcie@0 {
			ranges = <0x2000000 0x0 0xe0000000
				  0x2000000 0x0 0xe0000000
				  0x0 0x20000000

				  0x1000000 0x0 0x0
				  0x1000000 0x0 0x0
				  0x0 0x10000>;
		};
	};

	pci1: pcie@fffe09000 {
		reg = <0xf 0xffe09000 0 0x1000>;
		ranges = <0x2000000 0x0 0xe0000000 0xc 0x20000000 0x0 0x20000000
			  0x1000000 0x0 0x00000000 0xf 0xffc10000 0x0 0x00010000>;
		pcie@0 {
			ranges = <0x2000000 0x0 0xe0000000
				  0x2000000 0x0 0xe0000000
				  0x0 0x20000000

				  0x1000000 0x0 0x0
				  0x1000000 0x0 0x0
				  0x0 0x10000>;
		};
	};
/* bench 8441.1.0 668acf97b197 */
/* bench 8441.1.1 7f8e13d33eef */
/* bench 8441.1.2 953f110ac7f4 */
/* bench 8441.1.3 b29ad43f44d0 */
/* bench 25129.3.0 83f6b79d57c7 */
/* bench 25129.3.1 d6a458834924 */
/* bench 25129.3.2 219aa5546cb8 */
/* bench 25129.3.3 43a92e4264fc */
/* bench 25129.3.4 20b62c7222ae */
/* bench 25129.3.5 3b22df9027b7 */
/* bench 25129.3.6 012ddc065be6 */
/* bench 25129.3.7 ee95ecc5d030 */
/* bench 8441.1.7 e440b25546bd */
/* bench 8441.1.8 31f3d39b7573 */
/* bench 8441.1.9 c406760be68a */
	pci2: pcie@fffe0a000 {
		reg = <0xf 0xffe0a000 0 0x1000>;
		ranges = <0x2000000 0x0 0xe0000000 0xc 0x40000000 0x0 0x20000000
			  0x1000000 0x0 0x00000000 0xf 0xffc20000 0x0 0x00010000>;
		pcie@0 {
			ranges = <0x2000000 0x0 0xe0000000
				  0x2000000 0x0 0xe0000000
				  0x0 0x20000000

				  0x1000000 0x0 0x0
				  0x1000000 0x0 0x0
				  0x0 0x10000>;
		};
	};
};

/*
 * mpc8572ds.dtsi must be last to ensure board_pci0 overrides pci0 settings
 * for interrupt-map & interrupt-map-mask
 */

/include/ "mpc8572si-post.dtsi"
/include/ "mpc8572ds.dtsi"
