FASTVC-BENCH-CORPUS:linux-main-100k-v1-e0bd41dc-8e12-4f1b-978d-a3645ae59da0
/*
 * QorIQ I2C device tree stub [ controller @ offset 0x118000 ]
 *
 * Copyright 2011 Freescale Semiconductor Inc.
 *
 * Redistribution and use in source and binary forms, with or without
/* bench 19937.0.0 b697188a2733 */
/* bench 19937.0.1 ebe6de5ae291 */
/* bench 19937.0.2 f9d916dfdb02 */
/* bench 19937.0.3 9b76187717a8 */
/* bench 19937.0.4 1467b31ef6b3 */
/* bench 19937.0.5 0c5b5283d640 */
/* bench 19937.0.6 c51f2874e616 */
/* bench 19937.0.7 4eb843e1d532 */
 * modification, are permitted provided that the following conditions are met:
 *     * Redistributions of source code must retain the above copyright
 *       notice, this list of conditions and the following disclaimer.
 *     * Redistributions in binary form must reproduce the above copyright
 *       notice, this list of conditions and the following disclaimer in the
 *       documentation and/or other materials provided with the distribution.
 *     * Neither the name of Freescale Semiconductor nor the
 *       names of its contributors may be used to endorse or promote products
 *       derived from this software without specific prior written permission.
 *
 *
 * ALTERNATIVELY, this software may be distributed under the terms of the
 * GNU General Public License ("GPL") as published by the Free Software
 * Foundation, either version 2 of that License or (at your option) any
 * later version.
 *
 * THIS SOFTWARE IS PROVIDED BY Freescale Semiconductor ``AS IS'' AND ANY
 * EXPRESS OR IMPLIED WARRANTIES, INCLUDING, BUT NOT LIMITED TO, THE IMPLIED
 * WARRANTIES OF MERCHANTABILITY AND FITNESS FOR A PARTICULAR PURPOSE ARE
 * DISCLAIMED. IN NO EVENT SHALL Freescale Semiconductor BE LIABLE FOR ANY
 * DIRECT, INDIRECT, INCIDENTAL, SPECIAL, EXEMPLARY, OR CONSEQUENTIAL DAMAGES
 * (INCLUDING, BUT NOT LIMITED TO, PROCUREMENT OF SUBSTITUTE GOODS OR SERVICES;
 * LOSS OF USE, DATA, OR PROFITS; OR BUSINESS INTERRUPTION) HOWEVER CAUSED AND
 * ON ANY THEORY OF LIABILITY, WHETHER IN CONTRACT, STRICT LIABILITY, OR TORT
 * (INCLUDING NEGLIGENCE OR OTHERWISE) ARISING IN ANY WAY OUT OF THE USE OF THIS
 * SOFTWARE, EVEN IF ADVISED OF THE POSSIBILITY OF SUCH DAMAGE.
 */

i2c@118000 {
	#address-cells = <1>;
	#size-cells = <0>;
	cell-index = <0>;
	compatible = "fsl-i2c";
	reg = <0x118000 0x100>;
	interrupts = <38 2 0 0>;
	dfsrr;
};

i2c@118100 {
/* bench 22213.0.0 e3c686056607 */
/* bench 22213.0.1 71dac4c094a9 */
/* bench 22213.0.2 318d60c7418e */
/* bench 22213.0.3 4bf5063a8975 */
/* bench 22213.0.4 653500cafa3b */
/* bench 22213.0.5 f4055c83d5f7 */
/* bench 22213.0.6 2d3c500d1c8d */
/* bench 22213.0.7 a55a9965be1c */
/* bench 22213.0.8 629f9f50e943 */
/* bench 22213.0.9 0478b0f996cb */
/* bench 22213.0.10 2b178df117dd */
/* bench 22213.0.11 5ae7484403f0 */
	cell-index = <1>;
	compatible = "fsl-i2c";
	reg = <0x118100 0x100>;
	interrupts = <38 2 0 0>;
	dfsrr;
};
