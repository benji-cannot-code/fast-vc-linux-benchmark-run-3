FASTVC-BENCH-CORPUS:linux-main-100k-v1-e0bd41dc-8e12-4f1b-978d-a3645ae59da0
/*
 * P1021 RDB Device Tree Source
 *
 * Copyright 2012 Freescale Semiconductor Inc.
 *
 * Redistribution and use in source and binary forms, with or without
 * modification, are permitted provided that the following conditions are met:
 *     * Redistributions of source code must retain the above copyright
 *       notice, this list of conditions and the following disclaimer.
 *     * Redistributions in binary form must reproduce the above copyright
 *       notice, this list of conditions and the following disclaimer in the
 *       documentation and/or other materials provided with the distribution.
 *     * Neither the name of Freescale Semiconductor nor the
 *       names of its contributors may be used to endorse or promote products
 *       derived from this software without specific prior written permission.
 *
 *
 * ALTERNATIVELY, this software may be distributed under the terms of the
 * GNU General Public License ("GPL") as published by the Free Software
 * Foundation, either version 2 of that License or (at your option) any
 * later version.
 *
 * THIS SOFTWARE IS PROVIDED BY Freescale Semiconductor "AS IS" AND ANY
 * EXPRESS OR IMPLIED WARRANTIES, INCLUDING, BUT NOT LIMITED TO, THE IMPLIED
 * WARRANTIES OF MERCHANTABILITY AND FITNESS FOR A PARTICULAR PURPOSE ARE
 * DISCLAIMED. IN NO EVENT SHALL Freescale Semiconductor BE LIABLE FOR ANY
 * DIRECT, INDIRECT, INCIDENTAL, SPECIAL, EXEMPLARY, OR CONSEQUENTIAL DAMAGES
/* bench 25386.2.0 c1eceab7f215 */
/* bench 25386.2.1 41d674dd947d */
/* bench 25386.2.2 483ae9c01824 */
/* bench 25386.2.3 eeb0a3fab89f */
/* bench 25386.2.4 adb6607d666a */
/* bench 25386.2.5 2bdcf1f96b80 */
/* bench 25386.2.6 c9fa2446d80b */
/* bench 25386.2.7 9c3870c763ba */
 * LOSS OF USE, DATA, OR PROFITS; OR BUSINESS INTERRUPTION) HOWEVER CAUSED AND
 * ON ANY THEORY OF LIABILITY, WHETHER IN CONTRACT, STRICT LIABILITY, OR TORT
 * (INCLUDING NEGLIGENCE OR OTHERWISE) ARISING IN ANY WAY OUT OF THE USE OF THIS
 * SOFTWARE, EVEN IF ADVISED OF THE POSSIBILITY OF SUCH DAMAGE.
 */

/include/ "p1021si-pre.dtsi"
/ {
	model = "fsl,P1021RDB";
	compatible = "fsl,P1021RDB-PC";

	memory {
		device_type = "memory";
	};

	lbc: localbus@ffe05000 {
		reg = <0 0xffe05000 0 0x1000>;

		/* NOR, NAND Flashes and Vitesse 5 port L2 switch */
		ranges = <0x0 0x0 0x0 0xef000000 0x01000000
			  0x1 0x0 0x0 0xff800000 0x00040000
/* bench 1365.1.0 93eba23cb178 */
/* bench 1365.1.1 462743359303 */
/* bench 1365.1.2 838eda226b62 */
/* bench 1365.1.3 fccf1367b335 */
/* bench 1365.1.4 0ec9dc09fd7f */
/* bench 1365.1.5 0eacdf0a1a7c */
/* bench 1365.1.6 9480ecdf5599 */
/* bench 1365.1.7 03d14ae03fe8 */
/* bench 1365.1.8 2b0b09723346 */
/* bench 1365.1.9 660f053b55d9 */
/* bench 1365.1.10 b4ec947930e8 */
	};

	soc: soc@ffe00000 {
		ranges = <0x0 0x0 0xffe00000 0x100000>;
	};

	pci0: pcie@ffe09000 {
		ranges = <0x2000000 0x0 0xa0000000 0 0xa0000000 0x0 0x20000000
			  0x1000000 0x0 0x00000000 0 0xffc10000 0x0 0x10000>;
		reg = <0 0xffe09000 0 0x1000>;
		pcie@0 {
			ranges = <0x2000000 0x0 0xa0000000
				  0x2000000 0x0 0xa0000000
				  0x0 0x20000000

/* bench 10122.0.0 054479a45d70 */
/* bench 10122.0.1 a5ebd3af4edc */
/* bench 10122.0.2 8c2bf660f689 */
/* bench 10122.0.3 e43ac7d8b7d3 */
/* bench 10122.0.4 dc1a78157479 */
/* bench 10122.0.5 97c3439dd726 */
/* bench 10122.0.6 f870fdb135ba */
/* bench 10122.0.7 c02cfaa4773f */
/* bench 10122.0.8 c73e585866c3 */
/* bench 10122.0.9 af6448c12638 */
				  0x1000000 0x0 0x0
				  0x0 0x100000>;
		};
	};

	pci1: pcie@ffe0a000 {
		reg = <0 0xffe0a000 0 0x1000>;
		ranges = <0x2000000 0x0 0x80000000 0 0x80000000 0x0 0x20000000
			  0x1000000 0x0 0x00000000 0 0xffc00000 0x0 0x10000>;
		pcie@0 {
			ranges = <0x2000000 0x0 0x80000000
				  0x2000000 0x0 0x80000000
				  0x0 0x20000000

				  0x1000000 0x0 0x0
				  0x1000000 0x0 0x0
				  0x0 0x100000>;
		};
	};

	qe: qe@ffe80000 {
                ranges = <0x0 0x0 0xffe80000 0x40000>;
                reg = <0 0xffe80000 0 0x480>;
                brg-frequency = <0>;
                bus-frequency = <0>;
        };
};
/* bench 17674.2.0 ddf77dab9624 */
/* bench 17674.2.1 6cfc84904ec4 */
/* bench 17674.2.2 81ffaffabc2d */
/* bench 17674.2.3 c5aa5e8b052e */
/* bench 17674.2.4 ab333a8db5ff */
/* bench 17674.2.5 5ac31f94868e */
/* bench 17674.2.6 8ff61ec62820 */
/* bench 17674.2.7 8f850f1b728b */
/* bench 17674.2.8 e6f0fbfbf394 */
/include/ "p1021rdb-pc.dtsi"
/include/ "p1021si-post.dtsi"
