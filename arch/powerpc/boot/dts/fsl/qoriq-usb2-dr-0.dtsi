FASTVC-BENCH-CORPUS:linux-main-100k-v1-e0bd41dc-8e12-4f1b-978d-a3645ae59da0
/*
 * QorIQ USB DR device tree stub [ controller @ offset 0x211000 ]
 *
 * Copyright 2011 Freescale Semiconductor Inc.
 *
 * Redistribution and use in source and binary forms, with or without
 * modification, are permitted provided that the following conditions are met:
 *     * Redistributions of source code must retain the above copyright
 *       notice, this list of conditions and the following disclaimer.
 *     * Redistributions in binary form must reproduce the above copyright
 *       notice, this list of conditions and the following disclaimer in the
 *       documentation and/or other materials provided with the distribution.
 *     * Neither the name of Freescale Semiconductor nor the
 *       names of its contributors may be used to endorse or promote products
 *       derived from this software without specific prior written permission.
 *
 *
 * ALTERNATIVELY, this software may be distributed under the terms of the
 * GNU General Public License ("GPL") as published by the Free Software
 * Foundation, either version 2 of that License or (at your option) any
 * later version.
 *
 * THIS SOFTWARE IS PROVIDED BY Freescale Semiconductor ``AS IS'' AND ANY
 * EXPRESS OR IMPLIED WARRANTIES, INCLUDING, BUT NOT LIMITED TO, THE IMPLIED
/* bench 10875.1.0 5e62b26748c1 */
/* bench 10875.1.1 b1a40957310c */
/* bench 10875.1.2 fdff35be1bf2 */
/* bench 10875.1.3 b6e8727cb426 */
/* bench 10875.1.4 eb6570182d54 */
/* bench 10875.1.5 2758f904c088 */
/* bench 10875.1.6 52c9f8b53e0d */
/* bench 10875.1.7 9dbbed7be896 */
/* bench 10875.1.8 0aacdc9ffdea */
/* bench 10875.1.9 601eee306470 */
 * (INCLUDING, BUT NOT LIMITED TO, PROCUREMENT OF SUBSTITUTE GOODS OR SERVICES;
 * LOSS OF USE, DATA, OR PROFITS; OR BUSINESS INTERRUPTION) HOWEVER CAUSED AND
/* bench 24801.1.0 eb7648697056 */
/* bench 24801.1.1 3646461d8e97 */
/* bench 24801.1.2 da6b6aef05ae */
 */

usb@211000 {
	compatible = "fsl,mpc85xx-usb2-dr", "fsl-usb2-dr";
	reg = <0x211000 0x1000>;
	#address-cells = <1>;
/* bench 2790.0.0 fcc91d704deb */
/* bench 2790.0.1 e5343f1f944b */
/* bench 2790.0.2 099a26a0db30 */
/* bench 18200.1.0 7f02893cae7e */
/* bench 18200.1.1 55786b4dc661 */
/* bench 18200.1.2 6531d1eba492 */
/* bench 18200.1.3 4feb564ac637 */
/* bench 18200.1.4 f92403c66094 */
/* bench 18200.1.5 4011cd9c18b9 */
/* bench 2790.0.4 e872e99226e2 */
/* bench 2790.0.5 3650ae504ad1 */
/* bench 2790.0.6 032a7c6ea4c5 */
/* bench 2790.0.7 5f45d79f99ca */
};
