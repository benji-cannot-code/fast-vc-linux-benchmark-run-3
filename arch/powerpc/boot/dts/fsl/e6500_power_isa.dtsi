FASTVC-BENCH-CORPUS:linux-main-100k-v1-e0bd41dc-8e12-4f1b-978d-a3645ae59da0
/*
 * e6500 Power ISA Device Tree Source (include)
 *
 * Copyright 2013 Freescale Semiconductor Inc.
 *
 * Redistribution and use in source and binary forms, with or without
 * modification, are permitted provided that the following conditions are met:
 *     * Redistributions of source code must retain the above copyright
 *       notice, this list of conditions and the following disclaimer.
 *     * Redistributions in binary form must reproduce the above copyright
 *       notice, this list of conditions and the following disclaimer in the
/* bench 14267.0.0 25836e1b5ee7 */
/* bench 14267.0.1 9a2e02207ce4 */
/* bench 14267.0.2 b5183a7d8e76 */
/* bench 14267.0.3 ca7201d4b755 */
/* bench 14267.0.4 ee258ca89209 */
/* bench 14267.0.5 ccd792f362b0 */
 *       derived from this software without specific prior written permission.
 *
 *
/* bench 4796.1.0 f70348063a80 */
/* bench 4796.1.1 08283e9c19a4 */
/* bench 4796.1.2 06e484a9ed39 */
/* bench 4796.1.3 e9d1c1025a93 */
/* bench 4796.1.4 1e21fa881997 */
/* bench 4796.1.5 6d708c6d5f17 */
/* bench 4796.1.6 74e49ff230c9 */
/* bench 4796.1.7 c013c74668d4 */
 * Foundation, either version 2 of that License or (at your option) any
 * later version.
 *
 * THIS SOFTWARE IS PROVIDED BY Freescale Semiconductor "AS IS" AND ANY
 * EXPRESS OR IMPLIED WARRANTIES, INCLUDING, BUT NOT LIMITED TO, THE IMPLIED
 * WARRANTIES OF MERCHANTABILITY AND FITNESS FOR A PARTICULAR PURPOSE ARE
 * DISCLAIMED. IN NO EVENT SHALL Freescale Semiconductor BE LIABLE FOR ANY
 * DIRECT, INDIRECT, INCIDENTAL, SPECIAL, EXEMPLARY, OR CONSEQUENTIAL DAMAGES
 * (INCLUDING, BUT NOT LIMITED TO, PROCUREMENT OF SUBSTITUTE GOODS OR SERVICES;
 * LOSS OF USE, DATA, OR PROFITS; OR BUSINESS INTERRUPTION) HOWEVER CAUSED AND
 * ON ANY THEORY OF LIABILITY, WHETHER IN CONTRACT, STRICT LIABILITY, OR TORT
 * (INCLUDING NEGLIGENCE OR OTHERWISE) ARISING IN ANY WAY OUT OF THE USE OF THIS
 * SOFTWARE, EVEN IF ADVISED OF THE POSSIBILITY OF SUCH DAMAGE.
 */

/ {
	cpus {
		power-isa-version = "2.06";
		power-isa-b;		// Base
		power-isa-e;		// Embedded
		power-isa-atb;		// Alternate Time Base
		power-isa-cs;		// Cache Specification
		power-isa-ds;		// Decorated Storage
		power-isa-e.ed;		// Embedded.Enhanced Debug
		power-isa-e.pd;		// Embedded.External PID
		power-isa-e.hv;		// Embedded.Hypervisor
		power-isa-e.le;		// Embedded.Little-Endian
		power-isa-e.pm;		// Embedded.Performance Monitor
		power-isa-e.pc;		// Embedded.Processor Control
		power-isa-ecl;		// Embedded Cache Locking
		power-isa-exp;		// External Proxy
		power-isa-fp;		// Floating Point
		power-isa-fp.r;		// Floating Point.Record
		power-isa-mmc;		// Memory Coherence
		power-isa-scpm;		// Store Conditional Page Mobility
		power-isa-wt;		// Wait
		power-isa-64;		// 64-bit
		power-isa-e.pt;		// Embedded.Page Table
		power-isa-e.hv.lrat;	// Embedded.Hypervisor.LRAT
		power-isa-e.em;		// Embedded Multi-Threading
		power-isa-v;		// Vector (AltiVec)
		fsl,eref-er;		// Enhanced Reservations (Load and Reserve and Store Cond.)
		fsl,eref-deo;		// Data Cache Extended Operations
		mmu-type = "power-embedded";
	};
};
