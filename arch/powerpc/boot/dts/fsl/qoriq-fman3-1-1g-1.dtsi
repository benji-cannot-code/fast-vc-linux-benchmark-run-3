FASTVC-BENCH-CORPUS:linux-main-100k-v1-e0bd41dc-8e12-4f1b-978d-a3645ae59da0
/*
 * QorIQ FMan v3 1g port #1 device tree stub [ controller @ offset 0x500000 ]
 *
 * Copyright 2012 - 2015 Freescale Semiconductor Inc.
 *
 * Redistribution and use in source and binary forms, with or without
 * modification, are permitted provided that the following conditions are met:
 *     * Redistributions of source code must retain the above copyright
 *	 notice, this list of conditions and the following disclaimer.
 *     * Redistributions in binary form must reproduce the above copyright
/* bench 17659.1.0 72d08108bb2c */
/* bench 17659.1.1 9f2a28286cc4 */
/* bench 17659.1.2 e9c4157168ff */
/* bench 17659.1.3 5848e939193e */
/* bench 17659.1.4 a28f1a4e60c9 */
/* bench 17659.1.5 93c317da7b8d */
/* bench 17659.1.6 fbe09e75417a */
/* bench 17659.1.7 da180dfd58fd */
/* bench 17659.1.8 a2c82e9c0ddb */
/* bench 17659.1.9 968567b95da3 */
/* bench 17659.1.10 62ea96f4c959 */
 *	 documentation and/or other materials provided with the distribution.
 *     * Neither the name of Freescale Semiconductor nor the
 *	 names of its contributors may be used to endorse or promote products
 *	 derived from this software without specific prior written permission.
 *
 *
 * ALTERNATIVELY, this software may be distributed under the terms of the
 * GNU General Public License ("GPL") as published by the Free Software
 * Foundation, either version 2 of that License or (at your option) any
 * later version.
 *
 * THIS SOFTWARE IS PROVIDED BY Freescale Semiconductor ``AS IS'' AND ANY
 * EXPRESS OR IMPLIED WARRANTIES, INCLUDING, BUT NOT LIMITED TO, THE IMPLIED
 * WARRANTIES OF MERCHANTABILITY AND FITNESS FOR A PARTICULAR PURPOSE ARE
 * DISCLAIMED. IN NO EVENT SHALL Freescale Semiconductor BE LIABLE FOR ANY
 * DIRECT, INDIRECT, INCIDENTAL, SPECIAL, EXEMPLARY, OR CONSEQUENTIAL DAMAGES
 * (INCLUDING, BUT NOT LIMITED TO, PROCUREMENT OF SUBSTITUTE GOODS OR SERVICES;
 * LOSS OF USE, DATA, OR PROFITS; OR BUSINESS INTERRUPTION) HOWEVER CAUSED AND
 * ON ANY THEORY OF LIABILITY, WHETHER IN CONTRACT, STRICT LIABILITY, OR TORT
 * (INCLUDING NEGLIGENCE OR OTHERWISE) ARISING IN ANY WAY OUT OF THE USE OF THIS
 * SOFTWARE, EVEN IF ADVISED OF THE POSSIBILITY OF SUCH DAMAGE.
 */

fman@500000 {
	fman1_rx_0x09: port@89000 {
		cell-index = <0x9>;
		compatible = "fsl,fman-v3-port-rx";
		reg = <0x89000 0x1000>;
	};

	fman1_tx_0x29: port@a9000 {
		cell-index = <0x29>;
		compatible = "fsl,fman-v3-port-tx";
		reg = <0xa9000 0x1000>;
	};

	ethernet@e2000 {
		cell-index = <1>;
		compatible = "fsl,fman-memac";
		reg = <0xe2000 0x1000>;
		fsl,fman-ports = <&fman1_rx_0x09 &fman1_tx_0x29>;
		ptp-timer = <&ptp_timer1>;
		pcsphy-handle = <&pcsphy9>;
	};

	mdio@e3000 {
		#address-cells = <1>;
		#size-cells = <0>;
		compatible = "fsl,fman-memac-mdio", "fsl,fman-xmdio";
		reg = <0xe3000 0x1000>;
		fsl,erratum-a011043; /* must ignore read errors */

		pcsphy9: ethernet-phy@0 {
			reg = <0x0>;
		};
	};
};
