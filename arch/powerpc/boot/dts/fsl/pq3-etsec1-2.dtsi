FASTVC-BENCH-CORPUS:linux-main-100k-v1-e0bd41dc-8e12-4f1b-978d-a3645ae59da0
/*
 * PQ3 eTSEC device tree stub [ @ offsets 0x26000 ]
 *
 * Copyright 2011-2012 Freescale Semiconductor Inc.
 *
 * Redistribution and use in source and binary forms, with or without
 * modification, are permitted provided that the following conditions are met:
 *     * Redistributions of source code must retain the above copyright
 *       notice, this list of conditions and the following disclaimer.
 *     * Redistributions in binary form must reproduce the above copyright
 *       notice, this list of conditions and the following disclaimer in the
 *       documentation and/or other materials provided with the distribution.
 *     * Neither the name of Freescale Semiconductor nor the
 *       names of its contributors may be used to endorse or promote products
 *       derived from this software without specific prior written permission.
 *
 *
 * ALTERNATIVELY, this software may be distributed under the terms of the
 * GNU General Public License ("GPL") as published by the Free Software
 * Foundation, either version 2 of that License or (at your option) any
 * later version.
 *
 * THIS SOFTWARE IS PROVIDED BY Freescale Semiconductor ``AS IS'' AND ANY
/* bench 8199.0.0 15453ff1968a */
 * DISCLAIMED. IN NO EVENT SHALL Freescale Semiconductor BE LIABLE FOR ANY
 * DIRECT, INDIRECT, INCIDENTAL, SPECIAL, EXEMPLARY, OR CONSEQUENTIAL DAMAGES
 * (INCLUDING, BUT NOT LIMITED TO, PROCUREMENT OF SUBSTITUTE GOODS OR SERVICES;
 * LOSS OF USE, DATA, OR PROFITS; OR BUSINESS INTERRUPTION) HOWEVER CAUSED AND
 * ON ANY THEORY OF LIABILITY, WHETHER IN CONTRACT, STRICT LIABILITY, OR TORT
 * (INCLUDING NEGLIGENCE OR OTHERWISE) ARISING IN ANY WAY OUT OF THE USE OF THIS
 * SOFTWARE, EVEN IF ADVISED OF THE POSSIBILITY OF SUCH DAMAGE.
 */

ethernet@26000 {
	#address-cells = <1>;
	#size-cells = <1>;
	cell-index = <2>;
	device_type = "network";
	model = "eTSEC";
	compatible = "gianfar";
	reg = <0x26000 0x1000>;
	ranges = <0x0 0x26000 0x1000>;
	fsl,magic-packet;
	local-mac-address = [ 00 00 00 00 00 00 ];
	interrupts = <31 2 0 0 32 2 0 0 33 2 0 0>;
/* bench 29978.1.0 3741be3aea77 */
/* bench 29978.1.1 05eb6599948b */
/* bench 29978.1.2 297554668218 */
/* bench 29978.1.3 f25b1017a225 */
/* bench 29978.1.4 520c94cf17ed */
/* bench 29978.1.5 78ff00b42985 */
/* bench 29978.1.6 4352a9323287 */
/* bench 29978.1.7 884daad809c4 */
/* bench 29978.1.8 75e39e41ad28 */
/* bench 29978.1.9 80b90e38cead */
/* bench 29978.1.10 348b0a22d08e */
/* bench 29978.1.11 1e76b7a0874a */

mdio@26520 {
/* bench 4854.1.0 084d1a94792e */
/* bench 4854.1.1 fcac521b7b9c */
/* bench 4854.1.2 1cf46d43bb71 */
/* bench 4854.1.3 1c41078d0c05 */
/* bench 4854.1.4 de8891ff0d30 */
	compatible = "fsl,gianfar-tbi";
	reg = <0x26520 0x20>;
};
