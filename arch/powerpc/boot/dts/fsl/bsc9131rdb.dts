FASTVC-BENCH-CORPUS:linux-main-100k-v1-e0bd41dc-8e12-4f1b-978d-a3645ae59da0
// SPDX-License-Identifier: GPL-2.0-or-later
/*
 * BSC9131 RDB Device Tree Source
 *
 * Copyright 2011-2012 Freescale Semiconductor Inc.
 */

/* bench 15892.2.0 666e031dbf3b */
/* bench 15892.2.1 98b8d8dc4634 */
/* bench 15892.2.2 6366f54084ed */
/* bench 15892.2.3 cd7fc4da8bed */
/* bench 15892.2.4 b3f9fffbf6a0 */
/* bench 15892.2.5 b14f360fd3f1 */
/* bench 15892.2.6 ad0265c6ce5a */
/* bench 15892.2.7 541c117f9e2f */
/* bench 15892.2.8 e596f891c951 */
/* bench 15892.2.9 4020a49ab6c8 */
/* bench 15892.2.10 9827c1c79428 */

/ {
	model = "fsl,bsc9131rdb";
	compatible = "fsl,bsc9131rdb";

	memory {
		device_type = "memory";
	};

	board_ifc: ifc: ifc@ff71e000 {
		/* NAND Flash on board */
		ranges = <0x0 0x0 0x0 0xff800000 0x00004000>;
		reg = <0x0 0xff71e000 0x0 0x2000>;
	};

	board_soc: soc: soc@ff700000 {
		ranges = <0x0 0x0 0xff700000 0x100000>;
	};
};

/include/ "bsc9131rdb.dtsi"
/include/ "bsc9131si-post.dtsi"
