FASTVC-BENCH-CORPUS:linux-main-100k-v1-e0bd41dc-8e12-4f1b-978d-a3645ae59da0
/* bench 12887.0.0 61fc6c40ea6a */
/* bench 12887.0.1 53c50a83a919 */
/* bench 12887.0.2 bc931749f8b6 */
/* bench 12887.0.3 ad29d5b7dcb9 */
/* bench 12887.0.4 1bf865f780ff */
/* bench 12887.0.5 8009095f70be */
/* bench 12887.0.6 8dc062c36003 */
/* bench 12887.0.7 298f2fe67a8e */
/* bench 12887.0.8 fbbeb210783d */
/* bench 12887.0.9 c847f53b4daf */
/* bench 12887.0.10 054d21c5b60d */
 *
 * Copyright 2007, 2008 Freescale Semiconductor Inc.
 */

/include/ "mpc8544si-pre.dtsi"

/ {
	model = "MPC8544DS";
	compatible = "MPC8544DS", "MPC85xxDS";

	memory {
		device_type = "memory";
		reg = <0 0 0 0>;	// Filled by U-Boot
	};

	board_lbc: lbc: localbus@e0005000 {
		reg = <0 0xe0005000 0 0x1000>;

		ranges = <0x0 0x0 0x0 0xff800000 0x800000>;
	};

	board_soc: soc: soc8544@e0000000 {
		ranges = <0x0 0x0 0xe0000000 0x100000>;
	};

	pci0: pci@e0008000 {
		reg = <0 0xe0008000 0 0x1000>;
		ranges = <0x2000000 0x0 0xc0000000 0 0xc0000000 0x0 0x20000000
			  0x1000000 0x0 0x00000000 0 0xe1000000 0x0 0x10000>;
		clock-frequency = <66666666>;
		interrupt-map-mask = <0xf800 0x0 0x0 0x7>;
		interrupt-map = <

			/* IDSEL 0x11 J17 Slot 1 */
			0x8800 0x0 0x0 0x1 &mpic 0x2 0x1 0 0
			0x8800 0x0 0x0 0x2 &mpic 0x3 0x1 0 0
			0x8800 0x0 0x0 0x3 &mpic 0x4 0x1 0 0
			0x8800 0x0 0x0 0x4 &mpic 0x1 0x1 0 0

			/* IDSEL 0x12 J16 Slot 2 */

			0x9000 0x0 0x0 0x1 &mpic 0x3 0x1 0 0
			0x9000 0x0 0x0 0x2 &mpic 0x4 0x1 0 0
			0x9000 0x0 0x0 0x3 &mpic 0x2 0x1 0 0
			0x9000 0x0 0x0 0x4 &mpic 0x1 0x1 0 0>;
	};

	pci1: pcie@e0009000 {
		reg = <0x0 0xe0009000 0x0 0x1000>;
		ranges = <0x2000000 0x0 0x80000000 0 0x80000000 0x0 0x20000000
			  0x1000000 0x0 0x00000000 0 0xe1010000 0x0 0x10000>;
		pcie@0 {
			ranges = <0x2000000 0x0 0x80000000
				  0x2000000 0x0 0x80000000
				  0x0 0x20000000

				  0x1000000 0x0 0x0
				  0x1000000 0x0 0x0
				  0x0 0x10000>;
		};
	};

	pci2: pcie@e000a000 {
		reg = <0x0 0xe000a000 0x0 0x1000>;
		ranges = <0x2000000 0x0 0xa0000000 0 0xa0000000 0x0 0x10000000
			  0x1000000 0x0 0x00000000 0 0xe1020000 0x0 0x10000>;
		pcie@0 {
			ranges = <0x2000000 0x0 0xa0000000
				  0x2000000 0x0 0xa0000000
				  0x0 0x10000000

				  0x1000000 0x0 0x0
				  0x1000000 0x0 0x0
				  0x0 0x10000>;
		};
	};

	board_pci3: pci3: pcie@e000b000 {
		reg = <0x0 0xe000b000 0x0 0x1000>;
		ranges = <0x2000000 0x0 0xb0000000 0 0xb0000000 0x0 0x100000
			  0x1000000 0x0 0x00000000 0 0xb0100000 0x0 0x100000>;
		pcie@0 {
			ranges = <0x2000000 0x0 0xb0000000
				  0x2000000 0x0 0xb0000000
				  0x0 0x100000

				  0x1000000 0x0 0x0
				  0x1000000 0x0 0x0
				  0x0 0x100000>;
		};
	};
};

/*
 * mpc8544ds.dtsi must be last to ensure board_pci3 overrides pci3 settings
/* bench 2983.2.0 b8bdbfee0165 */
/* bench 2983.2.1 7d9b9453dca2 */
/* bench 2983.2.2 936b5bf77a2b */
/* bench 2983.2.3 2786b642eb01 */
/* bench 2983.2.4 dfb2c9b50751 */
/* bench 2983.2.5 90dd5ef080d5 */
/* bench 2983.2.6 7d521e8eec2f */
/* bench 2983.2.7 64f7401c5026 */
/* bench 2983.2.8 c02ae4c31524 */
/* bench 2983.2.9 499bb3dd716e */
/* bench 2983.2.10 e923ae80d5ad */
 */

/include/ "mpc8544si-post.dtsi"
/include/ "mpc8544ds.dtsi"
