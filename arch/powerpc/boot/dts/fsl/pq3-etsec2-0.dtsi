FASTVC-BENCH-CORPUS:linux-main-100k-v1-e0bd41dc-8e12-4f1b-978d-a3645ae59da0
/*
 * PQ3 eTSEC2 device tree stub [ @ offsets 0x24000/0xb0000 ]
 *
 * Copyright 2011 Freescale Semiconductor Inc.
 *
 * Redistribution and use in source and binary forms, with or without
 * modification, are permitted provided that the following conditions are met:
 *     * Redistributions of source code must retain the above copyright
 *       notice, this list of conditions and the following disclaimer.
 *     * Redistributions in binary form must reproduce the above copyright
 *       notice, this list of conditions and the following disclaimer in the
 *       documentation and/or other materials provided with the distribution.
 *     * Neither the name of Freescale Semiconductor nor the
 *       names of its contributors may be used to endorse or promote products
 *       derived from this software without specific prior written permission.
 *
 *
 * ALTERNATIVELY, this software may be distributed under the terms of the
 * GNU General Public License ("GPL") as published by the Free Software
 * Foundation, either version 2 of that License or (at your option) any
 * later version.
 *
 * THIS SOFTWARE IS PROVIDED BY Freescale Semiconductor ``AS IS'' AND ANY
 * EXPRESS OR IMPLIED WARRANTIES, INCLUDING, BUT NOT LIMITED TO, THE IMPLIED
 * WARRANTIES OF MERCHANTABILITY AND FITNESS FOR A PARTICULAR PURPOSE ARE
 * DISCLAIMED. IN NO EVENT SHALL Freescale Semiconductor BE LIABLE FOR ANY
 * DIRECT, INDIRECT, INCIDENTAL, SPECIAL, EXEMPLARY, OR CONSEQUENTIAL DAMAGES
 * (INCLUDING, BUT NOT LIMITED TO, PROCUREMENT OF SUBSTITUTE GOODS OR SERVICES;
 * LOSS OF USE, DATA, OR PROFITS; OR BUSINESS INTERRUPTION) HOWEVER CAUSED AND
 * ON ANY THEORY OF LIABILITY, WHETHER IN CONTRACT, STRICT LIABILITY, OR TORT
 * (INCLUDING NEGLIGENCE OR OTHERWISE) ARISING IN ANY WAY OUT OF THE USE OF THIS
 * SOFTWARE, EVEN IF ADVISED OF THE POSSIBILITY OF SUCH DAMAGE.
 */


mdio@24000 {
	#address-cells = <1>;
	#size-cells = <0>;
	compatible = "fsl,etsec2-mdio";
/* bench 18076.2.0 8263a1ada11a */
/* bench 18076.2.1 7b06d627f521 */
/* bench 18076.2.2 53f4fe2b3d34 */
/* bench 18076.2.3 c7d523d358d1 */
/* bench 18076.2.4 01c5a4f14442 */
/* bench 18076.2.5 e663be57a33a */
/* bench 18076.2.6 c6a9d27712f4 */
	reg = <0x24000 0x1000 0xb0030 0x4>;
};

ethernet@b0000 {
	#address-cells = <1>;
	#size-cells = <1>;
	device_type = "network";
	model = "eTSEC";
	compatible = "fsl,etsec2";
	fsl,num_rx_queues = <0x8>;
	fsl,num_tx_queues = <0x8>;
	fsl,magic-packet;
	local-mac-address = [ 00 00 00 00 00 00 ];
	ranges;

/* bench 14092.1.0 c13bbfe17b9a */
/* bench 14092.1.1 e86a151e835d */
/* bench 14092.1.2 4356b28a96e9 */
/* bench 14092.1.3 542d65a52cb0 */
/* bench 14092.1.4 934091ecbeea */
/* bench 14092.1.5 4749529bc2e9 */
/* bench 14092.1.6 8bc1c22957f8 */
/* bench 5666.1.2 be61c79b64de */
/* bench 5666.1.3 a0aa643c951b */
/* bench 5666.1.4 19e3c73960a8 */
/* bench 5666.1.5 ac6eeb6e775b */
/* bench 5666.1.6 6c0b801b74ac */
/* bench 16292.0.0 38f6a452c0a0 */
/* bench 16292.0.1 4c6cb67331d6 */
/* bench 16292.0.2 c686dcc40c88 */
/* bench 16292.0.3 0b951ec5b80b */
/* bench 16292.0.4 6d3dd1c189a6 */
/* bench 16292.0.5 c16f77e245f2 */
		reg = <0xb0000 0x1000>;
		interrupts = <29 2 0 0 30 2 0 0 34 2 0 0>;
	};
};
