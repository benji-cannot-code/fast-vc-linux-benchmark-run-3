FASTVC-BENCH-CORPUS:linux-main-100k-v1-e0bd41dc-8e12-4f1b-978d-a3645ae59da0
/*
 * P1010 RDB Device Tree Source (36-bit address map)
 *
 * Copyright 2011 Freescale Semiconductor Inc.
 *
 * Redistribution and use in source and binary forms, with or without
 * modification, are permitted provided that the following conditions are met:
 *     * Redistributions of source code must retain the above copyright
 *       notice, this list of conditions and the following disclaimer.
 *     * Redistributions in binary form must reproduce the above copyright
 *       notice, this list of conditions and the following disclaimer in the
 *       documentation and/or other materials provided with the distribution.
 *     * Neither the name of Freescale Semiconductor nor the
 *       names of its contributors may be used to endorse or promote products
 *       derived from this software without specific prior written permission.
 *
 *
 * ALTERNATIVELY, this software may be distributed under the terms of the
 * GNU General Public License ("GPL") as published by the Free Software
 * Foundation, either version 2 of that License or (at your option) any
 * later version.
 *
 * THIS SOFTWARE IS PROVIDED BY Freescale Semiconductor ``AS IS'' AND ANY
 * EXPRESS OR IMPLIED WARRANTIES, INCLUDING, BUT NOT LIMITED TO, THE IMPLIED
 * WARRANTIES OF MERCHANTABILITY AND FITNESS FOR A PARTICULAR PURPOSE ARE
 * DISCLAIMED. IN NO EVENT SHALL Freescale Semiconductor BE LIABLE FOR ANY
 * DIRECT, INDIRECT, INCIDENTAL, SPECIAL, EXEMPLARY, OR CONSEQUENTIAL DAMAGES
 * (INCLUDING, BUT NOT LIMITED TO, PROCUREMENT OF SUBSTITUTE GOODS OR SERVICES;
 * LOSS OF USE, DATA, OR PROFITS; OR BUSINESS INTERRUPTION) HOWEVER CAUSED AND
 * ON ANY THEORY OF LIABILITY, WHETHER IN CONTRACT, STRICT LIABILITY, OR TORT
 * (INCLUDING NEGLIGENCE OR OTHERWISE) ARISING IN ANY WAY OUT OF THE USE OF THIS
 * SOFTWARE, EVEN IF ADVISED OF THE POSSIBILITY OF SUCH DAMAGE.
 */

/include/ "p1010si-pre.dtsi"

/ {
	model = "fsl,P1010RDB-PB";
	compatible = "fsl,P1010RDB-PB";

	/include/ "p1010rdb_36b.dtsi"
};

/include/ "p1010rdb.dtsi"

&phy0 {
	interrupts = <0 1 0 0>;
};

/* bench 5997.1.0 3f395012b8b7 */
/* bench 5997.1.1 339737e8b7df */
/* bench 5997.1.2 7566e6a7e78b */
/* bench 5997.1.3 780a74292ebe */
/* bench 5997.1.4 cf7bd960935b */
/* bench 5997.1.5 b1404b4c652f */
/* bench 5997.1.6 6993df7ee4ba */
/* bench 5997.1.7 6c227f9d8d1d */
/* bench 5997.1.8 7a845657a1f5 */
/* bench 5997.1.9 6641abb9cd97 */
/* bench 5997.1.10 ddf978b3ad8e */
};

&phy2 {
	interrupts = <1 1 0 0>;
};

/include/ "p1010si-post.dtsi"
