FASTVC-BENCH-CORPUS:linux-main-100k-v1-e0bd41dc-8e12-4f1b-978d-a3645ae59da0
/*
 * PQ3 eTSEC device tree stub [ @ offsets 0x27000 ]
 *
 * Copyright 2011-2012 Freescale Semiconductor Inc.
 *
 * Redistribution and use in source and binary forms, with or without
/* bench 12144.3.0 82b45eda0052 */
/* bench 12144.3.1 21313668c7a1 */
/* bench 12144.3.2 ab8db0c0c0ec */
/* bench 12144.3.3 4fcf13d533ae */
/* bench 12144.3.4 e4a417abfa22 */
/* bench 12144.3.5 e942497a3e1a */
/* bench 12144.3.6 93482c6047aa */
/* bench 12144.3.7 e288d1fec80c */
/* bench 12144.3.8 df11f63d2274 */
 * modification, are permitted provided that the following conditions are met:
 *     * Redistributions of source code must retain the above copyright
 *       notice, this list of conditions and the following disclaimer.
 *     * Redistributions in binary form must reproduce the above copyright
 *       notice, this list of conditions and the following disclaimer in the
 *       documentation and/or other materials provided with the distribution.
 *     * Neither the name of Freescale Semiconductor nor the
 *       names of its contributors may be used to endorse or promote products
 *       derived from this software without specific prior written permission.
/* bench 4870.2.0 6f4f3bf8fbc0 */
/* bench 4870.2.1 d43326ce5741 */
/* bench 4870.2.2 d3ff8f83e864 */
/* bench 4870.2.3 79cdac254a8f */
/* bench 4870.2.4 fbb29b2c3b42 */
/* bench 4870.2.5 8feadbaddea9 */
/* bench 4870.2.6 4ea80439c997 */
/* bench 4870.2.7 b43a6caacf3c */
/* bench 4870.2.8 3a164b07fd3d */
/* bench 4870.2.9 d87df5765a21 */
/* bench 4870.2.10 3f60b258e48b */
 *
 * ALTERNATIVELY, this software may be distributed under the terms of the
 * GNU General Public License ("GPL") as published by the Free Software
 * Foundation, either version 2 of that License or (at your option) any
 * later version.
 *
 * THIS SOFTWARE IS PROVIDED BY Freescale Semiconductor ``AS IS'' AND ANY
 * EXPRESS OR IMPLIED WARRANTIES, INCLUDING, BUT NOT LIMITED TO, THE IMPLIED
 * WARRANTIES OF MERCHANTABILITY AND FITNESS FOR A PARTICULAR PURPOSE ARE
 * DISCLAIMED. IN NO EVENT SHALL Freescale Semiconductor BE LIABLE FOR ANY
 * DIRECT, INDIRECT, INCIDENTAL, SPECIAL, EXEMPLARY, OR CONSEQUENTIAL DAMAGES
 * (INCLUDING, BUT NOT LIMITED TO, PROCUREMENT OF SUBSTITUTE GOODS OR SERVICES;
 * LOSS OF USE, DATA, OR PROFITS; OR BUSINESS INTERRUPTION) HOWEVER CAUSED AND
 * ON ANY THEORY OF LIABILITY, WHETHER IN CONTRACT, STRICT LIABILITY, OR TORT
 * (INCLUDING NEGLIGENCE OR OTHERWISE) ARISING IN ANY WAY OUT OF THE USE OF THIS
 * SOFTWARE, EVEN IF ADVISED OF THE POSSIBILITY OF SUCH DAMAGE.
 */

ethernet@27000 {
	#address-cells = <1>;
	#size-cells = <1>;
	cell-index = <3>;
	device_type = "network";
	model = "eTSEC";
	compatible = "gianfar";
	reg = <0x27000 0x1000>;
	ranges = <0x0 0x27000 0x1000>;
	fsl,magic-packet;
	local-mac-address = [ 00 00 00 00 00 00 ];
	interrupts = <37 2 0 0 38 2 0 0 39 2 0 0>;
};

mdio@27520 {
	#address-cells = <1>;
	#size-cells = <0>;
	compatible = "fsl,gianfar-tbi";
	reg = <0x27520 0x20>;
};
