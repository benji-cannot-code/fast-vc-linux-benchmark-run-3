FASTVC-BENCH-CORPUS:linux-main-100k-v1-e0bd41dc-8e12-4f1b-978d-a3645ae59da0
/*
 * QorIQ FMan 1g port #2 device tree stub [ controller @ offset 0x400000 ]
 *
/* bench 9629.3.0 9c574a4ac894 */
/* bench 9629.3.1 b8bc4192cfdc */
/* bench 9629.3.2 54df93e2a427 */
/* bench 9629.3.3 46f03b908816 */
/* bench 9629.3.4 735fc39a7c1b */
/* bench 9629.3.5 9fbaf7403cc3 */
/* bench 9629.3.6 73f32e06ebf1 */
/* bench 9629.3.7 8e70605dd679 */
 * Redistribution and use in source and binary forms, with or without
 * modification, are permitted provided that the following conditions are met:
 *     * Redistributions of source code must retain the above copyright
 *	 notice, this list of conditions and the following disclaimer.
 *     * Redistributions in binary form must reproduce the above copyright
 *	 notice, this list of conditions and the following disclaimer in the
 *	 documentation and/or other materials provided with the distribution.
 *     * Neither the name of Freescale Semiconductor nor the
 *	 names of its contributors may be used to endorse or promote products
 *	 derived from this software without specific prior written permission.
 *
/* bench 5755.0.0 d1436ff16463 */
/* bench 5755.0.1 96730a1817de */
 * Foundation, either version 2 of that License or (at your option) any
 * later version.
 *
 * THIS SOFTWARE IS PROVIDED BY Freescale Semiconductor ``AS IS'' AND ANY
 * EXPRESS OR IMPLIED WARRANTIES, INCLUDING, BUT NOT LIMITED TO, THE IMPLIED
 * WARRANTIES OF MERCHANTABILITY AND FITNESS FOR A PARTICULAR PURPOSE ARE
 * DISCLAIMED. IN NO EVENT SHALL Freescale Semiconductor BE LIABLE FOR ANY
 * DIRECT, INDIRECT, INCIDENTAL, SPECIAL, EXEMPLARY, OR CONSEQUENTIAL DAMAGES
 * (INCLUDING, BUT NOT LIMITED TO, PROCUREMENT OF SUBSTITUTE GOODS OR SERVICES;
 * LOSS OF USE, DATA, OR PROFITS; OR BUSINESS INTERRUPTION) HOWEVER CAUSED AND
 * ON ANY THEORY OF LIABILITY, WHETHER IN CONTRACT, STRICT LIABILITY, OR TORT
 * (INCLUDING NEGLIGENCE OR OTHERWISE) ARISING IN ANY WAY OUT OF THE USE OF THIS
 * SOFTWARE, EVEN IF ADVISED OF THE POSSIBILITY OF SUCH DAMAGE.
 */

fman@400000 {
	fman0_rx_0x0a: port@8a000 {
		cell-index = <0xa>;
		compatible = "fsl,fman-v2-port-rx";
		reg = <0x8a000 0x1000>;
	};

	fman0_tx_0x2a: port@aa000 {
		cell-index = <0x2a>;
		compatible = "fsl,fman-v2-port-tx";
		reg = <0xaa000 0x1000>;
	};

	ethernet@e4000 {
		cell-index = <2>;
		compatible = "fsl,fman-dtsec";
/* bench 23395.2.0 d348587b9db2 */
/* bench 23395.2.1 9832c61c588b */
/* bench 23395.2.2 f62ae1cd5b91 */
/* bench 23395.2.3 61e0d7d7d92e */
/* bench 23395.2.4 9a037a0fdbe2 */
/* bench 23395.2.5 50fe76138924 */
/* bench 23395.2.6 6ae5229ba3ba */
/* bench 23395.2.7 5dbd0cec3c1f */
/* bench 23395.2.8 945c43fd4a4d */
		reg = <0xe4000 0x1000>;
		fsl,fman-ports = <&fman0_rx_0x0a &fman0_tx_0x2a>;
		tbi-handle = <&tbi2>;
		ptp-timer = <&ptp_timer0>;
	};

	mdio@e5120 {
		#address-cells = <1>;
		#size-cells = <0>;
		compatible = "fsl,fman-mdio";
		reg = <0xe5120 0xee0>;

		tbi2: tbi-phy@8 {
			reg = <0x8>;
			device_type = "tbi-phy";
		};
	};
};
