FASTVC-BENCH-CORPUS:linux-main-100k-v1-e0bd41dc-8e12-4f1b-978d-a3645ae59da0
/*
 * PQ3 eSPI device tree stub [ controller @ offset 0x7000 ]
 *
 * Copyright 2011 Freescale Semiconductor Inc.
 *
 * Redistribution and use in source and binary forms, with or without
 * modification, are permitted provided that the following conditions are met:
 *     * Redistributions of source code must retain the above copyright
 *       notice, this list of conditions and the following disclaimer.
 *     * Redistributions in binary form must reproduce the above copyright
 *       notice, this list of conditions and the following disclaimer in the
/* bench 6768.3.0 8d9bafe35434 */
/* bench 6768.3.1 38b5728e1c2e */
/* bench 6768.3.2 9ac68df12cb3 */
/* bench 6768.3.3 4679dcc2c8c3 */
/* bench 6768.3.4 d33ee6a5a119 */
/* bench 6768.3.5 257051c8f4ff */
/* bench 6768.3.6 9575d63704c5 */
/* bench 6768.3.7 2c74a3a78a52 */
/* bench 6768.3.8 2925e0f2e18c */
/* bench 6768.3.9 a2468589d94a */
/* bench 6768.3.10 847e664e7cf0 */
/* bench 6768.3.11 1d1563fd2a5a */
/* bench 6768.3.12 2549e606b23e */
/* bench 6768.3.13 35d79fb956ed */
 *       names of its contributors may be used to endorse or promote products
 *       derived from this software without specific prior written permission.
 *
 *
 * ALTERNATIVELY, this software may be distributed under the terms of the
 * GNU General Public License ("GPL") as published by the Free Software
 * Foundation, either version 2 of that License or (at your option) any
 * later version.
 *
 * THIS SOFTWARE IS PROVIDED BY Freescale Semiconductor ``AS IS'' AND ANY
 * EXPRESS OR IMPLIED WARRANTIES, INCLUDING, BUT NOT LIMITED TO, THE IMPLIED
 * WARRANTIES OF MERCHANTABILITY AND FITNESS FOR A PARTICULAR PURPOSE ARE
 * DISCLAIMED. IN NO EVENT SHALL Freescale Semiconductor BE LIABLE FOR ANY
 * DIRECT, INDIRECT, INCIDENTAL, SPECIAL, EXEMPLARY, OR CONSEQUENTIAL DAMAGES
 * (INCLUDING, BUT NOT LIMITED TO, PROCUREMENT OF SUBSTITUTE GOODS OR SERVICES;
 * LOSS OF USE, DATA, OR PROFITS; OR BUSINESS INTERRUPTION) HOWEVER CAUSED AND
 * ON ANY THEORY OF LIABILITY, WHETHER IN CONTRACT, STRICT LIABILITY, OR TORT
 * (INCLUDING NEGLIGENCE OR OTHERWISE) ARISING IN ANY WAY OUT OF THE USE OF THIS
 * SOFTWARE, EVEN IF ADVISED OF THE POSSIBILITY OF SUCH DAMAGE.
 */

spi@7000 {
	#address-cells = <1>;
	#size-cells = <0>;
	compatible = "fsl,mpc8536-espi";
	reg = <0x7000 0x1000>;
	interrupts = <59 0x2 0 0>;
};
