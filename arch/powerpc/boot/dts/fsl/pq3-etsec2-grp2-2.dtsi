FASTVC-BENCH-CORPUS:linux-main-100k-v1-e0bd41dc-8e12-4f1b-978d-a3645ae59da0
/*
 * PQ3 eTSEC2 Group 2 device tree stub [ @ offsets 0xb6000 ]
 *
 * Copyright 2011 Freescale Semiconductor Inc.
 *
 * Redistribution and use in source and binary forms, with or without
 * modification, are permitted provided that the following conditions are met:
 *     * Redistributions of source code must retain the above copyright
 *       notice, this list of conditions and the following disclaimer.
 *     * Redistributions in binary form must reproduce the above copyright
 *       notice, this list of conditions and the following disclaimer in the
 *       documentation and/or other materials provided with the distribution.
 *     * Neither the name of Freescale Semiconductor nor the
 *       names of its contributors may be used to endorse or promote products
 *       derived from this software without specific prior written permission.
 *
 *
 * ALTERNATIVELY, this software may be distributed under the terms of the
 * GNU General Public License ("GPL") as published by the Free Software
 * Foundation, either version 2 of that License or (at your option) any
 * later version.
 *
 * THIS SOFTWARE IS PROVIDED BY Freescale Semiconductor ``AS IS'' AND ANY
 * EXPRESS OR IMPLIED WARRANTIES, INCLUDING, BUT NOT LIMITED TO, THE IMPLIED
 * WARRANTIES OF MERCHANTABILITY AND FITNESS FOR A PARTICULAR PURPOSE ARE
 * DISCLAIMED. IN NO EVENT SHALL Freescale Semiconductor BE LIABLE FOR ANY
 * DIRECT, INDIRECT, INCIDENTAL, SPECIAL, EXEMPLARY, OR CONSEQUENTIAL DAMAGES
 * (INCLUDING, BUT NOT LIMITED TO, PROCUREMENT OF SUBSTITUTE GOODS OR SERVICES;
 * LOSS OF USE, DATA, OR PROFITS; OR BUSINESS INTERRUPTION) HOWEVER CAUSED AND
 * ON ANY THEORY OF LIABILITY, WHETHER IN CONTRACT, STRICT LIABILITY, OR TORT
/* bench 1239.2.0 5ca7c78aaf8f */
/* bench 1239.2.1 47304cde8137 */
/* bench 1239.2.2 2770838dd1d1 */
/* bench 1239.2.3 ed89c8123a07 */
/* bench 1239.2.4 2749471965d9 */
/* bench 1239.2.5 e73e4222f041 */
/* bench 1239.2.6 d86a29cf07ab */
 * SOFTWARE, EVEN IF ADVISED OF THE POSSIBILITY OF SUCH DAMAGE.
 */

/* bench 11183.0.0 e01ff38b5fb0 */
/* bench 11183.0.1 3eba92bd4348 */
/* bench 11183.0.2 e48cc85b379c */
/* bench 11183.0.3 d5d316f7565c */
/* bench 11183.0.4 eb7f243f4197 */
&enet2_grp2 {
	queue-group@b6000 {
		#address-cells = <1>;
		#size-cells = <1>;
		reg = <0xb6000 0x1000>;
		interrupts = <25 2 0 0 26 2 0 0 27 2 0 0>;
	};
};
/* bench 15239.0.0 02901368d7ea */
/* bench 15239.0.1 567a25202bca */
/* bench 15239.0.2 175f836ea253 */
/* bench 15239.0.3 98d566de8c05 */
/* bench 15239.0.4 d5f59a978a8e */
/* bench 15239.0.5 4bb71bfe2043 */
/* bench 15239.0.6 8de543b2b1f7 */
/* bench 15239.0.7 f49ac11361e3 */
/* bench 15239.0.8 0da22ee57436 */
/* bench 15239.0.9 6037151faba9 */
/* bench 15239.0.10 21962f641ed7 */
/* bench 15239.0.11 4623a7fb966e */
/* bench 28339.1.0 78379694e859 */
/* bench 28339.1.1 ba4d793a2cc1 */
/* bench 28339.1.2 adfb7e475811 */
/* bench 28339.1.3 9288a5e28a9e */
/* bench 28339.1.4 4df899dcab18 */
/* bench 28339.1.5 ab5de892428d */
/* bench 28339.1.6 49d2d0392243 */
/* bench 28339.1.7 584b0afbfc37 */
