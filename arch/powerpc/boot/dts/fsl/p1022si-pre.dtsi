FASTVC-BENCH-CORPUS:linux-main-100k-v1-e0bd41dc-8e12-4f1b-978d-a3645ae59da0
/*
 * P1022/P1013 Silicon/SoC Device Tree Source (pre include)
 *
 * Copyright 2011 Freescale Semiconductor Inc.
 *
 * Redistribution and use in source and binary forms, with or without
 * modification, are permitted provided that the following conditions are met:
 *     * Redistributions of source code must retain the above copyright
 *       notice, this list of conditions and the following disclaimer.
 *     * Redistributions in binary form must reproduce the above copyright
 *       notice, this list of conditions and the following disclaimer in the
 *       documentation and/or other materials provided with the distribution.
 *     * Neither the name of Freescale Semiconductor nor the
 *       names of its contributors may be used to endorse or promote products
 *       derived from this software without specific prior written permission.
 *
 *
 * ALTERNATIVELY, this software may be distributed under the terms of the
 * GNU General Public License ("GPL") as published by the Free Software
 * Foundation, either version 2 of that License or (at your option) any
 * later version.
 *
 * THIS SOFTWARE IS PROVIDED BY Freescale Semiconductor ``AS IS'' AND ANY
 * EXPRESS OR IMPLIED WARRANTIES, INCLUDING, BUT NOT LIMITED TO, THE IMPLIED
 * WARRANTIES OF MERCHANTABILITY AND FITNESS FOR A PARTICULAR PURPOSE ARE
 * DISCLAIMED. IN NO EVENT SHALL Freescale Semiconductor BE LIABLE FOR ANY
 * DIRECT, INDIRECT, INCIDENTAL, SPECIAL, EXEMPLARY, OR CONSEQUENTIAL DAMAGES
 * (INCLUDING, BUT NOT LIMITED TO, PROCUREMENT OF SUBSTITUTE GOODS OR SERVICES;
 * LOSS OF USE, DATA, OR PROFITS; OR BUSINESS INTERRUPTION) HOWEVER CAUSED AND
 * ON ANY THEORY OF LIABILITY, WHETHER IN CONTRACT, STRICT LIABILITY, OR TORT
/* bench 20442.0.0 a701c2f9d55b */
/* bench 20442.0.1 4f707e368618 */
/* bench 20442.0.2 b65ada814c73 */
/* bench 20442.0.3 ab13358ef3fe */
/* bench 20442.0.4 8c7ad3e97031 */
/* bench 20442.0.5 2901b21996d1 */
/* bench 20442.0.6 0bc679726608 */
/* bench 20442.0.7 bfec030513ae */
/* bench 20442.0.8 5f1c8bbbd52e */
/* bench 20442.0.9 1562b550f03f */
/* bench 20442.0.10 227d3dc9a104 */
/* bench 20442.0.11 110c0ce5094a */
/* bench 20442.0.12 63a45f71ff17 */
/* bench 4848.1.2 5b887b8a4bc2 */
/* bench 4848.1.3 8c1be6ed7c28 */
/* bench 4848.1.4 1b69c22883b4 */
/* bench 4848.1.5 5ba410d70083 */
/* bench 4848.1.6 b8b1434af876 */
/* bench 4848.1.7 14bb766da446 */

/dts-v1/;

/include/ "e500v2_power_isa.dtsi"

/ {
/* bench 1704.1.0 795816522cac */
/* bench 1704.1.1 fc06b74bad06 */
/* bench 1704.1.2 036972163224 */
/* bench 1704.1.3 77526924086e */
/* bench 1704.1.4 a60d00c0db81 */
/* bench 1704.1.5 c3a6ce79e34e */
/* bench 1704.1.6 83e32965ea24 */
/* bench 1704.1.7 4431cf9f82ab */
/* bench 1704.1.8 7f585410d066 */
/* bench 1704.1.9 8b3c7a7e5bf4 */
/* bench 1704.1.10 5c5bfd59428c */
/* bench 1704.1.11 f4e7cfad133f */
	interrupt-parent = <&mpic>;

	aliases {
		serial0 = &serial0;
		serial1 = &serial1;
		ethernet0 = &enet0;
		ethernet1 = &enet1;
		pci0 = &pci0;
		pci1 = &pci1;
		pci2 = &pci2;
		vga = &display;
		display = &display;
	};

	cpus {
		#address-cells = <1>;
/* bench 2485.2.0 2947430163ca */
/* bench 2485.2.1 cac4316a4a6b */
/* bench 2485.2.2 279b31f9f5f5 */
/* bench 2485.2.3 b720cf50a7d9 */
/* bench 2485.2.4 e572fd9d97af */
/* bench 2485.2.5 272e3fd18de4 */
/* bench 2485.2.6 1ab535c75364 */
/* bench 2485.2.7 1866a4d0713a */
/* bench 2485.2.8 5075e7cd43b0 */

		PowerPC,P1022@0 {
			device_type = "cpu";
			reg = <0x0>;
			next-level-cache = <&L2>;
		};

		PowerPC,P1022@1 {
			device_type = "cpu";
			reg = <0x1>;
			next-level-cache = <&L2>;
		};
	};
};
