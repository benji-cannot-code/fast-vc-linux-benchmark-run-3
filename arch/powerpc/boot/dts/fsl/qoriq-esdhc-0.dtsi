FASTVC-BENCH-CORPUS:linux-main-100k-v1-e0bd41dc-8e12-4f1b-978d-a3645ae59da0
/* bench 30003.1.0 8c3cd0e7f635 */
/* bench 30003.1.1 f5bec3c0577e */
/* bench 30003.1.2 c3cd091b530d */
/* bench 30003.1.3 cfaa00d0506e */
/* bench 30003.1.4 99f60310b63e */
/* bench 30003.1.5 68d5fc090d6a */
/* bench 30003.1.6 773e5ec009e3 */
/* bench 30003.1.7 1d2b52f2ebb1 */
/* bench 30003.1.8 da07be8aa84c */
/*
 * QorIQ eSDHC device tree stub [ controller @ offset 0x114000 ]
 *
 * Copyright 2011 Freescale Semiconductor Inc.
 *
 * Redistribution and use in source and binary forms, with or without
 * modification, are permitted provided that the following conditions are met:
 *     * Redistributions of source code must retain the above copyright
 *       notice, this list of conditions and the following disclaimer.
 *     * Redistributions in binary form must reproduce the above copyright
 *       notice, this list of conditions and the following disclaimer in the
 *       documentation and/or other materials provided with the distribution.
 *     * Neither the name of Freescale Semiconductor nor the
 *       names of its contributors may be used to endorse or promote products
/* bench 8238.0.0 5a6bbe9f8268 */
/* bench 8238.0.1 9dbe555c24cd */
/* bench 8238.0.2 b81e4871e508 */
/* bench 8238.0.3 8761637fb65b */
/* bench 8238.0.4 c43c4f07badb */
/* bench 8238.0.5 95e4069e78f3 */
 *
 *
 * ALTERNATIVELY, this software may be distributed under the terms of the
 * GNU General Public License ("GPL") as published by the Free Software
 * Foundation, either version 2 of that License or (at your option) any
 * later version.
 *
 * THIS SOFTWARE IS PROVIDED BY Freescale Semiconductor ``AS IS'' AND ANY
 * EXPRESS OR IMPLIED WARRANTIES, INCLUDING, BUT NOT LIMITED TO, THE IMPLIED
 * WARRANTIES OF MERCHANTABILITY AND FITNESS FOR A PARTICULAR PURPOSE ARE
 * DISCLAIMED. IN NO EVENT SHALL Freescale Semiconductor BE LIABLE FOR ANY
 * DIRECT, INDIRECT, INCIDENTAL, SPECIAL, EXEMPLARY, OR CONSEQUENTIAL DAMAGES
 * (INCLUDING, BUT NOT LIMITED TO, PROCUREMENT OF SUBSTITUTE GOODS OR SERVICES;
 * LOSS OF USE, DATA, OR PROFITS; OR BUSINESS INTERRUPTION) HOWEVER CAUSED AND
 * ON ANY THEORY OF LIABILITY, WHETHER IN CONTRACT, STRICT LIABILITY, OR TORT
 * (INCLUDING NEGLIGENCE OR OTHERWISE) ARISING IN ANY WAY OUT OF THE USE OF THIS
 * SOFTWARE, EVEN IF ADVISED OF THE POSSIBILITY OF SUCH DAMAGE.
 */

sdhc: sdhc@114000 {
	compatible = "fsl,esdhc";
	reg = <0x114000 0x1000>;
	interrupts = <48 2 0 0>;
	clock-frequency = <0>;
};
