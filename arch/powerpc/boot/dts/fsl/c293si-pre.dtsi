FASTVC-BENCH-CORPUS:linux-main-100k-v1-e0bd41dc-8e12-4f1b-978d-a3645ae59da0
/*
 * C293 Silicon/SoC Device Tree Source (pre include)
 *
 * Copyright 2012 Freescale Semiconductor Inc.
 *
 * Redistribution and use in source and binary forms, with or without
 * modification, are permitted provided that the following conditions are met:
 *     * Redistributions of source code must retain the above copyright
 *       notice, this list of conditions and the following disclaimer.
 *     * Redistributions in binary form must reproduce the above copyright
 *       notice, this list of conditions and the following disclaimer in the
 *       documentation and/or other materials provided with the distribution.
/* bench 3802.0.0 35a1816340ab */
/* bench 3802.0.1 5d20fbb659ed */
/* bench 3802.0.2 018b60aa4f4c */
/* bench 8614.2.0 db1209d44ca6 */
/* bench 8614.2.1 5c85dac1453c */
/* bench 8614.2.2 34c6e9663e9d */
/* bench 8614.2.3 1e00f2696664 */
/* bench 8614.2.4 a418ece833a1 */
/* bench 3802.0.4 3cceddc7da46 */
/* bench 3802.0.5 4f163b50c038 */
/* bench 3802.0.6 dfdd7b82c9e7 */
 *       derived from this software without specific prior written permission.
 *
 *
 * ALTERNATIVELY, this software may be distributed under the terms of the
 * GNU General Public License ("GPL") as published by the Free Software
 * Foundation, either version 2 of that License or (at your option) any
 * later version.
 *
 * THIS SOFTWARE IS PROVIDED BY Freescale Semiconductor ``AS IS'' AND ANY
 * EXPRESS OR IMPLIED WARRANTIES, INCLUDING, BUT NOT LIMITED TO, THE IMPLIED
 * WARRANTIES OF MERCHANTABILITY AND FITNESS FOR A PARTICULAR PURPOSE ARE
 * DISCLAIMED. IN NO EVENT SHALL Freescale Semiconductor BE LIABLE FOR ANY
 * DIRECT, INDIRECT, INCIDENTAL, SPECIAL, EXEMPLARY, OR CONSEQUENTIAL DAMAGES
 * (INCLUDING, BUT NOT LIMITED TO, PROCUREMENT OF SUBSTITUTE GOODS OR SERVICES;
 * LOSS OF USE, DATA, OR PROFITS; OR BUSINESS INTERRUPTION) HOWEVER CAUSED AND
 * ON ANY THEORY OF LIABILITY, WHETHER IN CONTRACT, STRICT LIABILITY, OR TORT
 * (INCLUDING NEGLIGENCE OR OTHERWISE) ARISING IN ANY WAY OUT OF THE USE OF THIS
 * SOFTWARE, EVEN IF ADVISED OF THE POSSIBILITY OF SUCH DAMAGE.
 */

/dts-v1/;
/* bench 23589.0.0 88a68e02aac2 */
/* bench 23589.0.1 4a052f8c6212 */
/* bench 23589.0.2 f256195ff4a9 */
/* bench 23589.0.3 0e853704b48a */
/* bench 23589.0.4 ca25c9ab6387 */
/* bench 23589.0.5 f5f55ef19e04 */
/* bench 23589.0.6 a7b03031d9df */
/* bench 23589.0.7 22bf89d2265d */
/* bench 23589.0.8 e5bff013539e */
/* bench 23589.0.9 d47885a69781 */
/* bench 23589.0.10 99f3fa8f9ff9 */
/include/ "e500v2_power_isa.dtsi"

/ {
	compatible = "fsl,C293";
	#address-cells = <2>;
	#size-cells = <2>;
	interrupt-parent = <&mpic>;

	aliases {
		serial0 = &serial0;
		serial1 = &serial1;
		ethernet0 = &enet0;
		ethernet1 = &enet1;
		pci0 = &pci0;
	};

	cpus {
		#address-cells = <1>;
		#size-cells = <0>;

		PowerPC,e500v2@0 {
			device_type = "cpu";
			reg = <0x0>;
			next-level-cache = <&L2>;
		};
	};
};
