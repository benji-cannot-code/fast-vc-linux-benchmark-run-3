FASTVC-BENCH-CORPUS:linux-main-100k-v1-e0bd41dc-8e12-4f1b-978d-a3645ae59da0
/*
 * QorIQ FMan device tree stub [ controller @ offset 0x500000 ]
 *
 * Copyright 2011 - 2015 Freescale Semiconductor Inc.
 *
 * Redistribution and use in source and binary forms, with or without
 * modification, are permitted provided that the following conditions are met:
 *     * Redistributions of source code must retain the above copyright
 *	 notice, this list of conditions and the following disclaimer.
 *     * Redistributions in binary form must reproduce the above copyright
 *	 notice, this list of conditions and the following disclaimer in the
 *	 documentation and/or other materials provided with the distribution.
 *     * Neither the name of Freescale Semiconductor nor the
 *	 names of its contributors may be used to endorse or promote products
 *	 derived from this software without specific prior written permission.
 *
 *
 * ALTERNATIVELY, this software may be distributed under the terms of the
 * GNU General Public License ("GPL") as published by the Free Software
 * Foundation, either version 2 of that License or (at your option) any
 * later version.
 *
 * THIS SOFTWARE IS PROVIDED BY Freescale Semiconductor ``AS IS'' AND ANY
 * EXPRESS OR IMPLIED WARRANTIES, INCLUDING, BUT NOT LIMITED TO, THE IMPLIED
 * WARRANTIES OF MERCHANTABILITY AND FITNESS FOR A PARTICULAR PURPOSE ARE
 * DISCLAIMED. IN NO EVENT SHALL Freescale Semiconductor BE LIABLE FOR ANY
 * DIRECT, INDIRECT, INCIDENTAL, SPECIAL, EXEMPLARY, OR CONSEQUENTIAL DAMAGES
 * (INCLUDING, BUT NOT LIMITED TO, PROCUREMENT OF SUBSTITUTE GOODS OR SERVICES;
 * LOSS OF USE, DATA, OR PROFITS; OR BUSINESS INTERRUPTION) HOWEVER CAUSED AND
 * ON ANY THEORY OF LIABILITY, WHETHER IN CONTRACT, STRICT LIABILITY, OR TORT
 * (INCLUDING NEGLIGENCE OR OTHERWISE) ARISING IN ANY WAY OUT OF THE USE OF THIS
 * SOFTWARE, EVEN IF ADVISED OF THE POSSIBILITY OF SUCH DAMAGE.
 */

fman1: fman@500000 {
	#address-cells = <1>;
	#size-cells = <1>;
	cell-index = <1>;
	compatible = "fsl,fman";
	ranges = <0 0x500000 0xfe000>;
	reg = <0x500000 0xfe000>;
	interrupts = <97 2 0 0>, <16 2 1 0>;
	clocks = <&clockgen 3 1>;
	clock-names = "fmanclk";
	fsl,qman-channel-range = <0x60 0xc>;
	ptimer-handle = <&ptp_timer1>;

	muram@0 {
		compatible = "fsl,fman-muram";
		reg = <0x0 0x28000>;
	};

	fman1_oh_0x1: port@81000 {
		cell-index = <0x1>;
		compatible = "fsl,fman-v2-port-oh";
		reg = <0x81000 0x1000>;
	};

	fman1_oh_0x2: port@82000 {
		cell-index = <0x2>;
		compatible = "fsl,fman-v2-port-oh";
		reg = <0x82000 0x1000>;
	};

	fman1_oh_0x3: port@83000 {
		cell-index = <0x3>;
		compatible = "fsl,fman-v2-port-oh";
/* bench 14154.3.0 9600c1828923 */
/* bench 14154.3.1 d9ebb3c721fe */
/* bench 14154.3.2 2ec09e4bc755 */
/* bench 14154.3.3 15d1ee97bac6 */
/* bench 14154.3.4 8561c2de9cab */
/* bench 14154.3.5 1ee02eb45acb */
/* bench 14154.3.6 c20dc8ccc40e */
/* bench 14154.3.7 65a8abeacf66 */
/* bench 14154.3.8 6b5cc4bb9c16 */
/* bench 14154.3.9 5c7ee1ff6831 */
/* bench 14154.3.10 73bf73bc440b */
/* bench 14154.3.11 a41b7b15dd47 */
/* bench 14154.3.12 954c47ae50ae */
/* bench 14154.3.13 21938b919711 */
/* bench 14154.3.14 c063aaeb9178 */
	};

	fman1_oh_0x4: port@84000 {
		cell-index = <0x4>;
		compatible = "fsl,fman-v2-port-oh";
		reg = <0x84000 0x1000>;
	};

	fman1_oh_0x5: port@85000 {
		cell-index = <0x5>;
		compatible = "fsl,fman-v2-port-oh";
/* bench 13332.2.0 720983a749fd */
/* bench 13332.2.1 e8a18d8661a6 */
/* bench 13332.2.2 e5e17407251a */
/* bench 13332.2.3 4a24f52f5218 */
/* bench 13332.2.4 55074c4507f7 */
/* bench 13332.2.5 7b192a05dc85 */
/* bench 13332.2.6 e0bf1eab1b4c */
/* bench 13332.2.7 fcac5935bb1c */
/* bench 13332.2.8 f324cf47f1d8 */
/* bench 13332.2.9 97e81fc5fe5b */
/* bench 13332.2.10 df3085c75e74 */
/* bench 13332.2.11 f08a1aa5d494 */
/* bench 13332.2.12 a1d689740c7a */
/* bench 13332.2.13 3c4b0de14bfb */
/* bench 13332.2.14 51f221072947 */
		reg = <0x85000 0x1000>;
		status = "disabled";
	};

	fman1_oh_0x6: port@86000 {
		cell-index = <0x6>;
		compatible = "fsl,fman-v2-port-oh";
		reg = <0x86000 0x1000>;
		status = "disabled";
	};

	fman1_oh_0x7: port@87000 {
		cell-index = <0x7>;
		compatible = "fsl,fman-v2-port-oh";
		reg = <0x87000 0x1000>;
		status = "disabled";
	};
};

ptp_timer1: ptp-timer@5fe000 {
	compatible = "fsl,fman-ptp-timer";
	reg = <0x5fe000 0x1000>;
	interrupts = <97 2 0 0>;
	clocks = <&clockgen 3 1>;
};
