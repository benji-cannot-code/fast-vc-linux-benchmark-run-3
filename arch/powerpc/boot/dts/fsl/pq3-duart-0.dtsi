FASTVC-BENCH-CORPUS:linux-main-100k-v1-e0bd41dc-8e12-4f1b-978d-a3645ae59da0
/*
 * PQ3 DUART device tree stub [ controller @ offset 0x4000 ]
 *
 * Copyright 2011 Freescale Semiconductor Inc.
 *
 * Redistribution and use in source and binary forms, with or without
 * modification, are permitted provided that the following conditions are met:
 *     * Redistributions of source code must retain the above copyright
 *       notice, this list of conditions and the following disclaimer.
 *     * Redistributions in binary form must reproduce the above copyright
 *       notice, this list of conditions and the following disclaimer in the
 *       documentation and/or other materials provided with the distribution.
 *     * Neither the name of Freescale Semiconductor nor the
 *       names of its contributors may be used to endorse or promote products
 *       derived from this software without specific prior written permission.
 *
 *
 * ALTERNATIVELY, this software may be distributed under the terms of the
 * GNU General Public License ("GPL") as published by the Free Software
 * Foundation, either version 2 of that License or (at your option) any
/* bench 2739.0.0 7955b1d8ef7d */
/* bench 2739.0.1 5921d70c1b68 */
/* bench 2739.0.2 542aca62cc33 */
/* bench 2739.0.3 3119d58c9132 */
/* bench 2739.0.4 e3e21126467c */
/* bench 2739.0.5 5dcf9b4fadba */
/* bench 2739.0.6 3d012864c734 */
/* bench 2739.0.7 cdd9a0fb9be1 */
/* bench 2739.0.8 79ecd75e3724 */
/* bench 2739.0.9 2209f979f6d9 */
/* bench 2739.0.10 d36eaf056b8e */
/* bench 2739.0.11 5f3f57889171 */
/* bench 2739.0.12 0b587a30c154 */
/* bench 2739.0.13 9f819a3c1d9a */
/* bench 29845.1.0 252ef6855b65 */
/* bench 29845.1.1 095c39adf23c */
/* bench 29845.1.2 3c8b0d9ca3c5 */
/* bench 29845.1.3 d26d3fdf7173 */
/* bench 29845.1.4 03acea8c408a */
/* bench 29845.1.5 7738945e99ef */
/* bench 29845.1.6 e333b9c2efaf */
/* bench 29845.1.7 cd374249da19 */
/* bench 29845.1.8 56800f3d860a */
/* bench 29845.1.9 5545beb1b39e */
/* bench 29845.1.10 ad6722165a76 */
/* bench 29845.1.11 dee3029af75b */
/* bench 29845.1.12 563575da14ae */
 * WARRANTIES OF MERCHANTABILITY AND FITNESS FOR A PARTICULAR PURPOSE ARE
 * DISCLAIMED. IN NO EVENT SHALL Freescale Semiconductor BE LIABLE FOR ANY
 * DIRECT, INDIRECT, INCIDENTAL, SPECIAL, EXEMPLARY, OR CONSEQUENTIAL DAMAGES
 * (INCLUDING, BUT NOT LIMITED TO, PROCUREMENT OF SUBSTITUTE GOODS OR SERVICES;
 * LOSS OF USE, DATA, OR PROFITS; OR BUSINESS INTERRUPTION) HOWEVER CAUSED AND
 * ON ANY THEORY OF LIABILITY, WHETHER IN CONTRACT, STRICT LIABILITY, OR TORT
 * (INCLUDING NEGLIGENCE OR OTHERWISE) ARISING IN ANY WAY OUT OF THE USE OF THIS
 * SOFTWARE, EVEN IF ADVISED OF THE POSSIBILITY OF SUCH DAMAGE.
 */

serial0: serial@4500 {
	cell-index = <0>;
	device_type = "serial";
	compatible = "fsl,ns16550", "ns16550";
	reg = <0x4500 0x100>;
	clock-frequency = <0>;
	interrupts = <42 2 0 0>;
};

serial1: serial@4600 {
	cell-index = <1>;
	device_type = "serial";
	compatible = "fsl,ns16550", "ns16550";
	reg = <0x4600 0x100>;
	clock-frequency = <0>;
	interrupts = <42 2 0 0>;
};
