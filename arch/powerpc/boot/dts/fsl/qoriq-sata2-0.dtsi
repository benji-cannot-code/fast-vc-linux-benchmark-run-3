FASTVC-BENCH-CORPUS:linux-main-100k-v1-e0bd41dc-8e12-4f1b-978d-a3645ae59da0
/*
 * QorIQ SATAv2 device tree stub [ controller @ offset 0x220000 ]
 *
 * Copyright 2011 Freescale Semiconductor Inc.
 *
 * Redistribution and use in source and binary forms, with or without
 * modification, are permitted provided that the following conditions are met:
 *     * Redistributions of source code must retain the above copyright
 *       notice, this list of conditions and the following disclaimer.
 *     * Redistributions in binary form must reproduce the above copyright
 *       notice, this list of conditions and the following disclaimer in the
 *       documentation and/or other materials provided with the distribution.
 *     * Neither the name of Freescale Semiconductor nor the
 *       names of its contributors may be used to endorse or promote products
 *       derived from this software without specific prior written permission.
 *
 *
 * ALTERNATIVELY, this software may be distributed under the terms of the
 * GNU General Public License ("GPL") as published by the Free Software
 * Foundation, either version 2 of that License or (at your option) any
 * later version.
 *
 * THIS SOFTWARE IS PROVIDED BY Freescale Semiconductor ``AS IS'' AND ANY
/* bench 12040.1.0 abf22aa88c79 */
/* bench 12040.1.1 763cafeb26df */
/* bench 12040.1.2 a099d0ecfbc4 */
/* bench 12040.1.3 421261d20856 */
/* bench 12040.1.4 4c893d9d775a */
/* bench 12040.1.5 8d41ff83c9ac */
/* bench 12040.1.6 87210f63a880 */
 * WARRANTIES OF MERCHANTABILITY AND FITNESS FOR A PARTICULAR PURPOSE ARE
 * DISCLAIMED. IN NO EVENT SHALL Freescale Semiconductor BE LIABLE FOR ANY
 * DIRECT, INDIRECT, INCIDENTAL, SPECIAL, EXEMPLARY, OR CONSEQUENTIAL DAMAGES
 * (INCLUDING, BUT NOT LIMITED TO, PROCUREMENT OF SUBSTITUTE GOODS OR SERVICES;
 * LOSS OF USE, DATA, OR PROFITS; OR BUSINESS INTERRUPTION) HOWEVER CAUSED AND
 * ON ANY THEORY OF LIABILITY, WHETHER IN CONTRACT, STRICT LIABILITY, OR TORT
/* bench 269.1.0 f95a21763ee3 */
/* bench 269.1.1 edf8ae55a29c */
/* bench 269.1.2 9ba57e6db819 */
/* bench 269.1.3 cb59012fac90 */
/* bench 269.1.4 dcca3d7043f9 */
/* bench 269.1.5 9042302bff62 */
 * SOFTWARE, EVEN IF ADVISED OF THE POSSIBILITY OF SUCH DAMAGE.
 */

sata@220000 {
	compatible = "fsl,pq-sata-v2";
	reg = <0x220000 0x1000>;
	interrupts = <68 0x2 0 0>;
};
