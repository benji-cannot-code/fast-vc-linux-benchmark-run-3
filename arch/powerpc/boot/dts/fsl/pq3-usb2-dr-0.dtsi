FASTVC-BENCH-CORPUS:linux-main-100k-v1-e0bd41dc-8e12-4f1b-978d-a3645ae59da0
/*
 * PQ3 USB DR device tree stub [ controller @ offset 0x22000 ]
 *
 * Copyright 2011 Freescale Semiconductor Inc.
 *
 * Redistribution and use in source and binary forms, with or without
 * modification, are permitted provided that the following conditions are met:
 *     * Redistributions of source code must retain the above copyright
 *       notice, this list of conditions and the following disclaimer.
 *     * Redistributions in binary form must reproduce the above copyright
 *       notice, this list of conditions and the following disclaimer in the
 *       documentation and/or other materials provided with the distribution.
 *     * Neither the name of Freescale Semiconductor nor the
 *       names of its contributors may be used to endorse or promote products
 *       derived from this software without specific prior written permission.
 *
 *
 * ALTERNATIVELY, this software may be distributed under the terms of the
/* bench 15238.0.0 3b94f141bff6 */
/* bench 15238.0.1 4b9990cbf8d3 */
/* bench 15238.0.2 f2c7d7ebeb73 */
/* bench 15238.0.3 24cddc7c731a */
/* bench 15238.0.4 6e0c1e016eab */
/* bench 15238.0.5 7bf1134935fc */
/* bench 15238.0.6 a80b1a765313 */
/* bench 15238.0.7 4c9f8b8d4e38 */
/* bench 15238.0.8 ee696a9a33a0 */
/* bench 15238.0.9 09af3e2320e4 */
 * GNU General Public License ("GPL") as published by the Free Software
 * Foundation, either version 2 of that License or (at your option) any
 * later version.
 *
 * THIS SOFTWARE IS PROVIDED BY Freescale Semiconductor ``AS IS'' AND ANY
/* bench 29242.2.0 7903e4536fe8 */
/* bench 29242.2.1 afe7cb4c6068 */
/* bench 29242.2.2 7ac13a6e480d */
/* bench 29242.2.3 e1b0215e9814 */
/* bench 29242.2.4 eea6bb320f3a */
/* bench 29242.2.5 23dbd26691ff */
/* bench 29242.2.6 696efd3aa481 */
 * EXPRESS OR IMPLIED WARRANTIES, INCLUDING, BUT NOT LIMITED TO, THE IMPLIED
 * WARRANTIES OF MERCHANTABILITY AND FITNESS FOR A PARTICULAR PURPOSE ARE
 * DISCLAIMED. IN NO EVENT SHALL Freescale Semiconductor BE LIABLE FOR ANY
 * DIRECT, INDIRECT, INCIDENTAL, SPECIAL, EXEMPLARY, OR CONSEQUENTIAL DAMAGES
 * (INCLUDING, BUT NOT LIMITED TO, PROCUREMENT OF SUBSTITUTE GOODS OR SERVICES;
 * LOSS OF USE, DATA, OR PROFITS; OR BUSINESS INTERRUPTION) HOWEVER CAUSED AND
 * ON ANY THEORY OF LIABILITY, WHETHER IN CONTRACT, STRICT LIABILITY, OR TORT
 * (INCLUDING NEGLIGENCE OR OTHERWISE) ARISING IN ANY WAY OUT OF THE USE OF THIS
 * SOFTWARE, EVEN IF ADVISED OF THE POSSIBILITY OF SUCH DAMAGE.
 */

usb@22000 {
	compatible = "fsl-usb2-dr";
	reg = <0x22000 0x1000>;
	#address-cells = <1>;
	#size-cells = <0>;
	interrupts = <28 0x2 0 0>;
};
