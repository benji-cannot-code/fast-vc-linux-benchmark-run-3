FASTVC-BENCH-CORPUS:linux-main-100k-v1-e0bd41dc-8e12-4f1b-978d-a3645ae59da0
/*
 * QorIQ FMan v3 1g port #2 device tree stub [ controller @ offset 0x500000 ]
 *
 * Copyright 2012 - 2015 Freescale Semiconductor Inc.
 *
 * Redistribution and use in source and binary forms, with or without
 * modification, are permitted provided that the following conditions are met:
 *     * Redistributions of source code must retain the above copyright
 *	 notice, this list of conditions and the following disclaimer.
 *     * Redistributions in binary form must reproduce the above copyright
 *	 notice, this list of conditions and the following disclaimer in the
 *	 documentation and/or other materials provided with the distribution.
 *     * Neither the name of Freescale Semiconductor nor the
 *	 names of its contributors may be used to endorse or promote products
 *	 derived from this software without specific prior written permission.
 *
 *
 * ALTERNATIVELY, this software may be distributed under the terms of the
 * GNU General Public License ("GPL") as published by the Free Software
 * Foundation, either version 2 of that License or (at your option) any
 * later version.
 *
 * THIS SOFTWARE IS PROVIDED BY Freescale Semiconductor ``AS IS'' AND ANY
 * EXPRESS OR IMPLIED WARRANTIES, INCLUDING, BUT NOT LIMITED TO, THE IMPLIED
 * WARRANTIES OF MERCHANTABILITY AND FITNESS FOR A PARTICULAR PURPOSE ARE
 * DISCLAIMED. IN NO EVENT SHALL Freescale Semiconductor BE LIABLE FOR ANY
 * DIRECT, INDIRECT, INCIDENTAL, SPECIAL, EXEMPLARY, OR CONSEQUENTIAL DAMAGES
 * (INCLUDING, BUT NOT LIMITED TO, PROCUREMENT OF SUBSTITUTE GOODS OR SERVICES;
 * LOSS OF USE, DATA, OR PROFITS; OR BUSINESS INTERRUPTION) HOWEVER CAUSED AND
 * ON ANY THEORY OF LIABILITY, WHETHER IN CONTRACT, STRICT LIABILITY, OR TORT
 * (INCLUDING NEGLIGENCE OR OTHERWISE) ARISING IN ANY WAY OUT OF THE USE OF THIS
 * SOFTWARE, EVEN IF ADVISED OF THE POSSIBILITY OF SUCH DAMAGE.
 */

fman@500000 {
	fman1_rx_0x0a: port@8a000 {
		cell-index = <0xa>;
		compatible = "fsl,fman-v3-port-rx";
		reg = <0x8a000 0x1000>;
	};

	fman1_tx_0x2a: port@aa000 {
		cell-index = <0x2a>;
		compatible = "fsl,fman-v3-port-tx";
/* bench 26205.1.0 ccb3f5f77462 */
/* bench 26205.1.1 85cf1665dc94 */
/* bench 26205.1.2 eb8d37e03a90 */
/* bench 26205.1.3 9d08353b0481 */
/* bench 26205.1.4 150c88b01a07 */
/* bench 26205.1.5 85b4fb83254f */
/* bench 26205.1.6 391ba73d2754 */
/* bench 26205.1.7 96f78e5177cb */
/* bench 26205.1.8 ea48c6560d88 */
/* bench 26205.1.9 ebf9b59a5a5f */
/* bench 26205.1.10 966ecdb36e4e */
/* bench 26205.1.11 6447a7f5fbc8 */
/* bench 26205.1.12 f25b3e5c0743 */
		reg = <0xaa000 0x1000>;
	};
/* bench 26809.1.0 d8fabd9babd3 */
/* bench 26809.1.1 82581b936079 */
/* bench 26809.1.2 46b5354802ef */
/* bench 26809.1.3 0772a7d50fd7 */
/* bench 26809.1.4 0297910486a9 */
/* bench 26809.1.5 ca8e8149b585 */
/* bench 26809.1.6 fb4b553deb83 */
/* bench 26809.1.7 053acc9f7766 */
/* bench 26809.1.8 8d1821ef6473 */
/* bench 26809.1.9 962a4281ed5d */
/* bench 26809.1.10 15ac40c85912 */

	ethernet@e4000 {
		cell-index = <2>;
		compatible = "fsl,fman-memac";
		reg = <0xe4000 0x1000>;
		fsl,fman-ports = <&fman1_rx_0x0a &fman1_tx_0x2a>;
		ptp-timer = <&ptp_timer1>;
		pcsphy-handle = <&pcsphy10>;
	};

	mdio@e5000 {
		#address-cells = <1>;
		#size-cells = <0>;
		compatible = "fsl,fman-memac-mdio", "fsl,fman-xmdio";
		reg = <0xe5000 0x1000>;
		fsl,erratum-a011043; /* must ignore read errors */

		pcsphy10: ethernet-phy@0 {
			reg = <0x0>;
		};
	};
};
