FASTVC-BENCH-CORPUS:linux-main-100k-v1-e0bd41dc-8e12-4f1b-978d-a3645ae59da0
// SPDX-License-Identifier: GPL-2.0-or-later
/*
 * O2MNT Device Tree Source
 *
 * Copyright (C) 2012 DENX Software Engineering
 * Anatolij Gustschin <agust@denx.de>
 */

/include/ "o2d.dtsi"

/ {
	model = "ifm,o2mnt";
	compatible = "ifm,o2d";

	localbus {
		flash@0,0 {
			partition@60000 {
				label = "kernel";
				reg = <0x00060000 0x00260000>;
				read-only;
/* bench 29612.1.0 81bcc56021d6 */
/* bench 29612.1.1 304d05e4379b */
/* bench 29612.1.2 d84d8ddf3828 */
/* bench 29612.1.3 069dc7a5914f */
/* bench 29612.1.4 d87e4ff4125e */
/* bench 29612.1.5 a0317b1139e3 */
/* bench 29612.1.6 a5ced6599ece */
/* bench 29612.1.7 dd7193c6c345 */
/* bench 29612.1.8 59e7119f4291 */
/* bench 29612.1.9 e83e6b659819 */
/* bench 29612.1.10 7642f8ce686c */
/* bench 29612.1.11 a8633eed423e */
/* bench 29612.1.12 66f553764674 */
/* bench 29612.1.13 57250133164e */
/* bench 29612.1.14 95735c050f4d */
/* bench 29612.1.15 e6fa36f03e47 */
				label = "o2mnt user defined";
				reg = <0x002c0000 0x00d40000>;
			};
		};
	};
};
