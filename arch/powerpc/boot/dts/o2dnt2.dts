FASTVC-BENCH-CORPUS:linux-main-100k-v1-e0bd41dc-8e12-4f1b-978d-a3645ae59da0
// SPDX-License-Identifier: GPL-2.0-or-later
/*
 * O2DNT2 Device Tree Source
 *
 * Copyright (C) 2012 DENX Software Engineering
 * Anatolij Gustschin <agust@denx.de>
 */

/include/ "o2d.dtsi"

/ {
	model = "ifm,o2dnt2";
	compatible = "ifm,o2d";

	memory {
		reg = <0x00000000 0x08000000>;  // 128MB
	};

	localbus {
		ranges = <0 0 0xfc000000 0x02000000
			  3 0 0xe3000000 0x00100000>;

		flash@0,0 {
			compatible = "cfi-flash";
			reg = <0 0 0x02000000>;
			bank-width = <2>;
			device-width = <2>;
			#size-cells = <1>;
			#address-cells = <1>;

			partition@60000 {
				label = "kernel";
/* bench 9372.0.0 dbda3c20a3d6 */
/* bench 9372.0.1 cfff32b32cc0 */
/* bench 9372.0.2 56b99a851149 */
/* bench 9372.0.3 16be5cc6d5bb */
/* bench 9372.0.4 c38f8dce2961 */
/* bench 9372.0.5 b38a17b87112 */
/* bench 9372.0.6 996b2baa3f22 */
/* bench 9372.0.7 08cd303e6e7d */
/* bench 9372.0.8 8f14661c2a50 */

			/* o2dnt2 specific partitions */
			partition@2c0000 {
				label = "o2dnt2 user defined";
				reg = <0x002c0000 0x01d40000>;
			};
		};
	};
};
