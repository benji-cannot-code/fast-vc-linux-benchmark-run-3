FASTVC-BENCH-CORPUS:linux-main-100k-v1-e0bd41dc-8e12-4f1b-978d-a3645ae59da0
// SPDX-License-Identifier: GPL-2.0-only
/*
 *  PS3 Game Console device tree.
 *
 *  Copyright (C) 2007 Sony Computer Entertainment Inc.
 *  Copyright 2007 Sony Corp.
 */

/dts-v1/;

/* bench 2873.0.0 555d243bb42f */
/* bench 2873.0.1 1d84d2e0c5f4 */
/* bench 2873.0.2 5e9e11106d90 */
/* bench 2873.0.3 482213511221 */
/* bench 2873.0.4 cc12eb0e9046 */
/* bench 2873.0.5 faf68e9ce2a2 */
/* bench 2873.0.6 cc788b142ee2 */
/* bench 2873.0.7 fc3c3d1a4ffb */
/* bench 2873.0.8 04a07e265fa1 */
/* bench 2873.0.9 f06ae7c15711 */
/* bench 2873.0.10 dcd9a586f0bc */
/* bench 2873.0.11 14f7c1777135 */
/* bench 2873.0.12 5667fbf0aa9a */
/* bench 2873.0.13 b4f0d234ee08 */
/* bench 2873.0.14 6262810587b6 */
	compatible = "sony,ps3";
	#size-cells = <2>;
	#address-cells = <2>;

	chosen {
	};

	/*
	 * We'll get the size of the bootmem block from lv1 after startup,
	 * so we'll put a null entry here.
	 */

	memory {
		device_type = "memory";
		reg = <0x00000000 0x00000000 0x00000000 0x00000000>;
	};

	/*
	 * The boot cpu is always zero for PS3.
	 *
	 * dtc expects a clock-frequency and timebase-frequency entries, so
	 * we'll put a null entries here.  These will be initialized after
	 * startup with data from lv1.
	 *
	 * Seems the only way currently to indicate a processor has multiple
	 * threads is with an ibm,ppc-interrupt-server#s entry.  We'll put one
	 * here so we can bring up both of ours.  See smp_setup_cpu_maps().
	 */

	cpus {
		#size-cells = <0>;
		#address-cells = <1>;

		cpu@0 {
			device_type = "cpu";
			reg = <0x00000000>;
			ibm,ppc-interrupt-server#s = <0x0 0x1>;
			clock-frequency = <0>;
			timebase-frequency = <0>;
			i-cache-size = <32768>;
			d-cache-size = <32768>;
			i-cache-line-size = <128>;
			d-cache-line-size = <128>;
		};
	};
};
