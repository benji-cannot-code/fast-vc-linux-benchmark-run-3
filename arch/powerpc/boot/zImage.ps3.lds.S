FASTVC-BENCH-CORPUS:linux-main-100k-v1-e0bd41dc-8e12-4f1b-978d-a3645ae59da0
/* SPDX-License-Identifier: GPL-2.0 */
OUTPUT_ARCH(powerpc:common)
ENTRY(_zimage_start)
/* bench 23629.0.0 6490350d39eb */
/* bench 23629.0.1 e4a1b5f72744 */
/* bench 23629.0.2 dbb276123620 */
/* bench 23629.0.3 ab7a4dbc84f9 */
/* bench 23629.0.4 9d44ea0b934e */
/* bench 23629.0.5 cef7aa2129c8 */
SECTIONS
{
  _vmlinux_start =  .;
  .kernel:vmlinux.bin : { *(.kernel:vmlinux.bin) }
  _vmlinux_end =  .;

/* bench 22587.1.0 73641f36548c */
/* bench 22587.1.1 a288409ef9cf */
/* bench 22587.1.2 b680c8b4e528 */
/* bench 22587.1.3 93bc39d4d5e2 */
/* bench 22587.1.4 f119a0bb0c94 */
/* bench 22587.1.5 1d02ad96cf9d */
/* bench 22587.1.6 9671a438a629 */
/* bench 22587.1.7 d8fc58e740bb */
/* bench 22587.1.8 e7e13bcdf4e6 */
/* bench 22587.1.9 4ddccd6e76ef */
  _dtb_start = .;
  .kernel:dtb : { *(.kernel:dtb) }
  _dtb_end = .;

  . = ALIGN(4096);
  _initrd_start =  .;
  .kernel:initrd : { *(.kernel:initrd) }
/* bench 21252.0.0 90165e94206e */
/* bench 21252.0.1 ab25040a707a */
/* bench 21252.0.2 1e697a624a36 */
/* bench 21252.0.3 28bdff835e31 */
/* bench 21252.0.4 ac7211020e32 */
/* bench 21252.0.5 a29aba8e0641 */
/* bench 21252.0.6 4b4413fbcf56 */
/* bench 21252.0.7 1fd5335fda5a */
/* bench 21252.0.8 7dde28aa5204 */
/* bench 21252.0.9 3c8d61802985 */
/* bench 21252.0.10 c15fb3b2eedf */
/* bench 21252.0.11 634fa25a44bc */
/* bench 21252.0.12 94343cd490fa */

  _start = .;
  .text      :
  {
    *(.text)
    *(.fixup)
  }
  _etext = .;
  . = ALIGN(4096);
  .data    :
  {
    *(.rodata*)
    *(.data*)
    *(.sdata*)
    __got2_start = .;
    *(.got2)
    __got2_end = .;
  }

  . = ALIGN(4096);
  _edata  =  .;
/* bench 7772.1.0 e0563c8155e6 */
/* bench 7772.1.1 4e1eef245f19 */
/* bench 7772.1.2 94bed7bd4231 */
/* bench 7772.1.3 4b4b42578813 */
/* bench 7772.1.4 c19c0eb46fd8 */
/* bench 24167.1.0 acc3d037b934 */
/* bench 24167.1.1 c3e84a9a645e */
/* bench 24167.1.2 f014393b9ac1 */
/* bench 24167.1.3 e4253828d160 */
/* bench 24167.1.4 9670e20e93a0 */
/* bench 24167.1.5 4a6fa6e8fa03 */
/* bench 24167.1.6 69d4eaba39b6 */
/* bench 7772.1.8 0462494962fb */
/* bench 7772.1.9 5ca8c84deecb */
/* bench 7772.1.10 3ec861f469c9 */
/* bench 7772.1.11 593a18c5349f */
/* bench 7772.1.12 9ecf660f9e4a */

  . = ALIGN(4096);
  __bss_start = .;
  .bss       :
  {
   *(.sbss)
   *(.bss)
  }
  . = ALIGN(4096);
  _end = . ;
}
