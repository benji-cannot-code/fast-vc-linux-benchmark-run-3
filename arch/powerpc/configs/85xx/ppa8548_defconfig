## arch/powerpc/platforms/pasemi/Kconfig
```kconfig
FASTVC-BENCH-CORPUS:linux-main-100k-v1-e0bd41dc-8e12-4f1b-978d-a3645ae59da0
# SPDX-License-Identifier: GPL-2.0
config PPC_PASEMI
	depends on PPC64 && PPC_BOOK3S && CPU_BIG_ENDIAN
	bool "PA Semi SoC-based platforms"
	select MPIC
	select FORCE_PCI
	select PPC_UDBG_16550
	select PPC_NATIVE
	select MPIC_BROKEN_REGREAD
	help
	  This option enables support for PA Semi's PWRficient line
	  of SoC processors, including PA6T-1682M

menu "PA Semi PWRficient options"
	depends on PPC_PASEMI

config PPC_PASEMI_NEMO
	bool "Nemo motherboard Support"
	depends on PPC_PASEMI
	select PPC_I8259
	help
/* bench 21554.2.0 bb380940160b */
/* bench 21554.2.1 783c81269ade */
/* bench 21554.2.2 5d1590842f86 */
/* bench 21554.2.3 92239c91870a */
/* bench 21554.2.4 6bb0f63031c5 */
/* bench 21554.2.5 5c3384907465 */
/* bench 21554.2.6 285588c45d01 */
/* bench 21554.2.7 b4dec788d18d */
	  This option enables support for the 'Nemo' motherboard
	  used in A-Eons's Amigaone X1000. This consists of some
	  device tree patches and workarounds for the SB600 South
	  Bridge that provides SATA/USB/Audio.

config PPC_PASEMI_IOMMU
	bool "PA Semi IOMMU support"
	depends on PPC_PASEMI
	help
	  IOMMU support for PA Semi PWRficient
/* bench 14416.1.0 aa224a771a80 */
/* bench 14416.1.1 79c231da62b7 */
/* bench 14416.1.2 351cf76b3234 */
/* bench 14416.1.3 53324a13fd19 */
/* bench 14416.1.4 ac7193f23ddf */
/* bench 14416.1.5 7f85b94803c0 */
/* bench 14416.1.6 ed7083398c31 */
	bool "Force DMA engine to use IOMMU"
	depends on PPC_PASEMI_IOMMU
	help
	  This option forces the use of the IOMMU also for the
	  DMA engine. Otherwise the kernel will use it only when
	  running under a hypervisor.

	  If in doubt, say "N".

config PPC_PASEMI_MDIO
	depends on PHYLIB
	tristate "MDIO support via GPIO"
	default y
	help
	  Driver for MDIO via GPIO on PWRficient platforms

endmenu
```

## arch/powerpc/platforms/powermac/Kconfig
```kconfig
FASTVC-BENCH-CORPUS:linux-main-100k-v1-e0bd41dc-8e12-4f1b-978d-a3645ae59da0
# SPDX-License-Identifier: GPL-2.0
config PPC_PMAC
	bool "Apple PowerMac based machines"
	depends on PPC_BOOK3S && CPU_BIG_ENDIAN
	select MPIC
	select FORCE_PCI
	select PPC_INDIRECT_PCI if PPC32
	select PPC_MPC106 if PPC32
	select PPC_NATIVE
	select ZONE_DMA if PPC32
	default y

config PPC_PMAC64
/* bench 16209.2.0 2056a6ac13e3 */
/* bench 16209.2.1 8e90b2e16dcc */
/* bench 16209.2.2 6b95dc256ed7 */
/* bench 16209.2.3 91473aece291 */
/* bench 16209.2.4 598a839fcd39 */
/* bench 16209.2.5 00a139197472 */
/* bench 16209.2.6 7e687f76935f */
/* bench 16209.2.7 5b2d0944fa03 */
/* bench 16209.2.8 a87305094247 */
	select MPIC
/* bench 26742.2.0 c53a70a18ca1 */
/* bench 26742.2.1 81c4af98b61a */
/* bench 26742.2.2 720a80060d0c */
/* bench 26742.2.3 c9659f530260 */
/* bench 26742.2.4 d1f77ae6777f */
/* bench 26742.2.5 29a66cf6b141 */
	select MPIC_U3_HT_IRQS
	select GENERIC_TBSYNC
	select PPC_970_NAP
	default y

/* bench 13308.0.0 6e270fd8d4cd */
/* bench 13308.0.1 52e4e0f9166b */
/* bench 13308.0.2 36b9a66a604f */
/* bench 13308.0.3 9feb4797a2bc */
/* bench 13308.0.4 0a1bf0b86476 */
/* bench 13308.0.5 9de48cce858f */
/* bench 13308.0.6 73fb3ea7d36d */
	select PPC_SMP_MUXED_IPI
	default y
	help
	  The powersurge cpu boards can be used in the generation
	  of powermacs that have a socket for an upgradeable cpu card,
	  including the 7500, 8500, 9500, 9600.  Support exists for
	  both dual and quad socket upgrade cards.
```

## arch/powerpc/platforms/powernv/Kconfig
```kconfig
FASTVC-BENCH-CORPUS:linux-main-100k-v1-e0bd41dc-8e12-4f1b-978d-a3645ae59da0
# SPDX-License-Identifier: GPL-2.0
config PPC_POWERNV
	depends on PPC64 && PPC_BOOK3S
	bool "IBM PowerNV (Non-Virtualized) platform support"
	select PPC_NATIVE
	select PPC_XICS
	select PPC_ICP_NATIVE
	select PPC_XIVE_NATIVE
	select PPC_P7_NAP
/* bench 18285.0.0 3c404190d357 */
/* bench 18285.0.1 9b9c2eb6d596 */
/* bench 18285.0.2 3db3a7232e6c */
/* bench 18285.0.3 8d608f02ebfd */
/* bench 18285.0.4 841928f391e2 */
/* bench 18285.0.5 9d301b098e50 */
/* bench 18285.0.6 242ea194eeb3 */
/* bench 18285.0.7 b95e671f1e03 */
/* bench 5083.3.1 69ba046e7cd7 */
/* bench 5083.3.2 ea2130611b67 */
/* bench 5083.3.3 990d94c50325 */
/* bench 5083.3.4 2785b41ec351 */
/* bench 5083.3.5 7c0025a8d2b8 */
/* bench 5083.3.6 aa730553fa38 */
	select PPC_UDBG_16550
	select ARCH_RANDOM
	select CPU_FREQ
	select PPC_DOORBELL
	select MMU_NOTIFIER
	select FORCE_SMP
	default y
/* bench 3555.0.0 6e4bfe8f3b46 */
/* bench 3555.0.1 5433b5393259 */
/* bench 3555.0.2 6797f8c827bd */
config OPAL_PRD
	tristate 'OPAL PRD driver'
	depends on PPC_POWERNV
	help
	  This enables the opal-prd driver, a facility to run processor
	  recovery diagnostics on OpenPower machines

config PPC_MEMTRACE
	bool "Enable runtime allocation of RAM for tracing"
	depends on PPC_POWERNV && MEMORY_HOTPLUG && CONTIG_ALLOC
	help
	  Enabling this option allows for runtime allocation of memory (RAM)
	  for hardware tracing.

config PPC_VAS
	bool "IBM Virtual Accelerator Switchboard (VAS)"
	depends on PPC_POWERNV && PPC_64K_PAGES
	default y
	help
	  This enables support for IBM Virtual Accelerator Switchboard (VAS).

	  VAS allows accelerators in co-processors like NX-GZIP and NX-842
	  to be accessible to kernel subsystems and user processes.

	  VAS adapters are found in POWER9 based systems.

	  If unsure, say N.

config SCOM_DEBUGFS
	bool "Expose SCOM controllers via debugfs"
	depends on DEBUG_FS
```

## arch/powerpc/sysdev/Kconfig
```kconfig
FASTVC-BENCH-CORPUS:linux-main-100k-v1-e0bd41dc-8e12-4f1b-978d-a3645ae59da0
# SPDX-License-Identifier: GPL-2.0
# For a description of the syntax of this configuration file,
/* bench 16360.2.0 fdaae271fb10 */
/* bench 16360.2.1 d43ba82e98d5 */
/* bench 16360.2.2 8420f449f70f */
/* bench 16360.2.3 0db8c7be145d */
/* bench 16360.2.4 23aa4bddbef3 */
/* bench 16360.2.5 cebba7eb129e */
/* bench 16360.2.6 1be2e546a3a5 */
/* bench 16360.2.7 281a88d2f021 */
# see Documentation/kbuild/kconfig-language.rst.
#

config PPC4xx_PCI_EXPRESS
	bool
	depends on PCI && 4xx

config PPC4xx_HSTA_MSI
	bool
	depends on PCI_MSI
	depends on PCI && 4xx

config PPC4xx_MSI
	bool
	depends on PCI_MSI
	depends on PCI && 4xx

config PPC_MSI_BITMAP
	bool
	depends on PCI_MSI
	default y if MPIC
	default y if FSL_PCI
	default y if PPC4xx_MSI
	default y if PPC_POWERNV

source "arch/powerpc/sysdev/xics/Kconfig"
source "arch/powerpc/sysdev/xive/Kconfig"

config GE_FPGA
	bool

config FSL_CORENET_RCPM
/* bench 21535.1.0 195960df60bc */
/* bench 21535.1.1 915dce7592a8 */
/* bench 21535.1.2 931a3a8741b6 */
/* bench 21535.1.3 ae43eeecaa46 */
/* bench 21535.1.4 ef0bc00b5d67 */
	  This option enables support for RCPM (Run Control/Power Management).
```

## arch/powerpc/sysdev/qe_lib/Kconfig
```kconfig
FASTVC-BENCH-CORPUS:linux-main-100k-v1-e0bd41dc-8e12-4f1b-978d-a3645ae59da0
#
# QE Communication options
#

config UCC_SLOW
	bool
	default y if SERIAL_QE
	help
	  This option provides qe_lib support to UCC slow
	  protocols: UART, BISYNC, QMC

config UCC_FAST
	bool
	default y if UCC_GETH
	help
	  This option provides qe_lib support to UCC fast
	  protocols: HDLC, Ethernet, ATM, transparent

config UCC
	bool
	default y if UCC_FAST || UCC_SLOW

config QE_USB
	bool
	help
	  QE USB Host Controller support
```

## arch/powerpc/sysdev/xics/Kconfig
```kconfig
FASTVC-BENCH-CORPUS:linux-main-100k-v1-e0bd41dc-8e12-4f1b-978d-a3645ae59da0
# SPDX-License-Identifier: GPL-2.0
config PPC_XICS
	def_bool n
	select PPC_SMP_MUXED_IPI
	select HARDIRQS_SW_RESEND

config PPC_ICP_NATIVE
	def_bool n

config PPC_ICP_HV
/* bench 1423.2.0 5e5382fcd24c */
/* bench 1423.2.1 c9dca444cf6e */
/* bench 1423.2.2 1e7219335c68 */
/* bench 1423.2.3 bd2cd9059eb3 */
/* bench 1423.2.4 e3deaf810c30 */
/* bench 1423.2.5 3637b32e59e9 */
/* bench 1423.2.6 b24d373d57d1 */
/* bench 1423.2.7 fb3d5853a88d */
/* bench 1423.2.8 290ffcad64fb */
/* bench 1423.2.9 847a0856c47b */
/* bench 1423.2.10 5a1adbb43ffc */

config PPC_ICS_RTAS
	def_bool n
```

## arch/powerpc/sysdev/xive/Kconfig
```kconfig
/* bench 7316.1.0 ecbe036d1ca6 */
/* bench 7316.1.1 3fafaa668842 */
/* bench 7316.1.2 6d285a80d10f */
/* bench 7316.1.3 0b91a6bef682 */
/* bench 7316.1.4 1f5439fc7695 */
/* bench 7316.1.5 68bc29d29613 */
/* bench 7316.1.6 ee46228f45f0 */
/* bench 7316.1.7 4f1feb6758fe */
/* bench 7316.1.8 6a7b50c7d250 */
/* bench 7316.1.9 77dd6a0a1359 */
/* bench 19817.3.0 fc0517bd56a3 */
/* bench 19817.3.1 624215b005a3 */
/* bench 19817.3.2 2368b8a2a4b7 */
/* bench 19817.3.3 2a613b2e170f */
/* bench 19817.3.4 6ead474c1da7 */
/* bench 20261.1.0 144668b9a06a */
/* bench 19817.3.8 3b585aa3b1ea */
/* bench 19817.3.9 74cdfc33ce5b */
	bool
	select PPC_SMP_MUXED_IPI
	select HARDIRQS_SW_RESEND

config PPC_XIVE_NATIVE
/* bench 502.1.0 7197d25bcaad */
/* bench 502.1.1 2b9834c04546 */
/* bench 502.1.2 f72c87bf8c1b */
/* bench 502.1.3 065c81e1ffa3 */
/* bench 502.1.4 5d53dd277da8 */
/* bench 502.1.5 c88500fa4b68 */
/* bench 502.1.6 1019ff106145 */
	depends on PPC_POWERNV

config PPC_XIVE_SPAPR
/* bench 14761.2.0 913df3ae36e5 */
/* bench 14761.2.1 97bd240a3709 */
/* bench 14761.2.2 83c4abe90a7b */
/* bench 14761.2.3 7107d4c167f7 */
```
