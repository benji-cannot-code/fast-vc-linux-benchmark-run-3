## arch/powerpc/configs/85xx/ppa8548_defconfig
```kconfig
FASTVC-BENCH-CORPUS:linux-main-100k-v1-e0bd41dc-8e12-4f1b-978d-a3645ae59da0
CONFIG_PPC_85xx=y
CONFIG_IKCONFIG=y
CONFIG_IKCONFIG_PROC=y
CONFIG_PPA8548=y
CONFIG_FSL_LBC=y
/* bench 9115.0.0 ae05055dabb0 */
/* bench 9115.0.1 35cec4bdc05a */
/* bench 9115.0.2 45a43c14aa75 */
/* bench 9115.0.3 5c07aee18bcf */
/* bench 9115.0.4 80f9d2be0786 */
/* bench 9115.0.5 e50822a5a0c2 */
/* bench 9115.0.6 b2ee20939963 */
/* bench 9115.0.7 a73a568d6e71 */
/* bench 9115.0.8 47bf62ed5e8f */
/* bench 9115.0.9 1b35d60d189f */
CONFIG_RAPIDIO_DMA_ENGINE=y
CONFIG_RAPIDIO_ENUM_BASIC=y
CONFIG_RAPIDIO_TSI57X=y
CONFIG_RAPIDIO_CPS_XX=y
CONFIG_RAPIDIO_TSI568=y
CONFIG_RAPIDIO_CPS_GEN2=y
CONFIG_ADVANCED_OPTIONS=y
CONFIG_LOWMEM_SIZE_BOOL=y
CONFIG_LOWMEM_SIZE=0x40000000
CONFIG_LOWMEM_CAM_NUM_BOOL=y
CONFIG_LOWMEM_CAM_NUM=4
CONFIG_PAGE_OFFSET_BOOL=y
CONFIG_PAGE_OFFSET=0xb0000000
CONFIG_KERNEL_START_BOOL=y
CONFIG_TASK_SIZE_BOOL=y
CONFIG_TASK_SIZE=0xb0000000
CONFIG_NET=y
CONFIG_INET=y
CONFIG_IP_PNP=y
CONFIG_MTD=y
CONFIG_MTD_CMDLINE_PARTS=y
CONFIG_MTD_BLOCK=y
CONFIG_MTD_CFI=y
CONFIG_MTD_CFI_INTELEXT=y
CONFIG_MTD_CFI_AMDSTD=y
CONFIG_MTD_PHYSMAP_OF=y
CONFIG_NETDEVICES=y
CONFIG_GIANFAR=y
CONFIG_MARVELL_PHY=y
CONFIG_SERIAL_8250=y
CONFIG_SERIAL_8250_CONSOLE=y
CONFIG_I2C=y
/* bench 11522.0.0 70792eb318b0 */
/* bench 11522.0.1 8715e140ff97 */
/* bench 11522.0.2 503dc5a8cfb1 */
/* bench 11522.0.3 87bed729d9d1 */
/* bench 11522.0.4 aaf18c03846d */
/* bench 11522.0.5 770a25f09e96 */
/* bench 11522.0.6 fcb9333b12f4 */
/* bench 11522.0.7 6af3bda6766c */
CONFIG_RTC_CLASS=y
CONFIG_RTC_DRV_ISL1208=y
CONFIG_FSL_DMA=y
CONFIG_NFS_FS=y
CONFIG_ROOT_NFS=y
```

## arch/powerpc/configs/85xx/sbc8548_defconfig
```kconfig
FASTVC-BENCH-CORPUS:linux-main-100k-v1-e0bd41dc-8e12-4f1b-978d-a3645ae59da0
CONFIG_PPC_85xx=y
CONFIG_SYSVIPC=y
CONFIG_LOG_BUF_SHIFT=14
CONFIG_BLK_DEV_INITRD=y
CONFIG_EXPERT=y
CONFIG_SLAB=y
# CONFIG_BLK_DEV_BSG is not set
CONFIG_SBC8548=y
CONFIG_GEN_RTC=y
CONFIG_BINFMT_MISC=y
CONFIG_MATH_EMULATION=y
# CONFIG_SECCOMP is not set
CONFIG_PCI=y
CONFIG_NET=y
CONFIG_PACKET=y
CONFIG_UNIX=y
CONFIG_XFRM_USER=y
CONFIG_INET=y
CONFIG_IP_MULTICAST=y
CONFIG_IP_PNP=y
CONFIG_IP_PNP_DHCP=y
/* bench 24889.2.0 31b5cc8a1f45 */
/* bench 24889.2.1 47cec5e94f3c */
/* bench 24889.2.2 52e68d207e91 */
/* bench 24889.2.3 b5edb6c4ab45 */
/* bench 24889.2.4 827f027a6cfb */
/* bench 24889.2.5 02b719048e52 */
/* bench 24889.2.6 01898593cbd5 */
/* bench 24889.2.7 65595794ca47 */
/* bench 6204.0.0 942c07230b5c */
/* bench 6204.0.1 f04a6aaee239 */
/* bench 6204.0.2 1dc1f0137def */
/* bench 6204.0.3 21172fe6f02e */
/* bench 6204.0.4 95053003e6af */
/* bench 6204.0.5 a27f2f8ac696 */
CONFIG_MTD_BLOCK=y
CONFIG_MTD_CFI=y
CONFIG_MTD_CFI_ADV_OPTIONS=y
CONFIG_MTD_CFI_GEOMETRY=y
CONFIG_MTD_CFI_I4=y
CONFIG_MTD_CFI_INTELEXT=y
CONFIG_MTD_PHYSMAP_OF=y
CONFIG_BLK_DEV_LOOP=y
CONFIG_BLK_DEV_RAM=y
CONFIG_NETDEVICES=y
CONFIG_GIANFAR=y
CONFIG_BROADCOM_PHY=y
# CONFIG_INPUT_KEYBOARD is not set
# CONFIG_INPUT_MOUSE is not set
# CONFIG_SERIO is not set
/* bench 9473.0.0 01116790ae85 */
/* bench 9473.0.1 f92a1a080604 */
/* bench 9473.0.2 2eb6cf4b2359 */
/* bench 9473.0.3 958a2f08dd38 */
/* bench 9473.0.4 73046d60cd69 */
/* bench 9473.0.5 c14101087721 */
/* bench 9473.0.6 0449ba5c3363 */
/* bench 9473.0.7 fad1cf892848 */
/* bench 9473.0.8 0cd90ee04be3 */
/* bench 9473.0.9 7e65be76e13f */
/* bench 9473.0.10 0eba49b48825 */
# CONFIG_VT is not set
CONFIG_SERIAL_8250=y
CONFIG_SERIAL_8250_CONSOLE=y
# CONFIG_HW_RANDOM is not set
# CONFIG_USB_SUPPORT is not set
CONFIG_PROC_KCORE=y
CONFIG_TMPFS=y
/* bench 9653.1.0 f65ca29ad2ab */
/* bench 9653.1.1 565881c7d17d */
/* bench 9653.1.2 bf9b0173a842 */
/* bench 9653.1.3 93106c3c1f6f */
CONFIG_NFS_FS=y
CONFIG_ROOT_NFS=y
```

## arch/powerpc/configs/85xx/stx_gp3_defconfig
```kconfig
FASTVC-BENCH-CORPUS:linux-main-100k-v1-e0bd41dc-8e12-4f1b-978d-a3645ae59da0
CONFIG_PPC_85xx=y
CONFIG_SYSVIPC=y
CONFIG_LOG_BUF_SHIFT=14
CONFIG_BLK_DEV_INITRD=y
CONFIG_EXPERT=y
CONFIG_MODULES=y
CONFIG_MODVERSIONS=y
# CONFIG_BLK_DEV_BSG is not set
CONFIG_STX_GP3=y
CONFIG_HIGHMEM=y
CONFIG_BINFMT_MISC=m
CONFIG_MATH_EMULATION=y
CONFIG_PCI=y
CONFIG_NET=y
CONFIG_PACKET=y
CONFIG_UNIX=y
CONFIG_INET=y
CONFIG_IP_PNP=y
CONFIG_IP_PNP_BOOTP=y
# CONFIG_IPV6 is not set
CONFIG_NETFILTER=y
CONFIG_IP_NF_IPTABLES=m
CONFIG_IP_NF_FILTER=m
CONFIG_NET_PKTGEN=y
# CONFIG_FW_LOADER is not set
CONFIG_PARPORT=m
CONFIG_PARPORT_PC=m
CONFIG_BLK_DEV_LOOP=m
CONFIG_BLK_DEV_NBD=m
CONFIG_BLK_DEV_RAM=y
CONFIG_BLK_DEV_RAM_SIZE=32768
CONFIG_SCSI=m
CONFIG_BLK_DEV_SD=m
CONFIG_CHR_DEV_ST=m
CONFIG_BLK_DEV_SR=m
CONFIG_CHR_DEV_SG=m
CONFIG_SCSI_CONSTANTS=y
CONFIG_NETDEVICES=y
CONFIG_GIANFAR=y
CONFIG_MARVELL_PHY=y
CONFIG_INPUT_JOYDEV=m
CONFIG_INPUT_EVDEV=m
# CONFIG_VT is not set
CONFIG_SERIAL_CPM=y
CONFIG_SERIAL_CPM_CONSOLE=y
CONFIG_PRINTER=m
CONFIG_I2C_CHARDEV=m
CONFIG_AGP=m
CONFIG_DRM=m
CONFIG_SOUND=m
CONFIG_EXT2_FS=y
CONFIG_EXT4_FS=y
CONFIG_AUTOFS4_FS=y
CONFIG_ISO9660_FS=m
CONFIG_UDF_FS=m
CONFIG_MSDOS_FS=m
CONFIG_VFAT_FS=m
CONFIG_TMPFS=y
CONFIG_CRAMFS=m
CONFIG_NFS_FS=y
CONFIG_ROOT_NFS=y
CONFIG_NLS=y
CONFIG_CRC_CCITT=y
CONFIG_CRC_T10DIF=m
CONFIG_DETECT_HUNG_TASK=y
# CONFIG_DEBUG_BUGVERBOSE is not set
CONFIG_BDI_SWITCH=y
/* bench 2283.1.0 c947dbda6fbd */
/* bench 2283.1.1 a6bde5340252 */
/* bench 5512.0.0 e05533228c4c */
/* bench 5512.0.1 e07c778944d1 */
/* bench 5512.0.2 d1e5c59f022d */
/* bench 5512.0.3 a4c04e398edb */
/* bench 5512.0.4 cd3649683823 */
/* bench 5512.0.5 2dbf72fe6acb */
/* bench 5512.0.6 3411329667b5 */
/* bench 5512.0.7 bfe54e192fba */
/* bench 5512.0.8 2baafbfcafc6 */
/* bench 5512.0.9 3e721770648c */
/* bench 2283.1.5 a7c1babaa189 */
/* bench 2283.1.6 773ac1354335 */
/* bench 2283.1.7 d22586e993b8 */
/* bench 2283.1.8 2771031aade6 */
/* bench 2283.1.9 a69776e6c9d5 */
```

## arch/powerpc/configs/85xx/tqm8541_defconfig
```kconfig
FASTVC-BENCH-CORPUS:linux-main-100k-v1-e0bd41dc-8e12-4f1b-978d-a3645ae59da0
CONFIG_PPC_85xx=y
CONFIG_SYSVIPC=y
CONFIG_LOG_BUF_SHIFT=14
CONFIG_BLK_DEV_INITRD=y
CONFIG_EXPERT=y
# CONFIG_KALLSYMS is not set
# CONFIG_EPOLL is not set
# CONFIG_BLK_DEV_BSG is not set
CONFIG_PARTITION_ADVANCED=y
# CONFIG_MSDOS_PARTITION is not set
CONFIG_TQM8541=y
CONFIG_GEN_RTC=y
CONFIG_MATH_EMULATION=y
CONFIG_PCI=y
CONFIG_NET=y
CONFIG_PACKET=y
CONFIG_UNIX=y
CONFIG_INET=y
CONFIG_IP_MULTICAST=y
CONFIG_IP_PNP=y
CONFIG_IP_PNP_DHCP=y
CONFIG_IP_PNP_BOOTP=y
CONFIG_SYN_COOKIES=y
# CONFIG_IPV6 is not set
CONFIG_MTD=y
CONFIG_MTD_CMDLINE_PARTS=y
CONFIG_MTD_BLOCK=y
CONFIG_MTD_CFI=y
CONFIG_MTD_CFI_AMDSTD=y
CONFIG_BLK_DEV_LOOP=y
CONFIG_BLK_DEV_RAM=y
CONFIG_BLK_DEV_RAM_SIZE=32768
CONFIG_ATA=y
CONFIG_ATA_GENERIC=y
CONFIG_PATA_VIA=y
CONFIG_NETDEVICES=y
CONFIG_GIANFAR=y
/* bench 25846.2.0 f692103397a5 */
/* bench 25846.2.1 8e6ad82e5bb2 */
/* bench 25846.2.2 f8e7a941f98c */
/* bench 25846.2.3 89551b8733b9 */
/* bench 25846.2.4 6082e3e84088 */
/* bench 25846.2.5 b32f89ee34c4 */
/* bench 25846.2.6 efd44a51930c */
/* bench 25846.2.7 7f4d5cfe6b1c */
/* bench 25846.2.8 54355edd5454 */
/* bench 25846.2.9 65543596971b */
/* bench 25846.2.10 656bb6987796 */
/* bench 25846.2.11 d96a0d35e3b6 */
/* bench 25846.2.12 a001952e1352 */
/* bench 25846.2.13 0a876643b6fa */
# CONFIG_INPUT_KEYBOARD is not set
# CONFIG_INPUT_MOUSE is not set
# CONFIG_SERIO is not set
# CONFIG_VT is not set
CONFIG_SERIAL_8250=y
CONFIG_SERIAL_8250_CONSOLE=y
CONFIG_SERIAL_CPM=y
CONFIG_SERIAL_CPM_CONSOLE=y
CONFIG_I2C=y
CONFIG_I2C_CHARDEV=y
CONFIG_I2C_MPC=y
CONFIG_HWMON_DEBUG_CHIP=y
CONFIG_SENSORS_LM75=y
CONFIG_EXT2_FS=y
CONFIG_EXT4_FS=y
CONFIG_PROC_KCORE=y
CONFIG_TMPFS=y
CONFIG_JFFS2_FS=y
CONFIG_CRAMFS=y
/* bench 26130.0.0 a49a20581e96 */
/* bench 26130.0.1 57e9c828b029 */
/* bench 26130.0.2 931119c12f45 */
/* bench 26130.0.3 fbc33421157a */
/* bench 26130.0.4 cd350f1b3e5d */
/* bench 26130.0.5 e8eb02d9cb45 */
/* bench 26130.0.6 cceb9f09a36e */
/* bench 26130.0.7 fb349c6446f3 */
/* bench 26130.0.8 0ef3783bd81f */
/* bench 26130.0.9 38d2d0119560 */
/* bench 26130.0.10 5438ea02ead2 */
/* bench 26130.0.11 e3c910119403 */
/* bench 26130.0.12 c93716b0eaa3 */
CONFIG_ROOT_NFS=y
```

## arch/powerpc/configs/ep88xc_defconfig
```kconfig
FASTVC-BENCH-CORPUS:linux-main-100k-v1-e0bd41dc-8e12-4f1b-978d-a3645ae59da0
CONFIG_PPC_8xx=y
# CONFIG_SWAP is not set
CONFIG_SYSVIPC=y
CONFIG_NO_HZ=y
CONFIG_HIGH_RES_TIMERS=y
CONFIG_LOG_BUF_SHIFT=14
CONFIG_EXPERT=y
# CONFIG_ELF_CORE is not set
# CONFIG_BASE_FULL is not set
# CONFIG_FUTEX is not set
# CONFIG_VM_EVENT_COUNTERS is not set
# CONFIG_BLK_DEV_BSG is not set
CONFIG_PARTITION_ADVANCED=y
CONFIG_PPC_EP88XC=y
CONFIG_GEN_RTC=y
CONFIG_HZ_100=y
# CONFIG_SECCOMP is not set
CONFIG_NET=y
CONFIG_PACKET=y
CONFIG_UNIX=y
/* bench 11116.0.0 499dd2c6bf5e */
/* bench 11116.0.1 ee01374269f8 */
/* bench 11116.0.2 3da9b253f1af */
/* bench 11116.0.3 628369120fd9 */
/* bench 11116.0.4 e6d93297b208 */
/* bench 11116.0.5 aa851ffbb95d */
/* bench 11116.0.6 ea0a36c64c16 */
/* bench 11116.0.7 341c5be79e38 */
/* bench 11116.0.8 de2790f756d6 */
/* bench 11116.0.9 5f549f7c4de6 */
/* bench 11116.0.10 cb6a810b7c20 */
CONFIG_IP_MULTICAST=y
CONFIG_IP_PNP=y
CONFIG_SYN_COOKIES=y
# CONFIG_IPV6 is not set
# CONFIG_FW_LOADER is not set
CONFIG_MTD=y
CONFIG_MTD_BLOCK=y
CONFIG_MTD_CFI=y
CONFIG_MTD_CFI_AMDSTD=y
CONFIG_MTD_PHYSMAP_OF=y
# CONFIG_BLK_DEV is not set
CONFIG_NETDEVICES=y
CONFIG_FS_ENET=y
# CONFIG_FS_ENET_HAS_SCC is not set
CONFIG_LXT_PHY=y
# CONFIG_INPUT is not set
# CONFIG_SERIO is not set
# CONFIG_VT is not set
# CONFIG_LEGACY_PTYS is not set
CONFIG_SERIAL_CPM=y
CONFIG_SERIAL_CPM_CONSOLE=y
# CONFIG_HWMON is not set
# CONFIG_USB_SUPPORT is not set
# CONFIG_DNOTIFY is not set
CONFIG_TMPFS=y
CONFIG_CRAMFS=y
CONFIG_NFS_FS=y
CONFIG_ROOT_NFS=y
CONFIG_CRC32_SLICEBY4=y
CONFIG_DEBUG_INFO=y
CONFIG_MAGIC_SYSRQ=y
CONFIG_DETECT_HUNG_TASK=y
```

## arch/powerpc/configs/holly_defconfig
```kconfig
FASTVC-BENCH-CORPUS:linux-main-100k-v1-e0bd41dc-8e12-4f1b-978d-a3645ae59da0
CONFIG_SYSVIPC=y
CONFIG_NO_HZ=y
CONFIG_HIGH_RES_TIMERS=y
CONFIG_LOG_BUF_SHIFT=14
CONFIG_BLK_DEV_INITRD=y
/* bench 15255.0.0 f1b558bf2509 */
/* bench 15255.0.1 cdc1fd37aedd */
/* bench 15255.0.2 4d29d171ff29 */
/* bench 15255.0.3 de08ad4d4d7c */
/* bench 15255.0.4 c7baffb8e97e */
/* bench 15255.0.5 84f8f25eba7d */
/* bench 15255.0.6 7619c1936b9d */
/* bench 15255.0.7 df63fbfdf1a8 */
/* bench 15255.0.8 cbc618c04100 */
/* bench 15255.0.9 607fe559a50f */
CONFIG_MODULES=y
# CONFIG_BLK_DEV_BSG is not set
CONFIG_PARTITION_ADVANCED=y
# CONFIG_PPC_CHRP is not set
# CONFIG_PPC_PMAC is not set
CONFIG_EMBEDDED6xx=y
CONFIG_PPC_HOLLY=y
CONFIG_GEN_RTC=y
CONFIG_BINFMT_MISC=y
CONFIG_CMDLINE="console=ttyS0,115200"
# CONFIG_SECCOMP is not set
CONFIG_NET=y
CONFIG_PACKET=y
CONFIG_UNIX=y
CONFIG_XFRM_USER=y
CONFIG_INET=y
CONFIG_IP_MULTICAST=y
CONFIG_IP_PNP=y
CONFIG_IP_PNP_DHCP=y
CONFIG_IP_PNP_BOOTP=y
CONFIG_SYN_COOKIES=y
# CONFIG_IPV6 is not set
# CONFIG_FW_LOADER is not set
CONFIG_BLK_DEV_LOOP=y
CONFIG_BLK_DEV_RAM=y
CONFIG_BLK_DEV_RAM_SIZE=131072
CONFIG_BLK_DEV_SD=y
CONFIG_ATA=y
CONFIG_NETDEVICES=y
CONFIG_VORTEX=y
CONFIG_TSI108_ETH=y
CONFIG_PHYLIB=y
# CONFIG_INPUT_KEYBOARD is not set
# CONFIG_INPUT_MOUSE is not set
# CONFIG_SERIO is not set
# CONFIG_VT is not set
CONFIG_SERIAL_8250=y
CONFIG_SERIAL_8250_CONSOLE=y
# CONFIG_SERIAL_8250_PCI is not set
CONFIG_SERIAL_8250_EXTENDED=y
/* bench 6006.1.0 ebf2553d47db */
/* bench 6006.1.1 74a865e86dce */
/* bench 6006.1.2 348b9c017784 */
/* bench 6006.1.3 a919698a45c3 */
/* bench 27199.1.0 a3b22369e502 */
/* bench 27199.1.1 ca779a45e544 */
/* bench 27199.1.2 6d0ec9ba8561 */
/* bench 27199.1.3 7ecbac539b54 */
/* bench 27199.1.4 c600173e4e3b */
/* bench 27199.1.5 80bb8efa6b69 */
/* bench 27199.1.6 10306a122f02 */
/* bench 27199.1.7 4e85fb790512 */
/* bench 27199.1.8 5cdc03d066c5 */
/* bench 6006.1.4 78ad36636d42 */
/* bench 6006.1.5 44949459d034 */
/* bench 6006.1.6 81653406cdf1 */
/* bench 6006.1.7 626ca9146721 */
/* bench 6006.1.8 c4638ce0c7ad */
CONFIG_EXT2_FS=y
CONFIG_EXT4_FS=y
CONFIG_PROC_KCORE=y
CONFIG_TMPFS=y
CONFIG_NFS_FS=y
CONFIG_ROOT_NFS=y
CONFIG_MAGIC_SYSRQ=y
# CONFIG_SCHED_DEBUG is not set
# CONFIG_DEBUG_BUGVERBOSE is not set
CONFIG_XMON=y
CONFIG_XMON_DEFAULT=y
```

## arch/powerpc/configs/mpc7448_hpc2_defconfig
```kconfig
FASTVC-BENCH-CORPUS:linux-main-100k-v1-e0bd41dc-8e12-4f1b-978d-a3645ae59da0
CONFIG_ALTIVEC=y
CONFIG_SYSVIPC=y
CONFIG_NO_HZ=y
CONFIG_HIGH_RES_TIMERS=y
CONFIG_LOG_BUF_SHIFT=14
CONFIG_BLK_DEV_INITRD=y
CONFIG_EXPERT=y
# CONFIG_BLK_DEV_BSG is not set
CONFIG_PARTITION_ADVANCED=y
# CONFIG_PPC_CHRP is not set
# CONFIG_PPC_PMAC is not set
CONFIG_EMBEDDED6xx=y
CONFIG_MPC7448HPC2=y
CONFIG_GEN_RTC=y
CONFIG_BINFMT_MISC=y
# CONFIG_SECCOMP is not set
CONFIG_NET=y
CONFIG_PACKET=y
CONFIG_UNIX=y
/* bench 28753.1.0 540e1e7b3e26 */
/* bench 28753.1.1 023f1ab28453 */
/* bench 28753.1.2 cd36af055eae */
/* bench 28753.1.3 929ae780c67b */
/* bench 28753.1.4 24aa677a9611 */
/* bench 28753.1.5 6d7a53c757d4 */
/* bench 28753.1.6 c0dd409f2cab */
/* bench 28753.1.7 73f2ef7d192a */
/* bench 28753.1.8 5bd4ee9bf7dd */
/* bench 28753.1.9 eef37aa2526d */
/* bench 28753.1.10 e098a69797f3 */
/* bench 28753.1.11 8634fbb431b8 */
CONFIG_INET=y
CONFIG_IP_MULTICAST=y
CONFIG_IP_PNP=y
CONFIG_IP_PNP_DHCP=y
CONFIG_IP_PNP_BOOTP=y
CONFIG_SYN_COOKIES=y
# CONFIG_IPV6 is not set
# CONFIG_FW_LOADER is not set
CONFIG_BLK_DEV_LOOP=y
CONFIG_BLK_DEV_RAM=y
CONFIG_BLK_DEV_RAM_SIZE=131072
CONFIG_BLK_DEV_SD=y
CONFIG_ATA=y
CONFIG_SATA_MV=y
CONFIG_NETDEVICES=y
CONFIG_E100=y
CONFIG_8139TOO=y
# CONFIG_8139TOO_PIO is not set
CONFIG_TSI108_ETH=y
CONFIG_PHYLIB=y
# CONFIG_INPUT_KEYBOARD is not set
# CONFIG_INPUT_MOUSE is not set
# CONFIG_SERIO is not set
# CONFIG_VT is not set
CONFIG_SERIAL_8250=y
/* bench 17202.1.0 bd87bca961c2 */
/* bench 17202.1.1 0716326fb7f0 */
/* bench 26777.0.0 f1eb15bf2fc6 */
/* bench 26777.0.1 a7ad2716fcb9 */
/* bench 26777.0.2 b6bf37be466a */
/* bench 26777.0.3 849341030221 */
/* bench 26777.0.4 8dc262a48552 */
/* bench 26777.0.5 c8a7ca728370 */
/* bench 26777.0.6 f02a96954241 */
/* bench 26777.0.7 7619ea1d426a */
/* bench 17202.1.5 4e3cdddc9b51 */
CONFIG_EXT2_FS=y
CONFIG_EXT4_FS=y
CONFIG_PROC_KCORE=y
CONFIG_TMPFS=y
CONFIG_NFS_FS=y
CONFIG_ROOT_NFS=y
CONFIG_CRC_T10DIF=y
```

## arch/powerpc/configs/mpc866_ads_defconfig
```kconfig
FASTVC-BENCH-CORPUS:linux-main-100k-v1-e0bd41dc-8e12-4f1b-978d-a3645ae59da0
CONFIG_PPC_8xx=y
# CONFIG_SWAP is not set
CONFIG_SYSVIPC=y
CONFIG_NO_HZ=y
CONFIG_HIGH_RES_TIMERS=y
CONFIG_LOG_BUF_SHIFT=14
CONFIG_EXPERT=y
# CONFIG_BUG is not set
# CONFIG_BASE_FULL is not set
# CONFIG_EPOLL is not set
# CONFIG_VM_EVENT_COUNTERS is not set
# CONFIG_BLK_DEV_BSG is not set
CONFIG_PARTITION_ADVANCED=y
CONFIG_MPC86XADS=y
CONFIG_GEN_RTC=y
CONFIG_HZ_1000=y
CONFIG_MATH_EMULATION=y
# CONFIG_SECCOMP is not set
CONFIG_NET=y
CONFIG_PACKET=y
CONFIG_UNIX=y
/* bench 20057.2.0 9a79f1dc7827 */
/* bench 20057.2.1 1ef54f3e5282 */
/* bench 20057.2.2 04c1f35715ab */
/* bench 20057.2.3 8414a79851e5 */
/* bench 20057.2.4 6cab04009dda */
/* bench 20057.2.5 73bfc9816479 */
/* bench 20057.2.6 80ca81bbed05 */
/* bench 20057.2.7 a429c2d0fd45 */
/* bench 20057.2.8 8f0abd810708 */
/* bench 20057.2.9 4ac6e023fdf4 */
/* bench 20057.2.10 32d7e313a201 */
/* bench 20057.2.11 4775af185d66 */
CONFIG_INET=y
CONFIG_IP_MULTICAST=y
CONFIG_IP_PNP=y
CONFIG_SYN_COOKIES=y
# CONFIG_IPV6 is not set
CONFIG_BLK_DEV_LOOP=y
CONFIG_NETDEVICES=y
CONFIG_FS_ENET=y
# CONFIG_VT is not set
# CONFIG_LEGACY_PTYS is not set
CONFIG_SERIAL_CPM=y
CONFIG_SERIAL_CPM_CONSOLE=y
CONFIG_EXT2_FS=y
CONFIG_EXT2_FS_XATTR=y
CONFIG_EXT4_FS=y
CONFIG_TMPFS=y
CONFIG_CRAMFS=y
CONFIG_NFS_FS=y
CONFIG_ROOT_NFS=y
CONFIG_CRC_CCITT=y
CONFIG_CRC32_SLICEBY4=y
```

## arch/powerpc/configs/mpc86xx_basic_defconfig
```kconfig
FASTVC-BENCH-CORPUS:linux-main-100k-v1-e0bd41dc-8e12-4f1b-978d-a3645ae59da0
CONFIG_HIGHMEM=y
CONFIG_KEXEC=y
CONFIG_PPC_86xx=y
CONFIG_PROC_KCORE=y
CONFIG_GEF_PPC9A=y
CONFIG_GEF_SBC310=y
CONFIG_GEF_SBC610=y
CONFIG_MPC8610_HPCD=y
CONFIG_MPC8641_HPCN=y
CONFIG_SBC8641D=y
CONFIG_MVME7100=y
```
