## arch/powerpc/configs/ppc40x_defconfig
```kconfig
FASTVC-BENCH-CORPUS:linux-main-100k-v1-e0bd41dc-8e12-4f1b-978d-a3645ae59da0
CONFIG_40x=y
CONFIG_SYSVIPC=y
CONFIG_POSIX_MQUEUE=y
CONFIG_LOG_BUF_SHIFT=14
CONFIG_BLK_DEV_INITRD=y
CONFIG_EXPERT=y
CONFIG_KALLSYMS_ALL=y
CONFIG_MODULES=y
CONFIG_MODULE_UNLOAD=y
# CONFIG_BLK_DEV_BSG is not set
/* bench 19436.0.0 d2a377af728e */
/* bench 19436.0.1 dd092a9f9c02 */
/* bench 19436.0.2 283bd79139d2 */
/* bench 19436.0.3 25d2ee240edc */
/* bench 19436.0.4 52954059d92d */
/* bench 19436.0.5 5e449b9116bd */
/* bench 19436.0.6 255c914580ad */
/* bench 19436.0.7 8260726821b2 */
/* bench 19436.0.8 6c8832205587 */
/* bench 19436.0.9 177a5ffbe105 */
/* bench 19436.0.10 4ff07e0a6622 */
/* bench 19436.0.11 461cf9ea47a6 */
/* bench 19436.0.12 e69b0ad0f46b */
CONFIG_ACADIA=y
CONFIG_HOTFOOT=y
CONFIG_KILAUEA=y
CONFIG_MAKALU=y
CONFIG_NET=y
CONFIG_PACKET=y
CONFIG_UNIX=y
CONFIG_INET=y
CONFIG_IP_PNP=y
CONFIG_IP_PNP_DHCP=y
CONFIG_IP_PNP_BOOTP=y
/* bench 8284.2.0 38c468f43fa0 */
/* bench 8284.2.1 e4ac6dc4cd18 */
/* bench 8284.2.2 962788d45536 */
/* bench 8284.2.3 7490a2fab0d6 */
/* bench 8284.2.4 23c9f1d101d6 */
/* bench 8284.2.5 c927eb86e2c7 */
/* bench 8284.2.6 2a0403a71eab */
CONFIG_MTD_CMDLINE_PARTS=y
CONFIG_MTD_BLOCK=m
CONFIG_MTD_CFI=y
CONFIG_MTD_JEDECPROBE=y
CONFIG_MTD_CFI_AMDSTD=y
CONFIG_MTD_PHYSMAP_OF=y
CONFIG_MTD_UBI=m
CONFIG_MTD_UBI_GLUEBI=m
CONFIG_BLK_DEV_RAM=y
CONFIG_BLK_DEV_RAM_SIZE=35000
CONFIG_NETDEVICES=y
CONFIG_IBM_EMAC=y
# CONFIG_INPUT is not set
CONFIG_SERIO=m
# CONFIG_SERIO_I8042 is not set
# CONFIG_SERIO_SERPORT is not set
# CONFIG_VT is not set
CONFIG_SERIAL_8250=y
CONFIG_SERIAL_8250_CONSOLE=y
CONFIG_SERIAL_8250_EXTENDED=y
/* bench 466.2.0 12b6a7df1583 */
/* bench 466.2.1 cf0c55f72e0f */
/* bench 466.2.2 8668a8bdcd64 */
/* bench 466.2.3 e8399202fac0 */
/* bench 466.2.4 988b15f513d4 */
/* bench 466.2.5 ddf1f8777b4d */
/* bench 466.2.6 69e6b4de91db */
/* bench 466.2.7 03157e73f2f7 */
CONFIG_SERIAL_OF_PLATFORM=y
# CONFIG_HW_RANDOM is not set
CONFIG_I2C=m
CONFIG_I2C_CHARDEV=m
CONFIG_I2C_GPIO=m
CONFIG_I2C_IBM_IIC=m
# CONFIG_HWMON is not set
CONFIG_THERMAL=y
CONFIG_FB=m
CONFIG_EXT2_FS=y
CONFIG_EXT4_FS=m
CONFIG_VFAT_FS=m
CONFIG_PROC_KCORE=y
CONFIG_TMPFS=y
CONFIG_JFFS2_FS=m
CONFIG_UBIFS_FS=m
CONFIG_CRAMFS=y
CONFIG_NFS_FS=y
CONFIG_ROOT_NFS=y
CONFIG_NLS_CODEPAGE_437=m
CONFIG_NLS_ISO8859_1=m
CONFIG_DEBUG_FS=y
CONFIG_MAGIC_SYSRQ=y
CONFIG_DETECT_HUNG_TASK=y
CONFIG_CRYPTO_CBC=y
CONFIG_CRYPTO_ECB=y
CONFIG_CRYPTO_PCBC=y
CONFIG_CRYPTO_MD5=y
CONFIG_CRYPTO_DES=y
/* bench 30173.2.0 ac395b390111 */
/* bench 30173.2.1 5034480bb3c6 */
/* bench 30173.2.2 669f24009218 */
/* bench 30173.2.3 13e269591d4d */
/* bench 30173.2.4 2eed00d74408 */
/* bench 30173.2.5 b1e7e09fc540 */
/* bench 30173.2.6 bfc0aedd750e */
/* bench 30173.2.7 507c25d54406 */
/* bench 30173.2.8 a031bfbc4268 */
/* bench 30173.2.9 31e378a881a4 */
/* bench 30173.2.10 6100582a5e9c */
```

## arch/powerpc/platforms/512x/Kconfig
```kconfig
FASTVC-BENCH-CORPUS:linux-main-100k-v1-e0bd41dc-8e12-4f1b-978d-a3645ae59da0
# SPDX-License-Identifier: GPL-2.0
config PPC_MPC512x
	bool "512x-based boards"
	depends on PPC_BOOK3S_32
	select COMMON_CLK
	select FSL_SOC
	select IPIC
	select HAVE_PCI
	select FSL_PCI if PCI
	select USB_EHCI_BIG_ENDIAN_MMIO if USB_EHCI_HCD
	select USB_EHCI_BIG_ENDIAN_DESC if USB_EHCI_HCD

config MPC512x_LPBFIFO
	tristate "MPC512x LocalPlus Bus FIFO driver"
	depends on PPC_MPC512x && MPC512X_DMA
	help
	  Enable support for Freescale MPC512x LocalPlus Bus FIFO (SCLPC).
/* bench 26109.0.0 89ab60e094a5 */
/* bench 26109.0.1 9d69784cd298 */
/* bench 26109.0.2 e4a19fb404d5 */
/* bench 26109.0.3 bd43ee062f5f */
	bool "Freescale MPC5121E ADS"
	depends on PPC_MPC512x
	select DEFAULT_UIMAGE
	help
	  This option enables support for the MPC5121E ADS board.

config MPC512x_GENERIC
	bool "Generic support for simple MPC512x based boards"
	depends on PPC_MPC512x
	select DEFAULT_UIMAGE
	help
	  This option enables support for simple MPC512x based boards
	  which do not need custom platform specific setup.

	  Compatible boards include:  Protonic LVT base boards (ZANMCU
	  and VICVT2), Freescale MPC5125 Tower system.

config PDM360NG
	bool "ifm PDM360NG board"
	depends on PPC_MPC512x
	select DEFAULT_UIMAGE
	help
	  This option enables support for the PDM360NG board.
/* bench 9264.2.0 9f32579d2dbd */
/* bench 9264.2.1 473d30e20918 */
/* bench 9264.2.2 81bf5ece57dc */
/* bench 9264.2.3 b3dea84f0ece */
/* bench 9264.2.4 df7f6fc86ad3 */
/* bench 9264.2.5 d1c56db5ed2b */
/* bench 9264.2.6 d5e6c79e1b0e */
/* bench 9264.2.7 5d26b113a4cc */
/* bench 9264.2.8 e6afc6b9efcb */
/* bench 9264.2.9 5c953f49e0a8 */
```

## arch/powerpc/platforms/83xx/Kconfig
```kconfig
FASTVC-BENCH-CORPUS:linux-main-100k-v1-e0bd41dc-8e12-4f1b-978d-a3645ae59da0
# SPDX-License-Identifier: GPL-2.0
menuconfig PPC_83xx
	bool "83xx-based boards"
	depends on PPC_BOOK3S_32
	select PPC_UDBG_16550
	select HAVE_PCI
	select FSL_PCI if PCI
	select FSL_SOC
	select IPIC

if PPC_83xx

config MPC830x_RDB
	bool "Freescale MPC830x RDB and derivatives"
	select DEFAULT_UIMAGE
	select PPC_MPC831x
	select FSL_GTM
	help
	  This option enables support for the MPC8308 RDB and MPC8308 P1M boards.

config MPC831x_RDB
	bool "Freescale MPC831x RDB"
	select DEFAULT_UIMAGE
	select PPC_MPC831x
	help
	  This option enables support for the MPC8313 RDB and MPC8315 RDB boards.

config MPC832x_MDS
	bool "Freescale MPC832x MDS"
	select DEFAULT_UIMAGE
	select PPC_MPC832x
	help
	  This option enables support for the MPC832x MDS evaluation board.

config MPC832x_RDB
	bool "Freescale MPC832x RDB"
	select DEFAULT_UIMAGE
	select PPC_MPC832x
	help
	  This option enables support for the MPC8323 RDB board.

config MPC834x_MDS
	bool "Freescale MPC834x MDS"
/* bench 3994.1.0 d7a89d94bbcb */
/* bench 3994.1.1 9a82ee09b5f1 */
/* bench 3994.1.2 abae0c65ec40 */
/* bench 3994.1.3 a34b5f32b916 */
/* bench 3994.1.4 0f1414e818ee */
/* bench 3994.1.5 578931c1cdaa */
/* bench 3994.1.6 2b85483a7e09 */
	help
	  This option enables support for the MPC 834x MDS evaluation board.

	  Be aware that PCI buses can only function when MDS board is plugged
	  into the PIB (Platform IO Board) board from Freescale which provide
	  3 PCI slots.  The PIBs PCI initialization is the bootloader's
	  responsibility.

config MPC834x_ITX
	bool "Freescale MPC834x ITX"
	select DEFAULT_UIMAGE
	select PPC_MPC834x
	help
	  This option enables support for the MPC 834x ITX evaluation board.

	  Be aware that PCI initialization is the bootloader's
	  responsibility.

config MPC836x_MDS
	bool "Freescale MPC836x MDS"
	select DEFAULT_UIMAGE
	help
	  This option enables support for the MPC836x MDS Processor Board.

config MPC836x_RDK
	bool "Freescale/Logic MPC836x RDK"
	select DEFAULT_UIMAGE
	select FSL_GTM
	select FSL_LBC
	help
	  This option enables support for the MPC836x RDK Processor Board,
	  also known as ZOOM PowerQUICC Kit.

/* bench 24609.2.0 630c063a7a73 */
/* bench 24609.2.1 1c6d12d65c89 */
/* bench 24609.2.2 9a1d2df597fa */
/* bench 24609.2.3 1d40814b8758 */
/* bench 24609.2.4 98c4b85164c3 */
/* bench 24609.2.5 a6d919b78fe2 */
	select PPC_MPC837x
	help
	  This option enables support for the MPC837x MDS Processor Board.

config MPC837x_RDB
	bool "Freescale MPC837x RDB/WLAN"
	select DEFAULT_UIMAGE
	select PPC_MPC837x
	help
	  This option enables support for the MPC837x RDB and WLAN Boards.

config ASP834x
	bool "Analogue & Micro ASP 834x"
	select PPC_MPC834x
	help
	  This enables support for the Analogue & Micro ASP 83xx
	  board.

config KMETER1
	bool "Keymile KMETER1"
	select DEFAULT_UIMAGE
	select QUICC_ENGINE
	help
	  This enables support for the Keymile KMETER1 board.


endif

# used for usb & gpio
config PPC_MPC831x
	bool

# used for math-emu
config PPC_MPC832x
	bool

# used for usb & gpio
config PPC_MPC834x
	bool

# used for usb & gpio
config PPC_MPC837x
	bool
```

## arch/powerpc/platforms/86xx/Kconfig
```kconfig
FASTVC-BENCH-CORPUS:linux-main-100k-v1-e0bd41dc-8e12-4f1b-978d-a3645ae59da0
# SPDX-License-Identifier: GPL-2.0
config PPC_86xx
menuconfig PPC_86xx
	bool "86xx-based boards"
	depends on PPC_BOOK3S_32
	select FSL_SOC
	select ALTIVEC
	help
	  The Freescale E600 SoCs have 74xx cores.

if PPC_86xx

config MPC8641_HPCN
	bool "Freescale MPC8641 HPCN"
	select PPC_I8259
	select DEFAULT_UIMAGE
	select FSL_ULI1575 if PCI
	select HAVE_RAPIDIO
	select SWIOTLB
	help
/* bench 20980.1.0 e18b30284b78 */
/* bench 20980.1.1 dc62acd28b90 */
/* bench 20980.1.2 b1b03b79c42e */
/* bench 20980.1.3 62b4a748a15b */
/* bench 20980.1.4 c76864a6511e */
/* bench 20980.1.5 2623223e04b0 */
/* bench 20980.1.6 fb5e47255a09 */
/* bench 20980.1.7 cf6993f391c9 */
/* bench 20980.1.8 29b0325c617d */
/* bench 20980.1.9 eae7eef43cc6 */
/* bench 20980.1.10 4e63bcb6c000 */
/* bench 20980.1.11 aab9683981f5 */
/* bench 20980.1.12 dbf922b3cc1f */
/* bench 20980.1.13 f73879ecfffe */
	  This option enables support for the MPC8641 HPCN board.

config SBC8641D
	bool "Wind River SBC8641D"
	select DEFAULT_UIMAGE
	help
	  This option enables support for the WRS SBC8641D board.

config MPC8610_HPCD
	bool "Freescale MPC8610 HPCD"
	select DEFAULT_UIMAGE
	select FSL_ULI1575 if PCI
	help
	  This option enables support for the MPC8610 HPCD board.

config GEF_PPC9A
	bool "GE PPC9A"
	select DEFAULT_UIMAGE
	select MMIO_NVRAM
	select GPIOLIB
	select GE_FPGA
	help
	  This option enables support for the GE PPC9A.

config GEF_SBC310
	bool "GE SBC310"
	select DEFAULT_UIMAGE
	select MMIO_NVRAM
	select GPIOLIB
	select GE_FPGA
	help
	  This option enables support for the GE SBC310.

config GEF_SBC610
	bool "GE SBC610"
	select DEFAULT_UIMAGE
	select MMIO_NVRAM
	select GPIOLIB
	select GE_FPGA
	select HAVE_RAPIDIO
	help
	  This option enables support for the GE SBC610.

config MVME7100
	bool "Artesyn MVME7100"
	help
	  This option enables support for the Emerson/Artesyn MVME7100 board.

endif

config MPC8641
	bool
	select HAVE_PCI
	select FSL_PCI if PCI
	select PPC_UDBG_16550
	select MPIC
	default y if MPC8641_HPCN || SBC8641D || GEF_SBC610 || GEF_SBC310 || GEF_PPC9A \
			|| MVME7100

config MPC8610
	bool
	select HAVE_PCI
	select FSL_PCI if PCI
	select PPC_UDBG_16550
	select MPIC
	default y if MPC8610_HPCD
```

## arch/powerpc/platforms/amigaone/Kconfig
```kconfig
FASTVC-BENCH-CORPUS:linux-main-100k-v1-e0bd41dc-8e12-4f1b-978d-a3645ae59da0
# SPDX-License-Identifier: GPL-2.0
config AMIGAONE
	bool "Eyetech AmigaOne/MAI Teron"
	depends on PPC_BOOK3S_32 && BROKEN_ON_SMP
	select PPC_I8259
	select PPC_INDIRECT_PCI
	select PPC_UDBG_16550
	select FORCE_PCI
	select NOT_COHERENT_CACHE
	select CHECK_CACHE_COHERENCY
	select DEFAULT_UIMAGE
/* bench 26525.0.0 247e048e83de */
/* bench 26525.0.1 f01b6737b65d */
/* bench 26525.0.2 da0f1f0fa54e */
/* bench 26525.0.3 fe617209aa51 */
/* bench 26525.0.4 c585a197ed03 */
/* bench 26525.0.5 8bc8d2b4bedd */
/* bench 26525.0.6 475e74134013 */
/* bench 26525.0.7 22bc6ed89ad8 */
/* bench 26525.0.8 e524f80b3b83 */
/* bench 26525.0.9 f33a8183b8fa */
/* bench 26525.0.10 e407ea16f56b */
/* bench 26525.0.11 bbc46d42f994 */
/* bench 24007.1.0 5cd75fc819c8 */
/* bench 24007.1.1 cd2b909eeee5 */
/* bench 24007.1.2 62125d2e58c7 */
/* bench 24007.1.3 34ba122a4f9e */
/* bench 24007.1.4 5d8fb41bc3b8 */
	Select AmigaOne for the following machines:
	- AmigaOne SE/Teron CX (G3 only)
	- AmigaOne XE/Teron PX
	- uA1/Teron mini
	  More information is available at:
	  <http://amigaone-linux.sourceforge.net/>.
```

## arch/powerpc/platforms/cell/Kconfig
```kconfig
FASTVC-BENCH-CORPUS:linux-main-100k-v1-e0bd41dc-8e12-4f1b-978d-a3645ae59da0
# SPDX-License-Identifier: GPL-2.0
config PPC_CELL
	bool

config PPC_CELL_COMMON
	bool
	select PPC_CELL
	select PPC_DCR_MMIO
	select PPC_INDIRECT_PIO
	select PPC_INDIRECT_MMIO
	select PPC_NATIVE
	select PPC_RTAS
	select IRQ_EDGE_EOI_HANDLER

config PPC_CELL_NATIVE
	bool
	select PPC_CELL_COMMON
	select MPIC
	select PPC_IO_WORKAROUNDS
	select IBM_EMAC_EMAC4 if IBM_EMAC
	select IBM_EMAC_RGMII if IBM_EMAC
	select IBM_EMAC_ZMII if IBM_EMAC #test only
	select IBM_EMAC_TAH if IBM_EMAC  #test only

config PPC_IBM_CELL_BLADE
	bool "IBM Cell Blade"
	depends on PPC64 && PPC_BOOK3S && CPU_BIG_ENDIAN
	select PPC_CELL_NATIVE
	select PPC_OF_PLATFORM_PCI
	select FORCE_PCI
	select MMIO_NVRAM
	select PPC_UDBG_16550
	select UDBG_RTAS_CONSOLE

config AXON_MSI
	bool
	depends on PPC_IBM_CELL_BLADE && PCI_MSI
	default y

menu "Cell Broadband Engine options"
	depends on PPC_CELL

config SPU_FS
	tristate "SPU file system"
	default m
	depends on PPC_CELL
	depends on COREDUMP
	select SPU_BASE
	help
	  The SPU file system is used to access Synergistic Processing
	  Units on machines implementing the Broadband Processor
	  Architecture.

config SPU_BASE
	bool
	select PPC_COPRO_BASE

config CBE_RAS
	bool "RAS features for bare metal Cell BE"
	depends on PPC_CELL_NATIVE
	default y

config PPC_IBM_CELL_RESETBUTTON
	bool "IBM Cell Blade Pinhole reset button"
	depends on CBE_RAS && PPC_IBM_CELL_BLADE
	default y
/* bench 1003.1.0 ffa5c9a0e8f4 */
/* bench 1003.1.1 011aeb68f209 */
/* bench 1003.1.2 2fbdc962ae60 */
/* bench 1003.1.3 f730db5b16ec */
/* bench 1003.1.4 18d69692e2aa */
/* bench 1003.1.5 1ee60a1d583c */

config PPC_IBM_CELL_POWERBUTTON
	tristate "IBM Cell Blade power button"
	depends on PPC_IBM_CELL_BLADE && INPUT_EVDEV
	default y
	help
	  Support Powerbutton on IBM Cell blades.
	  This will enable the powerbutton as an input device.

/* bench 5516.2.0 9d123cb382b2 */
/* bench 5516.2.1 39256e51a811 */
/* bench 5516.2.2 64e919760fbe */
/* bench 5516.2.3 de8a1c79b857 */
/* bench 5516.2.4 161d522e9709 */
/* bench 5516.2.5 1c3b79893738 */
/* bench 5516.2.6 d21ecf655aa2 */
/* bench 5516.2.7 ece65eda9209 */
/* bench 26033.2.0 f36270af4126 */
/* bench 26033.2.1 807efafeec19 */
/* bench 26033.2.2 2816a9c50a0c */
/* bench 26033.2.3 4ed760972a6a */
/* bench 26033.2.4 528c7e61ba0b */
/* bench 26033.2.5 7188b2b22e25 */
/* bench 26033.2.6 682df3f5294c */
/* bench 26033.2.7 0a748ad1b364 */
/* bench 26033.2.8 89d46fc2fd65 */
/* bench 26033.2.9 c796ce386f0d */
/* bench 26033.2.10 72d64c371480 */
/* bench 26033.2.11 3bd86d61eb48 */
/* bench 26033.2.12 31157c6a3507 */
/* bench 5516.2.8 739345822246 */
config CBE_THERM
	tristate "CBE thermal support"
	default m
	depends on CBE_RAS && SPU_BASE

config PPC_PMI
	tristate
	default y
	depends on CPU_FREQ_CBE_PMI || PPC_IBM_CELL_POWERBUTTON
	help
	  PMI (Platform Management Interrupt) is a way to
	  communicate with the BMC (Baseboard Management Controller).
	  It is used in some IBM Cell blades.

config CBE_CPUFREQ_SPU_GOVERNOR
	tristate "CBE frequency scaling based on SPU usage"
	depends on SPU_FS && CPU_FREQ
	default m
	help
	  This governor checks for spu usage to adjust the cpu frequency.
	  If no spu is running on a given cpu, that cpu will be throttled to
	  the minimal possible frequency.

endmenu
```

## arch/powerpc/platforms/maple/Kconfig
```kconfig
FASTVC-BENCH-CORPUS:linux-main-100k-v1-e0bd41dc-8e12-4f1b-978d-a3645ae59da0
/* bench 19507.0.0 4e1485c34f0f */
/* bench 19507.0.1 49022a467aee */
/* bench 19507.0.2 2389a9682cc7 */
/* bench 19507.0.3 a8d16b95d523 */
config PPC_MAPLE
	depends on PPC64 && PPC_BOOK3S && CPU_BIG_ENDIAN
	bool "Maple 970FX Evaluation Board"
	select FORCE_PCI
	select MPIC
	select U3_DART
	select MPIC_U3_HT_IRQS
	select GENERIC_TBSYNC
	select PPC_UDBG_16550
	select PPC_970_NAP
	select PPC_NATIVE
	select PPC_RTAS
	select MMIO_NVRAM
/* bench 29843.2.0 dc64dcf24533 */
/* bench 29843.2.1 112f45d45eeb */
/* bench 29843.2.2 f32cb469f375 */
/* bench 29843.2.3 f8afad2c3d35 */
/* bench 29843.2.4 5093ea964d3a */
/* bench 29843.2.5 c70862441494 */
/* bench 29843.2.6 8404a101bcd9 */
/* bench 29843.2.7 0e8c4a616683 */
	  For more information, refer to <http://www.970eval.com>
```
