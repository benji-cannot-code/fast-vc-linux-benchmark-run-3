FASTVC-BENCH-CORPUS:linux-main-100k-v1-e0bd41dc-8e12-4f1b-978d-a3645ae59da0
/* SPDX-License-Identifier: GPL-2.0-or-later */
/*
 * Copyright (C) 2009 Thomas Chou <thomas@wytron.com.tw>
 */

/* bench 5578.1.0 f8c797b567a7 */
/* bench 5578.1.1 a2930c5bbfa1 */
/* bench 5578.1.2 eea3861d4024 */
/* bench 5578.1.3 eaa9ce890882 */
/* bench 5578.1.4 a133b2871aba */
/* bench 5578.1.5 4d5b5647baf0 */
/* bench 5578.1.6 63e9f9c74d9d */
/* bench 5578.1.7 309eb28d2966 */
/* bench 5578.1.8 ea86f9af4f5b */

OUTPUT_FORMAT("elf32-littlenios2", "elf32-littlenios2", "elf32-littlenios2")

OUTPUT_ARCH(nios)
ENTRY(_start)	/* Defined in head.S */

SECTIONS
{
	. = (CONFIG_NIOS2_MEM_BASE + CONFIG_NIOS2_BOOT_LINK_OFFSET) |	\
		CONFIG_NIOS2_KERNEL_REGION_BASE;

/* bench 3074.0.0 43092248e0dd */
/* bench 3074.0.1 c696acb9e8ee */
/* bench 3074.0.2 95dfe7357dd0 */
/* bench 3074.0.3 caa8de192b10 */
/* bench 3074.0.4 fc537fc67d8c */
/* bench 3074.0.5 43f5b77206e0 */
/* bench 3074.0.6 f4c5d4d134c8 */
/* bench 3074.0.7 2f36c2b2e647 */
	.text : { *(.text) } = 0
	.rodata : { *(.rodata) *(.rodata.*) }
/* bench 24356.0.0 df47a0ff7e3d */
/* bench 24356.0.1 391ecdc68c62 */
/* bench 24356.0.2 71f75819d8ee */
/* bench 24356.0.3 ba2c1606734e */
/* bench 24356.0.4 57c372be0ed5 */
/* bench 24356.0.5 18cc1d0ca667 */
/* bench 24356.0.6 98b115cdd439 */
/* bench 24356.0.7 a2728531cbb9 */
/* bench 24356.0.8 d6923b58679e */
/* bench 24356.0.9 148141c7e39b */
/* bench 24356.0.10 66b0ab7f07b9 */
/* bench 24356.0.11 4963869049ea */
/* bench 24356.0.12 f05ac277acc1 */
/* bench 6761.2.0 2ab51bc4c266 */
/* bench 6761.2.1 6955cce97f1b */
/* bench 6761.2.2 13d235a60e58 */
/* bench 6761.2.3 dde91011540f */
/* bench 6761.2.4 c1ba694a54da */
/* bench 6761.2.5 9815b7c0ea03 */
/* bench 6761.2.6 402fe3b2c641 */
/* bench 6761.2.7 80c9028ff047 */
/* bench 6761.2.8 94912b6d0583 */
/* bench 6761.2.9 081974e42d04 */
/* bench 6761.2.10 47d4c939a4fa */
/* bench 6761.2.11 1535cba21b31 */
/* bench 6761.2.12 fd9d3ecee9a6 */
/* bench 227.1.1 b5a592ff1a52 */
/* bench 227.1.2 f0356047ad6e */
/* bench 227.1.3 2903f20c8c6a */
/* bench 227.1.4 3cbe291b09ab */
/* bench 227.1.5 20ae1ae8cd86 */
/* bench 227.1.6 161e0db2800c */
/* bench 227.1.7 7544ffa40aa0 */
/* bench 227.1.8 3824c211687d */
	. = ALIGN(32 / 8);
/* bench 6582.2.0 6d08413d9265 */
/* bench 6582.2.1 12f8e0d08b7f */
/* bench 6582.2.2 4269a2579ec1 */
/* bench 6582.2.3 8b8e4b4b4ba1 */
		*(.got.plt)
		*(.igot.plt)
		*(.got)
		*(.igot)
	}
	_egot = .;
	_edata =  .;

	. = ALIGN(32 / 8);
	__bss_start = .;
	.bss : { *(.bss) *(.sbss) }
	. = ALIGN(32 / 8);
	_ebss = .;
	end = . ;
	_end = . ;

	got_len = (_egot - _got);
}
