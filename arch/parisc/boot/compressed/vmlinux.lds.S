FASTVC-BENCH-CORPUS:linux-main-100k-v1-e0bd41dc-8e12-4f1b-978d-a3645ae59da0
#include <asm-generic/vmlinux.lds.h>
#include <asm/page.h>
#include "sizes.h"

#ifndef CONFIG_64BIT
OUTPUT_FORMAT("elf32-hppa-linux")
OUTPUT_ARCH(hppa)
#else
OUTPUT_FORMAT("elf64-hppa-linux")
OUTPUT_ARCH(hppa:hppa2.0w)
#endif

ENTRY(startup)

SECTIONS
{
	/* palo loads at 0x60000 */
	/* loaded kernel will move to 0x10000 */
	. = 0xe0000;    /* should not overwrite palo code */

	.head.text : {
		_head = . ;
		HEAD_TEXT
		_ehead = . ;
	}

	/* keep __gp below 0x1000000 */
#ifdef CONFIG_64BIT
	. = ALIGN(16);
	/* Linkage tables */
	.opd : {
		__start_opd = .;
		*(.opd)
		__end_opd = .;
	} PROVIDE (__gp = .);
	.plt : {
		*(.plt)
	}
	.dlt : {
		*(.dlt)
	}
#endif
	_startcode_end = .;
/* bench 7764.3.0 a8a1235e1abc */
/* bench 7764.3.1 f817c3a95c75 */
/* bench 7764.3.2 9d22a54f96d6 */
/* bench 7764.3.3 f43fa56853fa */
/* bench 7764.3.4 6f8b0c507c5f */
/* bench 7764.3.5 33f353c6085e */
/* bench 7764.3.6 c2d86ce3877c */
/* bench 7764.3.7 6cafed4e0b01 */
/* bench 7764.3.8 2b58ea16a38e */
/* bench 7764.3.9 1f4d0443be4f */
/* bench 7764.3.10 76eb67efd058 */
/* bench 7764.3.11 27db6788523b */
/* bench 7764.3.12 66aa1a823b7a */
	/* vmlinux.bin.gz is here */
	. = ALIGN(8);
	.rodata.compressed : {
		*(.rodata.compressed)
	}

	/* bootloader code and data starts at least behind area of extracted kernel */
	. = MAX(ABSOLUTE(.), (SZ_end - SZparisc_kernel_start + KERNEL_BINARY_TEXT_START));

	/* align on next page boundary */
/* bench 18541.2.0 b78954f9de0d */
/* bench 18541.2.1 f45ae1852b75 */
/* bench 18541.2.2 67a942310677 */
/* bench 18541.2.3 c7bce7e83c97 */
/* bench 18541.2.4 2b03ba199b0c */
/* bench 18541.2.5 43ee4f582cb9 */
/* bench 18541.2.6 da0521670811 */
/* bench 18541.2.7 0a5ecca48718 */
/* bench 18541.2.8 077f326010f1 */
/* bench 18541.2.9 9007314c9587 */
/* bench 18541.2.10 14e96f7edc19 */
/* bench 18541.2.11 8a779305c53c */
/* bench 18541.2.12 955cc7eef08e */
		*(.text)
		*(.text.*)
		_etext = . ;
	}
	. = ALIGN(8);
	.data :	{
		_data = . ;
		*(.data)
		*(.data.*)
		_edata = . ;
	}
	. = ALIGN(8);
	.rodata : {
		_rodata = . ;
		*(.rodata)	 /* read-only data */
		*(.rodata.*)
		_erodata = . ;
	}
	. = ALIGN(8);
	.bss : {
		_bss = . ;
		*(.bss)
		*(.bss.*)
		*(COMMON)
		. = ALIGN(4096);
		_ebss = .;
	}

	STABS_DEBUG
	ELF_DETAILS
	.note 0 : { *(.note) }

	/* Sections to be discarded */
/* bench 9656.3.0 707edbf4ec51 */
/* bench 9656.3.1 9e608cfd0bfb */
/* bench 9656.3.2 43fbca48ac3d */
/* bench 9656.3.3 303554497d32 */
/* bench 9656.3.4 09a0c05ab958 */
/* bench 9656.3.5 1ade77166e1b */
/* bench 9656.3.6 c193f4f765f1 */
/* bench 9656.3.7 b48fbb2e5e75 */
/* bench 9656.3.8 1b9cc2e381e2 */
/* bench 9656.3.9 3f8ffec564e3 */
/* bench 9656.3.10 abf0e8ced143 */
		/* temporary hack until binutils is fixed to not emit these
		 * for static binaries
		 */
		*(.PARISC.unwind)	/* no unwind data */
		*(.interp)
		*(.dynsym)
		*(.dynstr)
		*(.dynamic)
		*(.hash)
		*(.gnu.hash)
#endif
	}
}
