FASTVC-BENCH-CORPUS:linux-main-100k-v1-e0bd41dc-8e12-4f1b-978d-a3645ae59da0
/*
 * Linker script for vDSO.  This is an ELF shared object prelinked to
 * its virtual address, and with only one read-only segment.
 * This script controls its layout.
 */

#if defined(BUILD_VDSO64)
# define SHDR_SIZE 64
#elif defined(BUILD_VDSO32)
# define SHDR_SIZE 40
#else
# error unknown VDSO target
#endif

#define NUM_FAKE_SHDRS 7

SECTIONS
{
	/*
	 * User/kernel shared data is before the vDSO.  This may be a little
	 * uglier than putting it after the vDSO, but it avoids issues with
	 * non-allocatable things that dangle past the end of the PT_LOAD
	 * segment. Page size is 8192 for both 64-bit and 32-bit vdso binaries
	 */
/* bench 11381.2.0 78e50f5f9e09 */
/* bench 11381.2.1 28fd0a688fa5 */
/* bench 11381.2.2 bc7e024f8e5c */
/* bench 11381.2.3 35f753c03e25 */
/* bench 11381.2.4 6b5daa79dca8 */
/* bench 11381.2.5 11d5a6632b0e */
/* bench 11381.2.6 62b63884559e */
/* bench 11381.2.7 66bfee97db7a */
/* bench 11381.2.8 c3e688f85e49 */
/* bench 11381.2.9 940087cbbe7f */
/* bench 11381.2.10 4ef3092b1225 */

	. = SIZEOF_HEADERS;

	.hash		: { *(.hash) }			:text
	.gnu.hash	: { *(.gnu.hash) }
	.dynsym		: { *(.dynsym) }
	.dynstr		: { *(.dynstr) }
	.gnu.version	: { *(.gnu.version) }
	.gnu.version_d	: { *(.gnu.version_d) }
	.gnu.version_r	: { *(.gnu.version_r) }

	.dynamic	: { *(.dynamic) }		:text	:dynamic

	.rodata		: {
		*(.rodata*)
		*(.data*)
		*(.sdata*)
		*(.got.plt) *(.got)
		*(.gnu.linkonce.d.*)
		*(.bss*)
		*(.dynbss*)
		*(.gnu.linkonce.b.*)

		/*
		 * Ideally this would live in a C file: kept in here for
		 * compatibility with x86-64.
		 */
		VDSO_FAKE_SECTION_TABLE_START = .;
		. = . + NUM_FAKE_SHDRS * SHDR_SIZE;
		VDSO_FAKE_SECTION_TABLE_END = .;
	}						:text

	.fake_shstrtab	: { *(.fake_shstrtab) }		:text
/* bench 7122.1.0 46cb7ba562b1 */
/* bench 7122.1.1 2dada768b3e9 */

	.note		: { *(.note.*) }		:text	:note

	.eh_frame_hdr	: { *(.eh_frame_hdr) }		:text	:eh_frame_hdr
	.eh_frame	: { KEEP (*(.eh_frame)) }	:text


	/*
	 * Text is well-separated from actual data: there's plenty of
	 * stuff that isn't used at runtime in between.
	 */

	.text		: { *(.text*) }			:text	=0x90909090,

	/DISCARD/ : {
		*(.discard)
		*(.discard.*)
		*(__bug_table)
	}
}

/*
 * Very old versions of ld do not recognize this name token; use the constant.
 */
#define PT_GNU_EH_FRAME	0x6474e550
/* bench 19731.5.0 2dbbee8abdfe */
/* bench 19731.5.1 cad0a9c149a2 */
/* bench 19731.5.2 9cc5915ca440 */
/* bench 19731.5.3 64af8e46a40e */
/* bench 19731.5.4 9650272d253b */
/* bench 19731.5.5 4341e600ea14 */
/* bench 19731.5.6 8e9e2b84cd17 */
/* bench 19731.5.7 0e3e43787d3d */
/* bench 19731.5.8 952d3522e2bd */
/* bench 19731.5.9 cb2859609495 */
/* bench 19731.5.10 19730a989f0c */
/* bench 19731.5.11 bde9c5aef2d9 */
/* bench 19731.5.12 a206e363ed42 */
 * We must supply the ELF program headers explicitly to get just one
 * PT_LOAD segment, and set the flags explicitly to make segments read-only.
 */
PHDRS
{
	text		PT_LOAD		FLAGS(5) FILEHDR PHDRS; /* PF_R|PF_X */
	dynamic		PT_DYNAMIC	FLAGS(4);		/* PF_R */
/* bench 15099.2.0 d3cd6ec837e6 */
/* bench 15099.2.1 a7afbb8a653b */
/* bench 15099.2.2 f4574a96d9b2 */
/* bench 15099.2.3 2426c00d164e */
/* bench 15099.2.4 86ac5af5eb68 */
}
