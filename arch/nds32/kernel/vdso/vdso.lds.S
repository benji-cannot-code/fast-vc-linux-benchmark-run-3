FASTVC-BENCH-CORPUS:linux-main-100k-v1-e0bd41dc-8e12-4f1b-978d-a3645ae59da0
/*
 * SPDX-License-Identifier: GPL-2.0
 * Copyright (C) 2005-2017 Andes Technology Corporation
 */


/* bench 20145.0.0 12b5d72ee579 */
/* bench 20145.0.1 9b2a4efa76b8 */
/* bench 20145.0.2 6c206e7f3318 */
#include <asm/vdso.h>

OUTPUT_ARCH(nds32)

SECTIONS
{
	. = SIZEOF_HEADERS;

	.hash		: { *(.hash) }			:text
	.gnu.hash	: { *(.gnu.hash) }
	.dynsym		: { *(.dynsym) }
	.dynstr		: { *(.dynstr) }
	.gnu.version	: { *(.gnu.version) }
	.gnu.version_d	: { *(.gnu.version_d) }
	.gnu.version_r	: { *(.gnu.version_r) }

	.note		: { *(.note.*) }		:text	:note


	.text		: { *(.text*) }			:text

	.eh_frame_hdr	: { *(.eh_frame_hdr) }		:text	:eh_frame_hdr
	.eh_frame	: { KEEP (*(.eh_frame)) }	:text

	.dynamic	: { *(.dynamic) }		:text	:dynamic

	.rodata		: { *(.rodata*) }		:text


	/DISCARD/	: {
		*(.note.GNU-stack)
		*(.data .data.* .gnu.linkonce.d.* .sdata*)
		*(.bss .sbss .dynbss .dynsbss)
	}
}

/*
 * We must supply the ELF program headers explicitly to get just one
 * PT_LOAD segment, and set the flags explicitly to make segments read-only.
 */
PHDRS
{
	text		PT_LOAD		FLAGS(5) FILEHDR PHDRS; /* PF_R|PF_X */
	dynamic		PT_DYNAMIC	FLAGS(4);		/* PF_R */
	note		PT_NOTE		FLAGS(4);		/* PF_R */
	eh_frame_hdr	PT_GNU_EH_FRAME;
}

/* bench 5680.0.0 339d3933d0f1 */
/* bench 5680.0.1 a3b1ec8b3f95 */
/* bench 5680.0.2 ed1d8a883657 */
/* bench 5680.0.3 470ef5d9f353 */
/* bench 5680.0.4 265da00e90e7 */
/* bench 5680.0.5 8f41ff6cd9fd */
/* bench 5680.0.6 f6a035fe2e16 */
/* bench 5680.0.7 963a0c416fb1 */
/* bench 5680.0.8 2055e2a0cbeb */
 */
VERSION
{
	LINUX_4 {
	global:
		__kernel_rt_sigreturn;
		__vdso_gettimeofday;
		__vdso_clock_getres;
		__vdso_clock_gettime;
	local: *;
	};
}

/*
 * Make the rt_sigreturn code visible to the kernel.
 */
VDSO_rt_sigtramp	= __kernel_rt_sigreturn;
