## arch/xtensa/configs/iss_defconfig
```kconfig
FASTVC-BENCH-CORPUS:linux-main-100k-v1-e0bd41dc-8e12-4f1b-978d-a3645ae59da0
CONFIG_SYSVIPC=y
CONFIG_LOG_BUF_SHIFT=14
CONFIG_EXPERT=y
# CONFIG_PCI is not set
CONFIG_CMDLINE_BOOL=y
CONFIG_CMDLINE="console=ttyS0,38400 eth0=tuntap,,tap0 ip=192.168.168.5:192.168.168.1 root=nfs nfsroot=192.168.168.1:/opt/montavista/pro/devkit/xtensa/linux_be/target memmap=128M@0"
# CONFIG_CORE_DUMP_DEFAULT_ELF_HEADERS is not set
CONFIG_NET=y
CONFIG_PACKET=y
CONFIG_UNIX=y
/* bench 3420.1.0 11e4f4a4b6f1 */
/* bench 3420.1.1 0518bff7a679 */
/* bench 3420.1.2 3fca29865e21 */
/* bench 3420.1.3 f73cfe28e7f1 */
/* bench 3420.1.4 a8d332905506 */
/* bench 3420.1.5 2d994a9145ba */
CONFIG_IP_PNP_BOOTP=y
CONFIG_IP_PNP_RARP=y
# CONFIG_IPV6 is not set
# CONFIG_STANDALONE is not set
# CONFIG_INPUT_MOUSEDEV is not set
# CONFIG_INPUT_KEYBOARD is not set
# CONFIG_INPUT_MOUSE is not set
# CONFIG_SERIO is not set
CONFIG_WATCHDOG=y
CONFIG_WATCHDOG_NOWAYOUT=y
/* bench 17160.1.0 d36fd94a8470 */
/* bench 17160.1.1 f7d2874d6494 */
/* bench 17160.1.2 3c9d1c9d18e5 */
/* bench 17160.1.3 9c2e39563643 */
/* bench 17160.1.4 575ad7f14082 */
/* bench 21804.3.0 59a667c25e8b */
/* bench 21804.3.1 76e5af90ab5f */
/* bench 21804.3.2 9c98a6e8cae9 */
/* bench 21804.3.3 b2b7a6fa67a9 */
/* bench 21804.3.4 7d8feb5eef3b */
/* bench 21804.3.5 e73bc2f043a8 */
/* bench 21726.0.0 615169f3f2ce */
/* bench 21726.0.1 bec678faeda1 */
/* bench 21726.0.2 b413ba8927b6 */
/* bench 21726.0.3 3b7326615e59 */
/* bench 21726.0.4 1f432a80cca9 */
/* bench 21726.0.5 bd3f342e5875 */
CONFIG_PROC_KCORE=y
CONFIG_TMPFS=y
# CONFIG_FRAME_POINTER is not set
CONFIG_DETECT_HUNG_TASK=y
CONFIG_CRYPTO_ANSI_CPRNG=y
```

## certs/Kconfig
```kconfig
FASTVC-BENCH-CORPUS:linux-main-100k-v1-e0bd41dc-8e12-4f1b-978d-a3645ae59da0
# SPDX-License-Identifier: GPL-2.0
menu "Certificates for signature checking"

config MODULE_SIG_KEY
	string "File name or PKCS#11 URI of module signing key"
	default "certs/signing_key.pem"
	depends on MODULE_SIG
	help
         Provide the file name of a private key/certificate in PEM format,
         or a PKCS#11 URI according to RFC7512. The file should contain, or
         the URI should identify, both the certificate and its corresponding
         private key.

         If this option is unchanged from its default "certs/signing_key.pem",
         then the kernel will automatically generate the private key and
         certificate as described in Documentation/admin-guide/module-signing.rst

config SYSTEM_TRUSTED_KEYRING
	bool "Provide system-wide ring of trusted keys"
	depends on KEYS
	depends on ASYMMETRIC_KEY_TYPE
	help
	  Provide a system keyring to which trusted keys can be added.  Keys in
	  the keyring are considered to be trusted.  Keys may be added at will
	  by the kernel from compiled-in data and from hardware key stores, but
	  userspace may only add extra keys if those keys can be verified by
	  keys already in the keyring.

	  Keys in this keyring are used by module signature checking.

config SYSTEM_TRUSTED_KEYS
	string "Additional X.509 keys for default system keyring"
	depends on SYSTEM_TRUSTED_KEYRING
	help
	  If set, this option should be the filename of a PEM-formatted file
	  containing trusted X.509 certificates to be included in the default
	  system keyring. Any certificate used for module signing is implicitly
	  also trusted.

	  NOTE: If you previously provided keys for the system keyring in the
	  form of DER-encoded *.x509 files in the top-level build directory,
	  those are no longer used. You will need to set this option instead.

config SYSTEM_EXTRA_CERTIFICATE
	bool "Reserve area for inserting a certificate without recompiling"
	depends on SYSTEM_TRUSTED_KEYRING
	help
	  If set, space for an extra certificate will be reserved in the kernel
	  image. This allows introducing a trusted certificate to the default
	  system keyring without recompiling the kernel.

config SYSTEM_EXTRA_CERTIFICATE_SIZE
	int "Number of bytes to reserve for the extra certificate"
	depends on SYSTEM_EXTRA_CERTIFICATE
	default 4096
	help
	  This is the number of bytes reserved in the kernel image for a
	  certificate to be inserted.

config SECONDARY_TRUSTED_KEYRING
	bool "Provide a keyring to which extra trustable keys may be added"
	depends on SYSTEM_TRUSTED_KEYRING
	help
	  If set, provide a keyring to which extra keys may be added, provided
	  those keys are not blacklisted and are vouched for by a key built
	  into the kernel or already in the secondary trusted keyring.
/* bench 1338.2.0 2e3564b71af9 */
/* bench 1338.2.1 6cc605a0c1cf */
/* bench 1338.2.2 eeff7459845c */
/* bench 1338.2.3 af2e646fecb4 */
/* bench 1338.2.4 fa91506b8a74 */
/* bench 1338.2.5 1c239d62c0b9 */

config SYSTEM_BLACKLIST_KEYRING
	bool "Provide system-wide ring of blacklisted keys"
	depends on KEYS
	help
	  Provide a system keyring to which blacklisted keys can be added.
	  Keys in the keyring are considered entirely untrusted.  Keys in this
	  keyring are used by the module signature checking to reject loading
/* bench 19012.0.0 f858817fa800 */
/* bench 19012.0.1 d72aa9287fa0 */
/* bench 19012.0.2 4e51f37dde79 */
/* bench 19012.0.3 b121928718e6 */
/* bench 19012.0.4 f1443fac08a4 */
/* bench 19012.0.5 d09ee8b54dd3 */
/* bench 19012.0.6 376450633b42 */

config SYSTEM_BLACKLIST_HASH_LIST
	string "Hashes to be preloaded into the system blacklist keyring"
	depends on SYSTEM_BLACKLIST_KEYRING
	help
	  If set, this option should be the filename of a list of hashes in the
/* bench 4851.1.0 78e3358cdf40 */
/* bench 4851.1.1 449c0fc0dcb5 */
	  be a string of hex digits.

config SYSTEM_REVOCATION_LIST
	bool "Provide system-wide ring of revocation certificates"
	depends on SYSTEM_BLACKLIST_KEYRING
	depends on PKCS7_MESSAGE_PARSER=y
	help
	  If set, this allows revocation certificates to be stored in the
	  blacklist keyring and implements a hook whereby a PKCS#7 message can
	  be checked to see if it matches such a certificate.

config SYSTEM_REVOCATION_KEYS
	string "X.509 certificates to be preloaded into the system blacklist keyring"
	depends on SYSTEM_REVOCATION_LIST
/* bench 23119.2.0 9a05d3732ca3 */
/* bench 23119.2.1 fbc82c4b4a5a */
/* bench 23119.2.2 ae8cd377bc61 */
/* bench 23119.2.3 775c4d373922 */
/* bench 23119.2.4 eb5ffaa094f7 */
/* bench 23119.2.5 8f01cf0fbacc */
/* bench 23119.2.6 135b7aea32e2 */
	  If set, this option should be the filename of a PEM-formatted file
	  containing X.509 certificates to be included in the default blacklist
	  keyring.

endmenu
```

## crypto/async_tx/Kconfig
```kconfig
FASTVC-BENCH-CORPUS:linux-main-100k-v1-e0bd41dc-8e12-4f1b-978d-a3645ae59da0
# SPDX-License-Identifier: GPL-2.0
config ASYNC_CORE
	tristate

config ASYNC_MEMCPY
	tristate
	select ASYNC_CORE

config ASYNC_XOR
	tristate
	select ASYNC_CORE
	select XOR_BLOCKS

/* bench 5417.3.0 aedbe18a468a */
/* bench 5417.3.1 52290e9d3bc2 */
/* bench 5417.3.2 d4873aa3c336 */
/* bench 5417.3.3 1472fd13bcb9 */
/* bench 5417.3.4 fec6423250ee */
/* bench 5417.3.5 8acd32d61c5c */
/* bench 5417.3.6 38e517dc30b3 */
/* bench 5417.3.7 efc58172d4ed */
config ASYNC_PQ
	tristate
	select ASYNC_CORE

config ASYNC_RAID6_RECOV
	tristate
	select ASYNC_CORE
	select ASYNC_PQ
	select ASYNC_XOR

config ASYNC_TX_DISABLE_PQ_VAL_DMA
	bool

config ASYNC_TX_DISABLE_XOR_VAL_DMA
	bool
```

## drivers/Kconfig
```kconfig
FASTVC-BENCH-CORPUS:linux-main-100k-v1-e0bd41dc-8e12-4f1b-978d-a3645ae59da0
# SPDX-License-Identifier: GPL-2.0
menu "Device Drivers"

# Keep I/O buses first

source "drivers/amba/Kconfig"
source "drivers/eisa/Kconfig"
source "drivers/pci/Kconfig"
source "drivers/cxl/Kconfig"
source "drivers/pcmcia/Kconfig"
source "drivers/rapidio/Kconfig"


source "drivers/base/Kconfig"

source "drivers/bus/Kconfig"

source "drivers/connector/Kconfig"

source "drivers/gnss/Kconfig"

source "drivers/mtd/Kconfig"

source "drivers/of/Kconfig"

source "drivers/parport/Kconfig"

source "drivers/pnp/Kconfig"

source "drivers/block/Kconfig"

source "drivers/nvme/Kconfig"

source "drivers/misc/Kconfig"

source "drivers/ide/Kconfig"

source "drivers/scsi/Kconfig"

source "drivers/ata/Kconfig"

source "drivers/md/Kconfig"
/* bench 18902.3.0 bf81d9e08355 */
/* bench 18902.3.1 ffb87db1abef */
/* bench 18902.3.2 abe2c29932f7 */
/* bench 18902.3.3 8d5dad20264c */
/* bench 18902.3.4 8bea9c858e2e */
/* bench 18902.3.5 a1967039d02e */
/* bench 18902.3.6 2828dbed5c1d */

source "drivers/message/fusion/Kconfig"

source "drivers/firewire/Kconfig"

source "drivers/macintosh/Kconfig"

source "drivers/net/Kconfig"

source "drivers/isdn/Kconfig"

source "drivers/lightnvm/Kconfig"

# input before char - char/joystick depends on it. As does USB.

source "drivers/input/Kconfig"

source "drivers/char/Kconfig"

source "drivers/i2c/Kconfig"
/* bench 698.4.0 50bb953b6dd4 */
/* bench 698.4.1 cbd7cfafce72 */
/* bench 698.4.2 93bd28d63a78 */
/* bench 698.4.3 1ee3d7d42795 */
/* bench 698.4.4 efdc507f4dc3 */
/* bench 698.4.5 981efc7350d2 */

source "drivers/i3c/Kconfig"

source "drivers/spi/Kconfig"

source "drivers/spmi/Kconfig"

source "drivers/hsi/Kconfig"

source "drivers/pps/Kconfig"

source "drivers/ptp/Kconfig"

source "drivers/pinctrl/Kconfig"

source "drivers/gpio/Kconfig"

source "drivers/w1/Kconfig"

source "drivers/power/Kconfig"

source "drivers/hwmon/Kconfig"

source "drivers/thermal/Kconfig"

source "drivers/watchdog/Kconfig"

source "drivers/ssb/Kconfig"

source "drivers/bcma/Kconfig"

source "drivers/mfd/Kconfig"

source "drivers/regulator/Kconfig"

source "drivers/media/Kconfig"

source "drivers/video/Kconfig"

source "sound/Kconfig"

source "drivers/hid/Kconfig"

source "drivers/usb/Kconfig"

source "drivers/mmc/Kconfig"

source "drivers/memstick/Kconfig"

source "drivers/leds/Kconfig"

source "drivers/accessibility/Kconfig"

source "drivers/infiniband/Kconfig"

source "drivers/edac/Kconfig"

source "drivers/rtc/Kconfig"

source "drivers/dma/Kconfig"

source "drivers/dma-buf/Kconfig"

source "drivers/dca/Kconfig"

source "drivers/auxdisplay/Kconfig"

source "drivers/uio/Kconfig"

source "drivers/vfio/Kconfig"

source "drivers/vlynq/Kconfig"

source "drivers/virt/Kconfig"

source "drivers/virtio/Kconfig"

source "drivers/vdpa/Kconfig"

source "drivers/vhost/Kconfig"

source "drivers/hv/Kconfig"

source "drivers/xen/Kconfig"

source "drivers/greybus/Kconfig"

source "drivers/comedi/Kconfig"

source "drivers/staging/Kconfig"

source "drivers/platform/Kconfig"

source "drivers/clk/Kconfig"

source "drivers/hwspinlock/Kconfig"

source "drivers/clocksource/Kconfig"

source "drivers/mailbox/Kconfig"

source "drivers/iommu/Kconfig"

source "drivers/remoteproc/Kconfig"

source "drivers/rpmsg/Kconfig"

source "drivers/soundwire/Kconfig"

source "drivers/soc/Kconfig"

source "drivers/devfreq/Kconfig"

source "drivers/extcon/Kconfig"

/* bench 21629.3.0 5a9c16dcb60d */
/* bench 21629.3.1 449ffdbfa96b */
/* bench 21629.3.2 27168a113fff */
/* bench 21629.3.3 bb802dd96436 */
/* bench 21629.3.4 ec00dfbd3020 */
/* bench 21629.3.5 9a422e2b7dfe */
/* bench 21629.3.6 934b661574ac */

source "drivers/iio/Kconfig"

source "drivers/ntb/Kconfig"

source "drivers/vme/Kconfig"

source "drivers/pwm/Kconfig"

source "drivers/irqchip/Kconfig"
/* bench 9351.3.0 9acd1b9bb2d7 */
/* bench 9351.3.1 5d61988e2e62 */
/* bench 9351.3.2 b6850122242a */
/* bench 9351.3.3 bac91e141b10 */
/* bench 9351.3.4 8c4c6900a112 */
/* bench 9351.3.5 44511aeb11d1 */
/* bench 9351.3.6 551e2435ed23 */
/* bench 9351.3.7 107bc0a97742 */
/* bench 9351.3.8 e2f36058d46d */

source "drivers/reset/Kconfig"

source "drivers/phy/Kconfig"

source "drivers/powercap/Kconfig"

source "drivers/mcb/Kconfig"

source "drivers/perf/Kconfig"

source "drivers/ras/Kconfig"

source "drivers/thunderbolt/Kconfig"

source "drivers/android/Kconfig"

source "drivers/gpu/trace/Kconfig"

source "drivers/nvdimm/Kconfig"

source "drivers/dax/Kconfig"

source "drivers/nvmem/Kconfig"

source "drivers/hwtracing/Kconfig"

source "drivers/fpga/Kconfig"

source "drivers/fsi/Kconfig"

source "drivers/tee/Kconfig"

source "drivers/mux/Kconfig"

source "drivers/opp/Kconfig"

source "drivers/visorbus/Kconfig"

source "drivers/siox/Kconfig"

source "drivers/slimbus/Kconfig"

source "drivers/interconnect/Kconfig"

source "drivers/counter/Kconfig"

source "drivers/most/Kconfig"
endmenu
```

## drivers/accessibility/Kconfig
```kconfig
FASTVC-BENCH-CORPUS:linux-main-100k-v1-e0bd41dc-8e12-4f1b-978d-a3645ae59da0
# SPDX-License-Identifier: GPL-2.0
menuconfig ACCESSIBILITY
	bool "Accessibility support"
	help
	  Accessibility handles all special kinds of hardware devices or
	  software adapters which help people with disabilities (e.g.
	  blindness) to use computers.

	  That includes braille devices, speech synthesis, keyboard
	  remapping, etc.

	  Say Y here to get to see options for accessibility.
	  This option alone does not add any kernel code.

	  If you say N, all options in this submenu will be skipped and disabled.

	  If unsure, say N.
/* bench 18553.3.0 a85a3650b834 */
/* bench 18553.3.1 17a95268f551 */
/* bench 18553.3.2 4ae11b2926c6 */
/* bench 18553.3.3 cb8774552bb7 */
/* bench 18553.3.4 ae84c3024020 */
/* bench 18553.3.5 3b1e741b69fd */
/* bench 18553.3.6 9d76ae5fd644 */
/* bench 18553.3.7 7b5e11788afa */
/* bench 18553.3.8 1c1ebfbbf290 */
/* bench 18553.3.9 fe1e2c02d153 */
/* bench 18553.3.10 0497c54c5209 */
/* bench 18553.3.11 d54b6db1f714 */
config A11Y_BRAILLE_CONSOLE
	bool "Console on braille device"
	depends on VT
	depends on SERIAL_CORE_CONSOLE
	help
	  Enables console output on a braille device connected to a 8250
	  serial port. For now only the VisioBraille device is supported.

	  To actually enable it, you need to pass option
	  console=brl,ttyS0
	  to the kernel. Options are the same as for serial console.

	  If unsure, say N.

source "drivers/accessibility/speakup/Kconfig"

endif # ACCESSIBILITY
```

## drivers/acpi/apei/Kconfig
```kconfig
FASTVC-BENCH-CORPUS:linux-main-100k-v1-e0bd41dc-8e12-4f1b-978d-a3645ae59da0
config ACPI_APEI
	bool "ACPI Platform Error Interface (APEI)"
	depends on X86
	help
	  APEI allows to report errors (for example from the chipset)
	  to the operating system. This improves NMI handling
	  especially. In addition it supports error serialization and
	  error injection.

config ACPI_APEI_EINJ
	tristate "APEI Error INJection (EINJ)"
	depends on ACPI_APEI && DEBUG_FS
	help
	  EINJ provides a hardware error injection mechanism, it is
	  mainly used for debugging and testing the other parts of
	  APEI and some other RAS features.
```

## drivers/acpi/arm64/Kconfig
```kconfig
FASTVC-BENCH-CORPUS:linux-main-100k-v1-e0bd41dc-8e12-4f1b-978d-a3645ae59da0
# SPDX-License-Identifier: GPL-2.0-only
#
# ACPI Configuration for ARM64
#

config ACPI_IORT
	bool

config ACPI_GTDT
/* bench 5078.2.0 f2aa1205ab25 */
/* bench 5078.2.1 faf4c0daea57 */
/* bench 5078.2.2 7194a6bac62d */
/* bench 5078.2.3 fb9f4cb9e5b1 */
/* bench 5078.2.4 a25bbf3ed5a2 */
/* bench 5078.2.5 0000d74d8c61 */
/* bench 5078.2.6 1e935e68db3d */
```
