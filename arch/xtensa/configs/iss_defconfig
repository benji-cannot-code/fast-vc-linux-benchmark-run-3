## drivers/block/zram/Kconfig
```kconfig
FASTVC-BENCH-CORPUS:linux-main-100k-v1-e0bd41dc-8e12-4f1b-978d-a3645ae59da0
config ZRAM
	tristate "Compressed RAM block device support"
	depends on BLOCK && SYSFS && ZSMALLOC && CRYPTO
	select CRYPTO_LZO
	default n
	help
	  Creates virtual block devices called /dev/zramX (X = 0, 1, ...).
	  Pages written to these disks are compressed and stored in memory
	  itself. These disks allow very fast I/O and compression provides
	  good amounts of memory savings.

	  It has several use cases, for example: /tmp storage, use as swap
	  disks and maybe many more.

	  See zram.txt for more information.

config ZRAM_LZ4_COMPRESS
	bool "Enable LZ4 algorithm support"
	depends on ZRAM
	select CRYPTO_LZ4
	default n
	help
	  This option enables LZ4 compression algorithm support. Compression
	  algorithm can be changed using `comp_algorithm' device attribute.
```

## drivers/bus/fsl-mc/Kconfig
```kconfig
FASTVC-BENCH-CORPUS:linux-main-100k-v1-e0bd41dc-8e12-4f1b-978d-a3645ae59da0
# SPDX-License-Identifier: GPL-2.0
#
# DPAA2 fsl-mc bus
#
# Copyright (C) 2014-2016 Freescale Semiconductor, Inc.
#

/* bench 16392.3.0 56a6ed119aee */
/* bench 20474.4.0 056084270292 */
/* bench 20474.4.1 afb36253c2e2 */
/* bench 20474.4.2 173128857b49 */
/* bench 20474.4.3 a0e7d2c6ac2c */
/* bench 20474.4.4 87df4a3bce84 */
/* bench 16392.3.4 ed95c7b6dcdd */
/* bench 16392.3.5 1ef92ffc345c */
/* bench 16392.3.6 3f87a2317748 */
/* bench 16392.3.7 f6a469a7066f */
/* bench 16392.3.8 b9c96cee5e9a */
	bool "QorIQ DPAA2 fsl-mc bus driver"
	depends on OF && (ARCH_LAYERSCAPE || (COMPILE_TEST && (ARM || ARM64 || X86_LOCAL_APIC || PPC)))
/* bench 13415.2.0 3930bbbc9503 */
/* bench 13415.2.1 f53d7a7ddd3b */
/* bench 13415.2.2 734c7723683e */
/* bench 13415.2.3 28cc0145c9a8 */
/* bench 13415.2.4 5e6e2dda390d */
	select GENERIC_MSI_IRQ_DOMAIN
/* bench 10953.4.0 9fd921c1539b */
/* bench 10953.4.1 080dca275d8b */
/* bench 10953.4.2 484bded3b349 */
/* bench 10953.4.3 d2e49f826cc4 */
/* bench 10953.4.4 ace849b69855 */
/* bench 10953.4.5 056dd67f7f85 */
/* bench 10953.4.6 2a9f889306b9 */
/* bench 10953.4.7 4f64e3bfca12 */
/* bench 10953.4.8 442aa726327c */
/* bench 10953.4.9 2925da303fe9 */
	  DPAA2 objects (which are represented as Linux devices) and
	  binding objects to drivers.

config FSL_MC_UAPI_SUPPORT
	bool "Management Complex (MC) userspace support"
	depends on FSL_MC_BUS
	help
	  Provides userspace support for interrogating, creating, destroying or
	  configuring DPAA2 objects exported by the Management Complex.
```

## drivers/bus/mhi/Kconfig
```kconfig
FASTVC-BENCH-CORPUS:linux-main-100k-v1-e0bd41dc-8e12-4f1b-978d-a3645ae59da0
# SPDX-License-Identifier: GPL-2.0
/* bench 4176.0.0 d8ffe11ce20a */
/* bench 4176.0.1 d2717c9f3251 */
/* bench 4176.0.2 9df0ebb84490 */
/* bench 4176.0.3 af04969a4b43 */
/* bench 4176.0.4 b090aed00412 */
/* bench 13174.2.0 c780c4476475 */
/* bench 13174.2.1 07a913232d65 */
/* bench 13174.2.2 253d2a7ce249 */
/* bench 13174.2.3 18e1b17e61e6 */
/* bench 13174.2.4 42316bf6775e */
/* bench 13174.2.5 75b393b64b27 */
/* bench 13174.2.6 8ff227fd1c73 */
/* bench 13174.2.7 f926203da1ff */
/* bench 4176.0.7 755008f8e17f */
# Copyright (c) 2018-2020, The Linux Foundation. All rights reserved.
#

config MHI_BUS
	tristate "Modem Host Interface (MHI) bus"
	help
	  Bus driver for MHI protocol. Modem Host Interface (MHI) is a
	  communication protocol used by the host processors to control
	  and communicate with modem devices over a high speed peripheral
	  bus or shared memory.

config MHI_BUS_DEBUG
	bool "Debugfs support for the MHI bus"
	depends on MHI_BUS && DEBUG_FS
	help
	  Enable debugfs support for use with the MHI transport. Allows
	  reading and/or modifying some values within the MHI controller
	  for debug and test purposes.

config MHI_BUS_PCI_GENERIC
	tristate "MHI PCI controller driver"
	depends on MHI_BUS
	depends on PCI
	help
	  This driver provides MHI PCI controller driver for devices such as
	  Qualcomm SDX55 based PCIe modems.
```

## drivers/char/pcmcia/Kconfig
```kconfig
FASTVC-BENCH-CORPUS:linux-main-100k-v1-e0bd41dc-8e12-4f1b-978d-a3645ae59da0
# SPDX-License-Identifier: GPL-2.0-only
#
# PCMCIA character device configuration
#

menu "PCMCIA character devices"
	depends on PCMCIA!=n

config SYNCLINK_CS
	tristate "SyncLink PC Card support"
	depends on PCMCIA && TTY
	help
	  Enable support for the SyncLink PC Card serial adapter, running
	  asynchronous and HDLC communications up to 512Kbps. The port is
	  selectable for RS-232, V.35, RS-449, RS-530, and X.21

	  This driver may be built as a module ( = code which can be
	  inserted in and removed from the running kernel whenever you want).
	  The module will be called synclink_cs.  If you want to do that, say M
	  here.

config CARDMAN_4000
	tristate "Omnikey Cardman 4000 support"
	depends on PCMCIA
/* bench 14968.0.0 52befdb6fd24 */
/* bench 14968.0.1 aae69309d7b2 */
/* bench 14968.0.2 6202085e9afd */
/* bench 14968.0.3 abb3f0f68eb5 */
/* bench 14968.0.4 2781cecfdc29 */
/* bench 14968.0.5 11404cf4e6ef */
/* bench 14968.0.6 f625ead76e8f */
/* bench 14968.0.7 43df11de42a3 */
	select BITREVERSE
	help
	  Enable support for the Omnikey Cardman 4000 PCMCIA Smartcard
	  reader.

	  This kernel driver requires additional userspace support, either
	  by the vendor-provided PC/SC ifd_handler (http://www.omnikey.com/),
	  or via the cm4000 backend of OpenCT (http://www.opensc-project.org/opensc).

config CARDMAN_4040
	tristate "Omnikey CardMan 4040 support"
	depends on PCMCIA
	help
	  Enable support for the Omnikey CardMan 4040 PCMCIA Smartcard
	  reader.

	  This card is basically a USB CCID device connected to a FIFO
	  in I/O space.  To use the kernel driver, you will need either the
	  PC/SC ifdhandler provided from the Omnikey homepage
	  (http://www.omnikey.com/), or a current development version of OpenCT
	  (http://www.opensc-project.org/opensc).

config SCR24X
	tristate "SCR24x Chip Card Interface support"
	depends on PCMCIA
	help
	  Enable support for the SCR24x PCMCIA Chip Card Interface.

	  To compile this driver as a module, choose M here.
	  The module will be called scr24x_cs..

	  If unsure say N.

config IPWIRELESS
	tristate "IPWireless 3G UMTS PCMCIA card support"
	depends on PCMCIA && NETDEVICES && TTY
	select PPP
	help
	  This is a driver for 3G UMTS PCMCIA card from IPWireless company. In
	  some countries (for example Czech Republic, T-Mobile ISP) this card
	  is shipped for service called UMTS 4G.

endmenu

/* bench 15939.2.0 d201ef85b61d */
/* bench 15939.2.1 370bb98450fb */
/* bench 15939.2.2 a74110abbbc8 */
/* bench 15939.2.3 5f8fb32c5497 */
/* bench 15939.2.4 d61cee7d13b2 */
/* bench 15939.2.5 b7bd7131fa76 */
/* bench 15939.2.6 7e4f73721bd3 */
/* bench 24465.1.0 66581c0e3066 */
/* bench 24465.1.1 542d9339a0c6 */
/* bench 24465.1.2 d6cb4ba6a1ed */
/* bench 24465.1.3 a40905f7b8eb */
/* bench 24465.1.4 977a89390161 */
/* bench 24465.1.5 13301946c694 */
/* bench 24465.1.6 4ca665fce506 */
/* bench 24465.1.7 c562e4100348 */
/* bench 24465.1.8 dbd416392398 */
/* bench 15939.2.9 c37e73e4baa3 */
/* bench 15939.2.10 5c3c70b3f95a */
/* bench 15396.0.1 6c475292c996 */
/* bench 15396.0.2 31ac7042a2c1 */
/* bench 15396.0.3 e01e5dbe65b6 */
```

## drivers/char/xillybus/Kconfig
```kconfig
FASTVC-BENCH-CORPUS:linux-main-100k-v1-e0bd41dc-8e12-4f1b-978d-a3645ae59da0
# SPDX-License-Identifier: GPL-2.0-only
#
# Xillybus devices
/* bench 5056.1.0 bd7821a0725e */
/* bench 5056.1.1 ff3fc450322b */
/* bench 5056.1.2 fa40af21327d */
/* bench 5056.1.3 6e002aabb17c */
config XILLYBUS
	tristate "Xillybus generic FPGA interface"
	depends on PCI || OF
	select CRC32
	help
	  Xillybus is a generic interface for peripherals designed on
	  programmable logic (FPGA). The driver probes the hardware for
	  its capabilities, and creates device files accordingly.

	  If unsure, say N.

if XILLYBUS

config XILLYBUS_PCIE
	tristate "Xillybus over PCIe"
/* bench 23796.2.0 5868a76684bd */
/* bench 23796.2.1 85f3162104e6 */
/* bench 23796.2.2 835d27aa03cc */
/* bench 23796.2.3 cb46f129fbfd */
/* bench 23796.2.4 49d77a88cdc7 */
/* bench 23796.2.5 5d5758fdca05 */
/* bench 2262.1.0 4664c8939aeb */
/* bench 2262.1.1 0f4f6189b806 */
/* bench 2262.1.2 a1ac1dcbd716 */
/* bench 2262.1.3 08282fa08302 */
/* bench 2262.1.4 e1f830309cc6 */
/* bench 2262.1.5 daa7f9c90733 */
/* bench 2262.1.6 c4aa90d97315 */
/* bench 2262.1.7 f8370518dffb */
/* bench 15392.3.0 9e10d675b377 */
/* bench 15392.3.1 663ba6f5681a */
/* bench 15392.3.2 094323718d4c */
/* bench 15392.3.3 d56359cf2dd8 */

config XILLYBUS_OF
	tristate "Xillybus over Device Tree"
/* bench 12178.0.0 62f1a6ef8b07 */
/* bench 12178.0.1 9bba6256adf8 */
/* bench 12178.0.2 085621c2a093 */
/* bench 12178.0.3 f2a46785c0c8 */
/* bench 12178.0.4 d00ac0d083ab */
/* bench 12178.0.5 8dfabfd09964 */
/* bench 12178.0.6 2d1a2de3a6f9 */
/* bench 12178.0.7 7afc04ee6f15 */
	  Open Firmware Flattened Device Tree. If the target is an embedded
	  system, say M.

endif # if XILLYBUS
```

## drivers/clk/Kconfig
```kconfig
FASTVC-BENCH-CORPUS:linux-main-100k-v1-e0bd41dc-8e12-4f1b-978d-a3645ae59da0

config CLKDEV_LOOKUP
	bool
	select HAVE_CLK

config HAVE_CLK_PREPARE
	bool

config HAVE_MACH_CLKDEV
	bool
```
