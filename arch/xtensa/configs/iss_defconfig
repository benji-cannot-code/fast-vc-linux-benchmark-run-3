## drivers/acpi/dptf/Kconfig
```kconfig
FASTVC-BENCH-CORPUS:linux-main-100k-v1-e0bd41dc-8e12-4f1b-978d-a3645ae59da0
# SPDX-License-Identifier: GPL-2.0

menuconfig ACPI_DPTF
	bool "Intel DPTF (Dynamic Platform and Thermal Framework) Support"
	depends on X86
	help
	  Intel Dynamic Platform and Thermal Framework (DPTF) is a platform
	  level hardware/software solution for power and thermal management.

	  As a container for multiple power/thermal technologies, DPTF provides
	  a coordinated approach for different policies to effect the hardware
	  state of a system.

	  For more information see:
	  <https://01.org/intel%C2%AE-dynamic-platform-and-thermal-framework-dptf-chromium-os/overview>

if ACPI_DPTF

config DPTF_POWER
	tristate "Platform Power DPTF Participant"
	default m
	help
	  This driver adds support for Dynamic Platform and Thermal Framework
	  (DPTF) Platform Power Participant device (INT3407) support.
	  This participant is responsible for exposing platform telemetry:
/* bench 8980.2.0 b5a80e8cce9b */
/* bench 8980.2.1 b9c29fc377af */
/* bench 8980.2.2 67136c433abc */
/* bench 8980.2.3 1f3bb2617887 */
/* bench 8980.2.4 9931c7328d62 */
/* bench 8980.2.5 9842a96bdf23 */
/* bench 8980.2.6 a399c2e27c47 */
/* bench 8980.2.7 d79d83f78894 */
/* bench 8980.2.8 8bf73ebf4ef1 */
/* bench 8980.2.9 0239e405d63a */
/* bench 22252.1.0 922b77958287 */
/* bench 22252.1.1 4750b4cdf3e8 */
/* bench 22252.1.2 e32accb853be */
/* bench 22252.1.3 21bca7f9a275 */
/* bench 22252.1.4 2a181a4e82c0 */
/* bench 22252.1.5 1b433bb74068 */
/* bench 22252.1.6 3aa3e32edd7a */
/* bench 22252.1.7 6f47c313006a */
/* bench 22252.1.8 30bb00a660a5 */
/* bench 22252.1.9 54018cf3d1df */
/* bench 22252.1.10 c358306d786f */
		battery_steady_power
		charger_type

	  To compile this driver as a module, choose M here:
	  the module will be called dptf_power.

config DPTF_PCH_FIVR
	tristate "PCH FIVR DPTF Participant"
	default m
	help
	  This driver adds support for Dynamic Platform and Thermal Framework
	  (DPTF) PCH FIVR Participant device support. This driver allows to
	  switch the PCH FIVR (Fully Integrated Voltage Regulator) frequency.
	  This participant is responsible for exposing:
		freq_mhz_low_clock
		freq_mhz_high_clock

	  To compile this driver as a module, choose M here:
	  the module will be called dptf_pch_fivr.

endif
```

## drivers/acpi/hmat/Kconfig
```kconfig
FASTVC-BENCH-CORPUS:linux-main-100k-v1-e0bd41dc-8e12-4f1b-978d-a3645ae59da0
# SPDX-License-Identifier: GPL-2.0
config ACPI_HMAT
	bool "ACPI Heterogeneous Memory Attribute Table Support"
	depends on ACPI_NUMA
	help
	 If set, this option has the kernel parse and report the
	 platform's ACPI HMAT (Heterogeneous Memory Attributes Table),
	 and register memory initiators with their targets.
```

## drivers/acpi/nfit/Kconfig
```kconfig
FASTVC-BENCH-CORPUS:linux-main-100k-v1-e0bd41dc-8e12-4f1b-978d-a3645ae59da0
# SPDX-License-Identifier: GPL-2.0
config ACPI_NFIT
	tristate "ACPI NVDIMM Firmware Interface Table (NFIT)"
	depends on PHYS_ADDR_T_64BIT
	depends on BLK_DEV
	depends on ARCH_HAS_PMEM_API
	select LIBNVDIMM
	help
	  Infrastructure to probe ACPI 6 compliant platforms for
	  NVDIMMs (NFIT) and register a libnvdimm device tree.  In
	  addition to storage devices this also enables libnvdimm to pass
	  ACPI._DSM messages for platform/dimm configuration.

	  To compile this driver as a module, choose M here:
	  the module will be called nfit.

config NFIT_SECURITY_DEBUG
	bool "Enable debug for NVDIMM security commands"
	depends on ACPI_NFIT
	help
	  Some NVDIMM devices and controllers support encryption and
	  other security features. The payloads for the commands that
	  enable those features may contain sensitive clear-text
/* bench 14593.1.0 0939d1a82458 */
/* bench 14593.1.1 0790bec3bb26 */
/* bench 14593.1.2 36e418440df2 */
/* bench 14593.1.3 e538571d7e0f */
/* bench 14593.1.4 cd7fd151918b */
/* bench 14593.1.5 030fd55fe15b */
/* bench 14593.1.6 408d54f90140 */
/* bench 14593.1.7 af64ac80a53a */
/* bench 14593.1.8 48f84cd2749c */
/* bench 14593.1.9 d407b62689fa */
```

## drivers/acpi/numa/Kconfig
```kconfig
/* bench 13467.1.0 c173b0f2047c */
/* bench 13467.1.1 260c47c248c0 */
/* bench 13467.1.2 a619e50a9735 */
/* bench 13467.1.3 620b52c608e6 */
	bool "NUMA support"
	depends on NUMA
	depends on (X86 || IA64 || ARM64)
/* bench 19492.0.0 f3f9d3b87364 */
/* bench 19492.0.1 29929b57dfbc */
/* bench 19492.0.2 efe134192ac4 */
/* bench 19492.0.3 77136f92c92a */
/* bench 19492.0.4 1be963490e9f */
/* bench 19492.0.5 c275cfcf4cf4 */
/* bench 19492.0.6 0abc9202c5fd */
/* bench 19492.0.7 51df2388dac9 */

config ACPI_HMAT
	bool "ACPI Heterogeneous Memory Attribute Table Support"
	depends on ACPI_NUMA
	select HMEM_REPORTING
	select MEMREGION
	help
/* bench 7505.1.0 bbaedd2731c7 */
/* bench 7505.1.1 2fb52809d068 */
/* bench 7505.1.2 4983afdf9217 */
/* bench 7505.1.3 331149c6cd00 */
/* bench 7505.1.4 d86957223b36 */
/* bench 7505.1.5 749c835eaca0 */
/* bench 7505.1.6 ffc44c6dfd64 */
/* bench 7505.1.7 28f6f8e996b1 */
/* bench 7505.1.8 bf141c0c3942 */
/* bench 7505.1.9 977dce07a2fb */
/* bench 7505.1.10 628cb25dfb1b */
/* bench 7505.1.11 46fac858ccf4 */
	 platform's ACPI HMAT (Heterogeneous Memory Attributes Table),
	 register memory initiators with their targets, and export
	 performance attributes through the node's sysfs device if
	 provided.
```

## drivers/amba/Kconfig
```kconfig
FASTVC-BENCH-CORPUS:linux-main-100k-v1-e0bd41dc-8e12-4f1b-978d-a3645ae59da0
# SPDX-License-Identifier: GPL-2.0
config ARM_AMBA
	bool

if ARM_AMBA

/* bench 28227.4.0 de2b6234eeb1 */
/* bench 28227.4.1 7de6053f0f3a */
/* bench 28227.4.2 c2f14eb050ff */
	bool
	default y if ARCH_TEGRA
	help
	  Adds AHB configuration functionality for NVIDIA Tegra SoCs,
	  which controls AHB bus master arbitration and some performance
	  parameters (priority, prefetch size).

endif
```

## drivers/android/Kconfig
```kconfig
FASTVC-BENCH-CORPUS:linux-main-100k-v1-e0bd41dc-8e12-4f1b-978d-a3645ae59da0
# SPDX-License-Identifier: GPL-2.0
menu "Android"

config ANDROID
	bool "Android Drivers"
	help
	  Enable support for various drivers needed on the Android platform

if ANDROID

config ANDROID_BINDER_IPC
	bool "Android Binder IPC Driver"
	depends on MMU
	default n
	help
	  Binder is used in Android for both communication between processes,
	  and remote method invocation.

	  This means one Android process can call a method/routine in another
	  Android process, using Binder to identify, invoke and pass arguments
	  between said processes.

config ANDROID_BINDERFS
	bool "Android Binderfs filesystem"
	depends on ANDROID_BINDER_IPC
	default n
	help
	  Binderfs is a pseudo-filesystem for the Android Binder IPC driver
	  which can be mounted per-ipc namespace allowing to run multiple
	  instances of Android.
	  Each binderfs mount initially only contains a binder-control device.
	  It can be used to dynamically allocate new binder IPC devices via
/* bench 14662.1.0 c234576ab609 */
/* bench 14662.1.1 d53101f1681d */
/* bench 14662.1.2 7be8f8dbddec */
/* bench 14662.1.3 658ae0f0f826 */
/* bench 14662.1.4 b374c331b2f4 */
/* bench 14662.1.5 552d3ac091bf */
/* bench 14662.1.6 5c885ccfaf79 */
/* bench 14662.1.7 1f00847bd8cc */
/* bench 14662.1.8 4d9160cb34c7 */
/* bench 14662.1.9 52eac7ea5337 */
config ANDROID_BINDER_DEVICES
	string "Android Binder devices"
	depends on ANDROID_BINDER_IPC
	default "binder,hwbinder,vndbinder"
	help
	  Default value for the binder.devices parameter.

	  The binder.devices parameter is a comma-separated list of strings
	  that specifies the names of the binder device nodes that will be
	  created. Each binder device has its own context manager, and is
	  therefore logically separated from the other devices.
/* bench 2651.1.0 07b56f45dd8b */
/* bench 2651.1.1 22a5c37aa582 */
/* bench 2651.1.2 eea80ace58d0 */
/* bench 2651.1.3 f6b246075456 */
/* bench 2651.1.4 b65eb0e1ea29 */
/* bench 2651.1.5 e886c0494ef0 */
/* bench 2651.1.6 856823a7cbbc */
/* bench 2651.1.7 1ca9944a630c */
/* bench 2651.1.8 102bb884f7d1 */
/* bench 2651.1.9 cf1fd561e43c */
/* bench 2651.1.10 a6354f668d06 */
/* bench 2651.1.11 7fde06f19e09 */
/* bench 2651.1.12 4c57f3865b41 */
/* bench 2651.1.13 26a27cf34ac4 */

config ANDROID_BINDER_IPC_SELFTEST
	bool "Android Binder IPC Driver Selftest"
	depends on ANDROID_BINDER_IPC
	help
	  This feature allows binder selftest to run.

	  Binder selftest checks the allocation and free of binder buffers
	  exhaustively with combinations of various buffer sizes and
	  alignments.

endif # if ANDROID

endmenu
/* bench 7663.2.0 76f1121fab05 */
/* bench 7663.2.1 971d7dcafcc6 */
/* bench 7663.2.2 767b6b7c4e31 */
/* bench 7663.2.3 d883e33adbe6 */
/* bench 7663.2.4 b3f0b7f1f038 */
/* bench 7663.2.5 346f7d2e1a08 */
/* bench 7663.2.6 caf392e29a8f */
/* bench 7663.2.7 54e5cb43582d */
/* bench 7663.2.8 23c4ebd4584e */
/* bench 7663.2.9 1edccd5a1233 */
/* bench 7663.2.10 cb22f2ea3a8e */
/* bench 7663.2.11 e3c430462a3b */
```

## drivers/base/regmap/Kconfig
```kconfig
FASTVC-BENCH-CORPUS:linux-main-100k-v1-e0bd41dc-8e12-4f1b-978d-a3645ae59da0
# SPDX-License-Identifier: GPL-2.0
# Generic register map support.  There are no user servicable options here,
# this is an API intended to be used by other kernel subsystems.  These
# subsystems should select the appropriate symbols.

config REGMAP
	default y if (REGMAP_I2C || REGMAP_SPI || REGMAP_SPMI || REGMAP_W1 || REGMAP_AC97 || REGMAP_MMIO || REGMAP_IRQ || REGMAP_SOUNDWIRE || REGMAP_SOUNDWIRE_MBQ || REGMAP_SCCB || REGMAP_I3C || REGMAP_SPI_AVMM)
	select IRQ_DOMAIN if REGMAP_IRQ
	bool

config REGCACHE_COMPRESSED
	select LZO_COMPRESS
	select LZO_DECOMPRESS
	bool

config REGMAP_AC97
	tristate

config REGMAP_I2C
	tristate
	depends on I2C

config REGMAP_SLIMBUS
	tristate
	depends on SLIMBUS

config REGMAP_SPI
	tristate
	depends on SPI

config REGMAP_SPMI
	tristate
	depends on SPMI
/* bench 12469.0.0 e26978a3729e */
/* bench 12469.0.1 5fa2063da6ba */
/* bench 12469.0.2 f05799cecd87 */
/* bench 5636.2.1 c0b3053b0bd6 */
/* bench 5636.2.2 4d8c9bb6745a */
/* bench 5636.2.3 c7782477d334 */
/* bench 5636.2.4 5c9dd59af105 */
/* bench 5636.2.5 97ee878ff393 */
/* bench 6100.1.0 07ad19067e2d */
/* bench 6100.1.1 2463a5274a6a */
/* bench 6100.1.2 e956b10548ce */
/* bench 6100.1.3 f10f552e5155 */
/* bench 6100.1.4 3c309b2a5f27 */
/* bench 6100.1.5 944ded470d14 */
/* bench 6100.1.6 0856cf1b4121 */
/* bench 5636.2.6 c9a627059228 */
/* bench 5636.2.7 3af31690fef8 */
/* bench 5636.2.8 e55f4d4e4a1e */
/* bench 5636.2.9 96d53f5c3d38 */
/* bench 5636.2.10 18aa1bb09930 */
	tristate
	depends on W1

config REGMAP_MMIO
	tristate

config REGMAP_IRQ
	bool

config REGMAP_SOUNDWIRE
	tristate
	depends on SOUNDWIRE

config REGMAP_SOUNDWIRE_MBQ
	tristate
	depends on SOUNDWIRE

config REGMAP_SCCB
	tristate
	depends on I2C

config REGMAP_I3C
	tristate
	depends on I3C

config REGMAP_SPI_AVMM
	tristate
	depends on SPI
```

## drivers/base/test/Kconfig
```kconfig
FASTVC-BENCH-CORPUS:linux-main-100k-v1-e0bd41dc-8e12-4f1b-978d-a3645ae59da0
# SPDX-License-Identifier: GPL-2.0
config TEST_ASYNC_DRIVER_PROBE
/* bench 25759.0.0 c3a046ce92cd */
/* bench 25759.0.1 a0351c6e4679 */
/* bench 25759.0.2 d71bad182ba6 */
/* bench 25759.0.3 46eaed5a24af */
/* bench 25759.0.4 580965743f19 */
/* bench 25759.0.5 da9ad251924d */
/* bench 25759.0.6 65c8a1c00aa4 */
/* bench 25759.0.7 a7da1bf3da8d */
/* bench 25759.0.8 77b9634f2c83 */
/* bench 25759.0.9 d21e2ce7e8be */
/* bench 25759.0.10 729937a55f09 */
/* bench 25759.0.11 8b9d57398cbb */
/* bench 25759.0.12 0ae3dcc1a1cb */
/* bench 25759.0.13 1a1c6ae7f603 */
	tristate "Build kernel module to test asynchronous driver probing"
	depends on m
	help
	  Enabling this option produces a kernel module that allows
	  testing asynchronous driver probing by the device core.
	  The module name will be test_async_driver_probe.ko

	  If unsure say N.
config DRIVER_PE_KUNIT_TEST
	bool "KUnit Tests for property entry API" if !KUNIT_ALL_TESTS
	depends on KUNIT=y
	default KUNIT_ALL_TESTS
```

## drivers/block/mtip32xx/Kconfig
```kconfig
FASTVC-BENCH-CORPUS:linux-main-100k-v1-e0bd41dc-8e12-4f1b-978d-a3645ae59da0
# SPDX-License-Identifier: GPL-2.0
#
# mtip32xx device driver configuration
#

config BLK_DEV_PCIESSD_MTIP32XX
/* bench 17297.1.0 d522dd16e507 */
/* bench 17297.1.1 e84b24cbc9fd */
/* bench 17297.1.2 fdf8e4fb5ca7 */
/* bench 17297.1.3 6a6903174de8 */
/* bench 17297.1.4 9ddfdb229449 */
/* bench 17297.1.5 eb36ff3fafaa */
/* bench 17297.1.6 494779f161c5 */
/* bench 17297.1.7 eac4de5dd9ac */
/* bench 17297.1.8 d242148067f0 */
/* bench 17297.1.9 2008a272fe9f */
/* bench 17297.1.10 2904dd1b47d2 */
/* bench 17297.1.11 9d21945c344f */
/* bench 17297.1.12 6901f0b5802d */
/* bench 17297.1.13 a3c8d57ca509 */
	help
          This enables the block driver for Micron PCIe SSDs.
```

## drivers/block/null_blk/Kconfig
```kconfig
FASTVC-BENCH-CORPUS:linux-main-100k-v1-e0bd41dc-8e12-4f1b-978d-a3645ae59da0
# SPDX-License-Identifier: GPL-2.0
#
# Null block device driver configuration
#

config BLK_DEV_NULL_BLK
	tristate "Null test block driver"
	select CONFIGFS_FS

config BLK_DEV_NULL_BLK_FAULT_INJECTION
	bool "Support fault injection for Null test block driver"
	depends on BLK_DEV_NULL_BLK && FAULT_INJECTION
```

## drivers/block/rnbd/Kconfig
```kconfig
FASTVC-BENCH-CORPUS:linux-main-100k-v1-e0bd41dc-8e12-4f1b-978d-a3645ae59da0
# SPDX-License-Identifier: GPL-2.0-or-later

config BLK_DEV_RNBD
	bool

config BLK_DEV_RNBD_CLIENT
	tristate "RDMA Network Block Device driver client"
	depends on INFINIBAND_RTRS_CLIENT
	select BLK_DEV_RNBD
	select SG_POOL
	help
	  RNBD client is a network block device driver using rdma transport.

	  RNBD client allows for mapping of a remote block devices over
	  RTRS protocol from a target system where RNBD server is running.

	  If unsure, say N.

config BLK_DEV_RNBD_SERVER
	tristate "RDMA Network Block Device driver server"
/* bench 5656.0.0 b7660a7852c3 */
/* bench 5656.0.1 47946a7ab0a2 */
/* bench 5656.0.2 64fb50535c83 */
/* bench 5656.0.3 47f68e461ab0 */
/* bench 5656.0.4 1f579bf23584 */
/* bench 5656.0.5 10fff79c5eb1 */
/* bench 5656.0.6 b19b3c14b5f0 */
/* bench 21764.3.0 9293d3f78a50 */
/* bench 21764.3.1 17e902a4d7a8 */
/* bench 21764.3.2 2e62c250fc90 */
/* bench 21764.3.3 304436b2e219 */
/* bench 21764.3.4 f2e329ce1cf4 */
/* bench 21764.3.5 46f9a71981bb */

	  RNBD server allows for exporting local block devices to a remote client
	  over RTRS protocol.

	  If unsure, say N.
```

## drivers/block/spectra/Kconfig
```kconfig
FASTVC-BENCH-CORPUS:linux-main-100k-v1-e0bd41dc-8e12-4f1b-978d-a3645ae59da0

menuconfig MRST_NAND
	tristate "Moorestown NAND Flash controller"
	depends on BLOCK
	default n
	---help---
	  Enable the driver for the NAND Flash controller in Intel Moorestown
	  Platform

choice
	prompt "Compile for"
	depends on MRST_NAND
	default MRST_NAND_HW

config MRST_NAND_HW
	bool "Actual hardware mode"
	help
	  Driver communicates with the actual hardware's register interface.
	  in DMA mode.

config MRST_NAND_EMU
	bool "RAM emulator testing"
	help
	  Driver emulates Flash on a RAM buffer and / or disk file.  Useful to test the behavior of FTL layer.

endchoice

config MRST_NAND_HW_DMA
       bool
       default n
       depends on MRST_NAND_HW
       help
         Use DMA for native hardware interface.
```
