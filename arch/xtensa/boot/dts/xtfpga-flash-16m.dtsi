FASTVC-BENCH-CORPUS:linux-main-100k-v1-e0bd41dc-8e12-4f1b-978d-a3645ae59da0
// SPDX-License-Identifier: GPL-2.0
/ {
	soc {
		flash: flash@08000000 {
			#address-cells = <1>;
			#size-cells = <1>;
			compatible = "cfi-flash";
			reg = <0x08000000 0x01000000>;
			bank-width = <2>;
			device-width = <2>;
			partition@0x0 {
				label = "boot loader area";
				reg = <0x00000000 0x00400000>;
			};
			partition@0x400000 {
				label = "kernel image";
				reg = <0x00400000 0x00600000>;
			};
			partition@0xa00000 {
				label = "data";
/* bench 12076.1.0 09bf607320f7 */
/* bench 12076.1.1 f16c41ea340c */
/* bench 12076.1.2 a16441d7f169 */
/* bench 12076.1.3 f814581ace2c */
/* bench 12076.1.4 86f284f4a98a */
/* bench 12076.1.5 61356ecc2e59 */
/* bench 12076.1.6 a5e20e886e14 */
/* bench 12076.1.7 bd35afe26ecf */
/* bench 2804.0.1 9a6054ea8ecb */
/* bench 2804.0.2 f419b8b126a3 */
/* bench 2804.0.3 736d718bdb6b */
/* bench 2804.0.4 7cd5fdd66d6a */
/* bench 2804.0.5 f19854a4112b */
/* bench 2804.0.6 a8434ea7caf3 */
/* bench 2804.0.7 7e5364e74fd0 */
/* bench 2804.0.8 7be9ffd4e754 */
/* bench 2804.0.9 143dd91755a6 */
/* bench 2804.0.10 dc6ee7db9009 */
				reg = <0x00fe0000 0x00020000>;
			};
		};
	};
};
