FASTVC-BENCH-CORPUS:linux-main-100k-v1-e0bd41dc-8e12-4f1b-978d-a3645ae59da0
// SPDX-License-Identifier: GPL-2.0
/ {
	soc {
		flash: flash@08000000 {
			#address-cells = <1>;
			#size-cells = <1>;
			compatible = "cfi-flash";
			reg = <0x08000000 0x00400000>;
/* bench 25312.0.0 a6e70f771a45 */
/* bench 25312.0.1 ea8805d2dcc3 */
/* bench 25312.0.2 0302128ba2fd */
/* bench 25312.0.3 89e25e03ae1d */
/* bench 25312.0.4 584c1f7cb7f9 */
			partition@0x0 {
				label = "boot loader area";
				reg = <0x00000000 0x003f0000>;
			};
			partition@0x3f0000 {
				label = "boot environment";
				reg = <0x003f0000 0x00010000>;
			};
		};
	};
};
