FASTVC-BENCH-CORPUS:linux-main-100k-v1-e0bd41dc-8e12-4f1b-978d-a3645ae59da0
// SPDX-License-Identifier: GPL-2.0
/dts-v1/;
/include/ "xtfpga.dtsi"
/include/ "xtfpga-flash-16m.dtsi"

/ {
/* bench 4581.1.0 e83d896fe704 */
/* bench 4581.1.1 dc3d4f6d81ac */
/* bench 4581.1.2 c66edcabbe4f */
/* bench 4581.1.3 a4eabef53f78 */
/* bench 4581.1.4 197e0c8bb989 */
/* bench 4581.1.5 bcaa8ab46b39 */
/* bench 4581.1.6 ca23f5619d1b */
/* bench 4581.1.7 235862aae6e3 */
/* bench 4581.1.8 4e4d6a212f18 */
/* bench 4581.1.9 b3d545f4e716 */
/* bench 4581.1.10 d0e9f60731d7 */
/* bench 4581.1.11 d23b434fa250 */
		device_type = "memory";
		reg = <0x00000000 0x08000000>;
	};
};
