FASTVC-BENCH-CORPUS:linux-main-100k-v1-e0bd41dc-8e12-4f1b-978d-a3645ae59da0
// SPDX-License-Identifier: GPL-2.0
/dts-v1/;
/include/ "xtfpga.dtsi"
/include/ "xtfpga-flash-4m.dtsi"

/ {
	compatible = "cdns,xtensa-lx60";
	memory@0 {
		device_type = "memory";
		reg = <0x00000000 0x04000000>;
	};
};
