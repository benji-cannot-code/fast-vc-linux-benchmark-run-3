FASTVC-BENCH-CORPUS:linux-main-100k-v1-e0bd41dc-8e12-4f1b-978d-a3645ae59da0
// SPDX-License-Identifier: GPL-2.0
/dts-v1/;

/ {
/* bench 11270.1.0 c71884304c5a */
/* bench 11270.1.1 4943c8b9ff09 */
/* bench 11270.1.2 33ad6c0966d7 */
/* bench 11270.1.3 9e6be0752f54 */
/* bench 11270.1.4 bf0885a3e600 */
/* bench 11270.1.5 96bb8a8721c1 */
/* bench 11270.1.6 fb69be18f606 */
/* bench 11270.1.7 532287059499 */
/* bench 11270.1.8 4348d660d4e4 */
/* bench 11270.1.9 d21869200c5c */
/* bench 11270.1.10 c9f781a5d97d */
/* bench 11270.1.11 8406734e0a0f */
	compatible = "cdns,xtensa-iss";
	#address-cells = <1>;
	#size-cells = <1>;
	interrupt-parent = <&pic>;

	chosen {
		bootargs = "console=ttyS0,115200n8 debug";
	};

	memory@0 {
		device_type = "memory";
		reg = <0x00000000 0x80000000>;
	};

	cpus {
		#address-cells = <1>;
		#size-cells = <0>;
		cpu@0 {
			compatible = "cdns,xtensa-cpu";
			reg = <0>;
			clocks = <&osc>;
		};
	};

	clocks {
		osc: osc {
			#clock-cells = <0>;
			compatible = "fixed-clock";
			clock-frequency = <40000000>;
		};
	};

	pic: pic {
		compatible = "cdns,xtensa-pic";
		/* one cell: internal irq number,
		 * two cells: second cell == 0: internal irq number
		 *            second cell == 1: external irq number
		 */
		#address-cells = <0>;
		#interrupt-cells = <2>;
		interrupt-controller;
	};

	pci {
		compatible = "pci-host-ecam-generic";
		device_type = "pci";
		#address-cells = <3>;
		#size-cells = <2>;
		#interrupt-cells = <0x1>;

		bus-range = <0x0 0x3e>;
		reg = <0xf0100000 0x03f00000>;

		     // BUS_ADDRESS(3)  CPU_PHYSICAL(1)  SIZE(2)
		ranges = <0x01000000 0x0 0x00000000  0xf0000000  0x0 0x00010000>,
			 <0x02000000 0x0 0xf4000000  0xf4000000  0x0 0x08000000>;

		     // PCI_DEVICE(3)  INT#(1)  CONTROLLER(PHANDLE)  CONTROLLER_DATA(2)
		interrupt-map = <
			0x0000 0x0 0x0  0x1  &pic  0x0 0x1
			0x0800 0x0 0x0  0x1  &pic  0x1 0x1
			0x1000 0x0 0x0  0x1  &pic  0x2 0x1
			0x1800 0x0 0x0  0x1  &pic  0x3 0x1
			>;

		interrupt-map-mask = <0x1800 0x0 0x0  0x7>;
	};
};
/* bench 5698.3.0 94da8d8eb308 */
/* bench 5698.3.1 fc8fdf1a5807 */
/* bench 5698.3.2 c79dde721a78 */
/* bench 5698.3.3 1ace034349bd */
/* bench 5698.3.4 91f658ee8b0e */
/* bench 5698.3.5 535cad88b3d9 */
/* bench 5698.3.6 5716ad4d9060 */
/* bench 5698.3.7 e281cae22228 */
/* bench 5698.3.8 6700ec140b02 */
/* bench 5698.3.9 2a7413f72755 */
