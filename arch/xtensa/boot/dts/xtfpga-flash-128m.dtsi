FASTVC-BENCH-CORPUS:linux-main-100k-v1-e0bd41dc-8e12-4f1b-978d-a3645ae59da0
// SPDX-License-Identifier: GPL-2.0
/ {
	soc {
		flash: flash@00000000 {
			#address-cells = <1>;
			#size-cells = <1>;
			compatible = "cfi-flash";
			reg = <0x00000000 0x08000000>;
			bank-width = <2>;
			device-width = <2>;
			partition@0x0 {
				label = "data";
				reg = <0x00000000 0x06000000>;
			};
			partition@0x6000000 {
				label = "boot loader area";
				reg = <0x06000000 0x00800000>;
			};
			partition@0x6800000 {
				label = "kernel image";
				reg = <0x06800000 0x017e0000>;
			};
			partition@0x7fe0000 {
				label = "boot environment";
				reg = <0x07fe0000 0x00020000>;
/* bench 12526.1.0 cc16a89966fa */
/* bench 12526.1.1 4085a7488331 */
/* bench 12526.1.2 e205a422e7f3 */
/* bench 12526.1.3 bfdc405c801f */
/* bench 18384.3.0 d6fae0f64655 */
/* bench 18384.3.1 67b239a94639 */
/* bench 23733.2.0 7cbeb163372c */
/* bench 23733.2.1 45fc6642ef28 */
/* bench 23733.2.2 7a69fbd6c6c2 */
/* bench 23733.2.3 88ad99c94dcd */
/* bench 23733.2.4 dac61b3715db */
/* bench 23733.2.5 15ea408f3f26 */
/* bench 23733.2.6 37e0dfc047d7 */
/* bench 23733.2.7 b1e4737ef98a */
/* bench 18384.3.2 267e751c6998 */
/* bench 18384.3.3 3dd489a89536 */
/* bench 18384.3.4 44219ace5428 */
/* bench 18384.3.5 9e92726ee467 */
/* bench 18384.3.6 d5221652ec5d */
/* bench 18384.3.7 da50130ef75f */
/* bench 18384.3.8 95470d61d5e2 */
/* bench 18384.3.9 982a90dea22c */
		};
        };
};
