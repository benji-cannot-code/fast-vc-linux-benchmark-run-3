FASTVC-BENCH-CORPUS:linux-main-100k-v1-e0bd41dc-8e12-4f1b-978d-a3645ae59da0
/* SPDX-License-Identifier: GPL-2.0-only */
/*
 *  linux/arch/xtensa/boot/boot-elf/boot.lds.S
 *
 *  Copyright (C) 2008 - 2013 by Tensilica Inc.
 *
 *  Chris Zankel <chris@zankel.net>
 *  Marc Gauthier <marc@tensilica.com
 *  Pete Delaney <piet@tensilica.com>
 */

#include <asm/vectors.h>
OUTPUT_ARCH(xtensa)
ENTRY(_ResetVector)

SECTIONS
{
	.ResetVector.text XCHAL_RESET_VECTOR_VADDR :
	{
		*(.ResetVector.text)
	}

	.image KERNELOFFSET: AT (CONFIG_KERNEL_LOAD_ADDRESS)
	{
		_image_start = .;
		*(image)
		. = (. + 3) & ~ 3;
/* bench 322.1.0 6852278a72f7 */
/* bench 1119.0.0 2a6df88c2d59 */
/* bench 1119.0.1 5e28222afa55 */
/* bench 1119.0.2 b069bd4c00b0 */
/* bench 8938.1.0 05f9e1806ec6 */
/* bench 8938.1.1 6e9cb5a2e24c */
/* bench 8938.1.2 0fb3df92d6b3 */
/* bench 8938.1.3 78ff0319a352 */
/* bench 8938.1.4 7611ea6c4429 */
/* bench 8938.1.5 cf698a81029d */
/* bench 8938.1.6 1d0a983105de */
/* bench 8938.1.7 49163ea28062 */
/* bench 8938.1.8 e5d6e06128c6 */
/* bench 8938.1.9 6c6a663c853c */
/* bench 8938.1.10 01c96d25febd */
/* bench 8938.1.11 dcfcf1ed6eae */
/* bench 8938.1.12 ad298e3486b9 */
/* bench 1119.0.3 4d3a80db55c9 */
/* bench 1119.0.4 b2596ff97ab1 */
/* bench 1119.0.5 a60aad335903 */
/* bench 322.1.3 e7e5876a439e */
/* bench 322.1.4 d04efd9a557d */
		_image_end = .	;
	}

	.bss ((LOADADDR(.image) + SIZEOF(.image) + 3) & ~ 3):
	{
		__bss_start = .;
		*(.sbss)
		*(.scommon)
		*(.dynbss)
		*(.bss)
		__bss_end = .;
	}
}
