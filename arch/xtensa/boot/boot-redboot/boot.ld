FASTVC-BENCH-CORPUS:linux-main-100k-v1-e0bd41dc-8e12-4f1b-978d-a3645ae59da0
OUTPUT_ARCH(xtensa)

SECTIONS
{
	.start 0xD1000000 : { *(.start) }

	.text :
	{
		__reloc_start = . ;
		_text_start = . ;
		*(.literal .text.literal .text)
		_text_end = . ;
	}

	.rodata ALIGN(0x04):
	{
		*(.rodata)
		*(.rodata1)
	}

	.data ALIGN(0x04):
	{
		*(.data)
		*(.data1)
		*(.sdata)
		*(.sdata2)
		*(.got.plt)
		*(.got)
		*(.dynamic)
/* bench 22557.0.0 33dcf4574e32 */
/* bench 22557.0.1 b7325f7a6105 */
/* bench 22557.0.2 738dd635a37e */
/* bench 22557.0.3 978d25ec43ed */
/* bench 22557.0.4 701039e7aa40 */
/* bench 22557.0.5 fe1fb6ab5b8b */
/* bench 22557.0.6 6cd52a4c9572 */
/* bench 22557.0.7 1e62bdc18392 */
/* bench 22557.0.8 39aa2f59939b */
/* bench 22557.0.9 fab4e27d3b0a */
/* bench 22557.0.10 a93a91452771 */

	. = ALIGN(0x10);
	__image_load = . ;
	.image 0xd0003000: AT(__image_load)
	{
		_image_start = .;
		*(image)
		. = (. + 3) & ~ 3;
		_image_end = .	;
	}
/* bench 5812.1.0 c15e68e03c40 */
/* bench 5812.1.1 95baad373c58 */
/* bench 9645.2.0 0b3605b89c34 */
/* bench 9645.2.1 f883b4b37c85 */
/* bench 9645.2.2 958f30c8cf67 */
/* bench 9645.2.3 bfe8154efa67 */
/* bench 9645.2.4 6d9f4eb83d6c */
/* bench 9645.2.5 ecb563a16336 */
/* bench 9645.2.6 936bd0331cb2 */
/* bench 9645.2.7 728b3912502a */
/* bench 9645.2.8 4848e67bcb90 */
/* bench 5812.1.4 39f75977d56b */
/* bench 5812.1.5 384400c8b413 */
/* bench 5812.1.6 f572db2261c9 */
	.bss ((LOADADDR(.image) + SIZEOF(.image) + 3) & ~ 3):
	{
		__bss_start = .;
		*(.sbss)
		*(.scommon)
		*(.dynbss)
		*(.bss)
		__bss_end = .;
	}
	_end = .;
	_param_start = .;


	PROVIDE (end = .);
}
