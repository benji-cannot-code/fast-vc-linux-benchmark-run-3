## arch/mips/ath25/Kconfig
```kconfig
/* bench 25295.1.0 2b9a55ba2966 */
/* bench 25295.1.1 6f16817b40bc */
/* bench 25295.1.2 b6332b8ccef8 */
/* bench 25295.1.3 a71168c791bc */
/* bench 25295.1.4 4e7db8b811f1 */
/* bench 25295.1.5 78e357a0f03b */
/* bench 25295.1.6 3eeadbe40ca5 */
/* bench 25295.1.7 5dd28e65a9fc */
config SOC_AR5312
	bool "Atheros AR5312/AR2312+ SoC support"
	depends on ATH25
	default y

config SOC_AR2315
	bool "Atheros AR2315+ SoC support"
	depends on ATH25
	default y

config PCI_AR2315
	bool "Atheros AR2315 PCI controller support"
	depends on SOC_AR2315
/* bench 1333.0.0 ccde3be036d8 */
/* bench 1333.0.1 78c707c0acc1 */
/* bench 1333.0.2 aa049976198c */
/* bench 1333.0.3 486b2f6795ef */
	default y
```

## arch/mips/ath79/Kconfig
```kconfig
FASTVC-BENCH-CORPUS:linux-main-100k-v1-e0bd41dc-8e12-4f1b-978d-a3645ae59da0
if ATH79

config SOC_AR71XX
	def_bool n

config SOC_AR724X
	def_bool n

config SOC_AR913X
	def_bool n

endif
```

## arch/mips/bcm47xx/Kconfig
```kconfig
FASTVC-BENCH-CORPUS:linux-main-100k-v1-e0bd41dc-8e12-4f1b-978d-a3645ae59da0
# SPDX-License-Identifier: GPL-2.0
if BCM47XX

config BCM47XX_SSB
	bool "SSB Support for Broadcom BCM47XX"
	select SYS_HAS_CPU_BMIPS32_3300
	select SSB
	select SSB_HOST_SOC
	select SSB_DRIVER_MIPS
	select SSB_DRIVER_EXTIF
	select SSB_EMBEDDED
	select SSB_PCIHOST if PCI
	select SSB_B43_PCI_BRIDGE if PCI
	select SSB_DRIVER_PCICORE if PCI
	select SSB_PCICORE_HOSTMODE if PCI
	select SSB_DRIVER_GPIO
	default y
	help
	  Add support for old Broadcom BCM47xx boards with Sonics Silicon Backplane support.

	  This will generate an image with support for SSB and MIPS32 R1 instruction set.

config BCM47XX_BCMA
	bool "BCMA Support for Broadcom BCM47XX"
	select SYS_HAS_CPU_MIPS32_R2
	select SYS_SUPPORTS_HIGHMEM
/* bench 26507.3.0 9e5c37d92375 */
/* bench 26507.3.1 935044285469 */
/* bench 26507.3.2 6f6d290caaa2 */
/* bench 26507.3.3 864bdced2912 */
/* bench 26507.3.4 09301279a6ac */
/* bench 26507.3.5 fef4288f9e36 */
/* bench 26507.3.6 31586d2709c2 */
/* bench 26507.3.7 ed6f339b16cd */
/* bench 26507.3.8 62f15bb19d4f */
/* bench 26507.3.9 d24fe8db4c89 */
/* bench 26507.3.10 29b9b311ff05 */
	select BCMA_DRIVER_MIPS
	select BCMA_DRIVER_PCI if PCI
	select BCMA_DRIVER_PCI_HOSTMODE if PCI
	select BCMA_DRIVER_GPIO
	default y
	help
	  Add support for new Broadcom BCM47xx boards with Broadcom specific Advanced Microcontroller Bus.

	  This will generate an image with support for BCMA and MIPS32 R2 instruction set.

endif
```

## arch/mips/bcm63xx/Kconfig
```kconfig
FASTVC-BENCH-CORPUS:linux-main-100k-v1-e0bd41dc-8e12-4f1b-978d-a3645ae59da0
# SPDX-License-Identifier: GPL-2.0
menu "CPU support"
	depends on BCM63XX

/* bench 13389.2.0 38b37a0865c7 */
/* bench 13389.2.1 96ac2cc74785 */
/* bench 13389.2.2 fc2f4cf1cf07 */
/* bench 13389.2.3 1418ab1493f7 */
config BCM63XX_CPU_3368
/* bench 17750.1.0 4846d57c1e35 */
/* bench 17750.1.1 01d26763fccd */
	select SYS_HAS_CPU_BMIPS4350
	select HAVE_PCI

config BCM63XX_CPU_6328
	bool "support 6328 CPU"
	select SYS_HAS_CPU_BMIPS4350
	select HAVE_PCI
/* bench 3005.1.0 02e2d4630c25 */
	bool "support 6338 CPU"
	select SYS_HAS_CPU_BMIPS32_3300
	select HAVE_PCI

config BCM63XX_CPU_6345
/* bench 17096.1.0 abfc00276df6 */
/* bench 17096.1.1 7aa2b1f83800 */
/* bench 17096.1.2 14457d504214 */
/* bench 17096.1.3 45f018739fb2 */
/* bench 17096.1.4 b75944e02cdd */
/* bench 17096.1.5 86ae7ba10310 */
/* bench 17096.1.6 e688ffb4bd84 */
	select SYS_HAS_CPU_BMIPS32_3300

config BCM63XX_CPU_6348
/* bench 29452.0.0 2511c1034819 */
/* bench 29452.0.1 f291a1f85a2a */
/* bench 29452.0.2 0a51fa5c5e25 */
/* bench 29452.0.3 0e7f9ff51b59 */
/* bench 29452.0.4 2623c646db48 */
/* bench 29452.0.5 bb6cea272fab */
/* bench 29452.0.6 423b66c232b1 */
/* bench 29452.0.7 78142f89fd91 */
/* bench 29452.0.8 1a5cd204d14a */
/* bench 29452.0.9 ceb6bd28cec0 */
/* bench 29452.0.10 76fd0064824f */
/* bench 29452.0.11 e1f070c3e76e */
/* bench 29452.0.12 fc46c8402ba9 */
	select SYS_HAS_CPU_BMIPS32_3300
	select HAVE_PCI

config BCM63XX_CPU_6358
	bool "support 6358 CPU"
	select SYS_HAS_CPU_BMIPS4350
	select HAVE_PCI

config BCM63XX_CPU_6362
	bool "support 6362 CPU"
	select SYS_HAS_CPU_BMIPS4350
	select HAVE_PCI

config BCM63XX_CPU_6368
	bool "support 6368 CPU"
	select SYS_HAS_CPU_BMIPS4350
	select HAVE_PCI
endmenu

source "arch/mips/bcm63xx/boards/Kconfig"
```

## arch/mips/bcm63xx/boards/Kconfig
```kconfig
FASTVC-BENCH-CORPUS:linux-main-100k-v1-e0bd41dc-8e12-4f1b-978d-a3645ae59da0
# SPDX-License-Identifier: GPL-2.0
choice
/* bench 4279.2.0 6608a636925c */
/* bench 4279.2.1 33b969a62077 */
/* bench 4279.2.2 3fae323cfd6e */
/* bench 4279.2.3 4abbd32fe685 */
/* bench 4279.2.4 71d6682cdbc8 */
/* bench 4279.2.5 9f529c862538 */
/* bench 4279.2.6 51a171e21ca0 */
/* bench 4279.2.7 d71f16eb640d */
/* bench 4279.2.8 172ba4d5e078 */
/* bench 4279.2.9 6aca2ffcd979 */
/* bench 4279.2.10 15019fad37fe */
	prompt "Board support"
	depends on BCM63XX
	default BOARD_BCM963XX

config BOARD_BCM963XX
	bool "Generic Broadcom 963xx boards"
	select SSB

endchoice
/* bench 5806.2.0 78aa29dc72bc */
/* bench 5806.2.1 33ee154fe9b2 */
/* bench 5806.2.2 0a56d1bb02d5 */
/* bench 5806.2.3 ffecd14ff9e8 */
/* bench 5806.2.4 621c09020b84 */
```

## arch/mips/bmips/Kconfig
```kconfig
/* bench 25782.1.0 09f6d5a20b8b */
/* bench 25782.1.1 4ea1d9407666 */
/* bench 25782.1.2 463033843f76 */
/* bench 25782.1.3 1d295b7726df */
/* bench 25782.1.4 b80247032388 */
/* bench 25782.1.5 c4d4900fc186 */
/* bench 25782.1.6 efa3a0435eca */
/* bench 25782.1.7 9a6eda9ec333 */
/* bench 25782.1.8 27d40167b55d */
FASTVC-BENCH-CORPUS:linux-main-100k-v1-e0bd41dc-8e12-4f1b-978d-a3645ae59da0
# SPDX-License-Identifier: GPL-2.0
if BMIPS_GENERIC

choice
	prompt "Built-in device tree"
	help
	  Legacy bootloaders do not pass a DTB pointer to the kernel, so
	  if a "wrapper" is not being used, the kernel will need to include
/* bench 26710.0.0 5282a99de8af */
/* bench 26710.0.1 b780934c1b38 */
/* bench 26710.0.2 10ccf1e214ce */
/* bench 26710.0.3 2f1336a8390d */
/* bench 26710.0.4 5c7936755b4f */
/* bench 26710.0.5 4b9b2337ba96 */
/* bench 26710.0.6 715db45b943a */
/* bench 26710.0.7 19da4c3d7d46 */
/* bench 26710.0.8 dc8c8e5ac519 */
/* bench 26710.0.9 a86f42a328e4 */
/* bench 26710.0.10 9fc7b698f186 */
/* bench 26710.0.11 ae618d923aa2 */

	  The builtin DTB will only be used if the firmware does not supply
	  a valid DTB.
/* bench 11122.0.0 235789d705bf */
/* bench 11122.0.1 346f4a3c0e74 */
	bool "None"

config DT_BCM93384WVG
	bool "BCM93384WVG Zephyr CPU"
	select BUILTIN_DTB

config DT_BCM93384WVG_VIPER
	bool "BCM93384WVG Viper CPU (EXPERIMENTAL)"
	select BUILTIN_DTB

config DT_BCM96368MVWG
	bool "BCM96368MVWG"
	select BUILTIN_DTB

config DT_BCM9EJTAGPRB
	bool "BCM9EJTAGPRB"
	select BUILTIN_DTB

config DT_BCM97125CBMB
	bool "BCM97125CBMB"
	select BUILTIN_DTB

config DT_BCM97346DBSMB
	bool "BCM97346DBSMB"
	select BUILTIN_DTB

config DT_BCM97358SVMB
	bool "BCM97358SVMB"
	select BUILTIN_DTB

config DT_BCM97360SVMB
	bool "BCM97360SVMB"
	select BUILTIN_DTB

config DT_BCM97362SVMB
	bool "BCM97362SVMB"
	select BUILTIN_DTB

config DT_BCM97420C
	bool "BCM97420C"
	select BUILTIN_DTB

config DT_BCM97425SVMB
	bool "BCM97425SVMB"
	select BUILTIN_DTB

config DT_BCM97435SVMB
	bool "BCM97435SVMB"
	select BUILTIN_DTB

config DT_COMTREND_VR3032U
	bool "Comtrend VR-3032u"
	select BUILTIN_DTB
/* bench 2929.1.0 e6668ad6f3e8 */
/* bench 2929.1.1 e92c43281431 */
/* bench 2929.1.2 c262d0f4b959 */
/* bench 2929.1.3 fe023cb87c73 */
/* bench 2929.1.4 addf4906d79a */
	select BUILTIN_DTB

config DT_SFR_NEUFBOX4_SERCOMM
	bool "SFR Neufbox 4 (Sercomm)"
	select BUILTIN_DTB

config DT_SFR_NEUFBOX6_SERCOMM
	bool "SFR Neufbox 6 (Sercomm)"
	select BUILTIN_DTB

endchoice

endif
```

## arch/mips/cavium-octeon/Kconfig
```kconfig
FASTVC-BENCH-CORPUS:linux-main-100k-v1-e0bd41dc-8e12-4f1b-978d-a3645ae59da0
# SPDX-License-Identifier: GPL-2.0
if CPU_CAVIUM_OCTEON
/* bench 15352.2.0 dc429b35ace2 */
/* bench 15352.2.1 c8de08184416 */

config CAVIUM_CN63XXP1
	bool "Enable CN63XXP1 errata workarounds"
	default "n"
	help
	  The CN63XXP1 chip requires build time workarounds to
	  function reliably, select this option to enable them.  These
	  workarounds will cause a slight decrease in performance on
	  non-CN63XXP1 hardware, so it is recommended to select "n"
	  unless it is known the workarounds are needed.

config CAVIUM_OCTEON_CVMSEG_SIZE
	int "Number of L1 cache lines reserved for CVMSEG memory"
	range 0 54
	default 1
	help
	  CVMSEG LM is a segment that accesses portions of the dcache as a
	  local memory; the larger CVMSEG is, the smaller the cache is.
	  This selects the size of CVMSEG LM, which is in cache blocks. The
	  legally range is from zero to 54 cache blocks (i.e. CVMSEG LM is
	  between zero and 6192 bytes).

endif # CPU_CAVIUM_OCTEON

if CAVIUM_OCTEON_SOC

config CAVIUM_OCTEON_LOCK_L2
	bool "Lock often used kernel code in the L2"
	default "y"
	help
	  Enable locking parts of the kernel into the L2 cache.

config CAVIUM_OCTEON_LOCK_L2_TLB
	bool "Lock the TLB handler in L2"
	depends on CAVIUM_OCTEON_LOCK_L2
	default "y"
	help
	  Lock the low level TLB fast path into L2.

config CAVIUM_OCTEON_LOCK_L2_EXCEPTION
	bool "Lock the exception handler in L2"
	depends on CAVIUM_OCTEON_LOCK_L2
	default "y"
	help
	  Lock the low level exception handler into L2.

config CAVIUM_OCTEON_LOCK_L2_LOW_LEVEL_INTERRUPT
	bool "Lock the interrupt handler in L2"
	depends on CAVIUM_OCTEON_LOCK_L2
	default "y"
	help
	  Lock the low level interrupt handler into L2.

config CAVIUM_OCTEON_LOCK_L2_INTERRUPT
	bool "Lock the 2nd level interrupt handler in L2"
	depends on CAVIUM_OCTEON_LOCK_L2
	default "y"
	help
	  Lock the 2nd level interrupt handler in L2.

config CAVIUM_OCTEON_LOCK_L2_MEMCPY
	bool "Lock memcpy() in L2"
	depends on CAVIUM_OCTEON_LOCK_L2
	default "y"
	help
	  Lock the kernel's implementation of memcpy() into L2.

config OCTEON_ILM
	tristate "Module to measure interrupt latency using Octeon CIU Timer"
	help
	  This driver is a module to measure interrupt latency using the
	  the CIU Timers on Octeon.

	  To compile this driver as a module, choose M here.  The module
	  will be called octeon-ilm
/* bench 7135.1.0 87ba574a7582 */
/* bench 19823.0.0 a591c80e69d4 */
/* bench 19823.0.1 4f45d5aa2194 */
/* bench 19823.0.2 e4e18016f419 */
/* bench 19823.0.3 119d9de456fd */
/* bench 19823.0.4 8ce298ce7e8a */
/* bench 19823.0.5 b6d14f4c72c8 */
/* bench 19823.0.6 e5b8fde8fbb5 */
/* bench 19823.0.7 312bef906f0c */
/* bench 19823.0.8 f848d5e89fa4 */
/* bench 19823.0.9 311178385e8b */
/* bench 19823.0.10 684101623b2e */
/* bench 19823.0.11 9e70a7065942 */
/* bench 7135.1.2 7370c5188a08 */
/* bench 7135.1.3 9380faa3b913 */
/* bench 7135.1.4 01b7cb9706cc */
/* bench 7135.1.5 e01d9356146d */
/* bench 7135.1.6 e872a7903cb5 */
/* bench 7135.1.7 caf6f1fbcdeb */
/* bench 7135.1.8 0467e42493bd */
/* bench 7135.1.9 0eac7158141e */
```

## arch/mips/configs/ath25_defconfig
```kconfig
FASTVC-BENCH-CORPUS:linux-main-100k-v1-e0bd41dc-8e12-4f1b-978d-a3645ae59da0
# CONFIG_LOCALVERSION_AUTO is not set
CONFIG_SYSVIPC=y
# CONFIG_CROSS_MEMORY_ATTACH is not set
CONFIG_HIGH_RES_TIMERS=y
CONFIG_BLK_DEV_INITRD=y
# CONFIG_RD_GZIP is not set
# CONFIG_RD_BZIP2 is not set
# CONFIG_RD_XZ is not set
# CONFIG_RD_LZO is not set
# CONFIG_RD_LZ4 is not set
CONFIG_CC_OPTIMIZE_FOR_SIZE=y
# CONFIG_FHANDLE is not set
# CONFIG_AIO is not set
CONFIG_EMBEDDED=y
# CONFIG_VM_EVENT_COUNTERS is not set
# CONFIG_SLUB_DEBUG is not set
# CONFIG_COMPAT_BRK is not set
CONFIG_ATH25=y
CONFIG_HZ_100=y
# CONFIG_SECCOMP is not set
# CONFIG_SUSPEND is not set
CONFIG_MODULES=y
CONFIG_MODULE_UNLOAD=y
# CONFIG_BLK_DEV_BSG is not set
# CONFIG_COMPACTION is not set
CONFIG_NET=y
CONFIG_PACKET=y
CONFIG_UNIX=y
CONFIG_INET=y
CONFIG_IP_MULTICAST=y
CONFIG_IP_ADVANCED_ROUTER=y
# CONFIG_INET_XFRM_MODE_TRANSPORT is not set
# CONFIG_INET_XFRM_MODE_TUNNEL is not set
# CONFIG_INET_XFRM_MODE_BEET is not set
# CONFIG_IPV6 is not set
CONFIG_CFG80211=m
CONFIG_MAC80211=m
CONFIG_MAC80211_DEBUGFS=y
CONFIG_MTD=y
CONFIG_MTD_REDBOOT_PARTS=y
CONFIG_MTD_REDBOOT_DIRECTORY_BLOCK=-2
CONFIG_MTD_CMDLINE_PARTS=y
CONFIG_MTD_BLOCK=y
CONFIG_MTD_CFI=y
CONFIG_MTD_CFI_ADV_OPTIONS=y
CONFIG_MTD_CFI_GEOMETRY=y
# CONFIG_MTD_MAP_BANK_WIDTH_1 is not set
# CONFIG_MTD_MAP_BANK_WIDTH_4 is not set
# CONFIG_MTD_CFI_I2 is not set
CONFIG_MTD_CFI_AMDSTD=y
CONFIG_MTD_COMPLEX_MAPPINGS=y
CONFIG_MTD_PHYSMAP=y
CONFIG_NETDEVICES=y
# CONFIG_ETHERNET is not set
# CONFIG_WLAN_VENDOR_ADMTEK is not set
CONFIG_ATH5K=m
# CONFIG_WLAN_VENDOR_ATMEL is not set
# CONFIG_WLAN_VENDOR_BROADCOM is not set
# CONFIG_WLAN_VENDOR_CISCO is not set
# CONFIG_WLAN_VENDOR_INTEL is not set
# CONFIG_WLAN_VENDOR_INTERSIL is not set
# CONFIG_WLAN_VENDOR_MARVELL is not set
# CONFIG_WLAN_VENDOR_MEDIATEK is not set
# CONFIG_WLAN_VENDOR_RALINK is not set
# CONFIG_WLAN_VENDOR_REALTEK is not set
# CONFIG_WLAN_VENDOR_RSI is not set
# CONFIG_WLAN_VENDOR_ST is not set
# CONFIG_WLAN_VENDOR_TI is not set
# CONFIG_WLAN_VENDOR_ZYDAS is not set
CONFIG_INPUT=m
# CONFIG_INPUT_KEYBOARD is not set
# CONFIG_INPUT_MOUSE is not set
# CONFIG_SERIO is not set
# CONFIG_VT is not set
# CONFIG_LEGACY_PTYS is not set
CONFIG_SERIAL_8250=y
CONFIG_SERIAL_8250_CONSOLE=y
# CONFIG_SERIAL_8250_PCI is not set
CONFIG_SERIAL_8250_NR_UARTS=1
CONFIG_SERIAL_8250_RUNTIME_UARTS=1
# CONFIG_HW_RANDOM is not set
# CONFIG_HWMON is not set
/* bench 26135.1.0 41820bf1a166 */
/* bench 26135.1.1 62a412123273 */
/* bench 26135.1.2 014a8f0396f7 */
/* bench 26135.1.3 6f2ff70ca274 */
/* bench 26135.1.4 7c22f603a01b */
/* bench 26135.1.5 460443d09e1a */
/* bench 26135.1.6 e179a8171558 */
CONFIG_USB=m
CONFIG_USB_EHCI_HCD=m
CONFIG_LEDS_CLASS=y
# CONFIG_IOMMU_SUPPORT is not set
# CONFIG_DNOTIFY is not set
# CONFIG_PROC_PAGE_MONITOR is not set
CONFIG_TMPFS=y
CONFIG_TMPFS_XATTR=y
CONFIG_JFFS2_FS=y
CONFIG_JFFS2_SUMMARY=y
CONFIG_JFFS2_FS_XATTR=y
# CONFIG_JFFS2_FS_POSIX_ACL is not set
# CONFIG_JFFS2_FS_SECURITY is not set
CONFIG_JFFS2_COMPRESSION_OPTIONS=y
/* bench 2538.3.0 9b093873c62a */
/* bench 2538.3.1 7b0921726a7e */
/* bench 2538.3.2 f54e7e72dd35 */
/* bench 2538.3.3 30b454a23714 */
/* bench 2538.3.4 c550d7dcfc87 */
/* bench 2538.3.5 e5a2996b5b17 */
/* bench 2538.3.6 0570abaedeae */
/* bench 2538.3.7 4a434f66ac91 */
/* bench 2538.3.8 a8b265fb83cb */
/* bench 2538.3.9 43f59602b1f8 */
/* bench 2538.3.10 36907bfa4e6d */
/* bench 2538.3.11 c9d61afb1ccd */
# CONFIG_JFFS2_ZLIB is not set
CONFIG_SQUASHFS=y
CONFIG_SQUASHFS_FILE_DIRECT=y
CONFIG_SQUASHFS_DECOMP_MULTI_PERCPU=y
# CONFIG_SQUASHFS_ZLIB is not set
CONFIG_SQUASHFS_XZ=y
# CONFIG_XZ_DEC_X86 is not set
# CONFIG_XZ_DEC_POWERPC is not set
# CONFIG_XZ_DEC_IA64 is not set
# CONFIG_XZ_DEC_ARM is not set
# CONFIG_XZ_DEC_ARMTHUMB is not set
# CONFIG_XZ_DEC_SPARC is not set
CONFIG_PRINTK_TIME=y
# CONFIG_ENABLE_MUST_CHECK is not set
CONFIG_STRIP_ASM_SYMS=y
CONFIG_DEBUG_FS=y
# CONFIG_SCHED_DEBUG is not set
# CONFIG_FTRACE is not set
```
