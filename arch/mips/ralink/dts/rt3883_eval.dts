FASTVC-BENCH-CORPUS:linux-main-100k-v1-e0bd41dc-8e12-4f1b-978d-a3645ae59da0
/dts-v1/;

/include/ "rt3883.dtsi"

/ {
	compatible = "ralink,rt3883-eval-board", "ralink,rt3883-soc";
	model = "Ralink RT3883 evaluation board";

	memory@0 {
		reg = <0x0 0x2000000>;
	};

	chosen {
		bootargs = "console=ttyS0,57600";
	};
};
