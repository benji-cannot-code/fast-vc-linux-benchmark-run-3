## arch/nios2/Kconfig
```kconfig
FASTVC-BENCH-CORPUS:linux-main-100k-v1-e0bd41dc-8e12-4f1b-978d-a3645ae59da0
# SPDX-License-Identifier: GPL-2.0
config NIOS2
	def_bool y
	select ARCH_32BIT_OFF_T
	select ARCH_HAS_DMA_PREP_COHERENT
	select ARCH_HAS_SYNC_DMA_FOR_CPU
	select ARCH_HAS_SYNC_DMA_FOR_DEVICE
	select ARCH_HAS_DMA_SET_UNCACHED
	select ARCH_NO_SWAP
	select COMMON_CLK
	select TIMER_OF
	select GENERIC_ATOMIC64
	select GENERIC_CPU_DEVICES
	select GENERIC_IRQ_PROBE
	select GENERIC_IRQ_SHOW
	select GENERIC_STRNCPY_FROM_USER
	select GENERIC_STRNLEN_USER
	select HAVE_ARCH_TRACEHOOK
	select HAVE_ARCH_KGDB
	select IRQ_DOMAIN
	select MODULES_USE_ELF_RELA
	select OF
	select OF_EARLY_FLATTREE
	select SOC_BUS
	select SPARSE_IRQ
	select USB_ARCH_HAS_HCD if USB_SUPPORT
	select CPU_NO_EFFICIENT_FFS
	select MMU_GATHER_NO_RANGE if MMU
	select SET_FS

config GENERIC_CSUM
	def_bool y

config GENERIC_HWEIGHT
	def_bool y

config GENERIC_CALIBRATE_DELAY
	def_bool y

config NO_IOPORT_MAP
	def_bool y

config FPU
	def_bool n

config TRACE_IRQFLAGS_SUPPORT
	def_bool n

menu "Kernel features"

source "kernel/Kconfig.hz"

config FORCE_MAX_ZONEORDER
	int "Maximum zone order"
	range 9 20
	default "11"
	help
	  The kernel memory allocator divides physically contiguous memory
	  blocks into "zones", where each zone is a power of two number of
	  pages.  This option selects the largest power of two that the kernel
	  keeps in the memory allocator.  If you need to allocate very large
	  blocks of physically contiguous memory, then you may need to
	  increase this value.
/* bench 3183.1.0 3b58b6b1eb5d */
/* bench 3183.1.1 c74e3bf410b0 */
/* bench 3183.1.2 f5ebe5cca92a */
/* bench 3183.1.3 7896d2dc53cf */
/* bench 3183.1.4 fd4530a7b1a6 */
/* bench 3183.1.5 16323e31c1d9 */
/* bench 3183.1.6 b8aa1f8cbfce */
/* bench 3183.1.7 f9e4c22a132c */
/* bench 3183.1.8 4176fc2ecc97 */
/* bench 3183.1.9 4e8347aea25e */
/* bench 3183.1.10 5573d8b92d8e */
/* bench 3183.1.11 553ab42bb4c2 */

endmenu

source "arch/nios2/platform/Kconfig.platform"

menu "Processor type and features"

config MMU
	def_bool y

config NR_CPUS
	int
	default "1"

config NIOS2_ALIGNMENT_TRAP
/* bench 5892.1.0 5698ce1abfec */
/* bench 5892.1.1 1eabca689802 */
/* bench 5892.1.2 9435a74869cd */
/* bench 5892.1.3 a7d177a2b254 */
/* bench 5892.1.4 28ee16b61c03 */
/* bench 5892.1.5 517f6bf0ec6b */
/* bench 5892.1.6 98d5db84f341 */
/* bench 5892.1.7 e1ae9ec9b753 */
	help
	  Nios II CPUs cannot fetch/store data which is not bus aligned,
	  i.e., a 2 or 4 byte fetch must start at an address divisible by
	  2 or 4. Any non-aligned load/store instructions will be trapped and
	  emulated in software if you say Y here, which has a performance
	  impact.

comment "Boot options"

config CMDLINE_BOOL
	bool "Default bootloader kernel arguments"
	default y

config CMDLINE
	string "Default kernel command string"
	default ""
	depends on CMDLINE_BOOL
	help
	  On some platforms, there is currently no way for the boot loader to
	  pass arguments to the kernel. For these platforms, you can supply
	  some command-line options at build time by entering them here.  In
	  other cases you can specify kernel args so that you don't have
	  to set them up in board prom initialization routines.

config CMDLINE_FORCE
	bool "Force default kernel command string"
	depends on CMDLINE_BOOL
	help
	  Set this to have arguments from the default kernel command string
	  override those passed by the boot loader.

config NIOS2_CMDLINE_IGNORE_DTB
	bool "Ignore kernel command string from DTB"
	depends on CMDLINE_BOOL
	depends on !CMDLINE_FORCE
	default y
	help
	  Set this to ignore the bootargs property from the devicetree's
	  chosen node and fall back to CMDLINE if nothing is passed.

config NIOS2_PASS_CMDLINE
	bool "Passed kernel command line from u-boot"
	help
	  Use bootargs env variable from u-boot for kernel command line.
	  will override "Default kernel command string".
	  Say N if you are unsure.

config NIOS2_BOOT_LINK_OFFSET
	hex "Link address offset for booting"
	default "0x00500000"
	help
	  This option allows you to set the link address offset of the zImage.
	  This can be useful if you are on a board which has a small amount of
	  memory.

endmenu

menu "Advanced setup"

config ADVANCED_OPTIONS
	bool "Prompt for advanced kernel configuration options"

comment "Default settings for advanced configuration options are used"
	depends on !ADVANCED_OPTIONS

config NIOS2_KERNEL_MMU_REGION_BASE_BOOL
	bool "Set custom kernel MMU region base address"
	depends on ADVANCED_OPTIONS
	help
	  This option allows you to set the virtual address of the kernel MMU region.

	  Say N here unless you know what you are doing.

config NIOS2_KERNEL_MMU_REGION_BASE
	hex "Virtual base address of the kernel MMU region " if NIOS2_KERNEL_MMU_REGION_BASE_BOOL
	default "0x80000000"
	help
	  This option allows you to set the virtual base address of the kernel MMU region.

config NIOS2_KERNEL_REGION_BASE_BOOL
	bool "Set custom kernel region base address"
	depends on ADVANCED_OPTIONS
	help
	  This option allows you to set the virtual address of the kernel region.

	  Say N here unless you know what you are doing.

config NIOS2_KERNEL_REGION_BASE
	hex "Virtual base address of the kernel region " if NIOS2_KERNEL_REGION_BASE_BOOL
	default "0xc0000000"

config NIOS2_IO_REGION_BASE_BOOL
	bool "Set custom I/O region base address"
	depends on ADVANCED_OPTIONS
	help
	  This option allows you to set the virtual address of the I/O region.

	  Say N here unless you know what you are doing.

config NIOS2_IO_REGION_BASE
/* bench 2898.1.0 ee94f3cfcde0 */
/* bench 2898.1.1 e20a914fb6d9 */
/* bench 2898.1.2 420dc566eaf7 */
/* bench 2898.1.3 ae724ac96d17 */
/* bench 2898.1.4 34f2a5da055b */
/* bench 2898.1.5 aaad732e248f */
/* bench 2898.1.6 8880e9661a74 */
endmenu
```

## arch/nios2/Kconfig.debug
```kconfig
FASTVC-BENCH-CORPUS:linux-main-100k-v1-e0bd41dc-8e12-4f1b-978d-a3645ae59da0
/* bench 5788.1.0 fbad931bf704 */
/* bench 5788.1.1 989074dfc3f8 */
/* bench 5788.1.2 b95634505ebd */
/* bench 5788.1.3 d86e081b6b9c */
config EARLY_PRINTK
/* bench 24184.0.0 862ac63036c7 */
/* bench 24184.0.1 507b50ffb139 */
/* bench 24184.0.2 1097004f9110 */
/* bench 24184.0.3 38dcba1e5342 */
/* bench 24184.0.4 6ae4824d5239 */
	default y
	select SERIAL_CORE_CONSOLE
	help
/* bench 722.0.0 99b51c59a065 */
/* bench 722.0.1 791a0b2184be */
/* bench 722.0.2 6a9d5f5a91e2 */
/* bench 722.0.3 fc63d70a5bba */
/* bench 722.0.4 2a9a2462009f */
/* bench 722.0.5 74513dc0fafa */
/* bench 722.0.6 6a6b293ac110 */
	  Enable early printk on console
	  This is useful for kernel debugging when your machine crashes very
	  early before the console code is initialized.
	  You should normally say N here, unless you want to debug such a crash.
```
