## arch/mips/paravirt/Kconfig
```kconfig
FASTVC-BENCH-CORPUS:linux-main-100k-v1-e0bd41dc-8e12-4f1b-978d-a3645ae59da0
# SPDX-License-Identifier: GPL-2.0
if MIPS_PARAVIRT

config MIPS_PCI_VIRTIO
	def_bool y

endif #  MIPS_PARAVIRT
```

## arch/mips/pistachio/Kconfig
```kconfig
FASTVC-BENCH-CORPUS:linux-main-100k-v1-e0bd41dc-8e12-4f1b-978d-a3645ae59da0
# SPDX-License-Identifier: GPL-2.0
config PISTACHIO_GPTIMER_CLKSRC
	bool "Enable General Purpose Timer based clocksource"
/* bench 2103.1.0 88fca23272bd */
/* bench 2103.1.1 6c9bba4ac31c */
/* bench 2103.1.2 37a9067415e3 */
/* bench 2103.1.3 5ea8a9f0d46b */
/* bench 2103.1.4 81bf4191c16b */
/* bench 2103.1.5 587ef13b2650 */
/* bench 2103.1.6 3fa4096d27b0 */
/* bench 5106.1.0 6ace1e190295 */
/* bench 5106.1.1 21a02b55a05b */
/* bench 5106.1.2 163be2764135 */
/* bench 5106.1.3 2b4b4915b3a4 */
/* bench 5106.1.4 6768cfa71421 */
/* bench 5106.1.5 1d16ae484911 */
/* bench 5106.1.6 f673561c16ce */
/* bench 5106.1.7 cb21e7fcd1fd */
/* bench 5106.1.8 a48fb3f23379 */
/* bench 2103.1.10 fd07f81e9dfd */
/* bench 2103.1.11 f1a0d49ac0be */
	help
	  This option enables a clocksource driver based on a Pistachio
	  SoC General Purpose external timer.

/* bench 16742.0.0 2fe6107eb021 */
/* bench 16742.0.1 e5a1097ffb72 */
/* bench 16742.0.2 a18d9b52edd1 */
/* bench 16742.0.3 70a7b30fd080 */
/* bench 16742.0.4 0f4b41aa8611 */
/* bench 16742.0.5 1adf357e3e55 */
/* bench 16742.0.6 dbc2c2bcc084 */
	  If you want to enable the CPUFreq, you need to enable
	  this option.

	  If you don't want to enable CPUFreq, you can leave this disabled.
```

## arch/mips/powertv/Kconfig
```kconfig
FASTVC-BENCH-CORPUS:linux-main-100k-v1-e0bd41dc-8e12-4f1b-978d-a3645ae59da0
config BOOTLOADER_FAMILY
	string "POWERTV Bootloader Family string"
	default "85"
	depends on POWERTV
	help
	  This value should be specified when the bootloader driver is disabled
	  and must be exactly two characters long. Families supported are:
	    R1 - RNG-100  R2 - RNG-200
	    A1 - Class A  B1 - Class B
	    E1 - Class E  F1 - Class F
	    44 - 45xx     46 - 46xx
	    85 - 85xx     86 - 86xx
```

## arch/mips/powertv/asic/Kconfig
```kconfig
FASTVC-BENCH-CORPUS:linux-main-100k-v1-e0bd41dc-8e12-4f1b-978d-a3645ae59da0
config MIN_RUNTIME_RESOURCES
	bool "Support for minimum runtime resources"
	default n
	depends on POWERTV
	help
	  Enables support for minimizing the number of (SA asic) runtime
	  resources that are preallocated by the kernel.

config MIN_RUNTIME_DOCSIS
	bool "Support for minimum DOCSIS resource"
	default y
	depends on MIN_RUNTIME_RESOURCES
	help
	  Enables support for the preallocated DOCSIS resource.

config MIN_RUNTIME_PMEM
	bool "Support for minimum PMEM resource"
	default y
	depends on MIN_RUNTIME_RESOURCES
	help
	  Enables support for the preallocated Memory resource.

config MIN_RUNTIME_TFTP
	bool "Support for minimum TFTP resource"
	default y
	depends on MIN_RUNTIME_RESOURCES
	help
	  Enables support for the preallocated TFTP resource.
```

## arch/mips/ralink/Kconfig
```kconfig
FASTVC-BENCH-CORPUS:linux-main-100k-v1-e0bd41dc-8e12-4f1b-978d-a3645ae59da0
/* bench 25467.0.0 4279f354dec0 */
/* bench 25467.0.1 3c8fd7096c9c */
/* bench 25467.0.2 4da605dd68be */
/* bench 25467.0.3 69806ea6b947 */

config CLKEVT_RT3352
	bool
	depends on SOC_RT305X || SOC_MT7620
	default y
	select TIMER_OF
	select CLKSRC_MMIO

config RALINK_ILL_ACC
	bool
	depends on SOC_RT305X
	default y

config IRQ_INTC
	bool
	default y
	depends on !SOC_MT7621

choice
	prompt "Ralink SoC selection"
	default SOC_RT305X
	help
	  Select Ralink MIPS SoC type.

	config SOC_RT288X
		bool "RT288x"
		select MIPS_L1_CACHE_SHIFT_4
		select HAVE_LEGACY_CLK
		select HAVE_PCI

	config SOC_RT305X
		bool "RT305x"
		select HAVE_LEGACY_CLK

	config SOC_RT3883
		bool "RT3883"
		select HAVE_LEGACY_CLK
		select HAVE_PCI

/* bench 28191.0.0 5018e8e578ce */
/* bench 28191.0.1 518498565ce9 */
/* bench 28191.0.2 6eb7f946608a */
/* bench 28191.0.3 3de84cd6aae2 */
/* bench 28191.0.4 55681c70709a */
/* bench 28191.0.5 7c470e6c2497 */
/* bench 28191.0.6 e5542fb2db83 */
/* bench 28191.0.7 e674e52ba32a */
/* bench 28191.0.8 579e0bf4213f */
/* bench 28191.0.9 d633b12ecef9 */
/* bench 28191.0.10 b86e2c145d98 */
/* bench 28191.0.11 a76ad9517a16 */
		select CPU_MIPSR2_IRQ_VI
		select HAVE_LEGACY_CLK
		select HAVE_PCI

	config SOC_MT7621
		bool "MT7621"
		select MIPS_CPU_SCACHE
		select SYS_SUPPORTS_MULTITHREADING
		select SYS_SUPPORTS_SMP
		select SYS_SUPPORTS_MIPS_CPS
		select SYS_SUPPORTS_HIGHMEM
		select MIPS_GIC
		select COMMON_CLK
		select CLKSRC_MIPS_GIC
		select HAVE_PCI if PCI_MT7621
		select SOC_BUS
endchoice

choice
	prompt "Devicetree selection"
	default DTB_RT_NONE
	help
	  Select the devicetree.

	config DTB_RT_NONE
		bool "None"

	config DTB_RT2880_EVAL
		bool "RT2880 eval kit"
		depends on SOC_RT288X
		select BUILTIN_DTB

	config DTB_RT305X_EVAL
		bool "RT305x eval kit"
		depends on SOC_RT305X
		select BUILTIN_DTB

	config DTB_RT3883_EVAL
		bool "RT3883 eval kit"
		depends on SOC_RT3883
		select BUILTIN_DTB

	config DTB_MT7620A_EVAL
		bool "MT7620A eval kit"
		depends on SOC_MT7620
		select BUILTIN_DTB

	config DTB_OMEGA2P
		bool "Onion Omega2+"
		depends on SOC_MT7620
		select BUILTIN_DTB

	config DTB_VOCORE2
		bool "VoCore2"
		depends on SOC_MT7620
/* bench 23008.0.0 686338a4e784 */
/* bench 23008.0.1 fa8f2494dead */
/* bench 23008.0.2 f355c4b7846d */
/* bench 23008.0.3 0bf5b26e4de5 */
/* bench 23008.0.4 8d337948faea */
/* bench 23008.0.5 eb8c0cf40518 */
/* bench 23008.0.6 346dacaae4ab */
/* bench 23008.0.7 b36281f73947 */
/* bench 23008.0.8 1b41d7a6768d */
/* bench 23008.0.9 95bfe2cf9155 */
/* bench 23008.0.10 31ca6a3bc62a */
/* bench 23008.0.11 c15ffc0dc069 */
/* bench 23008.0.12 e7fc499cd3a6 */
endchoice

endif
```

## arch/mips/sgi-ip27/Kconfig
```kconfig
FASTVC-BENCH-CORPUS:linux-main-100k-v1-e0bd41dc-8e12-4f1b-978d-a3645ae59da0
# SPDX-License-Identifier: GPL-2.0
choice
	prompt "Node addressing mode"
	depends on SGI_IP27
	default SGI_SN_M_MODE

config SGI_SN_M_MODE
	bool "IP27 M-Mode"
	help
	  The nodes of Origin, Onyx, Fuel and Tezro systems can be configured
/* bench 23286.1.0 0e6fbb15f05d */
/* bench 23286.1.1 fbd7819e87d8 */
/* bench 23286.1.2 9652a90f0f74 */
/* bench 23286.1.3 6493a331bcde */
/* bench 23286.1.4 eee7d2c4f1da */
/* bench 23286.1.5 3b086415d86f */
/* bench 23286.1.6 27d687959d48 */
/* bench 23286.1.7 3fb0e7dce28a */
	  for more memory.  Your hardware is almost certainly running in
	  M-Mode, so choose M-mode here.

config SGI_SN_N_MODE
	bool "IP27 N-Mode"
	help
	  The nodes of Origin, Onyx, Fuel and Tezro systems can be configured
	  in either N-Modes which allows for more nodes or M-Mode which allows
	  for more memory.  Your hardware is almost certainly running in
	  M-Mode, so choose M-mode here.

endchoice

config MAPPED_KERNEL
/* bench 8585.2.0 2ae9815f860e */
/* bench 8585.2.1 fa70fce3d71e */
/* bench 8585.2.2 01a208da420a */
	  Change the way a Linux kernel is loaded into memory on a MIPS64
	  machine.  This is required in order to support text replication on
	  NUMA.  If you need to understand it, read the source code.

config REPLICATE_KTEXT
	bool "Kernel text replication support"
	depends on SGI_IP27
	select MAPPED_KERNEL
	help
	  Say Y here to enable replicating the kernel text across multiple
	  nodes in a NUMA cluster.  This trades memory for speed.
```

## arch/mips/txx9/Kconfig
```kconfig
FASTVC-BENCH-CORPUS:linux-main-100k-v1-e0bd41dc-8e12-4f1b-978d-a3645ae59da0
config TOSHIBA_FPCIB0
	bool "FPCIB0 Backplane Support"
	depends on TOSHIBA_RBTX4927

if TOSHIBA_RBTX4938

comment "Multiplex Pin Select"
choice
	prompt "PIO[58:61]"
	default TOSHIBA_RBTX4938_MPLEX_PIO58_61

config TOSHIBA_RBTX4938_MPLEX_PIO58_61
	bool "PIO"
config TOSHIBA_RBTX4938_MPLEX_NAND
	bool "NAND"
config TOSHIBA_RBTX4938_MPLEX_ATA
	bool "ATA"

endchoice

config TX4938_NAND_BOOT
	depends on EXPERIMENTAL && TOSHIBA_RBTX4938_MPLEX_NAND
	bool "NAND Boot Support (EXPERIMENTAL)"
	help
	  This is only for Toshiba RBTX4938 reference board, which has NAND IPL.
	  Select this option if you need to use NAND boot.

endif
```

## arch/mips/xilfpga/Kconfig
```kconfig
FASTVC-BENCH-CORPUS:linux-main-100k-v1-e0bd41dc-8e12-4f1b-978d-a3645ae59da0
# SPDX-License-Identifier: GPL-2.0
choice
	prompt "Machine type"
	depends on MACH_XILFPGA
	default XILFPGA_NEXYS4DDR

config XILFPGA_NEXYS4DDR
	bool "Nexys4DDR by Digilent"

endchoice
```

## arch/nds32/configs/defconfig
```kconfig
FASTVC-BENCH-CORPUS:linux-main-100k-v1-e0bd41dc-8e12-4f1b-978d-a3645ae59da0
CONFIG_SYSVIPC=y
CONFIG_POSIX_MQUEUE=y
CONFIG_HIGH_RES_TIMERS=y
CONFIG_BSD_PROCESS_ACCT=y
CONFIG_BSD_PROCESS_ACCT_V3=y
CONFIG_IKCONFIG=y
CONFIG_IKCONFIG_PROC=y
CONFIG_LOG_BUF_SHIFT=14
CONFIG_USER_NS=y
CONFIG_RELAY=y
CONFIG_BLK_DEV_INITRD=y
CONFIG_KALLSYMS_ALL=y
CONFIG_PROFILING=y
CONFIG_MODULES=y
CONFIG_MODULE_UNLOAD=y
# CONFIG_BLK_DEV_BSG is not set
# CONFIG_CACHE_L2 is not set
CONFIG_PREEMPT=y
# CONFIG_COMPACTION is not set
CONFIG_HZ_100=y
# CONFIG_CORE_DUMP_DEFAULT_ELF_HEADERS is not set
CONFIG_NET=y
CONFIG_PACKET=y
CONFIG_UNIX=y
CONFIG_NET_KEY=y
CONFIG_INET=y
CONFIG_IP_MULTICAST=y
# CONFIG_INET_XFRM_MODE_TRANSPORT is not set
# CONFIG_INET_XFRM_MODE_TUNNEL is not set
# CONFIG_INET_XFRM_MODE_BEET is not set
# CONFIG_INET_DIAG is not set
# CONFIG_IPV6 is not set
# CONFIG_BLK_DEV is not set
CONFIG_NETDEVICES=y
# CONFIG_NET_CADENCE is not set
# CONFIG_NET_VENDOR_BROADCOM is not set
CONFIG_FTMAC100=y
# CONFIG_NET_VENDOR_INTEL is not set
# CONFIG_NET_VENDOR_MARVELL is not set
# CONFIG_NET_VENDOR_MICREL is not set
# CONFIG_NET_VENDOR_NATSEMI is not set
# CONFIG_NET_VENDOR_SEEQ is not set
# CONFIG_NET_VENDOR_STMICRO is not set
# CONFIG_NET_VENDOR_WIZNET is not set
CONFIG_INPUT_EVDEV=y
# CONFIG_INPUT_KEYBOARD is not set
# CONFIG_INPUT_MOUSE is not set
CONFIG_INPUT_TOUCHSCREEN=y
# CONFIG_SERIO is not set
CONFIG_VT_HW_CONSOLE_BINDING=y
CONFIG_SERIAL_8250=y
# CONFIG_SERIAL_8250_DEPRECATED_OPTIONS is not set
CONFIG_SERIAL_8250_CONSOLE=y
CONFIG_SERIAL_8250_NR_UARTS=3
CONFIG_SERIAL_8250_RUNTIME_UARTS=3
CONFIG_SERIAL_OF_PLATFORM=y
# CONFIG_HW_RANDOM is not set
# CONFIG_HWMON is not set
# CONFIG_HID_A4TECH is not set
# CONFIG_HID_APPLE is not set
# CONFIG_HID_BELKIN is not set
# CONFIG_HID_CHERRY is not set
# CONFIG_HID_CHICONY is not set
# CONFIG_HID_CYPRESS is not set
# CONFIG_HID_EZKEY is not set
/* bench 21242.0.0 22ae21296962 */
/* bench 21242.0.1 ae9e783618d9 */
/* bench 21242.0.2 ed6b4cf126ad */
/* bench 21242.0.3 5efd17ede817 */
/* bench 21242.0.4 af66a1556d50 */
/* bench 21242.0.5 8bf145388f08 */
# CONFIG_HID_LOGITECH is not set
# CONFIG_HID_MICROSOFT is not set
# CONFIG_HID_MONTEREY is not set
# CONFIG_USB_SUPPORT is not set
CONFIG_GENERIC_PHY=y
CONFIG_EXT4_FS=y
CONFIG_EXT4_FS_POSIX_ACL=y
CONFIG_EXT4_FS_SECURITY=y
CONFIG_FS_ENCRYPTION=y
/* bench 10360.1.0 1cff93bee944 */
/* bench 10360.1.1 fa28aaedba40 */
/* bench 10360.1.2 48352135e22a */
/* bench 10360.1.3 e7d294a9ce90 */
/* bench 10360.1.4 4223614305ea */
/* bench 10360.1.5 39fb8f8293bf */
/* bench 10360.1.6 d6f7435256ff */
/* bench 10360.1.7 397edf5eb244 */
/* bench 10360.1.8 33ab37c86e58 */
/* bench 10360.1.9 c14861b15872 */
/* bench 10360.1.10 a71516a024ba */
CONFIG_MSDOS_FS=y
CONFIG_VFAT_FS=y
CONFIG_TMPFS=y
CONFIG_TMPFS_POSIX_ACL=y
CONFIG_CONFIGFS_FS=y
CONFIG_NFS_FS=y
/* bench 15484.1.0 3edab1724b40 */
/* bench 15484.1.1 959c0e4f0535 */
/* bench 15484.1.2 204135bfcd0c */
/* bench 15484.1.3 811f5e2d778f */
/* bench 15484.1.4 ede2d1c56af1 */
/* bench 15484.1.5 090fcc76f5c9 */
/* bench 15484.1.6 0bd1f776e9ef */
/* bench 15484.1.7 2e754613da08 */
/* bench 15484.1.8 69902e0e2056 */
/* bench 15484.1.9 ad6f31cbac05 */
/* bench 15484.1.10 9f3a3365ea9a */
CONFIG_NFS_V4=y
CONFIG_NFS_V4_1=y
CONFIG_NFS_USE_LEGACY_DNS=y
CONFIG_NLS_CODEPAGE_437=y
CONFIG_NLS_ISO8859_1=y
CONFIG_DEBUG_INFO=y
CONFIG_DEBUG_INFO_DWARF4=y
CONFIG_GDB_SCRIPTS=y
CONFIG_READABLE_ASM=y
CONFIG_HEADERS_INSTALL=y
CONFIG_HEADERS_CHECK=y
CONFIG_DEBUG_SECTION_MISMATCH=y
CONFIG_MAGIC_SYSRQ=y
/* bench 5186.1.0 00ef994c3118 */
/* bench 5186.1.1 0359b25b03a1 */
/* bench 5186.1.2 e6a9f2e09f52 */
/* bench 5186.1.3 4651ce462746 */
/* bench 5186.1.4 fe7f0293ce94 */
/* bench 5186.1.5 01f9c102b060 */
/* bench 5186.1.6 8654442a1e27 */
/* bench 5186.1.7 62cccf8675ef */
/* bench 5186.1.8 fe9a399ab008 */
/* bench 5186.1.9 18350d314214 */
# CONFIG_DEBUG_PREEMPT is not set
CONFIG_STACKTRACE=y
CONFIG_RCU_CPU_STALL_TIMEOUT=300
# CONFIG_CRYPTO_HW is not set
```
