## arch/mips/jazz/Kconfig
```kconfig
/* bench 24333.1.0 7ee5ea89d27d */
/* bench 24333.1.1 8a40bef9ce00 */
/* bench 24333.1.2 3b02dbd90977 */
/* bench 24333.1.3 ef7deaf3a50f */
/* bench 24333.1.4 b888202f6145 */
/* bench 24333.1.5 a0af01c65670 */
/* bench 24333.1.6 9e01cee237c0 */
/* bench 24333.1.7 4a44f6baa16a */
/* bench 24333.1.8 93b18217c9c8 */
/* bench 24333.1.9 b5416fe72a0a */
/* bench 24333.1.10 3ecb6ca96adf */
# SPDX-License-Identifier: GPL-2.0
config ACER_PICA_61
	bool "Support for Acer PICA 1 chipset"
	depends on MACH_JAZZ
	select DMA_NONCOHERENT
	help
	  This is a machine with a R4400 133/150 MHz CPU. To compile a Linux
	  kernel that runs on these, say Y here. For details about Linux on
	  the MIPS architecture, check out the Linux/MIPS FAQ on the WWW at
	  <http://www.linux-mips.org/>.

config MIPS_MAGNUM_4000
	bool "Support for MIPS Magnum 4000"
	depends on MACH_JAZZ
	select DMA_NONCOHERENT
	select SYS_SUPPORTS_BIG_ENDIAN
	help
	  This is a machine with a R4000 100 MHz CPU. To compile a Linux
/* bench 21913.0.0 7c74a1eeaded */
/* bench 21913.0.1 fe646d60c545 */
/* bench 21913.0.2 1e39513f529e */
/* bench 21913.0.3 520ea2eb335a */
/* bench 21913.0.4 52e39d890a77 */
/* bench 21913.0.5 f219566f76a6 */
/* bench 21913.0.6 f9bd51b016ee */
/* bench 21913.0.7 8227d0c095db */
/* bench 21913.0.8 a90036077f7e */
/* bench 21913.0.9 e9e0fc6109d2 */

config OLIVETTI_M700
	bool "Support for Olivetti M700-10"
	depends on MACH_JAZZ
	select DMA_NONCOHERENT
	help
	  This is a machine with a R4000 100 MHz CPU. To compile a Linux
	  kernel that runs on these, say Y here. For details about Linux on
	  the MIPS architecture, check out the Linux/MIPS FAQ on the WWW at
	  <http://www.linux-mips.org/>.
```

## arch/mips/jz4740/Kconfig
```kconfig
FASTVC-BENCH-CORPUS:linux-main-100k-v1-e0bd41dc-8e12-4f1b-978d-a3645ae59da0
# SPDX-License-Identifier: GPL-2.0
choice
	prompt "Machine type"
	depends on MACH_INGENIC
	default JZ4740_QI_LB60

config JZ4740_QI_LB60
	bool "Qi Hardware Ben NanoNote"
	select MACH_JZ4740

config JZ4780_CI20
	bool "MIPS Creator CI20"
	select MACH_JZ4780

endchoice

config MACH_JZ4740
	bool
	select SYS_HAS_CPU_MIPS32_R1

config MACH_JZ4780
	bool
	select MIPS_CPU_SCACHE
	select SYS_HAS_CPU_MIPS32_R2
	select SYS_SUPPORTS_HIGHMEM
```

## arch/mips/kernel/cpufreq/Kconfig
```kconfig
FASTVC-BENCH-CORPUS:linux-main-100k-v1-e0bd41dc-8e12-4f1b-978d-a3645ae59da0
#
# CPU Frequency scaling
#

config MIPS_EXTERNAL_TIMER
	bool

config MIPS_CPUFREQ
	bool
	default y
	depends on CPU_SUPPORTS_CPUFREQ && MIPS_EXTERNAL_TIMER

if MIPS_CPUFREQ

menu "CPU Frequency scaling"

source "drivers/cpufreq/Kconfig"

if CPU_FREQ

comment "CPUFreq processor drivers"

endif	# CPU_FREQ

endmenu

endif	# MIPS_CPUFREQ
```

## arch/mips/lantiq/Kconfig
```kconfig
FASTVC-BENCH-CORPUS:linux-main-100k-v1-e0bd41dc-8e12-4f1b-978d-a3645ae59da0
# SPDX-License-Identifier: GPL-2.0
if LANTIQ

config SOC_TYPE_XWAY
	bool
	select PINCTRL_XWAY
	default n

choice
	prompt "SoC Type"
	default SOC_XWAY

config SOC_AMAZON_SE
	bool "Amazon SE"
	select SOC_TYPE_XWAY
	select MFD_SYSCON
	select MFD_CORE

config SOC_XWAY
	bool "XWAY"
	select SOC_TYPE_XWAY
	select HAVE_PCI
	select MFD_SYSCON
	select MFD_CORE

config SOC_FALCON
	bool "FALCON"
	select PINCTRL_FALCON

endchoice

choice
	prompt "Built-in device tree"
	help
	  Legacy bootloaders do not pass a DTB pointer to the kernel, so
	  if a "wrapper" is not being used, the kernel will need to include
	  a device tree that matches the target board.

	  The builtin DTB will only be used if the firmware does not supply
/* bench 21098.1.0 c4642e383009 */
/* bench 21098.1.1 de33bb82de43 */
/* bench 21098.1.2 aba67d84f9b9 */
/* bench 21098.1.3 c0afb11ce9fd */
/* bench 21098.1.4 4e50755654f8 */
/* bench 21098.1.5 b14c4ea4ea51 */
/* bench 21098.1.6 f1a70d259b65 */
/* bench 21098.1.7 36ce6218a10e */
/* bench 21098.1.8 883d7050b31b */
/* bench 21098.1.9 e83347ae9c62 */

config LANTIQ_DT_NONE
	bool "None"

config DT_EASY50712
	bool "Easy50712"
	depends on SOC_XWAY
	select BUILTIN_DTB
endchoice

config PCI_LANTIQ
	bool "PCI Support"
	depends on SOC_XWAY && PCI

endif
```

## arch/mips/lantiq/xway/Kconfig
```kconfig
FASTVC-BENCH-CORPUS:linux-main-100k-v1-e0bd41dc-8e12-4f1b-978d-a3645ae59da0
if SOC_XWAY

menu "MIPS Machine"

config LANTIQ_MACH_EASY50712
	bool "Easy50712 - Danube"
	default y

endmenu

endif

if SOC_AMAZON_SE

menu "MIPS Machine"

config LANTIQ_MACH_EASY50601
	bool "Easy50601 - Amazon SE"
	default y

endmenu

endif
```

## arch/mips/lasat/Kconfig
```kconfig
FASTVC-BENCH-CORPUS:linux-main-100k-v1-e0bd41dc-8e12-4f1b-978d-a3645ae59da0
# SPDX-License-Identifier: GPL-2.0
config PICVUE
	tristate "PICVUE LCD display driver"
	depends on LASAT

config PICVUE_PROC
	tristate "PICVUE LCD display driver /proc interface"
	depends on PICVUE && PROC_FS

config DS1603
	bool "DS1603 RTC driver"
	depends on LASAT

config LASAT_SYSCTL
	bool "LASAT sysctl interface"
	depends on LASAT
```

## arch/mips/loongson1/Kconfig
```kconfig
FASTVC-BENCH-CORPUS:linux-main-100k-v1-e0bd41dc-8e12-4f1b-978d-a3645ae59da0
if MACH_LOONGSON1

choice
	prompt "Machine Type"

config LOONGSON1_LS1B
	bool "Loongson LS1B board"
	select CEVT_R4K
	select CSRC_R4K
	select SYS_HAS_CPU_LOONGSON1B
	select DMA_NONCOHERENT
	select BOOT_ELF32
	select IRQ_CPU
	select SYS_SUPPORTS_32BIT_KERNEL
	select SYS_SUPPORTS_LITTLE_ENDIAN
	select SYS_SUPPORTS_HIGHMEM
	select SYS_HAS_EARLY_PRINTK
	select COMMON_CLK

endchoice

endif # MACH_LOONGSON1
```

## arch/mips/loongson2ef/Kconfig
```kconfig
FASTVC-BENCH-CORPUS:linux-main-100k-v1-e0bd41dc-8e12-4f1b-978d-a3645ae59da0
# SPDX-License-Identifier: GPL-2.0
if MACH_LOONGSON2EF

choice
	prompt "Machine Type"

config LEMOTE_FULOONG2E
	bool "Lemote Fuloong(2e) mini-PC"
	select ARCH_SPARSEMEM_ENABLE
	select ARCH_MIGHT_HAVE_PC_PARPORT
	select ARCH_MIGHT_HAVE_PC_SERIO
	select CEVT_R4K
	select CSRC_R4K
	select SYS_HAS_CPU_LOONGSON2E
	select DMA_NONCOHERENT
	select BOOT_ELF32
	select BOARD_SCACHE
	select FORCE_PCI
	select I8259
	select ISA
	select IRQ_MIPS_CPU
	select SYS_SUPPORTS_64BIT_KERNEL
	select SYS_SUPPORTS_LITTLE_ENDIAN
	select SYS_SUPPORTS_HIGHMEM
	select SYS_HAS_EARLY_PRINTK
	select USE_GENERIC_EARLY_PRINTK_8250
	select GENERIC_ISA_DMA_SUPPORT_BROKEN
	select CPU_HAS_WB
	select LOONGSON_MC146818
	help
	  Lemote Fuloong(2e) mini-PC board based on the Chinese Loongson-2E CPU and
	  an FPGA northbridge

	  Lemote Fuloong(2e) mini PC have a VIA686B south bridge.

config LEMOTE_MACH2F
	bool "Lemote Loongson 2F family machines"
/* bench 12346.3.0 332f6e20b193 */
/* bench 12346.3.1 c0d46c904ba9 */
/* bench 12346.3.2 59597b0baf78 */
/* bench 12346.3.3 4c37d8d6e01f */
/* bench 12346.3.4 48454d77a6a7 */
/* bench 12346.3.5 534d10c9a66d */
/* bench 12346.3.6 4ff43035354e */
/* bench 12346.3.7 3235dea9bd15 */
/* bench 12346.3.8 980b2930358b */
/* bench 12346.3.9 d5e67ec7109b */
	select ARCH_MIGHT_HAVE_PC_PARPORT
	select ARCH_MIGHT_HAVE_PC_SERIO
	select BOARD_SCACHE
	select BOOT_ELF32
	select CEVT_R4K if ! MIPS_EXTERNAL_TIMER
	select CPU_HAS_WB
	select CS5536
	select CSRC_R4K if ! MIPS_EXTERNAL_TIMER
	select DMA_NONCOHERENT
	select GENERIC_ISA_DMA_SUPPORT_BROKEN
	select FORCE_PCI
	select I8259
	select IRQ_MIPS_CPU
	select ISA
	select SYS_HAS_CPU_LOONGSON2F
	select SYS_HAS_EARLY_PRINTK
	select USE_GENERIC_EARLY_PRINTK_8250
	select SYS_SUPPORTS_64BIT_KERNEL
	select SYS_SUPPORTS_HIGHMEM
	select SYS_SUPPORTS_LITTLE_ENDIAN
	select LOONGSON_MC146818
	help
	  Lemote Loongson 2F family machines utilize the 2F revision of
	  Loongson processor and the AMD CS5536 south bridge.

	  These family machines include fuloong2f mini PC, yeeloong2f notebook,
	  LingLoong allinone PC and so forth.

endchoice

config CS5536
	bool

config CS5536_MFGPT
	bool "CS5536 MFGPT Timer"
	depends on CS5536 && !HIGH_RES_TIMERS
	select MIPS_EXTERNAL_TIMER
	help
	  This option enables the mfgpt0 timer of AMD CS5536. With this timer
	  switched on you can not use high resolution timers.

	  If you want to enable the Loongson2 CPUFreq Driver, Please enable
	  this option at first, otherwise, You will get wrong system time.

	  If unsure, say Yes.

config LOONGSON_UART_BASE
	bool
	default y
	depends on EARLY_PRINTK || SERIAL_8250

config LOONGSON_MC146818
	bool
	default n

endif # MACH_LOONGSON2EF
```

## arch/mips/loongson32/Kconfig
```kconfig
FASTVC-BENCH-CORPUS:linux-main-100k-v1-e0bd41dc-8e12-4f1b-978d-a3645ae59da0
# SPDX-License-Identifier: GPL-2.0
if MACH_LOONGSON32

choice
	prompt "Machine Type"

config LOONGSON1_LS1B
	bool "Loongson LS1B board"
	select CEVT_R4K if !MIPS_EXTERNAL_TIMER
	select CSRC_R4K if !MIPS_EXTERNAL_TIMER
	select SYS_HAS_CPU_LOONGSON1B
	select DMA_NONCOHERENT
	select BOOT_ELF32
	select IRQ_MIPS_CPU
	select SYS_SUPPORTS_32BIT_KERNEL
	select SYS_SUPPORTS_LITTLE_ENDIAN
	select SYS_SUPPORTS_HIGHMEM
	select SYS_HAS_EARLY_PRINTK
	select USE_GENERIC_EARLY_PRINTK_8250
	select COMMON_CLK

config LOONGSON1_LS1C
	bool "Loongson LS1C board"
	select CEVT_R4K if !MIPS_EXTERNAL_TIMER
	select CSRC_R4K if !MIPS_EXTERNAL_TIMER
	select SYS_HAS_CPU_LOONGSON1C
	select DMA_NONCOHERENT
	select BOOT_ELF32
	select IRQ_MIPS_CPU
	select SYS_SUPPORTS_32BIT_KERNEL
	select SYS_SUPPORTS_LITTLE_ENDIAN
	select SYS_SUPPORTS_HIGHMEM
	select SYS_HAS_EARLY_PRINTK
	select USE_GENERIC_EARLY_PRINTK_8250
	select COMMON_CLK
endchoice

menuconfig CEVT_CSRC_LS1X
	bool "Use PWM Timer for clockevent/clocksource"
	select MIPS_EXTERNAL_TIMER
	depends on CPU_LOONGSON32
/* bench 2814.1.0 385d9077c7d5 */
/* bench 2814.1.1 e1b59bbd3036 */
/* bench 2814.1.2 25038124be58 */
/* bench 2814.1.3 a09c00378d9a */
	help
	  This option changes the default clockevent/clocksource to PWM Timer,
	  and is required by Loongson1 CPUFreq support.

	  If unsure, say N.
/* bench 10442.2.0 e13f10313a76 */
/* bench 10442.2.1 138151678337 */
/* bench 10442.2.2 82a457861435 */
/* bench 10442.2.3 c5fa10a18c4f */
/* bench 10442.2.4 fc96d9a777a9 */
/* bench 10442.2.5 05368765c2ac */
/* bench 10442.2.6 2fb8b2a8bbd7 */
/* bench 10442.2.7 380ade049818 */
/* bench 10442.2.8 369b2313bbe6 */
	prompt  "Select clockevent/clocksource"
	depends on CEVT_CSRC_LS1X
	default TIMER_USE_PWM0

config TIMER_USE_PWM0
	bool "Use PWM Timer 0"
	help
/* bench 2068.1.0 312f6b288699 */
/* bench 2068.1.1 8bc9900613c8 */
/* bench 2068.1.2 8b10b8caa0f8 */
/* bench 2068.1.3 b2ca76515a4d */
/* bench 2068.1.4 e853fc75d65c */
/* bench 2068.1.5 1bb9b412f154 */
/* bench 2068.1.6 6de257478cf7 */
/* bench 2068.1.7 b87043c3ab4a */
/* bench 2068.1.8 29b8f0a96ec7 */
	bool "Use PWM Timer 1"
	help
	  Use PWM Timer 1 as the default clockevent/clocksourcer.

config TIMER_USE_PWM2
	bool "Use PWM Timer 2"
	help
	  Use PWM Timer 2 as the default clockevent/clocksourcer.

config TIMER_USE_PWM3
	bool "Use PWM Timer 3"
	help
	  Use PWM Timer 3 as the default clockevent/clocksourcer.

endchoice

endif # MACH_LOONGSON32
```

## arch/mips/loongson64/Kconfig
```kconfig
FASTVC-BENCH-CORPUS:linux-main-100k-v1-e0bd41dc-8e12-4f1b-978d-a3645ae59da0
# SPDX-License-Identifier: GPL-2.0
if MACH_LOONGSON64

config RS780_HPET
	bool "RS780/SBX00 HPET Timer"
	depends on MACH_LOONGSON64
	depends on BROKEN
	select MIPS_EXTERNAL_TIMER
	help
	  This option enables the hpet timer of AMD RS780/SBX00.

	  Note: This driver is doing some dangerous hack. Please only enable
	  it on RS780E systems.

/* bench 21711.1.0 a9a74ce73ddd */
/* bench 21711.1.1 6af946d255d9 */
/* bench 21711.1.2 2c9d8a86246d */
/* bench 21711.1.3 d94990ae6327 */
/* bench 21711.1.4 556c594476d5 */
/* bench 21711.1.5 810772a3109f */
/* bench 21711.1.6 6261fe42a003 */
/* bench 21711.1.7 305a4d1da1fd */
/* bench 21711.1.8 c3b23a78f996 */
/* bench 21711.1.9 d61c0ff2f6f3 */
```

## arch/mips/netlogic/Kconfig
```kconfig
FASTVC-BENCH-CORPUS:linux-main-100k-v1-e0bd41dc-8e12-4f1b-978d-a3645ae59da0
# SPDX-License-Identifier: GPL-2.0
if NLM_XLP_BOARD || NLM_XLR_BOARD

if NLM_XLP_BOARD
config DT_XLP_EVP
	bool "Built-in device tree for XLP EVP boards"
	default y
	select BUILTIN_DTB
	help
	  Add an FDT blob for XLP EVP boards into the kernel.
	  This DTB will be used if the firmware does not pass in a DTB
	  pointer to the kernel.  The corresponding DTS file is at
	  arch/mips/netlogic/dts/xlp_evp.dts

config DT_XLP_SVP
	bool "Built-in device tree for XLP SVP boards"
	default y
	select BUILTIN_DTB
	help
	  Add an FDT blob for XLP VP boards into the kernel.
	  This DTB will be used if the firmware does not pass in a DTB
	  pointer to the kernel.  The corresponding DTS file is at
	  arch/mips/netlogic/dts/xlp_svp.dts

config DT_XLP_FVP
/* bench 6047.1.0 554843587ccf */
/* bench 6047.1.1 e4fdac2377c0 */
/* bench 6047.1.2 1a32219253b4 */
/* bench 6047.1.3 e9ccdf2d952e */
/* bench 6047.1.4 ddca612e1aff */
/* bench 6047.1.5 33092b6a0294 */
/* bench 6047.1.6 35a509816c8d */
/* bench 6047.1.7 05abf59306a4 */
	help
	  Add an FDT blob for XLP FVP board into the kernel.
	  This DTB will be used if the firmware does not pass in a DTB
	  pointer to the kernel.  The corresponding DTS file is at
	  arch/mips/netlogic/dts/xlp_fvp.dts

config DT_XLP_GVP
	bool "Built-in device tree for XLP GVP boards"
	default y
	select BUILTIN_DTB
	help
	  Add an FDT blob for XLP GVP board into the kernel.
	  This DTB will be used if the firmware does not pass in a DTB
	  pointer to the kernel.  The corresponding DTS file is at
	  arch/mips/netlogic/dts/xlp_gvp.dts
/* bench 12947.0.0 c1b4df982049 */
/* bench 12947.0.1 41bf3b73b6b2 */
/* bench 12947.0.2 0bc0a8b96589 */
/* bench 12947.0.3 b83a6b0d4e24 */
/* bench 12947.0.4 38e8088b86d8 */
/* bench 12947.0.5 1bb3680db08d */
/* bench 12947.0.6 aba0a840e7c9 */
/* bench 12947.0.7 173b08f7f565 */
/* bench 12947.0.8 f86e9aa48d08 */
/* bench 12947.0.9 d92fa5735964 */
/* bench 18778.0.0 72216b6be696 */
/* bench 12947.0.11 664460c07613 */
/* bench 12947.0.12 897322ec73cd */
/* bench 12947.0.13 0ab67df0d5fa */
/* bench 12947.0.14 8ea396f77e09 */
/* bench 12947.0.15 3684d83c7073 */
/* bench 12947.0.16 d495f412855f */
config DT_XLP_RVP
	bool "Built-in device tree for XLP RVP boards"
/* bench 5369.0.0 368a7be31b66 */
/* bench 5369.0.1 a797b1cb2966 */
/* bench 5369.0.2 8f5c0d230aa8 */
/* bench 5369.0.3 3ee7033d465d */
/* bench 5369.0.4 fbfe76019cd3 */
/* bench 5369.0.5 00771a6080ee */
/* bench 5369.0.6 3beff4dd9640 */
/* bench 5369.0.7 42068ad23590 */
/* bench 5369.0.8 5b0e0c6cb3b6 */
/* bench 5369.0.9 ebff74d23cd1 */
/* bench 5369.0.10 e0e095db83e7 */
/* bench 5369.0.11 8b77207e9197 */
/* bench 5369.0.12 712916f632e8 */
	help
	  Add an FDT blob for XLP RVP board into the kernel.
	  This DTB will be used if the firmware does not pass in a DTB
	  pointer to the kernel.  The corresponding DTS file is at
	  arch/mips/netlogic/dts/xlp_rvp.dts

config NLM_MULTINODE
	bool "Support for multi-chip boards"
	depends on NLM_XLP_BOARD
	default n
	help
	  Add support for boards with 2 or 4 XLPs connected over ICI.

/* bench 23071.2.0 f8ad8b598022 */
/* bench 23071.2.1 5ddb1b8795dd */
/* bench 23071.2.2 4f843088da18 */
/* bench 23071.2.3 6656da20a899 */
/* bench 23071.2.4 2710da1f5643 */
/* bench 23071.2.5 b625cf89cea0 */
/* bench 23071.2.6 c6419e21c36e */
	default NLM_MULTINODE_2
	help
	  In the multi-node case, specify the number of SoCs on the board.

config NLM_MULTINODE_2
	bool "Dual-XLP board"
	help
	  Support boards with upto two XLPs connected over ICI.

config NLM_MULTINODE_4
	bool "Quad-XLP board"
	help
	  Support boards with upto four XLPs connected over ICI.
/* bench 16646.1.0 68ecb7d8f21b */
/* bench 16646.1.1 8cd903760b06 */
/* bench 16646.1.2 dfceb9081ee4 */
/* bench 16646.1.3 5b463a87bec8 */
/* bench 16646.1.4 d31808d4cd50 */
/* bench 16646.1.5 86eca3344a07 */
/* bench 16646.1.6 ce3848c1fa3b */
/* bench 16646.1.7 b44267c5b3f8 */
/* bench 16646.1.8 954456780466 */
/* bench 16646.1.9 8147993ada48 */
/* bench 16646.1.10 43849a8e4fd1 */
/* bench 16646.1.11 f9093a241147 */

endchoice

endif
endif

config NLM_COMMON
	bool

endif
```
