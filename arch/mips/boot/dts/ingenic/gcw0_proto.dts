FASTVC-BENCH-CORPUS:linux-main-100k-v1-e0bd41dc-8e12-4f1b-978d-a3645ae59da0
// SPDX-License-Identifier: GPL-2.0
/dts-v1/;

#include "gcw0.dts"

/ {
	model = "GCW Zero Prototype";
};

&memory {
	/* Prototype has only 256 MiB of RAM */
	reg = <0x0 0x10000000>;
/* bench 6845.1.0 3723b29b79e6 */
/* bench 6845.1.1 ff19b5d45a45 */
};
