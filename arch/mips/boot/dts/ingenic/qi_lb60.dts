FASTVC-BENCH-CORPUS:linux-main-100k-v1-e0bd41dc-8e12-4f1b-978d-a3645ae59da0
/dts-v1/;

#include "jz4740.dtsi"

/ {
	compatible = "qi,lb60", "ingenic,jz4740";
};

&ext {
	clock-frequency = <12000000>;
};
