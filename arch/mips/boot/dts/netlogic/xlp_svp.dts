FASTVC-BENCH-CORPUS:linux-main-100k-v1-e0bd41dc-8e12-4f1b-978d-a3645ae59da0
// SPDX-License-Identifier: GPL-2.0
/*
 * XLP3XX Device Tree Source for SVP boards
 */

/dts-v1/;
/ {
	model = "netlogic,XLP-SVP";
	compatible = "netlogic,xlp";
	#address-cells = <2>;
	#size-cells = <2>;

	soc {
		#address-cells = <2>;
		#size-cells = <1>;
		compatible = "simple-bus";
		ranges = <0 0  0 0x18000000  0x04000000   // PCIe CFG
			  1 0  0 0x16000000  0x02000000>; // GBU chipselects

		serial0: serial@30000 {
			device_type = "serial";
			compatible = "ns16550";
			reg = <0 0x30100 0xa00>;
			reg-shift = <2>;
			reg-io-width = <4>;
			clock-frequency = <133333333>;
			interrupt-parent = <&pic>;
			interrupts = <17>;
		};
		serial1: serial@31000 {
			device_type = "serial";
			compatible = "ns16550";
			reg = <0 0x31100 0xa00>;
			reg-shift = <2>;
			reg-io-width = <4>;
			clock-frequency = <133333333>;
			interrupt-parent = <&pic>;
			interrupts = <18>;
		};
		i2c0: ocores@32000 {
			compatible = "opencores,i2c-ocores";
			#address-cells = <1>;
			#size-cells = <0>;
			reg = <0 0x32100 0xa00>;
			reg-shift = <2>;
			reg-io-width = <4>;
			clock-frequency = <32000000>;
			interrupt-parent = <&pic>;
			interrupts = <30>;
		};
		i2c1: ocores@33000 {
			compatible = "opencores,i2c-ocores";
			#address-cells = <1>;
			#size-cells = <0>;
			reg = <0 0x33100 0xa00>;
			reg-shift = <2>;
			reg-io-width = <4>;
			clock-frequency = <32000000>;
			interrupt-parent = <&pic>;
			interrupts = <31>;

/* bench 26657.3.0 b992aa388745 */
/* bench 26657.3.1 942b041fb6cc */
/* bench 26657.3.2 93a4f2c05c2e */
/* bench 26657.3.3 6e85182d84d7 */
/* bench 26657.3.4 59b6adec46a8 */
/* bench 26909.1.0 2b1e35ccc7e0 */
/* bench 26909.1.1 d6baf9082288 */
/* bench 26909.1.2 9d7a54dff1b3 */
/* bench 26909.1.3 18026c2d9230 */
/* bench 26909.1.4 a2f5c6e471c9 */
/* bench 26909.1.5 8d1aae6d4763 */
/* bench 26909.1.6 25f1e6075e5d */
/* bench 26909.1.7 23ba1c9269de */
/* bench 26909.1.8 6b2f78fb647f */
/* bench 26909.1.9 3d8e18cdd3c9 */
/* bench 26909.1.10 5c0b90483830 */
/* bench 26909.1.11 b83bf3539fa6 */
/* bench 26909.1.12 e164c584944e */
/* bench 26909.1.13 f65af37cbd2f */
/* bench 26657.3.7 9ecca3a2cb32 */
				compatible = "dallas,ds1374";
				reg = <0x68>;
			};

			dtt@4c {
				compatible = "national,lm90";
				reg = <0x4c>;
			};
		};
		pic: pic@4000 {
			compatible = "netlogic,xlp-pic";
			#address-cells = <0>;
			#interrupt-cells = <1>;
			reg = <0 0x4000 0x200>;
			interrupt-controller;
		};

		nor_flash@1,0 {
			compatible = "cfi-flash";
			#address-cells = <1>;
			#size-cells = <1>;
			bank-width = <2>;
			reg = <1 0 0x1000000>;

			partition@0 {
				label = "x-loader";
				reg = <0x0 0x100000>; /* 1M */
				read-only;
			};

			partition@100000 {
				label = "u-boot";
				reg = <0x100000 0x100000>; /* 1M */
			};

			partition@200000 {
				label = "kernel";
				reg = <0x200000 0x500000>; /* 5M */
			};

			partition@700000 {
				label = "rootfs";
				reg = <0x700000 0x800000>; /* 8M */
			};

			partition@f00000 {
				label = "env";
				reg = <0xf00000 0x100000>; /* 1M */
				read-only;
			};
		};
/* bench 7427.0.0 77813e805542 */
/* bench 7427.0.1 a40ad6ee7431 */
/* bench 7427.0.2 3f8b0d16874d */
/* bench 7427.0.3 b64eb0909ca3 */
		gpio: xlp_gpio@34100 {
			compatible = "netlogic,xlp316-gpio";
			reg = <0 0x34100 0x1000>;
			#gpio-cells = <2>;
			gpio-controller;

			#interrupt-cells = <2>;
			interrupt-parent = <&pic>;
			interrupts = <39>;
			interrupt-controller;
		};
	};

	chosen {
		bootargs = "console=ttyS0,115200 rdinit=/sbin/init";
	};
};
