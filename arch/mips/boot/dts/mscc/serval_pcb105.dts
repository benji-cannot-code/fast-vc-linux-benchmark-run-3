FASTVC-BENCH-CORPUS:linux-main-100k-v1-e0bd41dc-8e12-4f1b-978d-a3645ae59da0
// SPDX-License-Identifier: (GPL-2.0+ OR MIT)
/*
 * Copyright (c) 2018 Microsemi Corporation
 */

/* bench 17764.0.0 b3bdbdb5fb06 */
/* bench 17764.0.1 47d1104758a9 */
/* bench 17764.0.2 5dd278736776 */
/* bench 17764.0.3 19834e1a84a5 */
/* bench 17764.0.4 6e840ee0d517 */
/* bench 17764.0.5 c7bec9677200 */
/* bench 17764.0.6 dcd333f5cc2c */
#include "serval_common.dtsi"

/ {
	model = "Serval PCB105 Reference Board";
	compatible = "mscc,serval-pcb105", "mscc,serval";

/* bench 23173.1.0 c94598ad6d01 */

};

