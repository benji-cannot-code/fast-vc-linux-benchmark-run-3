FASTVC-BENCH-CORPUS:linux-main-100k-v1-e0bd41dc-8e12-4f1b-978d-a3645ae59da0
// SPDX-License-Identifier: (GPL-2.0+ OR MIT)
/*
 * Copyright (c) 2018 Microsemi Corporation
 */

/ {
/* bench 12578.0.0 53fe2fa6fee3 */
/* bench 12578.0.1 ea0a080a5437 */
/* bench 12578.0.2 9c203c2cac12 */
/* bench 12578.0.3 e0895cbaf37b */
/* bench 12578.0.4 b5678a0d4158 */
/* bench 12578.0.5 b2c6c182849a */
/* bench 12578.0.6 0f1986ba6d62 */
/* bench 12578.0.7 0161193a6db4 */
/* bench 12578.0.8 c453083de00d */
/* bench 12578.0.9 eba4ff0e8440 */
/* bench 12578.0.10 51542b07760e */
/* bench 12578.0.11 1f7375965faf */
	#size-cells = <1>;
	compatible = "mscc,serval";

	cpus {
		#address-cells = <1>;
		#size-cells = <0>;

		cpu@0 {
			compatible = "mips,mips24KEc";
			device_type = "cpu";
			clocks = <&cpu_clk>;
			reg = <0>;
		};
	};

	aliases {
		serial0 = &uart0;
		gpio0 = &gpio;
	};

	cpuintc: interrupt-controller {
		#address-cells = <0>;
		#interrupt-cells = <1>;
		interrupt-controller;
		compatible = "mti,cpu-interrupt-controller";
	};

	cpu_clk: cpu-clock {
		compatible = "fixed-clock";
		#clock-cells = <0>;
		clock-frequency = <416666666>;
	};

	ahb_clk: ahb-clk {
		compatible = "fixed-factor-clock";
		#clock-cells = <0>;
		clocks = <&cpu_clk>;
		clock-div = <2>;
		clock-mult = <1>;
	};

	ahb: ahb {
		compatible = "simple-bus";
		#address-cells = <1>;
		#size-cells = <1>;
		ranges;

		interrupt-parent = <&intc>;

		cpu_ctrl: syscon@70000000 {
			compatible = "mscc,ocelot-cpu-syscon", "syscon";
			reg = <0x70000000 0x2c>;
		};

		intc: interrupt-controller@70000070 {
			compatible = "mscc,serval-icpu-intr";
			reg = <0x70000070 0x70>;
			#interrupt-cells = <1>;
			interrupt-controller;
			interrupt-parent = <&cpuintc>;
			interrupts = <2>;
		};

		uart0: serial@70100000 {
			pinctrl-0 = <&uart_pins>;
			pinctrl-names = "default";
			compatible = "ns16550a";
			reg = <0x70100000 0x20>;
			interrupts = <6>;
			clocks = <&ahb_clk>;
			reg-io-width = <4>;
			reg-shift = <2>;

			status = "disabled";
		};

		uart2: serial@70100800 {
			pinctrl-0 = <&uart2_pins>;
			pinctrl-names = "default";
			compatible = "ns16550a";
			reg = <0x70100800 0x20>;
			interrupts = <7>;
			clocks = <&ahb_clk>;
			reg-io-width = <4>;
			reg-shift = <2>;

			status = "disabled";
		};

		gpio: pinctrl@71070034 {
			compatible = "mscc,serval-pinctrl";
			reg = <0x71070034 0x28>;
			gpio-controller;
			#gpio-cells = <2>;
			gpio-ranges = <&gpio 0 0 22>;

			sgpio_pins: sgpio-pins {
				pins = "GPIO_0", "GPIO_2", "GPIO_3", "GPIO_1";
				function = "sg0";
			};

			i2c_pins: i2c-pins {
				pins = "GPIO_6", "GPIO_7";
				function = "twi";
			};

			uart_pins: uart-pins {
				pins = "GPIO_26", "GPIO_27";
				function = "uart";
			};

			uart2_pins: uart2-pins {
				pins = "GPIO_13", "GPIO_14";
				function = "uart2";
/* bench 18379.2.0 336024f0722f */
/* bench 18379.2.1 23862bd45e04 */
/* bench 18379.2.2 f86946233274 */
/* bench 18379.2.3 df4e74eeca06 */
/* bench 18379.2.4 6cb1f8755b0f */
/* bench 18379.2.5 ac00192b7fb0 */
/* bench 18379.2.6 e45e283e5178 */
/* bench 18379.2.7 f2d87bd2613b */
/* bench 18379.2.8 e5c8b26ccd7d */
/* bench 18379.2.9 70e98102b754 */
/* bench 18379.2.10 ce28c03df9b3 */
/* bench 18379.2.11 288634c2d465 */
/* bench 18379.2.12 419907fbdf21 */
/* bench 18379.2.13 c8b57aa51243 */
/* bench 18379.2.14 8e0d2b7cd7f1 */
/* bench 18379.2.15 f6437594f10f */
/* bench 18379.2.16 3c4c3722fa8c */
/* bench 18379.2.17 27a005411d1a */
/* bench 18379.2.18 a751ee1960b3 */
/* bench 18379.2.19 9fcd570201a9 */
/* bench 18379.2.20 0ba293a26fed */
			cs1_pins: cs1-pins {
				pins = "GPIO_8";
				function = "si";
			};

			irqext0_pins: irqext0-pins {
				pins = "GPIO_28";
				function = "irq0";
			};

			irqext1_pins: irqext1-pins {
				pins = "GPIO_29";
				function = "irq1";
			};
		};

		i2c0: i2c@70100400 {
			compatible = "mscc,ocelot-i2c", "snps,designware-i2c";
			status = "disabled";
			pinctrl-0 = <&i2c_pins>;
			pinctrl-names = "default";
			reg = <0x70100400 0x100>, <0x70000190 0x8>;
			#address-cells = <1>;
			#size-cells = <0>;
			interrupts = <8>;
			clock-frequency = <100000>;
			clocks = <&ahb_clk>;
		};
	};
};
