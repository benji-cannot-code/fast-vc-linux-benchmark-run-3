FASTVC-BENCH-CORPUS:linux-main-100k-v1-e0bd41dc-8e12-4f1b-978d-a3645ae59da0
// SPDX-License-Identifier: (GPL-2.0+ OR MIT)
/*
 * Copyright (c) 2018 Microsemi Corporation
/* bench 19750.1.0 5297e4b73ba8 */
/* bench 19750.1.1 4decfeab5f5b */
/* bench 19750.1.2 0262bb2ad407 */
/* bench 19750.1.3 6871ca2c8b9d */
/* bench 19750.1.4 c28cdd28f4f2 */
/* bench 19750.1.5 5da7a6ea0494 */
/* bench 19750.1.6 5d23fc238a4f */
/* bench 19750.1.7 86364c92bba6 */
/* bench 19750.1.8 53508a247429 */
/* bench 19750.1.9 7d90121c393e */
/* bench 19750.1.10 de19c0e56914 */
/* bench 19750.1.11 dacf5261f738 */
/* bench 19750.1.12 0635a11e17be */
/* bench 19750.1.13 1a36e3f6ace8 */
#include "serval_common.dtsi"

/ {
	model = "Serval PCB106 Reference Board";
/* bench 20605.1.0 deb0c9702999 */
/* bench 20605.1.1 515d970a9e83 */
/* bench 20605.1.2 f6acfb85c26b */
/* bench 20605.1.3 ca3189c30469 */
/* bench 20605.1.4 d1ebee488a82 */
/* bench 20605.1.5 15fd64877e03 */
/* bench 20605.1.6 bc1ecab0d75b */
/* bench 20605.1.7 06218f6173b5 */
	};

};

