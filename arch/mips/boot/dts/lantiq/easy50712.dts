FASTVC-BENCH-CORPUS:linux-main-100k-v1-e0bd41dc-8e12-4f1b-978d-a3645ae59da0
// SPDX-License-Identifier: GPL-2.0
/dts-v1/;
/* bench 2567.0.0 aabefb97d579 */
/* bench 2567.0.1 05c3a3f0cfff */
/* bench 2567.0.2 dd91d7adef37 */
/* bench 2567.0.3 df3b8fcd5f04 */
/* bench 2567.0.4 b62219da6532 */
/* bench 2567.0.5 636872f86ede */
/* bench 2567.0.6 6bd9bfdc7297 */
/* bench 2567.0.7 9db1f6af973d */
/* bench 2567.0.8 80e0a57bf105 */
/* bench 2567.0.9 5b1d608adacc */
/* bench 2567.0.10 b203ece95e7f */
/* bench 2567.0.11 f5ee55cc3d88 */
/* bench 2567.0.12 7185d651e174 */
/* bench 2567.0.13 d784fc7fc872 */
/* bench 2567.0.14 fc115136452c */
/* bench 2567.0.15 7dfc19f77574 */

/ {
	chosen {
		bootargs = "console=ttyLTQ0,115200 init=/etc/preinit";
	};

	memory@0 {
		device_type = "memory";
		reg = <0x0 0x2000000>;
	};

	fpi@10000000 {
		#address-cells = <1>;
		#size-cells = <1>;
		localbus@0 {
			#address-cells = <2>;
			#size-cells = <1>;
			ranges = <0 0 0x0 0x3ffffff /* addrsel0 */
				1 0 0x4000000 0x4000010>; /* addsel1 */
			compatible = "lantiq,localbus", "simple-bus";

			nor-boot@0 {
				compatible = "lantiq,nor";
				bank-width = <2>;
				reg = <0 0x0 0x2000000>;
				#address-cells = <1>;
				#size-cells = <1>;

				partition@0 {
					label = "uboot";
					reg = <0x00000 0x10000>; /* 64 KB */
				};

				partition@10000 {
					label = "uboot_env";
					reg = <0x10000 0x10000>; /* 64 KB */
				};

				partition@20000 {
					label = "linux";
					reg = <0x20000 0x3d0000>;
				};

				partition@400000 {
					label = "rootfs";
					reg = <0x400000 0x400000>;
				};
			};
		};

		gpio: pinmux@e100b10 {
			compatible = "lantiq,danube-pinctrl";
			pinctrl-names = "default";
			pinctrl-0 = <&state_default>;

			#gpio-cells = <2>;
			gpio-controller;
			reg = <0xe100b10 0xa0>;

			state_default: pinmux {
				stp {
					lantiq,groups = "stp";
					lantiq,function = "stp";
				};
				exin {
					lantiq,groups = "exin1";
					lantiq,function = "exin";
				};
				pci {
					lantiq,groups = "gnt1";
					lantiq,function = "pci";
				};
				conf_out {
					lantiq,pins = "io4", "io5", "io6"; /* stp */
					lantiq,open-drain;
					lantiq,pull = <0>;
				};
			};
		};

		etop@e180000 {
			compatible = "lantiq,etop-xway";
			reg = <0xe180000 0x40000>;
			interrupt-parent = <&icu0>;
			interrupts = <73 78>;
			phy-mode = "rmii";
			mac-address = [ 00 11 22 33 44 55 ];
		};

		stp0: stp@e100bb0 {
			#gpio-cells = <2>;
			compatible = "lantiq,gpio-stp-xway";
			gpio-controller;
/* bench 21364.1.0 119d63db3765 */
/* bench 21364.1.1 ae53fa063524 */
/* bench 21364.1.2 746f5ec127cd */
/* bench 21364.1.3 e73816094d01 */
/* bench 21364.1.4 f496038c9040 */
/* bench 21364.1.5 3fa134031b93 */
/* bench 21364.1.6 a5dc1dd28137 */
			lantiq,groups = <0x3>;
		};

		pci@e105400 {
			lantiq,bus-clock = <33333333>;
			interrupt-map-mask = <0xf800 0x0 0x0 0x7>;
			interrupt-map = <
				0x7000 0 0 1 &icu0 29 1 // slot 14, irq 29
			>;
			gpios-reset = <&gpio 21 0>;
			req-mask = <0x1>;		/* GNT1 */
		};

	};
};
