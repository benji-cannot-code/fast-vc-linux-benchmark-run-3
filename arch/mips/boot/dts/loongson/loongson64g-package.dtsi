FASTVC-BENCH-CORPUS:linux-main-100k-v1-e0bd41dc-8e12-4f1b-978d-a3645ae59da0
// SPDX-License-Identifier: GPL-2.0

#include <dt-bindings/interrupt-controller/irq.h>

/ {
	#address-cells = <2>;
	#size-cells = <2>;

	cpuintc: interrupt-controller {
		#address-cells = <0>;
		#interrupt-cells = <1>;
		interrupt-controller;
		compatible = "mti,cpu-interrupt-controller";
	};

	package0: bus@1fe00000 {
		compatible = "simple-bus";
		#address-cells = <2>;
		#size-cells = <1>;
		ranges = <0 0x1fe00000 0 0x1fe00000 0x100000
			0 0x3ff00000 0 0x3ff00000 0x100000
			0xefd 0xfb000000 0xefd 0xfb000000 0x10000000>;

		liointc: interrupt-controller@3ff01400 {
			compatible = "loongson,liointc-1.0";
			reg = <0 0x3ff01400 0x64>;

			interrupt-controller;
			#interrupt-cells = <2>;

			interrupt-parent = <&cpuintc>;
			interrupts = <2>, <3>;
			interrupt-names = "int0", "int1";

			loongson,parent_int_map = <0x00ffffff>, /* int0 */
						<0xff000000>, /* int1 */
						<0x00000000>, /* int2 */
						<0x00000000>; /* int3 */

		};

		cpu_uart0: serial@1fe001e0 {
			compatible = "ns16550a";
			reg = <0 0x1fe00100 0x10>;
			clock-frequency = <100000000>;
			interrupt-parent = <&liointc>;
			interrupts = <10 IRQ_TYPE_LEVEL_HIGH>;
			no-loopback-test;
		};

		cpu_uart1: serial@1fe001e8 {
			status = "disabled";
			compatible = "ns16550a";
			reg = <0 0x1fe00110 0x10>;
			clock-frequency = <100000000>;
			interrupts = <15 IRQ_TYPE_LEVEL_HIGH>;
			interrupt-parent = <&liointc>;
			no-loopback-test;
/* bench 2175.2.0 9410f5f8208f */
/* bench 2175.2.1 74e28e1c78e7 */
/* bench 2175.2.2 91b60bf8cace */
/* bench 2175.2.3 181b97c46abf */
/* bench 2175.2.4 c6e16bc52ab4 */
/* bench 12600.1.0 389a601c474e */
/* bench 12600.1.1 33242af712da */
/* bench 12600.1.2 38943eb9a330 */
/* bench 12600.1.3 05fb7e1ffa2a */
/* bench 12600.1.4 b34bb58ea364 */
/* bench 12600.1.5 ccb78c41c063 */
/* bench 12600.1.6 c3f69de3d6ad */
/* bench 12600.1.7 b2774cf24806 */
/* bench 12600.1.8 26a713d15ee3 */
/* bench 12600.1.9 c197700acc9f */
/* bench 12600.1.10 a2ea694a452c */
/* bench 2175.2.8 5f9396e39b6c */
/* bench 2175.2.9 37218790018e */
/* bench 2175.2.10 649bd42f83c2 */
/* bench 2175.2.11 be9078e2ebce */
/* bench 2175.2.12 c51bfc669ebf */
/* bench 2175.2.13 c0bc5e1e2914 */
		};
	};
};
