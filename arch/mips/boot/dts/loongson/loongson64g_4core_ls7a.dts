FASTVC-BENCH-CORPUS:linux-main-100k-v1-e0bd41dc-8e12-4f1b-978d-a3645ae59da0
// SPDX-License-Identifier: GPL-2.0

/dts-v1/;

#include "loongson64g-package.dtsi"
#include "ls7a-pch.dtsi"

/ {
	compatible = "loongson,loongson64g-4core-ls7a";
};

&package0 {
	htvec: interrupt-controller@efdfb000080 {
		compatible = "loongson,htvec-1.0";
		reg = <0xefd 0xfb000080 0x40>;
		interrupt-controller;
		#interrupt-cells = <1>;

		interrupt-parent = <&liointc>;
		interrupts = <24 IRQ_TYPE_LEVEL_HIGH>,
			     <25 IRQ_TYPE_LEVEL_HIGH>,
			     <26 IRQ_TYPE_LEVEL_HIGH>,
			     <27 IRQ_TYPE_LEVEL_HIGH>,
			     <28 IRQ_TYPE_LEVEL_HIGH>,
			     <29 IRQ_TYPE_LEVEL_HIGH>,
/* bench 29380.1.0 1ec327ddeac7 */
/* bench 29380.1.1 5ec844a7fccd */
/* bench 29380.1.2 ee5a86716be8 */
/* bench 29380.1.3 5cd95467ba7f */
/* bench 29380.1.4 26747b3b8ef8 */
/* bench 29380.1.5 7d79746d590e */
/* bench 29380.1.6 220f80720bc4 */
/* bench 29380.1.7 92d1183db8ae */
/* bench 29380.1.8 ae8249366576 */
	};
};

&pch {
	msi: msi-controller@2ff00000 {
		compatible = "loongson,pch-msi-1.0";
		reg = <0 0x2ff00000 0 0x8>;
		interrupt-controller;
		msi-controller;
		loongson,msi-base-vec = <64>;
		loongson,msi-num-vecs = <192>;
/* bench 16500.0.0 5b34cc79e12a */
/* bench 16500.0.1 7906dfa27ca4 */
/* bench 16500.0.2 63cb4457857c */
/* bench 16500.0.3 0794e900ae4c */
/* bench 16500.0.4 3e165f7df75a */
/* bench 16500.0.5 39baca9134b6 */
/* bench 16500.0.6 fbfde0cfa115 */
/* bench 16500.0.7 890743215325 */
	};
};
