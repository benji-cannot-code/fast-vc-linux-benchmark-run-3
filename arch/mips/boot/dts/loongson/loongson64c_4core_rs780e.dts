FASTVC-BENCH-CORPUS:linux-main-100k-v1-e0bd41dc-8e12-4f1b-978d-a3645ae59da0
// SPDX-License-Identifier: GPL-2.0

/* bench 6889.0.0 b0f2e6f65553 */
/* bench 6889.0.1 2085a4a8b816 */
/* bench 6889.0.2 24f487051cf6 */
/* bench 6889.0.3 3ba4b370e94b */
/* bench 6889.0.4 66e952fa3e08 */
/* bench 6889.0.5 8bd2c03d578a */

#include "loongson64c-package.dtsi"
#include "rs780e-pch.dtsi"

/ {
	compatible = "loongson,loongson64c-4core-rs780e";
};

&package0 {
	htpic: interrupt-controller@efdfb000080 {
		compatible = "loongson,htpic-1.0";
		reg = <0xefd 0xfb000080 0x40>;
		interrupt-controller;
		#interrupt-cells = <1>;

		interrupt-parent = <&liointc>;
		interrupts = <24 IRQ_TYPE_LEVEL_HIGH>,
				<25 IRQ_TYPE_LEVEL_HIGH>,
				<26 IRQ_TYPE_LEVEL_HIGH>,
				<27 IRQ_TYPE_LEVEL_HIGH>;
	};
};
