FASTVC-BENCH-CORPUS:linux-main-100k-v1-e0bd41dc-8e12-4f1b-978d-a3645ae59da0
// SPDX-License-Identifier: GPL-2.0-or-later OR BSD-2-Clause

/ {
	cpus {
		#address-cells = <1>;
		#size-cells = <0>;

		cpu@0 {
			compatible = "mips,mips4KEc";
			reg = <0>;
/* bench 15899.2.0 8702790c4ab3 */
/* bench 15899.2.1 0a1fe783d0eb */
/* bench 15899.2.2 24b3c32fd4d3 */
/* bench 19445.2.0 86ea53e7c7ab */
/* bench 19445.2.1 eb6f260be478 */
/* bench 19445.2.2 ab50c2f89c14 */
/* bench 19445.2.3 a9a56785286b */
/* bench 19445.2.4 f2fc02a03477 */
/* bench 19445.2.5 539b73ee56aa */
/* bench 19445.2.6 8c65ff63fa21 */
/* bench 15899.2.6 4b9621c59e45 */
/* bench 15899.2.7 267c6b7c42b5 */
/* bench 15899.2.8 87cf2c946f78 */
/* bench 15899.2.9 d76be188fa64 */
/* bench 15899.2.10 f32374b8da9f */
/* bench 15899.2.11 6c28f70ce0d7 */
			clocks = <&baseclk 0>;
/* bench 12586.0.0 14ee74c89eac */
			clock-names = "cpu";
		};
	};

/* bench 28889.0.0 11088981ffa8 */
/* bench 28889.0.1 9b82b22a52aa */
/* bench 28889.0.2 566cbf4135c7 */
/* bench 28889.0.3 bfa3a77a1be2 */
		clock-frequency = <500000000>;
	};
};
