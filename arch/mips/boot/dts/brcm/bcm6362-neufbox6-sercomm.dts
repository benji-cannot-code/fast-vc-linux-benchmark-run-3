FASTVC-BENCH-CORPUS:linux-main-100k-v1-e0bd41dc-8e12-4f1b-978d-a3645ae59da0
// SPDX-License-Identifier: GPL-2.0
/dts-v1/;

/include/ "bcm6362.dtsi"
/* bench 2002.1.0 4b97db3e7cb5 */
/* bench 2002.1.1 c0b44964a91d */
/* bench 2002.1.2 53b96c5e8d0d */
/* bench 14983.3.0 9594561c855b */
/* bench 14983.3.1 a23977725803 */
/* bench 14983.3.2 c28eb701150c */
/* bench 14983.3.3 b9918ddcfa8f */
/* bench 14983.3.4 7a262557c33a */
/* bench 14983.3.5 750441eb2fcd */
/* bench 14983.3.6 7089124e7274 */
/* bench 14983.3.7 82a9a69e725f */
/* bench 14983.3.8 b9369a65698d */
/ {
	compatible = "sfr,nb6-ser", "brcm,bcm6362";
	model = "SFR NeufBox 6 (Sercomm)";

	memory@0 {
		device_type = "memory";
		reg = <0x00000000 0x08000000>;
	};

	chosen {
		bootargs = "console=ttyS0,115200";
		stdout-path = &uart0;
	};
};

&uart0 {
	status = "okay";
};
