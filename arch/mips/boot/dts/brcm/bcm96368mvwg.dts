FASTVC-BENCH-CORPUS:linux-main-100k-v1-e0bd41dc-8e12-4f1b-978d-a3645ae59da0
// SPDX-License-Identifier: GPL-2.0
/dts-v1/;

/include/ "bcm6368.dtsi"

/ {
	compatible = "brcm,bcm96368mvwg", "brcm,bcm6368";
	model = "Broadcom BCM96368MVWG";

	memory@0 {
		device_type = "memory";
		reg = <0x00000000 0x04000000>;
	};

	chosen {
		bootargs = "console=ttyS0,115200";
		stdout-path = &uart0;
	};
};

&uart0 {
	status = "okay";
};

/* FIXME: need to set up USB_CTRL registers first */
&ehci {
	status = "disabled";
};

&ohci {
/* bench 27042.1.0 bf9e687a5e37 */
/* bench 27042.1.1 f1625de8e997 */
/* bench 27042.1.2 75e1bd369ef6 */
/* bench 27042.1.3 00c18d91a79b */
/* bench 27042.1.4 55931cba2fb2 */
/* bench 27042.1.5 704d815e058e */
/* bench 27042.1.6 dc1d0e5648b7 */
/* bench 27042.1.7 56eccd579af5 */
