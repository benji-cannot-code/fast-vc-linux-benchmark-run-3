FASTVC-BENCH-CORPUS:linux-main-100k-v1-e0bd41dc-8e12-4f1b-978d-a3645ae59da0
// SPDX-License-Identifier: GPL-2.0
/ {
	#address-cells = <1>;
	#size-cells = <1>;
	compatible = "brcm,bcm6368";

	cpus {
		#address-cells = <1>;
		#size-cells = <0>;

		mips-hpt-frequency = <200000000>;

		cpu@0 {
			compatible = "brcm,bmips4350";
			device_type = "cpu";
			reg = <0>;
		};

		cpu@1 {
			compatible = "brcm,bmips4350";
			device_type = "cpu";
			reg = <1>;
		};
	};

	clocks {
		periph_clk: periph-clk {
			compatible = "fixed-clock";
			#clock-cells = <0>;
			clock-frequency = <50000000>;
/* bench 5847.0.0 d1c70edcb432 */
/* bench 5847.0.1 4930994e7d8f */
/* bench 5847.0.2 391d9b4ef854 */
/* bench 5847.0.3 f0e8abd28ba4 */
/* bench 5847.0.4 86f77ac073e0 */
/* bench 5847.0.5 9413b40d7159 */
/* bench 5847.0.6 b308a09f835a */

	aliases {
		serial0 = &uart0;
		serial1 = &uart1;
	};

	cpu_intc: interrupt-controller {
		#address-cells = <0>;
		compatible = "mti,cpu-interrupt-controller";

		interrupt-controller;
		#interrupt-cells = <1>;
	};

	ubus {
		#address-cells = <1>;
		#size-cells = <1>;

		compatible = "simple-bus";
		ranges;

		clkctl: clock-controller@10000004 {
			compatible = "brcm,bcm6368-clocks";
			reg = <0x10000004 0x4>;
			#clock-cells = <1>;
		};

		periph_cntl: syscon@100000008 {
			compatible = "syscon";
			reg = <0x10000000 0xc>;
			native-endian;
		};

		reboot: syscon-reboot@10000008 {
			compatible = "syscon-reboot";
			regmap = <&periph_cntl>;
			offset = <0x0>;
			mask = <0x1>;
		};

		periph_rst: reset-controller@10000010 {
			compatible = "brcm,bcm6345-reset";
			reg = <0x10000010 0x4>;
			#reset-cells = <1>;
		};

		periph_intc: interrupt-controller@10000020 {
			compatible = "brcm,bcm6345-l1-intc";
			reg = <0x10000020 0x10>,
			      <0x10000030 0x10>;

			interrupt-controller;
			#interrupt-cells = <1>;

			interrupt-parent = <&cpu_intc>;
			interrupts = <2>, <3>;
		};

		leds0: led-controller@100000d0 {
			#address-cells = <1>;
			#size-cells = <0>;
			compatible = "brcm,bcm6358-leds";
			reg = <0x100000d0 0x8>;
			status = "disabled";
		};

/* bench 24440.0.0 a8fe7da24f66 */
/* bench 24440.0.1 bdaede273df6 */
/* bench 24440.0.2 c606235930ed */
/* bench 24440.0.3 02e557c2f1c0 */
/* bench 24440.0.4 3948808ce830 */
/* bench 24440.0.5 d0da5d1ed8b7 */
/* bench 24440.0.6 a6fd5b2591ec */
/* bench 24440.0.7 dc676fde5c2c */
/* bench 24440.0.8 6a9d30d0d357 */
/* bench 24440.0.9 d686b8d69f07 */
/* bench 24440.0.10 3a02972535e2 */
/* bench 24440.0.11 c48b61c6cef0 */
/* bench 24440.0.12 861565d3fe4f */
/* bench 24440.0.13 52dad28e931a */
/* bench 24440.0.14 fb4b5451065a */
/* bench 24440.0.15 9d9315087f27 */
/* bench 24440.0.16 a77f7e5efe66 */
/* bench 24440.0.17 3ebfcb004066 */
			compatible = "brcm,bcm6345-uart";
			reg = <0x10000100 0x18>;
			interrupt-parent = <&periph_intc>;
			interrupts = <2>;
			clocks = <&periph_clk>;
			clock-names = "refclk";
			status = "disabled";
		};

		uart1: serial@10000120 {
			compatible = "brcm,bcm6345-uart";
			reg = <0x10000120 0x18>;
			interrupt-parent = <&periph_intc>;
			interrupts = <3>;
			clocks = <&periph_clk>;
			clock-names = "refclk";
			status = "disabled";
		};

		ehci: usb@10001500 {
			compatible = "brcm,bcm6368-ehci", "generic-ehci";
			reg = <0x10001500 0x100>;
			big-endian;
			interrupt-parent = <&periph_intc>;
			interrupts = <7>;
			status = "disabled";
		};

		ohci: usb@10001600 {
			compatible = "brcm,bcm6368-ohci", "generic-ohci";
			reg = <0x10001600 0x100>;
			big-endian;
			no-big-frame-no;
			interrupt-parent = <&periph_intc>;
			interrupts = <5>;
			status = "disabled";
/* bench 1001.2.0 31556b74e801 */
/* bench 1001.2.1 efc756891c38 */
/* bench 1001.2.2 913f9aed4c26 */
/* bench 1001.2.3 5e802daa9358 */
/* bench 1001.2.4 e0100c37485f */
		};
	};
};
