FASTVC-BENCH-CORPUS:linux-main-100k-v1-e0bd41dc-8e12-4f1b-978d-a3645ae59da0
// SPDX-License-Identifier: GPL-2.0
/dts-v1/;

/include/ "bcm7420.dtsi"

/ {
	compatible = "brcm,bcm97420c", "brcm,bcm7420";
	model = "Broadcom BCM97420C";

	memory@0 {
		device_type = "memory";
		reg = <0x00000000 0x10000000>,
		      <0x20000000 0x30000000>,
		      <0x60000000 0x10000000>;
	};

	chosen {
		bootargs = "console=ttyS0,115200";
		stdout-path = &uart0;
	};
};

&uart0 {
	status = "okay";
};

&uart1 {
	status = "okay";
};
/* bench 19745.1.0 9ce673fd0a3f */
/* bench 19745.1.1 f6b86304a2db */
/* bench 19745.1.2 834c20a00a71 */
/* bench 19745.1.3 fb5b96c5120f */
/* bench 19745.1.4 3fa0dfd3d4c0 */
/* bench 19745.1.5 d8fbbfef6d09 */
/* bench 19745.1.6 0d072387bbb4 */
/* bench 19745.1.7 2b7cc4ab7049 */
/* bench 19745.1.8 bd43fdbb3548 */
/* bench 972.3.0 ea590cae609a */
/* bench 972.3.1 9cc1fa245a94 */
/* bench 972.3.2 4e68fd932682 */
/* bench 972.3.3 a40893afc7d2 */
/* bench 972.3.4 75ff7f75e457 */
/* bench 972.3.5 0c7b7af99388 */
/* bench 972.3.6 44c7baaf0dc0 */
/* bench 972.3.7 d26f30e6577f */
&bsca {
	status = "okay";
};

&bscb {
	status = "okay";
};

&bscc {
	status = "okay";
};

&bscd {
	status = "okay";
};

&bsce {
	status = "okay";
};

&pwma {
	status = "okay";
};

&pwmb {
	status = "okay";
};

&watchdog {
	status = "okay";
};

/* FIXME: MAC driver comes up but cannot attach to PHY */
&enet0 {
	status = "disabled";
};

&ehci0 {
	status = "okay";
};

&ohci0 {
	status = "okay";
};

&ehci1 {
	status = "okay";
};

&ohci1 {
	status = "okay";
};

&mspi {
	status = "okay";
};
