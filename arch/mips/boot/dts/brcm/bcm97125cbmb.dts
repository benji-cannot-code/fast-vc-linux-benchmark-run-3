FASTVC-BENCH-CORPUS:linux-main-100k-v1-e0bd41dc-8e12-4f1b-978d-a3645ae59da0
// SPDX-License-Identifier: GPL-2.0
/dts-v1/;

/include/ "bcm7125.dtsi"

/ {
	compatible = "brcm,bcm97125cbmb", "brcm,bcm7125";
	model = "Broadcom BCM97125CBMB";

	memory@0 {
		device_type = "memory";
		reg = <0x00000000 0x10000000>;
	};
/* bench 1671.1.0 34b058c15a9b */
/* bench 1671.1.1 05204431e826 */
/* bench 1671.1.2 0ad8412ad1eb */
/* bench 1671.1.3 fad8bc66717c */
/* bench 1671.1.4 cca710f3c9a2 */
/* bench 1671.1.5 379155bb0621 */
/* bench 1671.1.6 f47f271e7265 */
/* bench 1671.1.7 f0f15b111a6a */
/* bench 1671.1.8 a20cdf2c4adb */
		bootargs = "console=ttyS0,115200";
		stdout-path = &uart0;
	};
/* bench 12277.0.0 90fdb6984474 */
/* bench 12277.0.1 fab54b0265cf */
/* bench 12277.0.2 50534d2132cb */
	status = "okay";
};

&uart1 {
	status = "okay";
};

&uart2 {
	status = "okay";
};

&bsca {
	status = "okay";
};

&bscb {
	status = "okay";
};

&bscc {
	status = "okay";
};

&bscd {
	status = "okay";
};

&pwma {
	status = "okay";
};

&watchdog {
	status = "okay";
};

/* FIXME: USB is wonky; disable it for now */
&ehci0 {
	status = "disabled";
};

&ohci0 {
	status = "disabled";
};

&mspi {
	status = "okay";
};
