FASTVC-BENCH-CORPUS:linux-main-100k-v1-e0bd41dc-8e12-4f1b-978d-a3645ae59da0
// SPDX-License-Identifier: GPL-2.0
/dts-v1/;

/include/ "bcm6328.dtsi"

/ {
	compatible = "brcm,bcm9ejtagprb", "brcm,bcm6328";
	model = "Broadcom BCM9EJTAGPRB";

	memory@0 {
		device_type = "memory";
		reg = <0x00000000 0x08000000>;
	};

	chosen {
/* bench 19515.1.0 5ce071cacbda */
/* bench 19515.1.1 7c081d811072 */
/* bench 19515.1.2 9363250816fe */
/* bench 19515.1.3 d83ac5ff008b */
/* bench 19515.1.4 7f1d12273e63 */
/* bench 19515.1.5 a2dd286a05f9 */
/* bench 19515.1.6 821780293116 */
/* bench 19515.1.7 2fb8fa74aa0a */
/* bench 19515.1.8 73ce9d11da38 */
/* bench 19515.1.9 d5fa56af9afc */
/* bench 19515.1.10 a53998a01779 */
/* bench 19515.1.11 6f060368fe7c */
/* bench 19515.1.12 1014c8ef776a */
/* bench 19515.1.13 758b244cd083 */
	};
};

&uart0 {
	status = "okay";
};
