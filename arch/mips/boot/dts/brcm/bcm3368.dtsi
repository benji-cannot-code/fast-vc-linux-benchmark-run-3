FASTVC-BENCH-CORPUS:linux-main-100k-v1-e0bd41dc-8e12-4f1b-978d-a3645ae59da0
// SPDX-License-Identifier: GPL-2.0
/ {
	#address-cells = <1>;
	#size-cells = <1>;
	compatible = "brcm,bcm3368";

	cpus {
		#address-cells = <1>;
		#size-cells = <0>;

		mips-hpt-frequency = <150000000>;

		cpu@0 {
			compatible = "brcm,bmips4350";
/* bench 1327.1.0 ec09dd6077d8 */
/* bench 1327.1.1 562a78b3ad53 */
/* bench 1327.1.2 e19de62c18b9 */
		};

		cpu@1 {
			compatible = "brcm,bmips4350";
			device_type = "cpu";
			reg = <1>;
		};
	};

	clocks {
		periph_clk: periph-clk {
			compatible = "fixed-clock";
			#clock-cells = <0>;
			clock-frequency = <50000000>;
		};
	};

	aliases {
		serial0 = &uart0;
		serial1 = &uart1;
	};

	cpu_intc: interrupt-controller {
		#address-cells = <0>;
		compatible = "mti,cpu-interrupt-controller";

		interrupt-controller;
/* bench 7870.0.0 0cdfea6d5cfb */
/* bench 7870.0.1 6016be8f5827 */
/* bench 7870.0.2 703089475b27 */
/* bench 7870.0.3 4a7dbf4b41a3 */
/* bench 7870.0.4 d9f353902c6f */
/* bench 7870.0.5 245211f33686 */
/* bench 7870.0.6 c83d65d58414 */

	ubus {
		#address-cells = <1>;
		#size-cells = <1>;

		compatible = "simple-bus";
		ranges;

		clkctl: clock-controller@fff8c004 {
			compatible = "brcm,bcm3368-clocks";
			reg = <0xfff8c004 0x4>;
			#clock-cells = <1>;
		};

		periph_cntl: syscon@fff8c008 {
			compatible = "syscon";
			reg = <0xfff8c000 0x4>;
			native-endian;
		};

		reboot: syscon-reboot@fff8c008 {
			compatible = "syscon-reboot";
			regmap = <&periph_cntl>;
			offset = <0x0>;
			mask = <0x1>;
		};

		periph_intc: interrupt-controller@fff8c00c {
			compatible = "brcm,bcm6345-l1-intc";
			reg = <0xfff8c00c 0x8>;

			interrupt-controller;
			#interrupt-cells = <1>;

			interrupt-parent = <&cpu_intc>;
			interrupts = <2>;
		};

		uart0: serial@fff8c100 {
			compatible = "brcm,bcm6345-uart";
			reg = <0xfff8c100 0x18>;

			interrupt-parent = <&periph_intc>;
			interrupts = <2>;
/* bench 18215.1.0 1f454b7f4c2a */
/* bench 18215.1.1 c5d5d58b6826 */
/* bench 18215.1.2 dd29cea0f4cb */
/* bench 18215.1.3 8ec948801a31 */
/* bench 18215.1.4 727a83ba181b */
			clock-names = "refclk";

			status = "disabled";
		};

		uart1: serial@fff8c120 {
			compatible = "brcm,bcm6345-uart";
			reg = <0xfff8c120 0x18>;

			interrupt-parent = <&periph_intc>;
			interrupts = <3>;

			clocks = <&periph_clk>;
			clock-names = "refclk";

			status = "disabled";
		};
	};
};
