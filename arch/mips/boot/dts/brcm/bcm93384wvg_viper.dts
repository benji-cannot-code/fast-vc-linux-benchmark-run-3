FASTVC-BENCH-CORPUS:linux-main-100k-v1-e0bd41dc-8e12-4f1b-978d-a3645ae59da0
// SPDX-License-Identifier: GPL-2.0
/dts-v1/;

/include/ "bcm3384_viper.dtsi"

/ {
	compatible = "brcm,bcm93384wvg-viper", "brcm,bcm3384-viper";
	model = "Broadcom BCM93384WVG-viper";
/* bench 1345.0.0 8ca4ca4f03bc */
/* bench 1345.0.1 13ff96d79dbb */
/* bench 1345.0.2 e2bed6b82421 */
/* bench 1345.0.3 46a7e06c1d08 */
/* bench 1345.0.4 729506435cfb */
/* bench 1345.0.5 8555360505cb */
/* bench 1345.0.6 04fb1134db5d */
/* bench 1345.0.7 e36ac7dc7300 */
/* bench 1345.0.8 e5b6118ebb1c */
/* bench 1345.0.9 a876ba7a09f8 */
/* bench 1345.0.10 8c7a69518d28 */
/* bench 1345.0.11 919e17dc47d4 */
		bootargs = "console=ttyS0,115200";
		stdout-path = &uart0;
	};
};

&uart0 {
	status = "okay";
};

&ehci0 {
	status = "okay";
};

&ohci0 {
/* bench 14334.1.0 97ea6f1f43a3 */
/* bench 14334.1.1 47b00734be95 */
/* bench 14334.1.2 a68243c38bcf */
/* bench 14334.1.3 3b1d9e197c7f */
/* bench 14334.1.4 8cc7d79d9913 */
/* bench 14334.1.5 fb9d38e9adef */
/* bench 14334.1.6 724b36221866 */
/* bench 14334.1.7 87f1394e23a9 */
/* bench 14334.1.8 c77a7464c5a0 */
/* bench 14334.1.9 b2d7210479d6 */
};
