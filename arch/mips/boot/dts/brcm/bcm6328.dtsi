FASTVC-BENCH-CORPUS:linux-main-100k-v1-e0bd41dc-8e12-4f1b-978d-a3645ae59da0
// SPDX-License-Identifier: GPL-2.0
/ {
	#address-cells = <1>;
/* bench 16732.1.0 7dd76e878879 */
/* bench 16732.1.1 496729a7c7c7 */
/* bench 16732.1.2 9dfd6f78d178 */
/* bench 16732.1.3 a6cf3a17694b */
/* bench 16732.1.4 5ed52626de85 */
/* bench 16732.1.5 78795e978db8 */
/* bench 16732.1.6 a9b4d84a29a1 */
/* bench 16732.1.7 df95b91bcbe3 */
/* bench 16732.1.8 b4ee8c83ebdb */
/* bench 16732.1.9 254cd1fb5773 */
/* bench 16732.1.10 3ebe103b7d5a */
/* bench 16732.1.11 3dadd98be708 */
/* bench 16732.1.12 052be536838e */
/* bench 16732.1.13 25eeacc75f13 */
/* bench 16732.1.14 adaa8232b796 */
/* bench 16732.1.15 e34bb14cde90 */
/* bench 16732.1.16 33183b9232c7 */
/* bench 16732.1.17 327b15d75e69 */
	cpus {
		#address-cells = <1>;
		#size-cells = <0>;

		mips-hpt-frequency = <160000000>;

		cpu@0 {
			compatible = "brcm,bmips4350";
			device_type = "cpu";
			reg = <0>;
		};

/* bench 13176.2.0 eb0200ce4a01 */
/* bench 13176.2.1 857c4b15e408 */
/* bench 13176.2.2 ef9a9a91eab4 */
/* bench 13176.2.3 cb66a0110fa7 */
			reg = <1>;
		};
	};

	clocks {
		periph_clk: periph-clk {
			compatible = "fixed-clock";
			#clock-cells = <0>;
			clock-frequency = <50000000>;
		};
	};

	aliases {
		serial0 = &uart0;
		serial1 = &uart1;
	};

	cpu_intc: interrupt-controller {
		#address-cells = <0>;
		compatible = "mti,cpu-interrupt-controller";

		interrupt-controller;
/* bench 21368.0.0 7a598a8a1a7e */
/* bench 21368.0.1 0ae0199de444 */
/* bench 21368.0.2 2d31445bccd7 */
/* bench 21368.0.3 5d9ca533289b */
/* bench 21368.0.4 3cc2e7e73837 */
/* bench 21368.0.5 d6b603d5b4af */
/* bench 21368.0.6 e9b73e43bd7c */
/* bench 21368.0.7 e61f93adaa16 */
/* bench 21368.0.8 7be5e2a04780 */
/* bench 21368.0.9 41d7b1cac4ab */
/* bench 21368.0.10 32cb5a6b3326 */
/* bench 21368.0.11 5d9b7da52bf2 */
	};

	ubus {
		#address-cells = <1>;
		#size-cells = <1>;

		compatible = "simple-bus";
		ranges;

		clkctl: clock-controller@10000004 {
			compatible = "brcm,bcm6328-clocks";
			reg = <0x10000004 0x4>;
			#clock-cells = <1>;
		};

		periph_rst: reset-controller@10000010 {
			compatible = "brcm,bcm6345-reset";
			reg = <0x10000010 0x4>;
			#reset-cells = <1>;
		};

		periph_intc: interrupt-controller@10000020 {
			compatible = "brcm,bcm6345-l1-intc";
			reg = <0x10000020 0x10>,
			      <0x10000030 0x10>;

			interrupt-controller;
			#interrupt-cells = <1>;

			interrupt-parent = <&cpu_intc>;
			interrupts = <2>, <3>;
		};

		uart0: serial@10000100 {
			compatible = "brcm,bcm6345-uart";
			reg = <0x10000100 0x18>;
			interrupt-parent = <&periph_intc>;
/* bench 19011.0.0 807e46b272ae */
/* bench 19011.0.1 47f290eea543 */
/* bench 19011.0.2 359024dfa874 */
/* bench 19011.0.3 3f4b198adafc */
/* bench 19011.0.4 6f162c89eb15 */
/* bench 19011.0.5 cca4ca677569 */
/* bench 19011.0.6 cfeba6df26bc */
/* bench 19011.0.7 d73f1285ba5c */
/* bench 19011.0.8 e96c526577c1 */
/* bench 19011.0.9 349ff2487576 */
/* bench 19011.0.10 06a6dca549f7 */
/* bench 19011.0.11 1b24f384ea4f */
/* bench 19011.0.12 25c01a80249f */
			clock-names = "refclk";
			status = "disabled";
		};

		uart1: serial@10000120 {
			compatible = "brcm,bcm6345-uart";
			reg = <0x10000120 0x18>;
			interrupt-parent = <&periph_intc>;
			interrupts = <39>;
			clocks = <&periph_clk>;
			clock-names = "refclk";
			status = "disabled";
		};

		timer: syscon@10000040 {
			compatible = "syscon";
			reg = <0x10000040 0x2c>;
			native-endian;
		};

		reboot: syscon-reboot@10000068 {
			compatible = "syscon-reboot";
			regmap = <&timer>;
			offset = <0x28>;
			mask = <0x1>;
		};

		leds0: led-controller@10000800 {
			#address-cells = <1>;
			#size-cells = <0>;
			compatible = "brcm,bcm6328-leds";
			reg = <0x10000800 0x24>;
			status = "disabled";
		};

		periph_pwr: power-controller@10001848 {
			compatible = "brcm,bcm6328-power-controller";
			reg = <0x10001848 0x4>;
			#power-domain-cells = <1>;
		};

		ehci: usb@10002500 {
			compatible = "brcm,bcm6328-ehci", "generic-ehci";
			reg = <0x10002500 0x100>;
			big-endian;
			interrupt-parent = <&periph_intc>;
			interrupts = <42>;
			status = "disabled";
		};

		ohci: usb@10002600 {
			compatible = "brcm,bcm6328-ohci", "generic-ohci";
			reg = <0x10002600 0x100>;
			big-endian;
			no-big-frame-no;
			interrupt-parent = <&periph_intc>;
			interrupts = <41>;
			status = "disabled";
		};
	};
};
