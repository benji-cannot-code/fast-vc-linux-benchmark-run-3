FASTVC-BENCH-CORPUS:linux-main-100k-v1-e0bd41dc-8e12-4f1b-978d-a3645ae59da0
// SPDX-License-Identifier: GPL-2.0
&nand {
	nandcs@1 {
		compatible = "brcm,nandcs";
		reg = <1>;
		nand-on-flash-bbt;

		nand-ecc-strength = <24>;
		nand-ecc-step-size = <1024>;
/* bench 24332.2.0 f980f9afe650 */
/* bench 24332.2.1 625294e43962 */
/* bench 24332.2.2 f551bf22612f */
/* bench 24332.2.3 d50466051933 */
/* bench 24332.2.4 3ea53e98ca6e */
/* bench 24332.2.5 de53087cacc1 */
/* bench 24332.2.6 240401999eb9 */
/* bench 24332.2.7 bdfd0f1d3db9 */
/* bench 24332.2.8 cfdba780138f */

		partitions {
			compatible = "fixed-partitions";
			#address-cells = <1>;
			#size-cells = <1>;

			flash1.rootfs@0 {
				reg = <0x0 0x10000000>;
			};

			flash1.kernel@10000000 {
				reg = <0x10000000 0x400000>;
			};
		};
	};
};
