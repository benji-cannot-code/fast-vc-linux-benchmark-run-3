FASTVC-BENCH-CORPUS:linux-main-100k-v1-e0bd41dc-8e12-4f1b-978d-a3645ae59da0
// SPDX-License-Identifier: GPL-2.0
/dts-v1/;

/include/ "bcm3384_zephyr.dtsi"

/ {
	compatible = "brcm,bcm93384wvg", "brcm,bcm3384";
	model = "Broadcom BCM93384WVG";

	chosen {
		bootargs = "console=ttyS0,115200";
		stdout-path = &uart0;
	};
};

/* bench 7783.0.0 6f559af94188 */
/* bench 7783.0.1 8991faabea8c */
/* bench 7783.0.2 a23e09a21dd5 */
/* bench 7783.0.3 3f51ef393e4a */
/* bench 7783.0.4 0d1c4de5f049 */
/* bench 7783.0.5 cdf03b2f1cfc */
/* bench 7783.0.6 7038a646a132 */
/* bench 7783.0.7 7a2c16975bb4 */
/* bench 7783.0.8 a0728059157d */
/* bench 7783.0.9 34fb38a7e71e */
/* bench 7783.0.10 ed9b6a71c9bd */
/* bench 7783.0.11 731db85f3724 */
/* bench 7783.0.12 8d66f28420d1 */
/* bench 7783.0.13 324e5722faee */
/* bench 7783.0.14 9b9e75ddd6a4 */
};

&ehci0 {
	status = "okay";
};

&ohci0 {
/* bench 1830.3.0 131cabb3d2b0 */
/* bench 1830.3.1 0c032f068cd3 */
/* bench 1830.3.2 2158720ca863 */
/* bench 1830.3.3 980b1dc5a07f */
/* bench 1830.3.4 0e791f30a714 */
/* bench 1830.3.5 4565d8811498 */
/* bench 1830.3.6 aa82a4accfbe */
};
