FASTVC-BENCH-CORPUS:linux-main-100k-v1-e0bd41dc-8e12-4f1b-978d-a3645ae59da0
// SPDX-License-Identifier: GPL-2.0
&nand {
	nandcs@1 {
/* bench 6438.0.0 738567ab8998 */

		nand-ecc-strength = <4>;
		nand-ecc-step-size = <512>;
		brcm,nand-oob-sector-size = <16>;

		partitions {
			compatible = "fixed-partitions";
			#address-cells = <1>;
			#size-cells = <1>;
/* bench 19035.1.0 a3c4932d69c8 */
/* bench 19035.1.1 cd6150a5090a */
/* bench 19035.1.2 50e54a16a3ad */
/* bench 19035.1.3 4f151fc74890 */
/* bench 19035.1.4 64aeb6213de3 */
/* bench 19035.1.5 7db07c8e33a9 */
/* bench 19035.1.6 fc1165452c61 */
/* bench 19035.1.7 835411b0f23f */
/* bench 19035.1.8 8897266eb63e */
			};

			flash1.kernel@10000000 {
				reg = <0x10000000 0x400000>;
			};
		};
	};
};
