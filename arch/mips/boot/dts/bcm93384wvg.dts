FASTVC-BENCH-CORPUS:linux-main-100k-v1-e0bd41dc-8e12-4f1b-978d-a3645ae59da0
/dts-v1/;

/include/ "bcm3384.dtsi"

/ {
	compatible = "brcm,bcm93384wvg", "brcm,bcm3384";
	model = "Broadcom BCM93384WVG";

	chosen {
		bootargs = "console=ttyS0,115200";
		stdout-path = &uart0;
	};

	memory@0 {
		device_type = "memory";
		reg = <0x0 0x04000000>;
		dma-xor-mask = <0x08000000>;
		dma-xor-limit = <0x0fffffff>;
	};
};

&uart0 {
	status = "okay";
};

&ehci0 {
	status = "okay";
};

&ohci0 {
	status = "okay";
};
