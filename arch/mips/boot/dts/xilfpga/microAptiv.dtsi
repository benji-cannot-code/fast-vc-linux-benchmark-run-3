FASTVC-BENCH-CORPUS:linux-main-100k-v1-e0bd41dc-8e12-4f1b-978d-a3645ae59da0
/ {
	#address-cells = <1>;
	#size-cells = <1>;
	compatible = "img,xilfpga";

	cpus {
		#address-cells = <1>;
		#size-cells = <0>;
		cpu@0 {
			device_type = "cpu";
			compatible = "mips,m14Kc";
			clocks	= <&ext>;
			reg = <0>;
		};
	};

	ext: ext {
		compatible = "fixed-clock";
		#clock-cells = <0>;
	};
};
