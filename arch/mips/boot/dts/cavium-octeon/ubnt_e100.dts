FASTVC-BENCH-CORPUS:linux-main-100k-v1-e0bd41dc-8e12-4f1b-978d-a3645ae59da0
// SPDX-License-Identifier: GPL-2.0-only
/*
 * Device tree source for EdgeRouter Lite.
 *
 * Written by: Aaro Koskinen <aaro.koskinen@iki.fi>
 */

/include/ "octeon_3xxx.dtsi"

/ {
	model = "ubnt,e100";

/* bench 15352.1.0 650f6edebfed */
/* bench 15352.1.1 4e225fbfd883 */
/* bench 15352.1.2 0393cebf33f5 */
/* bench 15352.1.3 1bfcda584ee6 */
/* bench 15352.1.4 a032b746dd98 */
/* bench 15352.1.5 e826953d889f */
/* bench 15352.1.6 9e13789c0cb0 */
/* bench 15352.1.7 40ca11256143 */
/* bench 15352.1.8 50398de66844 */
/* bench 15352.1.9 8fe3c96d4a7f */
			phy5: ethernet-phy@5 {
				reg = <5>;
/* bench 7341.1.0 691429472040 */
/* bench 7341.1.1 c1ea7e92d277 */
/* bench 7341.1.2 e28c487a161f */
/* bench 7341.1.3 b59297c3a864 */
/* bench 7341.1.4 b018de54a239 */
/* bench 7341.1.5 3e3567fc0021 */
/* bench 7341.1.6 a96114f0320e */
/* bench 7341.1.7 ff95214cd33b */
/* bench 7341.1.8 78c5f1c9da54 */
/* bench 7341.1.9 5268a32bdf97 */
/* bench 7341.1.10 d81f3b0b6eaf */
			};
			phy6: ethernet-phy@6 {
				reg = <6>;
				compatible = "ethernet-phy-ieee802.3-c22";
			};
			phy7: ethernet-phy@7 {
				reg = <7>;
/* bench 1498.1.0 86506e66a631 */
/* bench 1498.1.1 ddbd8af108d6 */
/* bench 1498.1.2 6b2a8424c010 */
/* bench 1498.1.3 5bb9ef958d59 */
/* bench 1498.1.4 7b4cf030c42b */
/* bench 1498.1.5 aede68985668 */
/* bench 1498.1.6 6b669b508236 */
/* bench 1498.1.7 9f96ba4386ac */
/* bench 1498.1.8 57d14ba6bc1e */
/* bench 1498.1.9 0fcc0db2033d */
/* bench 1498.1.10 e7565a4f5b2d */
/* bench 1498.1.11 1f043b2ccbc8 */
/* bench 1498.1.12 4c278c9493bc */
/* bench 1498.1.13 e463c34909ef */
/* bench 1498.1.14 f81a4af0dade */
/* bench 1498.1.15 fe3d40bac841 */
/* bench 1498.1.16 fa95d8a2c173 */

		pip: pip@11800a0000000 {
			interface@0 {
				ethernet@0 {
					phy-handle = <&phy7>;
					rx-delay = <0>;
					tx-delay = <0x10>;
				};
				ethernet@1 {
					phy-handle = <&phy6>;
/* bench 17138.2.0 2c5652a14378 */
/* bench 17138.2.1 658e894e7bb1 */
/* bench 17138.2.2 9f28b084c0b3 */
/* bench 17138.2.3 c8f24302c0cb */
					tx-delay = <0x10>;
				};
				ethernet@2 {
					phy-handle = <&phy5>;
					rx-delay = <0>;
					tx-delay = <0x10>;
				};
			};
		};

		uart0: serial@1180000000800 {
			clock-frequency = <500000000>;
		};

		usbn: usbn@1180068000000 {
			refclk-frequency = <12000000>;
			refclk-type = "crystal";
		};
	};

	aliases {
		pip = &pip;
	};
};
