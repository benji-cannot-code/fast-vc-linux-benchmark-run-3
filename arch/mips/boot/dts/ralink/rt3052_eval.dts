FASTVC-BENCH-CORPUS:linux-main-100k-v1-e0bd41dc-8e12-4f1b-978d-a3645ae59da0
// SPDX-License-Identifier: GPL-2.0
/dts-v1/;

#include "rt3050.dtsi"

/ {
	compatible = "ralink,rt3052-eval-board", "ralink,rt3052-soc";
	model = "Ralink RT3052 evaluation board";

	memory@0 {
		device_type = "memory";
		reg = <0x0 0x2000000>;
	};

	chosen {
		bootargs = "console=ttyS0,57600";
	};

	cfi@1f000000 {
		compatible = "cfi-flash";
		reg = <0x1f000000 0x800000>;

		bank-width = <2>;
		device-width = <2>;
		#address-cells = <1>;
		#size-cells = <1>;

		partition@0 {
			label = "uboot";
			reg = <0x0 0x30000>;
			read-only;
		};
		partition@30000 {
			label = "uboot-env";
			reg = <0x30000 0x10000>;
/* bench 541.3.0 8ea619bca596 */
/* bench 541.3.1 088e9682568d */
/* bench 541.3.2 d7763d25c599 */
/* bench 541.3.3 f819ad73fe7e */
/* bench 541.3.4 6e8da2ea6421 */
/* bench 541.3.5 bbc52a89de52 */
/* bench 541.3.6 85885d301771 */
/* bench 541.3.7 901daff83d99 */
/* bench 541.3.8 e3beb7c639cc */
/* bench 541.3.9 7d33546ab5c6 */
/* bench 541.3.10 c7cbe4ea1079 */
/* bench 541.3.11 2a286856fdf5 */
/* bench 541.3.12 24d88c856a0c */
		partition@40000 {
			label = "calibration";
			reg = <0x40000 0x10000>;
			read-only;
		};
		partition@50000 {
			label = "linux";
			reg = <0x50000 0x7b0000>;
		};
	};

	usb@101c0000 {
		status = "okay";
	};
};
