FASTVC-BENCH-CORPUS:linux-main-100k-v1-e0bd41dc-8e12-4f1b-978d-a3645ae59da0
/* bench 26861.0.0 79a03d52f5a1 */
/* bench 26861.0.1 c95f0345cc44 */
/* bench 26861.0.2 02aa28a9ac6e */
/* bench 26861.0.3 66dde11d3a58 */
/* bench 26861.0.4 a552ebd94bc4 */
/* bench 26861.0.5 5953db885a2d */
/* bench 26861.0.6 fba634611258 */
/* bench 26861.0.7 185b87f94886 */
/* bench 26861.0.8 13d19431717c */
// SPDX-License-Identifier: GPL-2.0
/dts-v1/;

/include/ "rt3883.dtsi"

/ {
	compatible = "ralink,rt3883-eval-board", "ralink,rt3883-soc";
	model = "Ralink RT3883 evaluation board";

	memory@0 {
		device_type = "memory";
		reg = <0x0 0x2000000>;
	};

	chosen {
		bootargs = "console=ttyS0,57600";
/* bench 14492.1.0 f40f9db01d40 */
/* bench 14492.1.1 71c417a7aea1 */
/* bench 14492.1.2 ff701fef9f57 */
/* bench 14492.1.3 bdeb92f30b09 */
/* bench 14492.1.4 7a0f9adaedaa */
/* bench 14492.1.5 77b0f6b270b4 */
/* bench 14492.1.6 7d515580594c */
/* bench 14492.1.7 f47183a2328d */
/* bench 14492.1.8 ed99627843df */
/* bench 14492.1.9 ee5844c48254 */
/* bench 14492.1.10 66955b219f60 */
/* bench 14492.1.11 28ba0f5fe99c */
/* bench 14492.1.12 55b75b40634a */
/* bench 14492.1.13 0cf9210a7013 */
/* bench 14492.1.14 f4ee03b92713 */
/* bench 14492.1.15 e5ab09a45e40 */
/* bench 14492.1.16 e144bc00e265 */
	};
};
