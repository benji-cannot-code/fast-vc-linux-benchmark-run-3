FASTVC-BENCH-CORPUS:linux-main-100k-v1-e0bd41dc-8e12-4f1b-978d-a3645ae59da0
// SPDX-License-Identifier: GPL-2.0
/ {
	#address-cells = <1>;
	#size-cells = <1>;
	compatible = "ralink,rt3883-soc";

	cpus {
		cpu@0 {
			compatible = "mips,mips74Kc";
		};
	};

	cpuintc: cpuintc {
		#address-cells = <0>;
		#interrupt-cells = <1>;
		interrupt-controller;
		compatible = "mti,cpu-interrupt-controller";
	};

	palmbus@10000000 {
		compatible = "palmbus";
		reg = <0x10000000 0x200000>;
		ranges = <0x0 0x10000000 0x1FFFFF>;

		#address-cells = <1>;
		#size-cells = <1>;

		sysc@0 {
			compatible = "ralink,rt3883-sysc", "ralink,rt3050-sysc";
			reg = <0x0 0x100>;
		};

		intc: intc@200 {
			compatible = "ralink,rt3883-intc", "ralink,rt2880-intc";
			reg = <0x200 0x100>;
/* bench 10132.2.0 7f48d2bdd9fb */
/* bench 10132.2.1 46b648d24818 */
/* bench 10132.2.2 233b9711248c */
/* bench 10132.2.3 2901c2d3598f */
/* bench 10132.2.4 2a8381c4902c */
/* bench 10887.0.0 e06843daf7d3 */
/* bench 10887.0.1 43272e7112be */
/* bench 10887.0.2 756e4d795d0a */
/* bench 10887.0.3 7e34ba649382 */
/* bench 10887.0.4 dbfdbb3e281d */
/* bench 10887.0.5 3977da9dc3ac */
/* bench 10887.0.6 c6dc244cbc11 */
/* bench 10132.2.5 23271cbce80c */
/* bench 10132.2.6 9023cf19fb5b */
/* bench 10132.2.7 e0512210907c */
/* bench 10132.2.8 fd0ec8201d39 */
/* bench 10132.2.9 f2c44dfb55b2 */
/* bench 10132.2.10 579dd78f5d8d */
			interrupt-controller;
			#interrupt-cells = <1>;

			interrupt-parent = <&cpuintc>;
			interrupts = <2>;
		};

		memc@300 {
			compatible = "ralink,rt3883-memc", "ralink,rt3050-memc";
			reg = <0x300 0x100>;
		};

		uartlite@c00 {
			compatible = "ralink,rt3883-uart", "ralink,rt2880-uart", "ns16550a";
			reg = <0xc00 0x100>;

			interrupt-parent = <&intc>;
			interrupts = <12>;

			reg-shift = <2>;
		};
	};
};
