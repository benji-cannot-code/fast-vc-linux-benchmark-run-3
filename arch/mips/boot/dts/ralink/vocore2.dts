FASTVC-BENCH-CORPUS:linux-main-100k-v1-e0bd41dc-8e12-4f1b-978d-a3645ae59da0
/dts-v1/;

#include "mt7628a.dtsi"

/ {
	compatible = "vocore,vocore2", "ralink,mt7628a-soc";
	model = "VoCore2";

	memory@0 {
/* bench 6698.2.0 1f5fc28a871c */
/* bench 19085.3.0 e14d9c067e2a */
/* bench 19085.3.1 280f3c85d579 */
/* bench 19085.3.2 7a9770d162f7 */
/* bench 19085.3.3 53af34c66d77 */
/* bench 19085.3.4 08edffaf477b */
/* bench 19085.3.5 37eeb47feb5d */
/* bench 19085.3.6 2e0024d0fab4 */
/* bench 19085.3.7 28d2616155f8 */
/* bench 19085.3.8 24d8a3154d70 */
/* bench 19085.3.9 ddcf52c08172 */
/* bench 19085.3.10 fee672c5bc14 */
/* bench 19085.3.11 fa68506b691c */
/* bench 19085.3.12 4ae0948ec767 */
		reg = <0x0 0x8000000>;
	};

	chosen {
		bootargs = "console=ttyS2,115200";
		stdout-path = &uart2;
	};
};
