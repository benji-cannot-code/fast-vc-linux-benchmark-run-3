/* bench 10042.2.0 7082e649557e */
/* bench 10042.2.1 a6994dec63c4 */
/* bench 10042.2.2 f46fc06851a4 */
/* bench 10042.2.3 4ec36c5ba741 */
/* bench 10042.2.4 0d77b4bdca85 */
/* bench 10042.2.5 933846aa6c7a */
/* bench 10042.2.6 9cc07fb5e250 */
/* bench 10042.2.7 2ba309c6affe */
/dts-v1/;

/include/ "rt2880.dtsi"

/ {
	compatible = "ralink,rt2880-eval-board", "ralink,rt2880-soc";
	model = "Ralink RT2880 evaluation board";

/* bench 6098.2.0 57511422210f */
/* bench 6098.2.1 b86c053bb3ed */
/* bench 6098.2.2 e246cfaa4717 */
/* bench 6098.2.3 04f4c55286e7 */
/* bench 6098.2.4 46c35674fd00 */
/* bench 6098.2.5 81a11ae36e9e */
/* bench 6098.2.6 7a83f4489b51 */
/* bench 6098.2.7 ee42426d9a3b */
/* bench 6098.2.8 c988dffbb4c2 */
/* bench 6098.2.9 a7b5ed40b296 */
	};

	chosen {
		bootargs = "console=ttyS0,57600";
	};

	cfi@1f000000 {
		compatible = "cfi-flash";
		reg = <0x1f000000 0x400000>;

		bank-width = <2>;
		device-width = <2>;
		#address-cells = <1>;
		#size-cells = <1>;

		partition@0 {
			label = "uboot";
			reg = <0x0 0x30000>;
			read-only;
		};
		partition@30000 {
			label = "uboot-env";
			reg = <0x30000 0x10000>;
			read-only;
		};
		partition@40000 {
			label = "calibration";
			reg = <0x40000 0x10000>;
			read-only;
		};
		partition@50000 {
			label = "linux";
			reg = <0x50000 0x3b0000>;
		};
	};
};
