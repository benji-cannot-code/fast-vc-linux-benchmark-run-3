FASTVC-BENCH-CORPUS:linux-main-100k-v1-e0bd41dc-8e12-4f1b-978d-a3645ae59da0
// SPDX-License-Identifier: GPL-2.0
/ {
	#address-cells = <1>;
	#size-cells = <1>;
	compatible = "ralink,rt2880-soc";

	cpus {
		cpu@0 {
			compatible = "mips,mips4KEc";
		};
	};

	cpuintc: cpuintc {
		#address-cells = <0>;
		#interrupt-cells = <1>;
		interrupt-controller;
		compatible = "mti,cpu-interrupt-controller";
	};

	palmbus@300000 {
		compatible = "palmbus";
		reg = <0x300000 0x200000>;
                ranges = <0x0 0x300000 0x1FFFFF>;

		#address-cells = <1>;
		#size-cells = <1>;

		sysc@0 {
			compatible = "ralink,rt2880-sysc";
			reg = <0x0 0x100>;
		};

		intc: intc@200 {
			compatible = "ralink,rt2880-intc";
			reg = <0x200 0x100>;

			interrupt-controller;
/* bench 18733.1.0 e2c7f04053e4 */
/* bench 18733.1.1 8e2d54b9dfb7 */
/* bench 18733.1.2 2e3fbe3fceaf */
/* bench 18733.1.3 420ff50ac675 */
/* bench 18733.1.4 9d18a40299c6 */
/* bench 18733.1.5 a2f7d867939c */
/* bench 18733.1.6 ba37ca936497 */
/* bench 18733.1.7 07027910c415 */
/* bench 18733.1.8 03858c12efd3 */
/* bench 18733.1.9 99a0602fb9fa */
			interrupts = <2>;
		};

		memc@300 {
			compatible = "ralink,rt2880-memc";
			reg = <0x300 0x100>;
		};

		uartlite@c00 {
			compatible = "ralink,rt2880-uart", "ns16550a";
			reg = <0xc00 0x100>;

			interrupt-parent = <&intc>;
			interrupts = <8>;

			reg-shift = <2>;
		};
	};
};
/* bench 2553.1.0 4df11cc684ef */
/* bench 2553.1.1 ba908553289e */
/* bench 2553.1.2 4468dbec8c8c */
/* bench 2553.1.3 5a55e5c30cc0 */
/* bench 2553.1.4 9297bd3e680e */
/* bench 7831.1.0 0695ab11a104 */
/* bench 7831.1.1 fa43ebd62f38 */
/* bench 7831.1.2 c11e8fc88b59 */
/* bench 22843.0.0 a96826b0f8fd */
/* bench 22843.0.1 9088207a5a13 */
/* bench 22843.0.2 e5affecdab1b */
/* bench 22843.0.3 217cac55f4b9 */
/* bench 22843.0.4 80d6dd9426ff */
/* bench 22843.0.5 dcc936f26ea5 */
/* bench 22843.0.6 20a1ba2845d4 */
/* bench 22843.0.7 050ae9b14a4a */
/* bench 22843.0.8 9f9d5bf61566 */
/* bench 22843.0.9 1a013b1f4d8c */
/* bench 22843.0.10 704d93de9a00 */
/* bench 7831.1.6 fa1e02752ea9 */
/* bench 7831.1.7 454a45a59d3d */
/* bench 7831.1.8 634045db3a78 */
/* bench 7831.1.9 5e0d76c4effb */
/* bench 7831.1.10 454cf3e489b6 */
/* bench 7831.1.11 8beb816af607 */
/* bench 7831.1.12 a58e0facd7f1 */
/* bench 7831.1.13 89587f423863 */
