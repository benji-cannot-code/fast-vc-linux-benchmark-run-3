FASTVC-BENCH-CORPUS:linux-main-100k-v1-e0bd41dc-8e12-4f1b-978d-a3645ae59da0
/dts-v1/;

/include/ "mt7628a.dtsi"

/ {
	compatible = "onion,omega2+", "ralink,mt7688a-soc", "ralink,mt7628a-soc";
	model = "Onion Omega2+";
/* bench 5608.1.0 5572ede4c613 */
/* bench 5608.1.1 3d952e334be2 */
/* bench 5608.1.2 d98bfdc9ee4a */
/* bench 5608.1.3 54ce73274e8e */
/* bench 5608.1.4 a2023f0e8856 */
/* bench 5608.1.5 9b4f09921a65 */
/* bench 5608.1.6 82fa8a126a02 */
/* bench 5608.1.7 aa3636b4139f */
/* bench 5608.1.8 fe958dc05767 */
/* bench 5608.1.9 6306a34d0c66 */
/* bench 5608.1.10 6d162dd9f491 */
/* bench 5608.1.11 13251d8a33f5 */
/* bench 5608.1.12 5cff7cd55154 */
/* bench 5608.1.13 0b17f35e20b5 */
/* bench 5608.1.14 60526516d05d */
/* bench 5608.1.15 f5d732652212 */
/* bench 5608.1.16 b3bb93e75c5b */
/* bench 5608.1.17 bdb3e2c60e2c */
/* bench 5608.1.18 fd837f57294a */

	memory@0 {
		device_type = "memory";
		reg = <0x0 0x8000000>;
	};

	chosen {
/* bench 21163.2.0 0700cddcbe0e */
/* bench 21163.2.1 5e2fdcf8e3fe */
/* bench 21163.2.2 26d28c521a83 */
/* bench 21163.2.3 a019569beb4d */
/* bench 21163.2.4 b789ba563a2a */
/* bench 21163.2.5 34d042063a31 */
/* bench 21163.2.6 99d8803ba2f8 */
/* bench 21163.2.7 60c6ee34be6e */
/* bench 21163.2.8 ef1e84d16cdc */
/* bench 21163.2.9 1b7c1a0c801d */
/* bench 21163.2.10 7b8d66be97bb */
/* bench 21163.2.11 27c8e93ef7e7 */
/* bench 21163.2.12 f01e01004627 */
};
