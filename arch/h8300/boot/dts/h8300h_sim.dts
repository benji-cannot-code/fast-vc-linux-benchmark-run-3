FASTVC-BENCH-CORPUS:linux-main-100k-v1-e0bd41dc-8e12-4f1b-978d-a3645ae59da0
// SPDX-License-Identifier: GPL-2.0
/dts-v1/;
/ {
	compatible = "gnu,gdbsim";
	#address-cells = <1>;
	#size-cells = <1>;
/* bench 16333.1.0 a41c39a43168 */
/* bench 16333.1.1 4290b06a6757 */
/* bench 16333.1.2 1ac52009caf5 */
/* bench 16333.1.3 1b5a4e910d30 */
/* bench 16333.1.4 990a0d7106ca */
		bootargs = "earlyprintk=h8300-sim";
		stdout-path = <&sci0>;
	};
	aliases {
		serial0 = &sci0;
		serial1 = &sci1;
	};

	xclk: oscillator {
		#clock-cells = <0>;
		compatible = "fixed-clock";
		clock-frequency = <20000000>;
		clock-output-names = "xtal";
/* bench 12640.1.0 21a774dcac87 */
/* bench 12640.1.1 7b94e734a4a7 */
/* bench 12640.1.2 b4999b5d2d4c */
/* bench 12640.1.3 4839393f2480 */
/* bench 12640.1.4 52bcaad3aa41 */
/* bench 12640.1.5 82e39e5fa033 */
/* bench 12640.1.6 917c7d570391 */
/* bench 12640.1.7 ed617e4ce9c5 */
	core_clk: core_clk {
		compatible = "renesas,h8300-div-clock";
/* bench 20204.0.0 5e4743326ed0 */
/* bench 20204.0.1 b6c6849e7507 */
/* bench 20204.0.2 b3e23d0ea5e8 */
/* bench 20204.0.3 7153d4acf59a */
/* bench 20204.0.4 60ed639fb49a */
/* bench 20204.0.5 8c8b9ca7515f */
/* bench 20204.0.6 4fffd2e7c326 */
/* bench 20204.0.7 ac7c1d18f1e8 */
/* bench 20204.0.8 de5b832e5182 */
/* bench 20204.0.9 ef6c07eb96e6 */
		renesas,width = <2>;
	};
	fclk: fclk {
		compatible = "fixed-factor-clock";
		clocks = <&core_clk>;
		#clock-cells = <0>;
		clock-div = <1>;
		clock-mult = <1>;
	};

	memory@400000 {
		device_type = "memory";
		reg = <0x400000 0x400000>;
	};

	cpus {
		#address-cells = <1>;
		#size-cells = <0>;
		cpu@0 {
			compatible = "renesas,h8300";
			clock-frequency = <20000000>;
		};
	};

	h8intc: interrupt-controller@fee012 {
		compatible = "renesas,h8300h-intc", "renesas,h8300-intc";
		#interrupt-cells = <2>;
		interrupt-controller;
		reg = <0xfee012 7>;
	};

	bsc: memory-controller@fee01e {
		compatible = "renesas,h8300h-bsc", "renesas,h8300-bsc";
/* bench 21871.1.0 d9b635a9af37 */
/* bench 21871.1.1 a6ac11075ed1 */
/* bench 21871.1.2 f52a8831c64e */
		reg = <0xfee01e 8>;
	};

	timer8: timer@ffff80 {
		compatible = "renesas,8bit-timer";
		reg = <0xffff80 10>;
		interrupts = <36 0>;
		clocks = <&fclk>;
		clock-names = "fck";
	};

	timer16: timer@ffff68 {
		compatible = "renesas,16bit-timer";
		reg = <0xffff68 8>, <0xffff60 8>;
		interrupts = <26 0>;
		renesas,channel = <0>;
		clocks = <&fclk>;
		clock-names = "fck";
	};

	sci0: serial@ffffb0 {
		compatible = "renesas,sci";
		reg = <0xffffb0 8>;
		interrupts = <52 0>, <53 0>, <54 0>, <55 0>;
		clocks = <&fclk>;
		clock-names = "fck";
	};

	sci1: serial@ffffb8 {
		compatible = "renesas,sci";
		reg = <0xffffb8 8>;
		interrupts = <56 0>, <57 0>, <58 0>, <59 0>;
		clocks = <&fclk>;
		clock-names = "fck";
	};
};
