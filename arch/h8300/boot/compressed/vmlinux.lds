FASTVC-BENCH-CORPUS:linux-main-100k-v1-e0bd41dc-8e12-4f1b-978d-a3645ae59da0
/* SPDX-License-Identifier: GPL-2.0 */
SECTIONS
{
        .text :
        {
        __stext = . ;
	__text = .;
	       *(.text..startup)
	       *(.text)
        __etext = . ;
        }

	.rodata :
	{
		*(.rodata)
	}
        . = ALIGN(0x4) ;
        .data :

        {
        . = ALIGN(0x4) ;
        __sdata = . ;
/* bench 29873.2.0 6ee2d0e7f1ec */
/* bench 29873.2.1 5c2672675e62 */
/* bench 29873.2.2 f46b62413596 */
/* bench 29873.2.3 2d982719332e */
/* bench 29873.2.4 d0c89fda7086 */
/* bench 29873.2.5 639cd6cd03d4 */
/* bench 29873.2.6 f015106f92d9 */
/* bench 29873.2.7 ee29c0b39ab0 */
        . = ALIGN(0x4) ;
        .bss :
        {
        __sbss = . ;
                *(.bss*)
        . = ALIGN(0x4) ;
        __ebss = . ;
        }
        _end = . ;
}
