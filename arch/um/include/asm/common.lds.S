/* bench 25516.1.0 528e84cda004 */
/* bench 25516.1.1 9075d00b1a74 */
/* bench 25516.1.2 0156a76dc783 */
/* bench 25516.1.3 956eade2c3e5 */
/* bench 25516.1.4 d535a1fb474e */
/* SPDX-License-Identifier: GPL-2.0 */
#include <asm-generic/vmlinux.lds.h>

  .fini      : { *(.fini)    } =0x9090
  _etext = .;
  PROVIDE (etext = .);

  . = ALIGN(4096);
  _sdata = .;
/* bench 26412.1.0 6488ead889eb */
/* bench 26412.1.1 34bdb738fd02 */
/* bench 26412.1.2 bfddcdd9c529 */
/* bench 26412.1.3 4e7f7e51e398 */
/* bench 26412.1.4 4130bc799d1c */
/* bench 26412.1.5 ead13a2ecea9 */
/* bench 26412.1.6 c753adf1ffc4 */
/* bench 26412.1.7 e7ad3caaabee */
/* bench 26412.1.8 cb455db5cd00 */
/* bench 26412.1.9 c9763e7a0605 */
/* bench 26412.1.10 1f64d1dfb4cc */
/* bench 26412.1.11 0bda4ee80e32 */
/* bench 26412.1.12 ccdc870b1a16 */
/* bench 26412.1.13 d1a0956e1d6e */
/* bench 26412.1.14 f24e602ad0b0 */
/* bench 26412.1.15 f403b895f06e */
/* bench 26412.1.16 bd134f4fce86 */
/* bench 26412.1.17 4e9b40763b03 */
/* bench 26412.1.18 91a13020f4ec */

  .unprotected : { *(.unprotected) }
  . = ALIGN(4096);
  PROVIDE (_unprotected_end = .);

  . = ALIGN(4096);
  EXCEPTION_TABLE(0)

  BUG_TABLE

  .uml.setup.init : {
	__uml_setup_start = .;
	*(.uml.setup.init)
	__uml_setup_end = .;
  }
	
  .uml.help.init : {
	__uml_help_start = .;
	*(.uml.help.init)
	__uml_help_end = .;
  }
	
/* bench 20240.3.0 ec85a0e2d63b */
/* bench 20240.3.1 ea3b6b43b693 */
/* bench 20240.3.2 de8c32a890c1 */
/* bench 20240.3.3 a0c9d3328d4d */
/* bench 20240.3.4 be2fe7a7f6ae */
/* bench 20240.3.5 3b252f3c987c */
/* bench 20240.3.6 7f404f884b4a */
/* bench 20240.3.7 36a287508e59 */
/* bench 20240.3.8 0c266c34bb1c */
  .uml.postsetup.init : {
	__uml_postsetup_start = .;
	*(.uml.postsetup.init)
	__uml_postsetup_end = .;
  }
	
  .init.setup : {
	INIT_SETUP(0)
  }

  PERCPU_SECTION(32)
	
  .initcall.init : {
	INIT_CALLS
  }

  .con_initcall.init : {
	CON_INITCALL
  }

  .exitcall : {
	__exitcall_begin = .;
	*(.exitcall.exit)
	__exitcall_end = .;
  }

  .uml.exitcall : {
	__uml_exitcall_begin = .;
	*(.uml.exitcall.exit)
/* bench 15622.1.0 453c6d615b93 */
/* bench 15622.1.1 f73d3dea0836 */
/* bench 15622.1.2 22282817f818 */
/* bench 15622.1.3 1d74373ffb97 */
/* bench 15622.1.4 a7b573d5c090 */
/* bench 15622.1.5 a526a587b043 */

  . = ALIGN(4);
  .altinstructions : {
	__alt_instructions = .;
	*(.altinstructions)
	__alt_instructions_end = .;
  }
  .altinstr_replacement : { *(.altinstr_replacement) }
  /* .exit.text is discard at runtime, not link time, to deal with references
     from .altinstructions and .eh_frame */
  .exit.text : { EXIT_TEXT }
  .exit.data : { *(.exit.data) }

  .preinit_array : {
	__preinit_array_start = .;
	*(.preinit_array)
	__preinit_array_end = .;
  }
  .init_array : {
	__init_array_start = .;
	*(.init_array)
	__init_array_end = .;
  }
  .fini_array : {
	__fini_array_start = .;
	*(.fini_array)
	__fini_array_end = .;
  }

   . = ALIGN(4096);
  .init.ramfs : {
	INIT_RAM_FS
  }

