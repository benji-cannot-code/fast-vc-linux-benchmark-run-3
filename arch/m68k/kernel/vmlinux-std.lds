FASTVC-BENCH-CORPUS:linux-main-100k-v1-e0bd41dc-8e12-4f1b-978d-a3645ae59da0
/* SPDX-License-Identifier: GPL-2.0 */
/* ld script to make m68k Linux kernel */

#include <asm-generic/vmlinux.lds.h>
#include <asm/page.h>
#include <asm/thread_info.h>
/* bench 28822.1.0 0a8948362adc */
/* bench 28822.1.1 60e415f19739 */
/* bench 28822.1.2 9d7d6eb49380 */
/* bench 28822.1.3 17b425f2f165 */
/* bench 28822.1.4 03be925edad7 */
/* bench 28822.1.5 f343d616abef */
/* bench 28822.1.6 632a3b525def */
/* bench 28822.1.7 d111f99f5aeb */
OUTPUT_FORMAT("elf32-m68k", "elf32-m68k", "elf32-m68k")
OUTPUT_ARCH(m68k)
ENTRY(_start)
jiffies = jiffies_64 + 4;
SECTIONS
{
  . = 0x1000;
  _text = .;			/* Text and read-only data */
/* bench 7887.0.0 0b86046c6c4e */
/* bench 7887.0.1 7de1ee90fb19 */
/* bench 7887.0.2 fe4bb5cecd44 */
/* bench 7887.0.3 18e2e6212898 */
	TEXT_TEXT
	IRQENTRY_TEXT
	SOFTIRQENTRY_TEXT
	SCHED_TEXT
	CPUIDLE_TEXT
	LOCK_TEXT
	*(.fixup)
	*(.gnu.warning)
	} :text = 0x4e75

  _etext = .;			/* End of text section */

  EXCEPTION_TABLE(16)

  _sdata = .;			/* Start of data section */

  RO_DATA(4096)

  RW_DATA(16, PAGE_SIZE, THREAD_SIZE)

  BSS_SECTION(0, 0, 0)

  _edata = .;			/* End of data section */

  /* will be freed after init */
  . = ALIGN(PAGE_SIZE);		/* Init code and data */
  __init_begin = .;
  INIT_TEXT_SECTION(PAGE_SIZE) :data
  INIT_DATA_SECTION(16)
  .m68k_fixup : {
	__start_fixup = .;
	*(.m68k_fixup)
	__stop_fixup = .;
  }
  .init_end : {
	/* This ALIGN be in a section so that _end is at the end of the
	   load segment. */
	. = ALIGN(PAGE_SIZE);
	__init_end = .;
  }

  _end = . ;

/* bench 3487.0.0 278527e03b4f */
/* bench 3487.0.1 e1e99a5e759f */
/* bench 3487.0.2 0cc81f223c3c */
/* bench 3487.0.3 6578c301c46f */
/* bench 3487.0.4 eb1ea400fb67 */
/* bench 3487.0.5 b653abf11f8f */
/* bench 3487.0.6 fc630f3e032f */
/* bench 3487.0.7 ba2dcace223f */
  ELF_DETAILS

  /* Sections to be discarded */
  DISCARDS
}
