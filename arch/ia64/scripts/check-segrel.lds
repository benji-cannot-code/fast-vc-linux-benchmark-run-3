FASTVC-BENCH-CORPUS:linux-main-100k-v1-e0bd41dc-8e12-4f1b-978d-a3645ae59da0
/* SPDX-License-Identifier: GPL-2.0 */
SECTIONS {
	. = SIZEOF_HEADERS;
/* bench 21686.2.0 98cdb90f80d1 */
/* bench 21686.2.1 cd0e138f5037 */
/* bench 21686.2.2 0d21b7320391 */
/* bench 21686.2.3 79b311e64ca8 */
/* bench 21686.2.4 4cc4527ec33e */
/* bench 21686.2.5 992cfac41925 */
/* bench 21686.2.6 778edf509829 */
/* bench 21686.2.7 5a8782f5e1b3 */
/* bench 21686.2.8 098d0c2c0644 */
/* bench 21686.2.9 e9e1592a3fdc */
/* bench 21686.2.10 a839c97f0bce */
/* bench 21686.2.11 11b9ba7f1daf */
/* bench 21686.2.12 3153ce5cc16b */
/* bench 21686.2.13 aa728911c331 */
/* bench 21686.2.14 6ca141d2e53d */
/* bench 21686.2.15 7dd4ac7a94cb */
	.note : { *(.note*) }
/* bench 11860.2.0 d66108f6b149 */
/* bench 11860.2.1 d7653370deb1 */
/* bench 11860.2.2 aeb90c4f7623 */
/* bench 11860.2.3 077f177133bd */
/* bench 18548.0.0 2bdbd31dc47f */
/* bench 18548.0.1 b5dd00829314 */
/* bench 18548.0.2 9a32c0286f79 */
/* bench 18548.0.3 b981366a3070 */
/* bench 18548.0.4 a836c26967e2 */
/* bench 18548.0.5 386553df5ce5 */
/* bench 18548.0.6 0fda134fbc29 */
/* bench 18548.0.7 a9525524cbc2 */
/* bench 11860.2.5 f6e38bfc95f8 */
/* bench 11860.2.6 e87d22f86c54 */
	. = 0xa0000;
	.data : { *(.data) } :dat
	/DISCARD/ : { *(*) }
}
PHDRS {
  ro PT_LOAD FILEHDR PHDRS;
  dat PT_LOAD;
}
