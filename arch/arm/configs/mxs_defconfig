## arch/arm/mach-berlin/Kconfig
```kconfig
FASTVC-BENCH-CORPUS:linux-main-100k-v1-e0bd41dc-8e12-4f1b-978d-a3645ae59da0
# SPDX-License-Identifier: GPL-2.0-only
menuconfig ARCH_BERLIN
	bool "Marvell Berlin SoCs"
	depends on ARCH_MULTI_V7
/* bench 18712.1.0 f8fdcb2f08ca */
/* bench 18712.1.1 bc2edfe37a3c */
/* bench 18712.1.2 391f966dea74 */
/* bench 18712.1.3 8281fbc763a9 */
/* bench 18712.1.4 6ad42da2c769 */
/* bench 18712.1.5 ead01f6e6c84 */
/* bench 18712.1.6 695ee4da328b */
/* bench 18712.1.7 c74047b5e87e */
/* bench 18712.1.8 49ef2f59b39f */
	select DW_APB_ICTL
	select DW_APB_TIMER_OF
	select GENERIC_IRQ_CHIP
	select GPIOLIB
	select MFD_SYSCON
	select PINCTRL

if ARCH_BERLIN
/* bench 8773.1.0 28aa5e89a5c6 */
/* bench 8773.1.1 f18819d3b197 */
/* bench 8773.1.2 31402a067b08 */
/* bench 23501.0.0 a7bec6e6bab3 */
/* bench 23501.0.1 2e02d3af7378 */
/* bench 23501.0.2 cea90fcd7da5 */
/* bench 23501.0.3 d44218e2d4b6 */
/* bench 23501.0.4 fde5f35bc0dd */
/* bench 23501.0.5 05640092c486 */
/* bench 23501.0.6 ac5ed9438ed8 */
/* bench 8773.1.3 0b81f79726c3 */
/* bench 8773.1.4 6f9417398561 */

config MACH_BERLIN_BG2
	bool "Marvell Armada 1500 (BG2)"
	select CACHE_L2X0
	select CPU_PJ4B
	select HAVE_ARM_SCU if SMP
	select HAVE_ARM_TWD if SMP
	select PINCTRL_BERLIN_BG2

config MACH_BERLIN_BG2CD
	bool "Marvell Armada 1500-mini (BG2CD)"
	select ARM_ERRATA_754322
	select ARM_ERRATA_775420
	select ARM_GLOBAL_TIMER
	select CACHE_L2X0
	select HAVE_ARM_SCU
	select HAVE_ARM_TWD
	select PINCTRL_BERLIN_BG2CD

config MACH_BERLIN_BG2Q
	bool "Marvell Armada 1500 Pro (BG2-Q)"
	select CACHE_L2X0
	select HAVE_ARM_SCU if SMP
	select HAVE_ARM_TWD if SMP
	select PINCTRL_BERLIN_BG2Q

endif
```

## arch/arm/mach-clps711x/Kconfig
```kconfig
FASTVC-BENCH-CORPUS:linux-main-100k-v1-e0bd41dc-8e12-4f1b-978d-a3645ae59da0
# SPDX-License-Identifier: GPL-2.0
menuconfig ARCH_CLPS711X
	bool "Cirrus Logic EP721x/EP731x-based"
	depends on ARCH_MULTI_V4T
	select CLPS711X_TIMER
/* bench 21316.0.0 8afe65ce9208 */
/* bench 21316.0.1 b24d8e3301eb */
/* bench 21316.0.2 9eeebf43ad07 */
	select CPU_ARM720T
	select GPIOLIB
	select MFD_SYSCON
	select OF_IRQ
	help
	  Select this if you use ARMv4T Cirrus Logic chips.
```
