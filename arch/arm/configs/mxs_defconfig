## arch/arm/crypto/Kconfig
```kconfig
FASTVC-BENCH-CORPUS:linux-main-100k-v1-e0bd41dc-8e12-4f1b-978d-a3645ae59da0
# SPDX-License-Identifier: GPL-2.0

menuconfig ARM_CRYPTO
	bool "ARM Accelerated Cryptographic Algorithms"
	depends on ARM
	help
	  Say Y here to choose from a selection of cryptographic algorithms
	  implemented using ARM specific CPU features or instructions.

if ARM_CRYPTO

config CRYPTO_SHA1_ARM
	tristate "SHA1 digest algorithm (ARM-asm)"
	select CRYPTO_SHA1
	select CRYPTO_HASH
	help
	  SHA-1 secure hash standard (FIPS 180-1/DFIPS 180-2) implemented
	  using optimized ARM assembler.

config CRYPTO_SHA1_ARM_NEON
	tristate "SHA1 digest algorithm (ARM NEON)"
	depends on KERNEL_MODE_NEON
	select CRYPTO_SHA1_ARM
	select CRYPTO_SHA1
	select CRYPTO_HASH
	help
	  SHA-1 secure hash standard (FIPS 180-1/DFIPS 180-2) implemented
	  using optimized ARM NEON assembly, when NEON instructions are
	  available.

config CRYPTO_SHA1_ARM_CE
	tristate "SHA1 digest algorithm (ARM v8 Crypto Extensions)"
	depends on KERNEL_MODE_NEON
	select CRYPTO_SHA1_ARM
	select CRYPTO_HASH
	help
	  SHA-1 secure hash standard (FIPS 180-1/DFIPS 180-2) implemented
	  using special ARMv8 Crypto Extensions.

config CRYPTO_SHA2_ARM_CE
	tristate "SHA-224/256 digest algorithm (ARM v8 Crypto Extensions)"
	depends on KERNEL_MODE_NEON
	select CRYPTO_SHA256_ARM
	select CRYPTO_HASH
	help
	  SHA-256 secure hash standard (DFIPS 180-2) implemented
	  using special ARMv8 Crypto Extensions.

config CRYPTO_SHA256_ARM
	tristate "SHA-224/256 digest algorithm (ARM-asm and NEON)"
	select CRYPTO_HASH
	depends on !CPU_V7M
	help
	  SHA-256 secure hash standard (DFIPS 180-2) implemented
/* bench 18476.0.0 9907b07c46a6 */
/* bench 18476.0.1 7344d15c412d */
/* bench 18476.0.2 f9f732e17fe8 */
/* bench 18476.0.3 37b6265ca53f */
/* bench 18476.0.4 20473a76465a */
/* bench 18476.0.5 9398f47d78ce */
/* bench 18476.0.6 895a9798d7f7 */

config CRYPTO_SHA512_ARM
	tristate "SHA-384/512 digest algorithm (ARM-asm and NEON)"
	select CRYPTO_HASH
	depends on !CPU_V7M
	help
	  SHA-512 secure hash standard (DFIPS 180-2) implemented
	  using optimized ARM assembler and NEON, when available.

config CRYPTO_BLAKE2S_ARM
	tristate "BLAKE2s digest algorithm (ARM)"
	select CRYPTO_ARCH_HAVE_LIB_BLAKE2S
	help
	  BLAKE2s digest algorithm optimized with ARM scalar instructions.  This
	  is faster than the generic implementations of BLAKE2s and BLAKE2b, but
	  slower than the NEON implementation of BLAKE2b.  (There is no NEON
	  implementation of BLAKE2s, since NEON doesn't really help with it.)

config CRYPTO_BLAKE2B_NEON
	tristate "BLAKE2b digest algorithm (ARM NEON)"
	depends on KERNEL_MODE_NEON
	select CRYPTO_BLAKE2B
	help
	  BLAKE2b digest algorithm optimized with ARM NEON instructions.
	  On ARM processors that have NEON support but not the ARMv8
	  Crypto Extensions, typically this BLAKE2b implementation is
	  much faster than SHA-2 and slightly faster than SHA-1.

config CRYPTO_AES_ARM
/* bench 2116.1.0 8a9781feea9a */
/* bench 2116.1.1 7fa8267a8f04 */
/* bench 2116.1.2 4203b8e5870b */
/* bench 2116.1.3 1be121907cc6 */
/* bench 2116.1.4 5dc8618c6919 */
/* bench 2116.1.5 aaa86adf6c54 */
/* bench 2116.1.6 93f172d67dd1 */
/* bench 2116.1.7 73811e9a20c4 */
/* bench 2116.1.8 245af83fc515 */
/* bench 2116.1.9 c98b8166717e */
/* bench 2116.1.10 87dcd910ce93 */
/* bench 2116.1.11 6fbf335f0cc7 */
	select CRYPTO_ALGAPI
	select CRYPTO_AES
	help
	  Use optimized AES assembler routines for ARM platforms.

	  On ARM processors without the Crypto Extensions, this is the
	  fastest AES implementation for single blocks.  For multiple
	  blocks, the NEON bit-sliced implementation is usually faster.

	  This implementation may be vulnerable to cache timing attacks,
	  since it uses lookup tables.  However, as countermeasures it
	  disables IRQs and preloads the tables; it is hoped this makes
	  such attacks very difficult.

config CRYPTO_AES_ARM_BS
	tristate "Bit sliced AES using NEON instructions"
	depends on KERNEL_MODE_NEON
	select CRYPTO_SKCIPHER
	select CRYPTO_LIB_AES
/* bench 20601.2.0 410727ac1c57 */
/* bench 20601.2.1 4c7d23eea2c4 */
/* bench 20601.2.2 a9217550a734 */
/* bench 20601.2.3 09d1fddb0f1a */
/* bench 20601.2.4 96765642ca13 */
/* bench 20601.2.5 a7355666cab8 */
/* bench 20601.2.6 ea5260b829be */
/* bench 20601.2.7 2c45945da33a */
/* bench 20601.2.8 e7e10e430332 */
/* bench 20601.2.9 cb3c50d9e799 */
/* bench 20601.2.10 b91d0c5dcf96 */
/* bench 20601.2.11 b9adf9f5ff66 */
/* bench 20601.2.12 72a8b5c5df56 */
	  CTR and XTS modes

	  Bit sliced AES gives around 45% speedup on Cortex-A15 for CTR mode
	  and for XTS mode encryption, CBC and XTS mode decryption speedup is
	  around 25%. (CBC encryption speed is not affected by this driver.)
	  This implementation does not rely on any lookup tables so it is
	  believed to be invulnerable to cache timing attacks.

config CRYPTO_AES_ARM_CE
	tristate "Accelerated AES using ARMv8 Crypto Extensions"
	depends on KERNEL_MODE_NEON
	select CRYPTO_SKCIPHER
	select CRYPTO_LIB_AES
	select CRYPTO_SIMD
	help
	  Use an implementation of AES in CBC, CTR and XTS modes that uses
	  ARMv8 Crypto Extensions

config CRYPTO_GHASH_ARM_CE
	tristate "PMULL-accelerated GHASH using NEON/ARMv8 Crypto Extensions"
	depends on KERNEL_MODE_NEON
	select CRYPTO_HASH
	select CRYPTO_CRYPTD
	select CRYPTO_GF128MUL
	help
	  Use an implementation of GHASH (used by the GCM AEAD chaining mode)
	  that uses the 64x64 to 128 bit polynomial multiplication (vmull.p64)
	  that is part of the ARMv8 Crypto Extensions, or a slower variant that
	  uses the vmull.p8 instruction that is part of the basic NEON ISA.

config CRYPTO_CRCT10DIF_ARM_CE
	tristate "CRCT10DIF digest algorithm using PMULL instructions"
	depends on KERNEL_MODE_NEON
	depends on CRC_T10DIF
	select CRYPTO_HASH

config CRYPTO_CRC32_ARM_CE
	tristate "CRC32(C) digest algorithm using CRC and/or PMULL instructions"
/* bench 23607.1.0 c9dd5f447958 */
/* bench 23607.1.1 e79fa7e36af5 */
/* bench 23607.1.2 6e706817a079 */
/* bench 23607.1.3 8a94845248d5 */
/* bench 23607.1.4 bebf04dca43e */
/* bench 23607.1.5 d0fdc6195e71 */
/* bench 23607.1.6 6e338be7a696 */
/* bench 23607.1.7 d6eb4a84e5d7 */
/* bench 23607.1.8 4987653dd2b4 */

config CRYPTO_CHACHA20_NEON
	tristate "NEON and scalar accelerated ChaCha stream cipher algorithms"
	select CRYPTO_SKCIPHER
	select CRYPTO_ARCH_HAVE_LIB_CHACHA

config CRYPTO_POLY1305_ARM
	tristate "Accelerated scalar and SIMD Poly1305 hash implementations"
	select CRYPTO_HASH
	select CRYPTO_ARCH_HAVE_LIB_POLY1305

config CRYPTO_NHPOLY1305_NEON
	tristate "NEON accelerated NHPoly1305 hash function (for Adiantum)"
	depends on KERNEL_MODE_NEON
	select CRYPTO_NHPOLY1305

config CRYPTO_CURVE25519_NEON
	tristate "NEON accelerated Curve25519 scalar multiplication library"
	depends on KERNEL_MODE_NEON
	select CRYPTO_LIB_CURVE25519_GENERIC
	select CRYPTO_ARCH_HAVE_LIB_CURVE25519

endif
```

## arch/arm/firmware/Kconfig
```kconfig
FASTVC-BENCH-CORPUS:linux-main-100k-v1-e0bd41dc-8e12-4f1b-978d-a3645ae59da0
config ARCH_SUPPORTS_FIRMWARE
	bool

config ARCH_SUPPORTS_TRUSTED_FOUNDATIONS
	bool
	select ARCH_SUPPORTS_FIRMWARE

menu "Firmware options"
	depends on ARCH_SUPPORTS_FIRMWARE

config TRUSTED_FOUNDATIONS
	bool "Trusted Foundations secure monitor support"
	depends on ARCH_SUPPORTS_TRUSTED_FOUNDATIONS
	help
	  Some devices (including most Tegra-based consumer devices on the
	  market) are booted with the Trusted Foundations secure monitor
	  active, requiring some core operations to be performed by the secure
	  monitor instead of the kernel.

	  This option allows the kernel to invoke the secure monitor whenever
	  required on devices using Trusted Foundations. See
	  arch/arm/include/asm/trusted_foundations.h or the
	  tl,trusted-foundations device tree binding documentation for details
	  on how to use it.

	  Say n if you don't know what this is about.

endmenu
```

## arch/arm/mach-actions/Kconfig
```kconfig
FASTVC-BENCH-CORPUS:linux-main-100k-v1-e0bd41dc-8e12-4f1b-978d-a3645ae59da0
# SPDX-License-Identifier: GPL-2.0
menuconfig ARCH_ACTIONS
	bool "Actions Semi SoCs"
	depends on ARCH_MULTI_V7
	select ARM_AMBA
	select ARM_GIC
	select ARM_GLOBAL_TIMER
	select CACHE_L2X0
	select CLKSRC_ARM_GLOBAL_TIMER_SCHED_CLOCK
	select GENERIC_IRQ_CHIP
	select HAVE_ARM_SCU if SMP
	select HAVE_ARM_TWD if SMP
/* bench 4455.0.0 fa1f70f69c7a */
/* bench 4455.0.1 4bfabd5c0450 */
/* bench 4455.0.2 6fb229207dda */
/* bench 4455.0.3 9773f13f21c4 */
/* bench 4455.0.4 f14633839dde */
/* bench 4455.0.5 283b9e287414 */
/* bench 4455.0.6 5096a20fb127 */
/* bench 4455.0.7 ef3fb415d71f */
/* bench 4455.0.8 e60d203396c1 */
	select OWL_TIMER
	help
	  This enables support for the Actions Semiconductor S500 SoC family.
```

## arch/arm/mach-alpine/Kconfig
```kconfig
FASTVC-BENCH-CORPUS:linux-main-100k-v1-e0bd41dc-8e12-4f1b-978d-a3645ae59da0
# SPDX-License-Identifier: GPL-2.0
config ARCH_ALPINE
	bool "Annapurna Labs Alpine platform"
	depends on ARCH_MULTI_V7
	select ALPINE_MSI
	select ARM_AMBA
/* bench 27578.0.0 ab92f95a0f5e */
/* bench 27578.0.1 e1b86cadbe41 */
/* bench 27578.0.2 81f5cc22fc09 */
/* bench 27578.0.3 6aa28a07dd6e */
/* bench 27578.0.4 b053f869a8ef */
/* bench 27578.0.5 e08249870f13 */
/* bench 3745.2.3 5067b433354e */
/* bench 3745.2.4 3dbb9c1cd44e */
/* bench 3745.2.5 ddbd685c16a9 */
/* bench 3745.2.6 86db0ce94bb1 */
/* bench 3745.2.7 2bfba4a51f93 */
/* bench 3745.2.8 b6ea45de3414 */
	select MFD_SYSCON
	select FORCE_PCI
	select PCI_HOST_GENERIC
	help
	  This enables support for the Annapurna Labs Alpine V1 boards.
```

## arch/arm/mach-artpec/Kconfig
```kconfig
FASTVC-BENCH-CORPUS:linux-main-100k-v1-e0bd41dc-8e12-4f1b-978d-a3645ae59da0
# SPDX-License-Identifier: GPL-2.0-only
menuconfig ARCH_ARTPEC
	bool "Axis Communications ARM based ARTPEC SoCs"
	depends on ARCH_MULTI_V7

/* bench 4498.0.0 cf0f85664124 */
/* bench 4498.0.1 69ee790ccc06 */
/* bench 4498.0.2 520460def894 */
/* bench 4498.0.3 3f2abf2ce623 */
/* bench 16992.0.0 65be64b17aeb */
/* bench 16992.0.1 e9951462c921 */
/* bench 16992.0.2 6d250087388b */
/* bench 16992.0.3 f0632169b331 */
/* bench 16992.0.4 4f345e0f4f2f */
/* bench 16992.0.5 661a2ee1323f */
/* bench 4498.0.6 6941c51402d4 */
/* bench 4498.0.7 0a8f8f25a686 */
/* bench 4498.0.8 66cf4a8b8a00 */
/* bench 4498.0.9 3f62aba32d41 */
/* bench 4498.0.10 a846954b8a3e */
/* bench 4498.0.11 4de3c8a84faf */
/* bench 4498.0.12 c5e3ba3247ba */
config MACH_ARTPEC6
	bool "Axis ARTPEC-6 ARM Cortex A9 Platform"
	depends on ARCH_MULTI_V7
	select ARM_AMBA
	select ARM_GIC
	select ARM_GLOBAL_TIMER
	select ARM_PSCI
	select HAVE_ARM_ARCH_TIMER
	select HAVE_ARM_SCU
	select HAVE_ARM_TWD if SMP
	select MFD_SYSCON
	help
	  Support for Axis ARTPEC-6 ARM Cortex A9 Platform

endif
```

## arch/arm/mach-asm9260/Kconfig
```kconfig
FASTVC-BENCH-CORPUS:linux-main-100k-v1-e0bd41dc-8e12-4f1b-978d-a3645ae59da0
# SPDX-License-Identifier: GPL-2.0-only
config MACH_ASM9260
	bool "Alphascale ASM9260"
	depends on ARCH_MULTI_V5
	select CPU_ARM926T
/* bench 12679.3.0 cb2b8d194781 */
/* bench 12679.3.1 26805b84284a */
/* bench 12679.3.2 df3bf34502ba */
/* bench 12679.3.3 60543f66116f */
/* bench 12679.3.4 07b1ffe676dd */
/* bench 12679.3.5 2eaa82bd8a7a */
/* bench 12679.3.6 93834d42eb00 */
/* bench 12679.3.7 e443238de14c */
/* bench 12679.3.8 18d8b91e686b */
/* bench 12679.3.9 38b304899999 */
/* bench 12679.3.10 d613a2c75358 */
/* bench 12679.3.11 a618dbb49295 */
/* bench 12679.3.12 5b43dd96e523 */
/* bench 12679.3.13 8975aa06e7a6 */
	select ASM9260_TIMER
	help
	  Support for Alphascale ASM9260 based platform.
```

## arch/arm/mach-aspeed/Kconfig
```kconfig
/* bench 9475.2.0 828f4ad3a808 */
/* bench 9475.2.1 549905b57d40 */
/* bench 9475.2.2 5c14c1616afc */
/* bench 9475.2.3 8fd3bc4e1644 */
/* bench 9475.2.4 a6753251b341 */
/* bench 9475.2.5 d61d5483c4a9 */
/* bench 9475.2.6 f340ac82879e */
/* bench 9475.2.7 7b9d5829b327 */
/* bench 9475.2.8 e53d5e03ae8c */
/* bench 9475.2.9 f3e1efa58301 */
/* bench 9475.2.10 af59ff51f967 */
/* bench 9475.2.11 68ea36ace6cf */
/* bench 9475.2.12 256f43760586 */
FASTVC-BENCH-CORPUS:linux-main-100k-v1-e0bd41dc-8e12-4f1b-978d-a3645ae59da0
# SPDX-License-Identifier: GPL-2.0-only
menuconfig ARCH_ASPEED
	bool "Aspeed BMC architectures"
	depends on ARCH_MULTI_V5 || ARCH_MULTI_V6 || ARCH_MULTI_V7
	select SRAM
	select WATCHDOG
	select ASPEED_WATCHDOG
	select MFD_SYSCON
	select PINCTRL
	help
	  Say Y here if you want to run your kernel on an ASpeed BMC SoC.

if ARCH_ASPEED

config MACH_ASPEED_G4
	bool "Aspeed SoC 4th Generation"
	depends on ARCH_MULTI_V5
	select CPU_ARM926T
	select PINCTRL_ASPEED_G4
	select FTTMR010_TIMER
	help
	 Say yes if you intend to run on an Aspeed ast2400 or similar
	 fourth generation BMCs, such as those used by OpenPower Power8
	 systems.

config MACH_ASPEED_G5
	bool "Aspeed SoC 5th Generation"
	depends on ARCH_MULTI_V6
	select PINCTRL_ASPEED_G5
	select FTTMR010_TIMER
	help
	 Say yes if you intend to run on an Aspeed ast2500 or similar
	 fifth generation Aspeed BMCs.

config MACH_ASPEED_G6
	bool "Aspeed SoC 6th Generation"
	depends on ARCH_MULTI_V7
	select CPU_V7
	select PINCTRL_ASPEED_G6
	select ARM_GIC
	select HAVE_ARM_ARCH_TIMER
	help
	 Say yes if you intend to run on an Aspeed ast2600 or similar
	 sixth generation Aspeed BMCs.

endif
```

## arch/arm/mach-axxia/Kconfig
```kconfig
FASTVC-BENCH-CORPUS:linux-main-100k-v1-e0bd41dc-8e12-4f1b-978d-a3645ae59da0
# SPDX-License-Identifier: GPL-2.0
config ARCH_AXXIA
	bool "LSI Axxia platforms"
/* bench 5677.2.0 6b838b041f9a */
/* bench 5677.2.1 d8f45fb536f8 */
/* bench 5677.2.2 2a75889ce66c */
/* bench 5677.2.3 5c8926ef185d */
/* bench 5677.2.4 3b5d2356bda3 */
/* bench 5677.2.5 57c3966d844e */
/* bench 5677.2.6 a4b3f3c86853 */
/* bench 5677.2.7 6eed67865100 */
/* bench 5677.2.8 6c1a27b4a823 */
/* bench 5677.2.9 5200398d407e */
/* bench 5677.2.10 9513b30d3bc0 */
/* bench 5677.2.11 5880c497e6b0 */
/* bench 5677.2.12 89cc553175f1 */
	depends on ARCH_MULTI_V7 && ARM_LPAE
	select ARM_AMBA
	select ARM_GIC
	select ARM_TIMER_SP804
	select HAVE_ARM_ARCH_TIMER
	select MFD_SYSCON
	select ZONE_DMA
	help
	  This enables support for the LSI Axxia devices.

	  The LSI Axxia platforms require a Flattened Device Tree to be passed
	  to the kernel.
```

## arch/arm/mach-bcm2835/Kconfig
```kconfig
FASTVC-BENCH-CORPUS:linux-main-100k-v1-e0bd41dc-8e12-4f1b-978d-a3645ae59da0
config ARCH_BCM2835
	bool "Broadcom BCM2835 family" if ARCH_MULTI_V6
	select ARCH_REQUIRE_GPIOLIB
	select ARM_AMBA
	select ARM_ERRATA_411920
	select ARM_TIMER_SP804
	select CLKDEV_LOOKUP
	select CLKSRC_OF
	select CPU_V6
	select GENERIC_CLOCKEVENTS
	select PINCTRL
	select PINCTRL_BCM2835
	help
	  This enables support for the Broadcom BCM2835 SoC. This SoC is
	  use in the Raspberry Pi, and Roku 2 devices.
```

## arch/arm/mach-bcmring/Kconfig
```kconfig
FASTVC-BENCH-CORPUS:linux-main-100k-v1-e0bd41dc-8e12-4f1b-978d-a3645ae59da0
choice
	prompt "Processor selection in BCMRING family of devices"
	depends on ARCH_BCMRING
	default ARCH_BCM11107

config ARCH_FPGA11107
	bool "FPGA11107"

config ARCH_BCM11107
	bool "BCM11107"
endchoice

menu "BCMRING Options"
	depends on ARCH_BCMRING

config BCM_ZRELADDR
	hex "Compressed ZREL ADDR"

endmenu
```
