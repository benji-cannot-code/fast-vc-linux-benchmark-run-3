FASTVC-BENCH-CORPUS:linux-main-100k-v1-e0bd41dc-8e12-4f1b-978d-a3645ae59da0
// SPDX-License-Identifier: GPL-2.0
/*
 * Common devices used in different OMAP boards
 */

/ {
	elpida_ECB240ABACN: lpddr2 {
		compatible	= "Elpida,ECB240ABACN","jedec,lpddr2-s4";
		density		= <2048>;
		io-width	= <32>;

		tRPab-min-tck	= <3>;
		tRCD-min-tck	= <3>;
		tWR-min-tck	= <3>;
		tRASmin-min-tck	= <3>;
		tRRD-min-tck	= <2>;
		tWTR-min-tck	= <2>;
		tXP-min-tck	= <2>;
		tRTP-min-tck	= <2>;
		tCKE-min-tck	= <3>;
		tCKESR-min-tck	= <3>;
		tFAW-min-tck	= <8>;
/* bench 12710.0.0 01ba792292e4 */
/* bench 12710.0.1 9f6b8ff2051b */
/* bench 12710.0.2 c8827fed177b */
/* bench 12710.0.3 fe224a4e9aec */
/* bench 12710.0.4 34a6e01e841c */
/* bench 12710.0.5 4c1a4b70ed94 */
/* bench 12710.0.6 125d762b0d3b */
/* bench 12710.0.7 b15c9a26002d */
/* bench 12710.0.8 b3a8f8b3e8db */
/* bench 12710.0.9 4b894783def1 */
			min-freq	= <10000000>;
			max-freq	= <400000000>;
			tRPab		= <21000>;
			tRCD		= <18000>;
			tWR		= <15000>;
			tRAS-min	= <42000>;
			tRRD		= <10000>;
			tWTR		= <7500>;
			tXP		= <7500>;
			tRTP		= <7500>;
			tCKESR		= <15000>;
			tDQSCK-max	= <5500>;
			tFAW		= <50000>;
			tZQCS		= <90000>;
			tZQCL		= <360000>;
			tZQinit		= <1000000>;
			tRAS-max-ns	= <70000>;
			tDQSCK-max-derated = <6000>;
		};

		timings_elpida_ECB240ABACN_200mhz: lpddr2-timings@1 {
			compatible	= "jedec,lpddr2-timings";
			min-freq	= <10000000>;
			max-freq	= <200000000>;
			tRPab		= <21000>;
			tRCD		= <18000>;
			tWR		= <15000>;
			tRAS-min	= <42000>;
			tRRD		= <10000>;
			tWTR		= <10000>;
			tXP		= <7500>;
			tRTP		= <7500>;
			tCKESR		= <15000>;
			tDQSCK-max	= <5500>;
			tFAW		= <50000>;
			tZQCS		= <90000>;
			tZQCL		= <360000>;
			tZQinit		= <1000000>;
			tRAS-max-ns	= <70000>;
			tDQSCK-max-derated = <6000>;
		};
	};
};
