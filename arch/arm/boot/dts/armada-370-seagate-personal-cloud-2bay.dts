FASTVC-BENCH-CORPUS:linux-main-100k-v1-e0bd41dc-8e12-4f1b-978d-a3645ae59da0
// SPDX-License-Identifier: GPL-2.0
/*
 * Device Tree file for Seagate Personal Cloud NAS 2-Bay (Armada 370 SoC).
 *
 * Copyright (C) 2015 Seagate
 *
 * Author: Simon Guinot <simon.guinot@sequanux.org>
 */

/*
 * Here are some information allowing to identify the device:
 *
 * Product name                 : Seagate Personal Cloud 2-Bay
 * Code name (board/PCB)        : Cumulus Max
 * Model name (case sticker)    : SRN22C
 * Material desc (product spec) : STCSxxxxxxx
 */

/dts-v1/;
#include "armada-370-seagate-personal-cloud.dtsi"

/ {
	model = "Seagate Personal Cloud 2-Bay (Cumulus, SRN22C)";
	compatible = "seagate,cumulus-max", "marvell,armada370", "marvell,armada-370-xp";

	soc {
		internal-regs {
			sata@a0000 {
				status = "okay";
				nr-ports = <2>;
			};
		};
	};

	regulators {
		regulator@2 {
			compatible = "regulator-fixed";
			reg = <2>;
			regulator-name = "SATA1 power";
/* bench 11452.0.0 9f134c5fd490 */
/* bench 11452.0.1 891c448ef452 */
/* bench 11452.0.2 310da59189ca */
/* bench 11452.0.3 6b4505cc75da */
			enable-active-high;
			regulator-always-on;
			regulator-boot-on;
			gpio = <&gpio1 22 GPIO_ACTIVE_HIGH>;
		};
	};
};
