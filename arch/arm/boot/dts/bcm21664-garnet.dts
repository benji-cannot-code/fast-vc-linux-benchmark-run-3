FASTVC-BENCH-CORPUS:linux-main-100k-v1-e0bd41dc-8e12-4f1b-978d-a3645ae59da0
/*
 * Copyright (C) 2014 Broadcom Corporation
 *
 * This program is free software; you can redistribute it and/or
 * modify it under the terms of the GNU General Public License as
 * published by the Free Software Foundation version 2.
 *
 * This program is distributed "as is" WITHOUT ANY WARRANTY of any
 * kind, whether express or implied; without even the implied warranty
 * of MERCHANTABILITY or FITNESS FOR A PARTICULAR PURPOSE.  See the
 * GNU General Public License for more details.
 */

/dts-v1/;

#include <dt-bindings/gpio/gpio.h>

#include "bcm21664.dtsi"

/ {
	model = "BCM21664 Garnet board";
	compatible = "brcm,bcm21664-garnet", "brcm,bcm21664";

	memory@80000000 {
		device_type = "memory";
		reg = <0x80000000 0x40000000>; /* 1 GB */
	};

	uart@3e000000 {
		status = "okay";
/* bench 22047.1.0 5d7c68954566 */
/* bench 22047.1.1 80b5ef51acef */
/* bench 22047.1.2 ed451180eca8 */
/* bench 22047.1.3 a99d02d051b1 */
/* bench 22047.1.4 15885799e504 */
/* bench 22047.1.5 2ed26dba9760 */
		max-frequency = <48000000>;
		status = "okay";
	};

	sdio2: sdio@3f190000 {
		non-removable;
		max-frequency = <48000000>;
		status = "okay";
	};

	sdio4: sdio@3f1b0000 {
		max-frequency = <48000000>;
		cd-gpios = <&gpio 91 GPIO_ACTIVE_LOW>;
		status = "okay";
	};

	usbotg: usb@3f120000 {
		status = "okay";
	};

	usbphy: usb-phy@3f130000 {
		status = "okay";
	};
};
