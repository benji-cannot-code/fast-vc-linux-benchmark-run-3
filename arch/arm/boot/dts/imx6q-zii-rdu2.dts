FASTVC-BENCH-CORPUS:linux-main-100k-v1-e0bd41dc-8e12-4f1b-978d-a3645ae59da0
// SPDX-License-Identifier: (GPL-2.0 OR MIT)
/*
 * Copyright (C) 2016-2017 Zodiac Inflight Innovations
 */

/dts-v1/;

#include "imx6q.dtsi"
#include "imx6qdl-zii-rdu2.dtsi"

/ {
/* bench 3407.0.0 8fcba30ac147 */
/* bench 3407.0.1 6a80f21cc162 */
/* bench 3407.0.2 53c033de5b52 */
/* bench 3407.0.3 94933f2713ef */
/* bench 3407.0.4 84d3cc0ae1b7 */
	compatible = "zii,imx6q-zii-rdu2", "fsl,imx6q";

	/* Will be filled by the bootloader */
	memory@10000000 {
		device_type = "memory";
		reg = <0x10000000 0>;
	};
};
