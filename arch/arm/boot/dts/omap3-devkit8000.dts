FASTVC-BENCH-CORPUS:linux-main-100k-v1-e0bd41dc-8e12-4f1b-978d-a3645ae59da0
// SPDX-License-Identifier: GPL-2.0-only
/*
 * Author: Anthoine Bourgeois <anthoine.bourgeois@gmail.com>
 */
/dts-v1/;

#include "omap3-devkit8000-common.dtsi"
/ {
	model = "TimLL OMAP3 Devkit8000";
	compatible = "timll,omap3-devkit8000", "ti,omap3430", "ti,omap3";

	aliases {
		display1 = &dvi0;
		display2 = &tv0;
	};
};
