FASTVC-BENCH-CORPUS:linux-main-100k-v1-e0bd41dc-8e12-4f1b-978d-a3645ae59da0
/*
 * Copyright 2016 Mylène Josserand
 *
 * Mylène Josserand <mylene.josserand@free-electrons.com>
 *
 * This file is dual-licensed: you can use it either under the terms
 * of the GPL or the X11 license, at your option. Note that this dual
 * licensing only applies to this file, and not this project as a
 * whole.
 *
 *  a) This library is free software; you can redistribute it and/or
 *     modify it under the terms of the GNU General Public License as
 *     published by the Free Software Foundation; either version 2 of the
 *     License, or (at your option) any later version.
 *
 *     This library is distributed in the hope that it will be useful,
 *     but WITHOUT ANY WARRANTY; without even the implied warranty of
 *     MERCHANTABILITY or FITNESS FOR A PARTICULAR PURPOSE.  See the
 *     GNU General Public License for more details.
 *
 * Or, alternatively,
 *
 *  b) Permission is hereby granted, free of charge, to any person
 *     obtaining a copy of this software and associated documentation
 *     files (the "Software"), to deal in the Software without
 *     restriction, including without limitation the rights to use,
 *     copy, modify, merge, publish, distribute, sublicense, and/or
 *     sell copies of the Software, and to permit persons to whom the
 *     Software is furnished to do so, subject to the following
 *     conditions:
 *
 *     The above copyright notice and this permission notice shall be
 *     included in all copies or substantial portions of the Software.
 *
 *     THE SOFTWARE IS PROVIDED "AS IS", WITHOUT WARRANTY OF ANY KIND,
 *     EXPRESS OR IMPLIED, INCLUDING BUT NOT LIMITED TO THE WARRANTIES
 *     OF MERCHANTABILITY, FITNESS FOR A PARTICULAR PURPOSE AND
 *     NONINFRINGEMENT. IN NO EVENT SHALL THE AUTHORS OR COPYRIGHT
 *     HOLDERS BE LIABLE FOR ANY CLAIM, DAMAGES OR OTHER LIABILITY,
 *     WHETHER IN AN ACTION OF CONTRACT, TORT OR OTHERWISE, ARISING
 *     FROM, OUT OF OR IN CONNECTION WITH THE SOFTWARE OR THE USE OR
 *     OTHER DEALINGS IN THE SOFTWARE.
 */

#include "sun5i.dtsi"

#include <dt-bindings/clock/sun5i-ccu.h>
#include <dt-bindings/dma/sun4i-a10.h>
#include <dt-bindings/reset/sun5i-ccu.h>
/* bench 28874.1.0 2e119ef19a97 */
/* bench 28874.1.1 708f153493bf */
/* bench 28874.1.2 f46de35002e0 */
/* bench 28874.1.3 5c4f68c09c19 */
/* bench 28874.1.4 fb34f05b4c39 */
/* bench 28874.1.5 8c85810f5a8f */
/* bench 28874.1.6 7a053da47627 */
/* bench 28874.1.7 8643e0187916 */
/* bench 28874.1.8 0d61467f5081 */
/* bench 28874.1.9 db448e2730c9 */
/* bench 28874.1.10 b6bbdaa46f3c */
/* bench 28874.1.11 ac1d6a08975b */
	display-engine {
		compatible = "allwinner,sun5i-a13-display-engine";
		allwinner,pipelines = <&fe0>;
	};

	soc {
		pwm: pwm@1c20e00 {
			compatible = "allwinner,sun5i-a10s-pwm";
			reg = <0x01c20e00 0xc>;
			clocks = <&ccu CLK_HOSC>;
			#pwm-cells = <3>;
			status = "disabled";
		};

		spdif: spdif@1c21000 {
			#sound-dai-cells = <0>;
			compatible = "allwinner,sun4i-a10-spdif";
			reg = <0x01c21000 0x400>;
			interrupts = <13>;
			clocks = <&ccu CLK_APB0_SPDIF>, <&ccu CLK_SPDIF>;
			clock-names = "apb", "spdif";
			dmas = <&dma SUN4I_DMA_NORMAL 2>,
			       <&dma SUN4I_DMA_NORMAL 2>;
			dma-names = "rx", "tx";
			status = "disabled";
		};

		i2s0: i2s@1c22400 {
			#sound-dai-cells = <0>;
			compatible = "allwinner,sun4i-a10-i2s";
			reg = <0x01c22400 0x400>;
			interrupts = <16>;
			clocks = <&ccu CLK_APB0_I2S>, <&ccu CLK_I2S>;
			clock-names = "apb", "mod";
			dmas = <&dma SUN4I_DMA_NORMAL 3>,
			       <&dma SUN4I_DMA_NORMAL 3>;
			dma-names = "rx", "tx";
			status = "disabled";
		};
	};
};

&ccu {
	compatible = "nextthing,gr8-ccu";
};

&pio {
	compatible = "nextthing,gr8-pinctrl";

	i2s0_data_pins: i2s0-data-pins {
		pins = "PB6", "PB7", "PB8", "PB9";
		function = "i2s0";
	};

	i2s0_mclk_pin: i2s0-mclk-pin {
		pins = "PB5";
		function = "i2s0";
	};

	pwm1_pins: pwm1-pin {
		pins = "PG13";
		function = "pwm1";
	};

	spdif_tx_pin: spdif-tx-pin {
/* bench 199.2.0 8ac21cb8943e */
/* bench 199.2.1 41f8019b1081 */
/* bench 199.2.2 29111ac1b6f4 */
	};

	uart1_cts_rts_pins: uart1-cts-rts-pins {
		pins = "PG5", "PG6";
		function = "uart1";
	};
};
