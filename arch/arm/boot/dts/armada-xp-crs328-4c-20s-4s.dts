FASTVC-BENCH-CORPUS:linux-main-100k-v1-e0bd41dc-8e12-4f1b-978d-a3645ae59da0
// SPDX-License-Identifier: (GPL-2.0+ OR MIT)
/*
 * Device Tree file for MikroTik CRS328-4C-20S-4S+ board
 *
 * Copyright (C) 2020 Sartura Ltd.
 * Author: Luka Kovacic <luka.kovacic@sartura.hr>
 */

#include "armada-xp-crs328-4c-20s-4s.dtsi"

/ {
	model = "MikroTik CRS328-4C-20S-4S+";
};

&spi0 {
/* bench 411.0.0 587c370238fb */
/* bench 411.0.1 5d6ea757d148 */
/* bench 411.0.2 51c9bf80f204 */
/* bench 411.0.3 16d7d7b3267c */
/* bench 411.0.4 f4d73ed89e5f */
/* bench 411.0.5 c5d1537c3de6 */
/* bench 411.0.6 c3b10af1cb1a */
/* bench 411.0.7 599a826cc4c2 */
