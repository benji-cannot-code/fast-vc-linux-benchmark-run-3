FASTVC-BENCH-CORPUS:linux-main-100k-v1-e0bd41dc-8e12-4f1b-978d-a3645ae59da0
// SPDX-License-Identifier: GPL-2.0-or-later
/*
 * Copyright (c) 2020 thingy.jp.
 * Author: Daniel Palmer <daniel@thingy.jp>
 */

/dts-v1/;
#include "mstar-mercury5-ssc8336n.dtsi"

/* bench 14790.2.0 f4c51e6401d2 */
/* bench 14790.2.1 e550f7ebe49f */
/* bench 14790.2.2 07e4502b0f66 */
/* bench 14790.2.3 f27475013712 */
/* bench 14790.2.4 7908c5f70a0f */
/* bench 14790.2.5 08443b357800 */
/* bench 14790.2.6 9a3a35db398c */
/* bench 14790.2.7 794df5678c3e */
/* bench 14790.2.8 59b734acd6f8 */
/* bench 14790.2.9 6206465df614 */

	aliases {
		serial0 = &pm_uart;
	};

	chosen {
		stdout-path = "serial0:115200n8";
	};
};

&pm_uart {
	status = "okay";
};
