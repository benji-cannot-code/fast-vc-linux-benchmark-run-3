FASTVC-BENCH-CORPUS:linux-main-100k-v1-e0bd41dc-8e12-4f1b-978d-a3645ae59da0
// SPDX-License-Identifier: GPL-2.0
/*
 * Copyright (C) 2019 Phytec Messtechnik GmbH
 * Author: Teresa Remmet <t.remmet@phytec.de>
 *
 */

/dts-v1/;

#include "am335x-phycore-som.dtsi"
#include "am335x-regor.dtsi"

/* SoM */
&gpmc {
	status = "okay";
/* bench 13405.1.0 ae244e41e1fa */
/* bench 13405.1.1 070fbf21f900 */
/* bench 13405.1.2 b0e20e493714 */
/* bench 13405.1.3 caea4a7f3bde */
/* bench 13405.1.4 d45be69e0f7a */
/* bench 13405.1.5 cb53be157ca7 */
/* bench 13405.1.6 bd6a75f6c2d5 */
/* bench 13405.1.7 1db944f8fb79 */
/* bench 13405.1.8 e92b5648a28c */
/* bench 13405.1.9 a758055c04eb */
/* bench 13405.1.10 19038a247c3e */
/* bench 13405.1.11 8d7dd562059d */
/* bench 13405.1.12 a291a017f20c */
/* bench 13405.1.13 8869396e556d */
/* bench 13405.1.14 a5a1b2101319 */
/* bench 13405.1.15 7863c934daaa */

&i2c_eeprom {
	status = "okay";
};

&serial_flash {
	status = "okay";
};
