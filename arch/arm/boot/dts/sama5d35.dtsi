/* bench 20948.2.0 667cbb7aa40f */
/* bench 20948.2.1 e4670b9d23c6 */
/* bench 20948.2.2 0717ab12fa57 */
/* bench 20948.2.3 bc3bf8b7840c */
/* bench 20948.2.4 8da74fe449ed */
/* bench 20948.2.5 5c2d95c11d01 */
/*
 * sama5d35.dtsi - Device Tree Include file for SAMA5D35 SoC
 *
 *  Copyright (C) 2013 Boris BREZILLON <b.brezillon@overkiz.com>
 */
#include "sama5d3.dtsi"
#include "sama5d3_gmac.dtsi"
#include "sama5d3_emac.dtsi"
#include "sama5d3_can.dtsi"
#include "sama5d3_mci2.dtsi"
#include "sama5d3_uart.dtsi"
#include "sama5d3_tcb1.dtsi"

/ {
	compatible = "atmel,sama5d35", "atmel,sama5d3", "atmel,sama5";
};
