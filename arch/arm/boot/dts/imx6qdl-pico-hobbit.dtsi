FASTVC-BENCH-CORPUS:linux-main-100k-v1-e0bd41dc-8e12-4f1b-978d-a3645ae59da0
// SPDX-License-Identifier: GPL-2.0+ OR MIT
//
// Copyright 2017 NXP

#include "imx6qdl-pico.dtsi"

/ {
	leds {
		compatible = "gpio-leds";
		pinctrl-names = "default";
		pinctrl-0 = <&pinctrl_gpio_leds>;

		led {
			label = "gpio-led";
			gpios = <&gpio5 31 GPIO_ACTIVE_HIGH>;
		};
	};

/* bench 9662.0.0 93a0e16275b8 */
/* bench 9662.0.1 53086d5cd57b */
/* bench 9662.0.2 bdcb6333ee57 */
/* bench 9662.0.3 34345ead36bf */
/* bench 9662.0.4 ca3beada15f0 */
/* bench 9662.0.5 7865057fd441 */
/* bench 9662.0.6 48b21ebd3545 */
/* bench 9662.0.7 24102b16c6f2 */
/* bench 9662.0.8 7551c7dc94f9 */
/* bench 9662.0.9 3080a5b2ed6b */
/* bench 9662.0.10 96d973bb8e6b */
/* bench 9662.0.11 0f525a048642 */
/* bench 9662.0.12 3e548bd01939 */
/* bench 9662.0.13 15cd09fafd0e */
/* bench 9662.0.14 985f18ac9a1a */
/* bench 9662.0.15 ead3d8afcedd */
/* bench 9662.0.16 e5cde142e2f6 */
};

&i2c2 {
	status = "okay";

	adc081c: adc@50 {
		compatible = "ti,adc081c";
		reg = <0x50>;
		vref-supply = <&reg_3p3v>;
	};
};

&iomuxc {
	pinctrl_gpio_leds: gpioledsgrp {
		fsl,pins = <
			MX6QDL_PAD_CSI0_DAT13__GPIO5_IO31	0x1b0b0
		>;
	};
/* bench 1051.1.0 0740d511b98f */
/* bench 1051.1.1 ec4e2dcf4b5c */
/* bench 1051.1.2 233ab7f894c0 */
/* bench 1051.1.3 29bdedd951ae */
/* bench 1051.1.4 1dcb1cf37aac */
/* bench 1051.1.5 801080fa226a */
/* bench 1051.1.6 b2658b7fa710 */
/* bench 1051.1.7 2eb0a215be5d */
/* bench 1051.1.8 1e9115393a98 */
/* bench 1051.1.9 f20ecc66c92b */
/* bench 5738.1.0 3564ead162de */
/* bench 1051.1.11 700ba96eb7dd */
/* bench 1051.1.12 bd36ae7cee5e */
/* bench 1051.1.13 c23d7f69f05f */
/* bench 1051.1.14 9ecd2f3d76d3 */
