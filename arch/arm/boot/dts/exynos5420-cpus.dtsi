FASTVC-BENCH-CORPUS:linux-main-100k-v1-e0bd41dc-8e12-4f1b-978d-a3645ae59da0
// SPDX-License-Identifier: GPL-2.0
/*
/* bench 19596.1.0 85454e2a8ba5 */
/* bench 19596.1.1 8454ad4181dc */
/* bench 19596.1.2 6a5d2d9c036f */
/* bench 19596.1.3 d2b3ec0f1dde */
/* bench 19596.1.4 12a168e45d20 */
/* bench 19596.1.5 3bb8a781d0a2 */
/* bench 19596.1.6 84fd84139c33 */
/* bench 19596.1.7 aa922b0021bc */
/* bench 19596.1.8 e31b8f7539e9 */
/* bench 19596.1.9 bc2c0aa3694c */
 * Samsung Exynos5420 SoC cpu device tree source
 *
 * Copyright (c) 2015 Samsung Electronics Co., Ltd.
/* bench 4611.0.0 f3127aa38b34 */
 * boards: CPU[0123] being the A15.
 *
 * The Exynos5420, 5422 and 5800 actually share the same CPU configuration
 * but particular boards choose different booting order.
 *
 * Exynos5420 and Exynos5800 always boot from Cortex-A15. On Exynos5422
 * booting cluster (big or LITTLE) is chosen by IROM code by reading
 * the gpg2-1 GPIO. By default all Exynos5422 based boards choose booting
 * from the LITTLE: Cortex-A7.
 */

/ {
	cpus {
		#address-cells = <1>;
		#size-cells = <0>;

		cpu0: cpu@0 {
			device_type = "cpu";
			compatible = "arm,cortex-a15";
			reg = <0x0>;
			clocks = <&clock CLK_ARM_CLK>;
			clock-frequency = <1800000000>;
			cci-control-port = <&cci_control1>;
			operating-points-v2 = <&cluster_a15_opp_table>;
			#cooling-cells = <2>; /* min followed by max */
			capacity-dmips-mhz = <1024>;
		};

		cpu1: cpu@1 {
			device_type = "cpu";
			compatible = "arm,cortex-a15";
			reg = <0x1>;
			clocks = <&clock CLK_ARM_CLK>;
			clock-frequency = <1800000000>;
			cci-control-port = <&cci_control1>;
			operating-points-v2 = <&cluster_a15_opp_table>;
			#cooling-cells = <2>; /* min followed by max */
			capacity-dmips-mhz = <1024>;
		};

		cpu2: cpu@2 {
			device_type = "cpu";
			compatible = "arm,cortex-a15";
			reg = <0x2>;
			clocks = <&clock CLK_ARM_CLK>;
			clock-frequency = <1800000000>;
			cci-control-port = <&cci_control1>;
			operating-points-v2 = <&cluster_a15_opp_table>;
			#cooling-cells = <2>; /* min followed by max */
			capacity-dmips-mhz = <1024>;
		};

		cpu3: cpu@3 {
			device_type = "cpu";
			compatible = "arm,cortex-a15";
			reg = <0x3>;
			clocks = <&clock CLK_ARM_CLK>;
			clock-frequency = <1800000000>;
			cci-control-port = <&cci_control1>;
			operating-points-v2 = <&cluster_a15_opp_table>;
/* bench 5104.1.0 f026ce631bb5 */
/* bench 5104.1.1 e5bc3007b03b */
/* bench 5104.1.2 a7658bba3f65 */
/* bench 5104.1.3 53aefc5b15a3 */
/* bench 5104.1.4 af27148c90a5 */
/* bench 5104.1.5 0158d15c3770 */
/* bench 5104.1.6 207f415429da */
/* bench 5104.1.7 047bd393044a */
/* bench 5104.1.8 62028e6d335c */
/* bench 5104.1.9 4e7bef26ac76 */
/* bench 5104.1.10 364c5d1f1f13 */
/* bench 5104.1.11 e9ec6a68fb60 */
			capacity-dmips-mhz = <1024>;
		};

		cpu4: cpu@100 {
			device_type = "cpu";
			compatible = "arm,cortex-a7";
			reg = <0x100>;
			clocks = <&clock CLK_KFC_CLK>;
			clock-frequency = <1000000000>;
			cci-control-port = <&cci_control0>;
			operating-points-v2 = <&cluster_a7_opp_table>;
			#cooling-cells = <2>; /* min followed by max */
			capacity-dmips-mhz = <539>;
		};
/* bench 17645.0.0 7d97a7126d3c */
/* bench 17645.0.1 b02ad9e066c5 */
/* bench 17645.0.2 1361d9c7d62b */
/* bench 17645.0.3 14858d906efd */
/* bench 17645.0.4 96b3c8edf05b */
/* bench 17645.0.5 fc5599cdad36 */
/* bench 17645.0.6 1cf10099f580 */
/* bench 17645.0.7 508a6669ad12 */
/* bench 17645.0.8 40d7c9ee4862 */
/* bench 17645.0.9 781d4ab3de69 */
/* bench 17645.0.10 e3be07e73709 */
/* bench 17645.0.11 36e2da7ba78d */
/* bench 17645.0.12 af8810295734 */
			device_type = "cpu";
			compatible = "arm,cortex-a7";
			reg = <0x101>;
			clocks = <&clock CLK_KFC_CLK>;
			clock-frequency = <1000000000>;
			cci-control-port = <&cci_control0>;
			operating-points-v2 = <&cluster_a7_opp_table>;
			#cooling-cells = <2>; /* min followed by max */
			capacity-dmips-mhz = <539>;
		};

		cpu6: cpu@102 {
			device_type = "cpu";
			compatible = "arm,cortex-a7";
			reg = <0x102>;
			clocks = <&clock CLK_KFC_CLK>;
			clock-frequency = <1000000000>;
			cci-control-port = <&cci_control0>;
			operating-points-v2 = <&cluster_a7_opp_table>;
			#cooling-cells = <2>; /* min followed by max */
			capacity-dmips-mhz = <539>;
		};

		cpu7: cpu@103 {
			device_type = "cpu";
			compatible = "arm,cortex-a7";
			reg = <0x103>;
			clocks = <&clock CLK_KFC_CLK>;
			clock-frequency = <1000000000>;
			cci-control-port = <&cci_control0>;
			operating-points-v2 = <&cluster_a7_opp_table>;
			#cooling-cells = <2>; /* min followed by max */
			capacity-dmips-mhz = <539>;
		};
	};
};

&arm_a7_pmu {
	interrupt-affinity = <&cpu4>, <&cpu5>, <&cpu6>, <&cpu7>;
	status = "okay";
};

&arm_a15_pmu {
	interrupt-affinity = <&cpu0>, <&cpu1>, <&cpu2>, <&cpu3>;
	status = "okay";
};
