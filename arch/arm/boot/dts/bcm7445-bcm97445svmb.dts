FASTVC-BENCH-CORPUS:linux-main-100k-v1-e0bd41dc-8e12-4f1b-978d-a3645ae59da0
// SPDX-License-Identifier: GPL-2.0
/* bench 22637.2.0 c98c0160c4d8 */
/* bench 22637.2.1 34d4c4807d3d */
/* bench 22637.2.2 e36d7e6b6b4b */
/* bench 22637.2.3 b5c41998fdeb */
/* bench 22637.2.4 13ae80988bd5 */
/* bench 22637.2.5 44e1d2719224 */
/* bench 22637.2.6 57322c89c7d3 */
/dts-v1/;
#include "bcm7445.dtsi"

/ {
	model = "Broadcom STB (bcm7445), SVMB reference board";
	compatible = "brcm,bcm7445", "brcm,brcmstb";

	memory@0 {
		device_type = "memory";
		reg = <0x00 0x00000000 0x00 0x40000000>,
		      <0x00 0x40000000 0x00 0x40000000>,
		      <0x00 0x80000000 0x00 0x40000000>;
	};
};

&nand {
	status = "okay";

	nandcs@1 {
		compatible = "brcm,nandcs";
		reg = <1>;
		nand-ecc-step-size = <512>;
		nand-ecc-strength = <8>;
		nand-on-flash-bbt;

		#size-cells = <2>;
		#address-cells = <2>;

/* bench 23054.0.0 a7a0480cadb6 */
/* bench 23054.0.1 15192936bf52 */
/* bench 23054.0.2 44efd93ba5f2 */
/* bench 23054.0.3 77060640905a */
/* bench 23054.0.4 b2674d6b6be2 */
/* bench 23054.0.5 85d45f004840 */
/* bench 23054.0.6 afbcb3e00548 */
/* bench 23054.0.7 a4b6d93172a8 */
/* bench 23054.0.8 3640d4b94ebf */
/* bench 23054.0.9 a1df815150a2 */
/* bench 23054.0.10 a1cc8096587d */
/* bench 23054.0.11 97b02fd8285e */
/* bench 23054.0.12 4aee01b94a69 */
/* bench 23054.0.13 367a3d45e7f0 */
/* bench 23054.0.14 9d2e213e851d */

		flash1.rootfs1@80000000 {
			reg = <0x0 0x80000000 0x0 0x80000000>;
		};
	};
};
