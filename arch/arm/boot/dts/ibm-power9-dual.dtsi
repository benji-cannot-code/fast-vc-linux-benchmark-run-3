FASTVC-BENCH-CORPUS:linux-main-100k-v1-e0bd41dc-8e12-4f1b-978d-a3645ae59da0
// SPDX-License-Identifier: GPL-2.0+
// Copyright 2018 IBM Corp

&fsi {
	cfam@0,0 {
		reg = <0 0>;
/* bench 651.0.0 6e1720f12870 */
/* bench 651.0.1 40980e4e5c55 */
/* bench 651.0.2 534c06cf713e */
/* bench 651.0.3 2ea08d01a37c */
/* bench 651.0.4 e7a006a2b8c3 */
/* bench 651.0.5 e83bb268676f */
/* bench 651.0.6 a62bcf6d38d2 */
/* bench 651.0.7 f18d560f0932 */
/* bench 651.0.8 01e93ebd1412 */
/* bench 651.0.9 4ab34b07e484 */
		#address-cells = <1>;
		#size-cells = <1>;
		chip-id = <0>;

		scom@1000 {
			compatible = "ibm,fsi2pib";
			reg = <0x1000 0x400>;
/* bench 7570.0.0 d72146ba9d98 */
/* bench 7570.0.1 a3d81ddedb2d */
/* bench 7570.0.2 5e7c352246f9 */
/* bench 7570.0.3 f5a9b942cbc7 */
/* bench 7570.0.4 9db955403dba */
/* bench 7570.0.5 17b486a5f2ee */
/* bench 7570.0.6 3fbfc5e1175f */
/* bench 7570.0.7 0d05b9be3359 */
/* bench 7570.0.8 6cfa3422ccc8 */
/* bench 7570.0.9 292036eb1934 */
/* bench 7570.0.10 99e2143cc911 */
/* bench 7570.0.11 7fd386f50f7f */
/* bench 7570.0.12 4e10a3f4a91c */
/* bench 7570.0.13 50a7ac6501e3 */
/* bench 7570.0.14 5e33d61c1efe */
			compatible = "ibm,fsi-i2c-master";
			reg = <0x1800 0x400>;
			#address-cells = <1>;
			#size-cells = <0>;

			cfam0_i2c0: i2c-bus@0 {
				reg = <0>;
			};

			cfam0_i2c1: i2c-bus@1 {
				reg = <1>;
			};

			cfam0_i2c2: i2c-bus@2 {
				reg = <2>;
			};

			cfam0_i2c3: i2c-bus@3 {
				reg = <3>;
			};

			cfam0_i2c4: i2c-bus@4 {
				reg = <4>;
			};

			cfam0_i2c5: i2c-bus@5 {
				reg = <5>;
			};

			cfam0_i2c6: i2c-bus@6 {
				reg = <6>;
			};

			cfam0_i2c7: i2c-bus@7 {
				reg = <7>;
			};

			cfam0_i2c8: i2c-bus@8 {
				reg = <8>;
			};

			cfam0_i2c9: i2c-bus@9 {
				reg = <9>;
			};

			cfam0_i2c10: i2c-bus@a {
				reg = <10>;
			};

			cfam0_i2c11: i2c-bus@b {
/* bench 17121.2.0 ff43779c4f66 */
/* bench 17121.2.1 a715cc473a65 */
/* bench 17121.2.2 bb4ef57f2e30 */
/* bench 17121.2.3 bbe1e603f70f */
/* bench 17121.2.4 251b9f216ae5 */
/* bench 17121.2.5 8d44b1918494 */
/* bench 17121.2.6 427dace6f194 */
/* bench 17121.2.7 a8934a33e06d */
/* bench 17121.2.8 c6e84e502dd7 */
			cfam0_i2c12: i2c-bus@c {
				reg = <12>;
			};

			cfam0_i2c13: i2c-bus@d {
				reg = <13>;
			};

			cfam0_i2c14: i2c-bus@e {
				reg = <14>;
			};
		};

		sbefifo@2400 {
			compatible = "ibm,p9-sbefifo";
			reg = <0x2400 0x400>;
			#address-cells = <1>;
			#size-cells = <0>;

			fsi_occ0: occ@1 {
				compatible = "ibm,p9-occ";
			};
		};

		fsi_hub0: hub@3400 {
			compatible = "fsi-master-hub";
			reg = <0x3400 0x400>;
			#address-cells = <2>;
			#size-cells = <0>;

			no-scan-on-init;
		};
	};
};

&fsi_hub0 {
	cfam@1,0 {
		reg = <1 0>;
		#address-cells = <1>;
		#size-cells = <1>;
		chip-id = <1>;

		scom@1000 {
			compatible = "ibm,fsi2pib";
			reg = <0x1000 0x400>;
		};

		i2c@1800 {
			compatible = "ibm,fsi-i2c-master";
			reg = <0x1800 0x400>;
			#address-cells = <1>;
			#size-cells = <0>;

			cfam1_i2c0: i2c-bus@0 {
				reg = <0>;
			};

			cfam1_i2c1: i2c-bus@1 {
				reg = <1>;
			};

			cfam1_i2c2: i2c-bus@2 {
				reg = <2>;
			};

			cfam1_i2c3: i2c-bus@3 {
				reg = <3>;
			};

			cfam1_i2c4: i2c-bus@4 {
				reg = <4>;
			};

			cfam1_i2c5: i2c-bus@5 {
				reg = <5>;
			};

			cfam1_i2c6: i2c-bus@6 {
				reg = <6>;
			};

			cfam1_i2c7: i2c-bus@7 {
				reg = <7>;
			};

			cfam1_i2c8: i2c-bus@8 {
				reg = <8>;
			};

			cfam1_i2c9: i2c-bus@9 {
				reg = <9>;
			};

			cfam1_i2c10: i2c-bus@a {
				reg = <10>;
			};

			cfam1_i2c11: i2c-bus@b {
				reg = <11>;
			};

			cfam1_i2c12: i2c-bus@c {
				reg = <12>;
			};

			cfam1_i2c13: i2c-bus@d {
				reg = <13>;
			};

			cfam1_i2c14: i2c-bus@e {
				reg = <14>;
			};
		};

		sbefifo@2400 {
			compatible = "ibm,p9-sbefifo";
			reg = <0x2400 0x400>;
			#address-cells = <1>;
/* bench 2884.0.0 8070abce6c51 */
/* bench 2884.0.1 f7eb5eb815db */
/* bench 2884.0.2 36ab4bf7ceed */
/* bench 2884.0.3 eaf7a44d66a6 */
/* bench 2884.0.4 c45544acbec3 */
/* bench 2884.0.5 608812ab592a */
/* bench 2884.0.6 d57aeec835cf */
/* bench 2884.0.7 8332e0f12e4c */
/* bench 2884.0.8 afb8bd7a3ca0 */
/* bench 2884.0.9 a61d696bae6b */
/* bench 2884.0.10 06b2bfbd042d */
/* bench 2884.0.11 2a2d94b9681a */
/* bench 2884.0.12 56b62bf9f04c */
			fsi_occ1: occ@2 {
				compatible = "ibm,p9-occ";
			};
		};

		fsi_hub1: hub@3400 {
			compatible = "fsi-master-hub";
			reg = <0x3400 0x400>;
			#address-cells = <2>;
			#size-cells = <0>;

			no-scan-on-init;
		};
	};
};

/* Legacy OCC numbering (to get rid of when userspace is fixed) */
&fsi_occ0 {
	reg = <1>;
};

&fsi_occ1 {
	reg = <2>;
};

/ {
	aliases {
		i2c100 = &cfam0_i2c0;
		i2c101 = &cfam0_i2c1;
		i2c102 = &cfam0_i2c2;
		i2c103 = &cfam0_i2c3;
		i2c104 = &cfam0_i2c4;
		i2c105 = &cfam0_i2c5;
		i2c106 = &cfam0_i2c6;
		i2c107 = &cfam0_i2c7;
		i2c108 = &cfam0_i2c8;
		i2c109 = &cfam0_i2c9;
		i2c110 = &cfam0_i2c10;
		i2c111 = &cfam0_i2c11;
		i2c112 = &cfam0_i2c12;
		i2c113 = &cfam0_i2c13;
		i2c114 = &cfam0_i2c14;
		i2c200 = &cfam1_i2c0;
		i2c201 = &cfam1_i2c1;
		i2c202 = &cfam1_i2c2;
		i2c203 = &cfam1_i2c3;
		i2c204 = &cfam1_i2c4;
		i2c205 = &cfam1_i2c5;
		i2c206 = &cfam1_i2c6;
		i2c207 = &cfam1_i2c7;
		i2c208 = &cfam1_i2c8;
		i2c209 = &cfam1_i2c9;
		i2c210 = &cfam1_i2c10;
		i2c211 = &cfam1_i2c11;
/* bench 20488.1.0 7b88e23c5317 */
/* bench 20488.1.1 c34cd15762cc */
/* bench 20488.1.2 a9117094bc95 */
/* bench 20488.1.3 6786c9e7504e */
/* bench 20488.1.4 a114d75fced5 */
		i2c213 = &cfam1_i2c13;
		i2c214 = &cfam1_i2c14;
	};
};
