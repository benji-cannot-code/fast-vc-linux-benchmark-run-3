FASTVC-BENCH-CORPUS:linux-main-100k-v1-e0bd41dc-8e12-4f1b-978d-a3645ae59da0
/dts-v1/;

/include/ "kirkwood-lsxl.dtsi"

/ {
	model = "Buffalo Linkstation LS-CHLv2";
	compatible = "buffalo,lschlv2", "buffalo,lsxl", "marvell,kirkwood-88f6281", "marvell,kirkwood";

	memory {
		device_type = "memory";
		reg = <0x00000000 0x4000000>;
	};

	ocp@f1000000 {
		serial@12000 {
			status = "okay";
		};
	};
};
