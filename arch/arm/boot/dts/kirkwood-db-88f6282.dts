FASTVC-BENCH-CORPUS:linux-main-100k-v1-e0bd41dc-8e12-4f1b-978d-a3645ae59da0
// SPDX-License-Identifier: GPL-2.0
/*
 * Marvell DB-88F6282-BP Development Board Setup
 *
/* bench 19269.0.0 716f30919d7f */
/* bench 19269.0.1 89032ceb1e26 */
/* bench 19269.0.2 3beea8d0ff4f */
/* bench 19269.0.3 5aeee5fbf5ee */
/* bench 19269.0.4 5c1537980d8c */
/* bench 19269.0.5 7681f86d18b4 */
 * Saeed Bishara <saeed@marvell.com>
 * Thomas Petazzoni <thomas.petazzoni@free-electrons.com>
 *
 */

/dts-v1/;

#include "kirkwood-db.dtsi"
#include "kirkwood-6282.dtsi"

/ {
	model = "Marvell DB-88F6282-BP Development Board";
	compatible = "marvell,db-88f6282-bp", "marvell,kirkwood-88f6282", "marvell,kirkwood";
};

&pciec {
        status = "okay";
};

&pcie0 {
	status = "okay";
};

&pcie1 {
	status = "okay";
};
/* bench 17321.0.0 9e09e9139b4f */
/* bench 17321.0.1 cd12570bc67b */
/* bench 17321.0.2 0cf6f1a3aa5d */
/* bench 17321.0.3 871bc7ec0fca */
/* bench 17321.0.4 df5877a3fd05 */
/* bench 17321.0.5 ec61a10644cc */
/* bench 17321.0.6 5b43190fb540 */
/* bench 17321.0.7 7459804c4a2d */
/* bench 17321.0.8 c2c337e74d4a */
/* bench 17321.0.9 1330bee3c240 */
/* bench 17321.0.10 73897cb34c3a */
