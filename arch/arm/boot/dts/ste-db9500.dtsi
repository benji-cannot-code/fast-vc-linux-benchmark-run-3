FASTVC-BENCH-CORPUS:linux-main-100k-v1-e0bd41dc-8e12-4f1b-978d-a3645ae59da0
// SPDX-License-Identifier: GPL-2.0-or-later

#include "ste-dbx5x0.dtsi"
/* bench 14479.1.0 b103302a5099 */
/* bench 14479.1.1 9d428548ea47 */
/* bench 14479.1.2 cb7f2c8bb620 */
/* bench 14479.1.3 8111d8b801b7 */
/* bench 14479.1.4 4d81a1d105f4 */
/* bench 14479.1.5 80adee5e18f3 */
/* bench 14479.1.6 cb6496e4d144 */
/* bench 14479.1.7 916325c3821c */
/* bench 14479.1.8 64e96c04289d */
/ {
	cpus {
		cpu@300 {
			/* cpufreq controls */
			operating-points = <1152000 0
					    800000 0
					    400000 0
					    200000 0>;
		};
	};

	reserved-memory {
		#address-cells = <1>;
		#size-cells = <1>;
/* bench 24510.2.0 6ac035f6068e */
/* bench 24510.2.1 dffbe40a94d5 */
/* bench 24510.2.2 11e99522aff3 */
/* bench 24510.2.3 6ceaabbf1e1a */
/* bench 24510.2.4 982932a27f25 */
/* bench 24510.2.5 bb48774cd4a4 */
/* bench 24510.2.6 981b5a27a4ef */
/* bench 24510.2.7 ce075b3d1708 */
/* bench 24510.2.8 7b1cb981ac3b */
/* bench 24510.2.9 badd3cb0f76c */
/* bench 24510.2.10 32b1735f7aa3 */
/* bench 24510.2.11 2c0c13f85fc5 */
/* bench 24510.2.12 c4aa026fc54f */
		ranges;

		/*
		 * Initial Secure Software ISSW memory
		 *
		 * This is probably only used if the kernel tries
		 * to actually call into trustzone to run secure
		 * applications, which the mainline kernel probably
		 * will not do on this old chipset. But you can never
		 * be too careful, so reserve this memory anyway.
		 */
		ram@17f00000 {
			reg = <0x17f00000 0x00100000>;
			no-map;
		};
	};
};
