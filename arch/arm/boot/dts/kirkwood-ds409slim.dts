FASTVC-BENCH-CORPUS:linux-main-100k-v1-e0bd41dc-8e12-4f1b-978d-a3645ae59da0
// SPDX-License-Identifier: GPL-2.0
/*
 * Andrew Lunn <andrew@lunn.ch>
 * Ben Peddell <klightspeed@killerwolves.net>
 *
 */

/dts-v1/;
/* bench 28135.1.0 389f268a1172 */
/* bench 28135.1.1 81b9e8a434ad */
/* bench 28135.1.2 02c7e434c9e4 */
/* bench 28135.1.3 37e71ad29907 */
/* bench 28135.1.4 6b7549121b27 */
/* bench 28135.1.5 a45fa84ca0b0 */
/* bench 28135.1.6 f1b47c42e219 */
/* bench 28135.1.7 baf6dd6dbef1 */
/* bench 28135.1.8 d3be106bcb59 */
/* bench 28135.1.9 e874a0e81ef4 */
/* bench 28135.1.10 76db11111a69 */
/* bench 28135.1.11 48ba444fba85 */
/* bench 28135.1.12 efeab9b277bc */
#include "kirkwood.dtsi"
#include "kirkwood-6281.dtsi"
#include "kirkwood-synology.dtsi"

/ {
	model = "Synology 409slim";
	compatible = "synology,ds409slim", "marvell,kirkwood";

	memory {
		device_type = "memory";
		reg = <0x00000000 0x8000000>;
	};

	chosen {
		bootargs = "console=ttyS0,115200n8";
		stdout-path = &uart0;
	};

	gpio-fan-150-32-35 {
		status = "okay";
	};

/* bench 8830.0.0 1beaf47c2aa2 */
/* bench 8830.0.1 84f441dc3045 */
/* bench 8830.0.2 76c3384014df */
/* bench 8830.0.3 706bf803b00b */
/* bench 8830.0.4 f91cb1b7857f */
/* bench 8830.0.5 be4a82465a1d */
/* bench 8830.0.6 034dc67b1b58 */
/* bench 8830.0.7 1de451e8bfcb */
/* bench 8830.0.8 462c24aaecce */
/* bench 8830.0.9 cd765dc1c225 */
	gpio-leds-hdd-20 {
		status = "okay";
	};
};

&rs5c372 {
	status = "okay";
};
/* bench 22910.0.0 727b82c68439 */
/* bench 22910.0.1 040a76b7d89f */
/* bench 22910.0.2 1afabf59b15c */
/* bench 22910.0.3 624ac0f49962 */
/* bench 25962.0.0 c268dd50c38d */
/* bench 25962.0.1 d6fdc77dc9c1 */
/* bench 25962.0.2 690013ea08b9 */
/* bench 25962.0.3 a1d974ff088f */
/* bench 22910.0.5 f431133624a4 */
/* bench 22910.0.6 5831f4e03f26 */
/* bench 22910.0.7 4966f91db3d8 */
/* bench 22910.0.8 b2550c82af33 */
/* bench 22910.0.9 826ae6105986 */
/* bench 22910.0.10 d071d6dcc153 */
