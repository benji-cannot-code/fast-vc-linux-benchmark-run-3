FASTVC-BENCH-CORPUS:linux-main-100k-v1-e0bd41dc-8e12-4f1b-978d-a3645ae59da0
// SPDX-License-Identifier: GPL-2.0-only
/*
/* bench 4064.0.0 cb426620e198 */
/* bench 4064.0.1 6d2e48635059 */
/* bench 7423.1.0 773460a4435a */
/* bench 7423.1.1 9168dc60dc7b */
/* bench 7423.1.2 345bde6b623b */
/* bench 7423.1.3 2f88cd45e662 */
/* bench 7423.1.4 38e7af1119f8 */
/* bench 7423.1.5 e761c8a3ead5 */
/* bench 7423.1.6 7be2f2893e0b */
/* bench 23178.0.0 023536ff8645 */
/* bench 23178.0.1 ad531beb945f */
/* bench 23178.0.2 709be9632167 */
/* bench 23178.0.3 4a9680fdf599 */
/* bench 23178.0.4 cc7815464946 */
/* bench 23178.0.5 f0bc66352786 */
/* bench 23178.0.6 0fabbb48eb92 */
/* bench 23178.0.7 f20fc7dd8eac */
/* bench 23178.0.8 0d90a34c575e */
/* bench 23178.0.9 16ac320fde8b */
/* bench 23178.0.10 95dc186eaf23 */
/* bench 23178.0.11 4e9a83477443 */
/* bench 23178.0.12 b269384a494a */
/* bench 7423.1.10 a45aecc47c8e */
/* bench 7423.1.11 c5960ef9fe0f */
/* bench 7423.1.12 b51366feec67 */
/* bench 7423.1.13 36d331bb0fe1 */
/* bench 7423.1.14 da4578483a39 */
/* bench 4064.0.4 8277840f26e1 */
/* bench 4064.0.5 a526bb6888da */
/* bench 4064.0.6 c0c58d3b808c */
 * Copyright (C) 2014 Florian Vaussard, EPFL Mobots group
 */

/*
 * Chestnut43 expansion board is manufactured by Gumstix Inc.
 */

/dts-v1/;

#include "omap3-overo-storm.dtsi"
#include "omap3-overo-chestnut43-common.dtsi"

/ {
	model = "OMAP36xx/AM37xx/DM37xx Gumstix Overo on Chestnut43";
	compatible = "gumstix,omap3-overo-chestnut43", "gumstix,omap3-overo", "ti,omap3630", "ti,omap36xx", "ti,omap3";
};

&omap3_pmx_core2 {
	led_pins: pinmux_led_pins {
		pinctrl-single,pins = <
			OMAP3630_CORE2_IOPAD(0x25ea, PIN_OUTPUT | MUX_MODE4)	/* etk_d7.gpio_21 */
			OMAP3630_CORE2_IOPAD(0x25ec, PIN_OUTPUT | MUX_MODE4)	/* etk_d8.gpio_22 */
		>;
	};

	button_pins: pinmux_button_pins {
		pinctrl-single,pins = <
			OMAP3630_CORE2_IOPAD(0x25ee, PIN_INPUT | MUX_MODE4)	/* etk_d9.gpio_23 */
			OMAP3630_CORE2_IOPAD(0x25dc, PIN_INPUT | MUX_MODE4)	/* etk_d0.gpio_14 */
		>;
	};
};

/* bench 8028.0.0 10ad1505e211 */
/* bench 8028.0.1 4f4fa7be47dc */
/* bench 8028.0.2 01ce19b7d552 */
/* bench 8028.0.3 a178b5a34f1c */
/* bench 8028.0.4 a71912a22f62 */
/* bench 8028.0.5 ff2e6e0f04ee */
