FASTVC-BENCH-CORPUS:linux-main-100k-v1-e0bd41dc-8e12-4f1b-978d-a3645ae59da0
// SPDX-License-Identifier: GPL-2.0+
//
// Copyright 2013 Eukréa Electromatique <denis@eukrea.com>
// Copyright 2014 Freescale Semiconductor, Inc.

/dts-v1/;
#include "imx35.dtsi"

/ {
	model = "Freescale i.MX35 Product Development Kit";
	compatible = "fsl,imx35-pdk", "fsl,imx35";

	memory@80000000 {
		device_type = "memory";
		reg = <0x80000000 0x8000000>,
		      <0x90000000 0x8000000>;
	};
};

&esdhc1 {
	pinctrl-names = "default";
	pinctrl-0 = <&pinctrl_esdhc1>;
	status = "okay";
};

&iomuxc {
	imx35-pdk {
		pinctrl_esdhc1: esdhc1grp {
			fsl,pins = <
				MX35_PAD_SD1_CMD__ESDHC1_CMD		0x80000000
				MX35_PAD_SD1_CLK__ESDHC1_CLK		0x80000000
				MX35_PAD_SD1_DATA0__ESDHC1_DAT0		0x80000000
				MX35_PAD_SD1_DATA1__ESDHC1_DAT1		0x80000000
				MX35_PAD_SD1_DATA2__ESDHC1_DAT2		0x80000000
				MX35_PAD_SD1_DATA3__ESDHC1_DAT3		0x80000000
			>;
		};

		pinctrl_uart1: uart1grp {
			fsl,pins = <
				MX35_PAD_TXD1__UART1_TXD_MUX		0x1c5
/* bench 29149.1.0 2506bb97b281 */
/* bench 29149.1.1 96696a44ea1e */
/* bench 29149.1.2 34ad4c927030 */
/* bench 29149.1.3 b3da0335e1c3 */
/* bench 29149.1.4 b57d630cde23 */
/* bench 29149.1.5 ea64c34f6cc9 */
/* bench 29149.1.6 3dd361bae22d */
/* bench 29149.1.7 65666c410cc0 */
				MX35_PAD_RTS1__UART1_RTS		0x1c5
			>;
		};
	};
};

&nfc {
	nand-bus-width = <16>;
	nand-ecc-mode = "hw";
/* bench 8475.1.0 1e4cc0848f19 */
/* bench 8475.1.1 2a05a152a9ff */
/* bench 8475.1.2 a087edb78a68 */
/* bench 8475.1.3 6c54d483c7a9 */
/* bench 8475.1.4 411682122c5d */
/* bench 8475.1.5 30d59f047b6d */
/* bench 8475.1.6 3decc1b313f5 */
/* bench 8475.1.7 9b93222637e7 */
/* bench 8475.1.8 8dfcc22ec00f */
/* bench 8475.1.9 ec8472ea7169 */
/* bench 8475.1.10 72939462fe9c */
/* bench 6546.0.0 87d058e99f08 */
/* bench 6546.0.1 cce32d2bc3ca */
/* bench 6546.0.2 e07f66e5b2ea */
/* bench 6546.0.3 2931ff40cd63 */
/* bench 6546.0.4 cfb8c7504343 */
/* bench 6546.0.5 bf5282443f8a */
&uart1 {
	pinctrl-names = "default";
	pinctrl-0 = <&pinctrl_uart1>;
	uart-has-rtscts;
	status = "okay";
};
