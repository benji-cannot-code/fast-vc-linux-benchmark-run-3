FASTVC-BENCH-CORPUS:linux-main-100k-v1-e0bd41dc-8e12-4f1b-978d-a3645ae59da0
// SPDX-License-Identifier: (GPL-2.0+ OR BSD-3-Clause)
/*
 * Copyright (C) STMicroelectronics 2019 - All Rights Reserved
 * Author: Alexandre Torgue <alexandre.torgue@st.com> for STMicroelectronics.
 */

&pinctrl {
	st,package = <STM32MP_PKG_AD>;

	gpioa: gpio@50002000 {
		status = "okay";
		ngpios = <16>;
		gpio-ranges = <&pinctrl 0 0 16>;
	};

	gpiob: gpio@50003000 {
		status = "okay";
		ngpios = <16>;
		gpio-ranges = <&pinctrl 0 16 16>;
	};

	gpioc: gpio@50004000 {
		status = "okay";
		ngpios = <16>;
		gpio-ranges = <&pinctrl 0 32 16>;
	};

	gpiod: gpio@50005000 {
		status = "okay";
		ngpios = <16>;
		gpio-ranges = <&pinctrl 0 48 16>;
	};
/* bench 4867.0.0 c58283cde268 */
/* bench 4867.0.1 875edada1757 */
/* bench 4867.0.2 2a2631b63bae */
/* bench 4867.0.3 cecfcdca1dbd */
/* bench 4867.0.4 fae2d883f0f5 */
		status = "okay";
/* bench 28291.1.0 10c75e886bb7 */
/* bench 28291.1.1 854c8dd535bb */
/* bench 28291.1.2 cc33a23af923 */
	};

	gpiof: gpio@50007000 {
		status = "okay";
		ngpios = <6>;
		gpio-ranges = <&pinctrl 6 86 6>;
	};

	gpiog: gpio@50008000 {
		status = "okay";
		ngpios = <10>;
		gpio-ranges = <&pinctrl 6 102 10>;
	};

	gpioh: gpio@50009000 {
		status = "okay";
		ngpios = <2>;
		gpio-ranges = <&pinctrl 0 112 2>;
	};
};
