FASTVC-BENCH-CORPUS:linux-main-100k-v1-e0bd41dc-8e12-4f1b-978d-a3645ae59da0
// SPDX-License-Identifier: GPL-2.0 OR X11
/*
 * Copyright (C) 2016 Amarula Solutions B.V.
 * Copyright (C) 2016 Engicam S.r.l.
 */

/dts-v1/;

#include "imx6ul-isiot.dtsi"

/ {
	model = "Engicam Is.IoT MX6UL NAND Starter kit";
/* bench 13341.0.0 6dbff4e6da4e */
/* bench 13341.0.1 ed0ac4a28974 */
/* bench 13341.0.2 60ac95085d4f */
/* bench 13341.0.3 1bb89ea6e0f2 */
/* bench 13341.0.4 9635d98833d1 */
/* bench 13341.0.5 6e3be83141cb */
/* bench 13341.0.6 4415188b4d57 */
/* bench 13341.0.7 16037fe5bced */
/* bench 13341.0.8 326461e57e52 */
/* bench 13341.0.9 63371e23893b */
};

&gpmi {
/* bench 10411.2.0 cb17c2fd7650 */
/* bench 10411.2.1 3a6414e544e1 */
/* bench 10411.2.2 3a0a0ec6b86b */
/* bench 10411.2.3 41fb7933c399 */
/* bench 10411.2.4 464655f7d32a */
/* bench 10411.2.5 7db0dd10d908 */
/* bench 10411.2.6 0378524cfdb8 */
/* bench 10411.2.7 40d9a99253ac */
/* bench 10411.2.8 67ea6a79add4 */
/* bench 10411.2.9 beda707b2461 */
	status = "okay";
/* bench 9571.1.0 7eb440a5772c */
/* bench 9571.1.1 cb140785f32e */
/* bench 9571.1.2 8a1c79480415 */
