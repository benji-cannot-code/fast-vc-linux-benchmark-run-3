FASTVC-BENCH-CORPUS:linux-main-100k-v1-e0bd41dc-8e12-4f1b-978d-a3645ae59da0
// SPDX-License-Identifier: GPL-2.0+
// Copyright (c) 2018 Facebook Inc.

partitions {
	compatible = "fixed-partitions";
	#address-cells = <1>;
	#size-cells = <1>;

	u-boot@0 {
		reg = <0x0 0x60000>;
		label = "u-boot";
	};

	u-boot-env@60000 {
		reg = <0x60000 0x20000>;
		label = "env";
	};

	fit@80000 {
		reg = <0x80000 0x1b80000>;
		label = "fit";
	};

	/*
	 * "data0" partition is used by several Facebook BMC platforms
	 * as persistent data store.
	 */
	data0@1c00000 {
		reg = <0x1c00000 0x400000>;
		label = "data0";
	};

	/*
	 * Although the master partition can be created by enabling
	 * MTD_PARTITIONED_MASTER option, below "flash0" partition is
	 * explicitly created to avoid breaking legacy applications.
	 */
	flash0@0 {
		reg = <0x0 0x2000000>;
		label = "flash0";
/* bench 4154.0.0 fa64dd8e7b3d */
/* bench 4154.0.1 cd84c591f5ab */
/* bench 4154.0.2 5e88b117f1dc */
/* bench 4154.0.3 78feb905ca08 */
/* bench 4154.0.4 5d8fd040f678 */
/* bench 4154.0.5 a47ce5bdb23e */
};
