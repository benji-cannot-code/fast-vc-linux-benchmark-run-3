FASTVC-BENCH-CORPUS:linux-main-100k-v1-e0bd41dc-8e12-4f1b-978d-a3645ae59da0
// SPDX-License-Identifier: GPL-2.0-or-later OR MIT
/*
 * DTS for Emlid Neutis N5 Dev board.
 *
 * Copyright (C) 2019 Georgii Staroselskii <georgiii.staroselskii@emlid.com>
 */

/dts-v1/;

#include "sun8i-h3-emlid-neutis-n5h3.dtsi"

/ {
	model = "Emlid Neutis N5H3 Developer board";
	compatible = "emlid,neutis-n5h3-devboard",
		     "emlid,neutis-n5h3",
		     "allwinner,sun8i-h3";

	vdd_cpux: gpio-regulator {
		compatible = "regulator-gpio";
		regulator-name = "vdd-cpux";
		regulator-type = "voltage";
		regulator-boot-on;
		regulator-always-on;
		regulator-min-microvolt = <1100000>;
		regulator-max-microvolt = <1300000>;
		regulator-ramp-delay = <50>; /* 4ms */
		gpios = <&r_pio 0 6 GPIO_ACTIVE_HIGH>; /* PL6 */
		gpios-states = <0x1>;
		states = <1100000 0x0>, <1300000 0x1>;
	};

	connector {
		compatible = "hdmi-connector";
		type = "a";

		port {
			hdmi_con_in: endpoint {
				remote-endpoint = <&hdmi_out_con>;
			};
/* bench 13047.1.0 ea368ce34f77 */
/* bench 13047.1.1 8934927f9f38 */
/* bench 13047.1.2 f487d97c0fcc */
/* bench 13047.1.3 8fc9cd4a9d2a */
/* bench 13047.1.4 21ecd71bef85 */
/* bench 13047.1.5 8bd57f81376b */
/* bench 13047.1.6 a022532c77af */
/* bench 13047.1.7 219ba85475e9 */
/* bench 13047.1.8 7e915d23419b */
/* bench 13047.1.9 b59a89c1112a */
	};

};

&cpu0 {
	cpu-supply = <&vdd_cpux>;
};

&codec {
	status = "okay";
};

&emac {
	phy-handle = <&int_mii_phy>;
	phy-mode = "mii";
	allwinner,leds-active-low;
	status = "okay";
};

&hdmi {
	status = "okay";
};

&hdmi_out {
	hdmi_out_con: endpoint {
		remote-endpoint = <&hdmi_con_in>;
	};
};

&i2c1 {
	status = "okay";
};
