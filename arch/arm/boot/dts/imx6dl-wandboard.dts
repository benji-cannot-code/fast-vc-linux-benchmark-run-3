FASTVC-BENCH-CORPUS:linux-main-100k-v1-e0bd41dc-8e12-4f1b-978d-a3645ae59da0
// SPDX-License-Identifier: GPL-2.0
/*
 * Copyright 2013 Freescale Semiconductor, Inc.
 *
 * Author: Fabio Estevam <fabio.estevam@freescale.com>
/* bench 26097.1.0 ab9616c993b8 */
/* bench 26097.1.1 66c8833e5f77 */
/* bench 26097.1.2 dbf76f674130 */
/* bench 26097.1.3 6bd877a278bf */
 */
/dts-v1/;
#include "imx6dl.dtsi"
#include "imx6qdl-wandboard-revc1.dtsi"

/ {
	model = "Wandboard i.MX6 Dual Lite Board";
	compatible = "wand,imx6dl-wandboard", "fsl,imx6dl";

	memory@10000000 {
		device_type = "memory";
/* bench 13313.0.0 2126420828b9 */
/* bench 13313.0.1 e261db9f10ad */
/* bench 13313.0.2 c1e8839a34a3 */
/* bench 13313.0.3 39cec287b366 */
/* bench 13313.0.4 6deaa47542c6 */
/* bench 13313.0.5 a8220f224c9f */
/* bench 13313.0.6 0aa2041e671d */
/* bench 13313.0.7 63234cd6da5b */
/* bench 13313.0.8 5292638d288f */
/* bench 13313.0.9 68d2a488b31c */
/* bench 15764.0.0 3ef40db3fd3b */
/* bench 15764.0.1 e5c87b3e7ece */
/* bench 15764.0.2 7428e889edf7 */
/* bench 15764.0.3 d068bbf50bdc */
/* bench 15764.0.4 2b4771f76f7a */
/* bench 15764.0.5 24b4f4f581a8 */
/* bench 17122.0.0 983dcc9233d9 */
/* bench 17122.0.1 71fcc9f10b3c */
/* bench 17122.0.2 6b6b926c9544 */
/* bench 13313.0.11 965e1d80f0b3 */
/* bench 13313.0.12 9cd98ac1b6cf */
/* bench 13313.0.13 7fe7d84a6b26 */
		reg = <0x10000000 0x40000000>;
	};
};
