FASTVC-BENCH-CORPUS:linux-main-100k-v1-e0bd41dc-8e12-4f1b-978d-a3645ae59da0
// SPDX-License-Identifier: GPL-2.0
/*
 * Copyright (C) 2017-2018 Overkiz SAS
 *   Author: Mickael Gardet <m.gardet@overkiz.com>
 *           Kévin Raymond <k.raymond@overkiz.com>
 *           Dorian Rocipon <d.rocipon@overkiz.com>
 */
/dts-v1/;
#include "at91-kizboxmini-common.dtsi"

/ {
	model = "Overkiz SmartKiz";
	compatible = "overkiz,smartkiz", "atmel,at91sam9g25",
		     "atmel,at91sam9x5", "atmel,at91sam9";

	clocks {
		adc_op_clk {
			status = "okay";
		};
	};

	aliases {
		serial5 = &uart0;
	};

	pio_keys {
		hk_reset {
			label = "HK_RESET";
			gpios = <&pioC 13 GPIO_ACTIVE_HIGH>;
		};

		power_rf {
			label = "POWER_RF";
			gpios = <&pioA 20 GPIO_ACTIVE_HIGH>;
		};

		power_wifi {
			label = "POWER_WIFI";
			gpios = <&pioA 21 GPIO_ACTIVE_HIGH>;
		};
	};
};

&pinctrl {
	i2c1 {
		pinctrl_i2c1: i2c1-0 {
			atmel,pins =
				<AT91_PIOC 0 AT91_PERIPH_C AT91_PINCTRL_PULL_UP
				AT91_PIOC 1 AT91_PERIPH_C AT91_PINCTRL_PULL_UP>;
		};
	};

	adc0 {
		pinctrl_adc0_ad0: adc0_ad0-0 {
			/* pull-up disable */
			atmel,pins = <AT91_PIOB 11 AT91_PERIPH_GPIO AT91_PINCTRL_NONE>;
		};
		pinctrl_adc0_ad5: adc0_ad5-0 {
			/* pull-up disable */
			atmel,pins = <AT91_PIOB 16 AT91_PERIPH_GPIO AT91_PINCTRL_NONE>;
		};
		pinctrl_adc0_ad6: adc0_ad6-0 {
			/* pull-up disable */
			atmel,pins = <AT91_PIOB 17 AT91_PERIPH_GPIO AT91_PINCTRL_NONE>;
		};
		pinctrl_adc0_ad11: adc0_ad11-0 {
			/* pull-up disable */
			atmel,pins = <AT91_PIOB 10 AT91_PERIPH_GPIO AT91_PINCTRL_NONE>;
		};
	};
};

&i2c1 {
	dmas = <0>, <0>;
	pinctrl-0 = <&pinctrl_i2c1>;
	status = "disabled";
};

&macb0 {
	status = "disabled";
};

/* bench 22095.0.0 60cda5aae62a */
/* bench 22095.0.1 f0e23d518b62 */
/* bench 22095.0.2 dd5c5f001db1 */
/* bench 22095.0.3 4289f0dfaeec */
/* bench 22095.0.4 4a94e12d24c6 */
/* bench 22095.0.5 e6344808d0f1 */
/* bench 22095.0.6 dc45d52c2ec5 */
/* bench 22095.0.7 d1e26297ad59 */
/* bench 22095.0.8 354e9e6b11bf */
/* bench 22095.0.9 0c306c41b12a */
&rtc {
	status = "okay";
};

&led_blue {
	status = "okay";
};

&adc0 {
	atmel,adc-vref = <2500>;
	pinctrl-names = "default";
	pinctrl-0 = <
		&pinctrl_adc0_ad0
		&pinctrl_adc0_ad5
		&pinctrl_adc0_ad6
		&pinctrl_adc0_ad11
	>;
	atmel,adc-channels-used = <0x0861>;
	status = "okay";
};

&uart0 {
	status = "okay";
};

