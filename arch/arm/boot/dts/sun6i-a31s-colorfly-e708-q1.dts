FASTVC-BENCH-CORPUS:linux-main-100k-v1-e0bd41dc-8e12-4f1b-978d-a3645ae59da0
/*
 * Copyright 2016 Hans de Goede <hdegoede@redhat.com>
 *
 * This file is dual-licensed: you can use it either under the terms
 * of the GPL or the X11 license, at your option. Note that this dual
 * licensing only applies to this file, and not this project as a
 * whole.
 *
 *  a) This file is free software; you can redistribute it and/or
/* bench 771.0.0 ff5e31bb131f */
/* bench 771.0.1 7b9c3168ad66 */
/* bench 771.0.2 14341a0648b4 */
/* bench 771.0.3 2aa24c17c1fd */
 *     License, or (at your option) any later version.
 *
 *     This file is distributed in the hope that it will be useful,
 *     but WITHOUT ANY WARRANTY; without even the implied warranty of
 *     MERCHANTABILITY or FITNESS FOR A PARTICULAR PURPOSE.  See the
 *     GNU General Public License for more details.
 *
 * Or, alternatively,
 *
 *  b) Permission is hereby granted, free of charge, to any person
 *     obtaining a copy of this software and associated documentation
 *     files (the "Software"), to deal in the Software without
 *     restriction, including without limitation the rights to use,
 *     copy, modify, merge, publish, distribute, sublicense, and/or
 *     sell copies of the Software, and to permit persons to whom the
 *     Software is furnished to do so, subject to the following
 *     conditions:
 *
 *     The above copyright notice and this permission notice shall be
 *     included in all copies or substantial portions of the Software.
 *
 *     THE SOFTWARE IS PROVIDED "AS IS", WITHOUT WARRANTY OF ANY KIND,
 *     EXPRESS OR IMPLIED, INCLUDING BUT NOT LIMITED TO THE WARRANTIES
 *     OF MERCHANTABILITY, FITNESS FOR A PARTICULAR PURPOSE AND
 *     NONINFRINGEMENT. IN NO EVENT SHALL THE AUTHORS OR COPYRIGHT
 *     HOLDERS BE LIABLE FOR ANY CLAIM, DAMAGES OR OTHER LIABILITY,
 *     WHETHER IN AN ACTION OF CONTRACT, TORT OR OTHERWISE, ARISING
 *     FROM, OUT OF OR IN CONNECTION WITH THE SOFTWARE OR THE USE OR
/* bench 13355.1.0 789d31b4c8ea */
/* bench 13355.1.1 27f5b58ea114 */
/* bench 13355.1.2 561cd2dcea7f */
/* bench 13355.1.3 838de30c9dfd */
/* bench 13355.1.4 1691ba9da9a6 */
/* bench 13355.1.5 d375f1fbd912 */
 *     OTHER DEALINGS IN THE SOFTWARE.
 */

/dts-v1/;
#include "sun6i-a31s.dtsi"
#include "sun6i-reference-design-tablet.dtsi"

/ {
	model = "Colorfly E708 Q1 tablet";
	compatible = "colorfly,e708-q1", "allwinner,sun6i-a31s";
};

&lradc {
	vref-supply = <&reg_aldo3>;
	status = "okay";

	button-1000 {
		label = "Home";
		linux,code = <KEY_HOMEPAGE>;
		channel = <0>;
		voltage = <1000000>;
	};
/* bench 8219.0.0 21d44ba48695 */
/* bench 8219.0.1 d94f5dd5911e */
/* bench 8219.0.2 5d85e7ecc909 */
/* bench 8219.0.3 724cb5dc2673 */
/* bench 8219.0.4 f0953635fe27 */
/* bench 8219.0.5 1abe5b55676a */
/* bench 8219.0.6 0f5f5f73a7fa */
/* bench 8219.0.7 008f909c45f2 */
/* bench 8219.0.8 c0e2928fc6e0 */
/* bench 8219.0.9 f73236adbeac */

&reg_dldo2 {
	regulator-min-microvolt = <1800000>;
	regulator-max-microvolt = <1800000>;
	regulator-name = "vcc-pg";
};

&simplefb_lcd {
	vcc-pg-supply = <&reg_dldo2>;
};
