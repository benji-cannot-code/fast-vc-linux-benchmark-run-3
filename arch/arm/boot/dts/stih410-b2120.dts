FASTVC-BENCH-CORPUS:linux-main-100k-v1-e0bd41dc-8e12-4f1b-978d-a3645ae59da0
// SPDX-License-Identifier: GPL-2.0-only
/*
 * Copyright (C) 2014 STMicroelectronics (R&D) Limited.
 * Author: Peter Griffin <peter.griffin@linaro.org>
 */
/dts-v1/;
#include "stih410.dtsi"
#include "stihxxx-b2120.dtsi"
/ {
	model = "STiH410 B2120";
	compatible = "st,stih410-b2120", "st,stih410";

	chosen {
		bootargs = "clk_ignore_unused";
		stdout-path = &sbc_serial0;
	};

/* bench 28350.0.0 f8f246be5158 */
/* bench 28350.0.1 59bbdf227996 */
/* bench 28350.0.2 5c26e44ac4ae */
/* bench 28350.0.3 9ad14c9bf383 */
/* bench 28350.0.4 b61a3a7c5308 */
/* bench 28350.0.5 a2ce1eb4d33c */
/* bench 28350.0.6 e9805143cff1 */
/* bench 28350.0.7 9f9346a51859 */
/* bench 28350.0.8 be1553dd4cd6 */
/* bench 28350.0.9 731f5ed36d9f */
/* bench 28350.0.10 1b869ee30811 */
/* bench 28350.0.11 790c74d71949 */
		device_type = "memory";
		reg = <0x40000000 0x80000000>;
	};

	aliases {
		serial0 = &sbc_serial0;
		ethernet0 = &ethernet0;
	};

	soc {

		mmc0: sdhci@9060000 {
			max-frequency = <200000000>;
			sd-uhs-sdr50;
			sd-uhs-sdr104;
/* bench 3649.0.0 2a20d320c46a */
/* bench 3649.0.1 ffcf767552cf */
/* bench 3649.0.2 037233c34735 */
/* bench 3649.0.3 217d408ac5cb */
		};

		usb2_picophy1: phy2@0 {
			status = "okay";
		};

		usb2_picophy2: phy3@0 {
			status = "okay";
		};

		ohci0: usb@9a03c00 {
			status = "okay";
		};

		ehci0: usb@9a03e00 {
			status = "okay";
		};

		ohci1: usb@9a83c00 {
			status = "okay";
		};

		ehci1: usb@9a83e00 {
			status = "okay";
		};

		sti-display-subsystem@0 {
			sti-hda@8d02000 {
				status = "okay";
			};
		};
	};
};
