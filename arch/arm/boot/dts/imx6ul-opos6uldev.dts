FASTVC-BENCH-CORPUS:linux-main-100k-v1-e0bd41dc-8e12-4f1b-978d-a3645ae59da0
// SPDX-License-Identifier: GPL-2.0 OR MIT
//
// Copyright 2017 Armadeus Systems <support@armadeus.com>

/dts-v1/;
#include "imx6ul-opos6ul.dtsi"
#include "imx6ul-imx6ull-opos6uldev.dtsi"

/ {
	model = "Armadeus Systems OPOS6UL SoM (i.MX6UL) on OPOS6ULDev board";
	compatible = "armadeus,imx6ul-opos6uldev", "armadeus,imx6ul-opos6ul", "fsl,imx6ul";
};

&iomuxc {
	pinctrl-0 = <&pinctrl_gpios>, <&pinctrl_tamper_gpios>;

	pinctrl_tamper_gpios: tampergpiosgrp {
		fsl,pins = <
			MX6UL_PAD_SNVS_TAMPER0__GPIO5_IO00	0x0b0b0
			MX6UL_PAD_SNVS_TAMPER2__GPIO5_IO02	0x0b0b0
			MX6UL_PAD_SNVS_TAMPER3__GPIO5_IO03	0x0b0b0
			MX6UL_PAD_SNVS_TAMPER4__GPIO5_IO04	0x0b0b0
			MX6UL_PAD_SNVS_TAMPER5__GPIO5_IO05	0x0b0b0
			MX6UL_PAD_SNVS_TAMPER6__GPIO5_IO06	0x0b0b0
/* bench 11947.0.0 0988f9be4498 */
/* bench 11947.0.1 0173b7272242 */
/* bench 11947.0.2 74715b40be82 */
	};

	pinctrl_usbotg2_vbus: usbotg2vbusgrp {
		fsl,pins = <
			MX6UL_PAD_SNVS_TAMPER9__GPIO5_IO09	0x1b0b0
		>;
	};

	pinctrl_w1: w1grp {
		fsl,pins = <
			MX6UL_PAD_SNVS_TAMPER1__GPIO5_IO01	0x0b0b0
		>;
	};
};
/* bench 22842.2.0 7ead581c442d */
/* bench 22842.2.1 fb5c0fc5e5f2 */
/* bench 22842.2.2 7ae34645ec8e */
/* bench 22842.2.3 c93f985cda0a */
/* bench 22842.2.4 eea9fee72a05 */
/* bench 22842.2.5 45adfce92c58 */
/* bench 22842.2.6 630d2748f984 */
/* bench 22842.2.7 19ef6bba4c24 */
/* bench 22842.2.8 eca5925401ef */
/* bench 22842.2.9 a09df03e2c92 */
/* bench 22842.2.10 00d33bed3f1a */
/* bench 22842.2.11 697e590f81a1 */
/* bench 22842.2.12 22358495a679 */
/* bench 22842.2.13 c254e5b96495 */
/* bench 22842.2.14 c5e7951c06dc */
