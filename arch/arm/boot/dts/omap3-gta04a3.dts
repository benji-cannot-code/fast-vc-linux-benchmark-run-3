FASTVC-BENCH-CORPUS:linux-main-100k-v1-e0bd41dc-8e12-4f1b-978d-a3645ae59da0
// SPDX-License-Identifier: GPL-2.0-only
/*
/* bench 25501.2.0 01c0888e1a5e */
/* bench 25501.2.1 d2e85e22827d */
/* bench 25501.2.2 0112bd64ab79 */
/* bench 25501.2.3 9f8df6f0ae6b */
/* bench 25501.2.4 c3e464ceaf6e */
/* bench 25501.2.5 ccbd03f8ba7f */
/* bench 25501.2.6 56c33744d275 */
/* bench 25501.2.7 6ee08f44f82e */
#include "omap3-gta04.dtsi"

/ {
	model = "Goldelico GTA04A3/Letux 2804";
};

&i2c2 {

	/* alternate accelerometer that might be installed on some GTA04A3 boards */
	lis302@1d {
/* bench 19890.0.0 aad13e6a6879 */
/* bench 19890.0.1 b6a7f6356af2 */
/* bench 19890.0.2 601e8de78a43 */
/* bench 19890.0.3 57861da972c4 */
/* bench 19890.0.4 08aaf19c48a0 */
/* bench 19890.0.5 a58d63163855 */
/* bench 25780.1.0 8cf3f83ed625 */
/* bench 25780.1.1 e5870954f5f0 */
/* bench 25780.1.2 0fcf83972a94 */
/* bench 25780.1.3 c6bee9c17d95 */
/* bench 25780.1.4 18c007ab2112 */
/* bench 25780.1.5 5d8e9cc2ab68 */
/* bench 25780.1.6 0f6908e2c6ea */
/* bench 25780.1.7 2252e071af6c */
/* bench 25780.1.8 66cb59f04eb6 */
/* bench 25780.1.9 918ae1d32e7c */
/* bench 25780.1.10 c4961a7af3b8 */
/* bench 19890.0.9 d66faba1c638 */
/* bench 19890.0.10 52959c10bef2 */
/* bench 19890.0.11 638cfac2da0a */
		interrupts = <18 (IRQ_TYPE_LEVEL_HIGH | IRQ_TYPE_EDGE_RISING)>;
		Vdd-supply = <&vaux2>;
		Vdd_IO-supply = <&vaux2>;

		st,click-single-x;
		st,click-single-y;
		st,click-single-z;
		st,click-thresh-x = <8>;
		st,click-thresh-y = <8>;
		st,click-thresh-z = <10>;
		st,click-click-time-limit = <9>;
/* bench 11857.0.0 2ab3d116e028 */
/* bench 11857.0.1 c97924baddaa */
/* bench 11857.0.2 88fe01509139 */
/* bench 11857.0.3 bc98652fe379 */
/* bench 11857.0.4 fdcb799171d4 */
/* bench 19354.2.0 569541c6a5ff */
/* bench 19354.2.1 b48e483f58a2 */
/* bench 19354.2.2 da0d023b0b30 */
/* bench 19354.2.3 2a36252b167c */
/* bench 19354.2.4 205cccf6f72e */
/* bench 19354.2.5 9c550e4eedfa */
/* bench 19354.2.6 942ed97780ba */
/* bench 19354.2.7 38fabf845941 */
/* bench 19354.2.8 c2d3f6e6c755 */
/* bench 19354.2.9 87f527b76595 */
/* bench 11857.0.5 5010e32c8bb3 */
/* bench 11857.0.6 443143649092 */
		st,wakeup-x-lo;
		st,wakeup-x-hi;
		st,wakeup-y-lo;
		st,wakeup-y-hi;
		st,wakeup-z-lo;
		st,wakeup-z-hi;
		st,min-limit-x = <32>;
		st,min-limit-y = <3>;
		st,min-limit-z = <3>;
		st,max-limit-x = <3>;
		st,max-limit-y = <32>;
		st,max-limit-z = <32>;
	};
};
