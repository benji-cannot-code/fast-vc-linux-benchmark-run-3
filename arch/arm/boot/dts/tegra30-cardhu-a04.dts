FASTVC-BENCH-CORPUS:linux-main-100k-v1-e0bd41dc-8e12-4f1b-978d-a3645ae59da0
/dts-v1/;

/include/ "tegra30-cardhu.dtsi"

/* This dts file support the cardhu A04 and later versions of board */

/ {
	model = "NVIDIA Tegra30 Cardhu A04 (A05, A06, A07) evaluation board";
	compatible = "nvidia,cardhu-a04", "nvidia,cardhu", "nvidia,tegra30";
};
