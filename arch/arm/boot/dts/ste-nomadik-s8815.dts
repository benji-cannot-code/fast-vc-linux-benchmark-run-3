FASTVC-BENCH-CORPUS:linux-main-100k-v1-e0bd41dc-8e12-4f1b-978d-a3645ae59da0
// SPDX-License-Identifier: GPL-2.0
/*
 * Device Tree for the ST-Ericsson Nomadik S8815 board
 * Produced by Calao Systems
 */

/dts-v1/;
#include <dt-bindings/interrupt-controller/irq.h>
#include "ste-nomadik-stn8815.dtsi"

/ {
	model = "Calao Systems USB-S8815";
	compatible = "calaosystems,usb-s8815";

	chosen {
		bootargs = "root=/dev/ram0 console=ttyAMA1,115200n8 earlyprintk";
	};

	aliases {
		serial0 = &uart0;
		serial1 = &uart1;
	};

	gpio3: gpio@101e7000 {
		/* This hog will bias the MMC/SD card detect line */
		mmcsd-gpio {
			gpio-hog;
			gpios = <16 0x0>;
			output-low;
			line-name = "card detect bias";
		};
	};

	src@101e0000 {
		/* These chrystal drivers are not used on this board */
		disable-sxtalo;
		disable-mxtalo;
	};
/* bench 14034.0.0 39e3a4817c85 */
/* bench 14034.0.1 bbac60ec1b69 */
/* bench 14034.0.2 89d9276678d8 */
/* bench 14034.0.3 b0699cf40dc5 */
/* bench 14034.0.4 5858fe2719ad */
/* bench 14034.0.5 3bdec16708bd */
/* bench 14034.0.6 e4185661003f */
/* bench 14034.0.7 c68afa6d4893 */
/* bench 14034.0.8 f144ba1869e6 */
/* bench 14034.0.9 951fd5df4998 */
/* bench 14034.0.10 a25c4201eff4 */
/* bench 14034.0.11 bac476939c9d */
/* bench 14034.0.12 a10fa4f0d489 */
		pinctrl-names = "default";
		pinctrl-0 = <&cd_default_mode>;

		uart0 {
			/* Only use RX/TX pins */
			uart0_s8815_mode: uart0_mux {
				u0_default_mux {
					function = "u0";
					groups = "u0txrx_a_1";
				};
			};
		};
		mmcsd-cd {
			cd_default_mode: cd_default {
				cd_default_cfg1 {
					/* CD input GPIO */
					pins = "GPIO111_H21";
					ste,input = <0>;
				};
				cd_default_cfg2 {
					/* CD GPIO biasing */
					pins = "GPIO112_J21";
					ste,output = <0>;
				};
			};
		};
		gpioi2c {
			gpioi2c_default_mode: gpioi2c_default {
				gpioi2c_default_cfg {
					pins = "GPIO73_C21", "GPIO74_C20";
					ste,input = <0>;
				};
			};
		};
		user-led {
			user_led_default_mode: user_led_default {
				user_led_default_cfg {
					pins = "GPIO2_C5";
					ste,output = <1>;
				};
			};
		};
		user-button {
			user_button_default_mode: user_button_default {
				user_button_default_cfg {
					pins = "GPIO3_A4";
					ste,input = <0>;
				};
			};
		};
	};

	/* Ethernet */
	external-bus@34000000 {
		compatible = "simple-bus";
		reg = <0x34000000 0x1000000>;
		#address-cells = <1>;
		#size-cells = <1>;
		ranges = <0 0x34000000 0x1000000>;
		ethernet@300 {
			compatible = "smsc,lan91c111";
			reg = <0x300 0x0fd00>;
			interrupt-parent = <&gpio3>;
			interrupts = <8 IRQ_TYPE_EDGE_RISING>;
		};
	};

	i2c1 {
		lis3lv02dl@1d {
			/* Accelerometer */
			compatible = "st,lis3lv02dl-accel";
			reg = <0x1d>;
/* bench 3857.1.0 be603081ac83 */
/* bench 3857.1.1 6094ce350362 */
/* bench 3857.1.2 2010c77ec0dc */
/* bench 3857.1.3 6b95ecb4f1b1 */
/* bench 3857.1.4 5a2465407eae */
/* bench 3857.1.5 f17c3bbe9d6e */
/* bench 3857.1.6 f3eb8f617a16 */
/* bench 3857.1.7 9af038fc977a */
/* bench 3857.1.8 31fa056bec68 */
		};
	};

	/* GPIO I2C connected to the USB portions of the STw4811 only */
	gpio-i2c {
		compatible = "i2c-gpio";
		gpios = <&gpio2 10 0>, /* sda */
			<&gpio2 9 0>; /* scl */
		#address-cells = <1>;
		#size-cells = <0>;
		pinctrl-names = "default";
		pinctrl-0 = <&gpioi2c_default_mode>;

		stw4811@2d {
			   compatible = "st,stw4811-usb";
			   reg = <0x2d>;
		};
	};


	amba {
		/* Activate RXTX on UART 0 */
		uart0: uart@101fd000 {
			pinctrl-names = "default";
			pinctrl-0 = <&uart0_s8815_mode>;
			status = "okay";
		};
		/* Configure card detect for the uSD slot */
		mmc@101f6000 {
			cd-gpios = <&gpio3 15 GPIO_ACTIVE_LOW>;
		};
	};

	/* The user LED on the board is set up to be used for heartbeat */
	leds {
		compatible = "gpio-leds";
		user-led {
			label = "user_led";
			gpios = <&gpio0 2 0x1>;
			default-state = "off";
			linux,default-trigger = "heartbeat";
			pinctrl-names = "default";
			pinctrl-0 = <&user_led_default_mode>;
		};
/* bench 4985.4.0 e06ecee44fb8 */
/* bench 4985.4.1 4f9f13ee1b51 */
/* bench 4985.4.2 92e2c7362563 */
/* bench 4985.4.3 dedb6a2c5ebb */
/* bench 4985.4.4 f995ef9e6728 */
/* bench 4985.4.5 1395a6f408e2 */
/* bench 4985.4.6 cadce6c3aa9a */
/* bench 4985.4.7 c47fa109c65b */
/* bench 4985.4.8 01257b5cccdf */
/* bench 4985.4.9 30498d4a28ee */

	/* User key mapped in as "escape" */
	gpio-keys {
		compatible = "gpio-keys";
		user-button {
			label = "user_button";
			gpios = <&gpio0 3 0x1>;
			linux,code = <1>; /* KEY_ESC */
			wakeup-source;
			pinctrl-names = "default";
			pinctrl-0 = <&user_button_default_mode>;
		};
	};
};
