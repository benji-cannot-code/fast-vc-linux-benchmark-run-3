FASTVC-BENCH-CORPUS:linux-main-100k-v1-e0bd41dc-8e12-4f1b-978d-a3645ae59da0
/* bench 27401.3.0 261a0ceb5329 */
/* bench 27401.3.1 0f7643fdb89f */
/* bench 27401.3.2 a4650a6423cf */
/* bench 27401.3.3 2a1138d776b2 */
/* bench 27401.3.4 b3ef604079c2 */
/* bench 27401.3.5 d743f7e70d53 */
/* bench 27401.3.6 977b4fac8842 */
/* bench 27401.3.7 355837ccb6f5 */
 * Samsung's Exynos4412 based Trats 2 board device tree source
 *
 * Copyright (c) 2013 Samsung Electronics Co., Ltd.
 *		http://www.samsung.com
 *
 * Device tree source file for Samsung's Trats 2 board which is based on
 * Samsung's Exynos4412 SoC.
 */

/dts-v1/;
/* bench 24182.0.0 eaabb19d48f4 */
/* bench 24182.0.1 2f05479492ad */
/* bench 24182.0.2 f65bc2bd49b9 */
/* bench 24182.0.3 79556c12dbb3 */
/* bench 24182.0.4 f4b668e847eb */
/ {
	model = "Samsung Trats 2 based on Exynos4412";
	compatible = "samsung,trats2", "samsung,midas", "samsung,exynos4412", "samsung,exynos4";

	memory@40000000 {
		device_type = "memory";
		reg = <0x40000000 0x40000000>;
	};

	chosen {
		bootargs = "root=/dev/mmcblk0p5 rootwait earlyprintk panic=5";
		stdout-path = "serial2:115200n8";
	};
};
