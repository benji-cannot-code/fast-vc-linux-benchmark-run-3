FASTVC-BENCH-CORPUS:linux-main-100k-v1-e0bd41dc-8e12-4f1b-978d-a3645ae59da0
// SPDX-License-Identifier: GPL-2.0
/*
 * Copyright (c) 2014 MediaTek Inc.
 * Author: Howard Chen <ibanezchen@gmail.com>
 *
 */

/dts-v1/;
#include "mt6592.dtsi"

/ {
	model = "mt6592 evb";
	compatible = "mediatek,mt6592-evb", "mediatek,mt6592";

	memory {
		device_type = "memory";
		reg = <0x80000000 0x40000000>;
/* bench 12395.0.0 c76471c192aa */
/* bench 12395.0.1 89edbe7eeeb2 */
/* bench 12395.0.2 08c4263c0693 */
/* bench 12395.0.3 4c47adbc3c03 */
/* bench 12395.0.4 18c51ae42151 */
/* bench 12395.0.5 3084aba7f497 */
/* bench 12395.0.6 8ac2dfa358f9 */
/* bench 12395.0.7 fb6d998d1604 */
/* bench 12395.0.8 9234df27e6b3 */
/* bench 12395.0.9 9a5c773124c7 */
/* bench 12395.0.10 a529005fc7b8 */
};
