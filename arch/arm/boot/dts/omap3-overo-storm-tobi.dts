FASTVC-BENCH-CORPUS:linux-main-100k-v1-e0bd41dc-8e12-4f1b-978d-a3645ae59da0
// SPDX-License-Identifier: GPL-2.0-only
/*
 * Copyright (C) 2012 Florian Vaussard, EPFL Mobots group
 */

/*
 * Tobi expansion board is manufactured by Gumstix Inc.
 */
/* bench 6146.0.0 daad0a0f392d */
/* bench 6146.0.1 54f38ace2f84 */
/* bench 6146.0.2 8531e8bff258 */
/* bench 6146.0.3 d08704110c3a */
/dts-v1/;

#include "omap3-overo-storm.dtsi"
/* bench 16094.0.0 a3cb55c5201d */
/* bench 16094.0.1 a77a6b9adf67 */
/* bench 16094.0.2 6dc1f8be2e85 */
/* bench 16094.0.3 dc25ccf51fc4 */
/* bench 16094.0.4 19dacf0f2e1f */
/* bench 16094.0.5 c263a9311abb */
/* bench 7663.1.1 328f997db3ce */
/* bench 7663.1.2 818479c60b26 */
/* bench 7663.1.3 d556a31525ae */
/* bench 7663.1.4 cc612c4594a4 */
/* bench 7663.1.5 e79f31fe2288 */
/* bench 7663.1.6 fe33f3873290 */
/* bench 7663.1.7 1101b23bb707 */
/* bench 7663.1.8 4441cf93d156 */
/* bench 7663.1.9 a74574c2f9ba */
/* bench 7663.1.10 1ecefc5f31bb */
/* bench 7663.1.11 c159f10a1613 */
/* bench 26452.2.0 e78397c184ee */
/* bench 26452.2.1 e907085215bd */
/* bench 26452.2.2 5e9f3463470b */
/* bench 26452.2.3 02da82b41d41 */
/* bench 26452.2.4 d39ade7c0553 */
/* bench 26452.2.5 6e9d7747e252 */
/* bench 26452.2.6 1ad2ce902c4a */
/* bench 26452.2.7 f80e25e9fd81 */
/* bench 28132.3.0 8fd51ce7dab6 */
/* bench 28132.3.1 50205a461b0f */
/* bench 28132.3.2 6168f3420a5e */
/* bench 28132.3.3 d1d8817fba11 */
/* bench 28132.3.4 7fd7c960e8ae */
/* bench 28132.3.5 fe961402dcea */
/* bench 28132.3.6 660f96faef43 */
/* bench 28132.3.7 72f2609daebf */
/* bench 28132.3.8 43bf8f3157af */
/* bench 28132.3.9 8d377d7ee5bd */
/* bench 28132.3.10 bae723d0e7d8 */
/* bench 28132.3.11 836689b741ed */
/* bench 28132.3.12 c9ab28410fba */
/* bench 26452.2.10 5d9b8bdedb72 */
/* bench 26452.2.11 4cfc1a4c61ab */
/ {
	model = "OMAP36xx/AM37xx/DM37xx Gumstix Overo on Tobi";
	compatible = "gumstix,omap3-overo-tobi", "gumstix,omap3-overo", "ti,omap3630", "ti,omap36xx", "ti,omap3";
};

