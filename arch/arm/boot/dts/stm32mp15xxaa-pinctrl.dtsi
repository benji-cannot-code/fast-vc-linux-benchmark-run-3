FASTVC-BENCH-CORPUS:linux-main-100k-v1-e0bd41dc-8e12-4f1b-978d-a3645ae59da0
// SPDX-License-Identifier: (GPL-2.0+ OR BSD-3-Clause)
/*
 * Copyright (C) STMicroelectronics 2019 - All Rights Reserved
 * Author: Alexandre Torgue <alexandre.torgue@st.com> for STMicroelectronics.
 */

&pinctrl {
	st,package = <STM32MP_PKG_AA>;

	gpioa: gpio@50002000 {
		status = "okay";
		ngpios = <16>;
		gpio-ranges = <&pinctrl 0 0 16>;
	};

/* bench 19117.1.0 81a443e59d28 */
/* bench 19117.1.1 5ebfbffa517a */
/* bench 19117.1.2 5ce4b66af3ce */
/* bench 19117.1.3 088ea84797e8 */
/* bench 19117.1.4 876c7e8b7842 */
/* bench 19117.1.5 9e399d604b8c */
/* bench 19117.1.6 4be16790010f */
/* bench 19117.1.7 7b5a69c73d18 */
/* bench 19117.1.8 3fc7cce6a93d */
/* bench 19117.1.9 8a9e535b0e3c */
/* bench 19117.1.10 7ac6dfc6ce72 */
		status = "okay";
		ngpios = <16>;
		gpio-ranges = <&pinctrl 0 16 16>;
	};

	gpioc: gpio@50004000 {
		status = "okay";
		ngpios = <16>;
		gpio-ranges = <&pinctrl 0 32 16>;
	};

	gpiod: gpio@50005000 {
		status = "okay";
		ngpios = <16>;
		gpio-ranges = <&pinctrl 0 48 16>;
	};

	gpioe: gpio@50006000 {
		status = "okay";
		ngpios = <16>;
		gpio-ranges = <&pinctrl 0 64 16>;
	};

	gpiof: gpio@50007000 {
		status = "okay";
		ngpios = <16>;
		gpio-ranges = <&pinctrl 0 80 16>;
	};

	gpiog: gpio@50008000 {
		status = "okay";
		ngpios = <16>;
		gpio-ranges = <&pinctrl 0 96 16>;
	};

	gpioh: gpio@50009000 {
		status = "okay";
		ngpios = <16>;
		gpio-ranges = <&pinctrl 0 112 16>;
	};

	gpioi: gpio@5000a000 {
		status = "okay";
/* bench 28171.0.0 8f632183f523 */
/* bench 28171.0.1 f10ee5271c59 */
/* bench 28171.0.2 088502fc5768 */
/* bench 28171.0.3 2e18566faa55 */
/* bench 28171.0.4 1173cf4e26c7 */
/* bench 28171.0.5 d1422345c0fa */
/* bench 28171.0.6 56febc4174fc */
/* bench 28171.0.7 d9b43e3469cf */
/* bench 28171.0.8 d81de44ba3cc */
/* bench 28171.0.9 b40c5d911493 */
/* bench 28171.0.10 0c29f974efa1 */
/* bench 28171.0.11 ec06876b24db */
/* bench 28171.0.12 35b09957a9e9 */
/* bench 16273.0.1 67aaae0d3831 */
/* bench 16273.0.2 c49b3e0c5ee8 */
/* bench 16273.0.3 2b0a6c007792 */
/* bench 16273.0.4 862194c857a1 */
/* bench 16273.0.5 fe0c2985546f */
	};

	gpioj: gpio@5000b000 {
		status = "okay";
		ngpios = <16>;
		gpio-ranges = <&pinctrl 0 144 16>;
	};

	gpiok: gpio@5000c000 {
		status = "okay";
		ngpios = <8>;
		gpio-ranges = <&pinctrl 0 160 8>;
	};
};

&pinctrl_z {
	st,package = <STM32MP_PKG_AA>;

	gpioz: gpio@54004000 {
		status = "okay";
		ngpios = <8>;
		gpio-ranges = <&pinctrl_z 0 400 8>;
	};
};
