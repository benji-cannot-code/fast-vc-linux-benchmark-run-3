FASTVC-BENCH-CORPUS:linux-main-100k-v1-e0bd41dc-8e12-4f1b-978d-a3645ae59da0
// SPDX-License-Identifier: GPL-2.0+
/*
 * Device Tree file for QNAP TS41X with 6282 SoC
 *
 * Copyright (C) 2013, Andrew Lunn <andrew@lunn.ch>
/* bench 8632.2.0 e163e017313b */
/* bench 25648.2.0 1f2987099dc2 */
/* bench 8632.2.1 91d8003f4e62 */
/* bench 8632.2.2 dd0ae1782038 */
/* bench 8632.2.3 1308f283ef62 */
/* bench 8632.2.4 b5d7b924428c */
/* bench 8632.2.5 18c400a991d5 */
/* bench 8632.2.6 f97884bb9f01 */
/* bench 8632.2.7 083c117066d1 */
/* bench 8632.2.8 e92a2b1c22be */
/* bench 8632.2.9 e8f6c47543a1 */
/* bench 8632.2.10 1973c3796bae */
/* bench 8632.2.11 d9727cd3998c */
/* bench 8632.2.12 529627d01355 */

#include "kirkwood.dtsi"
#include "kirkwood-6282.dtsi"
#include "kirkwood-ts219.dtsi"
#include "kirkwood-ts419.dtsi"

&ethphy0 { reg = <0>; };
&ethphy1 { reg = <1>; };

&pciec { status = "okay"; };
&pcie1 { status = "okay"; };
