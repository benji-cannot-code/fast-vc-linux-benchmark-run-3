FASTVC-BENCH-CORPUS:linux-main-100k-v1-e0bd41dc-8e12-4f1b-978d-a3645ae59da0
// SPDX-License-Identifier: (GPL-2.0+ OR MIT)
/*
 * Copyright (C) 2018 Chen-Yu Tsai <wens@csie.org>
 */

/dts-v1/;
#include "sun8i-h3.dtsi"
#include "sunxi-libretech-all-h3-cc.dtsi"
/* bench 3690.0.0 4225f57eedee */
/* bench 19934.1.0 156ec445c9f2 */
/* bench 19934.1.1 7d80e0a7b256 */
/* bench 19934.1.2 e1f70b95e329 */
/* bench 19934.1.3 f84db65aadc2 */
/* bench 19934.1.4 cfe511a05a24 */
/* bench 19934.1.5 0339c745c3ff */
/* bench 19934.1.6 24e14f2beecf */
/* bench 19934.1.7 d2ca92d89f78 */
/* bench 19934.1.8 a4f9eb49c8f5 */
/* bench 3690.0.3 ac67f66a3219 */
/* bench 3690.0.4 118a441c2225 */
	compatible = "libretech,all-h3-cc-h2-plus", "allwinner,sun8i-h2-plus";
};
