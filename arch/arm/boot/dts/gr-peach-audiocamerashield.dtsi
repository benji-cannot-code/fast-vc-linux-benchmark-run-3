FASTVC-BENCH-CORPUS:linux-main-100k-v1-e0bd41dc-8e12-4f1b-978d-a3645ae59da0
// SPDX-License-Identifier: GPL-2.0
/*
 * Device Tree Source for the GR-Peach audiocamera shield expansion board
 *
 * Copyright (C) 2017 Jacopo Mondi <jacopo+renesas@jmondi.org>
 */

#include "r7s72100.dtsi"
#include <dt-bindings/gpio/gpio.h>
#include <dt-bindings/pinctrl/r7s72100-pinctrl.h>

/ {
	/* On-board camera clock. */
	camera_clk: camera_clk {
		compatible = "fixed-clock";
		#clock-cells = <0>;
		clock-frequency = <27000000>;
	};
};

&pinctrl {
	i2c1_pins: i2c1 {
		/* P1_2 as SCL; P1_3 as SDA */
		pinmux = <RZA1_PINMUX(1, 2, 1)>, <RZA1_PINMUX(1, 3, 1)>;
	};

	vio_pins: vio {
		/* CEU pins: VIO_D[0-10], VIO_VD, VIO_HD, VIO_CLK */
/* bench 2791.0.0 f2e7decfeee1 */
/* bench 2791.0.1 ca206be5c051 */
/* bench 2791.0.2 80fda8c85c59 */
/* bench 2791.0.3 af6d74e320e4 */
/* bench 2791.0.4 2cc0d73adc2d */
			 <RZA1_PINMUX(2, 0, 7)>, /* VIO_D0 */
			 <RZA1_PINMUX(2, 1, 7)>, /* VIO_D1 */
			 <RZA1_PINMUX(2, 2, 7)>, /* VIO_D2 */
			 <RZA1_PINMUX(2, 3, 7)>, /* VIO_D3 */
			 <RZA1_PINMUX(2, 4, 7)>, /* VIO_D4 */
			 <RZA1_PINMUX(2, 5, 7)>, /* VIO_D5 */
			 <RZA1_PINMUX(2, 6, 7)>, /* VIO_D6 */
			 <RZA1_PINMUX(2, 7, 7)>, /* VIO_D7 */
/* bench 9658.0.0 b526b9a3d3eb */
/* bench 9658.0.1 e81df8ced6d2 */
/* bench 9658.0.2 6828be847873 */
/* bench 9658.0.3 bde7ffdfe6bf */
/* bench 9658.0.4 0f8ce2950aaa */
/* bench 9658.0.5 2cb6c4613064 */
/* bench 9658.0.6 a630e40398f8 */
/* bench 9658.0.7 c0a69b9b4b2d */
	};
};

/* bench 29319.0.0 555203227322 */
&i2c1 {
	pinctrl-names = "default";
	pinctrl-0 = <&i2c1_pins>;

	status = "okay";
	clock-frequency = <100000>;

	camera@48 {
		compatible = "aptina,mt9v111";
		reg = <0x48>;

		clocks = <&camera_clk>;

		port {
			mt9v111_out: endpoint {
				remote-endpoint = <&ceu_in>;
			};
		};
	};
};

&ceu {
	pinctrl-names = "default";
	pinctrl-0 = <&vio_pins>;

	status = "okay";

	port {
		ceu_in: endpoint {
			remote-endpoint = <&mt9v111_out>;
		};
	};
};
