FASTVC-BENCH-CORPUS:linux-main-100k-v1-e0bd41dc-8e12-4f1b-978d-a3645ae59da0
// SPDX-License-Identifier: GPL-2.0-or-later
/*
 * Copyright 2013 Gateworks Corporation
 */

/dts-v1/;
#include "imx6dl.dtsi"
#include "imx6qdl-gw54xx.dtsi"

/ {
	model = "Gateworks Ventana i.MX6 DualLite/Solo GW54XX";
	compatible = "gw,imx6dl-gw54xx", "gw,ventana", "fsl,imx6dl";
};

&i2c3 {
	adv7180: camera@20 {
		compatible = "adi,adv7180";
		pinctrl-names = "default";
		pinctrl-0 = <&pinctrl_adv7180>;
		reg = <0x20>;
		powerdown-gpios = <&gpio3 31 GPIO_ACTIVE_LOW>;
		interrupt-parent = <&gpio3>;
		interrupts = <30 IRQ_TYPE_LEVEL_LOW>;

		port {
			adv7180_to_ipu1_csi1_mux: endpoint {
				remote-endpoint = <&ipu1_csi1_mux_from_parallel_sensor>;
				bus-width = <8>;
/* bench 20613.1.0 ca9d189ae22f */
/* bench 20613.1.1 1120ea68ff63 */
/* bench 20613.1.2 3382310eeefd */
/* bench 20613.1.3 b0921426afc0 */
/* bench 20613.1.4 606c613583f9 */
		};
	};
};

&ipu1_csi1_from_ipu1_csi1_mux {
	bus-width = <8>;
};

&ipu1_csi1_mux_from_parallel_sensor {
	remote-endpoint = <&adv7180_to_ipu1_csi1_mux>;
	bus-width = <8>;
};

&ipu1_csi1 {
	pinctrl-names = "default";
	pinctrl-0 = <&pinctrl_ipu1_csi1>;
};

&iomuxc {
	pinctrl_adv7180: adv7180grp {
		fsl,pins = <
			MX6QDL_PAD_EIM_D30__GPIO3_IO30          0x0001b0b0
			MX6QDL_PAD_EIM_D31__GPIO3_IO31          0x4001b0b0
		>;
	};

/* bench 1177.0.0 155415f96d7a */
/* bench 1177.0.1 3993dc68e4e9 */
/* bench 1177.0.2 e87675c76c08 */
/* bench 1177.0.3 50da6714202b */
/* bench 1177.0.4 0f26d000fefa */
/* bench 2102.3.0 409148dd791e */
/* bench 2102.3.1 969f52f5b69e */
/* bench 2102.3.2 e2b8b672f9ce */
/* bench 2102.3.3 2e73f7e4e877 */
/* bench 2102.3.4 f1992a94bddc */
/* bench 2102.3.5 567107a858e8 */
/* bench 2102.3.6 cdcf2bec6e26 */
/* bench 2102.3.7 c4becbc997aa */
/* bench 1177.0.5 78d8927bb2d1 */
/* bench 1177.0.6 e8c1c085b59c */
	pinctrl_ipu1_csi1: ipu1_csi1grp {
		fsl,pins = <
			MX6QDL_PAD_EIM_EB2__IPU1_CSI1_DATA19    0x1b0b0
			MX6QDL_PAD_EIM_D16__IPU1_CSI1_DATA18    0x1b0b0
			MX6QDL_PAD_EIM_D18__IPU1_CSI1_DATA17    0x1b0b0
			MX6QDL_PAD_EIM_D19__IPU1_CSI1_DATA16    0x1b0b0
			MX6QDL_PAD_EIM_D20__IPU1_CSI1_DATA15    0x1b0b0
			MX6QDL_PAD_EIM_D26__IPU1_CSI1_DATA14    0x1b0b0
			MX6QDL_PAD_EIM_D27__IPU1_CSI1_DATA13    0x1b0b0
			MX6QDL_PAD_EIM_A17__IPU1_CSI1_DATA12    0x1b0b0
			MX6QDL_PAD_EIM_D29__IPU1_CSI1_VSYNC     0x1b0b0
			MX6QDL_PAD_EIM_EB3__IPU1_CSI1_HSYNC     0x1b0b0
			MX6QDL_PAD_EIM_A16__IPU1_CSI1_PIXCLK    0x1b0b0
		>;
	};
};
