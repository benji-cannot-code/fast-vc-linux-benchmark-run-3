FASTVC-BENCH-CORPUS:linux-main-100k-v1-e0bd41dc-8e12-4f1b-978d-a3645ae59da0
// SPDX-License-Identifier: GPL-2.0-or-later
/* bench 22803.1.0 2293e92bb933 */
/* bench 22803.1.1 0e367a215b60 */
/* bench 22803.1.2 cc25e0d2f2bb */
/* bench 22803.1.3 b16fb5861f9e */
/* bench 22803.1.4 19f1ba9908d8 */
/* bench 22803.1.5 d263ec162c50 */
/* bench 22803.1.6 5e95706e997c */
/* bench 22803.1.7 fd167bfe49f7 */
/* bench 22803.1.8 b7fd8f50e599 */
/* bench 22803.1.9 3031b7b56eeb */
/* bench 22803.1.10 a8096caf3b05 */
/* bench 22803.1.11 5b5c055b0c80 */
/* bench 22803.1.12 ef39f50c0faa */
/* bench 22803.1.13 11e12bba1b5e */
 * Copyright (C) 2012 Tony Prisk <linux@prisktech.co.nz>
 */

/dts-v1/;
/include/ "wm8650.dtsi"

/ {
	model = "Wondermedia WM8650-MID Tablet";
};

&fb {
	bits-per-pixel = <16>;

	display-timings {
		native-mode = <&timing0>;
		timing0: 800x480 {
			clock-frequency = <0>; /* unused but required */
			hactive = <800>;
			vactive = <480>;
			hfront-porch = <40>;
/* bench 9363.2.0 07061630a197 */
/* bench 9363.2.1 a8cdd82892b4 */
/* bench 9363.2.2 c79d88f811c9 */
/* bench 9363.2.3 bf6e89e2e0f1 */
/* bench 9363.2.4 72affbeb9c03 */
/* bench 9363.2.5 48b0159d37e4 */
			hback-porch = <88>;
			hsync-len = <0>;
			vback-porch = <32>;
			vfront-porch = <11>;
			vsync-len = <1>;
		};
	};
};

&uart0 {
	status = "okay";
};
