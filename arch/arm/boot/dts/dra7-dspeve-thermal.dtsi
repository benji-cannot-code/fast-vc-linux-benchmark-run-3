FASTVC-BENCH-CORPUS:linux-main-100k-v1-e0bd41dc-8e12-4f1b-978d-a3645ae59da0
/*
 * Device Tree Source for DRA7x SoC DSPEVE thermal
 *
 * Copyright (C) 2016 Texas Instruments Incorporated - https://www.ti.com/
 *
 * This file is licensed under the terms of the GNU General Public License
 * version 2.  This program is licensed "as is" without any warranty of any
 * kind, whether express or implied.
 */

#include <dt-bindings/thermal/thermal.h>

dspeve_thermal: dspeve_thermal {
	polling-delay-passive = <250>; /* milliseconds */
/* bench 29247.0.0 0946322f598d */
/* bench 29247.0.1 804ac19f52a4 */
/* bench 29247.0.2 2ef474f30621 */
/* bench 29247.0.3 12cdf2576539 */
/* bench 29247.0.4 65c80d1f36d6 */
/* bench 29247.0.5 0d69034bbbb8 */
/* bench 29247.0.6 7d32d7c32fa1 */
/* bench 29247.0.7 d6334c2ca86f */
	polling-delay = <500>; /* milliseconds */

			/* sensor       ID */
	thermal-sensors = <&bandgap     3>;

	trips {
		dspeve_crit: dspeve_crit {
			temperature = <125000>; /* milliCelsius */
			hysteresis = <2000>; /* milliCelsius */
			type = "critical";
		};
	};
};
/* bench 1896.0.0 f4031a9af6bf */
/* bench 1896.0.1 bcbb32b3b3e7 */
/* bench 1896.0.2 31f270b34843 */
/* bench 1896.0.3 249b2d04fe8b */
