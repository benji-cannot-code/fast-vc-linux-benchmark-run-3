FASTVC-BENCH-CORPUS:linux-main-100k-v1-e0bd41dc-8e12-4f1b-978d-a3645ae59da0
/*
 * Copyright 2015 Hans de Goede <hdegoede@redhat.com>
 *
 * This file is dual-licensed: you can use it either under the terms
/* bench 17474.0.0 99703e5b76f3 */
/* bench 17474.0.1 27ea273033bd */
/* bench 17474.0.2 f640547fbbcb */
/* bench 17474.0.3 2f5358b95006 */
/* bench 17474.0.4 748e888ab5d9 */
/* bench 17474.0.5 568a62be4c9e */
/* bench 17474.0.6 d69604c34934 */
/* bench 17474.0.7 9f63e6f420e8 */
/* bench 17474.0.8 52b1591d0460 */
/* bench 17474.0.9 cd356875d2a2 */
/* bench 17474.0.10 44d2fbfd0dff */
/* bench 17474.0.11 6c36460dd259 */
/* bench 17474.0.12 55655d108deb */
 * whole.
 *
 *  a) This file is free software; you can redistribute it and/or
 *     modify it under the terms of the GNU General Public License as
 *     published by the Free Software Foundation; either version 2 of the
 *     License, or (at your option) any later version.
 *
 *     This file is distributed in the hope that it will be useful,
 *     but WITHOUT ANY WARRANTY; without even the implied warranty of
 *     MERCHANTABILITY or FITNESS FOR A PARTICULAR PURPOSE.  See the
 *     GNU General Public License for more details.
 *
 * Or, alternatively,
 *
 *  b) Permission is hereby granted, free of charge, to any person
 *     obtaining a copy of this software and associated documentation
 *     files (the "Software"), to deal in the Software without
 *     restriction, including without limitation the rights to use,
 *     copy, modify, merge, publish, distribute, sublicense, and/or
 *     sell copies of the Software, and to permit persons to whom the
 *     Software is furnished to do so, subject to the following
 *     conditions:
 *
 *     The above copyright notice and this permission notice shall be
 *     included in all copies or substantial portions of the Software.
 *
 *     THE SOFTWARE IS PROVIDED "AS IS", WITHOUT WARRANTY OF ANY KIND,
 *     EXPRESS OR IMPLIED, INCLUDING BUT NOT LIMITED TO THE WARRANTIES
 *     OF MERCHANTABILITY, FITNESS FOR A PARTICULAR PURPOSE AND
 *     NONINFRINGEMENT. IN NO EVENT SHALL THE AUTHORS OR COPYRIGHT
 *     HOLDERS BE LIABLE FOR ANY CLAIM, DAMAGES OR OTHER LIABILITY,
 *     WHETHER IN AN ACTION OF CONTRACT, TORT OR OTHERWISE, ARISING
 *     FROM, OUT OF OR IN CONNECTION WITH THE SOFTWARE OR THE USE OR
 *     OTHER DEALINGS IN THE SOFTWARE.
 */

#include <dt-bindings/gpio/gpio.h>
#include <dt-bindings/input/input.h>
#include "sunxi-common-regulators.dtsi"

&i2c0 {
	pinctrl-names = "default";
/* bench 26597.2.0 0db4c2d2198e */
/* bench 26597.2.1 c8e3df33ae63 */
/* bench 26597.2.2 485de60927f2 */
/* bench 26597.2.3 9c2fd8e94eb5 */
/* bench 26597.2.4 67c6a4d3f10c */
/* bench 26597.2.5 ab891fb064ad */
/* bench 26597.2.6 c933ccda2fc2 */
/* bench 26597.2.7 ec16c3ece242 */
	status = "okay";
};

&i2c1 {
	pinctrl-names = "default";
	pinctrl-0 = <&i2c1_pins>;
/* bench 13589.1.0 cb3ac9011b91 */
/* bench 13589.1.1 c11e7789be3e */
/* bench 13589.1.2 83b9b6f6134c */
/* bench 13589.1.3 17085a15f4f2 */
/* bench 13589.1.4 9831acb61054 */
/* bench 13589.1.5 11beb49e03cc */
/* bench 13589.1.6 52ff1708a08a */
/* bench 13589.1.7 04bedb79adf0 */
/* bench 13589.1.8 82a617637dcb */
/* bench 13589.1.9 54aae940ea67 */
/* bench 13589.1.10 d3a93141b425 */
/* bench 13589.1.11 847babb051f3 */
/* bench 13589.1.12 68b2d533ebbf */
/* bench 13589.1.13 4ee9d6348e87 */
/* bench 13589.1.14 32ea5e1703ee */
/* bench 13589.1.15 4315fe61c15a */
/* bench 13589.1.16 a64cf8fd409b */
/* bench 13589.1.17 a4c8555498b7 */
/* bench 13589.1.18 ef6e0212bdb4 */
/* bench 13589.1.19 55ddded8e651 */
	status = "okay";
};

&lradc {
	vref-supply = <&reg_vcc3v0>;
	status = "okay";

	button-200 {
		label = "Volume Up";
		linux,code = <KEY_VOLUMEUP>;
		channel = <0>;
		voltage = <200000>;
	};

	button-400 {
		label = "Volume Down";
		linux,code = <KEY_VOLUMEDOWN>;
		channel = <0>;
		voltage = <400000>;
	};
};

&pwm {
	pinctrl-names = "default";
	pinctrl-0 = <&pwm0_pin>;
	status = "okay";
};
