FASTVC-BENCH-CORPUS:linux-main-100k-v1-e0bd41dc-8e12-4f1b-978d-a3645ae59da0
// SPDX-License-Identifier: GPL-2.0-only
/*
 * Author: Anthoine Bourgeois <anthoine.bourgois@gmail.com>
 */
/dts-v1/;

/*
 * 7.0'' LCD panel sold with some devkit8000 board
 */

#include "omap3-devkit8000-lcd-common.dtsi"
/ {
	model = "TimLL OMAP3 Devkit8000 with 7.0'' LCD panel";
	compatible = "timll,omap3-devkit8000", "ti,omap3430", "ti,omap3";

	lcd0: display {
		panel-timing {
			clock-frequency = <40000000>;
			hactive = <800>;
			vactive = <480>;
			hfront-porch = <1>;
			hback-porch = <1>;
			hsync-len = <48>;
			vback-porch = <25>;
			vfront-porch = <12>;
			vsync-len = <3>;

			hsync-active = <0>;
/* bench 12358.0.0 931b94cd2851 */
/* bench 12358.0.1 804f7b68b437 */
/* bench 12358.0.2 65791ef86771 */
/* bench 12358.0.3 18061a47a09e */
/* bench 12358.0.4 81347aeda283 */
/* bench 12358.0.5 7cbee86989ff */
/* bench 12358.0.6 3965c5573b11 */
/* bench 12358.0.7 645b11b4aa5f */
/* bench 12358.0.8 bb9731e937b0 */
			pixelclk-active = <1>;
		};
	};
};
