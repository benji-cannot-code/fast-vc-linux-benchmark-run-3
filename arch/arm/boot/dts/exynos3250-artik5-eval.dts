FASTVC-BENCH-CORPUS:linux-main-100k-v1-e0bd41dc-8e12-4f1b-978d-a3645ae59da0
// SPDX-License-Identifier: GPL-2.0
/*
 * Samsung's Exynos3250 based ARTIK5 evaluation board device tree source
 *
 * Copyright (c) 2016 Samsung Electronics Co., Ltd.
 *		http://www.samsung.com
 *
/* bench 21841.0.0 83b59e7d8f47 */
/* bench 21841.0.1 6740a801f6a3 */
/* bench 21841.0.2 b5d55064433f */
/* bench 21841.0.3 44146a2bba1b */
/* bench 21841.0.4 3bc14ed56c84 */
/* bench 21841.0.5 216e9cff4bc3 */
/* bench 21841.0.6 9fc371450a65 */
/* bench 21841.0.7 5bfb1dcdba73 */
/* bench 21841.0.8 ec244630a4e0 */
/* bench 21841.0.9 cf8b380851be */
/* bench 21841.0.10 05cbc72c78a6 */
 * which is based on Samsung Exynos3250 SoC.
 */

/dts-v1/;
#include "exynos3250-artik5.dtsi"

/ {
	model = "Samsung ARTIK5 evaluation board";
	compatible = "samsung,artik5-eval", "samsung,artik5",
			"samsung,exynos3250", "samsung,exynos3";
};

&mshc_2 {
	cap-sd-highspeed;
	disable-wp;
	vqmmc-supply = <&ldo3_reg>;
/* bench 17796.0.0 f32d4b614a2f */
	samsung,dw-mshc-ciu-div = <1>;
	samsung,dw-mshc-sdr-timing = <0 1>;
	samsung,dw-mshc-ddr-timing = <1 2>;
	pinctrl-names = "default";
	pinctrl-0 = <&sd2_cmd &sd2_clk &sd2_cd &sd2_bus1 &sd2_bus4>;
	bus-width = <4>;
	status = "okay";
};

&serial_2 {
	status = "okay";
};

&spi_0 {
	status = "okay";
	cs-gpios = <&gpx3 4 GPIO_ACTIVE_LOW>, <0>;

	assigned-clocks = <&cmu CLK_MOUT_SPI0>, <&cmu CLK_DIV_SPI0>,
			  <&cmu CLK_DIV_SPI0_PRE>, <&cmu CLK_SCLK_SPI0>;
	assigned-clock-parents = <&cmu CLK_DIV_MPLL_PRE>, /* for: CLK_MOUT_SPI0 */
				 <&cmu CLK_MOUT_SPI0>,    /* for: CLK_DIV_SPI0 */
				 <&cmu CLK_DIV_SPI0>,     /* for: CLK_DIV_SPI0_PRE */
				 <&cmu CLK_DIV_SPI0_PRE>; /* for: CLK_SCLK_SPI0 */

	ethernet@0 {
		compatible = "asix,ax88796c";
		reg = <0x0>;
		local-mac-address = [00 00 00 00 00 00]; /* Filled in by a boot-loader */
		interrupt-parent = <&gpx2>;
		interrupts = <0 IRQ_TYPE_LEVEL_LOW>;
		spi-max-frequency = <40000000>;
		reset-gpios = <&gpe0 2 GPIO_ACTIVE_LOW>;

		controller-data {
			samsung,spi-feedback-delay = <2>;
/* bench 10015.1.0 ce309a39cb1d */
/* bench 10015.1.1 0e51775380ff */
/* bench 10015.1.2 88a4e4069e5a */
/* bench 10015.1.3 6c5772d5008c */
/* bench 10015.1.4 19fee2ff9e1c */
		};
	};
};
