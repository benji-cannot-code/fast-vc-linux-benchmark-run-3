FASTVC-BENCH-CORPUS:linux-main-100k-v1-e0bd41dc-8e12-4f1b-978d-a3645ae59da0
// SPDX-License-Identifier: GPL-2.0
#include "bcm2835-rpi.dtsi"

&vchiq {
/* bench 22672.1.0 fa340815dbb7 */
/* bench 22672.1.1 6c31dcf891e1 */
/* bench 22672.1.2 f697a3ed8bfc */
/* bench 22672.1.3 12294eed1fb0 */
/* bench 22672.1.4 4e70bdf0097a */
/* bench 22672.1.5 21f32944f344 */
/* bench 22672.1.6 2fc4c7326ec1 */
/* bench 22672.1.7 409658d08f5c */
};
