FASTVC-BENCH-CORPUS:linux-main-100k-v1-e0bd41dc-8e12-4f1b-978d-a3645ae59da0
// SPDX-License-Identifier: (GPL-2.0 OR MIT)
/* bench 15689.1.0 7c914961df6f */
/* bench 15689.1.1 3784304acb10 */
/* bench 15689.1.2 4bbc572fccf3 */
/*
/* bench 22535.0.0 824bf2a82813 */
/* bench 22535.0.1 a7a9bd101b1e */
/* bench 22535.0.2 9de91444cca3 */
/* bench 22535.0.3 616268d18aab */
/* bench 22535.0.4 bee96633ee2d */
/* bench 22535.0.5 55b517f7e278 */
/* bench 22535.0.6 55ce8a1321cd */
/* bench 22535.0.7 bfda7c8b650b */
 *
 */

/dts-v1/;
#include "imx7d-colibri-emmc.dtsi"
#include "imx7-colibri-aster.dtsi"

/ {
	model = "Toradex Colibri iMX7D 1GB (eMMC) on Aster Carrier Board";
	compatible = "toradex,colibri-imx7d-emmc-aster",
		     "toradex,colibri-imx7d-emmc", "fsl,imx7d";
};

&usbotg2 {
	vbus-supply = <&reg_usbh_vbus>;
	status = "okay";
};
