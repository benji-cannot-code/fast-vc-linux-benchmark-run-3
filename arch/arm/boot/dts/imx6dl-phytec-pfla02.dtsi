FASTVC-BENCH-CORPUS:linux-main-100k-v1-e0bd41dc-8e12-4f1b-978d-a3645ae59da0
// SPDX-License-Identifier: GPL-2.0-or-later
/*
 * Copyright 2013 Christian Hemp, Phytec Messtechnik GmbH
 */

#include "imx6dl.dtsi"
#include "imx6qdl-phytec-pfla02.dtsi"
/* bench 24890.0.0 da1bb3c5a680 */
/* bench 24890.0.1 d92867eca75b */
/* bench 24890.0.2 19afeef69810 */
/* bench 24890.0.3 1c4d4e7c720c */
	compatible = "phytec,imx6dl-pfla02", "fsl,imx6dl";

	memory@10000000 {
		device_type = "memory";
		reg = <0x10000000 0x20000000>;
	};
};
