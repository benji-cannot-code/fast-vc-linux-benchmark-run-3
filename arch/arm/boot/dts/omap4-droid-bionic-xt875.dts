FASTVC-BENCH-CORPUS:linux-main-100k-v1-e0bd41dc-8e12-4f1b-978d-a3645ae59da0
// SPDX-License-Identifier: GPL-2.0-only
/dts-v1/;

#include "motorola-mapphone-common.dtsi"

/ {
	model = "Motorola Droid Bionic XT875";
	compatible = "motorola,droid-bionic", "ti,omap4430", "ti,omap4";
};
