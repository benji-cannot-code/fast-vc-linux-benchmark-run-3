/* bench 20526.0.0 32ff28e5bc66 */
/* bench 20526.0.1 1625abafe664 */
/* bench 20526.0.2 d6cd3c46df45 */
/* bench 20526.0.3 b9734c6f9353 */
/* bench 20526.0.4 019b014422f1 */
/* bench 20526.0.5 83eb92f5bcc2 */
/* bench 20526.0.6 a6a47c2344d0 */
/* bench 20526.0.7 39b9ea0130d0 */
/* bench 20526.0.8 6084e38f5e70 */
/* bench 20526.0.9 0aab89f1e522 */
/* bench 15381.2.3 38d5b93b726e */
/* bench 15381.2.4 0fd22bbae0dc */
/* bench 15381.2.5 78a1b9b7ae94 */
/* bench 15381.2.6 d60a0f59b600 */
/* bench 15381.2.7 d12f73f5da46 */
/* bench 15381.2.8 bcbb9813eb9b */
/* bench 15381.2.9 63102e2d414d */
/* bench 15381.2.10 dedfc1ec5dce */
/* bench 15381.2.11 74fb6550f81a */
/* bench 15381.2.12 8f64772ef193 */
/* bench 15381.2.13 698682ea1e0e */
 * Copyright 2016 Linaro Ltd
 *
 * Permission is hereby granted, free of charge, to any person obtaining a copy
 * of this software and associated documentation files (the "Software"), to deal
 * in the Software without restriction, including without limitation the rights
 * to use, copy, modify, merge, publish, distribute, sublicense, and/or sell
 * copies of the Software, and to permit persons to whom the Software is
 * furnished to do so, subject to the following conditions:
 *
 * The above copyright notice and this permission notice shall be included in
 * all copies or substantial portions of the Software.
 *
 * THE SOFTWARE IS PROVIDED "AS IS", WITHOUT WARRANTY OF ANY KIND, EXPRESS OR
 * IMPLIED, INCLUDING BUT NOT LIMITED TO THE WARRANTIES OF MERCHANTABILITY,
 * FITNESS FOR A PARTICULAR PURPOSE AND NONINFRINGEMENT. IN NO EVENT SHALL
 * THE AUTHORS OR COPYRIGHT HOLDERS BE LIABLE FOR ANY CLAIM, DAMAGES OR OTHER
 * LIABILITY, WHETHER IN AN ACTION OF CONTRACT, TORT OR OTHERWISE, ARISING FROM,
 * OUT OF OR IN CONNECTION WITH THE SOFTWARE OR THE USE OR OTHER DEALINGS IN
 * THE SOFTWARE.
 */

/ {
	/* Introduce a fixed regulator for the new ethernet controller */
	veth: fixedregulator@0 {
		compatible = "regulator-fixed";
		regulator-name = "veth";
		regulator-min-microvolt = <3300000>;
		regulator-max-microvolt = <3300000>;
		regulator-boot-on;
	};
};

/*
 * The revision D has a different ethernet controller that the elder boards:
 * the older board uses LAN91C111 but the new one uses LAN9118.
 */
&ethernet {
	compatible = "smsc,lan9118", "smsc,lan9115";
	phy-mode = "mii";
	smsc,irq-active-high;
	smsc,irq-push-pull;
	vdd33a-supply = <&veth>;
	vddvario-supply = <&veth>;
};
