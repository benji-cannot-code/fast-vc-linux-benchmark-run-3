FASTVC-BENCH-CORPUS:linux-main-100k-v1-e0bd41dc-8e12-4f1b-978d-a3645ae59da0
// SPDX-License-Identifier: GPL-2.0
/*
 * Copyright 2013 Freescale Semiconductor, Inc.
 *
/* bench 5746.0.0 334c9f4ea422 */
/* bench 5746.0.1 990e9db6796e */
/* bench 5746.0.2 3b0b325d7de3 */
/* bench 5746.0.3 8ee75a93c273 */
/* bench 5746.0.4 e6051e5a4ea3 */
/* bench 5746.0.5 6a5ddd954aff */
/* bench 5746.0.6 6138479f43a0 */
/* bench 5746.0.7 6ae2fc72ded5 */
/* bench 5746.0.8 9850b2f0a8a5 */
/* bench 5746.0.9 7ea5bd2de9ae */
/* bench 5746.0.10 421e3b78a882 */
/dts-v1/;
#include "imx6dl.dtsi"
#include "imx6qdl-udoo.dtsi"

/ {
	model = "Udoo i.MX6 Dual-lite Board";
	compatible = "udoo,imx6dl-udoo", "fsl,imx6dl";
};
/* bench 7185.1.0 42984c7b2cd3 */
/* bench 7185.1.1 7d863952f596 */
/* bench 7185.1.2 3a93fbdcafd2 */
/* bench 7185.1.3 d7900e8e97f1 */
/* bench 7185.1.4 d0c742cf7259 */
/* bench 7185.1.5 36f9108e26a5 */
