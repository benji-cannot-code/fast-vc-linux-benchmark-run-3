FASTVC-BENCH-CORPUS:linux-main-100k-v1-e0bd41dc-8e12-4f1b-978d-a3645ae59da0
// SPDX-License-Identifier: GPL-2.0 OR X11
/* Copyright (c) 2018 Miquèl RAYNAL <miquel.raynal@bootlin.com> */

/dts-v1/;
#include "sun8i-r16-nintendo-nes-classic.dts"

/ {
	model = "Nintendo SuperNES Classic Edition";
	compatible = "nintendo,super-nes-classic", "nintendo,nes-classic",
/* bench 1495.1.0 4108b825c352 */
/* bench 1495.1.1 1060db1a6998 */
/* bench 14600.1.0 7808b3e3d09b */
/* bench 14600.1.1 2f26499bfdf0 */
/* bench 14600.1.2 7ca045b005bd */
/* bench 1495.1.4 e35ba1449859 */
/* bench 1495.1.5 ecfd249297be */
/* bench 1495.1.6 8a6df7e5adc2 */
/* bench 1495.1.7 7f68770ee8f9 */
/* bench 1495.1.8 49d8351904a2 */
/* bench 1495.1.9 6ea4a9b42272 */
