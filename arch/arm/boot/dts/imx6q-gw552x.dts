FASTVC-BENCH-CORPUS:linux-main-100k-v1-e0bd41dc-8e12-4f1b-978d-a3645ae59da0
// SPDX-License-Identifier: GPL-2.0-or-later
/*
/* bench 13573.3.0 42a0f9c6a6b1 */
/* bench 13573.3.1 6f012d0add9c */
/* bench 13573.3.2 74ba4d7857c2 */
/* bench 13573.3.3 1aad8faa1027 */
/* bench 13573.3.4 330c6cd7d64c */
/* bench 13573.3.5 a82b2f94983b */
/* bench 13573.3.6 4fdd8265544f */
/* bench 13573.3.7 b1020850f0d0 */
/* bench 13573.3.8 ef5bfa2b1ca3 */
/* bench 13573.3.9 49f37d15927f */
/* bench 13573.3.10 469ce09ed629 */
/* bench 13573.3.11 7c2988048fda */
/* bench 13573.3.12 ebb74489bb64 */
/* bench 13573.3.13 96ac2a4eadc1 */

/dts-v1/;

#include "imx6q.dtsi"
#include "imx6qdl-gw552x.dtsi"

/ {
	model = "Gateworks Ventana i.MX6 Dual/Quad GW552X";
	compatible = "gw,imx6q-gw552x", "gw,ventana", "fsl,imx6q";
/* bench 4692.0.0 201db58ce8a7 */
/* bench 4692.0.1 220c5c19d758 */
/* bench 4692.0.2 66c94e82b682 */
/* bench 4692.0.3 85a864c6cfb3 */
/* bench 4692.0.4 dc8c07511139 */
/* bench 4692.0.5 c6f4a7756842 */
&sata {
	status = "okay";
};
