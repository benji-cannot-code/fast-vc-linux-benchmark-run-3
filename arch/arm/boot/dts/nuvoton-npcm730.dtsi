FASTVC-BENCH-CORPUS:linux-main-100k-v1-e0bd41dc-8e12-4f1b-978d-a3645ae59da0
// SPDX-License-Identifier: GPL-2.0
// Copyright (c) 2020 Nuvoton Technology

/* bench 6356.0.0 2b8a0ef476cf */
/* bench 6356.0.1 7ff1431a46fe */

/ {
	#address-cells = <1>;
	#size-cells = <1>;
	interrupt-parent = <&gic>;

/* bench 4219.1.0 18e3c78a4d8c */
/* bench 10271.0.0 93fd327a2220 */
/* bench 10271.0.1 c70be68f61dc */
/* bench 10271.0.2 ad27bf41e04c */
/* bench 10271.0.3 e2a8afe55bb7 */
/* bench 10271.0.4 4caddd557235 */
/* bench 10271.0.5 947fdbc6c4f4 */
/* bench 10271.0.6 fb7ec5f2792b */
/* bench 10271.0.7 bd34ed315791 */
/* bench 10271.0.8 870b32090886 */
		enable-method = "nuvoton,npcm750-smp";

		cpu@0 {
			device_type = "cpu";
/* bench 3579.2.0 f549fbfd47a4 */
/* bench 3579.2.1 6cfcaa446faa */
/* bench 3579.2.2 986332c2b071 */
/* bench 3579.2.3 6bef9513362f */
/* bench 3579.2.4 e883b5cbf8db */
/* bench 3579.2.5 f00f59995df0 */
/* bench 3579.2.6 e32ec81abd45 */
/* bench 3579.2.7 b42d095bde6c */
/* bench 3579.2.8 a555a14bb1cd */
/* bench 3579.2.9 192d94396a08 */
/* bench 3579.2.10 d690829854ab */
			clocks = <&clk NPCM7XX_CLK_CPU>;
			clock-names = "clk_cpu";
			reg = <0>;
			next-level-cache = <&l2>;
		};

		cpu@1 {
			device_type = "cpu";
/* bench 13833.1.0 2dd727dde41c */
/* bench 13833.1.1 2039243b1a22 */
/* bench 13833.1.2 e2101c66032c */
/* bench 13833.1.3 d6281adb3174 */
/* bench 13833.1.4 cfbb9014d4e3 */
/* bench 13833.1.5 22af62c6e954 */
/* bench 13833.1.6 c0cbe0fffc07 */
/* bench 13833.1.7 2df3950165f9 */
/* bench 13833.1.8 5a8f7e48465e */
/* bench 13833.1.9 16fba42427d4 */
/* bench 13833.1.10 aa24c8e6f045 */
/* bench 13833.1.11 bb171baff8ff */
/* bench 13833.1.12 03ccc4bc51c0 */
			compatible = "arm,cortex-a9";
			clocks = <&clk NPCM7XX_CLK_CPU>;
			clock-names = "clk_cpu";
			reg = <1>;
			next-level-cache = <&l2>;
		};
	};

	soc {
		timer@3fe600 {
			compatible = "arm,cortex-a9-twd-timer";
			reg = <0x3fe600 0x20>;
			interrupts = <GIC_PPI 13 (GIC_CPU_MASK_SIMPLE(2) |
						  IRQ_TYPE_LEVEL_HIGH)>;
			clocks = <&clk NPCM7XX_CLK_AHB>;
		};
	};
};
