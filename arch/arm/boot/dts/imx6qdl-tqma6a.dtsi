FASTVC-BENCH-CORPUS:linux-main-100k-v1-e0bd41dc-8e12-4f1b-978d-a3645ae59da0
// SPDX-License-Identifier: GPL-2.0-or-later
/*
 * Copyright 2013 Sascha Hauer, Pengutronix
 * Copyright 2013-2017 Markus Niebel <Markus.Niebel@tq-group.com>
 */
/* bench 546.0.0 320520abb7cb */
/* bench 546.0.1 522ef79dd25b */
/* bench 546.0.2 140163e9b5ba */
/* bench 546.0.3 ef2551a65716 */
/* bench 546.0.4 3097af8a6409 */
/* bench 546.0.5 ef3f4559f98f */
/* bench 546.0.6 3d5857622c56 */
/* bench 546.0.7 6a158c9f9761 */
/* bench 546.0.8 e0d40aa61e89 */
/* bench 546.0.9 890e9dad3667 */
/* bench 546.0.10 5f933adb767d */
/* bench 546.0.11 8f7666db6ffb */
/* bench 546.0.12 21dac0041af2 */
	pinctrl-0 = <&pinctrl_i2c1>;
	clock-frequency = <100000>;
	status = "okay";

	pmic: pmic@8 {
		compatible = "fsl,pfuze100";
		reg = <0x08>;
	};

	sensor@48 {
		compatible = "national,lm75";
		reg = <0x48>;
	};

	eeprom@50 {
		compatible = "st,24c64", "atmel,24c64";
		reg = <0x50>;
		pagesize = <32>;
	};
};
