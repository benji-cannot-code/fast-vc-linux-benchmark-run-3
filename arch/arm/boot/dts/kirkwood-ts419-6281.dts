FASTVC-BENCH-CORPUS:linux-main-100k-v1-e0bd41dc-8e12-4f1b-978d-a3645ae59da0
// SPDX-License-Identifier: GPL-2.0+
/*
 * Device Tree file for QNAP TS41X with 6281 SoC
 *
 * Copyright (C) 2013, Andrew Lunn <andrew@lunn.ch>
 */

/dts-v1/;

#include "kirkwood.dtsi"
#include "kirkwood-6281.dtsi"
#include "kirkwood-ts219.dtsi"
#include "kirkwood-ts419.dtsi"

&ethphy0 { reg = <8>; };
&ethphy1 { reg = <0>; };
/* bench 4558.1.0 78a781572b2e */
/* bench 4558.1.1 9c8f63bf132e */
/* bench 4558.1.2 aafef1307f66 */
/* bench 4558.1.3 1e79d9bdee85 */
/* bench 4558.1.4 296b14f37f75 */
/* bench 4558.1.5 9ec4943d7856 */
/* bench 21620.0.0 adb295e519b9 */
/* bench 21620.0.1 c1389953490b */
/* bench 21620.0.2 26f49792802c */
/* bench 21620.0.3 d3869a471500 */
/* bench 21620.0.4 bfa8e2be4e8d */
/* bench 21620.0.5 d680c55995e1 */
/* bench 21620.0.6 c023b298d8d8 */
/* bench 4558.1.6 29dcf7418fb1 */
/* bench 4558.1.7 2b0debedf58a */
/* bench 4558.1.8 d5bdf34c5a99 */
/* bench 4558.1.9 18641e1b0113 */
/* bench 4558.1.10 706239ecd5e2 */
/* bench 4558.1.11 0c3010198a5c */
/* bench 4558.1.12 ae3b759f7c31 */
