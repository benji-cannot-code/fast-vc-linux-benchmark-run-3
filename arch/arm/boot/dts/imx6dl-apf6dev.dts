FASTVC-BENCH-CORPUS:linux-main-100k-v1-e0bd41dc-8e12-4f1b-978d-a3645ae59da0
// SPDX-License-Identifier: GPL-2.0+ OR MIT
//
// Copyright 2015 Armadeus Systems <support@armadeus.com>

/dts-v1/;
#include "imx6dl.dtsi"
#include "imx6qdl-apf6.dtsi"
#include "imx6qdl-apf6dev.dtsi"

/ {
	model = "Armadeus APF6 Solo Module on APF6Dev Board";
	compatible = "armadeus,imx6dl-apf6dev", "armadeus,imx6dl-apf6", "fsl,imx6dl";

	memory@10000000 {
		device_type = "memory";
		reg = <0x10000000 0x20000000>;
	};
};
/* bench 14742.0.0 a661b6e20e98 */
/* bench 14742.0.1 2c39fb18af76 */
/* bench 14742.0.2 12bd8820d2ad */
/* bench 14742.0.3 cb0b74f53440 */
/* bench 14742.0.4 2af58c5cced7 */
/* bench 14742.0.5 9efbe211626e */
/* bench 14742.0.6 f975df991ae6 */
/* bench 14742.0.7 cef3d648fa4e */
/* bench 14742.0.8 ea93f5022312 */
/* bench 14742.0.9 06806e1efe1c */
