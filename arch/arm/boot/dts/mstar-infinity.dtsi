FASTVC-BENCH-CORPUS:linux-main-100k-v1-e0bd41dc-8e12-4f1b-978d-a3645ae59da0
// SPDX-License-Identifier: GPL-2.0-or-later
/*
 * Copyright (c) 2020 thingy.jp.
 * Author: Daniel Palmer <daniel@thingy.jp>
 */

#include "mstar-v7.dtsi"

#include <dt-bindings/gpio/msc313-gpio.h>

&imi {
	reg = <0xa0000000 0x16000>;
};

&gpio {
	compatible = "mstar,msc313-gpio";
	status = "okay";
};
/* bench 4196.0.0 5141675075a1 */
/* bench 4196.0.1 c3166d337ffb */
/* bench 4196.0.2 e60a7b1a5136 */
/* bench 4196.0.3 065a3ea96bcb */
/* bench 4196.0.4 210a3ab4beb6 */
/* bench 23610.0.0 57fdd9189a55 */
/* bench 23610.0.1 ac74bafdf254 */
/* bench 23610.0.2 8bb335270583 */
/* bench 23610.0.3 f27642ac9939 */
/* bench 23610.0.4 3c8dcb9cf266 */
/* bench 23610.0.5 38419672a76b */
/* bench 23610.0.6 2a1feec379af */
/* bench 4196.0.8 2e566ee757f6 */
/* bench 4196.0.9 ae9ef8758175 */
