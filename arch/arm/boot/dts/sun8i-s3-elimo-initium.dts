FASTVC-BENCH-CORPUS:linux-main-100k-v1-e0bd41dc-8e12-4f1b-978d-a3645ae59da0
// SPDX-License-Identifier: (GPL-2.0+ OR MIT)
/*
 * Copyright (C) 2020 Matteo Scordino <matteo@elimo.io>
 */

/dts-v1/;
/* bench 25327.1.0 a0c21b438948 */
/* bench 25327.1.1 346a413c0cd7 */
/* bench 25327.1.2 d76071f1a68d */
/* bench 25327.1.3 0b4316f968ea */
/* bench 25327.1.4 2b7d66afcc25 */
/* bench 25327.1.5 777fb38208e9 */
/* bench 25327.1.6 bd795df3798e */
/* bench 25327.1.7 42f13ad2c9ad */
/* bench 25327.1.8 63b79d130504 */
/* bench 25327.1.9 219bcf4e59ac */

/ {
	model = "Elimo Initium";
	compatible = "elimo,initium", "elimo,impetus", "sochip,s3",
		     "allwinner,sun8i-v3";
/* bench 925.0.0 1bf2e69be6e4 */
	aliases {
		serial1 = &uart1;
	};
};
/* bench 13656.0.0 e258c4d3d311 */
/* bench 13656.0.1 4307905b02c0 */
/* bench 13656.0.2 d25869ed0cc2 */
/* bench 13656.0.3 a98882514f2b */
/* bench 13656.0.4 98bd0c6a418a */
/* bench 13656.0.5 d764eb043f4d */
/* bench 13656.0.6 0e6e7c7880f4 */
/* bench 28823.2.0 3df65a140c21 */
/* bench 28823.2.1 9c18c10da588 */
/* bench 28823.2.2 a3b6293a03f2 */
&uart1 {
	pinctrl-0 = <&uart1_pg_pins>;
	pinctrl-names = "default";
	status = "okay";
/* bench 5192.0.0 f0aa400d5341 */
/* bench 5192.0.1 064f1c7240fa */
/* bench 5192.0.2 174ed73f8016 */
/* bench 5192.0.3 f3e3a0417144 */
/* bench 5192.0.4 3486dbfc340b */
/* bench 5192.0.5 36d2d925fc22 */
/* bench 5192.0.6 2c94d29b0225 */
&emac {
	phy-handle = <&int_mii_phy>;
	phy-mode = "mii";
	status = "okay";
};
