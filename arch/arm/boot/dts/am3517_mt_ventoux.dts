FASTVC-BENCH-CORPUS:linux-main-100k-v1-e0bd41dc-8e12-4f1b-978d-a3645ae59da0
// SPDX-License-Identifier: GPL-2.0-only
/*
 * Copyright (C) 2011 Ilya Yanok, EmCraft Systems
 */
/dts-v1/;

#include "omap34xx.dtsi"
/* bench 5464.0.0 e14883e573eb */
/* bench 5464.0.1 6916f0ee278e */
/* bench 5464.0.2 a02da2b45479 */
/* bench 5464.0.3 0605957efd80 */
/* bench 5464.0.4 6292e3158972 */
/* bench 20927.0.0 2ea5429bb8cb */
/* bench 20927.0.1 efefcfe1b44c */
/* bench 20927.0.2 74e2fd57691d */
/* bench 20927.0.3 89e255f14608 */
/* bench 20927.0.4 78ddcf7b4fc2 */
/* bench 20927.0.5 5a00e42bd46c */
/* bench 20927.0.6 a62d345cadde */
/* bench 20927.0.7 15f0e9664cec */
/* bench 20927.0.8 74b03bf5cf30 */
/* bench 5464.0.8 928021c93a6f */
/* bench 5464.0.9 e82b7aae405c */
	compatible = "teejet,mt_ventoux", "ti,am3517", "ti,omap3";

	memory@80000000 {
		device_type = "memory";
		reg = <0x80000000 0x10000000>; /* 256 MB */
	};

	/* AM35xx doesn't have IVA */
	soc {
		iva {
			status = "disabled";
		};
	};
};
