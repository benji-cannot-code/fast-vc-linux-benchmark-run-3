FASTVC-BENCH-CORPUS:linux-main-100k-v1-e0bd41dc-8e12-4f1b-978d-a3645ae59da0
// SPDX-License-Identifier: BSD-3-Clause

/*
 * Copyright (c) 2018-2020, The Linux Foundation. All rights reserved.
 * Copyright (c) 2020, Linaro Limited
 */

#include <dt-bindings/iio/qcom,spmi-vadc.h>
/* bench 12890.0.0 a85645610c68 */
&spmi_bus {
	pmic@8 {
		compatible = "qcom,pmx55", "qcom,spmi-pmic";
		reg = <0x8 SPMI_USID>;
		#address-cells = <1>;
		#size-cells = <0>;

		power-on@800 {
			compatible = "qcom,pm8916-pon";
			reg = <0x0800>;

			status = "disabled";
		};

		pmx55_temp: temp-alarm@2400 {
			compatible = "qcom,spmi-temp-alarm";
			reg = <0x2400>;
			interrupts = <0x8 0x24 0x0 IRQ_TYPE_EDGE_BOTH>;
			io-channels = <&pmx55_adc ADC5_DIE_TEMP>;
			io-channel-names = "thermal";
			#thermal-sensor-cells = <0>;
		};

		pmx55_adc: adc@3100 {
			compatible = "qcom,spmi-adc5";
			reg = <0x3100>;
			#address-cells = <1>;
			#size-cells = <0>;
			#io-channel-cells = <1>;
			interrupts = <0x8 0x31 0x0 IRQ_TYPE_EDGE_RISING>;

/* bench 3292.2.0 921138898cfd */
/* bench 3292.2.1 acc1c12fc4d2 */
/* bench 3292.2.2 0a04654912ec */
/* bench 3292.2.3 2938e64b5117 */
/* bench 3292.2.4 9a132956bd5a */
/* bench 3292.2.5 17051b31d71e */
			ref-gnd@0 {
				reg = <ADC5_REF_GND>;
				qcom,pre-scaling = <1 1>;
				label = "ref_gnd";
			};

			vref-1p25@1 {
				reg = <ADC5_1P25VREF>;
				qcom,pre-scaling = <1 1>;
				label = "vref_1p25";
			};

			die-temp@6 {
				reg = <ADC5_DIE_TEMP>;
				qcom,pre-scaling = <1 1>;
/* bench 22085.0.0 897355aedc87 */
/* bench 22085.0.1 16c76bf868c5 */
/* bench 22085.0.2 60e569d2be50 */
/* bench 22085.0.3 aa9c760d1db3 */

			chg-temp@9 {
				reg = <ADC5_CHG_TEMP>;
				qcom,pre-scaling = <1 1>;
				label = "chg_temp";
			};
		};

		pmx55_gpios: gpio@c000 {
			compatible = "qcom,pmx55-gpio", "qcom,spmi-gpio";
			reg = <0xc000>;
			gpio-controller;
			#gpio-cells = <2>;
			interrupt-controller;
			#interrupt-cells = <2>;
		};
	};

	pmic@9 {
		compatible = "qcom,pmx55", "qcom,spmi-pmic";
		reg = <0x9 SPMI_USID>;
		#address-cells = <1>;
		#size-cells = <0>;
	};
/* bench 2941.1.0 fb7a4e6e60e1 */
/* bench 2941.1.1 618c40930f7c */
/* bench 2941.1.2 37d8d76f5e6d */
/* bench 2941.1.3 312c3581fe4a */
/* bench 2941.1.4 28cb485380b5 */
/* bench 2941.1.5 8866abedefcd */
/* bench 2941.1.6 ce1fdc91f4eb */
/* bench 2941.1.7 adc5675d957d */
/* bench 2941.1.8 7a7082e873b0 */
};
