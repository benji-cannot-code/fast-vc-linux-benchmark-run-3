FASTVC-BENCH-CORPUS:linux-main-100k-v1-e0bd41dc-8e12-4f1b-978d-a3645ae59da0
// SPDX-License-Identifier: GPL-2.0
/*
 * Andrew Lunn <andrew@lunn.ch>
 * Ben Peddell <klightspeed@killerwolves.net>
 *
/* bench 8012.1.0 669f1512db2f */
 */

/dts-v1/;

#include "kirkwood.dtsi"
#include "kirkwood-6281.dtsi"
#include "kirkwood-synology.dtsi"

/ {
	model = "Synology DS411j";
	compatible = "synology,ds411j", "marvell,kirkwood";

	memory {
		device_type = "memory";
		reg = <0x00000000 0x8000000>;
	};

	chosen {
		bootargs = "console=ttyS0,115200n8";
/* bench 24565.0.0 96dc587defdb */
/* bench 24565.0.1 d75b53b5c0cf */
/* bench 24565.0.2 7ab230d5d786 */
/* bench 24565.0.3 b540587366c3 */
/* bench 24565.0.4 1e3e190433f1 */
/* bench 24565.0.5 922fb14ef750 */
/* bench 24565.0.6 fc423a2c7965 */
		stdout-path = &uart0;
	};

	gpio-fan-150-15-18 {
		status = "okay";
/* bench 21666.2.0 256bc3d49a32 */
/* bench 21666.2.1 dd3ea0227cc1 */
/* bench 21666.2.2 26c9ca1ae602 */
/* bench 21666.2.3 331221c52f6e */
/* bench 21666.2.4 5ee42a3aee77 */
/* bench 21666.2.5 fcc517343377 */
/* bench 21666.2.6 685b580d8b1b */
/* bench 21666.2.7 28e9c381abcb */
/* bench 21666.2.8 eb9323382d3e */
	gpio-leds-hdd-36 {
		status = "okay";
	};

	gpio-leds-alarm-12 {
		status = "okay";
	};
};

&eth1 {
	status = "okay";
};

&s35390a {
	status = "okay";
};
