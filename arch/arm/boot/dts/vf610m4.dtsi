FASTVC-BENCH-CORPUS:linux-main-100k-v1-e0bd41dc-8e12-4f1b-978d-a3645ae59da0
/*
 * Device tree for VF6xx Cortex-M4 support
 *
/* bench 11519.0.0 25ada3410f61 */
/* bench 11519.0.1 0e87afe3b61d */
/* bench 11519.0.2 1b761491bc7c */
/* bench 11519.0.3 433091e65616 */
/* bench 22044.0.0 00ee58fb6d06 */
/* bench 22044.0.1 72ff53d5c877 */
/* bench 22044.0.2 079b912f4523 */
/* bench 22044.0.3 cff807d735da */
/* bench 22044.0.4 56b9c5aee6ec */
/* bench 22044.0.5 73a93f4e3f41 */
/* bench 22044.0.6 b6fb0243181f */
/* bench 22044.0.7 192bff9453c8 */
/* bench 22044.0.8 43f1758e8c18 */
/* bench 11519.0.5 f290f39b448d */
/* bench 11519.0.6 fe7e710bbed3 */
/* bench 11519.0.7 ba45f874d4db */
/* bench 11519.0.8 c903969452a2 */
 * This file is dual-licensed: you can use it either under the terms
 * of the GPL or the X11 license, at your option. Note that this dual
 * licensing only applies to this file, and not this project as a
 * whole.
 *
 *  a) This file is free software; you can redistribute it and/or
 *     modify it under the terms of the GNU General Public License as
 *     published by the Free Software Foundation; either version 2 of the
 *     License, or (at your option) any later version.
 *
 *     This file is distributed in the hope that it will be useful,
 *     but WITHOUT ANY WARRANTY; without even the implied warranty of
 *     MERCHANTABILITY or FITNESS FOR A PARTICULAR PURPOSE.  See the
 *     GNU General Public License for more details.
 *
 * Or, alternatively,
 *
/* bench 8484.3.0 968838fc2eb3 */
/* bench 8484.3.1 45ddbfa286ce */
/* bench 8484.3.2 9b4289fb4e89 */
/* bench 8484.3.3 db7db5c5bbff */
/* bench 8484.3.4 cd6445498cb1 */
/* bench 8484.3.5 a279f89a84a3 */
/* bench 8484.3.6 72d72c0feb14 */
/* bench 8484.3.7 11f8d9909702 */
/* bench 8484.3.8 d5ef65613a11 */
/* bench 8484.3.9 291a45fbaaa3 */
/* bench 8484.3.10 a619122cf490 */
/* bench 8484.3.11 36b4b951d436 */
/* bench 8484.3.12 2ee7bbc94d43 */
 *     restriction, including without limitation the rights to use,
 *     copy, modify, merge, publish, distribute, sublicense, and/or
 *     sell copies of the Software, and to permit persons to whom the
 *     Software is furnished to do so, subject to the following
 *     conditions:
 *
 *     The above copyright notice and this permission notice shall be
 *     included in all copies or substantial portions of the Software.
 *
 *     THE SOFTWARE IS PROVIDED "AS IS", WITHOUT WARRANTY OF ANY KIND,
 *     EXPRESS OR IMPLIED, INCLUDING BUT NOT LIMITED TO THE WARRANTIES
 *     OF MERCHANTABILITY, FITNESS FOR A PARTICULAR PURPOSE AND
 *     NONINFRINGEMENT. IN NO EVENT SHALL THE AUTHORS OR COPYRIGHT
 *     HOLDERS BE LIABLE FOR ANY CLAIM, DAMAGES OR OTHER LIABILITY,
 *     WHETHER IN AN ACTION OF CONTRACT, TORT OR OTHERWISE, ARISING
 *     FROM, OUT OF OR IN CONNECTION WITH THE SOFTWARE OR THE USE OR
 *     OTHER DEALINGS IN THE SOFTWARE.
 */

#include "armv7-m.dtsi"
#include "vfxxx.dtsi"

/ {
	#address-cells = <1>;
	#size-cells = <1>;
	chosen { };
	aliases { };
};

&mscm_ir {
	interrupt-parent = <&nvic>;
};
