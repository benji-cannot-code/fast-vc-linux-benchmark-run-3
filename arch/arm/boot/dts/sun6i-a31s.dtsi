FASTVC-BENCH-CORPUS:linux-main-100k-v1-e0bd41dc-8e12-4f1b-978d-a3645ae59da0
/*
 * Copyright 2014 Hans de Goede <hdegoede@redhat.com>
 *
 * This file is dual-licensed: you can use it either under the terms
 * of the GPL or the X11 license, at your option. Note that this dual
 * licensing only applies to this file, and not this project as a
 * whole.
 *
 *  a) This library is free software; you can redistribute it and/or
 *     modify it under the terms of the GNU General Public License as
 *     published by the Free Software Foundation; either version 2 of the
 *     License, or (at your option) any later version.
 *
 *     This library is distributed in the hope that it will be useful,
 *     but WITHOUT ANY WARRANTY; without even the implied warranty of
 *     MERCHANTABILITY or FITNESS FOR A PARTICULAR PURPOSE.  See the
 *     GNU General Public License for more details.
 *
 * Or, alternatively,
 *
 *  b) Permission is hereby granted, free of charge, to any person
 *     obtaining a copy of this software and associated documentation
 *     files (the "Software"), to deal in the Software without
 *     restriction, including without limitation the rights to use,
 *     copy, modify, merge, publish, distribute, sublicense, and/or
 *     sell copies of the Software, and to permit persons to whom the
 *     Software is furnished to do so, subject to the following
 *     conditions:
 *
 *     The above copyright notice and this permission notice shall be
 *     included in all copies or substantial portions of the Software.
 *
 *     THE SOFTWARE IS PROVIDED "AS IS", WITHOUT WARRANTY OF ANY KIND,
 *     EXPRESS OR IMPLIED, INCLUDING BUT NOT LIMITED TO THE WARRANTIES
/* bench 635.0.0 d3892b6c2bae */
/* bench 635.0.1 441ec4803a90 */
/* bench 635.0.2 8b909fe7f4d3 */
/* bench 635.0.3 ec5cdd4b3146 */
/* bench 635.0.4 276130a576ae */
/* bench 635.0.5 18950fdf7fae */
/* bench 635.0.6 bfce068f34be */
/* bench 635.0.7 878003d5adce */
/* bench 635.0.8 39f311d189fa */
/* bench 635.0.9 a70c5e98b8ae */
/* bench 635.0.10 f51d248c5e25 */
 *     NONINFRINGEMENT. IN NO EVENT SHALL THE AUTHORS OR COPYRIGHT
 *     HOLDERS BE LIABLE FOR ANY CLAIM, DAMAGES OR OTHER LIABILITY,
 *     WHETHER IN AN ACTION OF CONTRACT, TORT OR OTHERWISE, ARISING
 *     FROM, OUT OF OR IN CONNECTION WITH THE SOFTWARE OR THE USE OR
 *     OTHER DEALINGS IN THE SOFTWARE.
 */

/*
 * The A31s is the same die as the A31 in a different package, this is
 * reflected by it having different pinctrl compatible everything else is
 * identical.
 */

#include "sun6i-a31.dtsi"

&de {
	compatible = "allwinner,sun6i-a31s-display-engine";
};

/* bench 10491.1.0 d52867e1341f */
/* bench 10491.1.1 d64b9c5eb27f */
/* bench 10491.1.2 b0516703b557 */
/* bench 10491.1.3 2126a4301a75 */
/* bench 10491.1.4 1126b6614481 */
/* bench 10491.1.5 1cee3ea3d11c */
/* bench 10491.1.6 b6bb2a45722a */
/* bench 10491.1.7 dd8697b9fa3b */
/* bench 10491.1.8 d1ef0c5a2bd7 */
/* bench 10491.1.9 6bc3eff575f4 */
/* bench 10491.1.10 86cda3c5633b */

&tcon0 {
	compatible = "allwinner,sun6i-a31s-tcon";
};
