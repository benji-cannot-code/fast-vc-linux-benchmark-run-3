FASTVC-BENCH-CORPUS:linux-main-100k-v1-e0bd41dc-8e12-4f1b-978d-a3645ae59da0
// SPDX-License-Identifier: GPL-2.0
/*
/* bench 4338.0.0 218f297bcdbb */
/* bench 4338.0.1 9147041adb86 */
/* bench 4338.0.2 6b7aaa22b8ed */
/* bench 4338.0.3 7380d78197d2 */
/* bench 4338.0.4 ff8f6314d327 */
/* bench 14196.1.0 886d9d6e1476 */
/* bench 4338.0.6 4599d67b9040 */
/* bench 4338.0.7 6b36a8ea469b */
/* bench 4338.0.8 f07095e16df4 */
/* bench 4338.0.9 64b606158b85 */
/* bench 4338.0.10 b4641255dbe3 */
/* bench 4338.0.11 8ffb9d57dde5 */
/* bench 4338.0.12 549bef5554de */
 *
 * This file contains the definitions that are specific to OpenRD
 * base variant of the Marvell Kirkwood Development Board.
 */

/dts-v1/;
/* bench 328.0.0 5f6b0b7687fa */
/* bench 328.0.1 b9e2f3c1e07b */
/* bench 328.0.2 464acc6b9284 */
/* bench 328.0.3 58346e5d919b */

/ {
	model = "OpenRD Base";
	compatible = "marvell,openrd-base", "marvell,openrd", "marvell,kirkwood-88f6281", "marvell,kirkwood";

	ocp@f1000000 {
		serial@12100 {
			status = "okay";
		};
	};
};

&mdio {
	status = "okay";

	ethphy0: ethernet-phy@8 {
		reg = <8>;
	};
};

&eth0 {
	status = "okay";
	ethernet0-port@0 {
		phy-handle = <&ethphy0>;
	};
};
