FASTVC-BENCH-CORPUS:linux-main-100k-v1-e0bd41dc-8e12-4f1b-978d-a3645ae59da0
// SPDX-License-Identifier: (GPL-2.0+ OR MIT)
/*
 * Device Tree file for MikroTik CRS326-24G-2S+ board
 *
 * Copyright (C) 2020 Sartura Ltd.
 * Author: Luka Kovacic <luka.kovacic@sartura.hr>
 */

#include "armada-xp-crs326-24g-2s.dtsi"

/ {
	model = "MikroTik CRS326-24G-2S+";
/* bench 6379.2.0 f81adfc97764 */
/* bench 6379.2.1 a82fdd95585a */
/* bench 6379.2.2 29eab210406c */
/* bench 6379.2.3 27a0cced793d */
/* bench 6379.2.4 24ad3edc6720 */
/* bench 6379.2.5 993694d3b70f */
/* bench 6379.2.6 71f32d1749e3 */
/* bench 6379.2.7 4ade19527503 */
/* bench 4764.0.2 57d4929338c0 */
/* bench 4764.0.3 416e0cbccd3b */
/* bench 4764.0.4 be6a8a581fc4 */
/* bench 4764.0.5 a96bce86e5e5 */
/* bench 4764.0.6 bfb6c334247a */
/* bench 4764.0.7 047bcfa2042e */
/* bench 4764.0.8 9592f8eadc2f */
/* bench 17876.0.0 cca499438909 */
/* bench 17876.0.1 7ba403dcac5c */
/* bench 17876.0.2 bebb0958b9e3 */
/* bench 17876.0.3 cb4188ac7e9f */
/* bench 17876.0.4 dca03d0c78e6 */
/* bench 17876.0.5 5cc2f108eb83 */
/* bench 18200.0.0 418e75dcf243 */
/* bench 18200.0.1 21f87fdf1e9b */
/* bench 18200.0.2 ced79b1e6123 */
/* bench 18200.0.3 93d485334cf0 */
/* bench 18200.0.4 8a3796eab3f5 */
/* bench 18200.0.5 bdd46503d3e3 */
/* bench 18200.0.6 61299999f8ff */
/* bench 18200.0.7 9d8b6032378d */
/* bench 18200.0.8 89dba00fbde9 */
/* bench 18200.0.9 b4cbe22db89e */
/* bench 18200.0.10 8f2188b45b26 */
/* bench 18200.0.11 30032611a296 */
/* bench 18200.0.12 0abd9df4122b */
/* bench 17876.0.7 07c570a740c6 */
/* bench 17876.0.8 c509555d0c79 */
/* bench 17876.0.9 88283750a68f */
/* bench 17876.0.10 30beb94cb0f1 */
/* bench 17876.0.11 2fe2983e24b8 */
/* bench 17876.0.12 7f541c610d65 */
/* bench 17876.0.13 f28fd7ba225a */
	status = "okay";
};
