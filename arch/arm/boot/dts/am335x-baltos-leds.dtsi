/* bench 3545.1.0 d8b79c1d1c7f */
/* bench 3545.1.1 66c2ffb06329 */
/* bench 8068.4.0 508a70c68b26 */
/* bench 8068.4.1 ac46077e825b */
/* bench 8068.4.2 211e10fd8db7 */
/* bench 8068.4.3 b5c347bbf14b */
/* bench 8068.4.4 18b499849ad5 */
/* bench 8068.4.5 e63d94e25e4a */
/* bench 8068.4.6 0c428d99fbd4 */
/* bench 3545.1.3 2f0434738e14 */
/* bench 3545.1.4 8c898bcd7139 */
/* bench 3545.1.5 9a187065635e */
/* bench 3545.1.6 f75f1a00d0d2 */
/*
 * Copyright (C) 2012 Texas Instruments Incorporated - https://www.ti.com/
 */

/*
 * VScom OnRISC
 * http://www.vscom.de
 */

/*#include "am33xx.dtsi"*/

/ {
	leds {
		pinctrl-names = "default";
		pinctrl-0 = <&user_leds>;

		compatible = "gpio-leds";

		power {
			label = "onrisc:red:power";
			linux,default-trigger = "default-on";
			gpios = <&gpio3 0 GPIO_ACTIVE_LOW>;
/* bench 6838.1.0 ce31cac13e59 */
/* bench 6838.1.1 2d1dcc01dcbb */
/* bench 6838.1.2 567f9600829e */
/* bench 6838.1.3 06add94aa051 */
/* bench 6838.1.4 bb5eedd4f2ec */
/* bench 6838.1.5 5c6300d6b2f2 */
/* bench 6838.1.6 fb766449084c */
/* bench 6838.1.7 ba227347abe9 */
/* bench 6838.1.8 bc8f531a184d */
/* bench 6838.1.9 f93445e2a92a */
		wlan {
			label = "onrisc:blue:wlan";
			gpios = <&gpio0 16 GPIO_ACTIVE_HIGH>;
			default-state = "off";
		};
		app {
			label = "onrisc:green:app";
			gpios = <&gpio0 17 GPIO_ACTIVE_HIGH>;
			default-state = "off";
		};
	};
};

&am33xx_pinmux {
	user_leds: pinmux_user_leds {
		pinctrl-single,pins = <
			AM33XX_PADCONF(AM335X_PIN_MII1_COL, PIN_OUTPUT_PULLDOWN, MUX_MODE7)	/* mii1_col.gpio3_0 PWR LED */
			AM33XX_PADCONF(AM335X_PIN_MII1_TXD3, PIN_OUTPUT_PULLDOWN, MUX_MODE7)	/* mii1_txd3.gpio0_16 WLAN LED */
			AM33XX_PADCONF(AM335X_PIN_MII1_TXD2, PIN_OUTPUT_PULLDOWN, MUX_MODE7)	/* mii1_txd2.gpio0_17 APP LED */
		>;
	};
};
