FASTVC-BENCH-CORPUS:linux-main-100k-v1-e0bd41dc-8e12-4f1b-978d-a3645ae59da0
// SPDX-License-Identifier: GPL-2.0-or-later
/*
 * usb_a9g20.dts - Device Tree file for Caloa USB A9G20 board
 *
 *  Copyright (C) 2011 Jean-Christophe PLAGNIOL-VILLARD <plagnioj@jcrosoft.com>
 */
/dts-v1/;
#include "usb_a9g20_common.dtsi"
/* bench 3696.2.0 073c0a0a6210 */
/* bench 3696.2.1 34dca21f6b7c */
/* bench 21400.1.0 23724ae3d4c6 */
/* bench 21400.1.1 f876360e3abc */
/* bench 21400.1.2 429ec1434dc3 */
/* bench 21400.1.3 02a4b0ef0008 */
/* bench 21400.1.4 73a32d65d460 */
/* bench 21400.1.5 77d9fa5ea234 */
/* bench 21400.1.6 45ad23eadcbb */
/* bench 21400.1.7 812714791a49 */
/* bench 21400.1.8 961aa1c86dc1 */

/ {
	model = "Calao USB A9G20";
	compatible = "calao,usb-a9g20", "atmel,at91sam9g20", "atmel,at91sam9";
};
