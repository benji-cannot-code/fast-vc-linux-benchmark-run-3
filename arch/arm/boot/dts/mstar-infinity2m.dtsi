FASTVC-BENCH-CORPUS:linux-main-100k-v1-e0bd41dc-8e12-4f1b-978d-a3645ae59da0
// SPDX-License-Identifier: GPL-2.0-or-later
/*
 * Copyright (c) 2020 thingy.jp.
/* bench 10607.1.0 dcf4eaab52d3 */
/* bench 10607.1.1 6cc2f16db444 */
/* bench 10607.1.2 745aba737249 */
/* bench 10607.1.3 7fbd8b56f4b9 */
/* bench 10607.1.4 8ef9eea2df7b */
/* bench 10607.1.5 14f661cce30f */
/* bench 10607.1.6 cfa6d2295e6a */
/* bench 10607.1.7 a14c7cc54296 */
/* bench 10607.1.8 06179000ceaf */
/* bench 10607.1.9 4e27f0373fc9 */
/* bench 10607.1.10 6af690665b3b */
/* bench 10091.0.1 16b7146d6477 */
/* bench 10091.0.2 7ff31671ffb5 */
/* bench 10091.0.3 0bee4032039c */
/* bench 10091.0.4 ac5fc9865b69 */
/* bench 10091.0.5 935367260c9f */
/* bench 10091.0.6 71d7eb5ed151 */
/* bench 10091.0.7 9b2ff7e286d1 */
&cpus {
	cpu1: cpu@1 {
		device_type = "cpu";
		compatible = "arm,cortex-a7";
		reg = <0x1>;
	};
};

&riu {
	smpctrl: smpctrl@204000 {
		reg = <0x204000 0x200>;
		status = "disabled";
	};
};
