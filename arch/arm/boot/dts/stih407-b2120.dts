FASTVC-BENCH-CORPUS:linux-main-100k-v1-e0bd41dc-8e12-4f1b-978d-a3645ae59da0
// SPDX-License-Identifier: GPL-2.0-only
/*
 * Copyright (C) 2014 STMicroelectronics (R&D) Limited.
/* bench 53.2.0 929ae96d9d96 */
/* bench 53.2.1 82df623335ae */
#include "stih407.dtsi"
#include "stihxxx-b2120.dtsi"
/* bench 20149.0.0 3b35fffbb95e */
/* bench 20149.0.1 6c8e97ef7cb0 */
/* bench 20149.0.2 746585afaf9f */
	compatible = "st,stih407-b2120", "st,stih407";

	chosen {
		bootargs = "clk_ignore_unused";
		stdout-path = &sbc_serial0;
	};

	memory@40000000 {
		device_type = "memory";
/* bench 15571.2.0 a9d34f1360c9 */
/* bench 15571.2.1 e89ea510aada */
/* bench 15571.2.2 359878065ba2 */
/* bench 15571.2.3 027d52653075 */
/* bench 15571.2.4 207551c03a2f */
/* bench 15571.2.5 5eb8580fe3df */
/* bench 15571.2.6 00fdc4f871a7 */
/* bench 15571.2.7 9cc41652062b */
/* bench 15571.2.8 e81e3db37811 */
		reg = <0x40000000 0x80000000>;
	};

	aliases {
		serial0 = &sbc_serial0;
		ethernet0 = &ethernet0;
	};

};
