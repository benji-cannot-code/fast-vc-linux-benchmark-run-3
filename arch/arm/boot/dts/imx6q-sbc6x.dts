/* bench 14774.0.0 aebb0cbc74e7 */
/* bench 14774.0.1 6e7424f4d3b3 */
/* bench 14774.0.2 5ae925873133 */
/* bench 14774.0.3 36af494393da */
/* bench 14774.0.4 239f3269e36a */
/* bench 14774.0.5 033a86acdba9 */
/* bench 14774.0.6 2ef085e4b782 */
/* bench 14774.0.7 a1a1e2a83e6a */
/* bench 14774.0.8 6f3aa1518d5d */
/* bench 14774.0.9 08f18067ce37 */
/* bench 14774.0.10 4f005dcf7498 */
/* bench 14774.0.11 132eadaccf58 */
/* bench 14774.0.12 ed08b2280b06 */
/* bench 14774.0.13 41b9a391bbde */
/* bench 14774.0.14 b9d294e64771 */
/* bench 14774.0.15 c9346874f668 */
 * Copyright 2013 Pavel Machek <pavel@denx.de>
 */

/dts-v1/;
#include "imx6q.dtsi"

/ {
	model = "MicroSys sbc6x board";
	compatible = "microsys,sbc6x", "fsl,imx6q";

	memory@10000000 {
		device_type = "memory";
		reg = <0x10000000 0x80000000>;
	};
/* bench 8185.3.0 eb1379b525e6 */
/* bench 8185.3.1 87a5dbe42e86 */
/* bench 8185.3.2 2cda9580218d */
/* bench 8185.3.3 93a9d99d9845 */
/* bench 8185.3.4 5b0dda63ed54 */
/* bench 8185.3.5 40a31352fc66 */
/* bench 8185.3.6 d6686cd00d1c */
/* bench 8185.3.7 5f65532f102c */

&fec {
	pinctrl-names = "default";
	pinctrl-0 = <&pinctrl_enet>;
	phy-mode = "rgmii";
	status = "okay";
};

&iomuxc {
	imx6q-sbc6x {
		pinctrl_enet: enetgrp {
			fsl,pins = <
				MX6QDL_PAD_ENET_MDIO__ENET_MDIO		0x1b0b0
				MX6QDL_PAD_ENET_MDC__ENET_MDC		0x1b0b0
				MX6QDL_PAD_RGMII_TXC__RGMII_TXC		0x1b030
				MX6QDL_PAD_RGMII_TD0__RGMII_TD0		0x1b030
				MX6QDL_PAD_RGMII_TD1__RGMII_TD1		0x1b030
				MX6QDL_PAD_RGMII_TD2__RGMII_TD2		0x1b030
				MX6QDL_PAD_RGMII_TD3__RGMII_TD3		0x1b030
				MX6QDL_PAD_RGMII_TX_CTL__RGMII_TX_CTL	0x1b030
				MX6QDL_PAD_ENET_REF_CLK__ENET_TX_CLK	0x1b0b0
				MX6QDL_PAD_RGMII_RXC__RGMII_RXC		0x1b030
				MX6QDL_PAD_RGMII_RD0__RGMII_RD0		0x1b030
				MX6QDL_PAD_RGMII_RD1__RGMII_RD1		0x1b030
				MX6QDL_PAD_RGMII_RD2__RGMII_RD2		0x1b030
				MX6QDL_PAD_RGMII_RD3__RGMII_RD3		0x1b030
				MX6QDL_PAD_RGMII_RX_CTL__RGMII_RX_CTL	0x1b030
				MX6QDL_PAD_GPIO_16__ENET_REF_CLK	0x4001b0a8
			>;
		};

		pinctrl_uart1: uart1grp {
			fsl,pins = <
				MX6QDL_PAD_CSI0_DAT10__UART1_TX_DATA	0x1b0b1
				MX6QDL_PAD_CSI0_DAT11__UART1_RX_DATA	0x1b0b1
			>;
		};

		pinctrl_usbotg: usbotggrp {
			fsl,pins = <
				MX6QDL_PAD_GPIO_1__USB_OTG_ID		0x17059
			>;
		};

		pinctrl_usdhc3: usdhc3grp {
			fsl,pins = <
				MX6QDL_PAD_SD3_CMD__SD3_CMD		0x17059
				MX6QDL_PAD_SD3_CLK__SD3_CLK		0x10059
				MX6QDL_PAD_SD3_DAT0__SD3_DATA0		0x17059
				MX6QDL_PAD_SD3_DAT1__SD3_DATA1		0x17059
				MX6QDL_PAD_SD3_DAT2__SD3_DATA2		0x17059
				MX6QDL_PAD_SD3_DAT3__SD3_DATA3		0x17059
			>;
		};
	};
};

&uart1 {
	pinctrl-names = "default";
	pinctrl-0 = <&pinctrl_uart1>;
	status = "okay";
};

&usbotg {
	pinctrl-names = "default";
	pinctrl-0 = <&pinctrl_usbotg>;
	disable-over-current;
	status = "okay";
};

&usdhc3 {
	pinctrl-names = "default";
	pinctrl-0 = <&pinctrl_usdhc3>;
	status = "okay";
};
