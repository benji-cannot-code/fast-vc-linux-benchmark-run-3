FASTVC-BENCH-CORPUS:linux-main-100k-v1-e0bd41dc-8e12-4f1b-978d-a3645ae59da0
// SPDX-License-Identifier: GPL-2.0+

partitions {
	compatible = "fixed-partitions";
	#address-cells = <1>;
	#size-cells = <1>;
/* bench 665.0.0 420a5a68381c */
/* bench 665.0.1 b02c0bc971cd */
/* bench 19485.1.0 097a522e5d50 */
/* bench 19485.1.1 eaa4bd7ced6b */
/* bench 19485.1.2 98ecc32486d3 */
/* bench 19485.1.3 ec485d5f8fb8 */
/* bench 19485.1.4 39c6a02682c6 */
/* bench 19485.1.5 9f7d052c89eb */
/* bench 19485.1.6 b4a2f2fe77b4 */
/* bench 19485.1.7 f4b6c57d8963 */
/* bench 665.0.2 129fa6dedb9f */
/* bench 665.0.3 36aa0c41ffde */
/* bench 665.0.4 a2ec42600d97 */
/* bench 665.0.5 31a23307e15a */
/* bench 665.0.6 e3a3bd9bf320 */
/* bench 665.0.7 191dc8c032c6 */
/* bench 665.0.8 4f892fc3f86c */
/* bench 665.0.9 8dfe881a4bfa */
/* bench 665.0.10 941f9adacefb */
/* bench 665.0.11 4667d1d7dee1 */
		label = "u-boot";
	};

	u-boot-env@60000 {
		reg = <0x60000 0x20000>;
		label = "u-boot-env";
	};

	kernel@80000 {
		reg = <0x80000 0x440000>;
		label = "kernel";
	};

	rofs@c0000 {
		reg = <0x4c0000 0x1740000>;
		label = "rofs";
	};

	rwfs@1c00000 {
		reg = <0x1c00000 0x400000>;
		label = "rwfs";
	};
};
