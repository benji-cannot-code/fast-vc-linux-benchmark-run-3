FASTVC-BENCH-CORPUS:linux-main-100k-v1-e0bd41dc-8e12-4f1b-978d-a3645ae59da0
/*
 * Copyright (C) 2012 Texas Instruments Incorporated - http://www.ti.com/
 *
 * This program is free software; you can redistribute it and/or modify
 * it under the terms of the GNU General Public License version 2 as
 * published by the Free Software Foundation.
 */
/dts-v1/;

/include/ "omap2.dtsi"

/ {
	model = "TI OMAP2420 H4 board";
	compatible = "ti,omap2420-h4", "ti,omap2420", "ti,omap2";

	memory {
		device_type = "memory";
		reg = <0x80000000 0x84000000>; /* 64 MB */
	};
};
