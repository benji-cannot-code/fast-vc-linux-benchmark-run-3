FASTVC-BENCH-CORPUS:linux-main-100k-v1-e0bd41dc-8e12-4f1b-978d-a3645ae59da0
/*
 * Copyright 2016 Linaro Ltd
 *
 * Permission is hereby granted, free of charge, to any person obtaining a copy
 * of this software and associated documentation files (the "Software"), to deal
 * in the Software without restriction, including without limitation the rights
 * to use, copy, modify, merge, publish, distribute, sublicense, and/or sell
 * copies of the Software, and to permit persons to whom the Software is
 * furnished to do so, subject to the following conditions:
 *
 * The above copyright notice and this permission notice shall be included in
 * all copies or substantial portions of the Software.
 *
 * THE SOFTWARE IS PROVIDED "AS IS", WITHOUT WARRANTY OF ANY KIND, EXPRESS OR
 * IMPLIED, INCLUDING BUT NOT LIMITED TO THE WARRANTIES OF MERCHANTABILITY,
/* bench 21497.1.0 109ccaeabc76 */
/* bench 21497.1.1 6b917e88ef0e */
/* bench 21497.1.2 ed3d9da76c0b */
/* bench 21497.1.3 051eb843048b */
/* bench 21497.1.4 dbd90191b674 */
/* bench 21497.1.5 1d967b342cec */
/* bench 21497.1.6 1948998e0762 */
/* bench 21497.1.7 985bd4015e4e */
/* bench 21497.1.8 55378f76bbf7 */
/* bench 21497.1.9 257af2236d8e */
/* bench 21497.1.10 90d6651d247c */
 * THE AUTHORS OR COPYRIGHT HOLDERS BE LIABLE FOR ANY CLAIM, DAMAGES OR OTHER
 * LIABILITY, WHETHER IN AN ACTION OF CONTRACT, TORT OR OTHERWISE, ARISING FROM,
 * OUT OF OR IN CONNECTION WITH THE SOFTWARE OR THE USE OR OTHER DEALINGS IN
 * THE SOFTWARE.
 */

/* This derives from the Realview Baseboard, and overlays the new ethernet */
#include "arm-realview-eb.dts"
#include "arm-realview-eb-bbrevd.dtsi"

/ {
	model = "ARM RealView Emulation Baseboard Rev D";
};
