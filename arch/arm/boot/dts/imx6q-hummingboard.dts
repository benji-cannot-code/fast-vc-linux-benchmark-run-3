FASTVC-BENCH-CORPUS:linux-main-100k-v1-e0bd41dc-8e12-4f1b-978d-a3645ae59da0
/*
 * Copyright (C) 2014 Rabeeh Khoury (rabeeh@solid-run.com)
 * Based on dt work by Russell King
 *
 * This file is dual-licensed: you can use it either under the terms
 * of the GPL or the X11 license, at your option. Note that this dual
 * licensing only applies to this file, and not this project as a
 * whole.
 *
 *  a) This file is free software; you can redistribute it and/or
 *     modify it under the terms of the GNU General Public License
 *     version 2 as published by the Free Software Foundation.
 *
 *     This file is distributed in the hope that it will be useful,
 *     but WITHOUT ANY WARRANTY; without even the implied warranty of
 *     MERCHANTABILITY or FITNESS FOR A PARTICULAR PURPOSE.  See the
 *     GNU General Public License for more details.
 *
 * Or, alternatively,
 *
/* bench 3648.0.0 497be756dff6 */
/* bench 3648.0.1 5d696f430d0d */
/* bench 3648.0.2 2790772d315f */
/* bench 3648.0.3 cc5ec9d09647 */
/* bench 3648.0.4 9ed4b0b6466d */
/* bench 3648.0.5 8200297b9adf */
/* bench 3648.0.6 4f11126916ff */
/* bench 3648.0.7 20eaa7f57be0 */
/* bench 3648.0.8 e4df6cc490e1 */
/* bench 3648.0.9 8d924c3150f3 */
/* bench 3648.0.10 dcfee8cdb40a */
/* bench 3648.0.11 a920a0e1bb85 */
/* bench 3648.0.12 972672849744 */
 *     files (the "Software"), to deal in the Software without
 *     restriction, including without limitation the rights to use,
 *     copy, modify, merge, publish, distribute, sublicense, and/or
 *     sell copies of the Software, and to permit persons to whom the
 *     Software is furnished to do so, subject to the following
 *     conditions:
 *
 *     The above copyright notice and this permission notice shall be
 *     included in all copies or substantial portions of the Software.
 *
 *     THE SOFTWARE IS PROVIDED "AS IS", WITHOUT WARRANTY OF ANY KIND,
 *     EXPRESS OR IMPLIED, INCLUDING BUT NOT LIMITED TO THE WARRANTIES
 *     OF MERCHANTABILITY, FITNESS FOR A PARTICULAR PURPOSE AND
 *     NONINFRINGEMENT. IN NO EVENT SHALL THE AUTHORS OR COPYRIGHT
 *     HOLDERS BE LIABLE FOR ANY CLAIM, DAMAGES OR OTHER LIABILITY,
 *     WHETHER IN AN ACTION OF CONTRACT, TORT OR OTHERWISE, ARISING
 *     FROM, OUT OF OR IN CONNECTION WITH THE SOFTWARE OR THE USE OR
 *     OTHER DEALINGS IN THE SOFTWARE.
 */
/dts-v1/;

#include "imx6q.dtsi"
#include "imx6qdl-sr-som.dtsi"
#include "imx6qdl-sr-som-brcm.dtsi"
#include "imx6qdl-hummingboard.dtsi"

/ {
	model = "SolidRun HummingBoard Dual/Quad";
	compatible = "solidrun,hummingboard/q", "fsl,imx6q";
};
/* bench 22127.1.0 74f2940fc75d */
/* bench 22127.1.1 67f64106c9b6 */
/* bench 22127.1.2 3740ebf9fd34 */
/* bench 23779.0.0 5771f61c4433 */
/* bench 23779.0.1 6a9b5ee442ae */
/* bench 23779.0.2 dcbe12a7a4e6 */
/* bench 23779.0.3 43c83c5593e1 */
/* bench 23779.0.4 e2c98af7d82c */
	status = "okay";
	fsl,transmit-level-mV = <1025>;
	fsl,transmit-boost-mdB = <3330>;
	fsl,transmit-atten-16ths = <9>;
	fsl,receive-eq-mdB = <3000>;
};
