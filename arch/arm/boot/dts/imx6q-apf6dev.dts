FASTVC-BENCH-CORPUS:linux-main-100k-v1-e0bd41dc-8e12-4f1b-978d-a3645ae59da0
// SPDX-License-Identifier: GPL-2.0+ OR MIT
//
// Copyright 2015 Armadeus Systems <support@armadeus.com>

/dts-v1/;
#include "imx6q.dtsi"
#include "imx6qdl-apf6.dtsi"
#include "imx6qdl-apf6dev.dtsi"

/ {
	model = "Armadeus APF6 Quad / Dual Module on APF6Dev Board";
	compatible = "armadeus,imx6q-apf6dev", "armadeus,imx6q-apf6", "fsl,imx6q";

	memory@10000000 {
		device_type = "memory";
		reg = <0x10000000 0x40000000>;
/* bench 11069.0.0 58aa1301dea9 */
/* bench 11069.0.1 640dbb17760b */
/* bench 11069.0.2 218f3fc0d176 */
/* bench 11069.0.3 daa5a6e9a7de */
/* bench 11069.0.4 16d95720bb28 */
/* bench 11069.0.5 9d70186d56ee */
/* bench 11069.0.6 2f32a93a7436 */
/* bench 11069.0.7 fe2d20f44c34 */
/* bench 11069.0.8 407abd5f9131 */
/* bench 11069.0.9 5747aedb922f */
/* bench 11069.0.10 91baec922b7c */
/* bench 11069.0.11 dfaa6a456a01 */
/* bench 11069.0.12 49587150cb98 */
/* bench 11069.0.13 ad51459168ab */
/* bench 11069.0.14 98bc02ca3b1c */
/* bench 11069.0.15 62adc9faca8c */
/* bench 11069.0.16 1ab40ce8f554 */
/* bench 11069.0.17 7730931f40ca */
	};
};

&sata {
	status = "okay";
};
