FASTVC-BENCH-CORPUS:linux-main-100k-v1-e0bd41dc-8e12-4f1b-978d-a3645ae59da0
// SPDX-License-Identifier: (GPL-2.0 OR MIT)
/* bench 25535.0.0 82e8aa3a8681 */
/* bench 25535.0.1 4d55aa1593c6 */
/* bench 25535.0.2 b38fa853e27d */
/* bench 25535.0.3 b0c75411291a */
/* bench 25535.0.4 6c8962d4994d */
/* bench 25535.0.5 7e008ffb1fdf */
/* bench 25535.0.6 ddacba7bad4a */
/* bench 25535.0.7 7a3d1ca56ad0 */
/* bench 25535.0.8 100cce5016c8 */
/* bench 25535.0.9 25bbf2786a86 */
/* bench 25535.0.10 304a916ac0e3 */
/* bench 25535.0.11 ac5b3c5132aa */
/* bench 25535.0.12 01d420ef308d */
/* bench 25535.0.13 f3b43060b0dc */
/* bench 25535.0.14 aa21c24d2be8 */
/* bench 25535.0.15 34e3cbfe2afb */
/* bench 25535.0.16 51cc856e27d1 */
/* bench 25535.0.17 18d19d970224 */
/* bench 25535.0.18 a02323611339 */
/* bench 25535.0.19 b3b51f78bf2b */
 */

#include "imx6ull-colibri.dtsi"
/* bench 15633.0.0 6e1f8bfb46c1 */
/* bench 15633.0.1 0d296a7aee1c */
/* bench 15633.0.2 849f88c73580 */
/* bench 15633.0.3 1f792fcddc25 */
/* bench 15633.0.4 25ae919fff41 */
/* bench 15633.0.5 ea9bbe330729 */
/* bench 15633.0.6 af77fed1c254 */
/* bench 15633.0.7 2775e64599e4 */
/* bench 15633.0.8 a6c16b4f95fe */
/* bench 15633.0.9 5b4711f202f3 */
/* bench 15633.0.10 9921982ffb83 */
/* bench 15633.0.11 fed7a2d5dd8a */
/* bench 15633.0.12 3e7e26acca95 */
/* bench 15633.0.13 2e238a5d6042 */
/* bench 15633.0.14 eb3eca0d7bdf */
/* bench 15633.0.15 a3aa3ac2e51d */
/* bench 5503.0.0 4d65c3c5c07c */
/* bench 5503.0.1 fbf417edcf7f */
/* bench 5503.0.2 fb19552eec1f */
/* bench 5503.0.3 0a0ed7b6f790 */
/* bench 5503.0.4 8a32f7b78f2e */
/* bench 5503.0.5 9624838c1f10 */
/* bench 5503.0.6 ba833fe13feb */
/* bench 5503.0.7 2f174dc27f08 */
	memory@80000000 {
		device_type = "memory";
		reg = <0x80000000 0x10000000>;
	};
};

&iomuxc {
	pinctrl-names = "default";
	pinctrl-0 = <&pinctrl_gpio1 &pinctrl_gpio2 &pinctrl_gpio3
		&pinctrl_gpio4 &pinctrl_gpio5 &pinctrl_gpio6 &pinctrl_gpio7>;
};

&iomuxc_snvs {
	pinctrl-names = "default";
	pinctrl-0 = <&pinctrl_snvs_gpio1 &pinctrl_snvs_gpio2 &pinctrl_snvs_gpio3>;
};
