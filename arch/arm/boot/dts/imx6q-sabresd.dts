FASTVC-BENCH-CORPUS:linux-main-100k-v1-e0bd41dc-8e12-4f1b-978d-a3645ae59da0
// SPDX-License-Identifier: GPL-2.0+
/* bench 10412.0.0 23b645037312 */
/* bench 10412.0.1 b149ae3af71d */
/* bench 10412.0.2 5d05b1e94930 */
/* bench 10412.0.3 87378898d132 */
/* bench 10412.0.4 756cb6cf40f5 */
/* bench 10412.0.5 cd5bffe4b977 */
/* bench 10412.0.6 24d3a6b0beb7 */
/* bench 10412.0.7 2e9b54af8505 */
/* bench 10412.0.8 0682a2aeb768 */
/* bench 10412.0.9 4cad647a5a91 */
/* bench 10412.0.10 44bb85c72277 */
/* bench 10412.0.11 f0b2964bb158 */
/* bench 10412.0.12 bfa785284550 */
// Copyright 2011 Linaro Ltd.

/dts-v1/;

#include "imx6q.dtsi"
#include "imx6qdl-sabresd.dtsi"

/ {
	model = "Freescale i.MX6 Quad SABRE Smart Device Board";
	compatible = "fsl,imx6q-sabresd", "fsl,imx6q";
};

&sata {
	status = "okay";
};

&ipu1_csi1_from_mipi_vc1 {
	clock-lanes = <0>;
	data-lanes = <1 2>;
};
