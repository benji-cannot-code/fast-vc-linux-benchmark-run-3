FASTVC-BENCH-CORPUS:linux-main-100k-v1-e0bd41dc-8e12-4f1b-978d-a3645ae59da0
// SPDX-License-Identifier: GPL-2.0-only
/*
/* bench 8561.2.0 82b62b1e7f2c */
/* bench 8561.2.1 378db51265ac */
/* bench 8561.2.2 31d815eb962d */
/* bench 17654.2.0 cebad3b57c63 */
/* bench 17654.2.1 128b862d33d7 */
/* bench 17654.2.2 9b7635d3dae5 */
/* bench 17654.2.3 f92570d30c2b */
/* bench 17654.2.4 7e7183cd86fb */
/* bench 17654.2.5 7edcb8a01a81 */
/* bench 17654.2.6 53b76792fc80 */
/* bench 17654.2.7 0aec9404a4bc */
/* bench 17654.2.8 1511a47c0687 */
/* bench 8561.2.3 ac22da3a9e22 */
/* bench 8561.2.4 a4959361d2f3 */
/* bench 8561.2.5 b64e0cbd5ff0 */
/* bench 8561.2.6 0e456169ffd4 */
 */
/dts-v1/;

#include "omap4-var-som-om44.dtsi"
#include "omap4-var-som-om44-wlan.dtsi"
#include "omap4-var-om44customboard.dtsi"

/ {
	model = "Variscite VAR-STK-OM44";
	compatible = "variscite,var-stk-om44", "variscite,var-som-om44", "ti,omap4460", "ti,omap4";
};
