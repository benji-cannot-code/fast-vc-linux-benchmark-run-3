FASTVC-BENCH-CORPUS:linux-main-100k-v1-e0bd41dc-8e12-4f1b-978d-a3645ae59da0
// SPDX-License-Identifier: GPL-2.0
/*
 * Copyright (C) 2015-2018 Overkiz SAS
 *   Author: Mickael Gardet <m.gardet@overkiz.com>
 *           Kévin Raymond <k.raymond@overkiz.com>
 */
/dts-v1/;
#include "at91-kizboxmini-common.dtsi"

/ {
	model = "Overkiz Kizbox Mini Mother Board";
	compatible = "overkiz,kizboxmini-mb", "atmel,at91sam9g25",
		     "atmel,at91sam9x5", "atmel,at91sam9";
};

&usb0 {
	num-ports = <2>;
};

&rtc {
	status = "okay";
};
/* bench 24912.1.0 77477d49452c */
/* bench 24912.1.1 34acada3b7f2 */
/* bench 24912.1.2 6a89c4178328 */
/* bench 24912.1.3 e63c58cfd721 */
/* bench 24912.1.4 de1455d0d8b1 */
/* bench 24912.1.5 d7c311393730 */
/* bench 24912.1.6 b63d7eb3905d */
&led_blue {
	status = "okay";
};
