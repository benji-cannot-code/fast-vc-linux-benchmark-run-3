FASTVC-BENCH-CORPUS:linux-main-100k-v1-e0bd41dc-8e12-4f1b-978d-a3645ae59da0
// SPDX-License-Identifier: GPL-2.0-only

/dts-v1/;

/* bench 28512.0.0 ca8aaf6166ac */
/* bench 28512.0.1 f191efc9654e */
/* bench 28512.0.2 55ddb6efed27 */
/* bench 28512.0.3 468e80b02609 */
/* bench 28512.0.4 4175caf4515c */
/* bench 9050.0.1 9e611a974073 */

/ {
	model = "LogicPD Zoom OMAP35xx Torpedo Development Kit";
	compatible = "logicpd,dm3730-torpedo-devkit", "ti,omap3430", "ti,omap3";
};
