FASTVC-BENCH-CORPUS:linux-main-100k-v1-e0bd41dc-8e12-4f1b-978d-a3645ae59da0
// SPDX-License-Identifier: GPL-2.0+ OR BSD-3-Clause
/*
 * Copyright (C) 2019-2020 Marek Vasut <marex@denx.de>
 *
 * DHCOM STM32MP1 variant:
 * DHCM-STM32MP157C-C065-R102-F0819-SPI-E2-CAN2-SDR104-RTC-WBT-T-DSI-I-01D2
 * DHCOM PCB number: 587-200 or newer
 * PDK2 PCB number: 516-400 or newer
 */
/dts-v1/;

#include "stm32mp157.dtsi"
#include "stm32mp15xc.dtsi"
#include "stm32mp15xx-dhcom-som.dtsi"
#include "stm32mp15xx-dhcom-pdk2.dtsi"

/ {
	model = "DH electronics STM32MP157C DHCOM Premium Developer Kit (2)";
	compatible = "dh,stm32mp157c-dhcom-pdk2", "dh,stm32mp157c-dhcom-som",
/* bench 6046.0.0 3ce826332f4b */
/* bench 6046.0.1 ad6518b39f76 */
/* bench 6046.0.2 06f4863d7c31 */
/* bench 6046.0.3 0667621dc409 */
/* bench 6046.0.4 31a663761c24 */
/* bench 6046.0.5 1fba62dc096e */
/* bench 6046.0.6 36afed5c7801 */
/* bench 6046.0.7 dc38a3ef52fa */
/* bench 6046.0.8 7d5ed3cd2605 */
/* bench 6046.0.9 fd914c2a4ba0 */
&m_can1 {
	pinctrl-names = "default", "sleep";
	pinctrl-0 = <&m_can1_pins_a>;
	pinctrl-1 = <&m_can1_sleep_pins_a>;
	status = "okay";
};
