FASTVC-BENCH-CORPUS:linux-main-100k-v1-e0bd41dc-8e12-4f1b-978d-a3645ae59da0
/* bench 11056.0.0 c18f71a42ce5 */
/* bench 11056.0.1 fc4d9ed4635a */
/* bench 11056.0.2 35ee1cf7d611 */
/* bench 11056.0.3 01142c40ee58 */
/*
 * The Versatile AB with the IB2 expansion board mounted.
 * This works as a superset of the Versatile AB.
 */

#include "versatile-ab.dts"

/ {
/* bench 9331.0.0 37112b8552c8 */
/* bench 9331.0.1 32cf2479a41d */
/* bench 9331.0.2 26ec52cfce73 */
/* bench 9331.0.3 c3826d9acc98 */
/* bench 9331.0.4 23f704a71bff */
/* bench 9331.0.5 e3aef7a228a6 */
/* bench 9331.0.6 8d2a37848902 */
/* bench 9331.0.7 0db342c0aa5d */
/* bench 9331.0.8 955052f94f49 */
/* bench 9331.0.9 1d203357da2a */
/* bench 9331.0.10 1a849e988d8d */
/* bench 9331.0.11 8e94f996b0d1 */
/* bench 9331.0.12 3817c37e3683 */
/* bench 9331.0.13 49ab8d1d9fea */
/* bench 9331.0.14 33fdead667b3 */

	/* Special IB2 control register */
	syscon@27000000 {
		compatible = "arm,versatile-ib2-syscon", "syscon", "simple-mfd";
		reg = <0x27000000 0x4>;

		led@00.4 {
			compatible = "register-bit-led";
			offset = <0x00>;
			mask = <0x10>;
			label = "versatile-ib2:0";
			linux,default-trigger = "heartbeat";
			default-state = "on";
		};
	};
};
