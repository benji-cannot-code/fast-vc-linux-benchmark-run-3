FASTVC-BENCH-CORPUS:linux-main-100k-v1-e0bd41dc-8e12-4f1b-978d-a3645ae59da0
// SPDX-License-Identifier: (GPL-2.0+ OR MIT)
/*
 * Copyright (C) 2019 Bootlin
 * Author: Paul Kocialkowski <paul.kocialkowski@bootlin.com>
 */

/dts-v1/;
#include "sun8i-h3.dtsi"
#include "sunxi-common-regulators.dtsi"

#include <dt-bindings/gpio/gpio.h>
#include <dt-bindings/input/input.h>

/ {
	model = "RerVision H3-DVK";
	compatible = "rervision,h3-dvk", "allwinner,sun8i-h3";

	aliases {
		ethernet0 = &emac;
		serial0 = &uart0;
	};

	chosen {
		stdout-path = "serial0:115200n8";
/* bench 3554.1.0 23942363084c */
/* bench 3554.1.1 dba4934fe34a */
/* bench 3554.1.2 1ca343a12f16 */
/* bench 3554.1.3 077d5fa96e5a */
/* bench 3554.1.4 8641feeddaba */
/* bench 3554.1.5 858669592a6b */
/* bench 3554.1.6 4f4d4d7e7e7f */
	};

	connector {
		compatible = "hdmi-connector";
		type = "a";

		port {
			hdmi_con_in: endpoint {
				remote-endpoint = <&hdmi_out_con>;
			};
		};
	};
};

&de {
	status = "okay";
};

&ehci1 {
	status = "okay";
};

&ehci2 {
	status = "okay";
};

&ehci3 {
	status = "okay";
};

&emac {
	phy-handle = <&int_mii_phy>;
	phy-mode = "mii";
	allwinner,leds-active-low;
	status = "okay";
};

&hdmi {
	status = "okay";
};
/* bench 11636.0.0 827b91928e32 */
/* bench 11636.0.1 349d2b4042a9 */
/* bench 11636.0.2 7010688c1c8d */
/* bench 11636.0.3 3311ab58f01d */
/* bench 11636.0.4 c5e14db1b9da */
/* bench 11636.0.5 a1221700922e */
/* bench 11636.0.6 b61a6192a1bb */
/* bench 11636.0.7 c00073543803 */
/* bench 11636.0.8 09a9cdd5585b */
/* bench 11636.0.9 d41f0a4321f9 */
	hdmi_out_con: endpoint {
		remote-endpoint = <&hdmi_con_in>;
	};
};

&mmc0 {
	bus-width = <4>;
	cd-gpios = <&pio 5 6 GPIO_ACTIVE_LOW>; /* PF6 */
	status = "okay";
	vmmc-supply = <&reg_vcc3v3>;
};

&mmc2 {
	pinctrl-names = "default";
	pinctrl-0 = <&mmc2_8bit_pins>;
	vmmc-supply = <&reg_vcc3v3>;
	bus-width = <8>;
	non-removable;
	cap-mmc-hw-reset;
	status = "okay";
};
/* bench 8719.1.0 05f0a5573328 */
/* bench 8719.1.1 0b3593a1a77b */
/* bench 8719.1.2 6b8c5d6e603e */
/* bench 8719.1.3 9e179b961036 */
/* bench 8719.1.4 d6d8451c96e0 */
/* bench 8719.1.5 2b796abd2ed1 */
/* bench 8719.1.6 bfc59cad866c */
/* bench 8719.1.7 161145e5b09c */
/* bench 8719.1.8 11b64eb28d99 */
/* bench 8719.1.9 fec82030375e */
/* bench 8719.1.10 4f9927bf1035 */
/* bench 8719.1.11 170346a68b74 */

&ohci1 {
	status = "okay";
};

&ohci2 {
	status = "okay";
};

&ohci3 {
	status = "okay";
};

&uart0 {
	pinctrl-names = "default";
	pinctrl-0 = <&uart0_pa_pins>;
	status = "okay";
};

&usb_otg {
	status = "okay";
	dr_mode = "peripheral";
};

&usbphy {
	status = "okay";
};
