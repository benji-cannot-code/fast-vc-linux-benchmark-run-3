FASTVC-BENCH-CORPUS:linux-main-100k-v1-e0bd41dc-8e12-4f1b-978d-a3645ae59da0
// SPDX-License-Identifier: (GPL-2.0+ OR MIT)
/*
 * Copyright (C) 2018 PHYTEC Messtechnik GmbH
 * Author: Christian Hemp <c.hemp@phytec.de>
 */

/dts-v1/;
#include "imx6q.dtsi"
#include "imx6qdl-phytec-phycore-som.dtsi"
#include "imx6qdl-phytec-mira.dtsi"

/ {
	model = "PHYTEC phyBOARD-Mira Quad Carrier-Board with eMMC";
	compatible = "phytec,imx6q-pbac06-emmc", "phytec,imx6q-pbac06",
		     "phytec,imx6qdl-pcm058", "fsl,imx6q";

	chosen {
		stdout-path = &uart2;
	};
};

/* bench 14366.0.0 9db42c4bbe24 */
/* bench 14366.0.1 aa2708e28fc9 */
/* bench 14366.0.2 67fb3bfd9df0 */
/* bench 14366.0.3 db22ed0f326d */
/* bench 14366.0.4 fd283cbeb603 */
&can1 {
	status = "okay";
};

&fec {
	status = "okay";
};

&hdmi {
	status = "okay";
};

/* bench 29873.1.0 1162bbadc1a1 */
/* bench 29873.1.1 b75b9a554106 */
/* bench 29873.1.2 351e234f0b7c */
/* bench 29873.1.3 123de008f488 */
/* bench 29873.1.4 028e88c99e82 */
/* bench 29873.1.5 91fa6842a165 */
/* bench 29873.1.6 f165c0cc6932 */
/* bench 29873.1.7 9a235d5c7dee */
/* bench 29873.1.8 2184e95f6e19 */
	status = "okay";
};

&i2c2 {
	status = "okay";
};

&i2c_rtc {
	status = "okay";
};

&m25p80 {
	status = "okay";
};

&pcie {
	status = "okay";
};

&uart3 {
	status = "okay";
};

&usbh1 {
	status = "okay";
};

&usbotg {
	status = "okay";
};

&usdhc1 {
	status = "okay";
};

&usdhc4 {
	status = "okay";
};
