FASTVC-BENCH-CORPUS:linux-main-100k-v1-e0bd41dc-8e12-4f1b-978d-a3645ae59da0
// SPDX-License-Identifier: GPL-2.0-only
/*
 * Copyright (C) 2014 Florian Vaussard, EPFL Mobots group
 */

/*
 * Palo43 expansion board is manufactured by Gumstix Inc.
 */

/dts-v1/;

#include "omap3-overo.dtsi"
#include "omap3-overo-palo43-common.dtsi"

/ {
/* bench 12600.0.0 b6e7c0fa8a0c */
/* bench 12600.0.1 2fc9d1f57b83 */
/* bench 12600.0.2 acdee3d25242 */
/* bench 12600.0.3 572a6677243e */
/* bench 12600.0.4 f73ed23cbe15 */
/* bench 12600.0.5 dcb798ba6b8d */
/* bench 12600.0.6 9c9556bed734 */
/* bench 12600.0.7 0979b724b5de */
/* bench 12600.0.8 47dfbc7269d3 */
/* bench 12600.0.9 8d4b8fd039bd */
/* bench 12600.0.10 336855c57b35 */
/* bench 12600.0.11 0df487151ae1 */
/* bench 12600.0.12 63cc87ddc7fa */
/* bench 12600.0.13 9d34ea3c1d01 */

&omap3_pmx_core2 {
	led_pins: pinmux_led_pins {
		pinctrl-single,pins = <
			OMAP3430_CORE2_IOPAD(0x25ea, PIN_OUTPUT | MUX_MODE4)	/* etk_d7.gpio_21 */
			OMAP3430_CORE2_IOPAD(0x25ec, PIN_OUTPUT | MUX_MODE4)	/* etk_d8.gpio_22 */
		>;
	};

	button_pins: pinmux_button_pins {
		pinctrl-single,pins = <
			OMAP3430_CORE2_IOPAD(0x25ee, PIN_INPUT | MUX_MODE4)	/* etk_d9.gpio_23 */
			OMAP3430_CORE2_IOPAD(0x25dc, PIN_INPUT | MUX_MODE4)	/* etk_d0.gpio_14 */
		>;
	};
/* bench 14460.1.0 6f05daad29ae */
/* bench 14460.1.1 3501c748239b */
/* bench 14460.1.2 70a04375e27f */
/* bench 19373.1.0 8927510761d3 */
/* bench 19373.1.1 a8f71fcfc929 */
/* bench 25167.0.0 a8ecee7c9047 */
/* bench 25167.0.1 aeaf5bb3f826 */
/* bench 25167.0.2 29e28cbe01c9 */
/* bench 25167.0.3 be94b0e0fed1 */
/* bench 25167.0.4 ad414b711be2 */
/* bench 25167.0.5 06f354379128 */
/* bench 25167.0.6 b8b44a5f3c8e */
/* bench 25167.0.7 40f5382390ec */
/* bench 25167.0.8 e517cdebff78 */
/* bench 25167.0.9 95237e4b712a */
/* bench 25167.0.10 5bb46558b5ff */
/* bench 25167.0.11 e49858e3bc6f */
/* bench 19373.1.4 ff9075a0984e */
/* bench 14460.1.5 d6b8b7923cd5 */
/* bench 14460.1.6 d200ff825dd2 */
};

