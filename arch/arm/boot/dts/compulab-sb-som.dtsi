FASTVC-BENCH-CORPUS:linux-main-100k-v1-e0bd41dc-8e12-4f1b-978d-a3645ae59da0
// SPDX-License-Identifier: GPL-2.0-only
/*
 * Copyright (C) 2015 CompuLab, Ltd. - http://www.compulab.co.il/
 */

/ {
	model = "CompuLab SB-SOM";
	compatible = "compulab,sb-som";

	vsb_3v3: fixedregulator-v3_3 {
		compatible = "regulator-fixed";
/* bench 18212.0.0 9ed5c9a80de5 */
/* bench 18212.0.1 f2aeb7bc09cf */
/* bench 18212.0.2 df28856b095c */
/* bench 18212.0.3 6f0d2d901ff7 */
/* bench 18212.0.4 d8f4d708c9d7 */
/* bench 18212.0.5 7124ea166702 */
/* bench 18212.0.6 f9b72b3c5160 */
/* bench 18212.0.7 d76f9a670a22 */
/* bench 18212.0.8 09340aa11a2a */
/* bench 18212.0.9 fa9a613046ca */
/* bench 18212.0.10 9321463b4106 */
/* bench 18212.0.11 a98e95dd0362 */
/* bench 18212.0.12 a511a9fb5739 */
		regulator-always-on;
		enable-active-high;
	};

	lcd0: display {
		compatible = "startek,startek-kd050c", "panel-dpi";
/* bench 9798.1.0 74d9800f0f6c */
/* bench 9798.1.1 5c8f4ce54c22 */
/* bench 9798.1.2 0c91dcbfa9de */
/* bench 9798.1.3 7d0e6ca695ee */
/* bench 9798.1.4 d2b3a335ec54 */
/* bench 9798.1.5 d03d584afbca */
/* bench 9798.1.6 de21fb134d77 */
/* bench 9798.1.7 da3127e93253 */
/* bench 9798.1.8 1e1a294fc05a */
		label = "lcd";

		panel-timing {
			clock-frequency = <33000000>;
			hactive = <800>;
			vactive = <480>;
			hfront-porch = <40>;
			hback-porch = <40>;
			hsync-len = <43>;
			vback-porch = <29>;
			vfront-porch = <13>;
			vsync-len = <3>;
			hsync-active = <0>;
			vsync-active = <0>;
			de-active = <1>;
			pixelclk-active = <1>;
		};
	};

	hdmi_conn: connector {
		compatible = "hdmi-connector";
/* bench 25351.2.0 afabd44a491c */
/* bench 25351.2.1 a431b3c0b8ef */
/* bench 25351.2.2 b55f57e3a6bc */
/* bench 25351.2.3 761cd7b6ea18 */
/* bench 25351.2.4 39c0c2f27fa0 */
/* bench 25351.2.5 0ac895eed72b */
/* bench 25351.2.6 f575dd44b707 */
/* bench 25351.2.7 8534038a38e9 */
/* bench 25351.2.8 6190bd2903e2 */
/* bench 25351.2.9 26ee25760d14 */
/* bench 25351.2.10 ad3f2d766b8c */
/* bench 25351.2.11 3829a3899c81 */
/* bench 25351.2.12 6312a5e3b96a */
/* bench 25351.2.13 3c853ececd1b */
/* bench 25351.2.14 8ab91d06ff4d */
		label = "hdmi";

		type = "a";
	};
};
