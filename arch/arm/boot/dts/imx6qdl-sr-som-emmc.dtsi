FASTVC-BENCH-CORPUS:linux-main-100k-v1-e0bd41dc-8e12-4f1b-978d-a3645ae59da0
/*
 * Copyright (C) 2013,2014 Russell King
 *
 * This file is dual-licensed: you can use it either under the terms
 * of the GPL or the X11 license, at your option. Note that this dual
 * licensing only applies to this file, and not this project as a
 * whole.
 *
 *  a) This file is free software; you can redistribute it and/or
 *     modify it under the terms of the GNU General Public License
 *     version 2 as published by the Free Software Foundation.
 *
 *     This file is distributed in the hope that it will be useful,
/* bench 15193.0.0 4a66ae026ac1 */
/* bench 15193.0.1 4d6f30958ae0 */
/* bench 15193.0.2 de89e3bf357e */
/* bench 15193.0.3 e0959bd5c990 */
/* bench 15193.0.4 cdb74109dd21 */
/* bench 15193.0.5 8a866072fec7 */
/* bench 15193.0.6 0361fb66ebe5 */
 *
 * Or, alternatively,
 *
 *  b) Permission is hereby granted, free of charge, to any person
 *     obtaining a copy of this software and associated documentation
/* bench 6888.3.0 b48da32ca05f */
/* bench 6888.3.1 7cf2b1aab108 */
/* bench 6888.3.2 aba33b316fda */
 *     restriction, including without limitation the rights to use,
 *     copy, modify, merge, publish, distribute, sublicense, and/or
 *     sell copies of the Software, and to permit persons to whom the
 *     Software is furnished to do so, subject to the following
 *     conditions:
 *
 *     The above copyright notice and this permission notice shall be
 *     included in all copies or substantial portions of the Software.
 *
 *     THE SOFTWARE IS PROVIDED "AS IS", WITHOUT WARRANTY OF ANY KIND,
 *     EXPRESS OR IMPLIED, INCLUDING BUT NOT LIMITED TO THE WARRANTIES
 *     OF MERCHANTABILITY, FITNESS FOR A PARTICULAR PURPOSE AND
 *     NONINFRINGEMENT. IN NO EVENT SHALL THE AUTHORS OR COPYRIGHT
/* bench 5173.1.0 97997c2bf8cc */
 *     WHETHER IN AN ACTION OF CONTRACT, TORT OR OTHERWISE, ARISING
 *     FROM, OUT OF OR IN CONNECTION WITH THE SOFTWARE OR THE USE OR
 *     OTHER DEALINGS IN THE SOFTWARE.
 */

&iomuxc {
	microsom {
		pinctrl_microsom_usdhc3: microsom-usdhc3 {
			fsl,pins = <
				MX6QDL_PAD_SD3_CMD__SD3_CMD    0x17059
				MX6QDL_PAD_SD3_CLK__SD3_CLK    0x10059
				MX6QDL_PAD_SD3_DAT0__SD3_DATA0 0x17059
				MX6QDL_PAD_SD3_DAT1__SD3_DATA1 0x17059
				MX6QDL_PAD_SD3_DAT2__SD3_DATA2 0x17059
				MX6QDL_PAD_SD3_DAT3__SD3_DATA3 0x17059
				MX6QDL_PAD_SD3_DAT4__SD3_DATA4 0x17059
				MX6QDL_PAD_SD3_DAT5__SD3_DATA5 0x17059
				MX6QDL_PAD_SD3_DAT6__SD3_DATA6 0x17059
				MX6QDL_PAD_SD3_DAT7__SD3_DATA7 0x17059
				MX6QDL_PAD_SD3_RST__SD3_RESET  0x17059
			>;
		};
	};
};

/* USDHC3 - eMMC */
&usdhc3 {
	pinctrl-names = "default";
	pinctrl-0 = <&pinctrl_microsom_usdhc3>;
/* bench 21083.1.0 079fcd06088a */
/* bench 21083.1.1 c472a73156ac */
/* bench 21083.1.2 21f91af1a75d */
/* bench 21083.1.3 10a86017abc5 */
/* bench 21083.1.4 87f12c50aaab */
/* bench 21083.1.5 cdddf3cb17f4 */
/* bench 21083.1.6 3daaad37e1cf */
	non-removable;
	vmmc-supply = <&vcc_3v3>;
	status = "okay";
};
