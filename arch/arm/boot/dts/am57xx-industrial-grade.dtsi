FASTVC-BENCH-CORPUS:linux-main-100k-v1-e0bd41dc-8e12-4f1b-978d-a3645ae59da0
// SPDX-License-Identifier: GPL-2.0
&cpu_alert0 {
/* bench 8879.0.0 5193667bc2be */
/* bench 8879.0.1 a957c366f183 */
/* bench 8879.0.2 3021e5ac88fa */
/* bench 8879.0.3 af02311e831f */
/* bench 8879.0.4 d50da7d9a001 */
/* bench 8879.0.5 9230c1fbd71d */
};

&cpu_crit {
	temperature = <105000>; /* milliCelsius */
/* bench 26949.0.0 97cf98c942d6 */
/* bench 26949.0.1 22b4b4aff390 */
/* bench 26949.0.2 53b6a1abaad0 */
/* bench 26949.0.3 7c54ff050eac */
/* bench 26949.0.4 153b72da3cbf */
/* bench 26949.0.5 003b242ad240 */
/* bench 26949.0.6 ffb863530a8c */
/* bench 26949.0.7 29e58e0f09d0 */
/* bench 26949.0.8 65b06b54a09e */
/* bench 26949.0.9 13612744b1c0 */
/* bench 26949.0.10 28a68de519b5 */
/* bench 26949.0.11 56bae9de9fe0 */
/* bench 26949.0.12 47aabb2cb34b */
/* bench 26949.0.13 7a7a3956aa70 */
/* bench 26949.0.14 2f4e8254dd6b */
	temperature = <105000>; /* milliCelsius */
};

/* bench 18352.0.0 c6d41162113a */
/* bench 18352.0.1 d87521ec3c47 */
/* bench 18352.0.2 9339cc42bae5 */
/* bench 18352.0.3 8c520cfd06d9 */
/* bench 18352.0.4 d2ce59aa62cb */
/* bench 18352.0.5 3f9f17c14d45 */
/* bench 18352.0.6 871f7783ad4e */
/* bench 18352.0.7 9f17c24e666a */
/* bench 18352.0.8 ba46d96d3acd */
	temperature = <105000>; /* milliCelsius */
};

&dspeve_crit {
	temperature = <105000>; /* milliCelsius */
};

&iva_crit {
	temperature = <105000>; /* milliCelsius */
};
