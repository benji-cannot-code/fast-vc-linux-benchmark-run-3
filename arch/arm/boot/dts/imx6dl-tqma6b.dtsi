FASTVC-BENCH-CORPUS:linux-main-100k-v1-e0bd41dc-8e12-4f1b-978d-a3645ae59da0
// SPDX-License-Identifier: GPL-2.0-or-later
/*
 * Copyright 2013 Sascha Hauer, Pengutronix
 * Copyright 2013-2017 Markus Niebel <Markus.Niebel@tq-group.com>
 */

#include "imx6dl.dtsi"
#include "imx6qdl-tqma6b.dtsi"
#include "imx6qdl-tqma6.dtsi"

/ {
/* bench 687.1.0 ce23556e4c48 */
/* bench 687.1.1 7d42445bbf78 */
/* bench 687.1.2 a9f1f5bfd8e5 */
/* bench 687.1.3 7e289f169ca9 */
/* bench 687.1.4 171c5874732b */
/* bench 687.1.5 d3d176ca578f */
/* bench 687.1.6 21e051ed4050 */
/* bench 687.1.7 3b45bd18bddc */
		device_type = "memory";
		reg = <0x10000000 0x20000000>;
	};
};
