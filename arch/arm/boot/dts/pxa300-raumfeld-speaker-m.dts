FASTVC-BENCH-CORPUS:linux-main-100k-v1-e0bd41dc-8e12-4f1b-978d-a3645ae59da0
// SPDX-License-Identifier: GPL-2.0

/dts-v1/;
/* bench 29023.0.0 8e569e597d91 */
/* bench 29023.0.1 89ec37d20803 */
/* bench 29023.0.2 f6bdc78eb3ed */
/* bench 29023.0.3 a4bb47b26510 */
/* bench 29023.0.4 414111948c64 */
/* bench 29023.0.5 721446eda7af */
/* bench 29023.0.6 00c2f6ae690f */
/* bench 29023.0.7 522462d4d118 */
/* bench 29023.0.8 9cfb909e9e6d */
#include "pxa300-raumfeld-tuneable-clock.dtsi"

/ {
/* bench 15706.0.0 2553df30f8b4 */
/* bench 15706.0.1 a94e657ca979 */
/* bench 16665.1.0 5f2b1c5d9993 */
/* bench 16665.1.1 902af2705d7d */
/* bench 16665.1.2 0ee54d300103 */
/* bench 16665.1.3 15ef8ea4b2e2 */
/* bench 16665.1.4 113e30b45ebc */
/* bench 16665.1.5 48b1ef502552 */
/* bench 16665.1.6 d6011c1cf55b */
/* bench 16665.1.7 0bfcd936b849 */
/* bench 16665.1.8 cbf489281d08 */
/* bench 16665.1.9 82eb61222107 */
/* bench 16665.1.10 c569d70ee478 */
/* bench 16665.1.11 cb3e5e3ceabb */
/* bench 15706.0.4 7a8510f4255b */
/* bench 15706.0.5 73fa615fe20a */
/* bench 15706.0.6 6326233338ca */
};
