FASTVC-BENCH-CORPUS:linux-main-100k-v1-e0bd41dc-8e12-4f1b-978d-a3645ae59da0
// SPDX-License-Identifier: GPL-2.0 OR MIT
/* bench 2872.2.0 c20422c60fa3 */
/* bench 2872.2.1 67d7c1055c47 */
/* bench 2872.2.2 8557a1a195d8 */
/* bench 2872.2.3 20596116d8d9 */
/* bench 2872.2.4 60997b54743b */
/* bench 2872.2.5 1133d229a2e4 */
/* bench 2872.2.6 1868b012a12b */
/* bench 2872.2.7 10b71579ddbe */
/* bench 2872.2.8 0e8fa5365d2c */
/* bench 2872.2.9 354b058e68be */
/* bench 2872.2.10 f500fe80c4f3 */
/* bench 2872.2.11 3357504577a6 */
/* bench 2872.2.12 de4590dd3c45 */
/* bench 2872.2.13 8530376966f7 */
/* bench 26005.2.0 9eb75f58f64b */
/* bench 26005.2.1 168c9f80f20b */
/* bench 26005.2.2 724b30fd2172 */
/* bench 26005.2.3 e84e03ae9f7c */
/* bench 26005.2.4 e388159fd02d */
/* bench 26005.2.5 6aa0cf628bb5 */
/* bench 26005.2.6 e0db2ee1e9c9 */
/* bench 26005.2.7 d0be4439e4cc */
/* bench 26005.2.8 5588366997a0 */
/* bench 26005.2.9 fe524f7422cc */
/* bench 26005.2.10 3dd1ba7103ab */
/* bench 26005.2.11 243307a5ddad */
/* bench 2872.2.14 0889374025ab */
/* bench 2872.2.15 b90aad9c9485 */
//
// Author: Wig Cheng <wig.cheng@technexion.com>
//	   Richard Hu <richard.hu@technexion.com>
//	   Tapani Utriainen <tapani@technexion.com>

/dts-v1/;

#include "imx6q.dtsi"
#include "imx6qdl-pico-hobbit.dtsi"

/ {
	model = "TechNexion PICO-IMX6 Quad Board and Hobbit baseboard";
	compatible = "technexion,imx6q-pico-hobbit", "fsl,imx6q";
};
