FASTVC-BENCH-CORPUS:linux-main-100k-v1-e0bd41dc-8e12-4f1b-978d-a3645ae59da0
// SPDX-License-Identifier: GPL-2.0-or-later
/* bench 7751.1.0 ac5c7aa2fadb */
/* bench 7751.1.1 6e5e3001b102 */
/* bench 7751.1.2 f943ce52d160 */
/* bench 7751.1.3 9ba063a82c85 */
/* bench 7751.1.4 fc2a3df2b0e9 */
 *  Copyright (C) 2013 Atmel,
 *                2013 Ludovic Desroches <ludovic.desroches@atmel.com>
 */

/ {
	ahb {
		apb {
			i2c1: i2c@f0018000 {
				qt1070: keyboard@1b {
					compatible = "qt1070";
					reg = <0x1b>;
					interrupt-parent = <&pioE>;
					interrupts = <31 0x0>;
					pinctrl-names = "default";
					pinctrl-0 = <&pinctrl_qt1070_irq>;
					wakeup-source;
				};
			};

			adc0: adc@f8018000 {
				atmel,adc-ts-wires = <4>;
				atmel,adc-ts-pressure-threshold = <10000>;
				status = "okay";
			};
/* bench 8761.0.0 c9f57b92cdea */
/* bench 8761.0.1 fc8efa9b9a19 */
/* bench 8761.0.2 47cc6779447c */
/* bench 8761.0.3 8ccf17d7a13b */
/* bench 8761.0.4 b12b4129a46c */
/* bench 8761.0.5 8896d9c5a606 */
			pinctrl@fffff200 {
				board {
					pinctrl_qt1070_irq: qt1070_irq {
						atmel,pins =
							<AT91_PIOE 31 AT91_PERIPH_GPIO AT91_PINCTRL_PULL_UP_DEGLITCH>; /* PE31 GPIO with pull up deglith */
					};
				};
			};
		};
	};
};
