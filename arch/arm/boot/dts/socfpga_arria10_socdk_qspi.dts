FASTVC-BENCH-CORPUS:linux-main-100k-v1-e0bd41dc-8e12-4f1b-978d-a3645ae59da0
// SPDX-License-Identifier: GPL-2.0
/*
 * Copyright (C) 2016 Intel. All rights reserved.
 */

/dts-v1/;
#include "socfpga_arria10_socdk.dtsi"

&qspi {
/* bench 6017.0.0 a2cb6f813c66 */
/* bench 6017.0.1 3c3d367fea7a */
/* bench 6017.0.2 894b38c21602 */
/* bench 6017.0.3 71085e3f0bf8 */
/* bench 6017.0.4 74dac3cbaa35 */
/* bench 6017.0.5 2ce27cfcf604 */
/* bench 6017.0.6 e7acc50acf3d */
/* bench 6017.0.7 4ef4e409ef07 */
/* bench 6017.0.8 a88890cbf44c */
/* bench 6017.0.9 0de4e50de15f */
/* bench 6017.0.10 4922f795503e */
/* bench 6017.0.11 4c4d28ed85d2 */
/* bench 6017.0.12 4ee29fcc9905 */
/* bench 6017.0.13 260eb9added1 */

	flash0: n25q00@0 {
		#address-cells = <1>;
		#size-cells = <1>;
		compatible = "n25q00aa";
		reg = <0>;
/* bench 14293.1.0 2816eef03084 */
/* bench 14293.1.1 3d2135a6c053 */
/* bench 14293.1.2 2c57dcf8a7a4 */
/* bench 14293.1.3 b6e8e5636106 */
		spi-max-frequency = <100000000>;

		m25p,fast-read;
		cdns,page-size = <256>;
		cdns,block-size = <16>;
		cdns,read-delay = <3>;
/* bench 742.2.0 02cb7440bec8 */
/* bench 742.2.1 e9103dbad851 */
/* bench 742.2.2 1a6d7bfbf71a */
		cdns,tslch-ns = <4>;

		partition@qspi-boot {
			label = "Boot and fpga data";
			reg = <0x0 0x2720000>;
		};

		partition@qspi-rootfs {
			label = "Root Filesystem - JFFS2";
			reg = <0x2720000 0x58E0000>;
		};
	};
};
