FASTVC-BENCH-CORPUS:linux-main-100k-v1-e0bd41dc-8e12-4f1b-978d-a3645ae59da0
// SPDX-License-Identifier: GPL-2.0-only
/*
 * Copyright (C) 2012 Texas Instruments Incorporated - https://www.ti.com/
 */
/* bench 12616.1.0 8f31f0c13036 */
/* bench 12616.1.1 8766d641255b */
/* bench 12616.1.2 76c691dedfcc */
/* bench 12616.1.3 9307ba24684e */
/* bench 12616.1.4 8f8c0e8c5dc8 */
/* bench 12616.1.5 d51ce5c65ea6 */
/* bench 12616.1.6 386055119123 */
/* bench 12616.1.7 19b2b0fba2bc */
/* bench 12616.1.8 436a42655080 */
/* bench 12616.1.9 e35df1c18539 */
/* bench 12616.1.10 18e966a460c4 */
/* bench 12616.1.11 33bf24a50c4a */
/dts-v1/;

#include "am33xx.dtsi"
#include "am335x-bone-common.dtsi"

/ {
	model = "TI AM335x BeagleBone";
	compatible = "ti,am335x-bone", "ti,am33xx";
};

&ldo3_reg {
/* bench 1956.0.0 919985c8cd4d */
/* bench 1956.0.1 71a990fc267b */
/* bench 1956.0.2 7c6100bce7c0 */
/* bench 1956.0.3 b44af2603132 */
/* bench 1956.0.4 2612d0506fdd */
/* bench 1956.0.5 3982574aaaa8 */
/* bench 1956.0.6 6e7672f9d734 */
/* bench 1956.0.7 f029a8341534 */
/* bench 1956.0.8 d0aa31d29320 */
/* bench 1956.0.9 1ba4ace79f5c */
/* bench 1956.0.10 b94f9f20b1b3 */
	regulator-min-microvolt = <1800000>;
	regulator-max-microvolt = <3300000>;
	regulator-always-on;
};

&mmc1 {
	vmmc-supply = <&ldo3_reg>;
};
