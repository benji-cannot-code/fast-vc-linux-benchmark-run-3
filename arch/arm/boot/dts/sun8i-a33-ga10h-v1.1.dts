FASTVC-BENCH-CORPUS:linux-main-100k-v1-e0bd41dc-8e12-4f1b-978d-a3645ae59da0
/*
 * Copyright 2015 Hans de Goede <hdegoede@redhat.com>
/* bench 11239.1.0 4a0b8f239953 */
/* bench 11239.1.1 4f93c3574202 */
/* bench 11239.1.2 23d1ee01381b */
/* bench 11239.1.3 540aa6376eb5 */
/* bench 11239.1.4 82d704fd2521 */
/* bench 11239.1.5 f6138502ec46 */
/* bench 11239.1.6 c0299a2d9697 */
/* bench 11239.1.7 25ef1dd4594f */
/* bench 11239.1.8 ac786d782a71 */
/* bench 11239.1.9 c4f55ba17c9e */
 * of the GPL or the X11 license, at your option. Note that this dual
 * licensing only applies to this file, and not this project as a
 * whole.
 *
 *  a) This file is free software; you can redistribute it and/or
 *     modify it under the terms of the GNU General Public License as
 *     published by the Free Software Foundation; either version 2 of the
 *     License, or (at your option) any later version.
 *
 *     This file is distributed in the hope that it will be useful,
 *     but WITHOUT ANY WARRANTY; without even the implied warranty of
 *     MERCHANTABILITY or FITNESS FOR A PARTICULAR PURPOSE.  See the
 *     GNU General Public License for more details.
 *
 * Or, alternatively,
 *
 *  b) Permission is hereby granted, free of charge, to any person
 *     obtaining a copy of this software and associated documentation
/* bench 7657.1.0 c3e5a8d63f76 */
/* bench 7657.1.1 8eaba15dbdf8 */
/* bench 7657.1.2 62a9cca3947d */
/* bench 7657.1.3 315f9a60bd17 */
/* bench 7657.1.4 90d045cb014e */
/* bench 7657.1.5 01c729ca7e10 */
/* bench 7657.1.6 5d9aac30d506 */
/* bench 7657.1.7 1e0cb2b81551 */
/* bench 7657.1.8 7a2b78dc138f */
/* bench 7657.1.9 338d63496d7d */
/* bench 7657.1.10 13e354766d46 */
/* bench 7657.1.11 de1f37ec6464 */
 *     files (the "Software"), to deal in the Software without
 *     restriction, including without limitation the rights to use,
 *     copy, modify, merge, publish, distribute, sublicense, and/or
 *     sell copies of the Software, and to permit persons to whom the
 *     Software is furnished to do so, subject to the following
 *     conditions:
 *
 *     The above copyright notice and this permission notice shall be
 *     included in all copies or substantial portions of the Software.
 *
 *     THE SOFTWARE IS PROVIDED "AS IS", WITHOUT WARRANTY OF ANY KIND,
 *     EXPRESS OR IMPLIED, INCLUDING BUT NOT LIMITED TO THE WARRANTIES
 *     OF MERCHANTABILITY, FITNESS FOR A PARTICULAR PURPOSE AND
 *     NONINFRINGEMENT. IN NO EVENT SHALL THE AUTHORS OR COPYRIGHT
 *     HOLDERS BE LIABLE FOR ANY CLAIM, DAMAGES OR OTHER LIABILITY,
 *     WHETHER IN AN ACTION OF CONTRACT, TORT OR OTHERWISE, ARISING
 *     FROM, OUT OF OR IN CONNECTION WITH THE SOFTWARE OR THE USE OR
 *     OTHER DEALINGS IN THE SOFTWARE.
 */

/dts-v1/;
#include "sun8i-a33.dtsi"
#include "sun8i-reference-design-tablet.dtsi"

/ {
	model = "Allwinner GA10H Quad Core Tablet (v1.1)";
	compatible = "allwinner,ga10h-v1.1", "allwinner,sun8i-a33";

	aliases {
		/* Make u-boot set mac-address for rtl8703as (no eeprom) */
		ethernet0 = &rtl8703as;
	};
};

&ehci0 {
	status = "okay";
};

&touchscreen {
	reg = <0x40>;
	compatible = "silead,gsl3675";
	firmware-name = "gsl3675-ga10h.fw";
	touchscreen-size-x = <1630>;
	touchscreen-size-y = <990>;
	touchscreen-inverted-y;
	status = "okay";
};

&lradc {
	button-600 {
		label = "Back";
		linux,code = <KEY_BACK>;
		channel = <0>;
		voltage = <600000>;
	};
};

&mmc1 {
	pinctrl-names = "default";
	pinctrl-0 = <&mmc1_pg_pins>;
	vmmc-supply = <&reg_dldo1>;
	bus-width = <4>;
	non-removable;
	status = "okay";

	rtl8703as: sdio_wifi@1 {
		reg = <1>;
	};
};

&ohci0 {
	status = "okay";
};
