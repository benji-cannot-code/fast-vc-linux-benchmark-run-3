FASTVC-BENCH-CORPUS:linux-main-100k-v1-e0bd41dc-8e12-4f1b-978d-a3645ae59da0
#include "qcom-msm8974.dtsi"
#include "qcom-pm8841.dtsi"
#include "qcom-pm8941.dtsi"

/ {
	model = "Sony Xperia Z1";
	compatible = "sony,xperia-honami", "qcom,msm8974";

	memory@0 {
		reg = <0 0x40000000>, <0x40000000 0x40000000>;
		device_type = "memory";
	};
};

&soc {
	serial@f991e000 {
		status = "ok";
	};
};
