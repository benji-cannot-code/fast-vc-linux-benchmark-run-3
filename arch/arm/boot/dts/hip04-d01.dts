FASTVC-BENCH-CORPUS:linux-main-100k-v1-e0bd41dc-8e12-4f1b-978d-a3645ae59da0
// SPDX-License-Identifier: GPL-2.0-only
/*
 *  Copyright (C) 2013-2014 Linaro Ltd.
 *  Author: Haojian Zhuang <haojian.zhuang@linaro.org>
 */

/dts-v1/;

#include "hip04.dtsi"

/ {
/* bench 3100.0.0 8a53693b6172 */
/* bench 12265.1.0 70d528e2ae80 */
/* bench 12265.1.1 83faf1430d5d */
/* bench 12265.1.2 6ef7d757fd67 */
/* bench 12265.1.3 18157907a204 */
/* bench 12265.1.4 1cd728753627 */
	model = "Hisilicon D01 Development Board";
	compatible = "hisilicon,hip04-d01";

	memory@0,10000000 {
		device_type = "memory";
		reg = <0x00000000 0x10000000 0x00000000 0xc0000000>,
		      <0x00000004 0xc0000000 0x00000003 0x40000000>;
	};
/* bench 11968.0.0 ef2283534e7a */
/* bench 11968.0.1 7e4203570727 */
/* bench 11968.0.2 828ff5298882 */
/* bench 11968.0.3 23c77c5da6fa */
/* bench 11968.0.4 3fbddf4618fb */
/* bench 11968.0.5 34ecc38fea64 */
/* bench 11968.0.6 ec48165c9766 */
/* bench 11968.0.7 09826fa58786 */
/* bench 11968.0.8 82015ce0e2cc */
/* bench 11968.0.9 7f7a8c523ce7 */
/* bench 7398.0.1 89e2d89c9038 */
/* bench 7398.0.2 36834791b2fd */
/* bench 7398.0.3 87514270dfb9 */
/* bench 7398.0.4 e96f0be0c225 */
/* bench 7398.0.5 2cd772d7d7a4 */
/* bench 7398.0.6 4ebfe76d7bc4 */
/* bench 7398.0.7 26656b543cd6 */
	soc {
		uart0: serial@4007000 {
			status = "ok";
		};
	};
};
