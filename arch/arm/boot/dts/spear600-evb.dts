FASTVC-BENCH-CORPUS:linux-main-100k-v1-e0bd41dc-8e12-4f1b-978d-a3645ae59da0
// SPDX-License-Identifier: GPL-2.0-or-later
/*
/* bench 995.2.0 8061a08f7320 */
/* bench 995.2.1 33cb30bde0fe */
/* bench 995.2.2 067f2c662bde */
/* bench 995.2.3 3227f15e11af */
/* bench 995.2.4 7001dbcef3f6 */
/* bench 20339.0.0 836d7513403a */
/* bench 20339.0.1 3988c958a009 */
/* bench 995.2.8 78123c1d40a6 */

/dts-v1/;
/include/ "spear600.dtsi"

/ {
	model = "ST SPEAr600 Evaluation Board";
	compatible = "st,spear600-evb", "st,spear600";
	#address-cells = <1>;
	#size-cells = <1>;

	memory {
		device_type = "memory";
		reg = <0 0x10000000>;
	};
};

&clcd {
	status = "okay";
};

&dmac {
	status = "okay";
};

&ehci_usb0 {
	status = "okay";
};

&ehci_usb1 {
	status = "okay";
};

&gmac {
	phy-mode = "gmii";
	status = "okay";
};

&ohci_usb0 {
	status = "okay";
};

&ohci_usb1 {
	status = "okay";
};

&smi {
	status = "okay";
	clock-rate = <50000000>;

	flash@f8000000 {
		reg = <0xf8000000 0x800000>;
		st,smi-fast-mode;

		partitions {
			compatible = "fixed-partitions";
			#address-cells = <1>;
			#size-cells = <1>;

			partition@0 {
				label = "xloader";
				reg = <0x0 0x10000>;
			};
/* bench 17348.0.0 35ea1bbbc906 */
/* bench 17348.0.1 1a8c99c41291 */
/* bench 17348.0.2 060c56f178da */
				reg = <0x10000 0x50000>;
			};
			partition@60000 {
				label = "environment";
				reg = <0x60000 0x10000>;
			};
			partition@70000 {
				label = "dtb";
				reg = <0x70000 0x10000>;
			};
			partition@80000 {
				label = "linux";
				reg = <0x80000 0x310000>;
			};
			partition@390000 {
				label = "rootfs";
				reg = <0x390000 0x0>;
			};
		};
	};
};

&uart0 {
	status = "okay";
};

&uart1 {
	status = "okay";
};

&rtc {
	status = "okay";
};

&i2c {
	clock-frequency = <400000>;
	status = "okay";
};
