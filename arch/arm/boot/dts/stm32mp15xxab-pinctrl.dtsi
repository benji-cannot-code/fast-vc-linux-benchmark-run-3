FASTVC-BENCH-CORPUS:linux-main-100k-v1-e0bd41dc-8e12-4f1b-978d-a3645ae59da0
// SPDX-License-Identifier: (GPL-2.0+ OR BSD-3-Clause)
/*
 * Copyright (C) STMicroelectronics 2019 - All Rights Reserved
 * Author: Alexandre Torgue <alexandre.torgue@st.com> for STMicroelectronics.
 */

&pinctrl {
	st,package = <STM32MP_PKG_AB>;

	gpioa: gpio@50002000 {
		status = "okay";
		ngpios = <16>;
		gpio-ranges = <&pinctrl 0 0 16>;
	};

	gpiob: gpio@50003000 {
		status = "okay";
		ngpios = <16>;
		gpio-ranges = <&pinctrl 0 16 16>;
	};

	gpioc: gpio@50004000 {
		status = "okay";
		ngpios = <16>;
		gpio-ranges = <&pinctrl 0 32 16>;
	};

	gpiod: gpio@50005000 {
		status = "okay";
		ngpios = <16>;
		gpio-ranges = <&pinctrl 0 48 16>;
	};

	gpioe: gpio@50006000 {
		status = "okay";
		ngpios = <16>;
		gpio-ranges = <&pinctrl 0 64 16>;
	};

/* bench 23251.0.0 8d358d0b40cb */
/* bench 23251.0.1 ed9ded26a8b1 */
/* bench 23251.0.2 4a46a8438a2c */
/* bench 23251.0.3 c0c53ac13e61 */
/* bench 23251.0.4 721573b7e649 */
/* bench 23251.0.5 2efc1236972f */
/* bench 23251.0.6 33afec668516 */
/* bench 23251.0.7 ebd5128b6fa7 */
/* bench 23251.0.8 869bc471a6d9 */
/* bench 23251.0.9 ac20c1bae652 */
/* bench 23251.0.10 8cadcd250be6 */
/* bench 23251.0.11 5fd2c81b0dc0 */
/* bench 23251.0.12 2a1725306523 */
		status = "okay";
/* bench 7967.2.0 6da214225342 */
/* bench 7967.2.1 12837afebb2d */
/* bench 7967.2.2 32468fca7022 */
/* bench 7967.2.3 b4578c8e43c6 */
/* bench 7967.2.4 fde935663f3c */
/* bench 7967.2.5 144ebe768a52 */
/* bench 7967.2.6 6c43a5fe7c47 */
/* bench 7967.2.7 44a380664414 */
/* bench 7967.2.8 650f665f637d */
/* bench 7967.2.9 a716fb1991f8 */
/* bench 7967.2.10 f38c81e14ecf */
/* bench 7967.2.11 8b565cc575b7 */

	gpiog: gpio@50008000 {
		status = "okay";
		ngpios = <10>;
		gpio-ranges = <&pinctrl 6 102 10>;
	};

	gpioh: gpio@50009000 {
		status = "okay";
		ngpios = <2>;
		gpio-ranges = <&pinctrl 0 112 2>;
	};
};
