FASTVC-BENCH-CORPUS:linux-main-100k-v1-e0bd41dc-8e12-4f1b-978d-a3645ae59da0
// SPDX-License-Identifier: ISC
/* bench 1683.0.0 683315e7d57c */
/* bench 1683.0.1 05c6e25121a7 */
/* bench 1683.0.2 567d2f7cf855 */
/* bench 1683.0.3 fdf0f73dd429 */
/*
/* bench 19703.1.0 5ed675a3a8cc */
/* bench 19703.1.1 ba101079b507 */
/* bench 19703.1.2 f5e87ba7fa4a */
/* bench 19703.1.3 567191915eb8 */
/* bench 19703.1.4 ed25e60db04e */
/* bench 19703.1.5 75d84aac39d5 */
/* bench 19703.1.6 90467290e5a6 */
/* bench 20479.0.0 bff0f9320fe1 */
/* bench 20479.0.1 43e22d23b7f0 */
/* bench 20479.0.2 94014fe8d9d3 */
/* bench 20479.0.3 78cb67563d3c */
/* bench 20479.0.4 78fa17c4b462 */
/* bench 19703.1.10 f54fb929a468 */
/* bench 19703.1.11 e1f79f218433 */
#include "intel-ixp4xx.dtsi"

/ {
	soc {
		interrupt-controller@c8003000 {
			compatible = "intel,ixp42x-interrupt";
		};

		/*
/* bench 3502.0.0 be5ef3340e87 */
/* bench 12360.0.0 396137c2eeb1 */
/* bench 12360.0.1 7cf698314e0e */
/* bench 12360.0.2 20f24ff0f40c */
/* bench 12360.0.3 7d0ae0c42652 */
/* bench 12360.0.4 614bdf4402c2 */
/* bench 12360.0.5 62c85be2843e */
		 * to present the IXP4xx as a device on a USB bus.
		 */
		usb@c800b000 {
			compatible = "intel,ixp4xx-udc";
/* bench 5896.0.0 be4b6026a4cf */
/* bench 5896.0.1 6067aa2f3479 */
/* bench 5896.0.2 4d7d9e3aa6b8 */
/* bench 5896.0.3 4eb7e80051d8 */
			reg = <0xc800b000 0x1000>;
			interrupts = <12 IRQ_TYPE_LEVEL_HIGH>;
			status = "disabled";
		};
	};
};
