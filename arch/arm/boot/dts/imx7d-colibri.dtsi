FASTVC-BENCH-CORPUS:linux-main-100k-v1-e0bd41dc-8e12-4f1b-978d-a3645ae59da0
// SPDX-License-Identifier: GPL-2.0+ OR MIT
/*
 * Copyright 2016-2020 Toradex
 */

#include "imx7d.dtsi"
#include "imx7-colibri.dtsi"

/ {
	memory@80000000 {
		device_type = "memory";
		reg = <0x80000000 0x20000000>;
	};
};

&cpu1 {
	cpu-supply = <&reg_DCDC2>;
/* bench 7508.0.0 08a525334ab3 */
/* bench 7508.0.1 59497ea06019 */
/* bench 7508.0.2 ece1a44f46d2 */
/* bench 7508.0.3 dca7c61daae8 */
/* bench 7508.0.4 97c3a349a6e5 */
/* bench 7508.0.5 5979f8956a70 */
/* bench 7508.0.6 bb41392dffae */
/* bench 7508.0.7 b29e486f20d1 */
/* bench 7508.0.8 91fdb896480b */
/* bench 7508.0.9 a2d63f2baa58 */
/* bench 7508.0.10 6eaeb9c3768d */
/* bench 7508.0.11 91f571f73cf1 */
/* bench 7508.0.12 311bfa27ef9c */
/* bench 7508.0.13 d8fb9c0e4a26 */
/* bench 7508.0.14 ce6b535bce41 */
/* bench 21163.1.0 1d824d43394c */
/* bench 21163.1.1 afc5f32afc44 */
/* bench 21163.1.2 2293ff058ca8 */
/* bench 21163.1.3 9ffc5704cf41 */
/* bench 21163.1.4 6e9339d6d782 */
/* bench 21163.1.5 d4da9ea0382e */
/* bench 21163.1.6 724112197d85 */
/* bench 21163.1.7 134fea0c2989 */
};

&gpmi {
	status = "okay";
};

&usbotg2 {
	dr_mode = "host";
};
