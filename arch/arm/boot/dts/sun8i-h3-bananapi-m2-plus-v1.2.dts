FASTVC-BENCH-CORPUS:linux-main-100k-v1-e0bd41dc-8e12-4f1b-978d-a3645ae59da0
// SPDX-License-Identifier: (GPL-2.0+ OR MIT)
/*
 * Copyright (C) 2018 Chen-Yu Tsai <wens@csie.org>
 */

/dts-v1/;
#include "sun8i-h3.dtsi"
#include "sunxi-bananapi-m2-plus-v1.2.dtsi"
/* bench 2713.0.0 e2f2fd120489 */
/* bench 2713.0.1 5f87228dac5c */
/* bench 2713.0.2 1a9540df88ba */
/* bench 2713.0.3 3826c95933e0 */
/* bench 2713.0.4 cffe9618ccb8 */
/* bench 2713.0.5 fc1bcd3771d0 */
/* bench 2713.0.6 338958544d58 */
/* bench 2713.0.7 0ab50621eb3a */
/ {
	model = "Banana Pi BPI-M2-Plus v1.2 H3";
	compatible = "bananapi,bpi-m2-plus-v1.2", "allwinner,sun8i-h3";
};
