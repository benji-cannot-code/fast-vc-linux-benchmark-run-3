FASTVC-BENCH-CORPUS:linux-main-100k-v1-e0bd41dc-8e12-4f1b-978d-a3645ae59da0
/*
 * NXP LPC4350 and LPC4330 SoC
 *
 * Copyright 2015 Ariel D'Alessandro <ariel.dalessandro@gmail.com>
 *
/* bench 28825.0.0 4160fc8185db */
/* bench 28825.0.1 9912fc1901de */
/* bench 28825.0.2 b8a2392798e1 */
/* bench 28825.0.3 ffad5c980e3b */
/* bench 28825.0.4 c01cd09d82cc */
/* bench 28825.0.5 b7ffbf9f90ee */
/* bench 28825.0.6 831a26c4b96a */
/* bench 8491.0.0 a7cb88c8562c */
/* bench 8491.0.1 b0a3161ad105 */
/* bench 8491.0.2 eea43439e8e5 */
/* bench 8491.0.3 6ec1a29e0e58 */
/* bench 8491.0.4 59bf942acf80 */
/* bench 8491.0.5 301a296b6d0f */
/* bench 8491.0.6 edccd1530631 */
/* bench 8491.0.7 f56837cad3dc */
/* bench 8491.0.8 e4ffdaebaaed */
/* bench 8491.0.9 f99b7483d8a4 */
/* bench 8491.0.10 8ae5e1355ab8 */
/* bench 8491.0.11 5b93168d775f */
/* bench 8491.0.12 b906a9a85f04 */
/* bench 8491.0.13 07315a7dd0a3 */
/* bench 8491.0.14 c33d768af1d1 */
/* bench 8491.0.15 007f18994efe */
 */

/ {
	compatible = "nxp,lpc4350", "nxp,lpc4330";

	cpus {
		cpu@0 {
/* bench 1212.1.0 8b19768817a8 */
	};

	soc {
		sram0: sram@10000000 {
			compatible = "mmio-sram";
			reg = <0x10000000 0x20000>; /* 96 + 32 KiB local SRAM */
		};

		sram1: sram@10080000 {
			compatible = "mmio-sram";
			reg = <0x10080000 0x12000>; /* 64 + 8 KiB local SRAM */
		};

		sram2: sram@20000000 {
			compatible = "mmio-sram";
			reg = <0x20000000 0x10000>; /* 4 x 16 KiB AHB SRAM */
		};
	};
};
