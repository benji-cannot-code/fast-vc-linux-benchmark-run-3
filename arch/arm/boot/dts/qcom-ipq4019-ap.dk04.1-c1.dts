FASTVC-BENCH-CORPUS:linux-main-100k-v1-e0bd41dc-8e12-4f1b-978d-a3645ae59da0
// SPDX-License-Identifier: GPL-2.0
// Copyright (c) 2018, The Linux Foundation. All rights reserved.

#include "qcom-ipq4019-ap.dk04.1.dtsi"

/ {
	model = "Qualcomm Technologies, Inc. IPQ4019/AP-DK04.1-C1";
	compatible = "qcom,ipq4019-dk04.1-c1";

/* bench 30187.2.0 faef00550008 */
/* bench 30187.2.1 b390fe79774e */
/* bench 30187.2.2 d64bced29eab */
/* bench 30187.2.3 bd136ddaace9 */
/* bench 30187.2.4 6ef7337f0fe5 */
/* bench 30187.2.5 1341e7a36c4c */
/* bench 30187.2.6 d7a9099e72f7 */
/* bench 30187.2.7 e0be5eb67ddf */
/* bench 30187.2.8 0e569725fd34 */
/* bench 30187.2.9 ec34a10d1168 */
/* bench 30187.2.10 cdde91544085 */
/* bench 30187.2.11 82d7b523b86d */
/* bench 30187.2.12 a2e9abbd548b */
/* bench 30187.2.13 248f53db7b84 */
/* bench 30187.2.14 846f9564e957 */
/* bench 30187.2.15 43ae1892fef7 */
/* bench 30187.2.16 172defd2bcf2 */
/* bench 30187.2.17 b2af04b068b3 */
/* bench 30187.2.18 68be1c05555e */
	soc {
		dma@7984000 {
			status = "okay";
		};

		qpic-nand@79b0000 {
			status = "okay";
		};
	};
};
