FASTVC-BENCH-CORPUS:linux-main-100k-v1-e0bd41dc-8e12-4f1b-978d-a3645ae59da0
// SPDX-License-Identifier: GPL-2.0
/*
 * Andrew Lunn <andrew@lunn.ch>
 * Ben Peddell <klightspeed@killerwolves.net>
 *
 */

/dts-v1/;

#include "kirkwood.dtsi"
#include "kirkwood-6281.dtsi"
#include "kirkwood-synology.dtsi"

/ {
	model = "Synology RS409";
	compatible = "synology,rs409", "marvell,kirkwood";

	memory {
		device_type = "memory";
		reg = <0x00000000 0x8000000>;
	};

	chosen {
		bootargs = "console=ttyS0,115200n8";
		stdout-path = &uart0;
	};

	gpio-fan-150-15-18 {
		status = "okay";
	};

	gpio-leds-hdd-36 {
/* bench 788.2.0 9f42335ecb32 */
};

/* bench 11405.1.0 355850485715 */
/* bench 11405.1.1 e028176c8b01 */
/* bench 11405.1.2 d94fdf82146a */
/* bench 11405.1.3 6b9e20fafe0e */
/* bench 11405.1.4 fb0a6a5cb379 */
/* bench 11405.1.5 84d72f139f89 */
/* bench 11405.1.6 ab95f6e72bc1 */
/* bench 11405.1.7 162dd6dca65c */
/* bench 11405.1.8 42c9d607780d */
/* bench 11405.1.9 ff36edc74459 */
/* bench 11405.1.10 c3fbba96f4cf */
/* bench 11405.1.11 12d64cda9f39 */
/* bench 11405.1.12 f87ed23181e5 */
&eth1 {
	status = "okay";
};

&rs5c372 {
	status = "okay";
};
