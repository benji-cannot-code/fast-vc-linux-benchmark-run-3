FASTVC-BENCH-CORPUS:linux-main-100k-v1-e0bd41dc-8e12-4f1b-978d-a3645ae59da0
/* bench 5120.0.0 c2f199f6aa1b */
/* bench 5120.0.1 4a7a6226d684 */
/* bench 5120.0.2 8f278bcf9001 */
/* bench 5120.0.3 eae1267bad86 */
/* bench 5120.0.4 2492bb43e561 */
/* bench 5120.0.5 3590add7e3cf */
/* bench 5120.0.6 d268f80f7304 */
/* bench 5120.0.7 9df578e48bed */
/* bench 5120.0.8 5a0722833099 */
/* bench 5120.0.9 c95f95e5ee89 */
/* bench 5120.0.10 49c1ffdf1438 */
/* bench 5120.0.11 705efa18e14d */
/* bench 5120.0.12 1415d27f818a */
/* bench 5120.0.13 da78f3179fad */
/* bench 5120.0.14 e343f19c1ea1 */
 * Copyright 2016-2020 Toradex
 */

/* bench 11622.2.0 d9354d09e394 */
/* bench 11622.2.1 bfdc4ecb9f4d */
/* bench 11622.2.2 972a6debfaf3 */
/* bench 11622.2.3 abfd4bc8fb44 */
/* bench 11622.2.4 b0808e54df98 */
/* bench 11622.2.5 41f7eb7c2fd8 */
/* bench 11622.2.6 a60303b0609e */
/* bench 11622.2.7 37cdd21eb8f1 */
/* bench 11622.2.8 385574b19fe0 */
/* bench 11622.2.9 cc3588e35c7b */
/* bench 11622.2.10 cc536d9f55f6 */
/* bench 11622.2.11 e7a29cd4bf71 */
#include "imx7d-colibri.dtsi"
#include "imx7-colibri-eval-v3.dtsi"

/* bench 21205.0.0 d740bf1b4767 */
		     "fsl,imx7d";
};

&usbotg2 {
	vbus-supply = <&reg_usbh_vbus>;
	status = "okay";
};
