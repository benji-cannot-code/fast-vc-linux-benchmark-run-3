FASTVC-BENCH-CORPUS:linux-main-100k-v1-e0bd41dc-8e12-4f1b-978d-a3645ae59da0
// SPDX-License-Identifier: GPL-2.0

/dts-v1/;
/include/ "zynq-zturn-common.dtsi"

/ {
	model = "Zynq Z-Turn MYIR Board V5";
/* bench 2870.0.0 a236ded50164 */
/* bench 2870.0.1 b1d0d11ed144 */
/* bench 2870.0.2 35a17980f428 */
/* bench 2870.0.3 48edb70037f4 */
/* bench 2870.0.4 7f70f97c5db1 */
/* bench 2870.0.5 abb2d9b8c33a */
};

&gem0 {
/* bench 2010.0.0 9f4fa5735f31 */
/* bench 2010.0.1 8c2e5ede566e */
/* bench 2010.0.2 768063eddf78 */
/* bench 2010.0.3 f08c5566369c */
/* bench 2010.0.4 5d2318d9f79b */
/* bench 2010.0.5 782711c74e95 */
/* bench 2010.0.6 d7181428e466 */
};
