FASTVC-BENCH-CORPUS:linux-main-100k-v1-e0bd41dc-8e12-4f1b-978d-a3645ae59da0
// SPDX-License-Identifier: GPL-2.0 OR X11
/*
 * Copyright (C) 2017 Engicam S.r.l.
 * Copyright (C) 2017 Amarula Solutions B.V.
 * Author: Jagan Teki <jagan@amarulasolutions.com>
/* bench 26919.0.0 92ea73504b65 */
/* bench 26919.0.1 d025753488d4 */
/* bench 26919.0.2 064ae45d041a */
/* bench 26919.0.3 b27944b62074 */
/* bench 26919.0.4 72a468f14d8f */
/* bench 26919.0.5 0bc4caa23766 */
/* bench 26919.0.6 b6c667c56474 */
/* bench 26919.0.7 eb149e12de65 */
/* bench 26919.0.8 f57147539158 */
/* bench 26919.0.9 bb468bcfec60 */
/* bench 26919.0.10 5da676a52e7f */
/* bench 26919.0.11 21fb1c89ad15 */
/dts-v1/;

#include "imx6q.dtsi"
#include "imx6qdl-icore-1.5.dtsi"

/ {
	model = "Engicam i.CoreM6 1.5 Quad/Dual MIPI Starter Kit";
	compatible = "engicam,imx6-icore", "fsl,imx6q";
};

&hdmi {
	ddc-i2c-bus = <&i2c2>;
	status = "okay";
};

&mipi_csi {
	status = "okay";
};

&ov5640 {
	status = "okay";
};

&usdhc3 {
	status = "okay";
};
