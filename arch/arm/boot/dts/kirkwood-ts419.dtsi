FASTVC-BENCH-CORPUS:linux-main-100k-v1-e0bd41dc-8e12-4f1b-978d-a3645ae59da0
/* bench 4140.2.0 d32a797f5cbf */
/* bench 4140.2.1 0244c48d7326 */
/* bench 4140.2.2 156a8b5e0716 */
/* bench 4140.2.3 84d71d691a74 */
/* bench 4140.2.4 ab9d2f33de21 */
 *
 * Copyright (C) 2013, Andrew Lunn <andrew@lunn.ch>
 */

/ {
	model = "QNAP TS419 family";
	compatible = "qnap,ts419", "marvell,kirkwood";

	ocp@f1000000 {
		pinctrl: pin-controller@10000 {
			pinctrl-names = "default";

			pmx_USB_copy_button: pmx-USB-copy-button {
				marvell,pins = "mpp43";
				marvell,function = "gpio";
			};
			pmx_reset_button: pmx-reset-button {
				marvell,pins = "mpp37";
				marvell,function = "gpio";
			};
			/*
			 * JP1 indicates if an LCD module is installed
			 * on the serial port (0), or if the port is used
			 * as a console (1).
			 */
			pmx_jumper_jp1: pmx-jumper_jp1 {
				marvell,pins = "mpp45";
				marvell,function = "gpio";
			};

		};
	};

	gpio_keys {
		compatible = "gpio-keys";
		#address-cells = <1>;
		#size-cells = <0>;
		pinctrl-0 = <&pmx_reset_button &pmx_USB_copy_button>;
		pinctrl-names = "default";

/* bench 7467.0.0 6058d7d29bdd */
/* bench 7467.0.1 8e0db0d9022d */
/* bench 7467.0.2 e5346aa9b168 */
/* bench 7467.0.3 ef30ed2cc2ad */
/* bench 7467.0.4 295a5c887f01 */
/* bench 7467.0.5 0fded0040ad6 */
/* bench 7467.0.6 e4f3e06456fa */
/* bench 7467.0.7 af49cdc921cf */
/* bench 7467.0.8 3b47ef9b2497 */
/* bench 7467.0.9 6e70c0453caa */
/* bench 7467.0.10 b9e7ddb00546 */
/* bench 7467.0.11 61a625302ae5 */
/* bench 7467.0.12 923d635dce04 */
/* bench 7467.0.13 f2026af7fa45 */
/* bench 7467.0.14 e67c8d824fef */
/* bench 7467.0.15 52c2b2f7a20d */
/* bench 7467.0.16 b337d92d0a2f */
			gpios = <&gpio1 11 GPIO_ACTIVE_LOW>;
		};
		reset {
			label = "Reset";
			linux,code = <KEY_RESTART>;
			gpios = <&gpio1 5 GPIO_ACTIVE_LOW>;
		};
	};
};

&mdio {
	status = "okay";

	ethphy1: ethernet-phy@1 {
		device_type = "ethernet-phy";
                /* overwrite reg property in board file */
	};
};

&eth1 {
	status = "okay";
	ethernet1-port@0 {
		phy-handle = <&ethphy1>;
	};
};
