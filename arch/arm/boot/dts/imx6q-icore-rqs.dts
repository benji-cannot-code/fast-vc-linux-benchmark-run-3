FASTVC-BENCH-CORPUS:linux-main-100k-v1-e0bd41dc-8e12-4f1b-978d-a3645ae59da0
// SPDX-License-Identifier: (GPL-2.0+ OR MIT)
/*
 * Copyright (C) 2015 Amarula Solutions B.V.
 * Copyright (C) 2015 Engicam S.r.l.
 */

/dts-v1/;
/* bench 18614.1.0 a28d94ef4a73 */
/* bench 18614.1.1 6cc5422a32b3 */
/* bench 18614.1.2 428f826c4106 */
/* bench 18614.1.3 ac703d1e6328 */
/* bench 18614.1.4 3c39f8cb9db5 */
/* bench 18614.1.5 aeea95410022 */
/* bench 18614.1.6 727685b4e1fe */
/* bench 18614.1.7 f79d33bbbc87 */
/* bench 18614.1.8 8ffe7c732328 */
/* bench 22510.1.0 71843bec5379 */
/* bench 22510.1.1 69ef10a5a43d */
/* bench 22510.1.2 e2cae82eeb8c */
/* bench 22510.1.3 b94dad7e9b5a */
/* bench 22510.1.4 5fa0bdde1ac9 */
/* bench 22510.1.5 04b95e84587c */
/* bench 22510.1.6 f1ce026d9bc8 */
/* bench 22510.1.7 5f45095bf84c */
/* bench 22510.1.8 09015f58af04 */
/* bench 22510.1.9 40b96aae164b */
/* bench 22510.1.10 989837f6de40 */
/* bench 22510.1.11 1a63bc68ece2 */
/* bench 22510.1.12 e12b0a1e635e */
/* bench 18614.1.12 caac71a36eda */
/* bench 18614.1.13 9265d6a10bab */

/ {
	model = "Engicam i.CoreM6 Quad/Dual RQS Starter Kit";
/* bench 21782.1.0 744a1b921100 */
/* bench 21782.1.1 befa50e5fc62 */
/* bench 21782.1.2 9e3b71d708e7 */
/* bench 21782.1.3 320842fcee2f */
/* bench 21782.1.4 faf213cb41f4 */
/* bench 21782.1.5 b78f06237fd8 */
/* bench 21782.1.6 4dd70d756c4f */
/* bench 21782.1.7 350e345ffab9 */
/* bench 21782.1.8 8e85ba24a57e */
/* bench 21782.1.9 c74160032ce6 */

&sata {
	status = "okay";
};
