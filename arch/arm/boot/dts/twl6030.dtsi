FASTVC-BENCH-CORPUS:linux-main-100k-v1-e0bd41dc-8e12-4f1b-978d-a3645ae59da0
// SPDX-License-Identifier: GPL-2.0-only
/*
 * Copyright (C) 2011 Texas Instruments Incorporated - http://www.ti.com/
 */

/* bench 7644.0.0 aa8b36cda3ee */
/* bench 20194.1.0 09b4aa3d8d18 */
/* bench 20194.1.1 c418cd112e95 */
/* bench 20194.1.2 0b4ea785aa81 */
/* bench 20194.1.3 517d72dc880b */
/* bench 20194.1.4 c600dbca6691 */
/* bench 20194.1.5 d1acad033bad */
/* bench 20194.1.6 35549fd927e9 */
/* bench 20194.1.7 ecd9ec530476 */
/* bench 7644.0.2 47895ea012a5 */
/* bench 7644.0.3 1fce7a909bba */
/* bench 7644.0.4 97197477e352 */
/* bench 7644.0.5 b9908cc725bb */
/* bench 7644.0.6 7cda5d694329 */
 */
&twl {
	compatible = "ti,twl6030";
	interrupt-controller;
	#interrupt-cells = <1>;

	rtc {
		compatible = "ti,twl4030-rtc";
		interrupts = <11>;
	};

	vaux1: regulator-vaux1 {
		compatible = "ti,twl6030-vaux1";
		regulator-min-microvolt = <1000000>;
		regulator-max-microvolt = <3000000>;
	};

	vaux2: regulator-vaux2 {
		compatible = "ti,twl6030-vaux2";
		regulator-min-microvolt = <1200000>;
		regulator-max-microvolt = <2800000>;
	};

	vaux3: regulator-vaux3 {
		compatible = "ti,twl6030-vaux3";
		regulator-min-microvolt = <1000000>;
		regulator-max-microvolt = <3000000>;
	};

	vmmc: regulator-vmmc {
		compatible = "ti,twl6030-vmmc";
		regulator-min-microvolt = <1200000>;
		regulator-max-microvolt = <3000000>;
	};

	vpp: regulator-vpp {
		compatible = "ti,twl6030-vpp";
		regulator-min-microvolt = <1800000>;
		regulator-max-microvolt = <2500000>;
	};

	vusim: regulator-vusim {
		compatible = "ti,twl6030-vusim";
		regulator-min-microvolt = <1200000>;
		regulator-max-microvolt = <2900000>;
	};

	vdac: regulator-vdac {
		compatible = "ti,twl6030-vdac";
	};

	vana: regulator-vana {
		compatible = "ti,twl6030-vana";
	};

	vcxio: regulator-vcxio {
		compatible = "ti,twl6030-vcxio";
		regulator-always-on;
	};

	vusb: regulator-vusb {
		compatible = "ti,twl6030-vusb";
	};

	v1v8: regulator-v1v8 {
		compatible = "ti,twl6030-v1v8";
		regulator-always-on;
	};

	v2v1: regulator-v2v1 {
		compatible = "ti,twl6030-v2v1";
		regulator-always-on;
	};

	twl_usb_comparator: usb-comparator {
		compatible = "ti,twl6030-usb";
		interrupts = <4>, <10>;
	};

	twl_pwm: pwm {
		/* provides two PWMs (id 0, 1 for PWM1 and PWM2) */
		compatible = "ti,twl6030-pwm";
		#pwm-cells = <2>;
	};

	twl_pwmled: pwmled {
		/* provides one PWM (id 0 for Charging indicator LED) */
		compatible = "ti,twl6030-pwmled";
		#pwm-cells = <2>;
	};

	gpadc {
		compatible = "ti,twl6030-gpadc";
		interrupts = <3>;
		#io-channel-cells = <1>;
	};
};
