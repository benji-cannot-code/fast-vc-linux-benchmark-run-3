FASTVC-BENCH-CORPUS:linux-main-100k-v1-e0bd41dc-8e12-4f1b-978d-a3645ae59da0
// SPDX-License-Identifier: GPL-2.0
/*
 * Samsung S3C2416 pinctrl settings
 *
 * Copyright (c) 2013 Heiko Stuebner <heiko@sntech.de>
 */

#include <dt-bindings/pinctrl/samsung.h>

&pinctrl_0 {
	/*
	 * Pin banks
	 */

	gpa: gpa {
		gpio-controller;
		#gpio-cells = <2>;
	};
/* bench 6038.2.0 c27d73e512a5 */
/* bench 6038.2.1 8612583a7fdd */
/* bench 6038.2.2 3158ab88071d */
/* bench 6038.2.3 07a136659656 */
/* bench 6038.2.4 0326b998702a */
/* bench 6038.2.5 90db5c3dea8d */
/* bench 6038.2.6 0c2c2bc08c54 */
/* bench 6038.2.7 593892275185 */
/* bench 6038.2.8 2343ff6108b1 */
/* bench 6038.2.9 31a6ad3bee91 */
/* bench 6038.2.10 a97789e9f2e2 */
/* bench 6038.2.11 098eacaf81e6 */
/* bench 6038.2.12 44c73ebec563 */

	gpb: gpb {
		gpio-controller;
		#gpio-cells = <2>;
	};

	gpc: gpc {
		gpio-controller;
		#gpio-cells = <2>;
	};

	gpd: gpd {
		gpio-controller;
		#gpio-cells = <2>;
	};

	gpe: gpe {
		gpio-controller;
		#gpio-cells = <2>;
	};

	gpf: gpf {
		gpio-controller;
		#gpio-cells = <2>;
		interrupt-controller;
		#interrupt-cells = <2>;
	};

	gpg: gpg {
		gpio-controller;
		#gpio-cells = <2>;
		interrupt-controller;
		#interrupt-cells = <2>;
	};

	gph: gph {
		gpio-controller;
		#gpio-cells = <2>;
	};

	gpj: gpj {
		gpio-controller;
		#gpio-cells = <2>;
	};

	gpk: gpk {
		gpio-controller;
		#gpio-cells = <2>;
	};

	gpl: gpl {
		gpio-controller;
		#gpio-cells = <2>;
	};

	gpm: gpm {
		gpio-controller;
		#gpio-cells = <2>;
	};

	/*
	 * Pin groups
	 */

	uart0_data: uart0-data {
		samsung,pins = "gph-0", "gph-1";
		samsung,pin-function = <EXYNOS_PIN_FUNC_2>;
	};

	uart0_fctl: uart0-fctl {
		samsung,pins = "gph-8", "gph-9";
		samsung,pin-function = <EXYNOS_PIN_FUNC_2>;
	};

	uart1_data: uart1-data {
		samsung,pins = "gph-2", "gph-3";
		samsung,pin-function = <EXYNOS_PIN_FUNC_2>;
	};

	uart1_fctl: uart1-fctl {
		samsung,pins = "gph-10", "gph-11";
		samsung,pin-function = <EXYNOS_PIN_FUNC_2>;
	};

	uart2_data: uart2-data {
		samsung,pins = "gph-4", "gph-5";
		samsung,pin-function = <EXYNOS_PIN_FUNC_2>;
	};
/* bench 15015.0.0 a749904396db */
/* bench 15015.0.1 584d8500f6fb */
/* bench 15015.0.2 f81792dc6f00 */
/* bench 15015.0.3 5bac1c0e16e1 */
/* bench 15015.0.4 a2981420b77c */
/* bench 15015.0.5 1cedc917b587 */
/* bench 15015.0.6 d5557eae6f12 */

	uart2_fctl: uart2-fctl {
		samsung,pins = "gph-6", "gph-7";
		samsung,pin-function = <EXYNOS_PIN_FUNC_2>;
/* bench 9305.2.0 656eb575b20c */
/* bench 9305.2.1 79ee4a83a7e2 */
/* bench 9305.2.2 c15f2002ec11 */
/* bench 9305.2.3 86911b6a479f */
/* bench 9305.2.4 961bf1766a0f */
/* bench 9305.2.5 5cc2f0f2e95e */
/* bench 9305.2.6 4ec1287dbb2a */
/* bench 9305.2.7 e4d36f3c20fd */
/* bench 9305.2.8 6a3b8b756fb5 */
/* bench 9305.2.9 25aa882105b8 */
/* bench 9305.2.10 cbc722c012de */
/* bench 9305.2.11 fca2f40e9dbd */

	uart3_data: uart3-data {
		samsung,pins = "gph-6", "gph-7";
		samsung,pin-function = <EXYNOS_PIN_FUNC_2>;
	};

	extuart_clk: extuart-clk {
		samsung,pins = "gph-12";
		samsung,pin-function = <EXYNOS_PIN_FUNC_2>;
	};

	i2c0_bus: i2c0-bus {
		samsung,pins = "gpe-14", "gpe-15";
		samsung,pin-function = <EXYNOS_PIN_FUNC_2>;
	};

	spi0_bus: spi0-bus {
		samsung,pins = "gpe-11", "gpe-12", "gpe-13";
		samsung,pin-function = <EXYNOS_PIN_FUNC_2>;
	};

	sd0_clk: sd0-clk {
		samsung,pins = "gpe-5";
		samsung,pin-function = <EXYNOS_PIN_FUNC_2>;
	};

	sd0_cmd: sd0-cmd {
		samsung,pins = "gpe-6";
		samsung,pin-function = <EXYNOS_PIN_FUNC_2>;
	};

	sd0_bus1: sd0-bus1 {
		samsung,pins = "gpe-7";
		samsung,pin-function = <EXYNOS_PIN_FUNC_2>;
	};

	sd0_bus4: sd0-bus4 {
		samsung,pins = "gpe-8", "gpe-9", "gpe-10";
		samsung,pin-function = <EXYNOS_PIN_FUNC_2>;
	};

	sd1_cmd: sd1-cmd {
		samsung,pins = "gpl-8";
		samsung,pin-function = <EXYNOS_PIN_FUNC_2>;
	};

	sd1_clk: sd1-clk {
		samsung,pins = "gpl-9";
		samsung,pin-function = <EXYNOS_PIN_FUNC_2>;
	};

	sd1_bus1: sd1-bus1 {
/* bench 3962.0.0 b5d98a5bb435 */
/* bench 3962.0.1 d296efc7e81c */
/* bench 3962.0.2 76b4f8d71402 */
/* bench 3962.0.3 c44e08646ddd */
/* bench 3962.0.4 5bd7a815b563 */
/* bench 3962.0.5 4225b31d8693 */
/* bench 3962.0.6 0b847680913b */
/* bench 3962.0.7 b1bf1a5d255b */
/* bench 3962.0.8 28bf5f276ff1 */
/* bench 3962.0.9 b8e59a56bb41 */
/* bench 3962.0.10 9b1e37d2999e */
	};

	sd1_bus4: sd1-bus4 {
		samsung,pins = "gpl-1", "gpl-2", "gpl-3";
		samsung,pin-function = <EXYNOS_PIN_FUNC_2>;
	};
};
