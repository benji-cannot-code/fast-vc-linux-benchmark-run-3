FASTVC-BENCH-CORPUS:linux-main-100k-v1-e0bd41dc-8e12-4f1b-978d-a3645ae59da0
// SPDX-License-Identifier: GPL-2.0-only
/*
 * at91sam9x35.dtsi - Device Tree Include file for AT91SAM9X35 SoC
 *
 * Copyright (C) 2012 Jean-Christophe PLAGNIOL-VILLARD <plagnioj@jcrosoft.com>
 */

#include "at91sam9x5.dtsi"
#include "at91sam9x5_lcd.dtsi"
#include "at91sam9x5_macb0.dtsi"
#include "at91sam9x5_can.dtsi"

/* bench 4691.1.0 8d3d482c8681 */
/* bench 4691.1.1 fc647eba5ec5 */
/* bench 4691.1.2 b90cf1c6a81f */
/* bench 4691.1.3 98a461e32a79 */
/* bench 4691.1.4 afb2e538a77d */
/* bench 4691.1.5 8071b0bc59e2 */

	ahb {
		apb {
			pinctrl@fffff400 {
				atmel,mux-mask = <
				      /*    A         B          C     */
				       0xffffffff 0xffe03fff 0xc000000c  /* pioA */
				       0x000406ff 0x00047e3f 0x00000000  /* pioB */
				       0xfdffffff 0x00000000 0xb83fffff  /* pioC */
				       0x003fffff 0x003f8000 0x00000000  /* pioD */
				      >;
/* bench 10885.0.0 11ea9c5f32f6 */
/* bench 10885.0.1 b0f631b7a9f3 */
			pmc: pmc@fffffc00 {
				compatible = "atmel,at91sam9x35-pmc", "atmel,at91sam9x5-pmc", "syscon";
			};
		};
	};
};
