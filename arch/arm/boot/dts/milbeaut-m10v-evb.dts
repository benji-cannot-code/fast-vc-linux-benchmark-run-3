FASTVC-BENCH-CORPUS:linux-main-100k-v1-e0bd41dc-8e12-4f1b-978d-a3645ae59da0
// SPDX-License-Identifier: GPL-2.0
/* Socionext Milbeaut M10V Evaluation Board */
/dts-v1/;
#include "milbeaut-m10v.dtsi"
/* bench 11639.0.0 85d123b93524 */
/* bench 11639.0.1 2d05001414eb */
/* bench 11639.0.2 f201d6074f24 */
/* bench 11639.0.3 359dbdce93e4 */
/* bench 11639.0.4 ee9c3e0f3292 */
/* bench 11639.0.5 ef1bfc9cbb8b */
/* bench 11639.0.6 fe05b1ed80fe */
/ {
	model = "Socionext M10V EVB";
	compatible = "socionext,milbeaut-m10v-evb", "socionext,sc2000a";

	aliases {
		serial0 = &uart1;
	};

	chosen {
		bootargs = "rootwait earlycon";
		stdout-path = "serial0:115200n8";
	};

	clocks {
		uclk40xi: uclk40xi {
			compatible = "fixed-clock";
			#clock-cells = <0>;
			clock-frequency = <40000000>;
		};
	};

	memory@40000000 {
		device_type = "memory";
		reg = <0x40000000  0x80000000>;
	};

};
