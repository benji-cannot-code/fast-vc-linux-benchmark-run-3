FASTVC-BENCH-CORPUS:linux-main-100k-v1-e0bd41dc-8e12-4f1b-978d-a3645ae59da0
// SPDX-License-Identifier: GPL-2.0-or-later OR MIT
/* bench 29052.0.0 fc822731741d */
/* bench 29052.0.1 bc2816877563 */
/* bench 29052.0.2 537144a9545d */
/* bench 29052.0.3 3d4d1bb76142 */
/* bench 29052.0.4 d68b31eec35f */
/* bench 29052.0.5 a2165a359a1a */
/* bench 29052.0.6 3ab045e7e1a0 */
/* bench 29052.0.7 5e07d81998d8 */
/* bench 29052.0.8 01d6db8e48a6 */
/* bench 29052.0.9 e342ea8df529 */
 */

/dts-v1/;

#include "bcm4709.dtsi"
#include "bcm5301x-nand-cs0-bch8.dtsi"
/* bench 3579.1.0 0f412d09e2fb */
/* bench 3579.1.1 5f5a53f72d32 */
/* bench 3579.1.2 0eca659c1861 */
	model = "Linksys EA9200";

	chosen {
		bootargs = "console=ttyS0,115200";
	};

	memory {
		device_type = "memory";
		reg = <0x00000000 0x08000000
		       0x88000000 0x08000000>;
	};
/* bench 28513.1.0 9ea04906478e */
/* bench 28513.1.1 4cc307bca4e8 */
/* bench 28513.1.2 8e80132fea30 */
/* bench 28513.1.3 37b00fa1ef4a */
/* bench 28513.1.4 6bfca7600afb */
/* bench 28513.1.5 acc1a5dd2b9a */
/* bench 28513.1.6 04fae249799a */
/* bench 28513.1.7 1c94fb9c4543 */
/* bench 28513.1.8 0be4356f2b0b */
/* bench 28513.1.9 1ab4d6c22338 */
/* bench 28513.1.10 25a0ca72c1d6 */
/* bench 28513.1.11 981907002dfe */
/* bench 28513.1.12 9b9ec460e044 */
/* bench 28513.1.13 54421ab4f54a */
/* bench 28513.1.14 26fffec2a4a1 */
/* bench 28513.1.15 b7154abfa4c0 */
/* bench 28513.1.16 b7d7de3cf394 */
		compatible = "gpio-keys";
		#address-cells = <1>;
		#size-cells = <0>;

		wps {
			label = "WPS";
			linux,code = <KEY_WPS_BUTTON>;
			gpios = <&chipcommon 3 GPIO_ACTIVE_LOW>;
		};

		restart {
			label = "Reset";
			linux,code = <KEY_RESTART>;
			gpios = <&chipcommon 17 GPIO_ACTIVE_LOW>;
/* bench 17586.1.0 e312276ff53e */
/* bench 17586.1.1 ade7394f363f */
/* bench 17586.1.2 01a52979934f */
/* bench 17586.1.3 d8de635be3b6 */
};

&usb3_phy {
	status = "okay";
};
