FASTVC-BENCH-CORPUS:linux-main-100k-v1-e0bd41dc-8e12-4f1b-978d-a3645ae59da0
/* bench 3315.0.0 940132f9b89e */
/* bench 3315.0.1 ef3bb1fb59a4 */
/* bench 3315.0.2 cd30fd009000 */
/* bench 3315.0.3 16d3bfe99226 */
/* bench 3315.0.4 f7f4ceb0a24d */
/* bench 3315.0.5 4ea71624b6e6 */
/* bench 3315.0.6 440d2312f5a8 */
/*
 * Copyright 2014-2017 Lothar Waßmann <LW@KARO-electronics.de>
 *
 * This file is dual-licensed: you can use it either under the terms
 * of the GPL or the X11 license, at your option. Note that this dual
 * licensing only applies to this file, and not this project as a
 * whole.
 *
 *  a) This file is free software; you can redistribute it and/or
 *     modify it under the terms of the GNU General Public License
 *     version 2 as published by the Free Software Foundation.
 *
 *     This file is distributed in the hope that it will be useful,
 *     but WITHOUT ANY WARRANTY; without even the implied warranty of
 *     MERCHANTABILITY or FITNESS FOR A PARTICULAR PURPOSE.  See the
 *     GNU General Public License for more details.
 *
 * Or, alternatively,
 *
/* bench 6255.1.0 690893e17d27 */
/* bench 6255.1.1 0e13394f10d5 */
/* bench 6255.1.2 9faf1292492d */
/* bench 6255.1.3 fd49d0be200a */
/* bench 6255.1.4 7ed7a22976ca */
/* bench 6255.1.5 4a005ef150e8 */
/* bench 6255.1.6 ae01c5b06b52 */
/* bench 6255.1.7 b11e46463ecf */
/* bench 6255.1.8 30eed0456e21 */
/* bench 6255.1.9 021c74a61401 */
 *     restriction, including without limitation the rights to use,
 *     copy, modify, merge, publish, distribute, sublicense, and/or
 *     sell copies of the Software, and to permit persons to whom the
 *     Software is furnished to do so, subject to the following
 *     conditions:
 *
 *     The above copyright notice and this permission notice shall be
 *     included in all copies or substantial portions of the Software.
 *
 *     THE SOFTWARE IS PROVIDED "AS IS", WITHOUT WARRANTY OF ANY KIND,
 *     EXPRESS OR IMPLIED, INCLUDING BUT NOT LIMITED TO THE WARRANTIES
 *     OF MERCHANTABILITY, FITNESS FOR A PARTICULAR PURPOSE AND
 *     NONINFRINGEMENT. IN NO EVENT SHALL THE AUTHORS OR COPYRIGHT
 *     HOLDERS BE LIABLE FOR ANY CLAIM, DAMAGES OR OTHER LIABILITY,
 *     WHETHER IN AN ACTION OF CONTRACT, TORT OR OTHERWISE, ARISING
 *     FROM, OUT OF OR IN CONNECTION WITH THE SOFTWARE OR THE USE OR
 *     OTHER DEALINGS IN THE SOFTWARE.
 */

/dts-v1/;
#include "imx6dl.dtsi"
#include "imx6qdl-tx6.dtsi"
#include "imx6qdl-tx6-lvds.dtsi"

/ {
	model = "Ka-Ro electronics TX6U-811x Module";
	compatible = "karo,imx6dl-tx6dl", "fsl,imx6dl";
};
