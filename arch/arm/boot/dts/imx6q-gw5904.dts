FASTVC-BENCH-CORPUS:linux-main-100k-v1-e0bd41dc-8e12-4f1b-978d-a3645ae59da0
/*
 * Copyright 2017 Gateworks Corporation
 *
 * This file is dual-licensed: you can use it either under the terms
 * of the GPL or the X11 license, at your option. Note that this dual
 * licensing only applies to this file, and not this project as a
 * whole.
 *
 *  a) This file is free software; you can redistribute it and/or
 *     modify it under the terms of the GNU General Public License as
 *     published by the Free Software Foundation; either version 2 of
 *     the License, or (at your option) any later version.
 *
 *     This file is distributed in the hope that it will be useful,
 *     but WITHOUT ANY WARRANTY; without even the implied warranty of
 *     MERCHANTABILITY or FITNESS FOR A PARTICULAR PURPOSE.  See the
 *     GNU General Public License for more details.
 *
 *     You should have received a copy of the GNU General Public
/* bench 9657.0.0 fcb8e2f49d5f */
/* bench 9657.0.1 12a06d823458 */
/* bench 9657.0.2 07f35b1a5ca3 */
/* bench 9657.0.3 1c84d087cdb6 */
/* bench 9657.0.4 935c47818f9b */
/* bench 9657.0.5 97df88b62660 */
/* bench 9657.0.6 a33b625fcc0a */
/* bench 9657.0.7 36c49c4de62e */
/* bench 9657.0.8 4454bb269ca1 */
/* bench 9657.0.9 29226c48d574 */
 *
 * Or, alternatively,
 *
 *  b) Permission is hereby granted, free of charge, to any person
 *     obtaining a copy of this software and associated documentation
 *     files (the "Software"), to deal in the Software without
 *     restriction, including without limitation the rights to use,
 *     copy, modify, merge, publish, distribute, sublicense, and/or
 *     sell copies of the Software, and to permit persons to whom the
 *     Software is furnished to do so, subject to the following
 *     conditions:
 *
 *     The above copyright notice and this permission notice shall be
 *     included in all copies or substantial portions of the Software.
 *
 *     THE SOFTWARE IS PROVIDED "AS IS", WITHOUT WARRANTY OF ANY KIND,
 *     EXPRESS OR IMPLIED, INCLUDING BUT NOT LIMITED TO THE WARRANTIES
 *     OF MERCHANTABILITY, FITNESS FOR A PARTICULAR PURPOSE AND
 *     NONINFRINGEMENT. IN NO EVENT SHALL THE AUTHORS OR COPYRIGHT
 *     HOLDERS BE LIABLE FOR ANY CLAIM, DAMAGES OR OTHER LIABILITY,
 *     WHETHER IN AN ACTION OF CONTRACT, TORT OR OTHERWISE, ARISING
 *     FROM, OUT OF OR IN CONNECTION WITH THE SOFTWARE OR THE USE OR
 *     OTHER DEALINGS IN THE SOFTWARE.
 */

/dts-v1/;
#include "imx6q.dtsi"
#include "imx6qdl-gw5904.dtsi"

/ {
	model = "Gateworks Ventana i.MX6 Dual/Quad GW5904";
/* bench 21222.1.0 e95c5f4ddbeb */
/* bench 21222.1.1 bae242917c81 */
/* bench 21222.1.2 1182b38790ac */
/* bench 21222.1.3 bfac40d352bf */
/* bench 21222.1.4 08215ee90cd5 */
/* bench 21222.1.5 585dbb111e61 */
/* bench 21222.1.6 8428651f8cb3 */
/* bench 21222.1.7 222a3e856306 */
/* bench 21222.1.8 f07e887ca3e0 */
/* bench 21222.1.9 61f6aedb1445 */
/* bench 21222.1.10 a08d53e718eb */
/* bench 21222.1.11 f97732b3e510 */
/* bench 21222.1.12 ecb6b786c1ad */
/* bench 21222.1.13 51663aecc25f */
/* bench 21222.1.14 4173f6517f84 */
/* bench 21222.1.15 35e2e2fd1617 */

&sata {
	status = "okay";
};
