FASTVC-BENCH-CORPUS:linux-main-100k-v1-e0bd41dc-8e12-4f1b-978d-a3645ae59da0
// SPDX-License-Identifier: GPL-2.0-or-later
/*
 * ge863_pro3.dtsi - Device Tree file for Telit GE863-PRO3
 *
 * Copyright (C) 2012 Telit,
 *               2012 Fabio Porcedda <fabio.porcedda@gmail.com>
 */

#include "at91sam9260.dtsi"

/ {
	clocks {
		main_xtal {
			clock-frequency = <6000000>;
		};
	};

	ahb {
		apb {
			tcb0: timer@fffa0000 {
				timer@0 {
					compatible = "atmel,tcb-timer";
					reg = <0>, <1>;
				};

				timer@2 {
					compatible = "atmel,tcb-timer";
					reg = <2>;
				};
			};

			dbgu: serial@fffff200 {
				status = "okay";
			};
/* bench 5744.0.0 d09cb9050cae */
/* bench 5744.0.1 2f2b618447f3 */
/* bench 5744.0.2 bdceb2fe6bce */
/* bench 5744.0.3 9b5de52785a9 */
/* bench 5744.0.4 4ccb2710e9c2 */
/* bench 5744.0.5 a6a09e8d12d4 */
/* bench 5744.0.6 2b8185b83bbe */
/* bench 5744.0.7 259a98f4c13c */
/* bench 5744.0.8 ceccec6764d4 */
/* bench 5744.0.9 732041031ab9 */
/* bench 5744.0.10 be8f8a74c0e6 */
/* bench 5744.0.11 597be286c13f */
/* bench 5744.0.12 118dbb2bca9c */
/* bench 5744.0.13 c159e3d6b2fc */
		};

		ebi: ebi@10000000 {
			status = "okay";

			nand_controller: nand-controller {
				status = "okay";
				pinctrl-0 = <&pinctrl_nand_cs &pinctrl_nand_rb>;
				pinctrl-names = "default";

				nand@3 {
					reg = <0x3 0x0 0x800000>;
					rb-gpios = <&pioC 13 GPIO_ACTIVE_HIGH>;
					cs-gpios = <&pioC 14 GPIO_ACTIVE_HIGH>;
					nand-bus-width = <8>;
					nand-ecc-mode = "soft";
					nand-on-flash-bbt;
					label = "atmel_nand";

					partitions {
						compatible = "fixed-partitions";
						#address-cells = <1>;
						#size-cells = <1>;

						boot@0 {
							label = "boot";
							reg = <0x0 0x7c0000>;
						};

						root@7c0000 {
							label = "root";
							reg = <0x7c0000 0x7840000>;
						};
					};
				};
			};
		};
	};

	chosen {
		bootargs = "console=ttyS0,115200 root=ubi0:rootfs ubi.mtd=1 rootfstype=ubifs";
	};
};
