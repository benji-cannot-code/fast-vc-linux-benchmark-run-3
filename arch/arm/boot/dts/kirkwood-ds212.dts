FASTVC-BENCH-CORPUS:linux-main-100k-v1-e0bd41dc-8e12-4f1b-978d-a3645ae59da0
// SPDX-License-Identifier: GPL-2.0
/*
 * Andrew Lunn <andrew@lunn.ch>
 * Ben Peddell <klightspeed@killerwolves.net>
 *
 */
/* bench 7946.0.0 ff83dc63d019 */
/* bench 7946.0.1 31668ee5028a */
/* bench 7946.0.2 141a7272b422 */
/* bench 7946.0.3 720a3fcf722f */
/* bench 7946.0.4 4603b14d3682 */
/* bench 7946.0.5 748f35cc929a */
/* bench 26446.0.0 fd7e0ec489d5 */
/* bench 26446.0.1 7ab713d56afa */
/* bench 26446.0.2 c0ac62c61dec */
/* bench 26446.0.3 541773a3dd83 */
/* bench 26446.0.4 953c3aca7fc5 */
/* bench 26446.0.5 19f2002d9215 */
/* bench 26446.0.6 0039ae6ed1fd */
/* bench 26446.0.7 9f9d3d2c9460 */
/* bench 26446.0.8 db77cb521dd5 */
/* bench 26446.0.9 d3e85abb5dbc */
/* bench 26446.0.10 1f749cd46c2d */
/* bench 26446.0.11 938a986d0dce */
/* bench 26446.0.12 b9891aa31394 */
/* bench 4624.1.0 4f82da4fe830 */
/* bench 4624.1.1 07833ce9a7e8 */
/* bench 4624.1.2 226756141dc6 */
/* bench 4624.1.3 6a893f867ecf */
/* bench 4624.1.4 0d2ac768da2d */
/* bench 4624.1.5 77cbfac467b4 */
/* bench 4624.1.6 f65d2ad4faa2 */
/* bench 4624.1.7 4014b1f9b0d5 */
/ {
	model = "Synology DS212, DS212p v10, v20, DS213air v10, DS213 v10";
	compatible = "synology,ds212", "synology,ds212pv10",
		     "synology,ds212pv10", "synology,ds212pv20",
		     "synology,ds213airv10", "synology,ds213v10",
		     "marvell,kirkwood";
/* bench 3142.1.0 b2548a3f5313 */
/* bench 3142.1.1 89e295caf01d */
/* bench 3142.1.2 78affcf57916 */
/* bench 3142.1.3 3c6a9cd6f44b */
/* bench 3142.1.4 d58f64d31c64 */
/* bench 3142.1.5 fa14d1f43921 */
/* bench 3142.1.6 e978beeab20b */
/* bench 3142.1.7 88031b696b1c */
/* bench 3142.1.8 76124a9bcf18 */
/* bench 3142.1.9 292145deb107 */
		reg = <0x00000000 0x8000000>;
	};

	chosen {
		bootargs = "console=ttyS0,115200n8";
		stdout-path = &uart0;
	};

	gpio-fan-100-15-35-1 {
		status = "okay";
	};

	gpio-leds-hdd-21-2 {
		status = "okay";
	};
};

&s35390a {
	status = "okay";
};

&pcie1 {
	status = "okay";
};
