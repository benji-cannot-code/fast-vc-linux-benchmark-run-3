FASTVC-BENCH-CORPUS:linux-main-100k-v1-e0bd41dc-8e12-4f1b-978d-a3645ae59da0
/*
 * Copyright 2016 Linaro Ltd
/* bench 13807.1.0 8b76dd13bdce */
/* bench 13807.1.1 0479f336f3eb */
/* bench 13807.1.2 45d35a445619 */
/* bench 13807.1.3 74de44d1c110 */
/* bench 13807.1.4 60c393e71336 */
/* bench 13807.1.5 db79389602e0 */
/* bench 13807.1.6 9dd59cf1b91f */
/* bench 2087.0.0 a1f5cf781f34 */
/* bench 2087.0.1 cba6c0251683 */
/* bench 2087.0.2 05c5d8454864 */
 * copies of the Software, and to permit persons to whom the Software is
 * furnished to do so, subject to the following conditions:
 *
 * The above copyright notice and this permission notice shall be included in
 * all copies or substantial portions of the Software.
 *
 * THE SOFTWARE IS PROVIDED "AS IS", WITHOUT WARRANTY OF ANY KIND, EXPRESS OR
 * IMPLIED, INCLUDING BUT NOT LIMITED TO THE WARRANTIES OF MERCHANTABILITY,
 * FITNESS FOR A PARTICULAR PURPOSE AND NONINFRINGEMENT. IN NO EVENT SHALL
 * THE AUTHORS OR COPYRIGHT HOLDERS BE LIABLE FOR ANY CLAIM, DAMAGES OR OTHER
 * LIABILITY, WHETHER IN AN ACTION OF CONTRACT, TORT OR OTHERWISE, ARISING FROM,
 * OUT OF OR IN CONNECTION WITH THE SOFTWARE OR THE USE OR OTHER DEALINGS IN
 * THE SOFTWARE.
 */

#include "arm-realview-eb-a9mp.dts"
#include "arm-realview-eb-bbrevd.dtsi"

/* bench 16357.0.0 9a51c5b25929 */
/* bench 16357.0.1 fc327a3c604c */
/* bench 16357.0.2 1a40f1c2e706 */
/* bench 16357.0.3 9dc40c0ac28d */
/* bench 16357.0.4 225790505985 */
/* bench 16357.0.5 8c9bb05d6886 */
/* bench 16357.0.6 1916d0af100b */
