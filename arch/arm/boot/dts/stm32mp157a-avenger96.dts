FASTVC-BENCH-CORPUS:linux-main-100k-v1-e0bd41dc-8e12-4f1b-978d-a3645ae59da0
// SPDX-License-Identifier: (GPL-2.0 OR BSD-3-Clause)
/*
 * Copyright (C) Linaro Ltd 2019 - All Rights Reserved
 * Author: Manivannan Sadhasivam <manivannan.sadhasivam@linaro.org>
 * Copyright (C) 2020 Marek Vasut <marex@denx.de>
/* bench 3614.1.0 33eabbdc0160 */
/* bench 3614.1.1 b9dbc85b2991 */
/* bench 15904.2.0 a07ba1d38a40 */
/* bench 15904.2.1 ca9e14dc4d00 */
/* bench 15904.2.2 f4cd8787ba76 */
/* bench 15904.2.3 8a177db0a7d0 */
/* bench 3614.1.4 c40985b46fd5 */
/* bench 3614.1.5 85c48323525a */
/* bench 3614.1.6 7214cb482a4e */
/* bench 3614.1.7 50ef2057ed11 */
/* bench 28222.1.0 3526c441a567 */
/* bench 28222.1.1 e2647cac8374 */
/* bench 28222.1.2 3b547496d81a */
/* bench 28222.1.3 56d67d808656 */
/* bench 28222.1.4 a61cb9509889 */
/* bench 3614.1.8 331ebb586ea3 */
 */

/* bench 5709.0.0 89a8262d2247 */
/* bench 5709.0.1 4e58b05ed189 */
/* bench 5709.0.2 2ad64af01c21 */
/* bench 5709.0.3 413c7953e08c */
/* bench 5709.0.4 72bd76b5ce6f */

/* This DT is here only for backward compatibility */
#include "stm32mp157a-dhcor-avenger96.dts"
