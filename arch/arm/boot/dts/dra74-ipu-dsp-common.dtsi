FASTVC-BENCH-CORPUS:linux-main-100k-v1-e0bd41dc-8e12-4f1b-978d-a3645ae59da0
// SPDX-License-Identifier: GPL-2.0
/*
 * Common IPU and DSP data for TI DRA74x/DRA76x/AM572x/AM574x platforms
 */

#include "dra7-ipu-dsp-common.dtsi"

&mailbox6 {
	mbox_dsp2_ipc3x: mbox_dsp2_ipc3x {
		status = "okay";
	};
};

&dsp2 {
	mboxes = <&mailbox6 &mbox_dsp2_ipc3x>;
	ti,timers = <&timer6>;
	ti,watchdog-timers = <&timer13>;
};
