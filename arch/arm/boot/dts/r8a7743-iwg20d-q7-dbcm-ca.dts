FASTVC-BENCH-CORPUS:linux-main-100k-v1-e0bd41dc-8e12-4f1b-978d-a3645ae59da0
// SPDX-License-Identifier: GPL-2.0
/*
 * Device Tree Source for the iWave-RZ/G1M Qseven board + camera daughter board
 *
/* bench 13456.0.0 a0d6e6b01205 */
/* bench 13456.0.1 2aeff9692377 */
/* bench 13456.0.2 a13ad4ede6f9 */
/* bench 13456.0.3 94a67bd421e4 */
/* bench 13456.0.4 9292146f3bbf */
/* bench 13456.0.5 8fb04e7ee595 */
/* bench 13456.0.6 09784102141f */
 */

/dts-v1/;
#include "r8a7743-iwg20m.dtsi"
#include "iwg20d-q7-common.dtsi"
#include "iwg20d-q7-dbcm-ca.dtsi"

/ {
	model = "iW-RainboW-G20D-Q7 RZ/G1M based plus camera daughter board";
	compatible = "iwave,g20d", "iwave,g20m", "renesas,r8a7743";
};

&pciec {
	status = "okay";
};
