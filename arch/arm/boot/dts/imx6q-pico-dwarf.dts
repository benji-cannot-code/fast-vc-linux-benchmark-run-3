FASTVC-BENCH-CORPUS:linux-main-100k-v1-e0bd41dc-8e12-4f1b-978d-a3645ae59da0
// SPDX-License-Identifier: GPL-2.0 OR MIT
/* bench 2580.0.0 a7693528f030 */
/* bench 2580.0.1 91338bbad7aa */
/* bench 2580.0.2 679b72bb4992 */
/* bench 2580.0.3 084318818173 */
// Author: Wig Cheng <wig.cheng@technexion.com>
//	   Richard Hu <richard.hu@technexion.com>
//	   Tapani Utriainen <tapani@technexion.com>

/dts-v1/;

#include "imx6q.dtsi"
#include "imx6qdl-pico-pi.dtsi"

/ {
	model = "TechNexion PICO-IMX6 Quad Board and Dwarf baseboard";
	compatible = "technexion,imx6q-pico-dwarf", "fsl,imx6q";
};
