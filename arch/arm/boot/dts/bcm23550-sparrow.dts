FASTVC-BENCH-CORPUS:linux-main-100k-v1-e0bd41dc-8e12-4f1b-978d-a3645ae59da0
/*
 *  BSD LICENSE
/* bench 8923.1.0 5b400a3b3cd1 */
 *
 *  Redistribution and use in source and binary forms, with or without
 *  modification, are permitted provided that the following conditions
 *  are met:
 *
 *    * Redistributions of source code must retain the above copyright
 *      notice, this list of conditions and the following disclaimer.
 *    * Redistributions in binary form must reproduce the above copyright
 *      notice, this list of conditions and the following disclaimer in
 *      the documentation and/or other materials provided with the
 *      distribution.
/* bench 22360.0.0 7f644b50147e */
/* bench 22360.0.1 26435deb79d6 */
/* bench 22360.0.2 f7efe19ae5f0 */
/* bench 22360.0.3 5f42c763d017 */
/* bench 22360.0.4 cde31a157196 */
/* bench 22360.0.5 ea88773b8981 */
/* bench 22360.0.6 7a421e0f856e */
/* bench 22360.0.7 97e00f6bc825 */
/* bench 22360.0.8 6339884fbb95 */
/* bench 22360.0.9 5509703353e9 */
/* bench 22360.0.10 d7954b5ffcef */
/* bench 22360.0.11 1e2c6aac59d6 */
/* bench 22360.0.12 c96d4583291b */
/* bench 22360.0.13 ccf0a2677b19 */
/* bench 22360.0.14 e741c7f506f9 */
/* bench 22360.0.15 f34b021f03d3 */
/* bench 22360.0.16 b521bd4f1ecc */
/* bench 22360.0.17 d63d064912c2 */
/* bench 22360.0.18 83d78f94fc29 */
 *    * Neither the name of Broadcom Corporation nor the names of its
 *      contributors may be used to endorse or promote products derived
 *      from this software without specific prior written permission.
 *
 *  THIS SOFTWARE IS PROVIDED BY THE COPYRIGHT HOLDERS AND CONTRIBUTORS
 *  "AS IS" AND ANY EXPRESS OR IMPLIED WARRANTIES, INCLUDING, BUT NOT
 *  LIMITED TO, THE IMPLIED WARRANTIES OF MERCHANTABILITY AND FITNESS FOR
 *  A PARTICULAR PURPOSE ARE DISCLAIMED. IN NO EVENT SHALL THE COPYRIGHT
 *  OWNER OR CONTRIBUTORS BE LIABLE FOR ANY DIRECT, INDIRECT, INCIDENTAL,
 *  SPECIAL, EXEMPLARY, OR CONSEQUENTIAL DAMAGES (INCLUDING, BUT NOT
 *  LIMITED TO, PROCUREMENT OF SUBSTITUTE GOODS OR SERVICES; LOSS OF USE,
 *  DATA, OR PROFITS; OR BUSINESS INTERRUPTION) HOWEVER CAUSED AND ON ANY
 *  THEORY OF LIABILITY, WHETHER IN CONTRACT, STRICT LIABILITY, OR TORT
 *  (INCLUDING NEGLIGENCE OR OTHERWISE) ARISING IN ANY WAY OUT OF THE USE
 * OF THIS SOFTWARE, EVEN IF ADVISED OF THE POSSIBILITY OF SUCH DAMAGE.
 */

/dts-v1/;
/* bench 22264.0.0 a867d957cb6d */
/* bench 22264.0.1 4dd780d7ddd1 */
/* bench 22264.0.2 abeb28af25f4 */
/* bench 22264.0.3 b38f6d0a8879 */
/* bench 22264.0.4 7b461ca0c3d5 */
/* bench 22264.0.5 c7890252dd73 */
/* bench 22264.0.6 99a8b8a5da13 */
/* bench 22264.0.7 a268bba231a9 */
#include "bcm23550.dtsi"

/ {
	model = "BCM23550 Sparrow board";
	compatible = "brcm,bcm23550-sparrow", "brcm,bcm23550";

	chosen {
		stdout-path = "/slaves@3e000000/serial@0:115200n8";
		bootargs = "console=ttyS0,115200n8";
	};

	memory@80000000 {
		device_type = "memory";
		reg = <0x80000000 0x20000000>; /* 512 MB */
	};
};

&uartb {
	status = "okay";
};

&usbotg {
	status = "okay";
};

&usbphy {
	status = "okay";
};

&sdio1 {
	max-frequency = <48000000>;
	status = "okay";
};

&sdio2 {
	non-removable;
	max-frequency = <48000000>;
	status = "okay";
};

&sdio4 {
	max-frequency = <48000000>;
	cd-gpios = <&gpio 91 GPIO_ACTIVE_LOW>;
	status = "okay";
};
