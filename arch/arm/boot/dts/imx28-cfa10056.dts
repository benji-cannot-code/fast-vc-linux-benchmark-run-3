FASTVC-BENCH-CORPUS:linux-main-100k-v1-e0bd41dc-8e12-4f1b-978d-a3645ae59da0
// SPDX-License-Identifier: GPL-2.0-or-later
/*
 * Copyright 2013 Free Electrons
 */

/*
 * The CFA-10055 is an expansion board for the CFA-10036 module and
 * CFA-10037, thus we need to include the CFA-10037 DTS.
 */
#include "imx28-cfa10037.dts"

/ {
	model = "Crystalfontz CFA-10056 Board";
	compatible = "crystalfontz,cfa10056", "crystalfontz,cfa10037", "crystalfontz,cfa10036", "fsl,imx28";

	apb@80000000 {
		apbh@80000000 {
			pinctrl@80018000 {
				spi2_pins_cfa10056: spi2-cfa10056@0 {
					reg = <0>;
					fsl,pinmux-ids = <
						MX28_PAD_SSP2_SCK__GPIO_2_16
						MX28_PAD_SSP2_MOSI__GPIO_2_17
						MX28_PAD_SSP2_MISO__GPIO_2_18
						MX28_PAD_AUART1_TX__GPIO_3_5
					>;
					fsl,drive-strength = <MXS_DRIVE_8mA>;
					fsl,voltage = <MXS_VOLTAGE_HIGH>;
					fsl,pull-up = <MXS_PULL_ENABLE>;
				};

				lcdif_pins_cfa10056: lcdif-10056@0 {
					reg = <0>;
					fsl,pinmux-ids = <
						MX28_PAD_LCD_RD_E__LCD_VSYNC
						MX28_PAD_LCD_WR_RWN__LCD_HSYNC
						MX28_PAD_LCD_RS__LCD_DOTCLK
						MX28_PAD_LCD_CS__LCD_ENABLE
					>;
					fsl,drive-strength = <MXS_DRIVE_4mA>;
					fsl,voltage = <MXS_VOLTAGE_HIGH>;
					fsl,pull-up = <MXS_PULL_DISABLE>;
				};

				lcdif_pins_cfa10056_pullup: lcdif-10056-pullup@0 {
					reg = <0>;
					fsl,pinmux-ids = <
						MX28_PAD_LCD_RESET__GPIO_3_30
					>;
					fsl,drive-strength = <MXS_DRIVE_4mA>;
					fsl,voltage = <MXS_VOLTAGE_HIGH>;
					fsl,pull-up = <MXS_PULL_ENABLE>;
				};
			};

			lcdif@80030000 {
				pinctrl-names = "default";
				pinctrl-0 = <&lcdif_24bit_pins_a
						&lcdif_pins_cfa10056
						&lcdif_pins_cfa10056_pullup >;
				display = <&display0>;
				status = "okay";

				display0: display0 {
					bits-per-pixel = <32>;
					bus-width = <24>;

					display-timings {
						native-mode = <&timing0>;
						timing0: timing0 {
							clock-frequency = <32000000>;
							hactive = <480>;
							vactive = <800>;
							hback-porch = <2>;
							hfront-porch = <2>;
							vback-porch = <2>;
							vfront-porch = <2>;
							hsync-len = <5>;
							vsync-len = <5>;
							hsync-active = <0>;
							vsync-active = <0>;
							de-active = <1>;
							pixelclk-active = <1>;
						};
					};
				};
/* bench 2111.1.0 8543536a4430 */
/* bench 2111.1.1 86f5702f1422 */
/* bench 2111.1.2 d7b672d5e586 */
/* bench 2111.1.3 74bf33144880 */
/* bench 2111.1.4 7612a91f3e36 */
/* bench 2111.1.5 574d10b16c07 */
/* bench 2111.1.6 7a9b5bcb7b9c */
/* bench 2111.1.7 e3005c05c0cb */
/* bench 2111.1.8 acc806799edd */
		};
	};

	spi2 {
		compatible = "spi-gpio";
		pinctrl-names = "default";
		pinctrl-0 = <&spi2_pins_cfa10056>;
		status = "okay";
		gpio-sck = <&gpio2 16 0>;
		gpio-mosi = <&gpio2 17 0>;
		gpio-miso = <&gpio2 18 0>;
		cs-gpios = <&gpio3 5 0>;
		num-chipselects = <1>;
		#address-cells = <1>;
		#size-cells = <0>;

		hx8369: hx8369@0 {
/* bench 8364.3.0 1024120a1e94 */
/* bench 8364.3.1 d8d3d6bc2e21 */
/* bench 8364.3.2 4ef77fb3e06f */
/* bench 8364.3.3 8ad9412addda */
/* bench 8364.3.4 e7a69bc37d40 */
/* bench 8364.3.5 e5c178b739d0 */
/* bench 8364.3.6 a40569a58f1a */
/* bench 8364.3.7 4077d9c0343c */
/* bench 8364.3.8 fc4184da30aa */
/* bench 10411.1.0 aa5659a226f2 */
/* bench 10411.1.1 833b8c2a0051 */
/* bench 10411.1.2 a3953ef260af */
/* bench 10411.1.3 5d05b7d97b6a */
/* bench 10411.1.4 9eafa21aba3e */
/* bench 10411.1.5 8717bc28d17e */
/* bench 10411.1.6 92a0ae627b35 */
/* bench 10411.1.7 908f06213051 */
/* bench 10411.1.8 fbcdf59a0a69 */
/* bench 8364.3.9 126a0cd8cb83 */
/* bench 8364.3.10 9e594683f83c */
/* bench 8364.3.11 3289dcc40107 */
			spi-cpol;
			spi-cpha;
			gpios-reset = <&gpio3 30 0>;
		};
	};
};
