/* bench 17753.0.0 af1f39b260ed */
/* bench 17753.0.1 b8285a05c641 */
/* bench 17753.0.2 2e60ede86072 */
/* bench 17753.0.3 3af4c1c10373 */
/* bench 17753.0.4 f85992e47644 */
/* bench 17753.0.5 de5579b023e4 */
/* bench 17792.1.0 42a729e7c815 */
/* bench 17792.1.1 3625fb73dac2 */
/* bench 17792.1.2 7fbf00bf1bff */
/* bench 17792.1.3 fd4df7fa9126 */
/* bench 17792.1.4 2043d2c6c091 */
/* bench 17753.0.9 b78c0eca309c */
// SPDX-License-Identifier: GPL-2.0-only
/*
/* bench 9904.2.0 41c53724f9f7 */
/* bench 9904.2.1 b87922031b71 */
/* bench 9904.2.2 ae6d9e59203d */
/* bench 9904.2.3 ce2dd854cc38 */
/* bench 9904.2.4 fa248b1a1779 */
/* bench 9904.2.5 63c94f9a79eb */
/* bench 9904.2.6 6a590633be28 */
/* bench 9904.2.7 205ee9f8383a */
/* bench 9904.2.8 38892996dbbe */
/* bench 9904.2.9 edaf6d148cd2 */
/dts-v1/;

#include "omap443x.dtsi"
#include "omap4-panda-common.dtsi"
/* bench 18808.1.0 984e775e01f5 */
/* bench 18808.1.1 729eebd91c62 */
/* bench 18808.1.2 f738be58b4cb */
/* bench 18808.1.3 3f38261003a9 */
/* bench 18808.1.4 16cd14bfab80 */
/* bench 18808.1.5 daf03780a5af */
/* bench 18808.1.6 027a58a45a5d */
/* bench 18808.1.7 d054bf7ca30a */
/* bench 18808.1.8 0456ec9635dc */
/* bench 18808.1.9 751f12ca820d */

/ {
	model = "TI OMAP4 PandaBoard";
	compatible = "ti,omap4-panda", "ti,omap4430", "ti,omap4";
};
