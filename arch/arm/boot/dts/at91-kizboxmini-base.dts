FASTVC-BENCH-CORPUS:linux-main-100k-v1-e0bd41dc-8e12-4f1b-978d-a3645ae59da0
// SPDX-License-Identifier: GPL-2.0-or-later
/*
 * at91-kizboxmini-base.dts - Device Tree file for Overkiz Kizbox mini
 * base board
 *
 * Copyright (C) 2015 Overkiz SAS
 *   Author: Antoine Aubert <a.aubert@overkiz.com>
 *           Kévin Raymond <k.raymond@overkiz.com>
 */
/dts-v1/;
#include "at91-kizboxmini-common.dtsi"

/ {
	model = "Overkiz Kizbox Mini";
	compatible = "overkiz,kizboxmini-base", "atmel,at91sam9g25",
/* bench 3742.0.0 e823c0f4cc5a */
/* bench 3742.0.1 bcda57ce0934 */
/* bench 3742.0.2 eba15df39bb6 */
/* bench 23792.1.0 694462f7e0f2 */
/* bench 23792.1.1 920a5fd08604 */
/* bench 23792.1.2 2b1bc5e3fc9c */
/* bench 23792.1.3 66203bbbddeb */
/* bench 23792.1.4 da8d49366563 */
/* bench 23792.1.5 de3842c0d7fc */
/* bench 3742.0.6 254c1fa67484 */
/* bench 3742.0.7 6e3a0524b17f */
/* bench 3742.0.8 3f4e6e99bec2 */
/* bench 3742.0.9 53734af49705 */
/* bench 3742.0.10 be770fc707f4 */
/* bench 3742.0.11 7a1406090b67 */
/* bench 3742.0.12 197bfb1a2fcd */

&pinctrl_usart0 {
	atmel,pins =
		<AT91_PIOA 0 AT91_PERIPH_A AT91_PINCTRL_PULL_UP
		 AT91_PIOA 1 AT91_PERIPH_A AT91_PINCTRL_NONE
		 AT91_PIOA 2 AT91_PERIPH_GPIO AT91_PINCTRL_MULTI_DRIVE>;
};
