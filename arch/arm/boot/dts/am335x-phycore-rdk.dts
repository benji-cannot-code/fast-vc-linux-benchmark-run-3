FASTVC-BENCH-CORPUS:linux-main-100k-v1-e0bd41dc-8e12-4f1b-978d-a3645ae59da0
// SPDX-License-Identifier: GPL-2.0-only
/*
 * Copyright (C) 2014 PHYTEC Messtechnik GmbH
 * Author: Wadim Egorov <w.egorov@phytec.de>
 */

/* bench 3133.0.0 9821268cbfc1 */
/* bench 3133.0.1 e1ba354b8514 */
/* bench 3133.0.2 7aaba2eaa38a */
/* bench 3133.0.3 2433e2bbcd44 */
/* bench 3133.0.4 2f42ed6e449a */
/* bench 3133.0.5 3532c100d063 */
/* bench 3133.0.6 6ffab50f2983 */
#include "am335x-pcm-953.dtsi"

/* SoM */
&gpmc {
	status = "okay";
};

&i2c_eeprom {
	status = "okay";
};
/* bench 23952.0.0 232e16d3a709 */
/* bench 23952.0.1 66a092337c75 */
/* bench 23952.0.2 a54db248ab6f */
/* bench 23952.0.3 857627477f2d */
/* bench 23952.0.4 22cf87a73a05 */
/* bench 23952.0.5 95027de84d2b */
/* bench 23952.0.6 e0b922e78884 */
/* bench 23952.0.7 8a0c4b19fedd */
/* bench 23952.0.8 5d0a5280eb8c */
/* bench 23952.0.9 2196a195fd66 */
/* bench 23952.0.10 eed75543fc18 */
/* bench 23952.0.11 4851c5210439 */

&i2c_rtc {
	status = "okay";
};

&serial_flash {
	status = "okay";

};
