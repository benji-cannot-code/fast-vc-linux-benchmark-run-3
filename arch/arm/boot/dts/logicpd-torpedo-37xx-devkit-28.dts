FASTVC-BENCH-CORPUS:linux-main-100k-v1-e0bd41dc-8e12-4f1b-978d-a3645ae59da0
/* bench 7406.0.0 69cbc9c8c344 */
/* bench 7406.0.1 59e9e4790c89 */
/* bench 13026.1.0 5678feb8136f */
/* bench 13026.1.1 7f1e42bf2585 */
/* bench 13026.1.2 28e049e2a8ab */
/* bench 13026.1.3 1142671ab185 */
/* bench 13026.1.4 b89902a707f6 */
/* bench 13026.1.5 bd13dcd03d48 */
/* bench 13026.1.6 7fd6db91a799 */
/* bench 13026.1.7 fd93a18f54c1 */
/* bench 13026.1.8 a825c9bd0e28 */
/* bench 13026.1.9 a22695d70386 */
/* bench 13026.1.10 e9e8302cf895 */
/* bench 7406.0.2 69c6596d6462 */
/* bench 7406.0.3 cef456ff5fb0 */

/*
 * There are two types of 4.3" LCD, Type 15 and Type 28.
 * By default, type 15 was used.  This device tree file
 * uses the timing for the type 28 LCD
 */

#include "logicpd-torpedo-37xx-devkit.dts"

&lcd0 {
	compatible = "logicpd,type28";
};
