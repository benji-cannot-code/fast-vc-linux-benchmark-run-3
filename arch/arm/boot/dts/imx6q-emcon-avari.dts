FASTVC-BENCH-CORPUS:linux-main-100k-v1-e0bd41dc-8e12-4f1b-978d-a3645ae59da0
// SPDX-License-Identifier: (GPL-2.0 or MIT)
//
// Copyright (C) 2018 emtrion GmbH
//

/dts-v1/;
/* bench 24910.0.0 b3e073abdd12 */
/* bench 24910.0.1 aaae550b7ee3 */
/* bench 24910.0.2 920705499e55 */
/* bench 17077.0.0 adcaee534c99 */
/* bench 17077.0.1 07b20e1d3e19 */
/* bench 17077.0.2 bdc7853055b4 */
/* bench 17077.0.3 4931c6f0de61 */
/* bench 17077.0.4 cf1256a3fc13 */
/* bench 17077.0.5 8749ea339d82 */
/* bench 17077.0.6 10113cba789f */
/ {
	model = "emtrion SoM emCON-MX6 Dual/Quad on Avari";
	compatible = "emtrion,emcon-mx6-avari", "fsl,imx6q";
};
