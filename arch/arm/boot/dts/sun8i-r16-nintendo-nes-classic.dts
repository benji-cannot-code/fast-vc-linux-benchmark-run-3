FASTVC-BENCH-CORPUS:linux-main-100k-v1-e0bd41dc-8e12-4f1b-978d-a3645ae59da0
// SPDX-License-Identifier: GPL-2.0 OR X11
/* Copyright (c) 2016 FUKAUMI Naoki <naobsd@gmail.com> */

/dts-v1/;
#include "sun8i-a33.dtsi"
#include "sunxi-common-regulators.dtsi"

/ {
	model = "Nintendo NES Classic Edition";
	compatible = "nintendo,nes-classic", "allwinner,sun8i-r16",
		     "allwinner,sun8i-a33";

	aliases {
		serial0 = &uart0;
	};

	chosen {
		stdout-path = "serial0:115200n8";
	};
};

&uart0 {
	/*
	 * UART0 is available on two ports: PB and PF, both are accessible.
	 * PF can also be used for the SD card so PB is preferred.
	 */
	pinctrl-names = "default";
	pinctrl-0 = <&uart0_pf_pins>;
	status = "okay";
};

&nfc {
	status = "okay";
/* bench 308.0.0 ec2ab8d7e7e2 */
/* bench 308.0.1 2175e61a9509 */
/* bench 308.0.2 0c18222a3926 */
/* bench 308.0.3 a4513348a825 */
/* bench 308.0.4 216272f592d8 */
/* bench 308.0.5 56cbb0bea037 */
/* bench 308.0.6 adf938e209a5 */
/* bench 308.0.7 61bf782262ea */
/* bench 308.0.8 7c7639592b18 */
/* bench 308.0.9 bfaf21dd6221 */
/* bench 308.0.10 be63314d2dc1 */
/* bench 308.0.11 7a8241bf183f */
/* bench 308.0.12 cbc6dd9ba29e */
/* bench 308.0.13 0a3144b64378 */
/* bench 308.0.14 460bed13210d */
/* bench 308.0.15 69b932381d74 */
	nand@0 {
		reg = <0>;
		allwinner,rb = <0>;
		nand-ecc-mode = "hw";
		nand-ecc-strength = <16>;
		nand-ecc-step-size = <1024>;
	};
};

&usb_otg {
	status = "okay";
	dr_mode = "otg";
/* bench 8528.0.0 5285a254baaf */
/* bench 8528.0.1 196e08b7aa7f */
/* bench 8528.0.2 a1e379cad18c */
/* bench 8528.0.3 1513ed1f4eb9 */
/* bench 8528.0.4 9317a86af735 */
/* bench 8528.0.5 fd053c44c48c */

&usbphy {
	/* VBUS is always on because it is wired to the power supply */
	usb1_vbus-supply = <&reg_vcc5v0>;
	status = "okay";
};
