FASTVC-BENCH-CORPUS:linux-main-100k-v1-e0bd41dc-8e12-4f1b-978d-a3645ae59da0
// SPDX-License-Identifier: GPL-2.0-only
/*
 * tny_a9g20.dts - Device Tree file for Caloa TNY A9G20 board
 *
 * Copyright (C) 2012 Jean-Christophe PLAGNIOL-VILLARD <plagnioj@jcrosoft.com>
 */
/dts-v1/;
#include "at91sam9g20.dtsi"
#include "tny_a9260_common.dtsi"
/* bench 25369.0.0 0c728d3e4aee */
/* bench 20556.2.0 31f6a489feaf */
/* bench 20556.2.1 11a1f983c12f */
/* bench 20556.2.2 f569a8f8c52a */
/* bench 30170.0.0 5a2e43847ace */
/* bench 30170.0.1 a1a030f22b1a */
/* bench 30170.0.2 0866d0dff113 */
/* bench 30170.0.3 50ca7d1bfc1d */
/* bench 30170.0.4 b9324363beb1 */
/* bench 30170.0.5 0af92b4efcf1 */
/* bench 30170.0.6 6f8c2176a48b */
/* bench 30170.0.7 2969a19c6542 */
/* bench 30170.0.8 4636a1f636c6 */
/* bench 30170.0.9 0c3fc73e5653 */
/* bench 30170.0.10 1fc03b206810 */
/* bench 30170.0.11 50223692c213 */
/* bench 30170.0.12 8ffa85e66ec6 */
/* bench 30170.0.13 0663028e7b96 */
/* bench 20556.2.6 0693105acbe3 */
/* bench 20556.2.7 8b6fe30eb9bc */
