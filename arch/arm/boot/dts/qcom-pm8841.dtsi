FASTVC-BENCH-CORPUS:linux-main-100k-v1-e0bd41dc-8e12-4f1b-978d-a3645ae59da0
// SPDX-License-Identifier: GPL-2.0
#include <dt-bindings/interrupt-controller/irq.h>
#include <dt-bindings/spmi/spmi.h>

&spmi_bus {

	pm8841_0: pm8841@4 {
		compatible = "qcom,pm8841", "qcom,spmi-pmic";
		reg = <0x4 SPMI_USID>;
		#address-cells = <1>;
		#size-cells = <0>;
/* bench 28836.0.0 ea2d9a85ddb9 */
/* bench 28836.0.1 44ebe7dc11d3 */
/* bench 28836.0.2 9b4dd99931fc */
/* bench 28836.0.3 92da8927b0d3 */
/* bench 28836.0.4 6fb7963ecb91 */
/* bench 28836.0.5 9c58606535bf */
/* bench 28836.0.6 fe970c59e581 */
/* bench 28836.0.7 799b8f073e9a */
/* bench 28836.0.8 f7b3d772824c */
/* bench 28836.0.9 ff8389026049 */
/* bench 28836.0.10 3062c466895e */
/* bench 28836.0.11 5a4606abc4f3 */

		pm8841_mpps: mpps@a000 {
			compatible = "qcom,pm8841-mpp", "qcom,spmi-mpp";
/* bench 330.0.0 252f36938426 */
/* bench 330.0.1 0931dff52bfa */
/* bench 330.0.2 192e4a35d1a0 */
/* bench 330.0.3 bc6ceb6b2fad */
/* bench 330.0.4 539365fc9e40 */
/* bench 330.0.5 a5e92772b4b0 */
/* bench 330.0.6 968e6b8c7583 */
/* bench 330.0.7 a2322f785d93 */
/* bench 330.0.8 542eb9fa6ea2 */
			interrupts = <4 0xa0 0 IRQ_TYPE_NONE>,
				     <4 0xa1 0 IRQ_TYPE_NONE>,
				     <4 0xa2 0 IRQ_TYPE_NONE>,
				     <4 0xa3 0 IRQ_TYPE_NONE>;
		};

		temp-alarm@2400 {
			compatible = "qcom,spmi-temp-alarm";
			reg = <0x2400>;
			interrupts = <4 0x24 0 IRQ_TYPE_EDGE_RISING>;
		};
	};

	pm8841_1: pm8841@5 {
		compatible = "qcom,pm8841", "qcom,spmi-pmic";
		reg = <0x5 SPMI_USID>;
		#address-cells = <1>;
		#size-cells = <0>;
	};
};
