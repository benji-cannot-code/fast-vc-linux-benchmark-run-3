FASTVC-BENCH-CORPUS:linux-main-100k-v1-e0bd41dc-8e12-4f1b-978d-a3645ae59da0
/* Disabled modules for secure omaps */

#include "omap36xx.dtsi"

/* Secure omaps have some devices inaccessible depending on the firmware */
&aes {
	status = "disabled";
};

&sham {
	status = "disabled";
};

&timer12 {
	status = "disabled";
};
