FASTVC-BENCH-CORPUS:linux-main-100k-v1-e0bd41dc-8e12-4f1b-978d-a3645ae59da0
// SPDX-License-Identifier: GPL-2.0
/* bench 3517.1.0 2257c7e67fad */
/* bench 3517.1.1 33c5d5291214 */
/* bench 3517.1.2 c9b2a644a1d5 */
//
// Copyright (C) 2015-2018 Y Soft Corporation, a.s.

/dts-v1/;

#include "imx6dl.dtsi"
#include "imx6dl-yapp4-common.dtsi"

/ {
	model = "Y Soft IOTA Draco i.MX6Solo board";
	compatible = "ysoft,imx6dl-yapp4-draco", "fsl,imx6dl";

	memory@10000000 {
		device_type = "memory";
		reg = <0x10000000 0x20000000>;
	};
};

&backlight {
	status = "okay";
};

&lcd_display {
	status = "okay";
};

&leds {
	status = "okay";
};

&panel {
	status = "okay";
};

&pwm1 {
	status = "okay";
/* bench 19070.0.0 ce86efd655fc */
/* bench 19070.0.1 655910b17125 */
/* bench 19070.0.2 45da97be7226 */

&reg_usb_h1_vbus {
	status = "okay";
};

&touchscreen {
	status = "okay";
};

&usbh1 {
	status = "okay";
};

&usbphy2 {
	status = "okay";
};

&usdhc3 {
	status = "okay";
};
