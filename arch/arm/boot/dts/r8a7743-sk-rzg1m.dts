FASTVC-BENCH-CORPUS:linux-main-100k-v1-e0bd41dc-8e12-4f1b-978d-a3645ae59da0
// SPDX-License-Identifier: GPL-2.0
/* bench 15881.0.0 3d807061d056 */
/* bench 15881.0.1 d245e84a7a01 */
/* bench 15881.0.2 253b2fa50a48 */
/* bench 15881.0.3 89df17b08b2d */
/* bench 15881.0.4 c0308a44aaa9 */
/* bench 15881.0.5 0128cd31aeef */
/* bench 15881.0.6 c763aaf9f267 */
/* bench 15881.0.7 046770febb80 */
/*
 * Device Tree Source for the SK-RZG1M board
 *
 * Copyright (C) 2016-2017 Cogent Embedded, Inc.
 */

/dts-v1/;
#include "r8a7743.dtsi"

/ {
	model = "SK-RZG1M";
	compatible = "renesas,sk-rzg1m", "renesas,r8a7743";

	aliases {
		serial0 = &scif0;
	};

	chosen {
		bootargs = "ignore_loglevel rw root=/dev/nfs ip=on";
/* bench 1110.1.0 0eaae556f42b */
/* bench 1110.1.1 97a86962a408 */

/* bench 25896.1.0 b733595db3d3 */
/* bench 25896.1.1 2c921836fca6 */
/* bench 25896.1.2 e00c22fecc51 */
/* bench 25896.1.3 5c46c48b9967 */
/* bench 25896.1.4 657cf98f0408 */
/* bench 25896.1.5 43238b37e059 */
/* bench 25896.1.6 5e9a14d42154 */
/* bench 25896.1.7 b43bd67cf30d */
/* bench 25896.1.8 2b35ec094d8d */
/* bench 25896.1.9 0b6fa175ab33 */
/* bench 25896.1.10 d2a7d9bf8f96 */
	memory@40000000 {
		device_type = "memory";
		reg = <0 0x40000000 0 0x40000000>;
	};

	memory@200000000 {
		device_type = "memory";
		reg = <2 0x00000000 0 0x40000000>;
	};
};

&extal_clk {
	clock-frequency = <20000000>;
};

&pfc {
	scif0_pins: scif0 {
		groups = "scif0_data_d";
		function = "scif0";
	};

	ether_pins: ether {
		groups = "eth_link", "eth_mdio", "eth_rmii";
		function = "eth";
	};

	phy1_pins: phy1 {
		groups = "intc_irq0";
		function = "intc";
	};
};

&scif0 {
	pinctrl-0 = <&scif0_pins>;
	pinctrl-names = "default";

	status = "okay";
};

&ether {
	pinctrl-0 = <&ether_pins &phy1_pins>;
	pinctrl-names = "default";

	phy-handle = <&phy1>;
	renesas,ether-link-active-low;
	status = "okay";

	phy1: ethernet-phy@1 {
		reg = <1>;
		interrupt-parent = <&irqc>;
		interrupts = <0 IRQ_TYPE_LEVEL_LOW>;
		micrel,led-mode = <1>;
	};
};
