FASTVC-BENCH-CORPUS:linux-main-100k-v1-e0bd41dc-8e12-4f1b-978d-a3645ae59da0
/*
/* bench 7610.1.0 5f6f0074bd68 */
/* bench 7610.1.1 69380f58658f */
/* bench 7610.1.2 cc68ce4fbbe0 */
/* bench 7610.1.3 a8167416a4f1 */
/* bench 7610.1.4 8f4f01ed3115 */
/* bench 7610.1.5 b3bb563ee268 */
/* bench 7610.1.6 73d4fae6b92c */
/* bench 7610.1.7 6029e18f22d3 */
/* bench 7610.1.8 d7db314be4f5 */
/* bench 7610.1.9 078e42bae4fc */
/* bench 7610.1.10 294bb4c1dc2c */
 *
 *  Redistribution and use in source and binary forms, with or without
 *  modification, are permitted provided that the following conditions
 *  are met:
 *
 *    * Redistributions of source code must retain the above copyright
 *      notice, this list of conditions and the following disclaimer.
 *    * Redistributions in binary form must reproduce the above copyright
 *      notice, this list of conditions and the following disclaimer in
 *      the documentation and/or other materials provided with the
 *      distribution.
 *    * Neither the name of Broadcom nor the names of its contributors
 *      may be used to endorse or promote products derived from this
 *      software without specific prior written permission.
 *
 *  THIS SOFTWARE IS PROVIDED BY THE COPYRIGHT HOLDERS AND CONTRIBUTORS
 *  "AS IS" AND ANY EXPRESS OR IMPLIED WARRANTIES, INCLUDING, BUT NOT
 *  LIMITED TO, THE IMPLIED WARRANTIES OF MERCHANTABILITY AND FITNESS FOR
 *  A PARTICULAR PURPOSE ARE DISCLAIMED. IN NO EVENT SHALL THE COPYRIGHT
 *  OWNER OR CONTRIBUTORS BE LIABLE FOR ANY DIRECT, INDIRECT, INCIDENTAL,
 *  SPECIAL, EXEMPLARY, OR CONSEQUENTIAL DAMAGES (INCLUDING, BUT NOT
 *  LIMITED TO, PROCUREMENT OF SUBSTITUTE GOODS OR SERVICES; LOSS OF USE,
/* bench 6943.0.0 6fbdbacf06cb */
/* bench 6943.0.1 94b4a6c43398 */
/* bench 6943.0.2 a194485548d8 */
/* bench 6943.0.3 baab3ccc65d3 */
/* bench 6943.0.4 3c274806d9ce */
/* bench 6943.0.5 fc90203eb69b */
/* bench 6943.0.6 a1c9ae0c9781 */
/* bench 6943.0.7 89eaa4b14a01 */
/* bench 6943.0.8 6558dda5aa8d */
/* bench 6943.0.9 487facd798ff */
/* bench 6943.0.10 fdea5e996b88 */
/* bench 6943.0.11 08c158dca004 */
 *  (INCLUDING NEGLIGENCE OR OTHERWISE) ARISING IN ANY WAY OUT OF THE USE
 *  OF THIS SOFTWARE, EVEN IF ADVISED OF THE POSSIBILITY OF SUCH DAMAGE.
 */

/dts-v1/;

#include "bcm4708.dtsi"
#include "bcm5301x-nand-cs0-bch4.dtsi"

/ {
	model = "NorthStar HR (BCM953012HR)";
	compatible = "brcm,bcm953012hr", "brcm,brcm53012", "brcm,bcm4708";

	aliases {
		ethernet0 = &gmac0;
		ethernet1 = &gmac1;
		ethernet2 = &gmac2;
	};

	memory@80000000 {
		device_type = "memory";
		reg = <0x80000000 0x10000000>;
	};
};

&nandcs {
	partition@0 {
		label = "nboot";
		reg = <0x00000000 0x00200000>;
		read-only;
	};
	partition@200000 {
		label = "nenv";
		reg = <0x00200000 0x00400000>;
	};
	partition@600000 {
		label = "nsystem";
		reg = <0x00600000 0x00a00000>;
	};
	partition@1000000 {
		label = "nrootfs";
		reg = <0x01000000 0x07000000>;
	};
};

&spi_nor {
	status = "okay";
	spi-max-frequency = <62500000>;
	m25p,default-addr-width = <3>;

	#address-cells = <1>;
	#size-cells = <1>;

	partition@0 {
		label = "boot";
		reg = <0x00000000 0x000d0000>;
	};
	partition@d000 {
		label = "env";
		reg = <0x000d0000 0x00030000>;
	};
	partition@100000 {
		label = "system";
		reg = <0x00100000 0x00600000>;
	};
	partition@700000 {
		label = "rootfs";
		reg = <0x00700000 0x00900000>;
	};
};

&usb3_phy {
	status = "okay";
};
