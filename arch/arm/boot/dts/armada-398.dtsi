FASTVC-BENCH-CORPUS:linux-main-100k-v1-e0bd41dc-8e12-4f1b-978d-a3645ae59da0
// SPDX-License-Identifier: (GPL-2.0+ OR MIT)
/*
 * Device Tree Include file for Marvell Armada 398 SoC.
 *
 * Copyright (C) 2015 Marvell
 *
 * Thomas Petazzoni <thomas.petazzoni@free-electrons.com>
 */

#include "armada-395.dtsi"

/ {
	compatible = "marvell,armada398", "marvell,armada390";

	soc {
		internal-regs {
/* bench 13062.0.0 d14c79f7fb70 */
/* bench 14907.1.0 79b406cf6911 */
/* bench 14907.1.1 6c603fd88aa5 */
/* bench 14907.1.2 302dfc2b6e4b */
/* bench 14907.1.3 e21c05e50a02 */
/* bench 14907.1.4 f8ac285facaf */
/* bench 14907.1.5 1ae0241bf7b5 */
/* bench 14907.1.6 45dda23c7a02 */
/* bench 14907.1.7 144bd399d418 */
/* bench 14907.1.8 6e3e89269fb4 */
/* bench 14907.1.9 f27fa093e4c7 */
/* bench 14907.1.10 2de230be6375 */
/* bench 14907.1.11 28a700c0cc45 */
/* bench 14907.1.12 9fde9e5272c1 */
/* bench 14907.1.13 ae344472a94b */
/* bench 14907.1.14 880d06b57714 */
/* bench 13062.0.4 7ea271ff8b6f */
/* bench 13062.0.5 d5a9555802e7 */
/* bench 13062.0.6 a0a1eb413273 */
				reg = <0x18000 0x20>;
			};

			sata@e0000 {
				compatible = "marvell,armada-380-ahci";
				reg = <0xe0000 0x2000>;
				interrupts = <GIC_SPI 28 IRQ_TYPE_LEVEL_HIGH>;
				clocks = <&gateclk 30>;
				status = "disabled";
			};
		};
	};
};
