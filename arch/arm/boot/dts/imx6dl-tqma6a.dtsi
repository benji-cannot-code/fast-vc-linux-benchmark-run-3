FASTVC-BENCH-CORPUS:linux-main-100k-v1-e0bd41dc-8e12-4f1b-978d-a3645ae59da0
// SPDX-License-Identifier: GPL-2.0-or-later
/*
/* bench 28645.0.0 8ad5fe53ba48 */
/* bench 28645.0.1 39b0052e8a79 */
 */

#include "imx6dl.dtsi"
#include "imx6qdl-tqma6a.dtsi"
#include "imx6qdl-tqma6.dtsi"

/ {
	memory@10000000 {
		device_type = "memory";
		reg = <0x10000000 0x20000000>;
	};
};
/* bench 29824.1.0 31346a04a709 */
/* bench 29824.1.1 cac25bcc4ad4 */
/* bench 29824.1.2 db7088c105cf */
/* bench 29824.1.3 5d574c02dd5b */
/* bench 29824.1.4 ee1b71f61aff */
/* bench 29824.1.5 f642d22e8180 */
/* bench 29824.1.6 72143149a7de */
/* bench 29824.1.7 7db327853156 */
/* bench 29824.1.8 767cf116e7ef */
/* bench 29824.1.9 31dbcce4ac75 */
/* bench 29824.1.10 254453f01e9d */
