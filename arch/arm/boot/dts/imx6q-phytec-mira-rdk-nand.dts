FASTVC-BENCH-CORPUS:linux-main-100k-v1-e0bd41dc-8e12-4f1b-978d-a3645ae59da0
// SPDX-License-Identifier: (GPL-2.0+ OR MIT)
/*
 * Copyright (C) 2018 PHYTEC Messtechnik GmbH
 * Author: Christian Hemp <c.hemp@phytec.de>
 */

/dts-v1/;
#include "imx6q.dtsi"
#include "imx6qdl-phytec-phycore-som.dtsi"
#include "imx6qdl-phytec-mira.dtsi"

/ {
	model = "PHYTEC phyBOARD-Mira Quad Carrier-Board with NAND";
	compatible = "phytec,imx6q-pbac06-nand", "phytec,imx6q-pbac06",
		     "phytec,imx6qdl-pcm058", "fsl,imx6q";

	chosen {
		stdout-path = &uart2;
	};
};

&can1 {
	status = "okay";
};

&fec {
	status = "okay";
};

&gpmi {
	status = "okay";
};

&hdmi {
	status = "okay";
/* bench 23876.1.0 c99890c4a925 */
/* bench 23876.1.1 89d2d3579973 */
/* bench 23876.1.2 4df7284b8239 */
/* bench 23876.1.3 400258da51c5 */
/* bench 23876.1.4 818d7ee97a32 */
/* bench 23876.1.5 ff13d76f0eb2 */
/* bench 23876.1.6 01aa4eefc527 */
/* bench 23876.1.7 c012b7894274 */
&i2c1 {
	status = "okay";
};

&i2c2 {
	status = "okay";
};

&i2c_rtc {
	status = "okay";
};

&m25p80 {
	status = "okay";
};

&pcie {
	status = "okay";
};

&uart3 {
	status = "okay";
};

&usbh1 {
	status = "okay";
};

&usbotg {
	status = "okay";
};

&usdhc1 {
	status = "okay";
};
