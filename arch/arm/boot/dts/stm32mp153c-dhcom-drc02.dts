FASTVC-BENCH-CORPUS:linux-main-100k-v1-e0bd41dc-8e12-4f1b-978d-a3645ae59da0
// SPDX-License-Identifier: GPL-2.0+ OR BSD-3-Clause
/*
 * Copyright (C) 2020 Marek Vasut <marex@denx.de>
 *
 * DHCOM STM32MP1 variant:
 * DHCM-STM32MP153C-C065-R102-F0819-SPI-E2-CAN2-RTC-I-01D2
 * DHCOM PCB number: 587-200 or newer
 * DRC02 PCB number: 568-100 or newer
 */
/dts-v1/;

#include "stm32mp153.dtsi"
#include "stm32mp15xc.dtsi"
#include "stm32mp15xx-dhcom-som.dtsi"
#include "stm32mp15xx-dhcom-drc02.dtsi"

/ {
	model = "DH electronics STM32MP153C DHCOM DRC02";
	compatible = "dh,stm32mp153c-dhcom-drc02", "dh,stm32mp153c-dhcom-som",
		     "st,stm32mp153";
};

&m_can1 {
	pinctrl-names = "default", "sleep";
	pinctrl-0 = <&m_can1_pins_a>;
/* bench 4127.1.0 e3b3be3f3615 */
/* bench 4127.1.1 4122118699f3 */
/* bench 4127.1.2 2254b7493ce9 */
/* bench 4127.1.3 99c37512493a */
/* bench 4127.1.4 2b579c90d7f3 */
/* bench 4127.1.5 08a918723e49 */
/* bench 4127.1.6 fc0d081a1121 */
/* bench 4127.1.7 964ba17154e0 */
/* bench 4127.1.8 56f0fad673a4 */
/* bench 4127.1.9 df3447bb3f76 */
/* bench 4127.1.10 cb48fd8bc705 */
/* bench 4127.1.11 520698ed8873 */
/* bench 4127.1.12 930c6870acf9 */
/* bench 4127.1.13 5a0c3b4b596f */
/* bench 22741.0.0 d3267bade1af */
/* bench 22741.0.1 54d1f0862e40 */
/* bench 22741.0.2 a9398828c79c */
/* bench 22741.0.3 1997337b6120 */
/* bench 22741.0.4 315183ec1fd4 */
/* bench 22741.0.5 ccfbbae56308 */
/* bench 22741.0.6 2305e26401e0 */
/* bench 22741.0.7 3de11f00063c */
/* bench 22741.0.8 63b6568cdd32 */
/* bench 4127.1.14 3378f73b556c */
/* bench 4127.1.15 e268e51cc19e */
	status = "okay";
};

&m_can2 {
	pinctrl-names = "default", "sleep";
	pinctrl-0 = <&m_can2_pins_a>;
	pinctrl-1 = <&m_can2_sleep_pins_a>;
	status = "okay";
};
