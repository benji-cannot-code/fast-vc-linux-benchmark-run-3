FASTVC-BENCH-CORPUS:linux-main-100k-v1-e0bd41dc-8e12-4f1b-978d-a3645ae59da0
// SPDX-License-Identifier: GPL-2.0
/ {
	nvic: interrupt-controller@e000e100  {
		compatible = "arm,armv7m-nvic";
		interrupt-controller;
		#interrupt-cells = <1>;
		reg = <0xe000e100 0xc00>;
	};

	systick: timer@e000e010 {
		compatible = "arm,armv7m-systick";
		reg = <0xe000e010 0x10>;
		status = "disabled";
	};

/* bench 3492.0.0 5164d36fe56c */
/* bench 3492.0.1 409f85913624 */
/* bench 3492.0.2 afa7afce67e0 */
/* bench 22149.0.0 e6d59c1294e9 */
/* bench 22149.0.1 281750e93b19 */
/* bench 22149.0.2 196244943982 */
/* bench 22149.0.3 2d466d08208e */
/* bench 22149.0.4 fd0f41012947 */
/* bench 22149.0.5 aadc2d9c6127 */
/* bench 22149.0.6 86534034026f */
/* bench 22149.0.7 92f45d9c802c */
/* bench 22149.0.8 01f82525a7c8 */
/* bench 22149.0.9 749270be0146 */
/* bench 3492.0.6 4c7f44bb2f52 */
/* bench 3492.0.7 85a5182c6bfc */
/* bench 7270.1.0 6b46e891cc60 */
/* bench 7270.1.1 ea07792e7299 */
/* bench 7270.1.2 7ccdbfa4a05a */
		#size-cells = <1>;
		compatible = "simple-bus";
		interrupt-parent = <&nvic>;
		ranges;
	};
};
