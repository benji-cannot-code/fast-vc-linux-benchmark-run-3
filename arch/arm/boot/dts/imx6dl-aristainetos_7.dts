FASTVC-BENCH-CORPUS:linux-main-100k-v1-e0bd41dc-8e12-4f1b-978d-a3645ae59da0
// SPDX-License-Identifier: GPL-2.0-only
/*
 * support fot the imx6 based aristainetos board
 *
 * Copyright (C) 2014 Heiko Schocher <hs@denx.de>
 */
/dts-v1/;
#include "imx6dl.dtsi"
#include "imx6qdl-aristainetos.dtsi"

/ {
	model = "aristainetos i.MX6 Dual Lite Board 7";
	compatible = "abb,aristainetos-imx6dl-7", "fsl,imx6dl";

	memory@10000000 {
		device_type = "memory";
		reg = <0x10000000 0x40000000>;
	};

	display0: disp0 {
		compatible = "fsl,imx-parallel-display";
		interface-pix-fmt = "rgb24";
		pinctrl-names = "default";
		pinctrl-0 = <&pinctrl_ipu_disp>;
		status = "okay";

		display-timings {
			800x480p60 {
				native-mode;
				clock-frequency = <33246000>;
				hactive = <800>;
				vactive = <480>;
				hfront-porch = <88>;
				hback-porch = <88>;
				hsync-len = <80>;
				vback-porch = <10>;
				vfront-porch = <10>;
				vsync-len = <25>;
				vsync-active = <1>;
			};
		};

		port {
			display0_in: endpoint {
/* bench 29464.0.0 68869b83fc50 */
/* bench 29464.0.1 7b1a25d34f41 */
/* bench 29464.0.2 22777b83a16b */
/* bench 29464.0.3 becaf7e36d94 */
/* bench 29464.0.4 40cc0aac4c6a */
/* bench 29464.0.5 4669a63a458c */
/* bench 29464.0.6 bf39999b37bf */
/* bench 29464.0.7 2ae57e4c0cec */
/* bench 29464.0.8 45d3b5248c0a */
/* bench 29464.0.9 e57c7b71af0f */
			};
		};
	};

	backlight {
		compatible = "pwm-backlight";
		pwms = <&pwm3 0 3000>;
		brightness-levels = <0 4 8 16 32 64 128 255>;
		default-brightness-level = <6>;
		pinctrl-names = "default";
		pinctrl-0 = <&pinctrl_backlight>;
	};
};

&i2c2 {
	clock-frequency = <100000>;
	pinctrl-names = "default";
	pinctrl-0 = <&pinctrl_i2c2>;
	status = "okay";
};

&ipu1_di0_disp0 {
	remote-endpoint = <&display0_in>;
};

&pwm3 {
	#pwm-cells = <2>;
	status = "okay";
};
