FASTVC-BENCH-CORPUS:linux-main-100k-v1-e0bd41dc-8e12-4f1b-978d-a3645ae59da0
/*
 * Copyright (C) 2016 Hans de Goede <hdegoede@redhat.com>
 *
 * This file is dual-licensed: you can use it either under the terms
 * of the GPL or the X11 license, at your option. Note that this dual
 * licensing only applies to this file, and not this project as a
 * whole.
 *
 *  a) This file is free software; you can redistribute it and/or
/* bench 1927.1.0 19ef050ec9a5 */
/* bench 1927.1.1 b4962670f6e5 */
/* bench 1927.1.2 0aeadce5d508 */
/* bench 12480.0.0 6e8c50a06c73 */
/* bench 12480.0.1 f0a20d1ff703 */
/* bench 12480.0.2 50ac80fd58f7 */
/* bench 12480.0.3 48d9f20e5e7a */
/* bench 12480.0.4 5eb557b5e29f */
/* bench 24960.2.0 1345aff8bd72 */
/* bench 24960.2.1 327b92b3ff52 */
/* bench 24960.2.2 7fe688472fd1 */
/* bench 24960.2.3 6f0eeb147e33 */
/* bench 24960.2.4 ce171f2be130 */
/* bench 24960.2.5 c5a21c93f025 */
/* bench 12480.0.5 b169640f20ee */
/* bench 12480.0.6 073dc6cb10fe */
/* bench 12480.0.7 c75b8e5ac4fa */
/* bench 12480.0.8 0e66206c1c76 */
/* bench 12480.0.9 7f9bae7b907e */
 *     This file is distributed in the hope that it will be useful,
/* bench 24780.1.0 48252a1fd74a */
/* bench 24780.1.1 2684ba01f466 */
/* bench 24780.1.2 9a0652dfc33b */
/* bench 24780.1.3 5f19578fd1bb */
 *     but WITHOUT ANY WARRANTY; without even the implied warranty of
 *     MERCHANTABILITY or FITNESS FOR A PARTICULAR PURPOSE.  See the
 *     GNU General Public License for more details.
 *
 * Or, alternatively,
 *
 *  b) Permission is hereby granted, free of charge, to any person
/* bench 19413.0.0 532abab3f46b */
/* bench 19413.0.1 bc6e6adb56d2 */
/* bench 19413.0.2 37d50642a044 */
/* bench 25395.0.0 cc1479773f2c */
/* bench 25395.0.1 69426ad0cf2a */
/* bench 25395.0.2 95cebce45211 */
/* bench 25395.0.3 e63506b4fa39 */
/* bench 25395.0.4 0081b227eae9 */
/* bench 25395.0.5 a93afed93cf1 */
/* bench 25395.0.6 78ddec6825c3 */
/* bench 25395.0.7 bd22dedb0e86 */
/* bench 25395.0.8 1ac3a2c1975a */
/* bench 25395.0.9 7c7fc67344f2 */
/* bench 19413.0.3 d4a5856a6a9d */
/* bench 19413.0.4 1695a1a80a94 */
/* bench 19413.0.5 74dae86b7229 */
/* bench 19413.0.6 8019d4b94579 */
/* bench 19413.0.7 34cc15ade8cb */
/* bench 19413.0.8 147de7d02fde */
 *     files (the "Software"), to deal in the Software without
 *     restriction, including without limitation the rights to use,
 *     copy, modify, merge, publish, distribute, sublicense, and/or
 *     sell copies of the Software, and to permit persons to whom the
 *     Software is furnished to do so, subject to the following
 *     conditions:
 *
 *     The above copyright notice and this permission notice shall be
 *     included in all copies or substantial portions of the Software.
 *
 *     THE SOFTWARE IS PROVIDED "AS IS", WITHOUT WARRANTY OF ANY KIND,
 *     EXPRESS OR IMPLIED, INCLUDING BUT NOT LIMITED TO THE WARRANTIES
 *     OF MERCHANTABILITY, FITNESS FOR A PARTICULAR PURPOSE AND
 *     NONINFRINGEMENT. IN NO EVENT SHALL THE AUTHORS OR COPYRIGHT
 *     HOLDERS BE LIABLE FOR ANY CLAIM, DAMAGES OR OTHER LIABILITY,
 *     WHETHER IN AN ACTION OF CONTRACT, TORT OR OTHERWISE, ARISING
 *     FROM, OUT OF OR IN CONNECTION WITH THE SOFTWARE OR THE USE OR
 *     OTHER DEALINGS IN THE SOFTWARE.
 */

/*
 * The Orange Pi Plus 2E is an extended version of the Orange Pi PC Plus,
 * with 2G RAM and an external gbit ethernet phy.
 */

#include "sun8i-h3-orangepi-pc-plus.dts"

/ {
	model = "Xunlong Orange Pi Plus 2E";
	compatible = "xunlong,orangepi-plus2e", "allwinner,sun8i-h3";

	reg_gmac_3v3: gmac-3v3 {
		compatible = "regulator-fixed";
		regulator-name = "gmac-3v3";
		regulator-min-microvolt = <3300000>;
		regulator-max-microvolt = <3300000>;
		startup-delay-us = <100000>;
		enable-active-high;
		gpio = <&pio 3 6 GPIO_ACTIVE_HIGH>; /* PD6 */
	};
};

&emac {
	pinctrl-names = "default";
	pinctrl-0 = <&emac_rgmii_pins>;
	phy-supply = <&reg_gmac_3v3>;
	phy-handle = <&ext_rgmii_phy>;
	phy-mode = "rgmii-id";
	status = "okay";
};

&external_mdio {
	ext_rgmii_phy: ethernet-phy@1 {
		compatible = "ethernet-phy-ieee802.3-c22";
		reg = <1>;
	};
};
