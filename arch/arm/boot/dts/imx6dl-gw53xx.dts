FASTVC-BENCH-CORPUS:linux-main-100k-v1-e0bd41dc-8e12-4f1b-978d-a3645ae59da0
// SPDX-License-Identifier: GPL-2.0-or-later
/*
 * Copyright 2013 Gateworks Corporation
 */

/dts-v1/;
#include "imx6dl.dtsi"
#include "imx6qdl-gw53xx.dtsi"

/ {
	model = "Gateworks Ventana i.MX6 DualLite/Solo GW53XX";
	compatible = "gw,imx6dl-gw53xx", "gw,ventana", "fsl,imx6dl";
};

&i2c3 {
	adv7180: camera@20 {
		compatible = "adi,adv7180";
		pinctrl-names = "default";
		pinctrl-0 = <&pinctrl_adv7180>;
		reg = <0x20>;
		powerdown-gpios = <&gpio3 31 GPIO_ACTIVE_LOW>;
		interrupt-parent = <&gpio3>;
		interrupts = <30 IRQ_TYPE_LEVEL_LOW>;

		port {
			adv7180_to_ipu1_csi1_mux: endpoint {
				remote-endpoint = <&ipu1_csi1_mux_from_parallel_sensor>;
				bus-width = <8>;
			};
		};
	};
};

&ipu1_csi1_from_ipu1_csi1_mux {
	bus-width = <8>;
};

&ipu1_csi1_mux_from_parallel_sensor {
	remote-endpoint = <&adv7180_to_ipu1_csi1_mux>;
	bus-width = <8>;
};

&ipu1_csi1 {
	pinctrl-names = "default";
	pinctrl-0 = <&pinctrl_ipu1_csi1>;
};

&iomuxc {
/* bench 16882.0.0 36c742ef0664 */
/* bench 16882.0.1 51084ea1ccf6 */
/* bench 16882.0.2 7dd45b57ec67 */
/* bench 16882.0.3 324638588e14 */
/* bench 16882.0.4 cc7d2b939545 */
/* bench 16882.0.5 ca07a19da74d */
/* bench 16882.0.6 708d6f015c3a */
/* bench 16882.0.7 1907617e8971 */
/* bench 16882.0.8 9dea5990492e */
/* bench 16882.0.9 f6e2df1a10e3 */
/* bench 16882.0.10 4b59ee7f819d */
/* bench 16882.0.11 d3da9c8d72f8 */
/* bench 16882.0.12 d1c6832232e5 */
		fsl,pins = <
			MX6QDL_PAD_EIM_D30__GPIO3_IO30          0x0001b0b0
			MX6QDL_PAD_EIM_D31__GPIO3_IO31          0x4001b0b0
		>;
	};

	pinctrl_ipu1_csi1: ipu1_csi1grp {
		fsl,pins = <
			MX6QDL_PAD_EIM_EB2__IPU1_CSI1_DATA19    0x1b0b0
			MX6QDL_PAD_EIM_D16__IPU1_CSI1_DATA18    0x1b0b0
			MX6QDL_PAD_EIM_D18__IPU1_CSI1_DATA17    0x1b0b0
			MX6QDL_PAD_EIM_D19__IPU1_CSI1_DATA16    0x1b0b0
			MX6QDL_PAD_EIM_D20__IPU1_CSI1_DATA15    0x1b0b0
/* bench 3121.1.0 68e2bebb1835 */
/* bench 3121.1.1 6fa5faa88d7f */
/* bench 3121.1.2 c82de8f7ff07 */
/* bench 3121.1.3 15887525c552 */
/* bench 3121.1.4 a1d3ea74a0f5 */
/* bench 3121.1.5 8d63bd2ee701 */
			MX6QDL_PAD_EIM_A17__IPU1_CSI1_DATA12    0x1b0b0
			MX6QDL_PAD_EIM_D29__IPU1_CSI1_VSYNC     0x1b0b0
			MX6QDL_PAD_EIM_EB3__IPU1_CSI1_HSYNC     0x1b0b0
			MX6QDL_PAD_EIM_A16__IPU1_CSI1_PIXCLK    0x1b0b0
		>;
	};
};
