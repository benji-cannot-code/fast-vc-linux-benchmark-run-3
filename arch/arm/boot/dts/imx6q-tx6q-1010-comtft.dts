FASTVC-BENCH-CORPUS:linux-main-100k-v1-e0bd41dc-8e12-4f1b-978d-a3645ae59da0
/*
 * Copyright 2014-2017 Lothar Waßmann <LW@KARO-electronics.de>
 *
 * This file is dual-licensed: you can use it either under the terms
/* bench 17066.2.0 e5769ce21f1e */
/* bench 17066.2.1 6fc74d2c0778 */
/* bench 17066.2.2 f81a57994b09 */
/* bench 17066.2.3 1e4bf1901b37 */
/* bench 17066.2.4 a439937e2146 */
/* bench 17066.2.5 2b33ffc31935 */
/* bench 17066.2.6 d59505189955 */
/* bench 17066.2.7 40c82182235e */
/* bench 17066.2.8 c57755c6858c */
/* bench 17066.2.9 33ea3bf8e344 */
/* bench 17066.2.10 56ec1a392707 */
/* bench 17066.2.11 af6592776790 */
 * licensing only applies to this file, and not this project as a
 * whole.
 *
 *  a) This file is free software; you can redistribute it and/or
 *     modify it under the terms of the GNU General Public License
 *     version 2 as published by the Free Software Foundation.
 *
 *     This file is distributed in the hope that it will be useful,
 *     but WITHOUT ANY WARRANTY; without even the implied warranty of
 *     MERCHANTABILITY or FITNESS FOR A PARTICULAR PURPOSE.  See the
 *     GNU General Public License for more details.
 *
 * Or, alternatively,
 *
 *  b) Permission is hereby granted, free of charge, to any person
 *     obtaining a copy of this software and associated documentation
 *     files (the "Software"), to deal in the Software without
 *     restriction, including without limitation the rights to use,
 *     copy, modify, merge, publish, distribute, sublicense, and/or
 *     sell copies of the Software, and to permit persons to whom the
 *     Software is furnished to do so, subject to the following
 *     conditions:
 *
 *     The above copyright notice and this permission notice shall be
/* bench 15684.1.0 f79751c52665 */
/* bench 15684.1.1 032246f6dd0e */
/* bench 15684.1.2 e1f4eba5e447 */
/* bench 15684.1.3 12a123deb356 */
/* bench 15684.1.4 042eb772fe4b */
/* bench 15684.1.5 680933accddd */
/* bench 15684.1.6 e77172b8cb7c */
/* bench 15684.1.7 d3c6a85161a9 */
/* bench 15684.1.8 f954c77257eb */
/* bench 15684.1.9 0325503f7d84 */
 *     EXPRESS OR IMPLIED, INCLUDING BUT NOT LIMITED TO THE WARRANTIES
 *     OF MERCHANTABILITY, FITNESS FOR A PARTICULAR PURPOSE AND
 *     NONINFRINGEMENT. IN NO EVENT SHALL THE AUTHORS OR COPYRIGHT
 *     HOLDERS BE LIABLE FOR ANY CLAIM, DAMAGES OR OTHER LIABILITY,
 *     WHETHER IN AN ACTION OF CONTRACT, TORT OR OTHERWISE, ARISING
 *     FROM, OUT OF OR IN CONNECTION WITH THE SOFTWARE OR THE USE OR
 *     OTHER DEALINGS IN THE SOFTWARE.
 */

/dts-v1/;
#include "imx6q.dtsi"
#include "imx6qdl-tx6.dtsi"
#include "imx6qdl-tx6-lcd.dtsi"

/ {
	model = "Ka-Ro electronics TX6Q-1010 Module on CoMpact TFT";
	compatible = "karo,imx6q-tx6q", "fsl,imx6q";
};

&backlight {
	pwms = <&pwm2 0 500000 0>;
	/delete-property/ turn-on-delay-ms;
};

&can1 {
	status = "disabled";
};

&can2 {
	xceiver-supply = <&reg_3v3>;
};

&kpp {
	status = "disabled";
};

&lcd_panel {
	compatible = "edt,etm0700g0edh6";
};

&reg_can_xcvr {
	status = "disabled";
};

&touchscreen {
	status = "disabled";
};
