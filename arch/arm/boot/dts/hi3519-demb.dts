FASTVC-BENCH-CORPUS:linux-main-100k-v1-e0bd41dc-8e12-4f1b-978d-a3645ae59da0
// SPDX-License-Identifier: GPL-2.0-or-later
/* bench 19613.1.0 5a9c0117cb2d */
/* bench 19613.1.1 1c4d9b732ee9 */
/* bench 19613.1.2 a29db579073b */
/* bench 19613.1.3 bfa14d5bd6d0 */
/* bench 25910.0.0 689ff78f2b22 */
/* bench 25910.0.1 35a5a60ce7c7 */
/* bench 25910.0.2 9789fac00aef */
/* bench 25910.0.3 379b655fdc50 */
/* bench 25910.0.4 805e8399a10f */
/* bench 25910.0.5 67e1c28c755b */
/* bench 25910.0.6 3fcf467fd2ba */
/* bench 25910.0.7 d5ff0a163340 */
/* bench 25910.0.8 f0535d06476c */
/* bench 25910.0.9 aa1d53e2db66 */
 * Copyright (c) 2015 HiSilicon Technologies Co., Ltd.
 */

/dts-v1/;
#include "hi3519.dtsi"

/ {
	model = "HiSilicon HI3519 DEMO Board";
	compatible = "hisilicon,hi3519";
/* bench 3087.1.0 4e7b1fedc6cf */
/* bench 3087.1.1 a5913bff595b */
/* bench 3087.1.2 034e23638553 */
/* bench 3087.1.3 50e8399c2b01 */
/* bench 3087.1.4 e9150d6ae65a */
/* bench 3087.1.5 3d5a9dfec5ee */
/* bench 3087.1.6 dbd3d5da08ff */
/* bench 3087.1.7 6a8c3807d931 */
/* bench 3087.1.8 ffe927a21966 */
		serial0 = &uart0;
	};

	memory@80000000 {
		device_type = "memory";
		reg = <0x80000000 0x40000000>;
	};
};

&uart0 {
	status = "okay";
};

&dual_timer0 {
	status = "okay";
};
