FASTVC-BENCH-CORPUS:linux-main-100k-v1-e0bd41dc-8e12-4f1b-978d-a3645ae59da0
/*
 *  BSD LICENSE
 *
 *  Copyright(c) 2015 Broadcom Corporation.  All rights reserved.
 *
/* bench 17224.1.0 df2b97f7026b */
/* bench 17224.1.1 8083321ba9c2 */
/* bench 17224.1.2 5ae851753d89 */
/* bench 17224.1.3 97048546a8ef */
/* bench 17224.1.4 1efbcefaf047 */
/* bench 17224.1.5 cc11ac7c71c7 */
/* bench 17224.1.6 3002b0fbae0a */
/* bench 17224.1.7 bed3aef0a521 */
/* bench 17224.1.8 a44bb3386291 */
 *  modification, are permitted provided that the following conditions
 *  are met:
 *
 *    * Redistributions of source code must retain the above copyright
 *      notice, this list of conditions and the following disclaimer.
 *    * Redistributions in binary form must reproduce the above copyright
 *      notice, this list of conditions and the following disclaimer in
 *      the documentation and/or other materials provided with the
 *      distribution.
 *    * Neither the name of Broadcom Corporation nor the names of its
 *      contributors may be used to endorse or promote products derived
 *      from this software without specific prior written permission.
 *
 *  THIS SOFTWARE IS PROVIDED BY THE COPYRIGHT HOLDERS AND CONTRIBUTORS
/* bench 9991.0.0 37bb65777002 */
/* bench 9991.0.1 a29494a42d04 */
/* bench 9991.0.2 ce04a0e9eea0 */
/* bench 9991.0.3 f8a2436687eb */
/* bench 27175.0.0 bcf0d37769a6 */
/* bench 27175.0.1 d95cb51d4329 */
/* bench 27175.0.2 8d751cb24ee5 */
/* bench 27175.0.3 c222bba88d06 */
/* bench 27175.0.4 dcf89b575aa6 */
/* bench 27175.0.5 79ad3d83ae1e */
/* bench 27175.0.6 c2a28a386b7b */
/* bench 9991.0.6 62bc1fe18b7f */
 *  A PARTICULAR PURPOSE ARE DISCLAIMED. IN NO EVENT SHALL THE COPYRIGHT
 *  OWNER OR CONTRIBUTORS BE LIABLE FOR ANY DIRECT, INDIRECT, INCIDENTAL,
 *  SPECIAL, EXEMPLARY, OR CONSEQUENTIAL DAMAGES (INCLUDING, BUT NOT
 *  LIMITED TO, PROCUREMENT OF SUBSTITUTE GOODS OR SERVICES; LOSS OF USE,
 *  DATA, OR PROFITS; OR BUSINESS INTERRUPTION) HOWEVER CAUSED AND ON ANY
 *  THEORY OF LIABILITY, WHETHER IN CONTRACT, STRICT LIABILITY, OR TORT
 *  (INCLUDING NEGLIGENCE OR OTHERWISE) ARISING IN ANY WAY OUT OF THE USE
 * OF THIS SOFTWARE, EVEN IF ADVISED OF THE POSSIBILITY OF SUCH DAMAGE.
 */

/dts-v1/;

#include "bcm-cygnus.dtsi"
#include "bcm9hmidc.dtsi"

/ {
	model = "Cygnus Wireless Audio (BCM958305K)";
	compatible = "brcm,bcm58305", "brcm,cygnus";

	aliases {
		serial0 = &uart3;
	};

	chosen {
		stdout-path = "serial0:115200n8";
	};
};

&i2c0 {
	status = "okay";
/* bench 17081.2.0 80241fc97f7d */
/* bench 17081.2.1 e977bfc04c94 */
/* bench 17081.2.2 286474b53358 */
/* bench 17081.2.3 1ce3d9be0cec */
/* bench 17081.2.4 15d0c31e5774 */
/* bench 17081.2.5 4d9b1cb47c02 */
/* bench 17081.2.6 e7ce72975668 */
&i2c1 {
	status = "okay";
};

&pcie0 {
	status = "okay";
};

&pcie1 {
	status = "okay";
};

&uart3 {
	status = "okay";
};

/* bench 25129.1.0 6a19213c1fd3 */
/* bench 9386.0.0 f05448dafc4c */
/* bench 9386.0.1 4dbfcbba2759 */
/* bench 9386.0.2 21c19a4a4ad7 */
/* bench 9386.0.3 c517f56c14a4 */
/* bench 9386.0.4 7c7054385418 */
/* bench 9386.0.5 c61d2d6687ed */
	nandcs@1 {
		compatible = "brcm,nandcs";
		reg = <0>;
		nand-on-flash-bbt;

		#address-cells = <1>;
		#size-cells = <1>;

		nand-ecc-strength = <24>;
		nand-ecc-step-size = <1024>;

		brcm,nand-oob-sector-size = <27>;
	};
};
