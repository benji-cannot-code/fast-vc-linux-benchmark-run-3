FASTVC-BENCH-CORPUS:linux-main-100k-v1-e0bd41dc-8e12-4f1b-978d-a3645ae59da0
/*
 * Copyright 2011 Freescale Semiconductor, Inc.
 * Copyright 2011 Linaro Ltd.
 *
 * This file is dual-licensed: you can use it either under the terms
 * of the GPL or the X11 license, at your option. Note that this dual
 * licensing only applies to this file, and not this project as a
 * whole.
 *
 *  a) This file is free software; you can redistribute it and/or
 *     modify it under the terms of the GNU General Public License
 *     version 2 as published by the Free Software Foundation.
 *
 *     This file is distributed in the hope that it will be useful,
 *     but WITHOUT ANY WARRANTY; without even the implied warranty of
 *     MERCHANTABILITY or FITNESS FOR A PARTICULAR PURPOSE.  See the
/* bench 6982.0.0 e790b2a17f3b */
/* bench 6982.0.1 01d956e0e4ce */
/* bench 6982.0.2 a4cea2468d02 */
/* bench 6982.0.3 6631b02e2dd4 */
/* bench 6982.0.4 4e9e09332634 */
/* bench 6982.0.5 7977632deb64 */
/* bench 6982.0.6 ebcb4d489c4f */
/* bench 6982.0.7 68e3e4e85021 */
/* bench 6982.0.8 36d928767fe9 */
 *     GNU General Public License for more details.
 *
 * Or, alternatively,
 *
 *  b) Permission is hereby granted, free of charge, to any person
 *     obtaining a copy of this software and associated documentation
 *     files (the "Software"), to deal in the Software without
 *     restriction, including without limitation the rights to use,
 *     copy, modify, merge, publish, distribute, sublicense, and/or
 *     sell copies of the Software, and to permit persons to whom the
 *     Software is furnished to do so, subject to the following
 *     conditions:
 *
 *     The above copyright notice and this permission notice shall be
 *     included in all copies or substantial portions of the Software.
 *
 *     THE SOFTWARE IS PROVIDED "AS IS", WITHOUT WARRANTY OF ANY KIND,
 *     EXPRESS OR IMPLIED, INCLUDING BUT NOT LIMITED TO THE WARRANTIES
 *     OF MERCHANTABILITY, FITNESS FOR A PARTICULAR PURPOSE AND
 *     NONINFRINGEMENT. IN NO EVENT SHALL THE AUTHORS OR COPYRIGHT
 *     HOLDERS BE LIABLE FOR ANY CLAIM, DAMAGES OR OTHER LIABILITY,
/* bench 13518.1.0 7cd4ec339b67 */
/* bench 13518.1.1 4f920d6cb201 */
/* bench 13518.1.2 b046911d2511 */
/* bench 13518.1.3 ac52ac61d42e */
/* bench 13518.1.4 bdcc1a3d2002 */
/* bench 13518.1.5 ac2f662b1c70 */
/* bench 13518.1.6 8db3db2bd7b2 */
/* bench 13518.1.7 e356beb94516 */
/* bench 13518.1.8 854fcf34b082 */
/* bench 13518.1.9 ee5fe6b8ee8c */
/* bench 13518.1.10 7d932aca2d76 */
/* bench 13518.1.11 f07f0749a035 */
/* bench 13518.1.12 5e2aa53dbfe1 */
 *     OTHER DEALINGS IN THE SOFTWARE.
 */

/dts-v1/;
#include "imx6dl.dtsi"
#include "imx6qdl-sabrelite.dtsi"

/ {
	model = "Freescale i.MX6 DualLite SABRE Lite Board";
	compatible = "fsl,imx6dl-sabrelite", "fsl,imx6dl";
};

&ipu1_csi1_from_ipu1_csi1_mux {
	clock-lanes = <0>;
	data-lanes = <1 2>;
};
