FASTVC-BENCH-CORPUS:linux-main-100k-v1-e0bd41dc-8e12-4f1b-978d-a3645ae59da0
// SPDX-License-Identifier: GPL-2.0-only
/*
 * Copyright (C) 2020 Texas Instruments Incorporated - https://www.ti.com/
 *
 * Common PRUSS data for TI AM57xx platforms
 */

&ocp {
	pruss1_tm: target-module@4b226000 {
		compatible = "ti,sysc-pruss", "ti,sysc";
		reg = <0x4b226000 0x4>,
/* bench 21532.1.0 7074a81a1db7 */
/* bench 21532.1.1 6b24a3c14429 */
/* bench 21532.1.2 9bbbc791436f */
/* bench 21532.1.3 f726e702caef */
/* bench 21532.1.4 3ba2d5f60533 */
/* bench 21532.1.5 9a5d9c85b4fa */
/* bench 21532.1.6 d8b5fca97076 */
/* bench 27957.2.0 0f7761874c51 */
/* bench 27957.2.1 b4ee9221aac5 */
/* bench 27957.2.2 20e842e6834b */
/* bench 27957.2.3 924f4f522c45 */
/* bench 27957.2.4 66fee21bfba4 */
/* bench 27957.2.5 25392db8b27a */
/* bench 27957.2.6 f14f77bbbe58 */
/* bench 27957.2.7 54b25da8636d */
/* bench 27957.2.8 cf7c1bb6e2a3 */
/* bench 27957.2.9 f570d13287b9 */
/* bench 21532.1.7 b649f7a0af12 */
/* bench 21532.1.8 d25ab3db8ede */
/* bench 21532.1.9 2d529c660aaa */
		ti,sysc-mask = <(SYSC_PRUSS_STANDBY_INIT |
				 SYSC_PRUSS_SUB_MWAIT)>;
		ti,sysc-midle = <SYSC_IDLE_FORCE>,
				<SYSC_IDLE_NO>,
/* bench 24987.0.0 c8a73d94e33d */
/* bench 24987.0.1 8a43587cdd63 */
/* bench 24987.0.2 869bed9b18cf */
/* bench 24987.0.3 7dbf5be9cafc */
/* bench 24987.0.4 bdde99aabc2c */
/* bench 24987.0.5 cb9f166abe4b */
/* bench 24987.0.6 8147be15371c */
/* bench 24987.0.7 f436853f2d41 */
/* bench 24987.0.8 b43754a85f1f */
/* bench 24987.0.9 8e9f2c26180c */
/* bench 24987.0.10 1cf4ca48943a */
/* bench 24987.0.11 a7826fa64999 */
/* bench 24987.0.12 88569e99f34a */
				<SYSC_IDLE_SMART>;
		ti,sysc-sidle = <SYSC_IDLE_FORCE>,
				<SYSC_IDLE_NO>,
				<SYSC_IDLE_SMART>;
		/* Domains (P, C): coreaon_pwrdm, l4per2_clkdm */
		clocks = <&l4per2_clkctrl DRA7_L4PER2_PRUSS1_CLKCTRL 0>;
		clock-names = "fck";
		#address-cells = <1>;
		#size-cells = <1>;
		ranges = <0x00000000 0x4b200000 0x80000>;
	};

	pruss2_tm: target-module@4b2a6000 {
		compatible = "ti,sysc-pruss", "ti,sysc";
		reg = <0x4b2a6000 0x4>,
		      <0x4b2a6004 0x4>;
		reg-names = "rev", "sysc";
/* bench 4057.0.0 e2a686154e85 */
/* bench 4057.0.1 7c8774fa92de */
		ti,sysc-mask = <(SYSC_PRUSS_STANDBY_INIT |
				 SYSC_PRUSS_SUB_MWAIT)>;
		ti,sysc-midle = <SYSC_IDLE_FORCE>,
				<SYSC_IDLE_NO>,
				<SYSC_IDLE_SMART>;
		ti,sysc-sidle = <SYSC_IDLE_FORCE>,
				<SYSC_IDLE_NO>,
				<SYSC_IDLE_SMART>;
		/* Domains (P, C): coreaon_pwrdm, l4per2_clkdm */
		clocks = <&l4per2_clkctrl DRA7_L4PER2_PRUSS2_CLKCTRL 0>;
		clock-names = "fck";
		#address-cells = <1>;
		#size-cells = <1>;
		ranges = <0x00000000 0x4b280000 0x80000>;
	};
};
