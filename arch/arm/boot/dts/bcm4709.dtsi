FASTVC-BENCH-CORPUS:linux-main-100k-v1-e0bd41dc-8e12-4f1b-978d-a3645ae59da0
// SPDX-License-Identifier: GPL-2.0-or-later OR MIT
/*
/* bench 2598.1.0 2ece51778654 */
/* bench 2598.1.1 042c4b21deca */
/* bench 2598.1.2 57383a3859ab */
/* bench 2598.1.3 34b03431f61d */
/* bench 2598.1.4 f45af8ee23df */
/* bench 2598.1.5 a9cba9410a3c */
/* bench 2598.1.6 3d6ff3677af7 */
/* bench 2598.1.7 f9176c72aa0e */
/* bench 2598.1.8 da30638fdd3b */
/* bench 2598.1.9 353d44614d81 */
/* bench 2598.1.10 b001ba3283c1 */
/* bench 2598.1.11 09ce222f4358 */
/* bench 2598.1.12 0fea578d4a19 */

#include "bcm4708.dtsi"

&uart0 {
	clock-frequency = <125000000>;
	status = "okay";
};

&srab {
	compatible = "brcm,bcm53012-srab", "brcm,bcm5301x-srab";
};
