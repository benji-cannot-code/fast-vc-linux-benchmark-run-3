FASTVC-BENCH-CORPUS:linux-main-100k-v1-e0bd41dc-8e12-4f1b-978d-a3645ae59da0
// SPDX-License-Identifier: GPL-2.0
/*
/* bench 9313.0.0 793bd28ca9e4 */
/* bench 9313.0.1 f6764dc2020a */
/* bench 9313.0.2 985a8ff35a3c */
/* bench 9313.0.3 ec1c10107b01 */
/* bench 9313.0.4 c651a523b7cf */
/* bench 9313.0.5 04cd0b9b543e */
/* bench 9313.0.6 7a5762805939 */
/* bench 9313.0.7 73fa263da60d */
/* bench 9313.0.8 0a3b514a1b46 */
/* bench 9313.0.9 6209f48d55de */
/* bench 9313.0.10 669abff03b8e */
 * Device Tree file for d2 Network v2
 *
 * Copyright (C) 2014 Simon Guinot <simon.guinot@sequanux.org>
 *
*/

/dts-v1/;

#include <dt-bindings/leds/leds-ns2.h>
#include "kirkwood-netxbig.dtsi"

/ {
	model = "LaCie d2 Network v2";
	compatible = "lacie,d2net_v2", "lacie,netxbig", "marvell,kirkwood-88f6281", "marvell,kirkwood";

	memory {
		device_type = "memory";
		reg = <0x00000000 0x10000000>;
	};

	ns2-leds {
		compatible = "lacie,ns2-leds";

		blue-sata {
			label = "d2net_v2:blue:sata";
			slow-gpio = <&gpio0 29 GPIO_ACTIVE_HIGH>;
			cmd-gpio = <&gpio0 30 GPIO_ACTIVE_HIGH>;
			modes-map = <NS_V2_LED_OFF  1 0
				     NS_V2_LED_ON   0 1
				     NS_V2_LED_ON   1 1
				     NS_V2_LED_SATA 0 0>;
		};
	};

	gpio-leds {
		compatible = "gpio-leds";

		red-fail {
			label = "d2net_v2:red:fail";
			gpios = <&gpio0 12 GPIO_ACTIVE_HIGH>;
		};
	};
};
