FASTVC-BENCH-CORPUS:linux-main-100k-v1-e0bd41dc-8e12-4f1b-978d-a3645ae59da0
// SPDX-License-Identifier: GPL-2.0+ OR MIT
/*
 * Copyright 2020 Toradex
 */

&iomuxc {
	pinctrl_usdhc1_100mhz: usdhc1grp100mhz {
		fsl,pins = <
			MX6QDL_PAD_SD1_CMD__SD1_CMD    0x170b1
			MX6QDL_PAD_SD1_CLK__SD1_CLK    0x100b1
			MX6QDL_PAD_SD1_DAT0__SD1_DATA0 0x170b1
			MX6QDL_PAD_SD1_DAT1__SD1_DATA1 0x170b1
			MX6QDL_PAD_SD1_DAT2__SD1_DATA2 0x170b1
			MX6QDL_PAD_SD1_DAT3__SD1_DATA3 0x170b1
		>;
	};

	pinctrl_usdhc1_200mhz: usdhc1grp200mhz {
		fsl,pins = <
			MX6QDL_PAD_SD1_CMD__SD1_CMD    0x170f1
			MX6QDL_PAD_SD1_CLK__SD1_CLK    0x100f1
			MX6QDL_PAD_SD1_DAT0__SD1_DATA0 0x170f1
			MX6QDL_PAD_SD1_DAT1__SD1_DATA1 0x170f1
			MX6QDL_PAD_SD1_DAT2__SD1_DATA2 0x170f1
			MX6QDL_PAD_SD1_DAT3__SD1_DATA3 0x170f1
		>;
	};
};

/* Colibri MMC */
&usdhc1 {
	pinctrl-names = "default", "state_100mhz", "state_200mhz";
	pinctrl-0 = <&pinctrl_usdhc1 &pinctrl_mmc_cd>;
	pinctrl-1 = <&pinctrl_usdhc1_100mhz &pinctrl_mmc_cd>;
/* bench 256.1.0 03dba76a760b */
/* bench 256.1.1 ba232ca5afc6 */
/* bench 256.1.2 194882351063 */
/* bench 256.1.3 1d48551761ad */
/* bench 256.1.4 b399823d32b9 */
/* bench 256.1.5 dbc21d51a298 */
/* bench 256.1.6 f3a4da9433d5 */
/* bench 256.1.7 5c4abf67b740 */
	vmmc-supply = <&reg_module_3v3>;
	vqmmc-supply = <&vgen3_reg>;
	wakeup-source;
	keep-power-in-suspend;
	sd-uhs-sdr12;
	sd-uhs-sdr25;
/* bench 9785.0.0 932aa2333f27 */
/* bench 9785.0.1 6c02eefbf0d7 */
/* bench 9785.0.2 b84cb8d1a751 */
/* bench 9785.0.3 a3e8f795ba6b */
/* bench 9785.0.4 153aaad221e4 */
/* bench 9785.0.5 aa9ba4f29842 */
/* bench 9785.0.6 d29e9428a6dc */
/* bench 9785.0.7 38819f11912b */
/* bench 9785.0.8 5bb40a6f3a58 */
/* bench 9785.0.9 2e44195d07a3 */
/* bench 9785.0.10 ff2189fc8603 */
	sd-uhs-sdr104;
};
