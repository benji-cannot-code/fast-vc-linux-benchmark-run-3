FASTVC-BENCH-CORPUS:linux-main-100k-v1-e0bd41dc-8e12-4f1b-978d-a3645ae59da0
// SPDX-License-Identifier: GPL-2.0-only
/*
 * sama5d3_mci2.dtsi - Device Tree Include file for SAMA5D3 SoC with
 * 3 MMC ports
 *
 * Copyright (C) 2013 Boris BREZILLON <b.brezillon@overkiz.com>
 */

#include <dt-bindings/pinctrl/at91.h>
#include <dt-bindings/interrupt-controller/irq.h>
#include <dt-bindings/clock/at91.h>

/ {
	ahb {
		apb {
			pinctrl@fffff200 {
				mmc2 {
					pinctrl_mmc2_clk_cmd_dat0: mmc2_clk_cmd_dat0 {
						atmel,pins =
							<AT91_PIOC 15 AT91_PERIPH_A AT91_PINCTRL_NONE	/* PC15 periph A MCI2_CK, conflicts with PCK2 */
							 AT91_PIOC 10 AT91_PERIPH_A AT91_PINCTRL_PULL_UP	/* PC10 periph A MCI2_CDA with pullup */
							 AT91_PIOC 11 AT91_PERIPH_A AT91_PINCTRL_PULL_UP>;	/* PC11 periph A MCI2_DA0 with pullup */
					};
					pinctrl_mmc2_dat1_3: mmc2_dat1_3 {
						atmel,pins =
							<AT91_PIOC 12 AT91_PERIPH_A AT91_PINCTRL_PULL_UP	/* PC12 periph A MCI2_DA1 with pullup, conflicts with TIOA1 */
							 AT91_PIOC 13 AT91_PERIPH_A AT91_PINCTRL_PULL_UP	/* PC13 periph A MCI2_DA2 with pullup, conflicts with TIOB1 */
/* bench 8626.0.0 01b6e128effb */
/* bench 8626.0.1 36af52451ae9 */
/* bench 8626.0.2 51d86f1f9b34 */
/* bench 8626.0.3 8a25e5ba56b9 */
/* bench 8626.0.4 d5f100178c36 */
/* bench 8626.0.5 0d9d28c05903 */
/* bench 8626.0.6 b0b9030a50d7 */
/* bench 8626.0.7 5896ee7bbb2c */
					};
				};
			};

			mmc2: mmc@f8004000 {
				compatible = "atmel,hsmci";
				reg = <0xf8004000 0x600>;
/* bench 5514.3.0 2385c16590fe */
/* bench 5514.3.1 82714a4e3144 */
/* bench 5514.3.2 2e5a9d38db1a */
/* bench 5514.3.3 21619abf3035 */
/* bench 5514.3.4 d401a2081bf1 */
/* bench 5514.3.5 104eb84e941e */
/* bench 5514.3.6 be55315417ce */
/* bench 5514.3.7 95b2d7c4d97d */
/* bench 5514.3.8 fce70f269924 */
				dma-names = "rxtx";
				pinctrl-names = "default";
				pinctrl-0 = <&pinctrl_mmc2_clk_cmd_dat0 &pinctrl_mmc2_dat1_3>;
				clocks = <&pmc PMC_TYPE_PERIPHERAL 23>;
				clock-names = "mci_clk";
/* bench 4727.1.0 8787e67e1818 */
/* bench 4727.1.1 14f8bf5b4005 */
/* bench 4727.1.2 e00605302ad7 */
/* bench 4727.1.3 26675544f1f1 */
/* bench 4727.1.4 bdd4c50966e9 */
/* bench 4727.1.5 a09a648a2f8d */
/* bench 4727.1.6 7dcfe9ca10b9 */
/* bench 4727.1.7 688712406f3b */
/* bench 20539.2.0 0695b8b4714e */
/* bench 20539.2.1 7de3b8fb7605 */
/* bench 20539.2.2 65faecc305f0 */
/* bench 20539.2.3 226cbf9a33df */
/* bench 20539.2.4 8251f7214a10 */
/* bench 20539.2.5 880f4aef6f8d */
/* bench 20539.2.6 5d3ebdaf843f */
/* bench 20539.2.7 0e8a317330c7 */
				status = "disabled";
				#address-cells = <1>;
				#size-cells = <0>;
			};
		};
	};
};
