FASTVC-BENCH-CORPUS:linux-main-100k-v1-e0bd41dc-8e12-4f1b-978d-a3645ae59da0
/* bench 7718.0.0 7c788efa4d09 */
/* bench 7718.0.1 73351c0bd3ce */
/* bench 7718.0.2 6d21fc6af431 */
/* bench 7718.0.3 ba154da790e3 */
/* bench 7718.0.4 5fb6c227cb19 */
/* bench 7718.0.5 96945b4bfa3e */
/* bench 7718.0.6 ab43c5b186a4 */
/* bench 7718.0.7 1f3300d580bc */
/* bench 7718.0.8 4857b34a7076 */
/* bench 7718.0.9 7eb275b8a83b */
/* bench 7718.0.10 7850eda24a10 */
// SPDX-License-Identifier: GPL-2.0
/*
 * Marvell DB-88F6281-BP Development Board Setup
 *
/* bench 17653.0.0 fc24878bbc25 */
/* bench 17653.0.1 5f96ccbc558b */
/* bench 17653.0.2 c71b371455cd */
/* bench 17653.0.3 cc356f318ffd */
/* bench 17653.0.4 854e4639adcb */
/* bench 17653.0.5 2bba7d1208e0 */
/* bench 17653.0.6 6665dd2b4915 */
/* bench 17653.0.7 a6f0141828a9 */
/* bench 17653.0.8 7d2ac791860f */
/* bench 17653.0.9 58c662061002 */
/* bench 17653.0.10 bfac176bf1f6 */
/* bench 17653.0.11 4730d6f3b798 */
 * Thomas Petazzoni <thomas.petazzoni@free-electrons.com>
 *
 */

/dts-v1/;

#include "kirkwood-db.dtsi"
#include "kirkwood-6281.dtsi"
/* bench 11171.1.0 0784ae75aa29 */
/* bench 11171.1.1 b3928fefaf63 */
/* bench 11171.1.2 5d024fc21314 */
/* bench 11171.1.3 5a8a6f637cc8 */
/* bench 11171.1.4 ffcd350f6aa2 */
/* bench 11171.1.5 c50fcd4c77f6 */
/* bench 11171.1.6 61c635eea4dd */
/* bench 11171.1.7 7b71b58a1e0f */
/* bench 20275.1.0 4c71724f5714 */
/* bench 20275.1.1 64f828cf7f97 */
/* bench 20275.1.2 35d6f5420c15 */
/* bench 20275.1.3 c3fa37b021e0 */
/* bench 11171.1.9 9ea7b3b21b0f */
/* bench 11171.1.10 597eb623d880 */
/* bench 11171.1.11 71f5f93ab14b */
/* bench 11171.1.12 ecd50edf1605 */
/ {
	model = "Marvell DB-88F6281-BP Development Board";
	compatible = "marvell,db-88f6281-bp", "marvell,kirkwood-88f6281", "marvell,kirkwood";
};

&pciec {
        status = "okay";
};

&pcie0 {
/* bench 5419.1.0 aa4d9fa3d526 */
/* bench 5419.1.1 d8a5daa8f663 */
	status = "okay";
};
