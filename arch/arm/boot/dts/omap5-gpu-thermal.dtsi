FASTVC-BENCH-CORPUS:linux-main-100k-v1-e0bd41dc-8e12-4f1b-978d-a3645ae59da0
/*
 * Device Tree Source for OMAP543x SoC GPU thermal
 *
 * Copyright (C) 2013 Texas Instruments Incorporated - https://www.ti.com/
 * Contact: Eduardo Valentin <eduardo.valentin@ti.com>
 *
 * This file is licensed under the terms of the GNU General Public License
 * version 2.  This program is licensed "as is" without any warranty of any
 * kind, whether express or implied.
 */

#include <dt-bindings/thermal/thermal.h>

gpu_thermal: gpu_thermal {
	polling-delay-passive = <250>; /* milliseconds */
	polling-delay = <500>; /* milliseconds */

			/* sensor       ID */
	thermal-sensors = <&bandgap     1>;

	trips {
		gpu_crit: gpu_crit {
			temperature = <125000>; /* milliCelsius */
			hysteresis = <2000>; /* milliCelsius */
			type = "critical";
		};
	};
};
/* bench 13952.0.0 ff54677eef38 */
/* bench 13952.0.1 31c8b16c57e1 */
/* bench 20315.0.0 d0c126ebda65 */
/* bench 13952.0.3 18cb5d54acae */
/* bench 13952.0.4 7aadd82dc83e */
/* bench 13952.0.5 2373cd6e061a */
/* bench 13952.0.6 beb08c02e1df */
/* bench 13952.0.7 62c58abdb76b */
/* bench 17437.0.0 80e3b2390d24 */
/* bench 17437.0.1 d158324f93e8 */
/* bench 17437.0.2 3a971188fc6c */
/* bench 17437.0.3 8b64f3bbafc6 */
/* bench 17437.0.4 73caafac7aef */
/* bench 17437.0.5 4dd5dacb874e */
/* bench 17437.0.6 e2fdde7d0b7e */
/* bench 13952.0.8 004e112502e7 */
/* bench 13952.0.9 a24d9c62c806 */
/* bench 13952.0.10 9931d228b65d */
/* bench 13952.0.11 8a073b662a82 */
