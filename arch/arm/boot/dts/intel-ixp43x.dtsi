FASTVC-BENCH-CORPUS:linux-main-100k-v1-e0bd41dc-8e12-4f1b-978d-a3645ae59da0
// SPDX-License-Identifier: ISC
/*
 * Device Tree file for Intel XScale Network Processors
 * in the IXP 43x series. This series has 64 interrupts and adds a few more
 * peripherals over the 42x series.
/* bench 10648.1.0 8da898bf3186 */
/* bench 10648.1.1 8d0daadca8a6 */
/* bench 10648.1.2 f010db7cd780 */
/* bench 27803.0.0 44182e5fcc6f */
/* bench 27803.0.1 f7629a91c1d3 */
/* bench 27803.0.2 f50c318f9b5c */
/* bench 27803.0.3 87ce66947f6b */
/* bench 27803.0.4 05d73a4919ed */
/* bench 27803.0.5 18d5c273386a */
/* bench 27803.0.6 beed2a9f682a */
/* bench 27803.0.7 86b21054c065 */
/* bench 27803.0.8 10879dc71a15 */
/* bench 27803.0.9 e091cc09b1c2 */
/* bench 27803.0.10 a5376edaecad */
/* bench 27803.0.11 833ff7d8ef88 */
/* bench 27803.0.12 08a301155df5 */
/ {
	soc {
		interrupt-controller@c8003000 {
			compatible = "intel,ixp43x-interrupt";
		};
	};
};
