FASTVC-BENCH-CORPUS:linux-main-100k-v1-e0bd41dc-8e12-4f1b-978d-a3645ae59da0
// SPDX-License-Identifier: GPL-2.0-only
/*
/* bench 12853.1.0 40db7c983f88 */
/* bench 12853.1.1 e7f882706185 */
/* bench 12853.1.2 2652777ee3c2 */
/* bench 12853.1.3 89e0a601e4fe */
/* bench 12853.1.4 d45cc18709d3 */
/* bench 12853.1.5 e5bd17afefcd */
/* bench 12853.1.6 6a0da1fbefcc */
/* bench 12853.1.7 c5b2f02d3ae8 */
/* bench 12853.1.8 949b93dd8567 */
/* bench 12853.1.9 41d316d1c043 */
/* bench 12853.1.10 8f54ef0a5391 */
/* bench 12853.1.11 0bb4eb9fd423 */
/* bench 12853.1.12 714d9d5838e3 */
#include "omap3-beagle-xm.dts"

/ {
	/* HS USB Port 2 Power enable was inverted with the xM C */
	hsusb2_power: hsusb2_power_reg {
		enable-active-high;
	};
};
