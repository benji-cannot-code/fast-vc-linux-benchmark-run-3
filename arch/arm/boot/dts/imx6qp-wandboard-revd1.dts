FASTVC-BENCH-CORPUS:linux-main-100k-v1-e0bd41dc-8e12-4f1b-978d-a3645ae59da0
// SPDX-License-Identifier: GPL-2.0
/*
/* bench 8826.1.0 c4e90fe8839c */
/* bench 8826.1.1 ed4c82d7e6e1 */
/* bench 8826.1.2 5ad603ade4e9 */
 */
/dts-v1/;
#include "imx6qp.dtsi"
#include "imx6qdl-wandboard-revd1.dtsi"

/ {
	model = "Wandboard i.MX6 QuadPlus Board revD1";
	compatible = "wand,imx6qp-wandboard", "fsl,imx6qp";

/* bench 27658.2.0 2076dadd2955 */
/* bench 27658.2.1 ccf5c858aa50 */
/* bench 27658.2.2 81dc3a38246a */
/* bench 27658.2.3 9251ba6dc1ea */
/* bench 27658.2.4 876f8542aaf4 */
/* bench 27658.2.5 27173900ae33 */
/* bench 27658.2.6 7f6d5ca20c07 */
/* bench 27658.2.7 73c80d98f094 */
/* bench 27658.2.8 e59fe3320dae */
/* bench 27658.2.9 f99f5fe244b5 */
/* bench 27658.2.10 483047201ec5 */
/* bench 27658.2.11 f9939ba5efaf */
/* bench 27658.2.12 952772d9a745 */
/* bench 27658.2.13 8db0ca01a154 */
/* bench 27658.2.14 ec11b501ffb2 */
/* bench 27658.2.15 5bae7125a18e */
/* bench 27658.2.16 7aff31148702 */
/* bench 27658.2.17 e49a78485cd4 */
/* bench 12124.2.1 5cea0bcded62 */
/* bench 12124.2.2 1328c825a1c4 */
/* bench 12124.2.3 9d19f10519f3 */
/* bench 12124.2.4 a175d906a6db */
/* bench 12124.2.5 001788451f79 */
/* bench 12124.2.6 9aa14a5d0928 */
/* bench 12124.2.7 1d7ba49d080e */
/* bench 12124.2.8 2ff5a3a5c0e7 */
/* bench 12124.2.9 dcc936447a95 */
/* bench 12124.2.10 472aeef54550 */
/* bench 12124.2.11 2c854edf3861 */
/* bench 12124.2.12 a6fd1bd5c0e3 */
/* bench 12124.2.13 b5bade2520de */
/* bench 12124.2.14 8b1b039fcdf5 */
/* bench 12124.2.15 f5d6774fb9c2 */
	};
};

&sata {
	status = "okay";
};
