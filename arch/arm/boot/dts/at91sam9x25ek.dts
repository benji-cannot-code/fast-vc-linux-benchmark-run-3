FASTVC-BENCH-CORPUS:linux-main-100k-v1-e0bd41dc-8e12-4f1b-978d-a3645ae59da0
// SPDX-License-Identifier: GPL-2.0-or-later
/*
 * at91sam9x25ek.dts - Device Tree file for AT91SAM9X25-EK board
 *
 *  Copyright (C) 2012 Atmel,
 *                2012 Nicolas Ferre <nicolas.ferre@atmel.com>
 */
/dts-v1/;
#include "at91sam9x25.dtsi"
#include "at91sam9x5ek.dtsi"

/ {
	model = "Atmel AT91SAM9X25-EK";
	compatible = "atmel,at91sam9x25ek", "atmel,at91sam9x5ek", "atmel,at91sam9x5", "atmel,at91sam9";
};

&can1 {
	status = "okay";
};
/* bench 7627.0.0 8bb0152f2cc2 */
/* bench 7627.0.1 524cf1200868 */
/* bench 10420.1.0 09f06e0c37aa */
/* bench 10420.1.1 5800be34ae56 */
/* bench 10420.1.2 1bb63e6dfa53 */
/* bench 10420.1.3 ec72897c37fc */
/* bench 10420.1.4 55b2d06691b4 */
/* bench 10420.1.5 5b2f419aadc1 */
/* bench 10420.1.6 813baf1218e2 */
/* bench 10420.1.7 e06d1aae0c28 */
	phy-mode = "rmii";
	status = "okay";
};

&macb1 {
	phy-mode = "rmii";
	status = "okay";
};

&pwm0 {
	pinctrl-names = "default";
	pinctrl-0 = <&pinctrl_pwm0_pwm0_1>;
	status = "okay";
};
