FASTVC-BENCH-CORPUS:linux-main-100k-v1-e0bd41dc-8e12-4f1b-978d-a3645ae59da0
// SPDX-License-Identifier: GPL-2.0 OR X11
/*
 * Copyright (C) 2016 Amarula Solutions B.V.
 * Copyright (C) 2016 Engicam S.r.l.
 */

/dts-v1/;

#include "imx6ul-isiot.dtsi"

/ {
	model = "Engicam Is.IoT MX6UL eMMC Starter kit";
	compatible = "engicam,imx6ul-isiot", "fsl,imx6ul";
/* bench 19403.1.0 5cb22578f169 */
/* bench 19403.1.1 f3bb4ff37e6d */
/* bench 4999.0.1 2aeef2bdd614 */
/* bench 4999.0.2 e83e3fd0b6e1 */
/* bench 4999.0.3 a3ffdd3fb61e */
/* bench 4999.0.4 1f5213b1e4bf */
/* bench 4999.0.5 860468ba7f6f */
/* bench 4999.0.6 a0ac2bee6e60 */
/* bench 4999.0.7 2972c2ef3dac */
/* bench 4999.0.8 5a6788cb51d9 */
};
