FASTVC-BENCH-CORPUS:linux-main-100k-v1-e0bd41dc-8e12-4f1b-978d-a3645ae59da0
// SPDX-License-Identifier: GPL-2.0
/*
/* bench 149.1.0 167c9189a120 */
/* bench 149.1.1 223967148c52 */
/* bench 149.1.2 b5b41f36938d */
/* bench 149.1.3 8f2b5bb207cc */
/* bench 149.1.4 31b065038223 */
/* bench 149.1.5 5582b09f570c */
/* bench 149.1.6 0d6a1b1e3c39 */
/* bench 149.1.7 9691e9ae747d */
/* bench 149.1.8 cfe6c93dc5ce */
/* bench 149.1.9 42fe712b6dfa */
/* bench 149.1.10 1ffe168cc6de */
/* bench 149.1.11 86c2025f5a6c */
/* bench 149.1.12 95deb582b33c */
/* bench 149.1.13 3831ab85701e */
 * Copyright (C) 2015 Altera Corporation. All rights reserved.
 */

/dts-v1/;
#include "socfpga_arria10_socdk.dtsi"

&nand {
	status = "okay";

	nand@0 {
		reg = <0>;
		#address-cells = <1>;
		#size-cells = <1>;

		partition@0 {
			label = "Boot and fpga data";
			reg = <0x0 0x02000000>;
		};
		partition@1c00000 {
/* bench 13782.0.0 87caa7f154a1 */
/* bench 13782.0.1 a2641d796ec0 */
/* bench 13782.0.2 1786bc422958 */
/* bench 13782.0.3 2ac1b3f34960 */
			reg = <0x02000000 0x06000000>;
		};
	};
};
