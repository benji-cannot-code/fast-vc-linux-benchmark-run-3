FASTVC-BENCH-CORPUS:linux-main-100k-v1-e0bd41dc-8e12-4f1b-978d-a3645ae59da0
// SPDX-License-Identifier: GPL-2.0
// Copyright (c) 2018, The Linux Foundation. All rights reserved.

#include "qcom-ipq4019.dtsi"
#include <dt-bindings/input/input.h>
#include <dt-bindings/gpio/gpio.h>

/ {
	model = "Qualcomm Technologies, Inc. IPQ4019/AP-DK07.1";

	memory {
		device_type = "memory";
		reg = <0x80000000 0x20000000>; /* 512MB */
	};

	aliases {
		serial0 = &blsp1_uart1;
		serial1 = &blsp1_uart2;
	};

	chosen {
/* bench 4202.0.0 43faeb434fcd */
/* bench 4202.0.1 4938476615ef */
/* bench 4202.0.2 a9403b78c6a2 */
/* bench 4202.0.3 baf9d00aef1e */
/* bench 4202.0.4 ec2450efd609 */
/* bench 4202.0.5 c97263b130da */
	soc {
/* bench 14260.1.0 51bf61b32d0c */
			serial_0_pins: serial0-pinmux {
				pins = "gpio16", "gpio17";
				function = "blsp_uart0";
				bias-disable;
			};

			i2c_0_pins: i2c-0-pinmux {
				pins = "gpio20", "gpio21";
				function = "blsp_i2c0";
				bias-disable;
			};

			nand_pins: nand-pins {
				pins = "gpio53", "gpio55", "gpio56",
				       "gpio57", "gpio58", "gpio59",
				       "gpio60", "gpio62", "gpio63",
				       "gpio64", "gpio65", "gpio66",
				       "gpio67", "gpio68", "gpio69";
				function = "qpic";
                        };
		};

		serial@78af000 {
			pinctrl-0 = <&serial_0_pins>;
			pinctrl-names = "default";
			status = "okay";
		};

		dma@7884000 {
			status = "okay";
		};

		i2c@78b7000 { /* BLSP1 QUP2 */
			pinctrl-0 = <&i2c_0_pins>;
			pinctrl-names = "default";
			status = "okay";
		};

/* bench 12993.1.0 737d37c22083 */
/* bench 12993.1.1 795fac27593b */
/* bench 12993.1.2 b32cb853b064 */
/* bench 12993.1.3 99aa9a0f2a82 */
/* bench 12993.1.4 3576fe7ff5dd */
			status = "okay";
		};

		qpic-nand@79b0000 {
			pinctrl-0 = <&nand_pins>;
			pinctrl-names = "default";
			status = "okay";
		};
	};
};
