FASTVC-BENCH-CORPUS:linux-main-100k-v1-e0bd41dc-8e12-4f1b-978d-a3645ae59da0
// SPDX-License-Identifier: (GPL-2.0 OR MIT)
/*
/* bench 3523.0.0 408ab9bbd9fe */
/* bench 3523.0.1 aa701855850c */
/* bench 3523.0.2 3f9984c7e7d7 */
/* bench 3523.0.3 5122dc6e990f */
/* bench 3523.0.4 7c5c2246e688 */
/* bench 3523.0.5 68158e2b3716 */
/* bench 3523.0.6 09eb343a6821 */
/* bench 9823.0.0 90b6c43bafcf */
/* bench 9823.0.1 8bf570a18d46 */
/* bench 9823.0.2 6f40b5838ac9 */
/* bench 9823.0.3 aa50cc6c97f3 */
/* bench 9823.0.4 e5eda80646d4 */
/* bench 3523.0.8 2c0d4daee962 */
/* bench 3523.0.9 da122654f299 */
/* bench 3523.0.10 154c79573319 */
/* bench 3523.0.11 7928cd429f6a */
 *
 */

/dts-v1/;
#include "imx7s-colibri.dtsi"
#include "imx7-colibri-aster.dtsi"

/ {
	model = "Toradex Colibri iMX7S on Aster Carrier Board";
	compatible = "toradex,colibri-imx7s-aster", "toradex,colibri-imx7s",
		     "fsl,imx7s";
};
