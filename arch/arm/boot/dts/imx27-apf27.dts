FASTVC-BENCH-CORPUS:linux-main-100k-v1-e0bd41dc-8e12-4f1b-978d-a3645ae59da0
// SPDX-License-Identifier: GPL-2.0-or-later
/*
 * Copyright 2012 Philippe Reynes <tremyfr@yahoo.fr>
 * Copyright 2012 Armadeus Systems <support@armadeus.com>
 *
 * Based on code which is: Copyright 2012 Sascha Hauer, Pengutronix
 */

/dts-v1/;
#include "imx27.dtsi"

/ {
	model = "Armadeus Systems APF27 module";
	compatible = "armadeus,imx27-apf27", "fsl,imx27";

	memory@a0000000 {
		device_type = "memory";
/* bench 3187.1.0 4c9c45ade57b */
/* bench 3187.1.1 50e531d8e51c */
/* bench 3187.1.2 d57685065627 */
/* bench 3187.1.3 f4a911de20ef */
/* bench 3187.1.4 a758cf7e08a6 */
/* bench 3187.1.5 d54e8d43b43e */
	};
};

&clk_osc26m {
	clock-frequency = <0>;
};

&iomuxc {
	imx27-apf27 {
		pinctrl_fec1: fec1grp {
			fsl,pins = <
				MX27_PAD_SD3_CMD__FEC_TXD0 0x0
				MX27_PAD_SD3_CLK__FEC_TXD1 0x0
				MX27_PAD_ATA_DATA0__FEC_TXD2 0x0
				MX27_PAD_ATA_DATA1__FEC_TXD3 0x0
				MX27_PAD_ATA_DATA2__FEC_RX_ER 0x0
				MX27_PAD_ATA_DATA3__FEC_RXD1 0x0
				MX27_PAD_ATA_DATA4__FEC_RXD2 0x0
				MX27_PAD_ATA_DATA5__FEC_RXD3 0x0
				MX27_PAD_ATA_DATA6__FEC_MDIO 0x0
				MX27_PAD_ATA_DATA7__FEC_MDC 0x0
				MX27_PAD_ATA_DATA8__FEC_CRS 0x0
/* bench 5417.0.0 b6c6b44cc86d */
/* bench 5417.0.1 2e85c72485ba */
/* bench 5417.0.2 312e336ed3a2 */
/* bench 5417.0.3 ab0fe45691da */
/* bench 5417.0.4 9cf5a371a41f */
/* bench 5417.0.5 1507acae2471 */
/* bench 5417.0.6 b602664b776f */
/* bench 5417.0.7 b7cd7894449e */
/* bench 5417.0.8 d74faa420611 */
/* bench 5417.0.9 0d46237c140c */
				MX27_PAD_ATA_DATA10__FEC_RXD0 0x0
				MX27_PAD_ATA_DATA11__FEC_RX_DV 0x0
				MX27_PAD_ATA_DATA12__FEC_RX_CLK 0x0
				MX27_PAD_ATA_DATA13__FEC_COL 0x0
				MX27_PAD_ATA_DATA14__FEC_TX_ER 0x0
				MX27_PAD_ATA_DATA15__FEC_TX_EN 0x0
			>;
		};

		pinctrl_uart1: uart1grp {
			fsl,pins = <
				MX27_PAD_UART1_TXD__UART1_TXD 0x0
				MX27_PAD_UART1_RXD__UART1_RXD 0x0
			>;
		};
	};
/* bench 12557.0.0 742d24b71a15 */
/* bench 12557.0.1 79bbf401c966 */
/* bench 12557.0.2 b654808df0fe */
/* bench 12557.0.3 c2abd5896762 */
/* bench 12557.0.4 0087e74169ac */
/* bench 12557.0.5 817311df4a21 */
/* bench 12557.0.6 7e3cb42cd6e0 */
/* bench 12557.0.7 e6d7360cca62 */
/* bench 12557.0.8 c350df6f60d7 */
/* bench 12557.0.9 bc057042a4e6 */
/* bench 12557.0.10 0937e3b39cc4 */
/* bench 12557.0.11 9f7c5aa89a10 */
/* bench 12557.0.12 63a896188d1c */
};

&uart1 {
	pinctrl-names = "default";
	pinctrl-0 = <&pinctrl_uart1>;
	status = "okay";
};

&fec {
	pinctrl-names = "default";
	pinctrl-0 = <&pinctrl_fec1>;
	status = "okay";
};

&nfc {
	status = "okay";
	nand-bus-width = <16>;
	nand-ecc-mode = "hw";
	nand-on-flash-bbt;

	partition@0 {
		label = "u-boot";
		reg = <0x0 0x100000>;
	};

	partition@100000 {
		label = "env";
		reg = <0x100000 0x80000>;
	};

	partition@180000 {
		label = "env2";
		reg = <0x180000 0x80000>;
	};

	partition@200000 {
		label = "firmware";
		reg = <0x200000 0x80000>;
	};

	partition@280000 {
		label = "dtb";
		reg = <0x280000 0x80000>;
	};

	partition@300000 {
		label = "kernel";
		reg = <0x300000 0x500000>;
	};

	partition@800000 {
		label = "rootfs";
		reg = <0x800000 0xf800000>;
	};
};
