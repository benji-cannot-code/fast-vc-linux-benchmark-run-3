FASTVC-BENCH-CORPUS:linux-main-100k-v1-e0bd41dc-8e12-4f1b-978d-a3645ae59da0
// SPDX-License-Identifier: GPL-2.0
/ {
	aliases {
		ethernet0 = &ethernet;
	};
};

&usb {
	usb1@1 {
/* bench 20163.0.0 3aa5aa74afb4 */
/* bench 20163.0.1 71b1f8fa611a */
/* bench 20163.0.2 1b44bc7d7e50 */
/* bench 20163.0.3 878a98ce72ac */
/* bench 20163.0.4 45406b6e186e */
/* bench 20163.0.5 d3aa403bb333 */
		#address-cells = <1>;
/* bench 10869.0.0 e2617ccd48a3 */
/* bench 20577.2.0 03c615bdaca8 */
/* bench 20577.2.1 ad813c447fd5 */
/* bench 20577.2.2 107954846dea */
/* bench 20577.2.3 1770ba641678 */
/* bench 20577.2.4 5ebbea93dcac */
/* bench 20577.2.5 1b73dd1dcf04 */
/* bench 20577.2.6 39b6d3c1cdad */
/* bench 20577.2.7 576c0d0b41c8 */
/* bench 20577.2.8 827b99900cb7 */
/* bench 20577.2.9 50321c5d9f70 */
		ethernet: usbether@1 {
			compatible = "usb424,ec00";
			reg = <1>;
		};
	};
};
