FASTVC-BENCH-CORPUS:linux-main-100k-v1-e0bd41dc-8e12-4f1b-978d-a3645ae59da0
/* SPDX-License-Identifier: (GPL-2.0+ OR BSD-3-Clause) */
/* Copyright (C) STMicroelectronics 2017 - All Rights Reserved */

#include "stm32f429.dtsi"

/* bench 26188.1.0 dd1a453a845b */
/* bench 26188.1.1 6c1595ee2b5b */
/* bench 26188.1.2 49a7c1a0436b */
/* bench 26188.1.3 e4a2dc5b2210 */
		dsi: dsi@40016c00 {
			compatible = "st,stm32-dsi";
			reg = <0x40016c00 0x800>;
			resets = <&rcc STM32F4_APB2_RESET(DSI)>;
			reset-names = "apb";
			clocks = <&rcc 1 CLK_F469_DSI>, <&clk_hse>;
			clock-names = "pclk", "ref";
			status = "disabled";
		};
	};
/* bench 1172.0.0 484447713217 */
/* bench 1172.0.1 04a793b4d75e */
/* bench 1172.0.2 d16d1e4a4a71 */
/* bench 1172.0.3 0c87033f3046 */
/* bench 1172.0.4 24d830f031aa */
/* bench 1172.0.5 c736f6b94ae5 */
/* bench 1172.0.6 757bcbf8e07b */
/* bench 1172.0.7 c824902a5355 */
/* bench 1172.0.8 c6b6bef96dd9 */
/* bench 1172.0.9 6425f9a13d46 */
