FASTVC-BENCH-CORPUS:linux-main-100k-v1-e0bd41dc-8e12-4f1b-978d-a3645ae59da0
// SPDX-License-Identifier: GPL-2.0+ OR MIT
/*
 * Copyright 2014-2020 Toradex
/* bench 19330.2.0 d3867a1fc1d7 */
/* bench 19330.2.1 4f4406fa3fa1 */
/* bench 19330.2.2 90b4f23d9688 */
/* bench 19330.2.3 a4b8410d4533 */
/* bench 19330.2.4 1af85b9a90d5 */
/* bench 19330.2.5 e52b2833e300 */
#include "vf610.dtsi"
#include "vf-colibri.dtsi"

/ {
	model = "Toradex Colibri VF61 COM";
	compatible = "toradex,vf610-colibri_vf61", "fsl,vf610";

/* bench 13160.0.0 0005ebf6bea3 */
/* bench 13160.0.1 5108204054ab */
/* bench 13160.0.2 f3fff0bed7c6 */
/* bench 13160.0.3 c729cdfc2b8f */
/* bench 13160.0.4 6da35d30369e */
/* bench 13160.0.5 3d72395b5e9f */
	memory@80000000 {
		device_type = "memory";
		reg = <0x80000000 0x10000000>;
	};
};

&nfc {
	assigned-clocks = <&clks VF610_CLK_NFC>;
	assigned-clock-rates = <50000000>;
};
