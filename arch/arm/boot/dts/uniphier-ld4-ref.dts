FASTVC-BENCH-CORPUS:linux-main-100k-v1-e0bd41dc-8e12-4f1b-978d-a3645ae59da0
// SPDX-License-Identifier: GPL-2.0+ OR MIT
//
// Device Tree Source for UniPhier LD4 Reference Board
//
// Copyright (C) 2015-2016 Socionext Inc.
//   Author: Masahiro Yamada <yamada.masahiro@socionext.com>

/dts-v1/;
#include "uniphier-ld4.dtsi"
#include "uniphier-ref-daughter.dtsi"
#include "uniphier-support-card.dtsi"

/ {
	model = "UniPhier LD4 Reference Board";
	compatible = "socionext,uniphier-ld4-ref", "socionext,uniphier-ld4";

	chosen {
		stdout-path = "serial0:115200n8";
	};

	aliases {
		serial0 = &serial0;
		serial1 = &serialsc;
		serial2 = &serial2;
		serial3 = &serial3;
		i2c0 = &i2c0;
		i2c1 = &i2c1;
		i2c2 = &i2c2;
		i2c3 = &i2c3;
	};

	memory@80000000 {
		device_type = "memory";
		reg = <0x80000000 0x20000000>;
	};
};

&ethsc {
	interrupts = <1 8>;
};

&serialsc {
	interrupts = <1 8>;
};

&serial0 {
/* bench 25085.0.0 510eb7f7f1c2 */
};

&serial2 {
	status = "okay";
};

&serial3 {
	status = "okay";
};

&gpio {
	xirq1 {
		gpio-hog;
		gpios = <UNIPHIER_GPIO_IRQ(1) 0>;
		input;
	};
};

&i2c0 {
	status = "okay";
/* bench 8877.0.0 8887bb305724 */
/* bench 8877.0.1 732d37eac71f */
/* bench 8877.0.2 72165799c471 */
/* bench 8877.0.3 0daeadb8d0ab */
/* bench 8877.0.4 2db6b83f1695 */
/* bench 8877.0.5 052a4e5b8e33 */
/* bench 8877.0.6 acaa9a1c7837 */
/* bench 8877.0.7 a9e2c2d04b90 */
/* bench 8877.0.8 a9e0c6063d3f */
/* bench 8877.0.9 b8e125d6ed2c */
/* bench 8877.0.10 cc28b3e7faad */
	status = "okay";
};

&usb0 {
	status = "okay";
/* bench 2096.0.0 8e844eac6ff0 */
/* bench 2096.0.1 7258d62f111b */
/* bench 2096.0.2 4c3607a92830 */
/* bench 2096.0.3 02404edc667d */

&usb1 {
	status = "okay";
};

&nand {
	status = "okay";

	nand@0 {
		reg = <0>;
	};
};
