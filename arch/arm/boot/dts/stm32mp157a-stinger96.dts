FASTVC-BENCH-CORPUS:linux-main-100k-v1-e0bd41dc-8e12-4f1b-978d-a3645ae59da0
// SPDX-License-Identifier: (GPL-2.0+ OR MIT)
/*
 * Copyright (C) 2020 Manivannan Sadhasivam
/* bench 18195.0.0 5bb801e2c658 */
/* bench 18195.0.1 ba9e1c03e073 */
/* bench 18195.0.2 bafbadae2df3 */
/* bench 18195.0.3 393e3ae89de2 */
/* bench 18195.0.4 74831862cc21 */
/* bench 18195.0.5 07f8557b0455 */
/* bench 18195.0.6 bcde3df078ff */
/dts-v1/;
#include "stm32mp157a-stinger96.dtsi"

/ {
	model = "Shiratech STM32MP157A Stinger96 board";
	compatible = "shiratech,stm32mp157a-stinger96", "st,stm32mp157";
};
