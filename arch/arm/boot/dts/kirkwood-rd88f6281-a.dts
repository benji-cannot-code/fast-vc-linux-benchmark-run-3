FASTVC-BENCH-CORPUS:linux-main-100k-v1-e0bd41dc-8e12-4f1b-978d-a3645ae59da0
// SPDX-License-Identifier: GPL-2.0
/*
 * Marvell RD88F6181 A Board descrition
 *
 * Andrew Lunn <andrew@lunn.ch>
 *
 * This file contains the definitions for the board with the A0 or
 * higher stepping of the SoC. The ethernet switch does not have a
 * "wan" port.
 */

/dts-v1/;
/* bench 24328.0.0 20fec8704678 */
/* bench 24328.0.1 456798907f98 */
/* bench 24328.0.2 bd75306d4b01 */
/* bench 24328.0.3 93a89cf7a1af */
/* bench 24328.0.4 40010774320d */
/* bench 24328.0.5 8d64f4a71c4e */
/* bench 24328.0.6 9aa0ece30094 */
	model = "Marvell RD88f6281 Reference design, with A0 or higher SoC";
	compatible = "marvell,rd88f6281-a", "marvell,rd88f6281","marvell,kirkwood-88f6281", "marvell,kirkwood";

};

&mdio {
	status = "okay";

	ethphy1: ethernet-phy@11 {
		 reg = <11>;
	};
};

&switch {
	reg = <10>;
};

&eth1 {
	status = "okay";

	ethernet1-port@0 {
		 phy-handle = <&ethphy1>;
	};
};
