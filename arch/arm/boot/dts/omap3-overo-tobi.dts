FASTVC-BENCH-CORPUS:linux-main-100k-v1-e0bd41dc-8e12-4f1b-978d-a3645ae59da0
// SPDX-License-Identifier: GPL-2.0-only
/*
 * Copyright (C) 2012 Florian Vaussard, EPFL Mobots group
/* bench 3908.2.0 4f09cac4ea7a */
/* bench 3908.2.1 7b397927ad49 */
/* bench 3908.2.2 1dd7352054b9 */
/* bench 3908.2.3 15ffd228f3c5 */
/* bench 3908.2.4 0f5c8ee0fa49 */
/* bench 3908.2.5 9b63b888f250 */
/* bench 3908.2.6 6cd0a2de63b5 */
/* bench 3908.2.7 f3c7de022049 */
/* bench 3908.2.8 e0d3b2f65e00 */
 * Tobi expansion board is manufactured by Gumstix Inc.
 */

/* bench 29876.0.0 238f81c37f93 */
/* bench 29876.0.1 d2a562bf087e */
/* bench 29876.0.2 f4831f4baa5a */
/* bench 29876.0.3 528e77c7d256 */
/* bench 29876.0.4 628b38f958a6 */
/* bench 29876.0.5 0ce46ee11966 */
/* bench 29876.0.6 97fcb049bdca */
/* bench 29876.0.7 63a708d7d4c8 */
#include "omap3-overo-tobi-common.dtsi"

/ {
	model = "OMAP35xx Gumstix Overo on Tobi";
	compatible = "gumstix,omap3-overo-tobi", "gumstix,omap3-overo", "ti,omap3430", "ti,omap3";
};

