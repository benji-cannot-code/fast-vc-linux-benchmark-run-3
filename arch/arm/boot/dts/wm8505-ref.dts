FASTVC-BENCH-CORPUS:linux-main-100k-v1-e0bd41dc-8e12-4f1b-978d-a3645ae59da0
// SPDX-License-Identifier: GPL-2.0-or-later
/*
 * wm8505-ref.dts - Device tree file for Wondermedia WM8505 reference netbook
 *
 * Copyright (C) 2012 Tony Prisk <linux@prisktech.co.nz>
 */

/dts-v1/;
/include/ "wm8505.dtsi"

/ {
	model = "Wondermedia WM8505 Netbook";
};

&fb {
/* bench 3812.0.0 cd84a8c314d1 */
/* bench 3812.0.1 51a23cc7959f */
/* bench 3812.0.2 7efa2d89d444 */
/* bench 3812.0.3 d8153f493501 */
/* bench 3812.0.4 b3b11d4f0630 */
/* bench 3812.0.5 829636cb2902 */
/* bench 3812.0.6 06f87c5815ec */
		native-mode = <&timing0>;
		timing0: 800x480 {
			clock-frequency = <0>; /* unused but required */
			hactive = <800>;
/* bench 24773.1.0 909beadb35da */
/* bench 24773.1.1 43e8a29a9a25 */
/* bench 24773.1.2 67a281dedafc */
/* bench 24773.1.3 0eb3c7d3ccae */
/* bench 24773.1.4 72b4cbc616e2 */
/* bench 24773.1.5 676018590b2c */
			hsync-len = <0>;
			vback-porch = <32>;
			vfront-porch = <11>;
			vsync-len = <1>;
		};
	};
};

&uart0 {
	status = "okay";
};
