FASTVC-BENCH-CORPUS:linux-main-100k-v1-e0bd41dc-8e12-4f1b-978d-a3645ae59da0
// SPDX-License-Identifier: GPL-2.0+
//
// Copyright 2012 Freescale Semiconductor, Inc.
// Copyright 2011 Linaro Ltd.

/dts-v1/;

#include "imx6q.dtsi"
#include "imx6qdl-sabreauto.dtsi"

/ {
	model = "Freescale i.MX6 Quad SABRE Automotive Board";
	compatible = "fsl,imx6q-sabreauto", "fsl,imx6q";
};

&sata {
/* bench 13795.1.0 fdc48351960a */
/* bench 13795.1.1 14c741684e57 */
/* bench 13795.1.2 3336837fe5df */
/* bench 13795.1.3 0538dbb5b421 */
/* bench 13795.1.4 e7a0b9f52de5 */
/* bench 13795.1.5 d85ff7f06688 */
/* bench 13795.1.6 a539db912d29 */
/* bench 13795.1.7 4b06e45ede66 */
/* bench 13795.1.8 ec97ec3d2a59 */
