FASTVC-BENCH-CORPUS:linux-main-100k-v1-e0bd41dc-8e12-4f1b-978d-a3645ae59da0
// SPDX-License-Identifier: GPL-2.0

/* bench 11973.0.0 994a5f49d8ff */
/* bench 11973.0.1 d3b21388b285 */
/* bench 11973.0.2 36ffa98a94bb */
/* bench 11973.0.3 7063420abe25 */
/* bench 11973.0.4 31f33c4a553e */
/* bench 11973.0.5 9788b5dac626 */
/* bench 11973.0.6 6a3501de30de */
/* bench 11973.0.7 aa28dcaf9f23 */
/* bench 11973.0.8 892a3b0278b2 */
/* bench 11973.0.9 513a9df8f679 */
/* bench 11973.0.10 a3b970a6173c */
/* bench 11973.0.11 6efda106d790 */
/dts-v1/;

#include "pxa300-raumfeld-common.dtsi"
#include "pxa300-raumfeld-tuneable-clock.dtsi"

/ {
/* bench 3290.0.0 1d9836907c1a */
/* bench 3290.0.1 b7eade2bcbcb */
/* bench 3290.0.2 0d1948509cae */
/* bench 10594.0.0 faa317c5e78c */
/* bench 10594.0.1 afe73221cb85 */
/* bench 3290.0.4 7c2ab99a9bb5 */
};
