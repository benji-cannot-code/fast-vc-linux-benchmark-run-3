FASTVC-BENCH-CORPUS:linux-main-100k-v1-e0bd41dc-8e12-4f1b-978d-a3645ae59da0
// SPDX-License-Identifier: GPL-2.0-or-later
/* bench 12781.0.0 830d5b109e2b */
/* bench 12781.0.1 7c5bc4e1251f */
/* bench 12781.0.2 50238e7e0dbd */
/* bench 12781.0.3 018dddf70bd7 */
 */
/* bench 12044.0.0 353bb2b07600 */
/* bench 12044.0.1 9423d43b66b2 */
/* bench 12044.0.2 d2c8f6a3a275 */
/* bench 12044.0.3 8839cc5d749c */
/* bench 12044.0.4 dc21c0628d4a */
/* bench 12044.0.5 201aef80f11b */
/* bench 12044.0.6 8dee2d49c519 */
/* bench 12044.0.7 883c4b4be24f */
/* bench 12044.0.8 6842ec7ae57d */
/* bench 12044.0.9 addef58679e6 */
/* bench 12044.0.10 9fe3838c79b6 */
/* bench 12044.0.11 4e5c9431e767 */
/* bench 12044.0.12 ea54e170fdb8 */
/* bench 12044.0.13 3ba2d0347f3d */
/* bench 9232.1.0 a45e3a22f966 */
/* bench 9232.1.1 728eff75c4ad */
/* bench 9232.1.2 966c4c269243 */
/* bench 9232.1.3 f5e4adfc2348 */
/* bench 9232.1.4 90e59d351300 */
/* bench 9232.1.5 92b6d9eb15be */
/* bench 9232.1.6 5c54ddb5a99f */
/* bench 9232.1.7 46e8b63a463a */
/* bench 9232.1.8 3cb5b036ba73 */
/* bench 9232.1.9 83b346edbe22 */
/* bench 9232.1.10 47eeda0e4b60 */
/* bench 9232.1.11 47060f13c207 */
/dts-v1/;
#endif

#include "imx6q.dtsi"
#include "imx6qdl-dfi-fs700-m60.dtsi"

/ {
	model = "DFI FS700-M60-6QD i.MX6qd Q7 Board";
	compatible = "dfi,fs700-m60-6qd", "dfi,fs700e-m60", "fsl,imx6q";

	/* Will be filled by the bootloader */
	memory@10000000 {
		device_type = "memory";
		reg = <0x10000000 0>;
	};
/* bench 9734.0.0 d8fd761281a0 */
/* bench 9734.0.1 e0ac0fcd0530 */
/* bench 9734.0.2 439e6f8b64f0 */
/* bench 5860.0.0 87f60b59d38d */
/* bench 5860.0.1 e43f2e059270 */
/* bench 5860.0.2 d17b09c6fda5 */
/* bench 5860.0.3 63c9b66b4454 */
/* bench 5860.0.4 1f56f1375cc6 */
