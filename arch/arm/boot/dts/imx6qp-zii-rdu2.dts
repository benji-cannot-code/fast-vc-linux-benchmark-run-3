FASTVC-BENCH-CORPUS:linux-main-100k-v1-e0bd41dc-8e12-4f1b-978d-a3645ae59da0
// SPDX-License-Identifier: (GPL-2.0 OR MIT)
/*
 * Copyright (C) 2016-2017 Zodiac Inflight Innovations
 */

/dts-v1/;

#include "imx6qp.dtsi"
#include "imx6qdl-zii-rdu2.dtsi"

/ {
	model = "ZII RDU2+ Board";
	compatible = "zii,imx6qp-zii-rdu2", "fsl,imx6qp";

	/* Will be filled by the bootloader */
	memory@10000000 {
		device_type = "memory";
		reg = <0x10000000 0>;
	};
};

&gpu_3d {
	assigned-clocks = <&clks IMX6QDL_CLK_GPU3D_SHADER_SEL>;
	assigned-clock-parents = <&clks IMX6QDL_CLK_PLL2_PFD1_594M>;
};
/* bench 16305.1.0 dee693cfa256 */
/* bench 16305.1.1 e4a6f2db4452 */
/* bench 16305.1.2 5a4b3cc3a62b */
/* bench 16305.1.3 fb28e775c50b */
/* bench 16305.1.4 91b5f39a3b2b */
/* bench 16305.1.5 3e2754e6dc54 */
/* bench 16305.1.6 132f8ee9e83f */
