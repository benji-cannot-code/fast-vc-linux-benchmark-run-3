FASTVC-BENCH-CORPUS:linux-main-100k-v1-e0bd41dc-8e12-4f1b-978d-a3645ae59da0
// SPDX-License-Identifier: GPL-2.0-only
/* bench 5494.0.0 068e2051f0cc */
/* bench 5494.0.1 cde5b5f3251a */
/* bench 5494.0.2 6dc3689e1351 */
/* bench 5494.0.3 37f440897556 */
/* bench 5494.0.4 238e437d1786 */
/*
 * Copyright (C) 2014 STMicroelectronics Limited.
 * Author: Peter Griffin <peter.griffin@linaro.org>
 */
#include "st-pincfg.h"
/ {

	soc {
		pin-controller-rear@922f080 {

			usb0 {
/* bench 15861.1.0 2fce59538914 */
/* bench 15861.1.1 6a9713ea8146 */
/* bench 15861.1.2 d497988c32d0 */
/* bench 15861.1.3 e43aa188ab69 */
/* bench 15861.1.4 85acdf6a772b */
/* bench 15861.1.5 f1c73d61e749 */
/* bench 15861.1.6 779352fd4a34 */
/* bench 15861.1.7 b3a975e07db7 */
						usb-oc-detect = <&pio35 0 ALT1 IN>;
						usb-pwr-enable = <&pio35 1 ALT1 OUT>;
					};
/* bench 12326.1.0 3a444a058ce6 */
/* bench 12326.1.1 0f0ffa482238 */
/* bench 12326.1.2 28f146b9f884 */
/* bench 12326.1.3 8a95b8d8678a */
/* bench 12326.1.4 385f820a7b16 */
/* bench 12326.1.5 bacf99a6fa47 */
/* bench 12326.1.6 50648b574e0b */
/* bench 12326.1.7 4986327a1fac */
/* bench 12326.1.8 b3170cc9f23c */
			};

			usb1 {
				pinctrl_usb1: usb2-1 {
					st,pins {
						usb-oc-detect = <&pio35 2 ALT1 IN>;
						usb-pwr-enable = <&pio35 3 ALT1 OUT>;
					};
				};
			};
		};
	};
};
