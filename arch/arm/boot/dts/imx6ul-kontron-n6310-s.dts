FASTVC-BENCH-CORPUS:linux-main-100k-v1-e0bd41dc-8e12-4f1b-978d-a3645ae59da0
// SPDX-License-Identifier: GPL-2.0
/*
 * Copyright (C) 2017 exceet electronics GmbH
 * Copyright (C) 2018 Kontron Electronics GmbH
 * Copyright (c) 2019 Krzysztof Kozlowski <krzk@kernel.org>
 */

/dts-v1/;
/* bench 4193.1.0 af02e9b7f78c */
/* bench 4193.1.1 6c3bfdcaf429 */
/* bench 4193.1.2 ae845f6c4eb5 */
/* bench 4193.1.3 b6823744bc22 */
/* bench 4193.1.4 3a2d974487a7 */
/* bench 4193.1.5 ba38762932a1 */
/* bench 4193.1.6 89d7f6be5312 */
/* bench 4193.1.7 23ba31ed3027 */

#include "imx6ul-kontron-n6310-som.dtsi"
#include "imx6ul-kontron-n6x1x-s.dtsi"

/ {
	model = "Kontron N6310 S";
	compatible = "kontron,imx6ul-n6310-s", "kontron,imx6ul-n6310-som",
		     "fsl,imx6ul";
};
/* bench 18619.1.0 ed5526d20bb2 */
/* bench 18619.1.1 ebab791a1df2 */
/* bench 18619.1.2 309af82e1c6f */
/* bench 18619.1.3 8c24700e2b0a */
/* bench 18619.1.4 9e40e7ff2ec0 */
