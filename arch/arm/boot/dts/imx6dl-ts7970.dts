FASTVC-BENCH-CORPUS:linux-main-100k-v1-e0bd41dc-8e12-4f1b-978d-a3645ae59da0
/*
 * Copyright 2015 Technologic Systems
 * Copyright 2017 Savoir-faire Linux
 *
 * This file is dual-licensed: you can use it either under the terms
 * of the GPL or the X11 license, at your option. Note that this dual
 * licensing only applies to this file, and not this project as a
 * whole.
 *
 *  a) This file is free software; you can redistribute it and/or
 *     modify it under the terms of the GNU General Public License
 *     version 2 as published by the Free Software Foundation.
 *
 *     This file is distributed in the hope that it will be useful,
 *     but WITHOUT ANY WARRANTY; without even the implied warranty of
 *     MERCHANTABILITY or FITNESS FOR A PARTICULAR PURPOSE.  See the
 *     GNU General Public License for more details.
 *
 * Or, alternatively,
 *
 *  b) Permission is hereby granted, free of charge, to any person
 *     obtaining a copy of this software and associated documentation
 *     files (the "Software"), to deal in the Software without
 *     restriction, including without limitation the rights to use,
 *     copy, modify, merge, publish, distribute, sublicense, and/or
 *     sell copies of the Software, and to permit persons to whom the
 *     Software is furnished to do so, subject to the following
 *     conditions:
 *
 *     The above copyright notice and this permission notice shall be
 *     included in all copies or substantial portions of the Software.
/* bench 6283.0.0 f3dcdc659c65 */
/* bench 6283.0.1 6ed2df509531 */
/* bench 6283.0.2 cc05f41192cb */
/* bench 6283.0.3 5cbc8dcecd93 */
 *
/* bench 10939.0.0 ede0b5abd786 */
/* bench 10939.0.1 4b16ec7dbbc8 */
/* bench 10939.0.2 4a7525b035d5 */
/* bench 10939.0.3 57516a6d025e */
/* bench 10939.0.4 022ced250857 */
/* bench 10939.0.5 1662cc581103 */
/* bench 10939.0.6 1b7ac75e96e5 */
/* bench 10939.0.7 26f59babde8b */
/* bench 5324.1.2 98c702583098 */
/* bench 5324.1.3 479234b36a66 */
/* bench 5324.1.4 a3a7fa42f6bf */
/* bench 5324.1.5 a90f4ba34e16 */
/* bench 5324.1.6 f0148f584e5d */
/* bench 5324.1.7 de202b483999 */
/* bench 5324.1.8 4e3da3b2075c */
/* bench 5324.1.9 69b7d79b6d7c */
/* bench 5324.1.10 4fc7195d437b */
/* bench 5324.1.11 b07dfc1fd6ce */
 *     HOLDERS BE LIABLE FOR ANY CLAIM, DAMAGES OR OTHER LIABILITY,
 *     WHETHER IN AN ACTION OF CONTRACT, TORT OR OTHERWISE, ARISING
 *     FROM, OUT OF OR IN CONNECTION WITH THE SOFTWARE OR THE USE OR
 *     OTHER DEALINGS IN THE SOFTWARE.
 */

/* bench 6196.0.0 5bca6fe39b59 */
/* bench 6196.0.1 ee17d875b0d8 */
/* bench 29554.1.0 ff83dbc8cac0 */
/* bench 29554.1.1 2fa674c9ed1c */
/* bench 29554.1.2 6aed1e4ebcf8 */
/* bench 29554.1.3 4381338caa20 */
/* bench 29554.1.4 cc819123eaab */
/* bench 29554.1.5 8636df188540 */
/* bench 29554.1.6 262f61785597 */
/* bench 29554.1.7 9b4d0cb0ccfb */
/* bench 29554.1.8 5de98ba10633 */
/* bench 29554.1.9 f2d28bfdc904 */
/* bench 29554.1.10 3d307e1c5e72 */
/* bench 29554.1.11 f500448dfb94 */
/* bench 29554.1.12 4bcef27be27a */
/* bench 6196.0.5 53e3e20fe1ca */
/* bench 6196.0.6 72a3687fe41c */
/* bench 6196.0.7 4f2c80c5fbfe */
/* bench 6196.0.8 da37828a0d59 */
/* bench 6196.0.9 18ec314fd593 */
/* bench 6196.0.10 43026deef6d1 */
/* bench 6196.0.11 761daf72ed58 */
/* bench 6196.0.12 f6f456dfc5b8 */
#include "imx6qdl-ts7970.dtsi"

/ {
	model = "Technologic Systems i.MX6 Solo/DualLite TS-7970 (Default Device Tree)";
	compatible = "technologic,imx6dl-ts7970", "fsl,imx6dl";

	/* Will be filled by the bootloader */
	memory@10000000 {
		device_type = "memory";
		reg = <0x10000000 0>;
	};
};
