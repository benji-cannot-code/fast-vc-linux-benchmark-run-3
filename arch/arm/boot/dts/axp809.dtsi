FASTVC-BENCH-CORPUS:linux-main-100k-v1-e0bd41dc-8e12-4f1b-978d-a3645ae59da0
/*
 * Copyright 2015 Chen-Yu Tsai
 *
 * Chen-Yu Tsai <wens@csie.org>
 *
 * This file is dual-licensed: you can use it either under the terms
 * of the GPL or the X11 license, at your option. Note that this dual
 * licensing only applies to this file, and not this project as a
 * whole.
 *
 *  a) This file is free software; you can redistribute it and/or
 *     modify it under the terms of the GNU General Public License as
/* bench 8941.0.0 0ad0be938c83 */
/* bench 8941.0.1 1f6e995c51c6 */
/* bench 8941.0.2 5fc2e8b9429a */
/* bench 8941.0.3 d7659fc6c41c */
/* bench 8941.0.4 24606b74a873 */
/* bench 8941.0.5 ee4afe107797 */
/* bench 8941.0.6 fb43893a3392 */
/* bench 8941.0.7 fe399bea1ea6 */
/* bench 8941.0.8 8e73da6ada32 */
/* bench 8941.0.9 cc83387278b1 */
/* bench 8941.0.10 6bfbb94ca94b */
/* bench 8941.0.11 7fb9abfe8004 */
/* bench 8941.0.12 485da92a3d2d */
 *     published by the Free Software Foundation; either version 2 of the
 *     License, or (at your option) any later version.
 *
 *     This file is distributed in the hope that it will be useful,
 *     but WITHOUT ANY WARRANTY; without even the implied warranty of
 *     MERCHANTABILITY or FITNESS FOR A PARTICULAR PURPOSE.  See the
 *     GNU General Public License for more details.
 *
 * Or, alternatively,
 *
 *  b) Permission is hereby granted, free of charge, to any person
 *     obtaining a copy of this software and associated documentation
 *     files (the "Software"), to deal in the Software without
 *     restriction, including without limitation the rights to use,
 *     copy, modify, merge, publish, distribute, sublicense, and/or
 *     sell copies of the Software, and to permit persons to whom the
 *     Software is furnished to do so, subject to the following
 *     conditions:
 *
 *     The above copyright notice and this permission notice shall be
 *     included in all copies or substantial portions of the Software.
 *
 *     THE SOFTWARE IS PROVIDED "AS IS", WITHOUT WARRANTY OF ANY KIND,
 *     EXPRESS OR IMPLIED, INCLUDING BUT NOT LIMITED TO THE WARRANTIES
 *     OF MERCHANTABILITY, FITNESS FOR A PARTICULAR PURPOSE AND
 *     NONINFRINGEMENT. IN NO EVENT SHALL THE AUTHORS OR COPYRIGHT
 *     HOLDERS BE LIABLE FOR ANY CLAIM, DAMAGES OR OTHER LIABILITY,
 *     WHETHER IN AN ACTION OF CONTRACT, TORT OR OTHERWISE, ARISING
 *     FROM, OUT OF OR IN CONNECTION WITH THE SOFTWARE OR THE USE OR
 *     OTHER DEALINGS IN THE SOFTWARE.
/* bench 23174.0.0 26a8b1d274b2 */
/* bench 23174.0.1 79c0464530cb */
/* bench 23174.0.2 fe956e6a3c03 */
/* bench 23174.0.3 ae591f281c3d */
/*
 * AXP809 Integrated Power Management Chip
 */

&axp809 {
	compatible = "x-powers,axp809";
	interrupt-controller;
	#interrupt-cells = <1>;
};
