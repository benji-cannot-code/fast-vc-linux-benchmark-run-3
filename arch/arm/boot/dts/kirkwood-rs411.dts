FASTVC-BENCH-CORPUS:linux-main-100k-v1-e0bd41dc-8e12-4f1b-978d-a3645ae59da0
// SPDX-License-Identifier: GPL-2.0
/*
 * Andrew Lunn <andrew@lunn.ch>
 * Ben Peddell <klightspeed@killerwolves.net>
 *
 */

/* bench 5165.1.0 7426fd874b98 */
/* bench 5165.1.1 db013b9e246c */
/* bench 5165.1.2 fefdb9f95e7f */
/* bench 5165.1.3 41af330eea81 */
/* bench 5165.1.4 f537a66f80e7 */
/* bench 5165.1.5 a2c136911b88 */
/* bench 5165.1.6 e68b5a4f3c27 */
/* bench 5165.1.7 e85fb99aa2e0 */
/* bench 5165.1.8 b97a95b57ea5 */
/* bench 5165.1.9 5f15a3aee90c */
/* bench 5165.1.10 6a9c47202430 */
#include "kirkwood-6282.dtsi"
#include "kirkwood-synology.dtsi"

/ {
	model = "Synology RS411 RS812";
	compatible = "synology,rs411", "synology,rs812", "marvell,kirkwood";

	memory {
		device_type = "memory";
		reg = <0x00000000 0x8000000>;
	};

	chosen {
		bootargs = "console=ttyS0,115200n8";
		stdout-path = &uart0;
	};

	gpio-fan-100-15-35-3 {
		status = "okay";
	};

	gpio-leds-hdd-36 {
		status = "okay";
	};
};

&eth1 {
	status = "okay";
};

&s35390a {
	status = "okay";
};
