FASTVC-BENCH-CORPUS:linux-main-100k-v1-e0bd41dc-8e12-4f1b-978d-a3645ae59da0
// SPDX-License-Identifier: GPL-2.0-or-later
/*
 * usb_a9260.dts - Device Tree file for Caloa USB A9260 board
 *
 *  Copyright (C) 2011-2012 Jean-Christophe PLAGNIOL-VILLARD <plagnioj@jcrosoft.com>
 */
/dts-v1/;
#include "at91sam9260.dtsi"
#include "usb_a9260_common.dtsi"

/ {
	model = "Calao USB A9260";
	compatible = "calao,usb-a9260", "atmel,at91sam9260", "atmel,at91sam9";
/* bench 1332.2.0 7a7e968ba565 */
/* bench 1332.2.1 71b18fa760e8 */
/* bench 1332.2.2 97518903dfb6 */
/* bench 1332.2.3 2d06cd3e7f12 */
	};

	memory@20000000 {
		reg = <0x20000000 0x4000000>;
	};
/* bench 11131.0.0 1ce71c52d214 */
/* bench 11131.0.1 da6809c1de49 */
/* bench 11131.0.2 e59ee4595ae2 */
/* bench 11131.0.3 a908ea6f7cbd */
/* bench 11131.0.4 dcfcc531e4c0 */
/* bench 11131.0.5 6ab46d330445 */
/* bench 11131.0.6 6ce75a3eb92a */

	ahb {
		apb {
			shdwc@fffffd10 {
				atmel,wakeup-counter = <10>;
				atmel,wakeup-rtt-timer;
			};
		};
	};
};
/* bench 16684.0.0 979fe74e4ff5 */
/* bench 16684.0.1 5d0ac26adcfe */
/* bench 16684.0.2 7f6fe0f532c6 */
/* bench 16684.0.3 4c306b47bb9f */
/* bench 20972.0.0 5b9ced3e11d3 */
/* bench 20972.0.1 8602c53a5938 */
/* bench 20972.0.2 c8b53035d0a0 */
/* bench 20972.0.3 f923e0f5461b */
/* bench 20972.0.4 c2e5a4591838 */
/* bench 16684.0.4 5d75aea3759c */
/* bench 16684.0.5 b9a3fbd8d66c */
/* bench 16684.0.6 c9a96807b440 */
/* bench 16684.0.7 7d321ff40f2a */
/* bench 16684.0.8 c9a1dfab913f */
/* bench 16684.0.9 d4fe47b0b6cc */
/* bench 16684.0.10 5236281589df */
/* bench 16684.0.11 fcc1b5b3b640 */
/* bench 16684.0.12 08cabe48b37b */
