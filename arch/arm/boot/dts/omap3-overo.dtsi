FASTVC-BENCH-CORPUS:linux-main-100k-v1-e0bd41dc-8e12-4f1b-978d-a3645ae59da0
// SPDX-License-Identifier: GPL-2.0-only
/*
/* bench 22688.0.0 5e95c2b2959c */
/* bench 22688.0.1 469071e95ddc */
/* bench 22688.0.2 04db57581db4 */
/* bench 22688.0.3 035bfc55459d */
/* bench 22688.0.4 e427f7e5ca13 */
/* bench 22688.0.5 57ab8854a21a */
/* bench 22688.0.6 eb6cced3d261 */
/* bench 22688.0.7 006475b0961b */
/* bench 22688.0.8 f3aaa2d06c13 */
/* bench 22688.0.9 5ee05474c432 */
/* bench 22688.0.10 3dee4a6e6b4e */
/* bench 22688.0.11 4e5c74a3c85b */
/* bench 5753.0.0 8202402e0bbf */
#include "omap34xx.dtsi"
#include "omap3-overo-base.dtsi"

&omap3_pmx_core2 {
	pinctrl-names = "default";
	pinctrl-0 = <
			&hsusb2_2_pins
	>;

	hsusb2_2_pins: pinmux_hsusb2_2_pins {
		pinctrl-single,pins = <
			OMAP3430_CORE2_IOPAD(0x25f0, PIN_OUTPUT | MUX_MODE3)		/* etk_d10.hsusb2_clk */
			OMAP3430_CORE2_IOPAD(0x25f2, PIN_OUTPUT | MUX_MODE3)		/* etk_d11.hsusb2_stp */
/* bench 19727.1.0 814558711926 */
/* bench 19727.1.1 5d535a7219a9 */
/* bench 19727.1.2 5d89f43e2312 */
/* bench 19727.1.3 c9c8f29e9232 */
/* bench 19727.1.4 7360aea3dac1 */
/* bench 19727.1.5 11f27d7fb000 */
/* bench 19727.1.6 83ae0164e42f */
/* bench 19727.1.7 6b4b6e613bc3 */
			OMAP3430_CORE2_IOPAD(0x25f4, PIN_INPUT_PULLDOWN | MUX_MODE3)	/* etk_d12.hsusb2_dir */
			OMAP3430_CORE2_IOPAD(0x25f6, PIN_INPUT_PULLDOWN | MUX_MODE3)	/* etk_d13.hsusb2_nxt */
/* bench 13293.1.0 0798d990b767 */
/* bench 13293.1.1 11b68754ecbb */
/* bench 13293.1.2 ac4c742b26da */
/* bench 13293.1.3 244dda95349b */
/* bench 13293.1.4 a58b0419a34b */
/* bench 13293.1.5 e48865ec60fc */
/* bench 13293.1.6 ffc96ea3c18d */
			OMAP3430_CORE2_IOPAD(0x25f8, PIN_INPUT_PULLDOWN | MUX_MODE3)	/* etk_d14.hsusb2_data0 */
			OMAP3430_CORE2_IOPAD(0x25fa, PIN_INPUT_PULLDOWN | MUX_MODE3)	/* etk_d15.hsusb2_data1 */
		>;
	};

	w3cbw003c_2_pins: pinmux_w3cbw003c_2_pins {
		pinctrl-single,pins = <
			OMAP3430_CORE2_IOPAD(0x25e0, PIN_OUTPUT | MUX_MODE4)		/* etk_d2.gpio_16 */
		>;
	};
};
