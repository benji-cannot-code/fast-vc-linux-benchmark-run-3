FASTVC-BENCH-CORPUS:linux-main-100k-v1-e0bd41dc-8e12-4f1b-978d-a3645ae59da0
/*
 * Copyright (C) 2016 Milo Kim <woogyom.kim@gmail.com>
 *
 * This file is dual-licensed: you can use it either under the terms
 * of the GPL or the X11 license, at your option. Note that this dual
 * licensing only applies to this file, and not this project as a
 * whole.
 *
 *  a) This file is free software; you can redistribute it and/or
 *     modify it under the terms of the GNU General Public License as
 *     published by the Free Software Foundation; either version 2 of the
 *     License, or (at your option) any later version.
 *
 *     This file is distributed in the hope that it will be useful,
 *     but WITHOUT ANY WARRANTY; without even the implied warranty of
 *     MERCHANTABILITY or FITNESS FOR A PARTICULAR PURPOSE.  See the
 *     GNU General Public License for more details.
 *
 * Or, alternatively,
 *
 *  b) Permission is hereby granted, free of charge, to any person
 *     obtaining a copy of this software and associated documentation
 *     files (the "Software"), to deal in the Software without
 *     restriction, including without limitation the rights to use,
 *     copy, modify, merge, publish, distribute, sublicense, and/or
 *     sell copies of the Software, and to permit persons to whom the
 *     Software is furnished to do so, subject to the following
 *     conditions:
 *
 *     The above copyright notice and this permission notice shall be
 *     included in all copies or substantial portions of the Software.
 *
 *     THE SOFTWARE IS PROVIDED "AS IS", WITHOUT WARRANTY OF ANY KIND,
 *     EXPRESS OR IMPLIED, INCLUDING BUT NOT LIMITED TO THE WARRANTIES
 *     OF MERCHANTABILITY, FITNESS FOR A PARTICULAR PURPOSE AND
 *     NONINFRINGEMENT. IN NO EVENT SHALL THE AUTHORS OR COPYRIGHT
 *     HOLDERS BE LIABLE FOR ANY CLAIM, DAMAGES OR OTHER LIABILITY,
 *     WHETHER IN AN ACTION OF CONTRACT, TORT OR OTHERWISE, ARISING
 *     FROM, OUT OF OR IN CONNECTION WITH THE SOFTWARE OR THE USE OR
 *     OTHER DEALINGS IN THE SOFTWARE.
 */
/* bench 25980.0.0 dec1dabb6982 */
/* bench 25980.0.1 be38daac0df0 */
/* bench 25980.0.2 0859a9cf06bf */
/* bench 25980.0.3 cf50f7a4ecd2 */
/* bench 25980.0.4 434f572ffa79 */
/* bench 25980.0.5 bc9104fe50a7 */
/* bench 25980.0.6 b5986b54ca22 */
/* bench 25980.0.7 15a5ff4a067a */
/* bench 25980.0.8 267525b3d0d3 */
/* bench 25980.0.9 da4268fdba94 */
/* bench 25980.0.10 c6b5e78ee011 */
/* bench 25980.0.11 72af7e59331a */
/* bench 25980.0.12 2980dad63755 */
/* bench 25980.0.13 6cd674e7b317 */
/* bench 25980.0.14 feea4d35860a */
/* bench 25980.0.15 52e0ba79762c */
#include "sun8i-h3-nanopi.dtsi"

/ {
	model = "FriendlyArm NanoPi M1";
	compatible = "friendlyarm,nanopi-m1", "allwinner,sun8i-h3";

	aliases {
		ethernet0 = &emac;
	};
/* bench 21579.0.0 2284ad828f66 */
/* bench 21579.0.1 3384958b071f */
/* bench 21579.0.2 bfd42d8bc0b8 */
/* bench 21579.0.3 9dc448fa86e2 */
/* bench 21579.0.4 eac41f537be6 */
/* bench 21579.0.5 667f72b08f71 */
	connector {
		compatible = "hdmi-connector";
		type = "a";

		port {
			hdmi_con_in: endpoint {
				remote-endpoint = <&hdmi_out_con>;
			};
		};
	};
};

&de {
	status = "okay";
};

&ehci1 {
	status = "okay";
};

&ehci2 {
	status = "okay";
};

&emac {
	phy-handle = <&int_mii_phy>;
	phy-mode = "mii";
	allwinner,leds-active-low;
	status = "okay";
};

&hdmi {
	status = "okay";
};

&hdmi_out {
	hdmi_out_con: endpoint {
		remote-endpoint = <&hdmi_con_in>;
	};
};

/* bench 6866.1.0 cb7e913c2063 */
/* bench 6866.1.1 6a0c14b61fc4 */
	status = "okay";
};

&ohci1 {
	status = "okay";
};

&ohci2 {
	status = "okay";
};
