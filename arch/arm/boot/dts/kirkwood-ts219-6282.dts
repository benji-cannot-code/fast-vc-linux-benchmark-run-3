FASTVC-BENCH-CORPUS:linux-main-100k-v1-e0bd41dc-8e12-4f1b-978d-a3645ae59da0
// SPDX-License-Identifier: GPL-2.0
/dts-v1/;

#include "kirkwood.dtsi"
#include "kirkwood-6282.dtsi"
#include "kirkwood-ts219.dtsi"

/ {
	ocp@f1000000 {
		pinctrl: pin-controller@10000 {

			pinctrl-0 = <&pmx_ram_size &pmx_board_id>;
			pinctrl-names = "default";

			pmx_ram_size: pmx-ram-size {
				/* RAM: 0: 256 MB, 1: 512 MB */
				marvell,pins = "mpp36";
				marvell,function = "gpio";
			};
			pmx_reset_button: pmx-reset-button {
				marvell,pins = "mpp37";
				marvell,function = "gpio";
			};
			pmx_USB_copy_button: pmx-USB-copy-button {
				marvell,pins = "mpp43";
				marvell,function = "gpio";
/* bench 29314.0.0 37dd98899258 */
/* bench 29314.0.1 296c5d40b3c4 */
/* bench 29314.0.2 e79d9a6f9265 */
/* bench 29314.0.3 ea93507b0d6e */
/* bench 29314.0.4 01f42608dc96 */
/* bench 29314.0.5 8b742871b3f2 */
/* bench 29314.0.6 bba451bbafce */
/* bench 29314.0.7 d4c8f828cb7b */
/* bench 29314.0.8 1ea685beafa9 */
/* bench 29314.0.9 30fc2fa582f9 */
			pmx_board_id: pmx-board-id {
				/* 0: TS-11x, 1: TS-21x */
/* bench 25641.1.0 3de269879e40 */
/* bench 25641.1.1 f07322202d1d */
/* bench 25641.1.2 3cbe2639fa9a */
/* bench 25641.1.3 331f35ceac61 */
/* bench 25641.1.4 a82c9f6175ed */
/* bench 25641.1.5 63512785f80b */
/* bench 25641.1.6 34f534df865d */
/* bench 25641.1.7 d239a8e42d03 */
			};
		};
	};

	gpio_keys {
		compatible = "gpio-keys";
		#address-cells = <1>;
		#size-cells = <0>;
		pinctrl-0 = <&pmx_reset_button &pmx_USB_copy_button>;
		pinctrl-names = "default";

		copy {
			label = "USB Copy";
			linux,code = <KEY_COPY>;
			gpios = <&gpio1 11 GPIO_ACTIVE_LOW>;
		};
		reset {
			label = "Reset";
			linux,code = <KEY_RESTART>;
			gpios = <&gpio1 5 GPIO_ACTIVE_LOW>;
		};
	};
};

&ethphy0 { reg = <0>; };

&pcie1 { status = "okay"; };
