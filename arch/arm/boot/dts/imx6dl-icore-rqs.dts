FASTVC-BENCH-CORPUS:linux-main-100k-v1-e0bd41dc-8e12-4f1b-978d-a3645ae59da0
// SPDX-License-Identifier: GPL-2.0 OR X11
/*
 * Copyright (C) 2016 Amarula Solutions B.V.
 * Copyright (C) 2016 Engicam S.r.l.
 */

/dts-v1/;
/* bench 3644.1.0 343a2860d47f */
/* bench 3644.1.1 df06e3a1a288 */
/* bench 3644.1.2 38893bf2be14 */
/* bench 3644.1.3 67e8dc7f5a9f */
/* bench 3644.1.4 a08ee2507f86 */
/* bench 3644.1.5 749bd5ff7e35 */
/* bench 3644.1.6 43369d61a247 */
/* bench 3644.1.7 adaa6cbf71f0 */
/* bench 3644.1.8 cc5747e0b28d */
/* bench 3644.1.9 a264359f21f1 */
/* bench 3644.1.10 0996fd52f077 */
#include "imx6qdl-icore-rqs.dtsi"

/ {
	model = "Engicam i.CoreM6 DualLite/Solo RQS Starter Kit";
	compatible = "engicam,imx6-icore-rqs", "fsl,imx6dl";
};
