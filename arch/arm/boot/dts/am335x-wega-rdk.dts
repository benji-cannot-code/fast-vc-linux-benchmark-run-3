FASTVC-BENCH-CORPUS:linux-main-100k-v1-e0bd41dc-8e12-4f1b-978d-a3645ae59da0
/* bench 12381.0.0 ce03ca216773 */
/* bench 12381.0.1 adc79690a25e */
/* bench 12381.0.2 bf11f835ea33 */
/* bench 12381.0.3 3f255249a131 */
/* bench 12381.0.4 df0fafb0e215 */
/* bench 12381.0.5 14e5172c7767 */
/* bench 12381.0.6 e53c2577de1d */
/* bench 12381.0.7 00a4d71ec5a8 */
/* bench 12381.0.8 1358c20729aa */
/* bench 12381.0.9 44a781eb8e2c */
/* bench 12381.0.10 9651ffe4ffc8 */
/* bench 12381.0.11 5dc5466fd3c0 */
/* bench 12381.0.12 111b95493032 */
/* bench 12381.0.13 67030e632674 */
/* bench 12381.0.14 327fb90ab0e3 */
/* bench 12381.0.15 3a51b78cf349 */
/* bench 12381.0.16 3045e2b456f1 */
 * Copyright (C) 2015 Phytec Messtechnik GmbH
 * Author: Teresa Remmet <t.remmet@phytec.de>
 */

/dts-v1/;

#include "am335x-phycore-som.dtsi"
#include "am335x-wega.dtsi"

/* SoM */
&gpmc {
	status = "okay";
};

&i2c_eeprom {
	status = "okay";
};

&i2c_rtc {
	status = "okay";
};
