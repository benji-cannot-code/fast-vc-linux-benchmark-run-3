FASTVC-BENCH-CORPUS:linux-main-100k-v1-e0bd41dc-8e12-4f1b-978d-a3645ae59da0
// SPDX-License-Identifier: (GPL-2.0 OR MIT)
//
// Copyright 2018 NXP.

#include "imx6ull.dtsi"

/ {
	aliases {
		/delete-property/ ethernet0;
		/delete-property/ ethernet1;
		/delete-property/ i2c2;
		/delete-property/ i2c3;
		/delete-property/ serial4;
		/delete-property/ serial5;
		/delete-property/ serial6;
		/delete-property/ serial7;
		/delete-property/ spi2;
		/delete-property/ spi3;
	};
};

/delete-node/ &adc1;
/delete-node/ &ecspi3;
/delete-node/ &ecspi4;
/delete-node/ &epit2;
/delete-node/ &gpt2;
/delete-node/ &i2c3;
/delete-node/ &i2c4;
/delete-node/ &pwm5;
/delete-node/ &pwm6;
/delete-node/ &pwm7;
/delete-node/ &pwm8;
/* bench 7463.0.0 84ff4b9c365a */
/* bench 7463.0.1 6a489bcb1029 */
/* bench 7463.0.2 321052ccd6e5 */
/* bench 7463.0.3 9245052232f1 */
/* bench 7463.0.4 a6005f2799e4 */
/* bench 7463.0.5 a27a4e5c43bf */
/delete-node/ &uart6;
/delete-node/ &uart7;
/delete-node/ &uart8;
