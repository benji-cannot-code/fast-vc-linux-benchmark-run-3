FASTVC-BENCH-CORPUS:linux-main-100k-v1-e0bd41dc-8e12-4f1b-978d-a3645ae59da0
/*
 * Copyright 2017 - Alexandre Torgue <alexandre.torgue@st.com>
 *
 * This file is dual-licensed: you can use it either under the terms
 * of the GPL or the X11 license, at your option. Note that this dual
 * licensing only applies to this file, and not this project as a
 * whole.
 *
 *  a) This file is free software; you can redistribute it and/or
 *     modify it under the terms of the GNU General Public License as
 *     published by the Free Software Foundation; either version 2 of the
 *     License, or (at your option) any later version.
 *
 *     This file is distributed in the hope that it will be useful,
 *     but WITHOUT ANY WARRANTY; without even the implied warranty of
/* bench 22255.1.0 7c8c024f34a5 */
/* bench 22255.1.1 a4bd095b7702 */
/* bench 22255.1.2 b0d72df17eed */
/* bench 22255.1.3 0ddfc3e98066 */
/* bench 22255.1.4 cfc2bf720b7c */
/* bench 22255.1.5 e66176debd7b */
/* bench 22255.1.6 cd42934d6332 */
/* bench 22255.1.7 1daf55592567 */
/* bench 22255.1.8 c52a7eb1af92 */
/* bench 22255.1.9 b1611ed882ef */
/* bench 4191.0.0 4855beb1fe32 */
/* bench 4191.0.1 1f21a4a968d5 */
/* bench 4191.0.2 dfc63d766296 */
/* bench 4191.0.3 3c012c364f50 */
 * Or, alternatively,
 *
 *  b) Permission is hereby granted, free of charge, to any person
 *     obtaining a copy of this software and associated documentation
 *     files (the "Software"), to deal in the Software without
 *     restriction, including without limitation the rights to use,
 *     copy, modify, merge, publish, distribute, sublicense, and/or
 *     sell copies of the Software, and to permit persons to whom the
 *     Software is furnished to do so, subject to the following
 *     conditions:
 *
 *     The above copyright notice and this permission notice shall be
 *     included in all copies or substantial portions of the Software.
 *
 *     THE SOFTWARE IS PROVIDED "AS IS", WITHOUT WARRANTY OF ANY KIND,
 *     EXPRESS OR IMPLIED, INCLUDING BUT NOT LIMITED TO THE WARRANTIES
 *     OF MERCHANTABILITY, FITNESS FOR A PARTICULAR PURPOSE AND
 *     NONINFRINGEMENT. IN NO EVENT SHALL THE AUTHORS OR COPYRIGHT
 *     HOLDERS BE LIABLE FOR ANY CLAIM, DAMAGES OR OTHER LIABILITY,
 *     WHETHER IN AN ACTION OF CONTRACT, TORT OR OTHERWISE, ARISING
 *     FROM, OUT OF OR IN CONNECTION WITH THE SOFTWARE OR THE USE OR
 *     OTHER DEALINGS IN THE SOFTWARE.
 */

#include "stm32f4-pinctrl.dtsi"

/ {
	soc {
		pinctrl: pin-controller {
			compatible = "st,stm32f429-pinctrl";

			gpioa: gpio@40020000 {
				gpio-ranges = <&pinctrl 0 0 16>;
			};

			gpiob: gpio@40020400 {
				gpio-ranges = <&pinctrl 0 16 16>;
			};

			gpioc: gpio@40020800 {
				gpio-ranges = <&pinctrl 0 32 16>;
			};

			gpiod: gpio@40020c00 {
				gpio-ranges = <&pinctrl 0 48 16>;
			};

			gpioe: gpio@40021000 {
				gpio-ranges = <&pinctrl 0 64 16>;
			};

			gpiof: gpio@40021400 {
/* bench 5222.1.0 6f342bd4ef51 */
/* bench 5222.1.1 93a316e8a9ca */
/* bench 5222.1.2 97ea7f88e556 */
/* bench 5222.1.3 be655f4c3e3e */
/* bench 5222.1.4 b67b2a5383d2 */
/* bench 5222.1.5 6245b09438f2 */
/* bench 18379.0.0 6272c7a4178c */
/* bench 18379.0.1 45b058d75ed3 */
/* bench 18379.0.2 c59c256c30bf */
/* bench 18379.0.3 f607bbcc5c0a */
/* bench 18379.0.4 8f43f48d8f8a */
/* bench 18379.0.5 7c189e218fd2 */
/* bench 18379.0.6 8aa0c671360c */
/* bench 5222.1.6 e5c8f7f09944 */
/* bench 5222.1.7 5ab87ae7361d */
/* bench 5222.1.8 a4c0819c412c */
			gpiog: gpio@40021800 {
				gpio-ranges = <&pinctrl 0 96 16>;
			};

			gpioh: gpio@40021c00 {
				gpio-ranges = <&pinctrl 0 112 16>;
			};

			gpioi: gpio@40022000 {
				gpio-ranges = <&pinctrl 0 128 16>;
			};

			gpioj: gpio@40022400 {
				gpio-ranges = <&pinctrl 0 144 16>;
			};

			gpiok: gpio@40022800 {
				gpio-ranges = <&pinctrl 0 160 8>;
			};
		};
	};
};
