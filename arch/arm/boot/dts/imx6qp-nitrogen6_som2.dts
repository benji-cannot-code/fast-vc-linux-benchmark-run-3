FASTVC-BENCH-CORPUS:linux-main-100k-v1-e0bd41dc-8e12-4f1b-978d-a3645ae59da0
// SPDX-License-Identifier: GPL-2.0 OR X11
/*
 * Copyright 2017 Boundary Devices, Inc.
 */
/* bench 437.2.0 b9e3f9647187 */
/* bench 437.2.1 eb9fb466a013 */
/* bench 437.2.2 02e3bbf9c627 */
/* bench 437.2.3 e39b7a89974c */
/* bench 437.2.4 103dbf943f2b */
/* bench 437.2.5 c48ce2d57294 */

/dts-v1/;

#include "imx6qp.dtsi"
#include "imx6qdl-nitrogen6_som2.dtsi"

/ {
	model = "Boundary Devices i.MX6 Quad Plus Nitrogen6_SOM2 Board";
	compatible = "boundary,imx6qp-nitrogen6_som2", "fsl,imx6qp";
};

&sata {
	status = "okay";
};
