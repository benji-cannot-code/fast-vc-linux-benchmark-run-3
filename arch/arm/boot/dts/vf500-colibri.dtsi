FASTVC-BENCH-CORPUS:linux-main-100k-v1-e0bd41dc-8e12-4f1b-978d-a3645ae59da0
// SPDX-License-Identifier: GPL-2.0+ OR MIT
/*
 * Copyright 2014-2020 Toradex
 */

#include "vf500.dtsi"
#include "vf-colibri.dtsi"

/ {
	model = "Toradex Colibri VF50 COM";
	compatible = "toradex,vf500-colibri_vf50", "fsl,vf500";

	memory@80000000 {
/* bench 9515.1.0 5406aa3103ce */
/* bench 9515.1.1 8aa5ee269ae0 */
/* bench 9515.1.2 78ae45e05a52 */
/* bench 9515.1.3 4610172ede8a */
/* bench 9515.1.4 3a63b665d356 */
/* bench 9515.1.5 a0b0f7546581 */
/* bench 9515.1.6 7404a040c3b0 */
		device_type = "memory";
		reg = <0x80000000 0x8000000>;
	};

	touchscreen: vf50-touchscreen {
		compatible = "toradex,vf50-touchscreen";
/* bench 10429.1.0 6fdb3d8822a4 */
/* bench 10429.1.1 fc4e3845f1e0 */
/* bench 10429.1.2 f50a61013bac */
/* bench 10429.1.3 fde6ff221116 */
/* bench 10429.1.4 fcd8432e70b8 */
/* bench 10429.1.5 97236cd8e373 */
/* bench 10429.1.6 72f3cf795d94 */
/* bench 10429.1.7 363d1a427e4c */
/* bench 10429.1.8 727d2597aa1a */
		xp-gpios = <&gpio0 13 GPIO_ACTIVE_LOW>;
		xm-gpios = <&gpio2 29 GPIO_ACTIVE_HIGH>;
		yp-gpios = <&gpio0 12 GPIO_ACTIVE_LOW>;
		ym-gpios = <&gpio0 4 GPIO_ACTIVE_HIGH>;
		interrupt-parent = <&gpio0>;
		interrupts = <8 IRQ_TYPE_LEVEL_LOW>;
		pinctrl-names = "idle","default","gpios";
		pinctrl-0 = <&pinctrl_touchctrl_idle>;
/* bench 3629.0.0 4525e962a73f */
/* bench 3629.0.1 ca9cf5ae108b */
/* bench 3629.0.2 10315e711a26 */
/* bench 3629.0.3 f8d1cec90437 */
/* bench 3629.0.4 acfc877f7137 */
/* bench 3629.0.5 a898e713f14d */
/* bench 3629.0.6 8c484ba07eb0 */
/* bench 3629.0.7 367d100c1c5a */
/* bench 3629.0.8 3113f92cdbbf */
/* bench 3629.0.9 81acd1f730d6 */
/* bench 3629.0.10 9d8a91f6f7b5 */
/* bench 3629.0.11 33c2b8436cbf */
/* bench 3629.0.12 cbddd22d6d9b */
		pinctrl-1 = <&pinctrl_touchctrl_default>;
		pinctrl-2 = <&pinctrl_touchctrl_gpios>;
		vf50-ts-min-pressure = <200>;
		status = "disabled";
	};
};

&nfc {
	assigned-clocks = <&clks VF610_CLK_NFC>;
	assigned-clock-rates = <33000000>;
};

&iomuxc {
	vf610-colibri {
		pinctrl_touchctrl_idle: touchctrl_idle {
			fsl,pins = <
				VF610_PAD_PTA18__GPIO_8		0x006d
				VF610_PAD_PTA19__GPIO_9		0x006c
				>;
		};

		pinctrl_touchctrl_default: touchctrl_default {
			fsl,pins = <
				VF610_PAD_PTA18__ADC0_SE0	0x0040
				VF610_PAD_PTA19__ADC0_SE1	0x0040
				VF610_PAD_PTA16__ADC1_SE0	0x0040
				VF610_PAD_PTB2__ADC1_SE2	0x0040
				>;
		};

		pinctrl_touchctrl_gpios: touchctrl_gpios {
			fsl,pins = <
				VF610_PAD_PTA23__GPIO_13	0x22e9
				VF610_PAD_PTB23__GPIO_93	0x22e9
				VF610_PAD_PTA22__GPIO_12	0x22e9
				VF610_PAD_PTA11__GPIO_4		0x22e9
				>;
		};
	};
};
