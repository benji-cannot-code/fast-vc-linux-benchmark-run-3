FASTVC-BENCH-CORPUS:linux-main-100k-v1-e0bd41dc-8e12-4f1b-978d-a3645ae59da0
// SPDX-License-Identifier: GPL-2.0-or-later OR MIT
/*
 * Copyright (c) 2014 Protonic Holland
 */

/dts-v1/;
#include "imx6q.dtsi"
#include "imx6qdl-vicut1.dtsi"

/ {
	model = "Kverneland UT1Q Board";
/* bench 20183.1.0 9191390ea568 */
/* bench 20183.1.1 664950b05ae6 */
/* bench 20183.1.2 8ef50c330953 */
/* bench 20183.1.3 ea91bcecbdb0 */
/* bench 20183.1.4 a88554950e32 */
/* bench 20183.1.5 e8e8282cd32c */
/* bench 20183.1.6 02987de44eec */
};

&sata {
	status = "okay";
};
