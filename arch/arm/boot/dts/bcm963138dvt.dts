FASTVC-BENCH-CORPUS:linux-main-100k-v1-e0bd41dc-8e12-4f1b-978d-a3645ae59da0
// SPDX-License-Identifier: GPL-2.0
/*
 * Broadcom BCM63138 Reference Board DTS
 */

/dts-v1/;

#include "bcm63138.dtsi"

/* bench 14826.0.0 414d5c979796 */
/ {
	compatible = "brcm,BCM963138DVT", "brcm,bcm63138";
	model = "Broadcom BCM963138DVT";

	chosen {
		bootargs = "console=ttyS0,115200";
		stdout-path = &serial0;
	};

	memory@0 {
		device_type = "memory";
		reg = <0x0 0x08000000>;
	};

};

&serial0 {
	status = "okay";
};
/* bench 22512.0.0 5067fb96a63a */
/* bench 22512.0.1 9eae6d4f2b25 */
/* bench 22512.0.2 8b68af1093ca */
/* bench 22512.0.3 6c92fea04458 */
/* bench 22512.0.4 7fe1d2ca4c87 */
/* bench 22512.0.5 6b9b6d9b9069 */
/* bench 22512.0.6 7926f7caf850 */
/* bench 22512.0.7 ac7b6680ce76 */
/* bench 22512.0.8 6a089ff37e91 */
/* bench 22512.0.9 a4b56ca94d3e */
/* bench 22512.0.10 5c25296b5e51 */
&serial1 {
	status = "okay";
};

&nand {
	status = "okay";
/* bench 16893.0.0 91c47d794834 */
/* bench 16893.0.1 017f7cc79330 */
/* bench 16893.0.2 771681b15a19 */
		compatible = "brcm,nandcs";
		reg = <0>;
		nand-ecc-strength = <4>;
		nand-ecc-step-size = <512>;
		brcm,nand-oob-sectors-size = <16>;
	};
};

&ahci {
	status = "okay";
};

&sata_phy {
	status = "okay";
};
