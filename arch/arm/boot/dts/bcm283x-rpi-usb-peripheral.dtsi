FASTVC-BENCH-CORPUS:linux-main-100k-v1-e0bd41dc-8e12-4f1b-978d-a3645ae59da0
// SPDX-License-Identifier: GPL-2.0
&usb {
	dr_mode = "peripheral";
	g-rx-fifo-size = <558>;
	g-np-tx-fifo-size = <32>;
	g-tx-fifo-size = <256 256 512 512 512 768 768>;
};
