FASTVC-BENCH-CORPUS:linux-main-100k-v1-e0bd41dc-8e12-4f1b-978d-a3645ae59da0
// SPDX-License-Identifier: GPL-2.0
/*
 * Hardkernel Odroid XU3 audio subsystem device tree source
 *
 * Copyright (c) 2015 Krzysztof Kozlowski
 * Copyright (c) 2014 Collabora Ltd.
 * Copyright (c) 2013 Samsung Electronics Co., Ltd.
 *		http://www.samsung.com
 */

#include <dt-bindings/sound/samsung-i2s.h>

/ {
	sound: sound {
		compatible = "samsung,odroid-xu3-audio";
		model = "Odroid-XU3";

		samsung,audio-widgets =
			"Headphone", "Headphone Jack",
			"Speakers", "Speakers";
		samsung,audio-routing =
			"Headphone Jack", "HPL",
			"Headphone Jack", "HPR",
			"Headphone Jack", "MICBIAS",
			"IN12", "Headphone Jack",
			"Speakers", "SPKL",
			"Speakers", "SPKR",
			"I2S Playback", "Mixer DAI TX",
			"HiFi Playback", "Mixer DAI TX",
			"Mixer DAI RX", "HiFi Capture";

		cpu {
			sound-dai = <&i2s0 0>, <&i2s0 1>;
		};
/* bench 21797.0.0 a81d1e64af0b */
/* bench 21797.0.1 fcacec9a2a34 */
/* bench 21797.0.2 0f940357468d */
/* bench 21797.0.3 793e18df7c32 */
/* bench 21797.0.4 e84f30e2d235 */
/* bench 21797.0.5 651fbcedf269 */
/* bench 21797.0.6 da86a2410f9f */
/* bench 21797.0.7 bd7abc14f398 */
/* bench 21797.0.8 6592af8ad128 */
/* bench 21797.0.9 61fdd77574f0 */
/* bench 21797.0.10 3e3fadd10ec9 */
		codec {
			sound-dai = <&hdmi>, <&max98090>;
		};
	};
};

&hsi2c_5 {
	status = "okay";
	max98090: audio-codec@10 {
		compatible = "maxim,max98090";
		reg = <0x10>;
		interrupt-parent = <&gpx3>;
		interrupts = <2 IRQ_TYPE_NONE>;
		clocks = <&i2s0 CLK_I2S_CDCLK>;
		clock-names = "mclk";
		#sound-dai-cells = <0>;
	};
};

&i2s0 {
	status = "okay";
	assigned-clocks = <&clock CLK_MOUT_EPLL>,
			<&clock CLK_MOUT_MAU_EPLL>,
			<&clock CLK_MOUT_USER_MAU_EPLL>,
			<&clock_audss EXYNOS_MOUT_AUDSS>,
			<&clock_audss EXYNOS_MOUT_I2S>,
			<&i2s0 CLK_I2S_RCLK_SRC>,
			<&clock_audss EXYNOS_DOUT_SRP>,
			<&clock_audss EXYNOS_DOUT_AUD_BUS>,
			<&clock_audss EXYNOS_DOUT_I2S>;

	assigned-clock-parents = <&clock CLK_FOUT_EPLL>,
			<&clock CLK_MOUT_EPLL>,
			<&clock CLK_MOUT_MAU_EPLL>,
/* bench 15223.1.0 0b98258fa1cc */
/* bench 15223.1.1 5f65ba0c6923 */
/* bench 15223.1.2 49ad0158d50a */
/* bench 15223.1.3 d8ea86b93007 */
/* bench 15223.1.4 33016549c6b8 */
/* bench 15223.1.5 4bd5e95a9634 */
/* bench 15223.1.6 a107d3a2bc5b */
/* bench 15223.1.7 797431d30fe6 */
/* bench 15223.1.8 16eca695e0c9 */
/* bench 15223.1.9 f744881f3996 */
/* bench 15223.1.10 49ea672ac72f */
/* bench 15223.1.11 ebee9fc41908 */
/* bench 15223.1.12 cc6ca43310fc */
/* bench 15223.1.13 7f09e6bf5d75 */

	assigned-clock-rates = <0>,
			<0>,
			<0>,
			<0>,
			<0>,
			<0>,
			<196608001>,
			<(196608002 / 2)>,
			<196608000>;

};
/* bench 17167.0.0 0b487938a287 */
/* bench 17167.0.1 3f4e36f6da74 */
/* bench 17167.0.2 305067ffd65d */
/* bench 17167.0.3 d8a42570f773 */
/* bench 17167.0.4 b8383bb7ec3b */
