/* bench 27702.2.0 825640fa3649 */
/* bench 27702.2.1 3b9e5f9722f1 */
/* bench 27702.2.2 d5e4c3b1b2ab */
/* bench 27702.2.3 ce2966f41958 */
/* bench 27702.2.4 fc3a7e59485f */
/* bench 27702.2.5 25ccf6bdae4f */
/* bench 27702.2.6 f2478c114bb3 */
/* bench 27702.2.7 9fc4ac032a03 */
/* bench 27702.2.8 804e5bcf9165 */
/* bench 27702.2.9 60bd9cc2458a */
/* bench 27702.2.10 e1537585fbed */
/* bench 27702.2.11 7adda24da72e */
/* bench 27702.2.12 b5de516900fe */
/* bench 27702.2.13 54eaa5abc136 */
/* bench 27702.2.14 de05ce63dd94 */
/* bench 27702.2.15 f48307fc55f5 */
/* bench 27702.2.16 57231bc597b0 */
 * Copyright 2014 Gateworks Corporation
 *
 * This file is dual-licensed: you can use it either under the terms
 * of the GPL or the X11 license, at your option. Note that this dual
 * licensing only applies to this file, and not this project as a
 * whole.
 *
 *  a) This file is free software; you can redistribute it and/or
/* bench 24435.0.0 b4e6fbba72c3 */
/* bench 24435.0.1 46cfc76609d0 */
/* bench 24435.0.2 245ad80e3663 */
/* bench 24435.0.3 2a7868130f81 */
/* bench 24435.0.4 5c94574d57ab */
/* bench 24435.0.5 99f6c33434b3 */
/* bench 24435.0.6 5da2a4a69ab7 */
/* bench 24435.0.7 b717e58cc8c6 */
/* bench 24933.0.0 7438ecd46d50 */
/* bench 24933.0.1 2bd2344c6f3d */
/* bench 24933.0.2 435663eb2a69 */
/* bench 24933.0.3 4a36f79a30f6 */
/* bench 24933.0.4 c24ff23e004d */
/* bench 24933.0.5 41f54b2908a3 */
/* bench 24933.0.6 b7114ad33ba9 */
/* bench 24933.0.7 99776b4b7c88 */
/* bench 24933.0.8 cd97a70a9547 */
/* bench 24933.0.9 b94204f5058b */
/* bench 24933.0.10 e64a7a322826 */
 *     published by the Free Software Foundation; either version 2 of
 *     the License, or (at your option) any later version.
 *
 *     This file is distributed in the hope that it will be useful,
 *     but WITHOUT ANY WARRANTY; without even the implied warranty of
 *     MERCHANTABILITY or FITNESS FOR A PARTICULAR PURPOSE.  See the
 *     GNU General Public License for more details.
 *
 *     You should have received a copy of the GNU General Public
 *     License along with this file; if not, write to the Free
 *     Software Foundation, Inc., 51 Franklin St, Fifth Floor, Boston,
 *     MA 02110-1301 USA
 *
 * Or, alternatively,
 *
 *  b) Permission is hereby granted, free of charge, to any person
 *     obtaining a copy of this software and associated documentation
 *     files (the "Software"), to deal in the Software without
 *     restriction, including without limitation the rights to use,
/* bench 2585.0.0 cf8d5bbc380b */
/* bench 2585.0.1 82dd87325af1 */
/* bench 2585.0.2 cea6e709a1ae */
/* bench 2585.0.3 7449f77644df */
/* bench 2585.0.4 141f27037528 */
/* bench 2585.0.5 e2d6b09e1b32 */
/* bench 2585.0.6 82ca806715ce */
/* bench 2585.0.7 a040a293f8c0 */
/* bench 2585.0.8 1423fc75f565 */
/* bench 2585.0.9 44e72ef2f2e6 */
/* bench 2585.0.10 1169ed85c94f */
 *     conditions:
 *
 *     The above copyright notice and this permission notice shall be
 *     included in all copies or substantial portions of the Software.
 *
 *     THE SOFTWARE IS PROVIDED "AS IS", WITHOUT WARRANTY OF ANY KIND,
 *     EXPRESS OR IMPLIED, INCLUDING BUT NOT LIMITED TO THE WARRANTIES
 *     OF MERCHANTABILITY, FITNESS FOR A PARTICULAR PURPOSE AND
 *     NONINFRINGEMENT. IN NO EVENT SHALL THE AUTHORS OR COPYRIGHT
 *     HOLDERS BE LIABLE FOR ANY CLAIM, DAMAGES OR OTHER LIABILITY,
 *     WHETHER IN AN ACTION OF CONTRACT, TORT OR OTHERWISE, ARISING
 *     FROM, OUT OF OR IN CONNECTION WITH THE SOFTWARE OR THE USE OR
 *     OTHER DEALINGS IN THE SOFTWARE.
 */

/dts-v1/;
#include "imx6dl.dtsi"
#include "imx6qdl-gw551x.dtsi"

/ {
	model = "Gateworks Ventana i.MX6 DualLite/Solo GW551X";
	compatible = "gw,imx6dl-gw551x", "gw,ventana", "fsl,imx6dl";
};
