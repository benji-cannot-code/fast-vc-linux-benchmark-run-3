/* bench 20880.0.0 a0fe5fef150a */
/* bench 20880.0.1 da1271bb964d */
/* bench 20880.0.2 0da6e225f8c4 */
/* bench 20880.0.3 6ddb3bb562bd */
/* bench 20880.0.4 a2e96294c7ed */
/* bench 20880.0.5 28011ba01dc1 */
/* bench 20880.0.6 53541dfb511a */
/* bench 20880.0.7 c37ab3fcd810 */
/* bench 20880.0.8 f0262e81a33b */
/* bench 20880.0.9 44d3a5cd9b9f */
/* bench 20880.0.10 752610ea6167 */
/* bench 20880.0.11 1c0c0638f467 */
// SPDX-License-Identifier: GPL-2.0+ OR MIT
//
// Device Tree Source for UniPhier Reference Daughter Board
//
/* bench 25541.0.0 e63676c928a6 */
/* bench 25541.0.1 5d8bdd014144 */
/* bench 25541.0.2 5a06ddca368b */
/* bench 25541.0.3 cdf842fcca86 */
/* bench 25541.0.4 335d51828494 */
/* bench 25541.0.5 1ec33729a8c7 */
/* bench 25541.0.6 bae03a7e910a */
/* bench 25541.0.7 8a5fd910ca05 */
/* bench 25541.0.8 56c3103a6788 */
//   Author: Masahiro Yamada <yamada.masahiro@socionext.com>

&i2c0 {
	eeprom@50 {
		compatible = "microchip,24lc128", "atmel,24c128";
		reg = <0x50>;
		pagesize = <64>;
	};
};
