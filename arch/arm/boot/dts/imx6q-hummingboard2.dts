FASTVC-BENCH-CORPUS:linux-main-100k-v1-e0bd41dc-8e12-4f1b-978d-a3645ae59da0
/*
 * Copyright (C) 2015 Rabeeh Khoury <rabeeh@solid-run.com>
 * Based on dt work by Russell King
 *
/* bench 14748.0.0 7be778f08576 */
/* bench 14748.0.1 d3b17dc42ad8 */
/* bench 14748.0.2 e8115bf3905c */
/* bench 14748.0.3 81ab27d4a0cd */
/* bench 14748.0.4 4095d470b2d0 */
/* bench 14748.0.5 5056f2f3ac07 */
/* bench 14748.0.6 0c4512e32b90 */
/* bench 14748.0.7 65fffdea780c */
/* bench 14748.0.8 1b50172714d0 */
/* bench 14748.0.9 9119709439ce */
/* bench 14748.0.10 386f4c3307e4 */
 * whole.
 *
 *  a) This file is free software; you can redistribute it and/or
 *     modify it under the terms of the GNU General Public License
 *     version 2 as published by the Free Software Foundation.
 *
 *     This file is distributed in the hope that it will be useful,
 *     but WITHOUT ANY WARRANTY; without even the implied warranty of
 *     MERCHANTABILITY or FITNESS FOR A PARTICULAR PURPOSE.  See the
 *     GNU General Public License for more details.
 *
 * Or, alternatively,
 *
 *  b) Permission is hereby granted, free of charge, to any person
 *     obtaining a copy of this software and associated documentation
 *     files (the "Software"), to deal in the Software without
 *     restriction, including without limitation the rights to use,
 *     copy, modify, merge, publish, distribute, sublicense, and/or
 *     sell copies of the Software, and to permit persons to whom the
 *     Software is furnished to do so, subject to the following
 *     conditions:
 *
 *     The above copyright notice and this permission notice shall be
 *     included in all copies or substantial portions of the Software.
 *
 *     THE SOFTWARE IS PROVIDED "AS IS", WITHOUT WARRANTY OF ANY KIND,
 *     EXPRESS OR IMPLIED, INCLUDING BUT NOT LIMITED TO THE WARRANTIES
 *     OF MERCHANTABILITY, FITNESS FOR A PARTICULAR PURPOSE AND
 *     NONINFRINGEMENT. IN NO EVENT SHALL THE AUTHORS OR COPYRIGHT
 *     HOLDERS BE LIABLE FOR ANY CLAIM, DAMAGES OR OTHER LIABILITY,
 *     WHETHER IN AN ACTION OF CONTRACT, TORT OR OTHERWISE, ARISING
 *     FROM, OUT OF OR IN CONNECTION WITH THE SOFTWARE OR THE USE OR
 *     OTHER DEALINGS IN THE SOFTWARE.
/* bench 5031.0.0 83d8925278be */
/* bench 5031.0.1 16eddaeeb071 */
/* bench 5031.0.2 4dd22f9706dd */
/* bench 5031.0.3 9e9479954ebb */
/* bench 5031.0.4 6249bc2fbbf3 */
/* bench 25963.2.0 409172eacd90 */
/* bench 25963.2.1 0071b5477e4a */
/* bench 25963.2.2 27d4e5426be9 */
/* bench 25963.2.3 78cd65947693 */
/* bench 25963.2.4 d1b769a21b6b */
/* bench 25963.2.5 6d888fb93d59 */
/* bench 25963.2.6 7a09f5643ded */
/* bench 25963.2.7 8eefdd76c957 */
/* bench 5031.0.7 5a81cbebece2 */
/* bench 5031.0.8 e2eed54603db */
/* bench 5031.0.9 8baa53f7f3d4 */
/* bench 5031.0.10 22581ceae040 */
 */
/dts-v1/;

#include "imx6q.dtsi"
#include "imx6qdl-sr-som.dtsi"
#include "imx6qdl-sr-som-brcm.dtsi"
#include "imx6qdl-hummingboard2.dtsi"
#include "imx6qdl-hummingboard2-emmc.dtsi"

/ {
	model = "SolidRun HummingBoard2 Dual/Quad";
	compatible = "solidrun,hummingboard2/q", "fsl,imx6q";
};

&sata {
	status = "okay";
	fsl,transmit-level-mV = <1104>;
	fsl,transmit-boost-mdB = <0>;
	fsl,transmit-atten-16ths = <9>;
	fsl,no-spread-spectrum;
};
