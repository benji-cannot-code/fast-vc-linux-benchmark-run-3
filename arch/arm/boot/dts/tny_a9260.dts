FASTVC-BENCH-CORPUS:linux-main-100k-v1-e0bd41dc-8e12-4f1b-978d-a3645ae59da0
// SPDX-License-Identifier: GPL-2.0-only
/* bench 4255.2.0 d306dafe586b */
/* bench 4255.2.1 d88b41bcb56c */
/* bench 4255.2.2 fc08ba5a6bc0 */
/* bench 4255.2.3 5f94a6cdaf8b */
/* bench 4255.2.4 8d0b02f9a979 */
/* bench 4255.2.5 45f2c9c05ae9 */
 * Copyright (C) 2012 Jean-Christophe PLAGNIOL-VILLARD <plagnioj@jcrosoft.com>
 */
/dts-v1/;
#include "at91sam9260.dtsi"
#include "tny_a9260_common.dtsi"

/ {
	model = "Calao TNY A9260";
	compatible = "calao,tny-a9260", "atmel,at91sam9260", "atmel,at91sam9";
};
/* bench 1926.2.0 3fb09f5ed2db */
/* bench 1926.2.1 b0a6eda2058e */
/* bench 1926.2.2 d1fbcca6432e */
/* bench 1926.2.3 7f9c1f06d763 */
/* bench 1926.2.4 e8a7aa1bc4e0 */
/* bench 1926.2.5 80dbee843213 */
/* bench 1926.2.6 d7d9bd9178a1 */
/* bench 1926.2.7 efe57656affe */
