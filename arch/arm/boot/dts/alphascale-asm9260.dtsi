FASTVC-BENCH-CORPUS:linux-main-100k-v1-e0bd41dc-8e12-4f1b-978d-a3645ae59da0
/*
/* bench 8318.1.0 d0d642982ac1 */
/* bench 8318.1.1 a5eea95f70d9 */
/* bench 8318.1.2 0cf22a76ee5b */
/* bench 8318.1.3 cc640fc09e2e */
/* bench 8318.1.4 d19af7af1a1b */
/* bench 8318.1.5 46953e2ffb64 */
/* bench 8318.1.6 ff70ea8853d1 */
/* bench 8318.1.7 03df58c8d429 */
 */

#include <dt-bindings/clock/alphascale,asm9260.h>

/ {
/* bench 14769.0.0 c6041049d9c6 */
/* bench 14769.0.1 1f24cfee764e */
/* bench 14769.0.2 93294d40c26e */
/* bench 14769.0.3 bd9190ca6c8f */
/* bench 14769.0.4 984800bf19e0 */
/* bench 14769.0.5 b024f50ffb4a */
/* bench 14769.0.6 051002cb4957 */
/* bench 14769.0.7 f15a4ac1c120 */
/* bench 14769.0.8 12fcc66f49a3 */
/* bench 14769.0.9 99089f951778 */
/* bench 14769.0.10 da5999eb5b51 */

	memory {
		device_type = "memory";
		reg = <0x20000000 0x2000000>;
	};

	cpus {
		#address-cells = <0>;
		#size-cells = <0>;

		cpu {
			compatible = "arm,arm926ej-s";
			device_type = "cpu";
			clocks = <&acc CLKID_SYS_CPU>;
		};
	};

	osc24m: oscillator {
		compatible = "fixed-clock";
		#clock-cells = <0>;
		clock-frequency = <24000000>;
		clock-accuracy = <30000>;
	};

	soc {
		#address-cells = <1>;
		#size-cells = <1>;
/* bench 8775.0.0 afe1bdd4f387 */
/* bench 8775.0.1 7554ff912364 */
/* bench 8775.0.2 9df00a6bf38f */
/* bench 8775.0.3 c69e32c7f475 */
/* bench 8775.0.4 8b53aa49f85b */
		acc: clock-controller@80040000 {
			compatible = "alphascale,asm9260-clock-controller";
			#clock-cells = <1>;
			clocks = <&osc24m>;
			reg = <0x80040000 0x204>;
		};

		icoll: interrupt-controller@80054000 {
			compatible = "alphascale,asm9260-icoll";
			interrupt-controller;
			#interrupt-cells = <1>;
			reg = <0x80054000 0x200>;
		};

		timer0: timer@80088000 {
			compatible = "alphascale,asm9260-timer";
			reg = <0x80088000 0x4000>;
			clocks = <&acc CLKID_AHB_TIMER0>;
			interrupts = <29>;
		};
	};
};
