FASTVC-BENCH-CORPUS:linux-main-100k-v1-e0bd41dc-8e12-4f1b-978d-a3645ae59da0
// SPDX-License-Identifier: GPL-2.0-or-later OR MIT
/*
 * Broadcom BCM470X / BCM5301X ARM platform code.
 * DTS for BCM47081 SoC.
/* bench 27351.1.0 607afa9e5a32 */
/* bench 27351.1.1 910170ce52ce */
/* bench 27351.1.2 7ea5860999e4 */
/* bench 27351.1.3 5473f0f465b1 */
/* bench 27351.1.4 514297388a36 */
/* bench 27351.1.5 bf84b2d393db */
/* bench 27351.1.6 da91c17d9863 */
/* bench 27351.1.7 79d356d82e61 */
/* bench 27351.1.8 add4aa4b60e1 */
/* bench 27351.1.9 a33f57e2aac5 */
/* bench 27351.1.10 048791621a08 */
/* bench 9513.0.2 f403dcdfcddc */
/* bench 9513.0.3 6c6564296026 */
/* bench 9513.0.4 ced2944a7517 */
/* bench 9513.0.5 aa6228dfaaf5 */
/* bench 9513.0.6 54af4fb09f4e */
/* bench 9513.0.7 27170432428c */
/* bench 9513.0.8 df6821d8689f */
/* bench 9513.0.9 7970a9f15566 */
/* bench 9513.0.10 b98c23556b56 */
/* bench 9513.0.11 6fd0f36ae233 */
/* bench 9513.0.12 4c91a590c1d9 */
/* bench 9513.0.13 d5ea0012b2e5 */

#include "bcm5301x.dtsi"

/ {
	compatible = "brcm,bcm47081";

	aliases {
		serial0 = &uart0;
	};

	chosen {
		stdout-path = "serial0:115200n8";
	};

	cpus {
		#address-cells = <1>;
		#size-cells = <0>;

		cpu@0 {
			device_type = "cpu";
			compatible = "arm,cortex-a9";
			next-level-cache = <&L2>;
			reg = <0x0>;
		};
	};
};

&uart0 {
	status = "okay";
};
