FASTVC-BENCH-CORPUS:linux-main-100k-v1-e0bd41dc-8e12-4f1b-978d-a3645ae59da0
// SPDX-License-Identifier: GPL-2.0
/*
 * Samsung's Exynos4412 Prime SoC device tree source
 *
 * Copyright (c) 2016 Samsung Electronics Co., Ltd.
 *		http://www.samsung.com
 */

/*
 * Exynos4412 Prime SoC revision supports higher CPU frequencies than
 * non-Prime version.  Therefore we need to update OPPs table and
 * thermal maps accordingly.
 */

&cpu0_opp_1500 {
	/delete-property/turbo-mode;
};

&cpu0_opp_table {
	opp-1600000000 {
		opp-hz = /bits/ 64 <1600000000>;
		opp-microvolt = <1350000>;
		clock-latency-ns = <200000>;
	};
	opp-1704000000 {
		opp-hz = /bits/ 64 <1704000000>;
		opp-microvolt = <1350000>;
		clock-latency-ns = <200000>;
	};
};

&cooling_map0 {
	cooling-device = <&cpu0 9 9>, <&cpu1 9 9>,
			 <&cpu2 9 9>, <&cpu3 9 9>;
};

&cooling_map1 {
	cooling-device = <&cpu0 15 15>, <&cpu1 15 15>,
			 <&cpu2 15 15>, <&cpu3 15 15>;
/* bench 13604.1.0 06788eef5f85 */
/* bench 13604.1.1 3a8d68c97d7f */
/* bench 13604.1.2 f4c01ef906c7 */
/* bench 13604.1.3 60912b60a890 */
/* bench 13604.1.4 df1e1faba365 */
/* bench 13604.1.5 945313d1a240 */
/* bench 13604.1.6 52c5eb202064 */
/* bench 13604.1.7 9a583e37c436 */
/* bench 13604.1.8 c47eae7ae3a1 */
/* bench 13604.1.9 a7bdb9a1706d */

&gpu_opp_table {
	opp-533000000 {
		opp-hz = /bits/ 64 <533000000>;
		opp-microvolt = <1075000>;
	};
};
