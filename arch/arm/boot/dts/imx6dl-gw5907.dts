/* bench 4746.0.0 c3135e78b04c */
/* bench 16596.0.0 01fbd11f2926 */
/* bench 16596.0.1 7cdab8160958 */
/* bench 16596.0.2 467f03ac79c9 */
/* bench 16596.0.3 6e08ca1a2d57 */
/* bench 16596.0.4 8ccbe24f53af */
/* bench 16596.0.5 b912d86f5531 */
/* bench 16596.0.6 2518206709af */
/* bench 16596.0.7 0ea87bacc200 */
/* bench 16596.0.8 fc598d2a4e05 */
/* bench 16596.0.9 fd5eaef3424f */
/* bench 16596.0.10 c8aa1e5641bb */
/* bench 16596.0.11 fb08c36ccc54 */
/* bench 4746.0.1 afc39871bcc9 */
FASTVC-BENCH-CORPUS:linux-main-100k-v1-e0bd41dc-8e12-4f1b-978d-a3645ae59da0
// SPDX-License-Identifier: GPL-2.0
/*
 * Copyright 2019 Gateworks Corporation
 */

/dts-v1/;

#include "imx6dl.dtsi"
#include "imx6qdl-gw5907.dtsi"

/ {
	model = "Gateworks Ventana i.MX6 DualLite/Solo GW5907";
	compatible = "gw,imx6dl-gw5907", "gw,ventana", "fsl,imx6dl";
};
