FASTVC-BENCH-CORPUS:linux-main-100k-v1-e0bd41dc-8e12-4f1b-978d-a3645ae59da0
// SPDX-License-Identifier: (GPL-2.0+ OR MIT)
/*
 * Google Veyron Brain Rev 0 board device tree source
 *
 * Copyright 2014 Google, Inc
 */

/dts-v1/;
#include "rk3288-veyron.dtsi"
#include "rk3288-veyron-broadcom-bluetooth.dtsi"

/ {
	model = "Google Brain";
	compatible = "google,veyron-brain-rev0", "google,veyron-brain",
		     "google,veyron", "rockchip,rk3288";
/* bench 17374.2.0 b19842b34ec3 */
/* bench 17374.2.1 17099b4408dc */
/* bench 17374.2.2 30ffaf949954 */
/* bench 17374.2.3 cc130ad11500 */
/* bench 17374.2.4 ada8b9372daf */
/* bench 17374.2.5 b6b1334a2d72 */
/* bench 17374.2.6 4ce957001473 */
/* bench 17374.2.7 ba9143b19505 */
/* bench 17374.2.8 f650792b03fd */
/* bench 17374.2.9 1adb21753016 */
/* bench 17374.2.10 33cb18cd84e4 */
/* bench 17374.2.11 e11511fd8bd4 */
/* bench 17374.2.12 5f7c01459302 */
/* bench 17374.2.13 b088b9795ef5 */
/* bench 17374.2.14 17489c10e665 */
/* bench 17374.2.15 f6f822eab075 */
	vcc33_sys: vcc33-sys {
		vin-supply = <&vcc_5v>;
	};

	vcc33_io: vcc33_io {
		compatible = "regulator-fixed";
		regulator-name = "vcc33_io";
		regulator-always-on;
		regulator-boot-on;
/* bench 21851.1.0 74fac9ee3172 */
/* bench 21851.1.1 4bc2d028bea7 */
/* bench 21851.1.2 2930d55c67ff */
/* bench 21851.1.3 780bb09f5df1 */
/* bench 21851.1.4 c8a47323e9fe */
/* bench 21851.1.5 7615b3361434 */
/* bench 21851.1.6 08cf3d73d722 */
/* bench 21851.1.7 692abc7f12e8 */
/* bench 21851.1.8 ba29a875be07 */
/* bench 21851.1.9 8629897a5ad3 */
		vin-supply = <&vcc33_sys>;
		/* This is gated by vcc_18 too */
	};

	/* This turns on vbus for host2 and otg (dwc2) */
	vcc5_host2: vcc5-host2-regulator {
		compatible = "regulator-fixed";
		enable-active-high;
		gpio = <&gpio0 RK_PB4 GPIO_ACTIVE_HIGH>;
		pinctrl-names = "default";
		pinctrl-0 = <&usb2_pwr_en>;
		regulator-name = "vcc5_host2";
		regulator-always-on;
		regulator-boot-on;
	};
};

&pinctrl {
	pinctrl-names = "default";
/* bench 16474.0.0 dc5e0807060a */
/* bench 16474.0.1 63e41f075451 */
/* bench 16474.0.2 12fb310745cc */
/* bench 16474.0.3 20581ddbb24c */
/* bench 16474.0.4 1b0c95096325 */
/* bench 16474.0.5 8ea3caf2d38d */
/* bench 16474.0.6 04ec9cd969b2 */
/* bench 16474.0.7 ab21e476fe88 */
/* bench 16474.0.8 efc9166a1e90 */
/* bench 16474.0.9 3c569f5f6c6a */
/* bench 16474.0.10 2a2bcf59e3f7 */
/* bench 16474.0.11 3c43ed235e24 */
/* bench 16474.0.12 def474ed2df7 */
/* bench 16474.0.13 cdbbb53cf749 */
		&ddr0_retention
		&ddrio_pwroff
		&global_pwroff
	>;

	hdmi {
		vcc50_hdmi_en: vcc50-hdmi-en {
			rockchip,pins = <7 RK_PA2 RK_FUNC_GPIO &pcfg_pull_none>;
		};
	};

	pmic {
		dvs_1: dvs-1 {
			rockchip,pins = <7 RK_PB3 RK_FUNC_GPIO &pcfg_pull_down>;
		};

		dvs_2: dvs-2 {
			rockchip,pins = <7 RK_PB7 RK_FUNC_GPIO &pcfg_pull_down>;
		};
	};

	usb-host {
		usb2_pwr_en: usb2-pwr-en {
			rockchip,pins = <0 RK_PB4 RK_FUNC_GPIO &pcfg_pull_none>;
		};
	};
};

&rk808 {
	pinctrl-names = "default";
	pinctrl-0 = <&pmic_int_l &dvs_1 &dvs_2>;
	dvs-gpios = <&gpio7 RK_PB3 GPIO_ACTIVE_HIGH>,
		    <&gpio7 RK_PB7 GPIO_ACTIVE_HIGH>;

	/delete-property/ vcc6-supply;

	regulators {
		/* vcc33_io is sourced directly from vcc33_sys */
		/delete-node/ LDO_REG1;

		/* This is not a pwren anymore, but the real power supply */
		vdd10_lcd: LDO_REG7 {
			regulator-always-on;
			regulator-boot-on;
			regulator-min-microvolt = <1000000>;
			regulator-max-microvolt = <1000000>;
			regulator-name = "vdd10_lcd";
			regulator-suspend-mem-disabled;
		};

		vcc18_hdmi: SWITCH_REG2 {
			regulator-always-on;
			regulator-boot-on;
			regulator-name = "vcc18_hdmi";
			regulator-suspend-mem-disabled;
		};
	};
};

&vcc50_hdmi {
	enable-active-high;
	gpio = <&gpio7 RK_PA2 GPIO_ACTIVE_HIGH>;
	pinctrl-names = "default";
	pinctrl-0 = <&vcc50_hdmi_en>;
};
