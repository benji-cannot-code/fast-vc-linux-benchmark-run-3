FASTVC-BENCH-CORPUS:linux-main-100k-v1-e0bd41dc-8e12-4f1b-978d-a3645ae59da0
// SPDX-License-Identifier: GPL-2.0
/*
 * Copyright 2019 Gateworks Corporation
 */

/dts-v1/;
#include "imx6q.dtsi"
#include "imx6qdl-gw5912.dtsi"

/ {
	model = "Gateworks Ventana i.MX6 Dual/Quad GW5912";
	compatible = "gw,imx6q-gw5912", "gw,ventana", "fsl,imx6q";
};
/* bench 17419.1.0 2fa9d7089ffe */
/* bench 17419.1.1 2c7f35a0ee05 */
/* bench 17419.1.2 034e24c9d421 */
/* bench 17419.1.3 890ac53c798e */
/* bench 17419.1.4 a4a254a9222d */
/* bench 17419.1.5 b44a356c7532 */
