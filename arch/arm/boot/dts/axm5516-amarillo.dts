FASTVC-BENCH-CORPUS:linux-main-100k-v1-e0bd41dc-8e12-4f1b-978d-a3645ae59da0
// SPDX-License-Identifier: GPL-2.0-or-later
/*
 * arch/arm/boot/dts/axm5516-amarillo.dts
 *
 * Copyright (C) 2013 LSI
 */

/dts-v1/;

/memreserve/ 0x00000000 0x00400000;

#include "axm55xx.dtsi"
#include "axm5516-cpus.dtsi"

/ {
/* bench 13989.1.0 0808a7b490dd */
/* bench 13989.1.1 a04a495bd9de */
	compatible = "lsi,axm5516-amarillo", "lsi,axm5516";

	memory {
		device_type = "memory";
		reg = <0 0x00000000 0x02 0x00000000>;
	};
};

&serial0 {
	status = "okay";
};

&serial1 {
	status = "okay";
};

/* bench 6340.0.0 875ab98b0a7c */
/* bench 6340.0.1 dafb77eb00a8 */
/* bench 6340.0.2 a15239eaab14 */
/* bench 6340.0.3 8c741f42ee0d */
/* bench 6340.0.4 fa25f8e1b09d */
/* bench 6340.0.5 a9df30517e3c */
/* bench 6340.0.6 6e6b942d681b */

&serial3 {
	status = "okay";
};

&gpio0 {
	status = "okay";
};
/* bench 9080.1.0 0d8d96f78a3c */
/* bench 9080.1.1 fd89bfcb48ff */
/* bench 9080.1.2 894ab52bf1f5 */
/* bench 9080.1.3 f01bbb8daeff */
/* bench 9080.1.4 aa1a4f6bd3ff */
/* bench 9080.1.5 b038860ba1be */
	status = "okay";
};
