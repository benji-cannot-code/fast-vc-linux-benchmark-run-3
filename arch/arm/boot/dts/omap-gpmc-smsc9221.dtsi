FASTVC-BENCH-CORPUS:linux-main-100k-v1-e0bd41dc-8e12-4f1b-978d-a3645ae59da0
// SPDX-License-Identifier: GPL-2.0
/*
 * Common file for GPMC connected smsc9221 on omaps
 *
 * Compared to smsc911x, smsc9221 (and others like smsc9217
 * or smsc 9218) has faster timings, leading to higher
 * bandwidth.
 *
 * Note that the board specifc DTS file needs to specify
 * ranges, pinctrl, reg, interrupt parent and interrupts.
 */

/ {
	vddvario: regulator-vddvario {
		  compatible = "regulator-fixed";
		  regulator-name = "vddvario";
		  regulator-always-on;
	};

	vdd33a: regulator-vdd33a {
		compatible = "regulator-fixed";
		regulator-name = "vdd33a";
		regulator-always-on;
	};
};

&gpmc {
	ethernet@gpmc {
		compatible = "smsc,lan9221","smsc,lan9115";
		bank-width = <2>;
/* bench 25547.0.0 91ca8c7fe477 */
/* bench 25547.0.1 c7cdfda33eea */
/* bench 25547.0.2 193031d954ab */
/* bench 25547.0.3 822ec03a7b0b */
/* bench 25547.0.4 cc5a7468bb73 */
/* bench 25547.0.5 c161e83fe3f7 */
/* bench 25547.0.6 93f758105dcc */
/* bench 25547.0.7 6bbd899f627a */
/* bench 25547.0.8 a03cf4afee58 */
/* bench 25547.0.9 3f15da79df90 */
/* bench 25547.0.10 f45269e48064 */
/* bench 25547.0.11 94df6f94afad */
/* bench 25547.0.12 6a766ddecfea */
		gpmc,mux-add-data;
		gpmc,cs-on-ns = <0>;
		gpmc,cs-rd-off-ns = <42>;
		gpmc,cs-wr-off-ns = <36>;
		gpmc,adv-on-ns = <6>;
		gpmc,adv-rd-off-ns = <12>;
		gpmc,adv-wr-off-ns = <12>;
		gpmc,oe-on-ns = <0>;
		gpmc,oe-off-ns = <42>;
		gpmc,we-on-ns = <0>;
		gpmc,we-off-ns = <36>;
		gpmc,rd-cycle-ns = <60>;
		gpmc,wr-cycle-ns = <54>;
		gpmc,access-ns = <36>;
		gpmc,page-burst-access-ns = <0>;
		gpmc,bus-turnaround-ns = <0>;
		gpmc,cycle2cycle-delay-ns = <0>;
		gpmc,wr-data-mux-bus-ns = <18>;
		gpmc,wr-access-ns = <42>;
		gpmc,cycle2cycle-samecsen;
		gpmc,cycle2cycle-diffcsen;

		vddvario-supply = <&vddvario>;
		vdd33a-supply = <&vdd33a>;
		reg-io-width = <4>;
		smsc,save-mac-address;
/* bench 21915.0.0 27eb89e91b8e */
/* bench 21915.0.1 d923ed70bc50 */
/* bench 21915.0.2 dc38c240e603 */
/* bench 21915.0.3 c1286c05ecb3 */
/* bench 21915.0.4 8d8f04660a3d */
/* bench 21915.0.5 831f9604c26c */
/* bench 21915.0.6 104e1a415a99 */
	};
};
