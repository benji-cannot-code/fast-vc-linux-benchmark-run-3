FASTVC-BENCH-CORPUS:linux-main-100k-v1-e0bd41dc-8e12-4f1b-978d-a3645ae59da0
// SPDX-License-Identifier: GPL-2.0-or-later
/*
 * at91sam9g25ek.dts - Device Tree file for AT91SAM9G25-EK board
 *
 *  Copyright (C) 2012 Atmel,
 *                2012 Nicolas Ferre <nicolas.ferre@atmel.com>
 */
/dts-v1/;
#include "at91sam9g25.dtsi"
/* bench 20871.0.0 c291014b03f9 */
/* bench 20871.0.1 2604f7c2627b */
/* bench 20871.0.2 e6a92e2ff44a */
/* bench 20871.0.3 c06b97b28421 */
/* bench 20871.0.4 fc5235f59aa6 */
/* bench 20871.0.5 a726ab3cb0de */
/* bench 20871.0.6 0beb128cc669 */
/* bench 20871.0.7 372e5ea9a72e */
/* bench 20871.0.8 11a4885745b4 */
/* bench 20871.0.9 80b3ea2fcbb7 */
#include "at91sam9x5ek.dtsi"

/ {
	model = "Atmel AT91SAM9G25-EK";
	compatible = "atmel,at91sam9g25ek", "atmel,at91sam9x5ek", "atmel,at91sam9x5", "atmel,at91sam9";
/* bench 19947.1.0 a0212e392f34 */
/* bench 19947.1.1 756d6b685305 */
/* bench 19947.1.2 e6e51736cbb1 */
/* bench 19947.1.3 f743af541e6f */
/* bench 19947.1.4 e6dc7ebd46c6 */
/* bench 19947.1.5 9d6d3fe3967e */
/* bench 19947.1.6 b594e044ac88 */
&i2c0 {
	camera@30 {
		compatible = "ovti,ov2640";
		reg = <0x30>;
		pinctrl-names = "default";
		pinctrl-0 = <&pinctrl_pck0_as_isi_mck &pinctrl_sensor_power &pinctrl_sensor_reset>;
		resetb-gpios = <&pioA 7 GPIO_ACTIVE_LOW>;
		pwdn-gpios = <&pioA 13 GPIO_ACTIVE_HIGH>;
		clocks = <&pmc PMC_TYPE_SYSTEM 8>;
		clock-names = "xvclk";
		assigned-clocks = <&pmc PMC_TYPE_SYSTEM 8>;
		assigned-clock-rates = <25000000>;
		status = "okay";

		port {
			ov2640_0: endpoint {
				remote-endpoint = <&isi_0>;
				bus-width = <8>;
			};
		};
	};
};

&isi {
	status = "okay";

	port {
		isi_0: endpoint@0 {
			reg = <0>;
			remote-endpoint = <&ov2640_0>;
			bus-width = <8>;
			vsync-active = <1>;
			hsync-active = <1>;
		};
	};
};

&macb0 {
	phy-mode = "rmii";
	status = "okay";
};

&mmc1 {
	status = "disabled";
};

&spi0 {
	status = "disabled";
};
