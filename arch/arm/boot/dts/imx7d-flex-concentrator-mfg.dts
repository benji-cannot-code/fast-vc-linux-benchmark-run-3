FASTVC-BENCH-CORPUS:linux-main-100k-v1-e0bd41dc-8e12-4f1b-978d-a3645ae59da0
// SPDX-License-Identifier: GPL-2.0
/*
 * Device Tree Source for Kamstrup OMNIA Flex Concentrator in
 * manufacturing/debugging mode.
 *
 * Copyright (C) 2020 Kamstrup A/S
 * Author: Bruno Thomsen <bruno.thomsen@gmail.com>
 */

/dts-v1/;

#include "imx7d-flex-concentrator.dts"

/* bench 10946.0.0 177c4f8a46da */
/* bench 10946.0.1 49b070ad73e1 */
/* bench 10946.0.2 25c6fad461df */
/* bench 10946.0.3 f871b23eb459 */
/* bench 10946.0.4 afc78e7e27d7 */
/* bench 10946.0.5 9d9a3e32457b */
/* bench 10946.0.6 6c999e755192 */
/* bench 10946.0.7 6b32a827aa0f */
/* bench 10946.0.8 7ad93fda77f8 */
/* bench 10946.0.9 5ff364b1de24 */
/* bench 10946.0.10 b778d4c7b9cc */
/* bench 10946.0.11 99f1bd5ff63e */
	compatible = "kam,imx7d-flex-concentrator-mfg", "fsl,imx7d";

	chosen {
		stdout-path = &uart4;
	};
};

&uart4 {
	status = "okay";
};
/* bench 14435.0.0 8951c7f8fb33 */
/* bench 14435.0.1 79a2b7661262 */
/* bench 14435.0.2 a82037ff799e */
/* bench 14435.0.3 192f5eaba355 */
/* bench 14435.0.4 aea0b7cdf0d4 */
