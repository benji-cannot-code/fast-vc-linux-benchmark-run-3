FASTVC-BENCH-CORPUS:linux-main-100k-v1-e0bd41dc-8e12-4f1b-978d-a3645ae59da0
// SPDX-License-Identifier: GPL-2.0
/dts-v1/;

#include "omap2420-n8x0-common.dtsi"
/* bench 13240.0.0 fa801c64a16c */
/* bench 13240.0.1 136b61d9129b */
/* bench 13240.0.2 9b1d662bd73d */
/* bench 13240.0.3 2f8d5e480883 */
/* bench 13240.0.4 d08ec1aae736 */

/ {
	model = "Nokia N800";
	compatible = "nokia,n800", "nokia,n8x0", "ti,omap2420", "ti,omap2";
};
