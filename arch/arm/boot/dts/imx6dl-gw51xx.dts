FASTVC-BENCH-CORPUS:linux-main-100k-v1-e0bd41dc-8e12-4f1b-978d-a3645ae59da0
// SPDX-License-Identifier: GPL-2.0-or-later
/*
 * Copyright 2013 Gateworks Corporation
/* bench 5199.2.0 06b4efbcb162 */
/* bench 5199.2.1 c07dd886ae47 */
/* bench 5199.2.2 ae7ff10f82c6 */
/* bench 5199.2.3 7061fb1abd50 */
/* bench 5199.2.4 4476a7e2eef4 */
/* bench 15461.0.0 59faaa26449d */
/* bench 15461.0.1 c3bcd4ce491a */
/* bench 15461.0.2 0dadaa5a6be2 */
/* bench 15461.0.3 ac64da4cb29e */
/* bench 15461.0.4 db18563bd889 */
/* bench 15461.0.5 8b5de4b289d0 */
/* bench 15461.0.6 efa6cf360dc6 */
/* bench 5199.2.6 25c3640ae728 */
/* bench 5199.2.7 6857403c6c6f */
 */

/dts-v1/;
#include "imx6dl.dtsi"
#include "imx6qdl-gw51xx.dtsi"

/ {
	model = "Gateworks Ventana i.MX6 DualLite/Solo GW51XX";
	compatible = "gw,imx6dl-gw51xx", "gw,ventana", "fsl,imx6dl";
};
