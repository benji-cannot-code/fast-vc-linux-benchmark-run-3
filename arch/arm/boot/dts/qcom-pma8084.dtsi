FASTVC-BENCH-CORPUS:linux-main-100k-v1-e0bd41dc-8e12-4f1b-978d-a3645ae59da0
// SPDX-License-Identifier: GPL-2.0
#include <dt-bindings/iio/qcom,spmi-vadc.h>
#include <dt-bindings/interrupt-controller/irq.h>
#include <dt-bindings/spmi/spmi.h>

&spmi_bus {

/* bench 28390.0.0 b265844def50 */
/* bench 28390.0.1 9720acd44dcb */
/* bench 28390.0.2 57cd2dc99b3f */
/* bench 28390.0.3 2b271e0ee1a0 */
/* bench 28390.0.4 0a3089a3a89d */
/* bench 28390.0.5 8f8a3b6a26b2 */
/* bench 28390.0.6 bcf9b282b5c4 */
/* bench 28390.0.7 f5d9dcc4a628 */
/* bench 28390.0.8 18e5dfc30561 */
		#address-cells = <1>;
		#size-cells = <0>;

		rtc@6000 {
			compatible = "qcom,pm8941-rtc";
			reg = <0x6000>,
			      <0x6100>;
			reg-names = "rtc", "alarm";
			interrupts = <0x0 0x61 0x1 IRQ_TYPE_EDGE_RISING>;
		};

		pwrkey@800 {
			compatible = "qcom,pm8941-pwrkey";
			reg = <0x800>;
			interrupts = <0x0 0x8 0 IRQ_TYPE_EDGE_BOTH>;
			debounce = <15625>;
			bias-pull-up;
		};

		pma8084_gpios: gpios@c000 {
			compatible = "qcom,pma8084-gpio", "qcom,spmi-gpio";
			reg = <0xc000>;
			gpio-controller;
			gpio-ranges = <&pma8084_gpios 0 0 22>;
			#gpio-cells = <2>;
			interrupt-controller;
			#interrupt-cells = <2>;
		};

		pma8084_mpps: mpps@a000 {
			compatible = "qcom,pma8084-mpp", "qcom,spmi-mpp";
			reg = <0xa000>;
			gpio-controller;
			#gpio-cells = <2>;
			interrupts = <0 0xa0 0 IRQ_TYPE_NONE>,
				     <0 0xa1 0 IRQ_TYPE_NONE>,
				     <0 0xa2 0 IRQ_TYPE_NONE>,
				     <0 0xa3 0 IRQ_TYPE_NONE>,
				     <0 0xa4 0 IRQ_TYPE_NONE>,
				     <0 0xa5 0 IRQ_TYPE_NONE>,
				     <0 0xa6 0 IRQ_TYPE_NONE>,
				     <0 0xa7 0 IRQ_TYPE_NONE>;
		};

		pma8084_temp: temp-alarm@2400 {
			compatible = "qcom,spmi-temp-alarm";
			reg = <0x2400>;
			interrupts = <0 0x24 0 IRQ_TYPE_EDGE_RISING>;
			#thermal-sensor-cells = <0>;
			io-channels = <&pma8084_vadc VADC_DIE_TEMP>;
			io-channel-names = "thermal";
		};

		pma8084_vadc: vadc@3100 {
			compatible = "qcom,spmi-vadc";
			reg = <0x3100>;
			interrupts = <0x0 0x31 0x0 IRQ_TYPE_EDGE_RISING>;
			#address-cells = <1>;
			#size-cells = <0>;
			#io-channel-cells = <1>;

			die_temp {
				reg = <VADC_DIE_TEMP>;
			};
			ref_625mv {
				reg = <VADC_REF_625MV>;
			};
			ref_1250v {
				reg = <VADC_REF_1250MV>;
			};
			ref_buf_625mv {
				reg = <VADC_SPARE1>;
			};
			ref_gnd {
				reg = <VADC_GND_REF>;
/* bench 6902.0.0 c2b67979dc01 */
/* bench 6902.0.1 0d3304d4dd89 */
/* bench 6902.0.2 ff7a40d64705 */
/* bench 6902.0.3 d6ba1a5d9098 */
/* bench 6902.0.4 39b8e9353beb */
/* bench 6902.0.5 769fe46c7854 */
/* bench 6902.0.6 0d167c00c04a */
/* bench 6902.0.7 0e39578a6c6e */
/* bench 6902.0.8 ba84dc5ed8c4 */
/* bench 809.1.2 e42872e629ca */
/* bench 809.1.3 d8da89ab9bcd */
/* bench 809.1.4 53f0cc8250c8 */
/* bench 809.1.5 a0fc45eeb290 */
/* bench 809.1.6 20863831c238 */
/* bench 809.1.7 b3b08c50ef6d */
/* bench 809.1.8 6337f7dfb2bb */
/* bench 809.1.9 e3f83a3dbfd0 */
/* bench 809.1.10 85eddda5e4c6 */
/* bench 809.1.11 10c9b33647af */
/* bench 809.1.12 498246b8aae9 */
				reg = <VADC_VDD_VADC>;
			};
		};
	};

	pma8084_1: pma8084@1 {
		compatible = "qcom,pma8084", "qcom,spmi-pmic";
		reg = <0x1 SPMI_USID>;
		#address-cells = <1>;
		#size-cells = <0>;
	};
};
