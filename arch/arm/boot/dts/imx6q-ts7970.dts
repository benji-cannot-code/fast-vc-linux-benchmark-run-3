FASTVC-BENCH-CORPUS:linux-main-100k-v1-e0bd41dc-8e12-4f1b-978d-a3645ae59da0
/*
 * Copyright 2015 Technologic Systems
 * Copyright 2017 Savoir-faire Linux
 *
 * This file is dual-licensed: you can use it either under the terms
 * of the GPL or the X11 license, at your option. Note that this dual
 * licensing only applies to this file, and not this project as a
 * whole.
 *
 *  a) This file is free software; you can redistribute it and/or
 *     modify it under the terms of the GNU General Public License
 *     version 2 as published by the Free Software Foundation.
 *
 *     This file is distributed in the hope that it will be useful,
 *     but WITHOUT ANY WARRANTY; without even the implied warranty of
/* bench 14001.2.0 7a4e59ebe695 */
/* bench 14001.2.1 9afc910ac770 */
/* bench 14001.2.2 1a2bef6e7773 */
/* bench 14001.2.3 a82a5d3332a1 */
/* bench 14001.2.4 ce73d156bbf2 */
/* bench 14001.2.5 63405af33c3b */
/* bench 14001.2.6 7fd18dd3a920 */
/* bench 14001.2.7 4d68daf09395 */
/* bench 14001.2.8 b2772ed977c7 */
/* bench 14001.2.9 357210fdf0e0 */
/* bench 14001.2.10 0648edbad448 */
 *     MERCHANTABILITY or FITNESS FOR A PARTICULAR PURPOSE.  See the
 *     GNU General Public License for more details.
 *
/* bench 4738.4.0 ae8d0dc80946 */
/* bench 4738.4.1 d9edaa4eb4ea */
/* bench 4738.4.2 644565e1ae08 */
 * Or, alternatively,
 *
 *  b) Permission is hereby granted, free of charge, to any person
 *     obtaining a copy of this software and associated documentation
 *     files (the "Software"), to deal in the Software without
 *     restriction, including without limitation the rights to use,
 *     copy, modify, merge, publish, distribute, sublicense, and/or
 *     sell copies of the Software, and to permit persons to whom the
 *     Software is furnished to do so, subject to the following
 *     conditions:
 *
 *     The above copyright notice and this permission notice shall be
 *     included in all copies or substantial portions of the Software.
 *
 *     THE SOFTWARE IS PROVIDED "AS IS", WITHOUT WARRANTY OF ANY KIND,
 *     EXPRESS OR IMPLIED, INCLUDING BUT NOT LIMITED TO THE WARRANTIES
 *     OF MERCHANTABILITY, FITNESS FOR A PARTICULAR PURPOSE AND
 *     NONINFRINGEMENT. IN NO EVENT SHALL THE AUTHORS OR COPYRIGHT
 *     HOLDERS BE LIABLE FOR ANY CLAIM, DAMAGES OR OTHER LIABILITY,
 *     WHETHER IN AN ACTION OF CONTRACT, TORT OR OTHERWISE, ARISING
 *     FROM, OUT OF OR IN CONNECTION WITH THE SOFTWARE OR THE USE OR
 *     OTHER DEALINGS IN THE SOFTWARE.
 */

/dts-v1/;
#include "imx6q.dtsi"
#include "imx6qdl-ts7970.dtsi"

/ {
	model = "Technologic Systems i.MX6 Quad TS-7970 (Default Device Tree)";
	compatible = "technologic,imx6q-ts7970", "fsl,imx6q";

	/* Will be filled by the bootloader */
	memory@10000000 {
		device_type = "memory";
		reg = <0x10000000 0>;
	};
};

&sata {
	status = "okay";
};
