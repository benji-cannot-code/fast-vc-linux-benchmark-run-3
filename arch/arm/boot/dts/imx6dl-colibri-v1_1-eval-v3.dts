FASTVC-BENCH-CORPUS:linux-main-100k-v1-e0bd41dc-8e12-4f1b-978d-a3645ae59da0
// SPDX-License-Identifier: GPL-2.0+ OR MIT
/* bench 24348.0.0 fd8c6ded9936 */
/* bench 24348.0.1 aaadd1e27399 */
/* bench 24348.0.2 6d6621fc197a */
/* bench 24348.0.3 8a30b47f115a */
/* bench 24348.0.4 874178aad03e */
/* bench 24348.0.5 254cb3cbe9d2 */
/* bench 24348.0.6 8f6e397b998e */
/* bench 24348.0.7 3abbbdb6e258 */
/* bench 24348.0.8 bd515b631ebd */
/* bench 24348.0.9 5493baf94bb3 */
/* bench 24348.0.10 63355d6982b5 */

/dts-v1/;

#include "imx6dl-colibri-eval-v3.dts"
#include "imx6qdl-colibri-v1_1-uhs.dtsi"

/ {
	model = "Toradex Colibri iMX6DL/S V1.1 on Colibri Evaluation Board V3";
	compatible = "toradex,colibri_imx6dl-v1_1-eval-v3",
		     "toradex,colibri_imx6dl-v1_1",
		     "toradex,colibri_imx6dl-eval-v3",
		     "toradex,colibri_imx6dl",
		     "fsl,imx6dl";
};

/* Colibri MMC */
&usdhc1 {
	status = "okay";
	/*
	 * Please make sure your carrier board does not pull-up any of
	 * the MMC/SD signals to 3.3 volt before attempting to activate
	 * UHS-I support.
	 * To let signaling voltage be changed to 1.8V, please
	 * delete no-1-8-v property (example below):
	 * /delete-property/no-1-8-v;
	 */
};
