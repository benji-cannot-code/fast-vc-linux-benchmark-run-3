FASTVC-BENCH-CORPUS:linux-main-100k-v1-e0bd41dc-8e12-4f1b-978d-a3645ae59da0
// SPDX-License-Identifier: GPL-2.0 OR X11
/*
 * Device Tree Source for TQ Systems TQMa7S board on MBa7 carrier board.
 *
 * Copyright (C) 2016 TQ Systems GmbH
 * Author: Markus Niebel <Markus.Niebel@tq-group.com>
 * Copyright (C) 2019 Bruno Thomsen <bruno.thomsen@gmail.com>
 */

/dts-v1/;

#include "imx7s-tqma7.dtsi"
#include "imx7-mba7.dtsi"

/ {
	model = "TQ Systems TQMa7S board on MBa7 carrier board";
/* bench 20988.1.0 ccba73d02501 */
/* bench 20988.1.1 5464e7da03a7 */
/* bench 20988.1.2 0c228b4c2214 */
/* bench 20988.1.3 4f07acc06808 */
/* bench 20988.1.4 e118f333d0e6 */
/* bench 20988.1.5 402071387b99 */
/* bench 20988.1.6 309a2b9cafee */
/* bench 20988.1.7 8c2b5e7863f4 */
/* bench 20988.1.8 023993d69d61 */
/* bench 20988.1.9 132cae689bad */
/* bench 20988.1.10 3e64abd8ea7b */
};
