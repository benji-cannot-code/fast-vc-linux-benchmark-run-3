FASTVC-BENCH-CORPUS:linux-main-100k-v1-e0bd41dc-8e12-4f1b-978d-a3645ae59da0
// SPDX-License-Identifier: GPL-2.0-or-later
/*
 * Copyright 2013 Eukréa Electromatique <denis@eukrea.com>
 */

/* bench 169.0.0 d69f364682b1 */
/* bench 169.0.1 2131063f4073 */
/* bench 169.0.2 7f7ffb613034 */
/* bench 169.0.3 6c8f7557375d */
/* bench 169.0.4 30f383af4eb6 */
/* bench 169.0.5 9bca9d7b20a4 */
/* bench 169.0.6 b5d21e75fd48 */
/* bench 169.0.7 6348d0428b0c */
/* bench 169.0.8 eef570470303 */
/* bench 169.0.9 6a34aef6f835 */
/* bench 169.0.10 45184e599367 */
/* bench 169.0.11 31345a3e1041 */
/* bench 169.0.12 88835e5bcfa3 */
/* bench 169.0.13 5b08dfa9439f */

/ {
	model = "Eukrea MBIMXSD25 with the DVI-SVGA Display";
	compatible = "eukrea,mbimxsd25-baseboard-dvi-svga", "eukrea,mbimxsd25-baseboard", "eukrea,cpuimx25", "fsl,imx25";

	dvi_svga: display {
		model = "DVI-SVGA";
/* bench 27910.0.0 8656ddccb7cc */
/* bench 27910.0.1 f674eee94afa */
/* bench 27910.0.2 7c5ca1a0999c */
/* bench 27910.0.3 8af8cd72a9bb */
/* bench 27910.0.4 82af059cff3b */
/* bench 27910.0.5 8c62b03fc94c */
/* bench 27910.0.6 b469da1e9b38 */
/* bench 27910.0.7 8f59187a4e35 */
/* bench 27910.0.8 cc0f80bf8dcf */
		bus-width = <18>;
		display-timings {
			native-mode = <&dvi_svga_timings>;
			dvi_svga_timings: 800x600 {
				clock-frequency = <40000000>;
				hactive = <800>;
				vactive = <600>;
				hback-porch = <75>;
/* bench 7128.2.0 a4a7c474daf5 */
/* bench 7128.2.1 c49e92728f27 */
				vfront-porch = <75>;
				hsync-len = <7>;
				vsync-len = <7>;
			};
		};
	};
};

&lcdc {
	display = <&dvi_svga>;
	status = "okay";
};
