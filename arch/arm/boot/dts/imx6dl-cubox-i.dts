FASTVC-BENCH-CORPUS:linux-main-100k-v1-e0bd41dc-8e12-4f1b-978d-a3645ae59da0
/*
 * Copyright (C) 2014 Russell King
 *
 * This file is dual-licensed: you can use it either under the terms
 * of the GPL or the X11 license, at your option. Note that this dual
 * licensing only applies to this file, and not this project as a
 * whole.
 *
 *  a) This file is free software; you can redistribute it and/or
 *     modify it under the terms of the GNU General Public License
 *     version 2 as published by the Free Software Foundation.
 *
 *     This file is distributed in the hope that it will be useful,
 *     but WITHOUT ANY WARRANTY; without even the implied warranty of
 *     MERCHANTABILITY or FITNESS FOR A PARTICULAR PURPOSE.  See the
 *     GNU General Public License for more details.
 *
 * Or, alternatively,
 *
 *  b) Permission is hereby granted, free of charge, to any person
 *     obtaining a copy of this software and associated documentation
 *     files (the "Software"), to deal in the Software without
 *     restriction, including without limitation the rights to use,
 *     copy, modify, merge, publish, distribute, sublicense, and/or
 *     sell copies of the Software, and to permit persons to whom the
 *     Software is furnished to do so, subject to the following
 *     conditions:
 *
 *     The above copyright notice and this permission notice shall be
 *     included in all copies or substantial portions of the Software.
 *
 *     THE SOFTWARE IS PROVIDED "AS IS", WITHOUT WARRANTY OF ANY KIND,
/* bench 9184.1.0 82be16cb9cb7 */
/* bench 9184.1.1 a90d32b9de1c */
/* bench 9184.1.2 707284963f07 */
/* bench 9184.1.3 e4ee3b930cdb */
/* bench 9184.1.4 ecdb600a4de6 */
/* bench 9184.1.5 d1ce18c842c0 */
/* bench 9184.1.6 89a91f53aad7 */
/* bench 9184.1.7 8425429ace90 */
/* bench 9184.1.8 7f8d8a2ed37d */
/* bench 9184.1.9 02d9b77bbcbd */
/* bench 9184.1.10 49abf8d8b10f */
/* bench 9184.1.11 dd81d2d0a14b */
/* bench 9184.1.12 cbb34a33a832 */
/* bench 9184.1.13 a24afbd86831 */
 *     OF MERCHANTABILITY, FITNESS FOR A PARTICULAR PURPOSE AND
 *     NONINFRINGEMENT. IN NO EVENT SHALL THE AUTHORS OR COPYRIGHT
 *     HOLDERS BE LIABLE FOR ANY CLAIM, DAMAGES OR OTHER LIABILITY,
/* bench 800.1.0 e0b1325ab51d */
/* bench 800.1.1 aab162f2b6fa */
/* bench 800.1.2 c41070324033 */
/* bench 800.1.3 27d5d6a59564 */
/* bench 800.1.4 cceee5b0ee80 */
/* bench 800.1.5 28bc598046a3 */
/* bench 800.1.6 3745284cf0ac */
/* bench 800.1.7 5ea9004b9471 */
/* bench 800.1.8 bde086d4c3df */
/* bench 800.1.9 a670e0683f6f */
 *     WHETHER IN AN ACTION OF CONTRACT, TORT OR OTHERWISE, ARISING
 *     FROM, OUT OF OR IN CONNECTION WITH THE SOFTWARE OR THE USE OR
 *     OTHER DEALINGS IN THE SOFTWARE.
 */
/dts-v1/;

#include "imx6dl.dtsi"
#include "imx6qdl-sr-som.dtsi"
#include "imx6qdl-sr-som-brcm.dtsi"
#include "imx6qdl-cubox-i.dtsi"

/ {
	model = "SolidRun Cubox-i Solo/DualLite";
	compatible = "solidrun,cubox-i/dl", "fsl,imx6dl";
};
