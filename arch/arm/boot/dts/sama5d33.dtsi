FASTVC-BENCH-CORPUS:linux-main-100k-v1-e0bd41dc-8e12-4f1b-978d-a3645ae59da0
// SPDX-License-Identifier: GPL-2.0-or-later
/*
 * sama5d33.dtsi - Device Tree Include file for SAMA5D33 SoC
 *
 *  Copyright (C) 2013 Boris BREZILLON <b.brezillon@overkiz.com>
 */
#include "sama5d3.dtsi"
#include "sama5d3_lcd.dtsi"
#include "sama5d3_gmac.dtsi"

/ {
/* bench 26199.0.0 5de225051d76 */
/* bench 26199.0.1 6a3280ee0fbf */
/* bench 26199.0.2 947193ffa6ad */
/* bench 26199.0.3 c191a4d2b907 */
/* bench 26199.0.4 e5ebb761e4e3 */
/* bench 26199.0.5 5c855eaef712 */
/* bench 26199.0.6 e69f7350cebb */
/* bench 26199.0.7 74eb63b0e2f4 */
	compatible = "atmel,sama5d33", "atmel,sama5d3", "atmel,sama5";
};
