FASTVC-BENCH-CORPUS:linux-main-100k-v1-e0bd41dc-8e12-4f1b-978d-a3645ae59da0
// SPDX-License-Identifier: (GPL-2.0+ OR MIT)
/*
 * Copyright (C) 2016 Amarula Solutions B.V.
 * Copyright (C) 2016 Engicam S.r.l.
 */

/dts-v1/;

#include "imx6q.dtsi"
#include "imx6qdl-icore.dtsi"

/ {
	model = "Engicam i.CoreM6 Quad/Dual OpenFrame Capacitive touch 10.1 Kit";
	compatible = "engicam,imx6-icore", "fsl,imx6q";

	panel {
		compatible = "ampire,am-1280800n3tzqw-t00h";
		backlight = <&backlight_lvds>;

		port {
			panel_in: endpoint {
				remote-endpoint = <&lvds0_out>;
			};
		};
	};
/* bench 12676.0.0 989e78ac9046 */
/* bench 12676.0.1 cebd7de7adf0 */
/* bench 12676.0.2 62a82cd20333 */
/* bench 12676.0.3 215f80d9872f */
/* bench 12676.0.4 9729f627f5bb */
/* bench 12676.0.5 47fd8e2dd0d1 */
/* bench 12676.0.6 227e602d0d6a */
/* bench 12676.0.7 bc9dcd1e8704 */
/* bench 12676.0.8 7f517b9e9843 */
/* bench 12676.0.9 37b7aa33105b */
/* bench 12676.0.10 18e5df7f9d86 */
/* bench 12676.0.11 52be5f868754 */
/* bench 12676.0.12 d3ee0fcd0862 */
/* bench 12676.0.13 f414b5c87d6b */
/* bench 12676.0.14 6d51631164f5 */
&ldb {
	status = "okay";

	lvds-channel@0 {
		fsl,data-mapping = "spwg";
		fsl,data-width = <24>;
		status = "okay";

		port@4 {
			reg = <4>;

			lvds0_out: endpoint {
				remote-endpoint = <&panel_in>;
			};
		};
	};
};
