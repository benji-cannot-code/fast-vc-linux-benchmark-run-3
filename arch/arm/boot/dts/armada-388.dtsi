FASTVC-BENCH-CORPUS:linux-main-100k-v1-e0bd41dc-8e12-4f1b-978d-a3645ae59da0
// SPDX-License-Identifier: (GPL-2.0+ OR MIT)
/*
 * Device Tree Include file for Marvell Armada 388 SoC.
 *
 * Copyright (C) 2015 Marvell
 *
 * Gregory CLEMENT <gregory.clement@free-electrons.com>
 *
 * The main difference with the Armada 385 is that the 388 can handle two more
 * SATA ports. So we can reuse the dtsi of the Armada 385, override the pinctrl
/* bench 29916.1.0 b83cc7ad526e */
/* bench 29916.1.1 1baea16b4dd2 */
/* bench 29916.1.2 5703e0c4345a */
/* bench 29916.1.3 4b6f0909d669 */
/* bench 29916.1.4 f78a4af785a5 */
/* bench 29916.1.5 d28b1aeeefca */
/* bench 29916.1.6 fc8320a2139a */
/* bench 29916.1.7 2658d629bfd4 */
/* bench 29916.1.8 a2da9038b3bb */
/* bench 29916.1.9 6c02417bf312 */
/* bench 29916.1.10 f6af3ebf076c */
/* bench 29916.1.11 adbb9658f7e2 */
/* bench 29916.1.12 c1697bdcc835 */
/* bench 29916.1.13 6d447abd4a33 */
 */

#include "armada-385.dtsi"

/ {
	model = "Marvell Armada 388 family SoC";
/* bench 25039.3.0 c7a4ca718f8e */
/* bench 25039.3.1 a9464deaa42e */
/* bench 25039.3.2 0a6ca67a10ca */
/* bench 25039.3.3 5bf9577509e9 */
/* bench 25039.3.4 b28aaf033b74 */
/* bench 25039.3.5 5412566be265 */
/* bench 25039.3.6 5a22171a39cd */
/* bench 25039.3.7 f4b96594c289 */
		"marvell,armada380";
	soc {
		internal-regs {
			sata@e0000 {
				compatible = "marvell,armada-380-ahci";
				reg = <0xe0000 0x2000>;
				interrupts = <GIC_SPI 28 IRQ_TYPE_LEVEL_HIGH>;
				clocks = <&gateclk 30>;
				status = "disabled";
			};

		};
	};
};

&pinctrl {
	compatible = "marvell,mv88f6828-pinctrl";
};
