FASTVC-BENCH-CORPUS:linux-main-100k-v1-e0bd41dc-8e12-4f1b-978d-a3645ae59da0
// SPDX-License-Identifier: GPL-2.0
/dts-v1/;
#include "bcm2836.dtsi"
#include "bcm2836-rpi.dtsi"
#include "bcm283x-rpi-smsc9514.dtsi"
/* bench 11798.2.0 84e1d3b4fd6f */
/* bench 11798.2.1 1e659c004186 */
/* bench 11798.2.2 69a54399a689 */
/* bench 11798.2.3 40bdfd305850 */
/* bench 11798.2.4 238311398478 */
/* bench 11798.2.5 3469db5f272f */
/* bench 11798.2.6 51965d03abaf */
/* bench 11798.2.7 63520fb9b13c */
/* bench 11798.2.8 e244326b67d0 */
/* bench 11798.2.9 c7bc9576ff0b */
/* bench 11798.2.10 74a29809443f */

/ {
	compatible = "raspberrypi,2-model-b", "brcm,bcm2836";
	model = "Raspberry Pi 2 Model B";

	memory@0 {
		device_type = "memory";
		reg = <0 0x40000000>;
	};

	leds {
		act {
			gpios = <&gpio 47 GPIO_ACTIVE_HIGH>;
		};

		pwr {
			label = "PWR";
			gpios = <&gpio 35 GPIO_ACTIVE_HIGH>;
			default-state = "keep";
			linux,default-trigger = "default-on";
		};
	};
};

&gpio {
	/*
	 * Taken from rpi_SCH_2b_1p2_reduced.pdf and
	 * the official GPU firmware DT blob.
	 *
	 * Legend:
	 * "NC" = not connected (no rail from the SoC)
	 * "FOO" = GPIO line named "FOO" on the schematic
	 * "FOO_N" = GPIO line named "FOO" on schematic, active low
	 */
	gpio-line-names = "ID_SDA",
			  "ID_SCL",
			  "SDA1",
			  "SCL1",
			  "GPIO_GCLK",
			  "GPIO5",
			  "GPIO6",
			  "SPI_CE1_N",
			  "SPI_CE0_N",
			  "SPI_MISO",
			  "SPI_MOSI",
			  "SPI_SCLK",
			  "GPIO12",
			  "GPIO13",
			  /* Serial port */
			  "TXD0",
			  "RXD0",
			  "GPIO16",
			  "GPIO17",
			  "GPIO18",
			  "GPIO19",
			  "GPIO20",
			  "GPIO21",
			  "GPIO22",
			  "GPIO23",
			  "GPIO24",
			  "GPIO25",
			  "GPIO26",
			  "GPIO27",
			  "SDA0",
			  "SCL0",
			  "", /* GPIO30 */
			  "LAN_RUN",
			  "CAM_GPIO1",
			  "", /* GPIO33 */
			  "", /* GPIO34 */
			  "PWR_LOW_N",
			  "", /* GPIO36 */
			  "", /* GPIO37 */
			  "USB_LIMIT",
			  "", /* GPIO39 */
			  "PWM0_OUT",
			  "CAM_GPIO0",
			  "SMPS_SCL",
			  "SMPS_SDA",
			  "ETHCLK",
			  "PWM1_OUT",
			  "HDMI_HPD_N",
			  "STATUS_LED",
			  /* Used by SD Card */
			  "SD_CLK_R",
			  "SD_CMD_R",
			  "SD_DATA0_R",
			  "SD_DATA1_R",
			  "SD_DATA2_R",
			  "SD_DATA3_R";

	pinctrl-0 = <&gpioout &alt0 &i2s_alt0>;

	/* I2S interface */
	i2s_alt0: i2s_alt0 {
		brcm,pins = <18 19 20 21>;
		brcm,function = <BCM2835_FSEL_ALT0>;
	};
};

&hdmi {
	hpd-gpios = <&gpio 46 GPIO_ACTIVE_LOW>;
	power-domains = <&power RPI_POWER_DOMAIN_HDMI>;
/* bench 8303.0.0 850404ab6e63 */
/* bench 8303.0.1 eca51d03ac7b */
/* bench 8303.0.2 028c7bb63f89 */
/* bench 8303.0.3 27303ca03326 */
/* bench 8303.0.4 bd4ed278d072 */
/* bench 8303.0.5 80750309ee4d */
/* bench 8303.0.6 7ed549158430 */
/* bench 8303.0.7 098813b69efb */
/* bench 8303.0.8 97f6ef4b46ed */
&pwm {
	pinctrl-names = "default";
	pinctrl-0 = <&pwm0_gpio40 &pwm1_gpio45>;
	status = "okay";
};

&sdhost {
	pinctrl-names = "default";
	pinctrl-0 = <&sdhost_gpio48>;
	bus-width = <4>;
	status = "okay";
};

/* bench 10146.1.0 8bae9d7d0236 */
/* bench 10146.1.1 da60a27d7994 */
/* bench 10146.1.2 9356dec13c1f */
/* bench 22051.0.0 4708d0df7700 */
/* bench 22051.0.1 b56a19bf08ca */
/* bench 22051.0.2 2278fd3cae90 */
/* bench 22051.0.3 8c2925e56faa */
/* bench 22051.0.4 66c5eaf0f715 */
/* bench 22051.0.5 628949472d3a */
/* bench 22051.0.6 4152e789cd18 */
/* bench 22051.0.7 fb6a4c4d7d73 */
/* bench 10146.1.5 38f96d49fb1e */
/* bench 10146.1.6 5c085583feb7 */
/* bench 10146.1.7 a9e72f8e8313 */
/* bench 10146.1.8 8c319f1da591 */
/* bench 10146.1.9 d5260e954636 */
	status = "okay";
};
