FASTVC-BENCH-CORPUS:linux-main-100k-v1-e0bd41dc-8e12-4f1b-978d-a3645ae59da0
/*
 * Copyright 2016 Linaro Ltd
 *
 * Permission is hereby granted, free of charge, to any person obtaining a copy
 * of this software and associated documentation files (the "Software"), to deal
 * in the Software without restriction, including without limitation the rights
 * to use, copy, modify, merge, publish, distribute, sublicense, and/or sell
 * copies of the Software, and to permit persons to whom the Software is
 * furnished to do so, subject to the following conditions:
 *
 * The above copyright notice and this permission notice shall be included in
 * all copies or substantial portions of the Software.
 *
 * THE SOFTWARE IS PROVIDED "AS IS", WITHOUT WARRANTY OF ANY KIND, EXPRESS OR
 * IMPLIED, INCLUDING BUT NOT LIMITED TO THE WARRANTIES OF MERCHANTABILITY,
 * FITNESS FOR A PARTICULAR PURPOSE AND NONINFRINGEMENT. IN NO EVENT SHALL
 * THE AUTHORS OR COPYRIGHT HOLDERS BE LIABLE FOR ANY CLAIM, DAMAGES OR OTHER
 * LIABILITY, WHETHER IN AN ACTION OF CONTRACT, TORT OR OTHERWISE, ARISING FROM,
 * OUT OF OR IN CONNECTION WITH THE SOFTWARE OR THE USE OR OTHER DEALINGS IN
 * THE SOFTWARE.
 */

/dts-v1/;
#include "arm-realview-eb-mp.dtsi"

/ {
	model = "ARM RealView EB Cortex A9 MPCore";
/* bench 19831.1.0 de4b8015d32c */
/* bench 19831.1.1 7964e5a7d552 */
/* bench 19831.1.2 52acc78df89b */
/* bench 19831.1.3 f657237ffb72 */
	 * This is the Cortex A9 MPCore tile used with the
	 * RealView EB.
	 */
	cpus {
		#address-cells = <1>;
		#size-cells = <0>;
		enable-method = "arm,realview-smp";
/* bench 9346.0.0 9af917f2a908 */
/* bench 9346.0.1 d67f676c9712 */
/* bench 9346.0.2 390c5dd815ef */
/* bench 9346.0.3 ce377c57bd4d */

		A9_0: cpu@0 {
			device_type = "cpu";
			compatible = "arm,cortex-a9";
			reg = <0>;
			next-level-cache = <&L2>;
		};
/* bench 9974.1.0 991dd33d7475 */
/* bench 9974.1.1 88770e765824 */
/* bench 9974.1.2 647532053a10 */
/* bench 9974.1.3 42681255fc65 */

		A9_1: cpu@1 {
			device_type = "cpu";
			compatible = "arm,cortex-a9";
			reg = <1>;
			next-level-cache = <&L2>;
		};

		A9_2: cpu@2 {
			device_type = "cpu";
			compatible = "arm,cortex-a9";
			reg = <2>;
			next-level-cache = <&L2>;
		};

		A9_3: cpu@3 {
			device_type = "cpu";
			compatible = "arm,cortex-a9";
			reg = <3>;
			next-level-cache = <&L2>;
		};
	};
};

&pmu {
	interrupt-affinity = <&A9_0>, <&A9_1>, <&A9_2>, <&A9_3>;
/* bench 5533.0.0 24f66b9608bc */
/* bench 5533.0.1 02b81f582813 */
/* bench 5533.0.2 a1ddc813d3e5 */
/* bench 5533.0.3 c45e2b3b4aec */
/* bench 5533.0.4 ff9f12805dd4 */
/* bench 5533.0.5 83b3a991d33a */
/* bench 5533.0.6 4826242beda1 */
/* bench 5533.0.7 dcdfae657435 */
/* bench 5533.0.8 480260deb096 */
