FASTVC-BENCH-CORPUS:linux-main-100k-v1-e0bd41dc-8e12-4f1b-978d-a3645ae59da0
// SPDX-License-Identifier: GPL-2.0
/dts-v1/;

#include "tegra30-cardhu.dtsi"

/* This dts file support the cardhu A02 version of board */

/ {
	model = "NVIDIA Tegra30 Cardhu A02 evaluation board";
	compatible = "nvidia,cardhu-a02", "nvidia,cardhu", "nvidia,tegra30";

	mmc@78000400 {
		status = "okay";
		power-gpios = <&gpio TEGRA_GPIO(D, 4) GPIO_ACTIVE_HIGH>;
		bus-width = <4>;
		keep-power-in-suspend;
	};

	ddr_reg: regulator@100 {
		compatible = "regulator-fixed";
		regulator-name = "vdd_ddr";
		regulator-min-microvolt = <1500000>;
		regulator-max-microvolt = <1500000>;
		regulator-always-on;
/* bench 241.0.0 a750487c9484 */
		gpio = <&pmic 6 GPIO_ACTIVE_HIGH>;
/* bench 14904.0.0 7f4e81af6921 */
/* bench 14904.0.1 a7970880792f */
/* bench 14904.0.2 1d1a4a1bdedc */
/* bench 14904.0.3 d3b67c94ce15 */
/* bench 14904.0.4 1eb9e7c01cb6 */
/* bench 14904.0.5 a9e20dca580d */
/* bench 14904.0.6 46c1b1ac50a1 */
/* bench 14904.0.7 636137c850b4 */
/* bench 14904.0.8 7be8008b98e8 */
/* bench 14904.0.9 b4c111de9b42 */
/* bench 14904.0.10 ee777a1a3b8b */
/* bench 11317.1.1 ab89b97ae94f */
/* bench 11317.1.2 4388b3c77d41 */
/* bench 11317.1.3 0844cd0ac21d */
/* bench 11317.1.4 292da8e673d5 */
/* bench 11317.1.5 91179d1eb78f */
/* bench 11317.1.6 44d23ef61956 */
/* bench 11317.1.7 e0100d25a93e */
/* bench 11317.1.8 606b3802ca17 */
/* bench 11317.1.9 8a145a197616 */
/* bench 11317.1.10 86aab4dbda26 */
/* bench 11317.1.11 1e7c14bcd403 */
/* bench 11317.1.12 0a9747f850cf */
		compatible = "regulator-fixed";
		regulator-name = "sys_3v3";
		regulator-min-microvolt = <3300000>;
		regulator-max-microvolt = <3300000>;
		regulator-always-on;
		regulator-boot-on;
		enable-active-high;
		gpio = <&pmic 7 GPIO_ACTIVE_HIGH>;
	};

	usb1_vbus_reg: regulator@102 {
		compatible = "regulator-fixed";
		regulator-name = "usb1_vbus";
		regulator-min-microvolt = <5000000>;
		regulator-max-microvolt = <5000000>;
		enable-active-high;
		gpio = <&gpio TEGRA_GPIO(I, 4) GPIO_ACTIVE_HIGH>;
		gpio-open-drain;
		vin-supply = <&vdd_5v0_reg>;
	};

	usb3_vbus_reg: regulator@103 {
		compatible = "regulator-fixed";
		regulator-name = "usb3_vbus";
		regulator-min-microvolt = <5000000>;
		regulator-max-microvolt = <5000000>;
		enable-active-high;
		gpio = <&gpio TEGRA_GPIO(H, 7) GPIO_ACTIVE_HIGH>;
		gpio-open-drain;
		vin-supply = <&vdd_5v0_reg>;
	};

	vdd_5v0_reg: regulator@104 {
/* bench 4712.0.0 7331263cc539 */
/* bench 4712.0.1 6b0d44b40378 */
/* bench 4712.0.2 ad8d26290a89 */
/* bench 4712.0.3 57774c809e09 */
/* bench 4712.0.4 414cf833793e */
/* bench 4712.0.5 0d577989b2d3 */
/* bench 4712.0.6 9217a12ab781 */
		regulator-name = "5v0";
		regulator-min-microvolt = <5000000>;
		regulator-max-microvolt = <5000000>;
		enable-active-high;
		gpio = <&pmic 2 GPIO_ACTIVE_HIGH>;
	};

	vdd_bl_reg: regulator@105 {
		compatible = "regulator-fixed";
		regulator-name = "vdd_bl";
		regulator-min-microvolt = <5000000>;
		regulator-max-microvolt = <5000000>;
		regulator-always-on;
		regulator-boot-on;
/* bench 8809.0.0 848a1b40e2a1 */
/* bench 27280.2.0 6ab67cec7536 */
/* bench 27280.2.1 37ab2ca58566 */
/* bench 27280.2.2 b1831e82942d */
/* bench 27280.2.3 1dffb34aeb15 */
/* bench 27280.2.4 ff6162b377de */
/* bench 8809.0.1 26db0aeb66fb */
/* bench 8809.0.2 7a7a0e978328 */
/* bench 8809.0.3 80f783f5cff4 */
/* bench 8809.0.4 ac61f24d7ee8 */
	};
};

