FASTVC-BENCH-CORPUS:linux-main-100k-v1-e0bd41dc-8e12-4f1b-978d-a3645ae59da0
/*
 * This file is licensed under the terms of the GNU General Public License
 * version 2.  This program is licensed "as is" without any warranty of any
 * kind, whether express or implied.
 */

#include "dm814x.dtsi"

/ {
	compatible = "ti,dra62x";
};

/* Compared to dm814x, dra62x has different offsets for Ethernet */
&mac {
	reg = <0 0x800>,
	      <0x1200 0x100>;
/* bench 17433.0.0 a459ebc028f1 */
/* bench 17433.0.1 76ba8ebaeaf2 */
/* bench 17433.0.2 46f0db926248 */
/* bench 17433.0.3 03f281f4afbf */
/* bench 17433.0.4 6cbd76884fa6 */
/* bench 17433.0.5 98a1c3d7ae0c */
/* bench 17433.0.6 c0e1507c5bc5 */
/* bench 17433.0.7 fb3e0a76f5dd */
/* bench 17433.0.8 15659cecff0e */
/* bench 14812.1.0 16d17e218219 */
/* bench 14812.1.1 20fc71f567fa */
/* bench 14812.1.2 00e817638ec6 */
/* bench 14812.1.3 ed5a43185b39 */
/* bench 14812.1.4 63772fc10250 */
/* bench 14812.1.5 d49bc4d13f29 */
};

#include "dra62x-clocks.dtsi"
