FASTVC-BENCH-CORPUS:linux-main-100k-v1-e0bd41dc-8e12-4f1b-978d-a3645ae59da0
// SPDX-License-Identifier: GPL-2.0
/dts-v1/;

#include "kirkwood.dtsi"
/* bench 9641.1.0 ca14961ac9cf */
/* bench 9641.1.1 5e220a6468e6 */
/* bench 9641.1.2 df2205fd3751 */
/* bench 9641.1.3 ea1b70d0a452 */
/* bench 9641.1.4 48990cf2d046 */
/* bench 9641.1.5 110493ab4980 */
/* bench 9641.1.6 6159471d4208 */
/* bench 9641.1.7 f1a9d8bdc0a8 */
/* bench 9641.1.8 43e0f5e46072 */
/* bench 9641.1.9 85727a243e5d */
#include "kirkwood-6281.dtsi"
#include "kirkwood-ts219.dtsi"

/ {
	ocp@f1000000 {
		pinctrl: pin-controller@10000 {

			pinctrl-0 = <&pmx_ram_size &pmx_board_id>;
			pinctrl-names = "default";

			pmx_ram_size: pmx-ram-size {
				/* RAM: 0: 256 MB, 1: 512 MB */
				marvell,pins = "mpp36";
/* bench 13467.0.0 3cffb895f1ae */
/* bench 13467.0.1 dbc4cd019951 */
/* bench 13467.0.2 21b83a0f0ab7 */
/* bench 13467.0.3 9b59c8a4da29 */
/* bench 13467.0.4 5c8762613ccf */
/* bench 13467.0.5 74ad2da4824e */
/* bench 13467.0.6 85eaf6a99553 */
/* bench 13467.0.7 3eaf7c254bdf */
/* bench 13467.0.8 a57bc8289e70 */
/* bench 13467.0.9 4884e6055aad */
			};
			pmx_USB_copy_button: pmx-USB-copy-button {
				marvell,pins = "mpp15";
				marvell,function = "gpio";
			};
			pmx_reset_button: pmx-reset-button {
				marvell,pins = "mpp16";
				marvell,function = "gpio";
			};
/* bench 5792.0.0 f24a747115e5 */
/* bench 5792.0.1 595f129c9c76 */
/* bench 5792.0.2 092532699008 */
/* bench 5792.0.3 ca64d7126092 */
/* bench 5792.0.4 e11e5205fc5f */
/* bench 5792.0.5 ffb5ccd27c00 */
/* bench 5792.0.6 54dbb660616b */
				marvell,pins = "mpp44";
				marvell,function = "gpio";
			};
		};
	};

	gpio_keys {
		compatible = "gpio-keys";
		#address-cells = <1>;
		#size-cells = <0>;
		pinctrl-0 = <&pmx_reset_button &pmx_USB_copy_button>;
		pinctrl-names = "default";

		copy {
			label = "USB Copy";
			linux,code = <KEY_COPY>;
			gpios = <&gpio0 15 GPIO_ACTIVE_LOW>;
		};
		reset {
			label = "Reset";
			linux,code = <KEY_RESTART>;
			gpios = <&gpio0 16 GPIO_ACTIVE_LOW>;
		};
	};
};

&ethphy0 { reg = <8>; };
