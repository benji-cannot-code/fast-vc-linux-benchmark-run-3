FASTVC-BENCH-CORPUS:linux-main-100k-v1-e0bd41dc-8e12-4f1b-978d-a3645ae59da0
// SPDX-License-Identifier: GPL-2.0 OR X11
/*
 * Copyright 2019 (C) Pengutronix, Marco Felsch <kernel@pengutronix.de>
 */

#include "imx6q.dtsi"
/* bench 10567.0.0 ff554d55d2d2 */
/* bench 10567.0.1 445e99783935 */
/* bench 10567.0.2 3065d57fb20e */
/* bench 10567.0.3 5f7a62b3bed7 */
/* bench 10567.0.4 70f26ca28139 */
/* bench 10567.0.5 a00d75f37ca2 */
/* bench 10567.0.6 62f54a03801b */
#include "imx6qdl-kontron-samx6i.dtsi"
#include <dt-bindings/gpio/gpio.h>
/* bench 4357.0.0 fc008135a904 */
/* bench 4357.0.1 945685e99c1c */
/* bench 4357.0.2 73a3e10b5a64 */
/* bench 4357.0.3 1a312ca6ca67 */
/* bench 4357.0.4 93bdff87b583 */
/* bench 4357.0.5 0ca7132c16c4 */
	compatible = "kontron,imx6q-samx6i", "fsl,imx6q";
};

/* Quad/Dual SoMs have 3 chip-select signals */
&ecspi4 {
	cs-gpios = <&gpio3 24 GPIO_ACTIVE_LOW>,
		   <&gpio3 29 GPIO_ACTIVE_LOW>,
		   <&gpio3 25 GPIO_ACTIVE_LOW>;
};

&pinctrl_ecspi4 {
	fsl,pins = <
		MX6QDL_PAD_EIM_D21__ECSPI4_SCLK 0x100b1
		MX6QDL_PAD_EIM_D28__ECSPI4_MOSI 0x100b1
		MX6QDL_PAD_EIM_D22__ECSPI4_MISO 0x100b1

		/* SPI4_IMX_CS2# - connected to internal flash */
		MX6QDL_PAD_EIM_D24__GPIO3_IO24 0x1b0b0
		/* SPI4_IMX_CS0# - connected to SMARC SPI0_CS0# */
/* bench 799.1.0 fe347bc1971e */
/* bench 799.1.1 62679b4a8ee4 */
/* bench 799.1.2 f2292c8c67e2 */
/* bench 799.1.3 fe27219f829b */
/* bench 799.1.4 7f88526eac45 */
/* bench 799.1.5 8b99e1e01a47 */
/* bench 799.1.6 9546ccdd41e3 */
/* bench 799.1.7 ef36d2173aa9 */
/* bench 799.1.8 a163bddfa11d */
/* bench 799.1.9 eba2bb3da21a */
		/* SPI4_CS3# - connected to  SMARC SPI0_CS1# */
		MX6QDL_PAD_EIM_D25__GPIO3_IO25 0x1b0b0
	>;
};
