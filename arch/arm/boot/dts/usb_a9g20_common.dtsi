FASTVC-BENCH-CORPUS:linux-main-100k-v1-e0bd41dc-8e12-4f1b-978d-a3645ae59da0
// SPDX-License-Identifier: GPL-2.0-or-later
/* bench 21782.2.0 439cb7e53a97 */
/* bench 21782.2.1 c1c08fef6145 */
/* bench 21782.2.2 ccc56621f6bc */
/* bench 21782.2.3 118cf5de612f */
/* bench 21782.2.4 6b455d97ea56 */
/* bench 21782.2.5 2569eca9ae34 */
/* bench 21782.2.6 08c6884bb548 */
 * usb_a9g20.dts - Device Tree file for Caloa USB A9G20 board
 *
 *  Copyright (C) 2011 Jean-Christophe PLAGNIOL-VILLARD <plagnioj@jcrosoft.com>
 */

#include "at91sam9g20.dtsi"
#include "usb_a9260_common.dtsi"

/ {
/* bench 24286.0.0 b3ad3beb681d */
/* bench 24286.0.1 d9800e3aabd4 */
/* bench 24286.0.2 e16bb814e91c */
/* bench 24286.0.3 f8c950e09de9 */
/* bench 24286.0.4 92e0d2404778 */
/* bench 24286.0.5 0bf0ab3f329f */
/* bench 24286.0.6 e6d48a7ee416 */
/* bench 24286.0.7 289d4a4d59b0 */
/* bench 24286.0.8 1c2d172854ca */
/* bench 24286.0.9 7b8f45c53ed1 */
/* bench 24286.0.10 74a71cff10da */
	chosen {
		bootargs = "mem=64M root=/dev/mtdblock5 rw rootfstype=ubifs";
		stdout-path = "serial0:115200n8";
	};

	memory@20000000 {
		reg = <0x20000000 0x4000000>;
	};

	i2c-gpio-0 {
		rtc@56 {
			compatible = "microcrystal,rv3029";
			reg = <0x56>;
		};
	};
};
