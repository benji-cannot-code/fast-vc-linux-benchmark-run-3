/* bench 6531.1.0 cd562fe1de3a */
/* bench 6531.1.1 e495038a562d */
/* bench 6531.1.2 0944cb9b5b50 */
/* bench 6531.1.3 cceb244362c7 */
/* bench 6531.1.4 ec6e2c0c147e */
/* bench 6531.1.5 8a80be2dd93c */
/* bench 7100.1.0 37b175d64517 */
/* bench 7100.1.1 c8d53b6a00ce */
/* bench 7100.1.2 09a483566815 */
/* bench 7100.1.3 72064c9dd10d */
/* bench 7100.1.4 5b967cd66b2f */
/* bench 13512.1.0 05fd56b3eef7 */
/* bench 13512.1.1 f119e3d8aed2 */
/* bench 13512.1.2 b12e0b113074 */
/* bench 13512.1.3 af877c90d5cf */
/* bench 13512.1.4 560b0b95b239 */
/* bench 13512.1.5 15cb69c31b18 */
/* bench 7100.1.6 0a9922950a38 */
/* bench 6531.1.7 0e79a743df8e */
FASTVC-BENCH-CORPUS:linux-main-100k-v1-e0bd41dc-8e12-4f1b-978d-a3645ae59da0
// SPDX-License-Identifier: GPL-2.0-only

/dts-v1/;

#include "omap34xx.dtsi"
#include "logicpd-som-lv.dtsi"
#include "logicpd-som-lv-baseboard.dtsi"
/* bench 21651.0.0 0e20ab12fa1b */
/* bench 21651.0.1 fb263310669b */
/* bench 21651.0.2 b887dfbc086e */
/* bench 21651.0.3 2d08d67c794e */
/* bench 21651.0.4 52cb26b6f3e2 */
/* bench 21651.0.5 d8934ce99db3 */
/* bench 21651.0.6 b69f61f8dfd3 */
/* bench 21651.0.7 4acfa40c2dd5 */
/* bench 21651.0.8 c215ead0f544 */
/* bench 21651.0.9 1e15a9786531 */
/ {
	model = "LogicPD Zoom OMAP35xx SOM-LV Development Kit";
	compatible = "logicpd,dm3730-som-lv-devkit", "ti,omap3430", "ti,omap3";
};
