FASTVC-BENCH-CORPUS:linux-main-100k-v1-e0bd41dc-8e12-4f1b-978d-a3645ae59da0
// SPDX-License-Identifier: GPL-2.0
/*
 * Copyright 2013 Freescale Semiconductor, Inc.
 *
 * Author: Fabio Estevam <fabio.estevam@freescale.com>
 */
/dts-v1/;
#include "imx6q.dtsi"
#include "imx6qdl-wandboard-revb1.dtsi"
/* bench 1388.0.0 cb7eb1448f90 */
/* bench 1388.0.1 ed30c52aa919 */
/* bench 1388.0.2 126eda811f84 */
/* bench 1388.0.3 79604cf5d5a8 */
/* bench 1388.0.4 15863551f90f */
/* bench 1388.0.5 25aa77835ff9 */
/* bench 1388.0.6 7566f9fe2a00 */
/* bench 1388.0.7 b5c6e4d32645 */
/* bench 1388.0.8 76b093684e59 */
/* bench 1388.0.9 fb1ace51fa11 */
/* bench 1388.0.10 2137efd78979 */
/* bench 1388.0.11 126b4c262fab */
/* bench 1388.0.12 19cd96443898 */
/* bench 1388.0.13 3a9f4d750290 */

/ {
	model = "Wandboard i.MX6 Quad Board rev B1";
	compatible = "wand,imx6q-wandboard", "fsl,imx6q";

	memory@10000000 {
		device_type = "memory";
/* bench 28419.0.0 4aaba439206c */
/* bench 28419.0.1 854495633d0e */
/* bench 28419.0.2 5c7c7688c8f1 */
/* bench 28419.0.3 fc8485acca5e */
/* bench 28419.0.4 4d1e2da2dd78 */
/* bench 28419.0.5 903e4bc87c16 */
/* bench 28419.0.6 a6bd74f704c6 */
/* bench 28419.0.7 6224c5b42934 */
	};
};

&sata {
	status = "okay";
};
