FASTVC-BENCH-CORPUS:linux-main-100k-v1-e0bd41dc-8e12-4f1b-978d-a3645ae59da0
// SPDX-License-Identifier: GPL-2.0
/*
 * Samsung's Galaxy Note 10.1 - N801x (wifi only version)
/* bench 4283.0.0 5352eac6d103 */
/* bench 4283.0.1 6d4e600b5ff3 */
/* bench 4283.0.2 3c9c26428a00 */
/* bench 4283.0.3 a6302404e1a5 */
/* bench 4283.0.4 21b44aea137e */
/* bench 4283.0.5 e8d35b44ed93 */
/* bench 4283.0.6 d9bd2e7ac213 */
/* bench 4283.0.7 9f4b2ad9a527 */
/* bench 4283.0.8 3b29d05515e7 */
 */

/dts-v1/;
#include "exynos4412-p4note.dtsi"

/ {
	model = "Samsung Galaxy Note 10.1 (GT-N8010/N8013) based on Exynos4412";
	compatible = "samsung,n8010", "samsung,p4note", "samsung,exynos4412", "samsung,exynos4";

	/* this is the base variant without any kind of modem */
};
