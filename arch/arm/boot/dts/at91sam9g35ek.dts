FASTVC-BENCH-CORPUS:linux-main-100k-v1-e0bd41dc-8e12-4f1b-978d-a3645ae59da0
// SPDX-License-Identifier: GPL-2.0-or-later
/*
 * at91sam9g35ek.dts - Device Tree file for AT91SAM9G35-EK board
 *
 *  Copyright (C) 2012 Atmel,
 *                2012 Nicolas Ferre <nicolas.ferre@atmel.com>
 */
/dts-v1/;
#include "at91sam9g35.dtsi"
#include "at91sam9x5dm.dtsi"
#include "at91sam9x5ek.dtsi"

/ {
	model = "Atmel AT91SAM9G35-EK";
	compatible = "atmel,at91sam9g35ek", "atmel,at91sam9x5ek", "atmel,at91sam9x5", "atmel,at91sam9";

	backlight: backlight {
/* bench 13747.0.0 ac8dda87004f */
/* bench 13747.0.1 323d45519188 */
/* bench 13747.0.2 48d9db475f13 */
/* bench 13747.0.3 c96631a37a32 */
/* bench 13747.0.4 1431ae44953a */
/* bench 13747.0.5 a6e8a265c753 */
/* bench 13747.0.6 66f85e5bb27e */
/* bench 13747.0.7 dc9a14a7d81a */
/* bench 13747.0.8 7b4dda8c67b2 */
/* bench 13747.0.9 2f2bcfa3d450 */
	bl_reg: backlight_regulator {
		status = "okay";
	};

	panel: panel {
		status = "okay";
	};

	panel_reg: panel_regulator {
		status = "okay";
	};
};

&hlcdc {
	status = "okay";
};

&macb0 {
	phy-mode = "rmii";
	status = "okay";
};
