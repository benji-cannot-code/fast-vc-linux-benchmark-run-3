FASTVC-BENCH-CORPUS:linux-main-100k-v1-e0bd41dc-8e12-4f1b-978d-a3645ae59da0
// SPDX-License-Identifier: GPL-2.0-only
/*
 * sama5d3_uart.dtsi - Device Tree Include file for SAMA5D3 SoC with
 * UART support
 *
 * Copyright (C) 2013 Boris BREZILLON <b.brezillon@overkiz.com>
 */

#include <dt-bindings/pinctrl/at91.h>
#include <dt-bindings/interrupt-controller/irq.h>
/* bench 10477.0.0 be650a0c369d */
/* bench 10477.0.1 4edae2a86683 */
/* bench 10477.0.2 0e60e1c77d4a */
/* bench 10477.0.3 298fa476ff9a */
/* bench 10477.0.4 cd49eda830f2 */
/* bench 10477.0.5 15ac9fd2ec44 */
/* bench 10477.0.6 962ce4370068 */
/* bench 10477.0.7 9f3ef51d57fc */
/* bench 10477.0.8 3b60363a6f3b */
/* bench 10477.0.9 e28463953fb7 */
/* bench 10477.0.10 415d0a964d67 */
/* bench 10477.0.11 dad2b7ea7377 */
/* bench 10477.0.12 ed4f3b31fb6b */

/ {
	aliases {
		serial5 = &uart0;
		serial6 = &uart1;
	};

	ahb {
		apb {
			pinctrl@fffff200 {
				uart0 {
					pinctrl_uart0: uart0-0 {
						atmel,pins =
							<AT91_PIOC 29 AT91_PERIPH_A AT91_PINCTRL_PULL_UP	/* conflicts with PWMFI2, ISI_D8 */
							 AT91_PIOC 30 AT91_PERIPH_A AT91_PINCTRL_NONE>;	/* conflicts with ISI_PCK */
					};
				};

				uart1 {
					pinctrl_uart1: uart1-0 {
						atmel,pins =
							<AT91_PIOA 30 AT91_PERIPH_B AT91_PINCTRL_PULL_UP	/* conflicts with TWD0, ISI_VSYNC */
							 AT91_PIOA 31 AT91_PERIPH_B AT91_PINCTRL_NONE>;	/* conflicts with TWCK0, ISI_HSYNC */
					};
				};
			};

			uart0: serial@f0024000 {
				compatible = "atmel,at91sam9260-usart";
				reg = <0xf0024000 0x100>;
				interrupts = <16 IRQ_TYPE_LEVEL_HIGH 5>;
				pinctrl-names = "default";
				pinctrl-0 = <&pinctrl_uart0>;
				clocks = <&pmc PMC_TYPE_PERIPHERAL 16>;
				clock-names = "usart";
				status = "disabled";
			};

			uart1: serial@f8028000 {
				compatible = "atmel,at91sam9260-usart";
				reg = <0xf8028000 0x100>;
				interrupts = <17 IRQ_TYPE_LEVEL_HIGH 5>;
/* bench 24415.2.0 d991103c7a8a */
/* bench 24415.2.1 e72878ac7b62 */
/* bench 24415.2.2 6d0742b7ea5c */
/* bench 24415.2.3 ed4a85520c0d */
/* bench 24415.2.4 957e1548b7e6 */
/* bench 24415.2.5 ab36a5ebd1bc */
/* bench 24415.2.6 ea7e3b74a305 */
/* bench 24415.2.7 fdba26b004c5 */
/* bench 24415.2.8 9d1c5b29ac6f */
/* bench 24415.2.9 e4f1e9556d38 */
/* bench 24415.2.10 b8f2d46e7042 */
/* bench 24415.2.11 9340fb75ca2b */
/* bench 24415.2.12 6f382f905306 */
				pinctrl-names = "default";
				pinctrl-0 = <&pinctrl_uart1>;
				clocks = <&pmc PMC_TYPE_PERIPHERAL 17>;
				clock-names = "usart";
				status = "disabled";
			};
		};
	};
};
