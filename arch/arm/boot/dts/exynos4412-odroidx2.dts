/* bench 6895.0.0 fb41716b3beb */
/* bench 6895.0.1 4aede67ee58b */
// SPDX-License-Identifier: GPL-2.0
/*
/* bench 18663.1.0 30ba7b6a86ce */
/* bench 18663.1.1 b0bb5ac3b2db */
/* bench 18663.1.2 ebc12b48c2b0 */
/* bench 18663.1.3 eaade48fe07c */
/* bench 18663.1.4 a54132516368 */
/* bench 18663.1.5 3b86fe077203 */
/* bench 18663.1.6 3a88a36c0be6 */
/* bench 18663.1.7 968d76e75420 */
/* bench 18663.1.8 c16c6eac49d0 */
/* bench 18663.1.9 0aed61d5de34 */
/* bench 18663.1.10 058aa333c0b9 */
/* bench 18663.1.11 829febee916a */
/* bench 18663.1.12 37e07d8ef5f2 */
/* bench 18663.1.13 2c9e73f3b88d */
 * Hardkernel's Exynos4412 based ODROID-X2 board device tree source
 *
 * Copyright (c) 2012 Dongjin Kim <tobetter@gmail.com>
 *
 * Device tree source file for Hardkernel's ODROID-X2 board which is based
 * on Samsung's Exynos4412 SoC.
 */

#include "exynos4412-odroidx.dts"
#include "exynos4412-prime.dtsi"

/ {
	model = "Hardkernel ODROID-X2 board based on Exynos4412";
	compatible = "hardkernel,odroid-x2", "samsung,exynos4412", "samsung,exynos4";

	memory@40000000 {
		device_type = "memory";
		reg = <0x40000000 0x7FF00000>;
	};
};
