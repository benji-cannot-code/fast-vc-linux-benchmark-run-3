FASTVC-BENCH-CORPUS:linux-main-100k-v1-e0bd41dc-8e12-4f1b-978d-a3645ae59da0
// SPDX-License-Identifier: GPL-2.0-only
/*
 * Copyright (C) 2014 Florian Vaussard, EPFL Mobots group
 */

#include "omap36xx.dtsi"
#include "omap3-overo-base.dtsi"

&omap3_pmx_core2 {
	pinctrl-names = "default";
	pinctrl-0 = <
			&hsusb2_2_pins
	>;

	hsusb2_2_pins: pinmux_hsusb2_2_pins {
		pinctrl-single,pins = <
			OMAP3630_CORE2_IOPAD(0x25f0, PIN_OUTPUT | MUX_MODE3)		/* etk_d10.hsusb2_clk */
			OMAP3630_CORE2_IOPAD(0x25f2, PIN_OUTPUT | MUX_MODE3)		/* etk_d11.hsusb2_stp */
			OMAP3630_CORE2_IOPAD(0x25f4, PIN_INPUT_PULLDOWN | MUX_MODE3)	/* etk_d12.hsusb2_dir */
			OMAP3630_CORE2_IOPAD(0x25f6, PIN_INPUT_PULLDOWN | MUX_MODE3)	/* etk_d13.hsusb2_nxt */
			OMAP3630_CORE2_IOPAD(0x25f8, PIN_INPUT_PULLDOWN | MUX_MODE3)	/* etk_d14.hsusb2_data0 */
			OMAP3630_CORE2_IOPAD(0x25fa, PIN_INPUT_PULLDOWN | MUX_MODE3)	/* etk_d15.hsusb2_data1 */
		>;
	};
/* bench 12654.0.0 673ac463f30b */
/* bench 12654.0.1 c1286bc0bbf2 */
/* bench 12654.0.2 99623e823915 */
/* bench 12654.0.3 b249c57ddf0c */
/* bench 8023.1.0 b6f0f7d03bae */
/* bench 8023.1.1 7ea0d5af934e */
/* bench 8023.1.2 8081ddf85bf5 */
/* bench 8023.1.3 229b10c6d06d */
/* bench 8023.1.4 6c69641efe6b */
/* bench 8023.1.5 af9c097eefaf */
/* bench 8023.1.6 654754b7f810 */
/* bench 8023.1.7 33ef32e81736 */
	};
};

/* bench 3895.0.0 e77ab7155df3 */
/* bench 3895.0.1 54b83fee6017 */
/* bench 3895.0.2 e0436d349f5d */
/* bench 3895.0.3 ec5a776eced4 */
/* bench 3895.0.4 99ea822e605a */
/* bench 3895.0.5 574364beb817 */
/* bench 3895.0.6 c6a63ee1dc00 */
/* bench 3895.0.7 eaf24e4efb6c */
/* bench 3895.0.8 96ae6c3eebd7 */
/* bench 3895.0.9 43c968881c83 */
/* bench 3895.0.10 35da0acf8e12 */
