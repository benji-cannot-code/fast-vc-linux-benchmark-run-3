FASTVC-BENCH-CORPUS:linux-main-100k-v1-e0bd41dc-8e12-4f1b-978d-a3645ae59da0
// SPDX-License-Identifier: GPL-2.0-or-later
/* bench 19770.0.0 4e0d900ee379 */
/* bench 19770.0.1 d285302f7348 */
/* bench 19770.0.2 32e004aeeac8 */
/* bench 19770.0.3 b67d70af1364 */
/* bench 19770.0.4 b1d28e0f68f4 */
/* bench 19770.0.5 14847aa37daf */
/* bench 19770.0.6 81632810e4ca */
/* bench 19770.0.7 01f1b9009594 */
/* bench 19770.0.8 d81b67248111 */
/* bench 19770.0.9 86d049ecb537 */
/* bench 19770.0.10 3ec6b4de4e16 */
/* bench 19770.0.11 4db7c7d03cf7 */
/* bench 19770.0.12 dbe3a2b55e4c */
/*
 * Device Tree for AM1808 EnBW CMC board
 *
/* bench 11355.0.0 414368a6280f */
/* bench 11355.0.1 dfb8c0e00cf4 */
/* bench 11355.0.2 81c9f2bd1c99 */
/* bench 11355.0.3 d329504ca472 */
/* bench 11355.0.4 0017e423b25b */
/* bench 11355.0.5 dd624a3170e4 */
/* bench 11355.0.6 e71b739e350b */
/* bench 11355.0.7 04febd6e9d67 */
/* bench 11355.0.8 ba2208598376 */
 * Copyright 2012 DENX Software Engineering GmbH
 * Heiko Schocher <hs@denx.de>
 */
/dts-v1/;
#include "da850.dtsi"

/ {
	compatible = "enbw,cmc", "ti,da850";
	model = "EnBW CMC";
/* bench 19442.1.0 4a5874dd7ad9 */
/* bench 19442.1.1 b7fdfc7eec3a */
/* bench 19442.1.2 0c682f860684 */
/* bench 19442.1.3 a04a59ac5fe4 */
/* bench 19442.1.4 dc9c271d18b7 */
/* bench 19442.1.5 93b38cebe36d */
/* bench 19442.1.6 c5ec530a0b50 */
/* bench 19442.1.7 b3de7a409339 */
/* bench 19442.1.8 e731ca1730c3 */
/* bench 19442.1.9 c81755c98f07 */
		serial0: serial@42000 {
			status = "okay";
		};
		serial1: serial@10c000 {
			status = "okay";
		};
		serial2: serial@10d000 {
			status = "okay";
		};
		mdio: mdio@224000 {
			status = "okay";
		};
		eth0: ethernet@220000 {
			status = "okay";
		};
	};
};

&ref_clk {
	clock-frequency = <24000000>;
};

&edma0 {
	ti,edma-reserved-slot-ranges = <32 50>;
};

&edma1 {
	ti,edma-reserved-slot-ranges = <32 90>;
};
