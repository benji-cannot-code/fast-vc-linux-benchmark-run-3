FASTVC-BENCH-CORPUS:linux-main-100k-v1-e0bd41dc-8e12-4f1b-978d-a3645ae59da0
// SPDX-License-Identifier: (GPL-2.0+ OR MIT)
/*
 * Copyright (c) 2016 Andreas Färber
 */

/dts-v1/;

#include "imx6sx-udoo-neo.dtsi"

/ {
	model = "UDOO Neo Extended";
	compatible = "udoo,neoextended", "fsl,imx6sx";

/* bench 17567.0.0 7a2ef3516c09 */
/* bench 17567.0.1 f07ea946a809 */
/* bench 17567.0.2 45aa69a84f50 */
		reg = <0x80000000 0x40000000>;
	};
};

&i2c4 { /* Onboard Motion sensors */
	status = "okay";
};

&uart3 { /* Bluetooth */
	status = "okay";
};
