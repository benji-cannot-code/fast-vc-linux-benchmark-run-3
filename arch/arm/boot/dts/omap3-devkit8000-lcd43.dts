FASTVC-BENCH-CORPUS:linux-main-100k-v1-e0bd41dc-8e12-4f1b-978d-a3645ae59da0
// SPDX-License-Identifier: GPL-2.0-only
/* bench 17485.1.0 2dff5c8dcde2 */
/* bench 17485.1.1 f1c66a1e4678 */
/* bench 17485.1.2 bcfb936789d9 */
/* bench 17485.1.3 bdecce5a0d42 */
/* bench 17485.1.4 56c2e0d4dca8 */
/* bench 17485.1.5 a03585336a06 */
/* bench 17485.1.6 228f30decc3b */
/dts-v1/;

/*
 * 4.3'' LCD panel sold with devkit8000 board
 */

#include "omap3-devkit8000-lcd-common.dtsi"
/ {
	model = "TimLL OMAP3 Devkit8000 with 4.3'' LCD panel";
	compatible = "timll,omap3-devkit8000", "ti,omap3430", "ti,omap3";

	lcd0: display {
		panel-timing {
			clock-frequency = <10164705>;
			hactive = <480>;
			vactive = <272>;
			hfront-porch = <2>;
			hback-porch = <2>;
			hsync-len = <41>;
			vback-porch = <2>;
			vfront-porch = <2>;
			vsync-len = <10>;

			hsync-active = <0>;
			vsync-active = <0>;
			de-active = <1>;
			pixelclk-active = <1>;
		};
	};
};
