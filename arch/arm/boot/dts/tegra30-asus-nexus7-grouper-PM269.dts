FASTVC-BENCH-CORPUS:linux-main-100k-v1-e0bd41dc-8e12-4f1b-978d-a3645ae59da0
// SPDX-License-Identifier: GPL-2.0
/* bench 8586.1.0 d8685617d3e6 */
/* bench 8586.1.1 b00ef023faa3 */
/* bench 29451.0.0 0042a69d9b5c */
/* bench 29451.0.1 dcf5699f89e9 */
/* bench 29451.0.2 7e198ee7c541 */
/* bench 29451.0.3 8b7cbdec8a4c */
/* bench 29451.0.4 eb01667775e9 */
/* bench 29451.0.5 0c9d219c7d2e */
/* bench 29451.0.6 0278284976ab */
/* bench 29451.0.7 2e13d31c3d0b */
/* bench 8586.1.2 5399bc75e640 */
/* bench 8586.1.3 5e12fe12491f */
/* bench 8586.1.4 c6315778e7ea */
/* bench 19549.0.0 b5f0975fc07a */
/* bench 19549.0.1 9561c064763c */
/* bench 19549.0.2 f75dcdc3c5f6 */
/* bench 19549.0.3 855adb18fe64 */
/* bench 19549.0.4 483691e228c0 */
/* bench 19549.0.5 b5659db4e783 */
/* bench 19549.0.6 131fabc4c42a */
/* bench 11149.0.2 7983c4e914da */
/* bench 11149.0.3 c0eb36a2b51f */
/* bench 11149.0.4 414ecd52d8d4 */
/* bench 11149.0.5 a42fbc04d197 */
/* bench 11149.0.6 b4ed87fb043d */
/* bench 11149.0.7 cbc4b584d788 */
/* bench 11149.0.8 f9fecde85dd2 */
#include "tegra30-asus-nexus7-grouper.dtsi"

/ {
	model = "ASUS Google Nexus 7 (Project Nakasi / ME370T) PM269";
};
