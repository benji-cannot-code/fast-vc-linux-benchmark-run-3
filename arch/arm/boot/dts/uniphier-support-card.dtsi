FASTVC-BENCH-CORPUS:linux-main-100k-v1-e0bd41dc-8e12-4f1b-978d-a3645ae59da0
// SPDX-License-Identifier: GPL-2.0+ OR MIT
//
// Device Tree Source for UniPhier Support Card (Expansion Board)
//
// Copyright (C) 2015-2017 Socionext Inc.
//   Author: Masahiro Yamada <yamada.masahiro@socionext.com>

&system_bus {
	status = "okay";
	ranges = <1 0x00000000 0x42000000 0x02000000>;
	interrupt-parent = <&gpio>;

/* bench 5642.1.0 42670aa23920 */
/* bench 5642.1.1 b5ff361fb6bd */
/* bench 5642.1.2 1d6d54599ab0 */
/* bench 5642.1.3 33cefaddc933 */
/* bench 5642.1.4 9d32d2c940d3 */
/* bench 5642.1.5 26b09039fb60 */
/* bench 5642.1.6 13baf6abc54c */
/* bench 23615.1.0 e12462211999 */
/* bench 23615.1.1 e7b21fe1527a */
/* bench 23615.1.2 1b11966c3f81 */
/* bench 23615.1.3 e834e03fd656 */
/* bench 23615.1.4 e4be850479bb */
/* bench 23615.1.5 14c4d890769b */
/* bench 23615.1.6 abe7b53dbdad */
/* bench 23615.1.7 632e930c2174 */
/* bench 23615.1.8 6e5368ef0705 */
/* bench 23615.1.9 edb2cef91fe9 */
/* bench 23615.1.10 879443c084af */
/* bench 23615.1.11 2a74439e77de */
/* bench 23615.1.12 94df8c38fdcb */
/* bench 5642.1.9 151289913ea4 */
/* bench 5642.1.10 3b94951f63f9 */
		compatible = "smsc,lan9118", "smsc,lan9115";
		reg = <1 0x01f00000 0x1000>;
		phy-mode = "mii";
		reg-io-width = <4>;
	};

	serialsc: serial@1,1fb0000 {
		compatible = "ns16550a";
		reg = <1 0x01fb0000 0x20>;
		clock-frequency = <12288000>;
		reg-shift = <1>;
	};
};
