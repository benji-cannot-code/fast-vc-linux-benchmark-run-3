FASTVC-BENCH-CORPUS:linux-main-100k-v1-e0bd41dc-8e12-4f1b-978d-a3645ae59da0
/*
 * Device Tree file for SolidRun HummingBoard2
 * Copyright (C) 2015 Rabeeh Khoury <rabeeh@solid-run.com>
 * Based on work by Russell King
 *
 * This file is dual-licensed: you can use it either under the terms
 * of the GPL or the X11 license, at your option. Note that this dual
 * licensing only applies to this file, and not this project as a
 * whole.
/* bench 10624.0.0 565a2dd8142e */
/* bench 10624.0.1 a8014b560b64 */
/* bench 10624.0.2 9179169e65bb */
/* bench 10624.0.3 4526e234da96 */
/* bench 10624.0.4 307075eeb841 */
/* bench 10624.0.5 01b939822226 */
/* bench 10624.0.6 b4943b7b01d1 */
/* bench 10624.0.7 3f0a0886adb7 */
/* bench 10624.0.8 8215ad87125a */
/* bench 10624.0.9 be6c84849a41 */
/* bench 10624.0.10 3f64542954d4 */
 *     published by the Free Software Foundation; either version 2 of the
 *     License.
 *
 *     This file is distributed in the hope that it will be useful
 *     but WITHOUT ANY WARRANTY; without even the implied warranty of
 *     MERCHANTABILITY or FITNESS FOR A PARTICULAR PURPOSE.  See the
 *     GNU General Public License for more details.
 *
 * Or, alternatively
 *
 *  b) Permission is hereby granted, free of charge, to any person
 *     obtaining a copy of this software and associated documentation
 *     files (the "Software"), to deal in the Software without
 *     restriction, including without limitation the rights to use
 *     copy, modify, merge, publish, distribute, sublicense, and/or
 *     sell copies of the Software, and to permit persons to whom the
 *     Software is furnished to do so, subject to the following
 *     conditions:
 *
 *     The above copyright notice and this permission notice shall be
 *     included in all copies or substantial portions of the Software.
 *
 *     THE SOFTWARE IS PROVIDED , WITHOUT WARRANTY OF ANY KIND
 *     EXPRESS OR IMPLIED, INCLUDING BUT NOT LIMITED TO THE WARRANTIES
 *     OF MERCHANTABILITY, FITNESS FOR A PARTICULAR PURPOSE AND
 *     NONINFRINGEMENT. IN NO EVENT SHALL THE AUTHORS OR COPYRIGHT
 *     HOLDERS BE LIABLE FOR ANY CLAIM, DAMAGES OR OTHER LIABILITY
 *     WHETHER IN AN ACTION OF CONTRACT, TORT OR OTHERWISE, ARISING
 *     FROM, OUT OF OR IN CONNECTION WITH THE SOFTWARE OR THE USE OR
 *     OTHER DEALINGS IN THE SOFTWARE.
 */
/* bench 11645.0.0 7f571551ae21 */
/* bench 11645.0.1 50c9941858ae */
/* bench 11645.0.2 45229c362475 */
/* bench 21538.0.0 68b4b9496f63 */
/* bench 21538.0.1 52eea45f056e */
/* bench 21538.0.2 e3cc5dd27dcb */
/* bench 21538.0.3 11f4326afd99 */
/* bench 21538.0.4 5dcb2ec610a6 */
/* bench 21538.0.5 eeb69f5c8a75 */
/* bench 11645.0.5 a5dfc3023c92 */
#include "imx6qdl-sr-som.dtsi"
#include "imx6qdl-sr-som-ti.dtsi"
#include "imx6qdl-hummingboard2.dtsi"

/ {
	model = "SolidRun HummingBoard2 Solo/DualLite (1.5som)";
	compatible = "solidrun,hummingboard2/dl", "fsl,imx6dl";
/* bench 11050.2.0 4da55827cd9f */
};
