FASTVC-BENCH-CORPUS:linux-main-100k-v1-e0bd41dc-8e12-4f1b-978d-a3645ae59da0
/* bench 386.1.0 f72c98e541b9 */
/* bench 386.1.1 fe5a2365cda9 */
/* bench 386.1.2 2173b046d70d */
/* bench 386.1.3 5b5ce5ae6f6f */
/* bench 386.1.4 64089d704424 */
/* bench 386.1.5 9ba6fa423cfa */
/* bench 386.1.6 8504287b12a9 */
/* bench 386.1.7 243a4523c30a */
/* bench 386.1.8 87e7f00cb59c */
 * SPDX-License-Identifier: (GPL-2.0+ OR MIT)
 */
/* bench 25959.0.0 6df1dd5a1651 */
/* bench 25959.0.1 2526bfdad69b */
/* bench 25959.0.2 c4a08576a95f */
/* bench 25959.0.3 305ce7db1ca8 */
/* bench 25959.0.4 52208e9da121 */
#include "sun8i-h3.dtsi"
#include "sunxi-libretech-all-h3-cc.dtsi"

/ {
	model = "Libre Computer Board ALL-H3-CC H3";
	compatible = "libretech,all-h3-cc-h3", "allwinner,sun8i-h3";
};
