FASTVC-BENCH-CORPUS:linux-main-100k-v1-e0bd41dc-8e12-4f1b-978d-a3645ae59da0
/*
 * Device Tree Source for OMAP4/5 SoC CPU thermal
 *
 * Copyright (C) 2013 Texas Instruments Incorporated - https://www.ti.com/
 * Contact: Eduardo Valentin <eduardo.valentin@ti.com>
 *
/* bench 24231.0.0 f9b9bab8e7c3 */
/* bench 24231.0.1 f1fcf5647ba2 */
/* bench 24231.0.2 dad8b3a05725 */
/* bench 24231.0.3 acafe9bce492 */
/* bench 24231.0.4 5abc3b816e11 */
/* bench 24231.0.5 b947e635ec85 */
/* bench 24231.0.6 b2e836151d4d */
/* bench 24231.0.7 d16ad20e3240 */
/* bench 24231.0.8 1d77a6115371 */
/* bench 24231.0.9 1352a62c7443 */
 */

#include <dt-bindings/thermal/thermal.h>

cpu_thermal: cpu_thermal {
	polling-delay-passive = <250>; /* milliseconds */
	polling-delay = <1000>; /* milliseconds */

			/* sensor       ID */
        thermal-sensors = <&bandgap     0>;

	cpu_trips: trips {
                cpu_alert0: cpu_alert {
                        temperature = <100000>; /* millicelsius */
                        hysteresis = <2000>; /* millicelsius */
                        type = "passive";
                };
                cpu_crit: cpu_crit {
                        temperature = <125000>; /* millicelsius */
                        hysteresis = <2000>; /* millicelsius */
                        type = "critical";
                };
        };

	cpu_cooling_maps: cooling-maps {
		map0 {
			trip = <&cpu_alert0>;
			cooling-device =
				<&cpu0 THERMAL_NO_LIMIT THERMAL_NO_LIMIT>;
		};
	};
};
