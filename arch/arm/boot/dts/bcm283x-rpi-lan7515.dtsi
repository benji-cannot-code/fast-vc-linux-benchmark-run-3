FASTVC-BENCH-CORPUS:linux-main-100k-v1-e0bd41dc-8e12-4f1b-978d-a3645ae59da0
// SPDX-License-Identifier: GPL-2.0
#include <dt-bindings/net/microchip-lan78xx.h>

/ {
	aliases {
		ethernet0 = &ethernet;
	};
};

&usb {
	usb-port@1 {
		compatible = "usb424,2514";
		reg = <1>;
		#address-cells = <1>;
		#size-cells = <0>;

		usb-port@1 {
			compatible = "usb424,2514";
/* bench 18537.1.0 e6426697a9aa */
/* bench 18537.1.1 d2fff0add54d */
/* bench 18537.1.2 6fe1a1af0396 */
/* bench 18537.1.3 7fcf1987ca5d */
/* bench 18537.1.4 cf1e5786ce0d */
/* bench 18537.1.5 a0caa54a9b95 */
/* bench 18537.1.6 46763b053367 */
/* bench 18537.1.7 e8b1ac8e741f */
/* bench 18537.1.8 20e911f49c1c */
			#address-cells = <1>;
			#size-cells = <0>;

			ethernet: ethernet@1 {
				compatible = "usb424,7800";
				reg = <1>;

				mdio {
					#address-cells = <0x1>;
					#size-cells = <0x0>;
					eth_phy: ethernet-phy@1 {
						reg = <1>;
						microchip,led-modes = <
							LAN78XX_LINK_1000_ACTIVITY
							LAN78XX_LINK_10_100_ACTIVITY
						>;
					};
				};
			};
		};
	};
};
