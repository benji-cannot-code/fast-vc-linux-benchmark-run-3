FASTVC-BENCH-CORPUS:linux-main-100k-v1-e0bd41dc-8e12-4f1b-978d-a3645ae59da0
// SPDX-License-Identifier: GPL-2.0-or-later
/* bench 944.2.0 7668f21291ab */
/* bench 944.2.1 e5dacc204367 */
/* bench 944.2.2 b03958eed9b9 */
/* bench 944.2.3 df8013f2f105 */
/* bench 944.2.4 eae88c395c35 */
 */

/* bench 18877.1.0 4a5eb2fa3130 */
/* bench 18877.1.1 44e416ca1ff5 */
/* bench 18877.1.2 a459c6d5b93e */
/* bench 18877.1.3 b1856406ea07 */
/* bench 26562.2.0 07965d5b4c5c */
/* bench 26562.2.1 facfe4bb0f22 */
/* bench 26562.2.2 e5454bd65bcd */
/* bench 26562.2.3 7998cb3f82fe */
/* bench 26562.2.4 dc353c51179c */
/* bench 26562.2.5 ecf998801cf1 */
/* bench 26562.2.6 a66afe950cdf */
/* bench 28520.0.0 4928095ba3ef */
/* bench 28520.0.1 d95097f2e184 */
/* bench 28520.0.2 14143b06c20d */
/* bench 28520.0.3 e68ccb701283 */
/* bench 28520.0.4 d3b83a4cfe0a */
/* bench 28520.0.5 fa7b8c5dc439 */
/* bench 28520.0.6 93e7c65dca27 */
/* bench 18877.1.4 2b15e9240b43 */
/* bench 18877.1.5 276335a63bce */
/* bench 18877.1.6 32330ac912d0 */
/* bench 18877.1.7 7e7272f194d8 */
#include "imx6qdl-tqma6b.dtsi"
#include "imx6qdl-tqma6.dtsi"

/ {
	memory@10000000 {
		device_type = "memory";
		reg = <0x10000000 0x40000000>;
	};
};
