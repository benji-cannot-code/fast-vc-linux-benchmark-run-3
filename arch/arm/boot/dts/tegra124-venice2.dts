FASTVC-BENCH-CORPUS:linux-main-100k-v1-e0bd41dc-8e12-4f1b-978d-a3645ae59da0
/dts-v1/;

#include "tegra124.dtsi"

/ {
	model = "NVIDIA Tegra124 Venice2";
	compatible = "nvidia,venice2", "nvidia,tegra124";

	memory {
		reg = <0x80000000 0x80000000>;
	};

	serial@70006000 {
		status = "okay";
	};

	pmc@7000e400 {
		nvidia,invert-interrupt;
	};
};
