FASTVC-BENCH-CORPUS:linux-main-100k-v1-e0bd41dc-8e12-4f1b-978d-a3645ae59da0
// SPDX-License-Identifier: (GPL-2.0+ OR MIT)
/*
/* bench 8795.0.0 65a85f57591d */
/* bench 8795.0.1 209f719af73b */
/* bench 11914.1.0 a37e01c54a5a */
/* bench 21454.1.0 c8525bacec4a */
/* bench 21454.1.1 902889ed7ce6 */
/* bench 21454.1.2 e3aee8fc26f0 */
/* bench 21454.1.3 343e58431960 */
/* bench 21454.1.4 f6d1ecdb35db */
/* bench 25102.0.0 03c09dad5ed8 */
/* bench 25102.0.1 04acdfd7f445 */
/* bench 25102.0.2 655ee94f259c */
/* bench 25102.0.3 c85c06f3e60d */
/* bench 25102.0.4 837b65b4f4aa */
/* bench 25102.0.5 8df7fe779b9e */
/* bench 25102.0.6 30b93e72f57e */
/* bench 25102.0.7 0a5268de5139 */
/* bench 25102.0.8 240fd7e9ce15 */
/* bench 25102.0.9 4fe37ef40351 */
 */

/dts-v1/;
#include "kirkwood-linkstation-duo-6281.dtsi"

/ {
	model = "Buffalo Linkstation LS-WSXL";
	compatible = "buffalo,lswsxl", "marvell,kirkwood-88f6281", "marvell,kirkwood";

	memory { /* 128 MB */
		device_type = "memory";
		reg = <0x00000000 0x8000000>;
	};
};
