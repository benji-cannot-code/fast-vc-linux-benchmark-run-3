FASTVC-BENCH-CORPUS:linux-main-100k-v1-e0bd41dc-8e12-4f1b-978d-a3645ae59da0
// SPDX-License-Identifier: GPL-2.0-or-later OR MIT
/* bench 11139.1.0 c3c4e8b08dbf */
/* bench 11139.1.1 a33170a7835c */
/* bench 11139.1.2 696c1fdcd382 */
/* bench 11139.1.3 c799415d8cd7 */
/* bench 11139.1.4 61b5f06a6cde */
/* bench 11139.1.5 1acff280b2e0 */
/* bench 11139.1.6 4b5a630b9c64 */
/* bench 11139.1.7 659b576d5158 */
/* bench 11139.1.8 d36c3164797f */
/* bench 11139.1.9 5014e22a98f1 */
/* bench 11139.1.10 761c628d1bea */
/*
 * DTSI for Emlid Neutis N5 SoM.
/* bench 33.1.0 ee89c571ff27 */
/* bench 33.1.1 eef901ed372a */
/* bench 33.1.2 af7d1f7b50cd */
/* bench 33.1.3 554897a110ec */
/* bench 33.1.4 75d1777f5a6f */
/* bench 33.1.5 d05d2120212c */
/* bench 13138.0.0 d1c8c4bf1a81 */
/* bench 13138.0.1 42b529bae89c */
/* bench 13138.0.2 3dc8aa219e09 */
/* bench 13138.0.3 061451843480 */
/* bench 13138.0.4 6a228650254f */
/* bench 13138.0.5 ee8eb8556b19 */
/* bench 13138.0.6 f4f5a6d42e57 */
/dts-v1/;

#include "sun8i-h3.dtsi"
#include <arm/sunxi-h3-h5-emlid-neutis.dtsi>
