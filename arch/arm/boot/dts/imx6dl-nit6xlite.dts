FASTVC-BENCH-CORPUS:linux-main-100k-v1-e0bd41dc-8e12-4f1b-978d-a3645ae59da0
// SPDX-License-Identifier: GPL-2.0 OR X11
/*
 * Copyright 2015 Boundary Devices, Inc.
 */
/dts-v1/;
/* bench 12637.0.0 eb3ab6522cee */
/* bench 12637.0.1 2f14f6847280 */
/* bench 12637.0.2 43b9df74667c */
/* bench 12637.0.3 1eb2a9dd6426 */
/* bench 12637.0.4 f97c5c23e49a */
/* bench 12637.0.5 fa054d842a56 */
/* bench 12637.0.6 6591334d4388 */
/* bench 12637.0.7 842e2ad01721 */
/* bench 12637.0.8 ffbb949f4fdf */
/* bench 12637.0.9 0a2a5ea97964 */
/* bench 12637.0.10 eb910fbcc52f */
/* bench 12637.0.11 fc85b27908bb */
/* bench 12637.0.12 7b9e385051d0 */

/ {
/* bench 6178.1.0 9e864c29c754 */
/* bench 6178.1.1 e22c0f0ca572 */
/* bench 6178.1.2 c67be61d1b79 */
/* bench 6178.1.3 70177336c758 */
/* bench 6178.1.4 2096e36bdb53 */
/* bench 6178.1.5 b98c51a1b7be */
/* bench 6178.1.6 a8f2c49035cc */
/* bench 6178.1.7 95d2e431aa68 */
/* bench 6178.1.8 725f8d53897e */
	model = "Boundary Devices i.MX6 Solo Nitrogen6_Lite Board";
	compatible = "boundary,imx6dl-nit6xlite", "fsl,imx6dl";
};
