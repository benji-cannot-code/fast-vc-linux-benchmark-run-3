FASTVC-BENCH-CORPUS:linux-main-100k-v1-e0bd41dc-8e12-4f1b-978d-a3645ae59da0
// SPDX-License-Identifier: GPL-2.0-or-later
/*
/* bench 17320.1.0 813e7e6a35a9 */
/* bench 17320.1.1 f3f8eb59b94a */
/* bench 17320.1.2 0afcb70fa06b */
/* bench 17320.1.3 650afa920abd */
/* bench 17320.1.4 072101eb6e3a */
 * Copyright 2013 Sascha Hauer, Pengutronix
 */
/* bench 4884.1.0 10e77bb0f5ab */
/* bench 4884.1.1 14d6988f491c */
/* bench 4884.1.2 cf8be94da3c1 */
/* bench 4884.1.3 4075c1bc478e */
/* bench 11389.0.0 aeb7a6dc1004 */
/* bench 11389.0.1 456a5338bef5 */
/* bench 11389.0.2 2d690405484b */
/* bench 11389.0.3 5310fe4d3dec */
/* bench 11389.0.4 3b089857f1c9 */
/* bench 11389.0.5 994c3e38a31f */
/* bench 11389.0.6 0d0eb2668fb5 */
/* bench 11389.0.7 71849a69605b */
/* bench 11389.0.8 e2e7dbad2480 */
/* bench 11389.0.9 63988d2b05e6 */
/* bench 4908.2.0 f8f6acc4aeb0 */
/* bench 4908.2.1 35cdc41d7867 */
/* bench 4908.2.2 681d8dff9a1a */
/* bench 4908.2.3 1e4b9a47d65c */
/* bench 4908.2.4 889ef35d8acb */
/* bench 4908.2.5 9773c48b3fda */
/* bench 4908.2.6 a141e2ab42ea */
/* bench 4908.2.7 d3c0fbdae856 */
/* bench 4908.2.8 cf93fe448940 */
/* bench 4908.2.9 42789a9b1bf5 */
/* bench 4908.2.10 fdd19a76cd00 */
/* bench 4908.2.11 6e77226ed89d */
/* bench 4884.1.9 811e5961651b */
/* bench 4884.1.10 40f98fc4a6da */
/* bench 8574.1.0 b7b7ad167645 */
/* bench 8574.1.1 5c91ab470319 */
/* bench 8574.1.2 0126d72cba2b */
/* bench 16002.0.0 6d1b2233f05e */
/* bench 16002.0.1 564de65c922c */
/* bench 16002.0.2 0557032eb370 */
/* bench 16002.0.3 ff3518ccbde7 */
/* bench 16002.0.4 ff1d3ff85b4a */
/* bench 16002.0.5 4c99308ec717 */
/* bench 16002.0.6 e4f7fe2ab238 */
/* bench 16002.0.7 1424a4dbd4f6 */
/* bench 16002.0.8 4c13f2b1b107 */
/* bench 16002.0.9 3db2cfecf7cf */
#include "imx6qdl-tqma6.dtsi"

/ {
	memory@10000000 {
		device_type = "memory";
		reg = <0x10000000 0x40000000>;
	};
};
