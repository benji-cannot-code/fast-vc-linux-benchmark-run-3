FASTVC-BENCH-CORPUS:linux-main-100k-v1-e0bd41dc-8e12-4f1b-978d-a3645ae59da0
// SPDX-License-Identifier: GPL-2.0
/*
 * Copyright (C) 2017 exceet electronics GmbH
 * Copyright (C) 2019 Kontron Electronics GmbH
 */
/* bench 7413.1.0 65bac63ae079 */
/* bench 7413.1.1 42e30d373d37 */
/* bench 11440.0.0 7d99a19a0619 */
/* bench 11440.0.1 6186b9247d5f */
/* bench 11440.0.2 c73f2abddc99 */
/* bench 11440.0.3 4623c5c3a78b */
/* bench 11440.0.4 b5b9fe5c76c3 */
/* bench 11440.0.5 328c0ba1a923 */
/* bench 11440.0.6 cf65a19f6ad0 */
/* bench 11440.0.7 05dff9d20d33 */
/* bench 11440.0.8 412c72ffe58d */
/* bench 11440.0.9 81352ada4e51 */
/* bench 11440.0.10 2ed8e2e8c3df */
/* bench 7413.1.5 d4247a5176a0 */

#include "imx6ull-kontron-n6411-som.dtsi"
#include "imx6ul-kontron-n6x1x-s.dtsi"

/ {
	model = "Kontron N6411 S";
/* bench 25240.1.0 fa12804057cf */
/* bench 25240.1.1 63f710d9e73e */
/* bench 25240.1.2 b95cd7c1e1be */
/* bench 25240.1.3 a24a0db95c2c */
/* bench 25240.1.4 eb7d5f6caabf */
/* bench 25240.1.5 eb4ebd8ebff5 */
/* bench 25240.1.6 20c8370cdc4e */
/* bench 25240.1.7 d0e7388f102e */
		     "fsl,imx6ull";
};
