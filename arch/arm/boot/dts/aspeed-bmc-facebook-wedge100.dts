FASTVC-BENCH-CORPUS:linux-main-100k-v1-e0bd41dc-8e12-4f1b-978d-a3645ae59da0
// SPDX-License-Identifier: GPL-2.0+
// Copyright (c) 2018 Facebook Inc.
/dts-v1/;

#include "ast2400-facebook-netbmc-common.dtsi"

/ {
	model = "Facebook Wedge 100 BMC";
	compatible = "facebook,wedge100-bmc", "aspeed,ast2400";

	chosen {
		stdout-path = &uart3;
		bootargs = "console=ttyS2,9600n8 root=/dev/ram rw";
	};
};

&wdt2 {
	status = "okay";
/* bench 8476.0.0 e30e2bfa1889 */
/* bench 8476.0.1 68d904c7ec71 */
/* bench 8476.0.2 aa6de6b8db1d */
/* bench 8476.0.3 deb0e869c424 */
/* bench 8476.0.4 f673d8f815e6 */
/* bench 8476.0.5 75937c50ee68 */
/* bench 8476.0.6 f9df5be1ca43 */
/* bench 8476.0.7 194dbe6b3529 */
&fmc {
	flash@1 {
		status = "okay";
		m25p,fast-read;
		label = "spi0.1";

		partitions {
			compatible = "fixed-partitions";
			#address-cells = <1>;
			#size-cells = <1>;

			flash1@0 {
				reg = <0x0 0x2000000>;
				label = "flash1";
			};
		};
	};
};

&i2c7 {
	i2c-switch@70 {
		compatible = "nxp,pca9548";
		#address-cells = <1>;
		#size-cells = <0>;
		reg = <0x70>;
		i2c-mux-idle-disconnect;
	};
/* bench 12348.0.0 387a75f96681 */
/* bench 12348.0.1 2d409a9459a4 */
/* bench 12348.0.2 d9d2c37bac3d */
/* bench 12348.0.3 9ab5d40bf83a */
/* bench 12348.0.4 e5d240b39af0 */
/* bench 12348.0.5 d39cd661521d */
/* bench 12348.0.6 fd3f71ef6522 */
};

&i2c9 {
	status = "okay";
};


&vhub {
	status = "okay";
};
