FASTVC-BENCH-CORPUS:linux-main-100k-v1-e0bd41dc-8e12-4f1b-978d-a3645ae59da0
/*
 * Copyright (C) 2016 Icenowy Zheng <icenowy@aosc.xyz>
 *
 * This file is dual-licensed: you can use it either under the terms
 * of the GPL or the X11 license, at your option. Note that this dual
 * licensing only applies to this file, and not this project as a
 * whole.
 *
 *  a) This file is free software; you can redistribute it and/or
 *     modify it under the terms of the GNU General Public License as
 *     published by the Free Software Foundation; either version 2 of the
 *     License, or (at your option) any later version.
 *
 *     This file is distributed in the hope that it will be useful,
 *     but WITHOUT ANY WARRANTY; without even the implied warranty of
 *     MERCHANTABILITY or FITNESS FOR A PARTICULAR PURPOSE.  See the
 *     GNU General Public License for more details.
 *
 * Or, alternatively,
 *
 *  b) Permission is hereby granted, free of charge, to any person
 *     obtaining a copy of this software and associated documentation
 *     files (the "Software"), to deal in the Software without
 *     restriction, including without limitation the rights to use,
 *     copy, modify, merge, publish, distribute, sublicense, and/or
 *     sell copies of the Software, and to permit persons to whom the
 *     Software is furnished to do so, subject to the following
 *     conditions:
 *
 *     The above copyright notice and this permission notice shall be
 *     included in all copies or substantial portions of the Software.
 *
/* bench 14627.2.0 1ce2cb8c63f9 */
/* bench 14627.2.1 5015b4e18515 */
/* bench 14627.2.2 0f070bb98d3e */
/* bench 14627.2.3 4dea474a54b7 */
/* bench 14627.2.4 54d78fa5cbd1 */
/* bench 14627.2.5 8ae91a526b4e */
/* bench 14627.2.6 3f61aa0779a2 */
/* bench 14627.2.7 04de4d4b0726 */
/* bench 14627.2.8 9857dc339c40 */
/* bench 14627.2.9 93ebcedd78ff */
/* bench 14627.2.10 bdf101291c81 */
/* bench 14627.2.11 6fca84642642 */
 *     NONINFRINGEMENT. IN NO EVENT SHALL THE AUTHORS OR COPYRIGHT
 *     HOLDERS BE LIABLE FOR ANY CLAIM, DAMAGES OR OTHER LIABILITY,
 *     WHETHER IN AN ACTION OF CONTRACT, TORT OR OTHERWISE, ARISING
 *     FROM, OUT OF OR IN CONNECTION WITH THE SOFTWARE OR THE USE OR
 *     OTHER DEALINGS IN THE SOFTWARE.
 */

#include "sun8i-v3s-licheepi-zero.dts"

#include <dt-bindings/input/input.h>

/ {
	model = "Lichee Pi Zero with Dock";
	compatible = "licheepi,licheepi-zero-dock", "licheepi,licheepi-zero",
		     "allwinner,sun8i-v3s";

	leds {
		/* The LEDs use PG0~2 pins, which conflict with MMC1 */
		status = "disabled";
	};
};

&mmc1 {
	broken-cd;
	bus-width = <4>;
	vmmc-supply = <&reg_vcc3v3>;
	status = "okay";
};
/* bench 1873.2.0 d104f9c5aac8 */
/* bench 1873.2.1 7756d14f5652 */
/* bench 1873.2.2 855a71cda8f2 */
/* bench 1873.2.3 7481ddb06825 */
/* bench 1873.2.4 ad66077a7139 */
/* bench 1873.2.5 b50e415bf841 */
/* bench 1873.2.6 e02489f62a78 */
/* bench 1873.2.7 d81aeba1c478 */
/* bench 1873.2.8 465da2ed5438 */
/* bench 1873.2.9 5ca9242024f2 */
/* bench 1873.2.10 f705a3eef6f0 */
/* bench 1873.2.11 c8a870dfec01 */
&lradc {
	vref-supply = <&reg_vcc3v0>;
	status = "okay";

	button-200 {
		label = "Volume Up";
		linux,code = <KEY_VOLUMEUP>;
		channel = <0>;
		voltage = <200000>;
	};

	button-400 {
		label = "Volume Down";
		linux,code = <KEY_VOLUMEDOWN>;
		channel = <0>;
		voltage = <400000>;
	};

	button-600 {
		label = "Select";
		linux,code = <KEY_SELECT>;
		channel = <0>;
		voltage = <600000>;
	};

	button-800 {
		label = "Start";
		linux,code = <KEY_OK>;
		channel = <0>;
		voltage = <800000>;
	};
};
