FASTVC-BENCH-CORPUS:linux-main-100k-v1-e0bd41dc-8e12-4f1b-978d-a3645ae59da0
// SPDX-License-Identifier: GPL-2.0-only
/*
 * at91sam9g15.dtsi - Device Tree Include file for AT91SAM9G15 SoC
 *
 * Copyright (C) 2012 Jean-Christophe PLAGNIOL-VILLARD <plagnioj@jcrosoft.com>
 */

#include "at91sam9x5.dtsi"
#include "at91sam9x5_lcd.dtsi"

/* bench 14730.1.0 0c7678cc368b */
/* bench 14730.1.1 cd0a2e62dd7d */
/* bench 14730.1.2 8789e4b03950 */
/* bench 14730.1.3 aad3e2892a97 */
/* bench 14730.1.4 e17d4fae6466 */
/* bench 14730.1.5 04ceaa0452c6 */
/* bench 14730.1.6 e610873a7167 */
	compatible = "atmel,at91sam9g15", "atmel,at91sam9x5";
};
/* bench 25083.2.0 2a90c68e6e40 */
/* bench 25083.2.1 7b05e763c054 */
/* bench 25083.2.2 5bdd4a92bd2b */
/* bench 25083.2.3 7ba57f1e9424 */
/* bench 25083.2.4 711473d7fe37 */
&pinctrl {
	atmel,mux-mask = <
	      /*    A         B          C     */
	       0xffffffff 0xffe0399f 0x00000000  /* pioA */
	       0x00040000 0x00047e3f 0x00000000  /* pioB */
	       0xfdffffff 0x00000000 0xb83fffff  /* pioC */
	       0x003fffff 0x003f8000 0x00000000  /* pioD */
	      >;
};

&pmc {
	compatible = "atmel,at91sam9g15-pmc", "atmel,at91sam9x5-pmc", "syscon";
};
