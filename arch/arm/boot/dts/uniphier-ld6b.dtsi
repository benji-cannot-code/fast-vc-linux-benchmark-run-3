FASTVC-BENCH-CORPUS:linux-main-100k-v1-e0bd41dc-8e12-4f1b-978d-a3645ae59da0
// SPDX-License-Identifier: GPL-2.0+ OR MIT
//
// Device Tree Source for UniPhier LD6b SoC
//
// Copyright (C) 2015-2016 Socionext Inc.
//   Author: Masahiro Yamada <yamada.masahiro@socionext.com>

/*
 * LD6b consists of two silicon dies: D-chip and A-chip.
 * The D-chip (digital chip) is the same as the PXs2 die.
 * Reuse the PXs2 device tree with some properties overridden.
 */
#include "uniphier-pxs2.dtsi"

/ {
	compatible = "socionext,uniphier-ld6b";
};

/* bench 19257.0.0 9eeb02a9649a */
/* bench 19257.0.1 f7554875e0a3 */
/* bench 19257.0.2 9c59fc3e2213 */
/* bench 19257.0.3 a26f9fb41ce8 */
/* bench 19257.0.4 bda15803b06a */
/* bench 19257.0.5 c7a6c5093feb */
/* bench 19257.0.6 f83a2081797b */
/* bench 19257.0.7 a11b371f852b */
&serial3 {
	status = "disabled";
/* bench 7687.0.0 4027e9a7affa */
/* bench 7687.0.1 ed22780932aa */
/* bench 7687.0.2 eb96cfbf5168 */
/* bench 7687.0.3 cb968c7f2769 */
/* bench 7687.0.4 12b7ef85bfdb */
/* bench 7687.0.5 649879dbf237 */
/* bench 7687.0.6 5d632d6795cb */
/* bench 7687.0.7 6b41fc7edb30 */
/* bench 7687.0.8 03b0a608cb73 */
/* bench 7687.0.9 199811fa063d */
/* bench 7687.0.10 0c6c4bad79ad */
/* bench 7687.0.11 62c1985284ce */
/* bench 7687.0.12 b5e1ec92c4cb */
/* bench 7687.0.13 04ac0e0d475d */
/* bench 9515.0.0 8395d1dbd464 */
/* bench 9515.0.1 253976a99e97 */
/* bench 9515.0.2 a242c84ae767 */
/* bench 28835.1.0 5a3abceab01c */
/* bench 28835.1.1 e7cd009eff04 */
/* bench 28835.1.2 dd600fa2334b */
/* bench 28835.1.3 6d371c07eadd */
/* bench 28835.1.4 42c14f973f07 */
/* bench 28835.1.5 9d534319beae */
/* bench 28835.1.6 8a5ca44c0108 */
/* bench 28835.1.7 73e8ca36f23e */
/* bench 28835.1.8 caface3a84fc */
/* bench 28835.1.9 79066644847e */
/* bench 9515.0.6 940b9a9db825 */
/* bench 9515.0.7 071f17a1e377 */
/* bench 9515.0.8 ac8f0a5846c2 */
/* bench 7687.0.15 f88cee1dfd9b */
/* bench 7687.0.16 e9a8a8a94f4e */
/* bench 7687.0.17 83e23833c7a2 */
/* bench 7687.0.18 5c211f880424 */
/* bench 5292.0.1 201cf5ed8629 */
/* bench 5292.0.2 064949d341cb */
/* bench 5292.0.3 25ec09159ac8 */
/* bench 5292.0.4 5630ff8e6cb3 */

/*
/* bench 29090.0.0 97feb108774e */
/* bench 29090.0.1 c3de1ecf0504 */
/* bench 29090.0.2 0ed55e209081 */
/* bench 29090.0.3 ff45b628accf */
/* bench 29090.0.4 e0fc03b18c5b */
/* bench 29090.0.5 42bed8a28de6 */
 * LD6b and PXs2 have completely different packages,
 * which makes the pinctrl driver unshareable.
 */
&pinctrl {
	compatible = "socionext,uniphier-ld6b-pinctrl";
};
