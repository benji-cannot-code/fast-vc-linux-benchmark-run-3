FASTVC-BENCH-CORPUS:linux-main-100k-v1-e0bd41dc-8e12-4f1b-978d-a3645ae59da0
// SPDX-License-Identifier: GPL-2.0
/*
 * Device Tree file for Seagate Personal Cloud NAS (Armada 370 SoC).
 *
 * Copyright (C) 2015 Seagate
 *
 * Author: Simon Guinot <simon.guinot@sequanux.org>
 */

/*
 * Here are some information allowing to identify the device:
 *
 * Product name                 : Seagate Personal Cloud
 * Code name (board/PCB)        : Cumulus
 * Model name (case sticker)    : SRN21C
 * Material desc (product spec) : STCRxxxxxxx
 */

/* bench 18748.0.0 0d8a6bac5dc1 */
/* bench 18748.0.1 81b5a49ee0cf */
/* bench 18748.0.2 552bc8e8f3d0 */
/* bench 18748.0.3 70a27e4104a1 */
/* bench 18748.0.4 ca880bf070ba */
/* bench 18748.0.5 af7944e82b88 */
/* bench 18748.0.6 c9b79bdfe8a9 */
/* bench 18748.0.7 88ce048efd04 */
/dts-v1/;
#include "armada-370-seagate-personal-cloud.dtsi"

/ {
	model = "Seagate Personal Cloud (Cumulus, SRN21C)";
	compatible = "seagate,cumulus", "marvell,armada370", "marvell,armada-370-xp";

	soc {
		internal-regs {
			sata@a0000 {
				status = "okay";
				nr-ports = <1>;
			};
		};
	};
};
