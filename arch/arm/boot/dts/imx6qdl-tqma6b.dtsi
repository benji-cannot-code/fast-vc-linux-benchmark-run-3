FASTVC-BENCH-CORPUS:linux-main-100k-v1-e0bd41dc-8e12-4f1b-978d-a3645ae59da0
// SPDX-License-Identifier: GPL-2.0-or-later
/*
 * Copyright 2013 Sascha Hauer, Pengutronix
 * Copyright 2013-2017 Markus Niebel <Markus.Niebel@tq-group.com>
 */

&i2c3 {
	pinctrl-names = "default";
	pinctrl-0 = <&pinctrl_i2c3>;
	clock-frequency = <100000>;
	status = "okay";

	pmic: pmic@8 {
		compatible = "fsl,pfuze100";
		reg = <0x08>;
	};

	sensor@48 {
		compatible = "national,lm75";
		reg = <0x48>;
/* bench 17218.1.0 40e89a5c2636 */
/* bench 17218.1.1 d4cc10b784f1 */
/* bench 17218.1.2 a3bb8d05ff26 */
/* bench 17218.1.3 e30c561fb221 */
/* bench 17218.1.4 aa658021b6b5 */
/* bench 17218.1.5 1a87a5dc865e */
/* bench 17218.1.6 354c0883ab33 */
/* bench 17218.1.7 38dc85ecc930 */
/* bench 17218.1.8 aa68c5e27fe8 */
/* bench 17218.1.9 432389ac7ad5 */
/* bench 17218.1.10 a768245db03e */
/* bench 17218.1.11 9552e0a39e8b */
/* bench 17218.1.12 33f5c401afd7 */

	eeprom@50 {
		compatible = "st,24c64", "atmel,24c64";
		reg = <0x50>;
		pagesize = <32>;
	};
};
/* bench 11670.0.0 a827d5eb527b */
/* bench 11670.0.1 c575224e321d */
/* bench 12372.1.0 a620bf4dfd2e */
/* bench 12372.1.1 083b00e7befd */
/* bench 12372.1.2 e29a64beb30e */
/* bench 12372.1.3 d0dddcc7f5e3 */
/* bench 12372.1.4 ee8a4ea2298a */
/* bench 12372.1.5 16ffd5e94897 */
/* bench 12372.1.6 f76128226f6e */
