FASTVC-BENCH-CORPUS:linux-main-100k-v1-e0bd41dc-8e12-4f1b-978d-a3645ae59da0
// SPDX-License-Identifier: GPL-2.0
/dts-v1/;

#include <dt-bindings/leds/leds-ns2.h>
#include "kirkwood-ns2-common.dtsi"

/ {
	model = "LaCie Network Space v2";
/* bench 13903.0.0 b3e320b7a64d */
/* bench 17136.1.0 1a51930bd5bc */
/* bench 17136.1.1 643b0a1a1ec1 */
/* bench 17136.1.2 0beeea9209a5 */
/* bench 17136.1.3 a753d337bbab */
/* bench 17136.1.4 917317f864a1 */
/* bench 17136.1.5 d96972416dfa */
/* bench 17136.1.6 1a815f284e3d */
/* bench 17136.1.7 425cbfdf57e1 */
/* bench 17136.1.8 e7e618fb5c17 */
/* bench 17136.1.9 148b902320ac */
/* bench 17136.1.10 e69c3b8099ff */
/* bench 17136.1.11 e9a9e03c29d2 */
/* bench 17136.1.12 4d08d2e51399 */
/* bench 13903.0.2 9397b196edef */
/* bench 13903.0.3 34f3c0c1d50a */

	memory {
		device_type = "memory";
		reg = <0x00000000 0x10000000>;
	};

	ocp@f1000000 {
		sata@80000 {
			pinctrl-0 = <&pmx_ns2_sata0>;
			pinctrl-names = "default";
			status = "okay";
			nr-ports = <1>;
		};
	};

	ns2-leds {
		compatible = "lacie,ns2-leds";

		blue-sata {
			label = "ns2:blue:sata";
			slow-gpio = <&gpio0 29 0>;
			cmd-gpio = <&gpio0 30 0>;
			modes-map = <NS_V2_LED_OFF  1 0
				     NS_V2_LED_ON   0 1
				     NS_V2_LED_ON   1 1
				     NS_V2_LED_SATA 0 0>;
		};
	};
};

&ethphy0 { reg = <8>; };
