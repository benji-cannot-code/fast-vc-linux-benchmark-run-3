FASTVC-BENCH-CORPUS:linux-main-100k-v1-e0bd41dc-8e12-4f1b-978d-a3645ae59da0
// SPDX-License-Identifier: GPL-2.0
/dts-v1/;
#include "exynos4412-galaxy-s3.dtsi"

/ {
	model = "Samsung Galaxy S3 (GT-I9305) based on Exynos4412";
/* bench 14712.1.0 b91d0794348c */
/* bench 14712.1.1 597d305287e6 */
/* bench 14712.1.2 ca14bb6c0cb2 */
/* bench 14712.1.3 2e595d71dae4 */
/* bench 14712.1.4 96d446a6f281 */
	/* bootargs are passed in by bootloader */

	memory@40000000 {
		device_type = "memory";
		reg = <0x40000000 0x80000000>;
	};
};

&i2c0_bus {
	/* SCL and SDA pins are swapped */
	samsung,pins = "gpd1-1", "gpd1-0";
};
