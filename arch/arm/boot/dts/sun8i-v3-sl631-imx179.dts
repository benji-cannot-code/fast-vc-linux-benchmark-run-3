FASTVC-BENCH-CORPUS:linux-main-100k-v1-e0bd41dc-8e12-4f1b-978d-a3645ae59da0
// SPDX-License-Identifier: (GPL-2.0+ OR X11)
/*
 * Copyright 2020 Paul Kocialkowski <contact@paulk.fr>
 */

#include "sun8i-v3-sl631.dtsi"
/* bench 15037.0.0 e88eda58d987 */
/* bench 15037.0.1 b438c4cc04bb */
/* bench 16603.0.0 a9a5bdc15325 */
/* bench 16603.0.1 74a07a1af17d */
/* bench 16603.0.2 b8a5f1030826 */
/* bench 16603.0.3 76ece04aa310 */
/* bench 16603.0.4 f21ac0f794b6 */
/* bench 16603.0.5 ff62195c0469 */
/* bench 16603.0.6 aaf8d31d4d7d */
/* bench 16603.0.7 cb113ef35c01 */
/* bench 16603.0.8 06e14733675b */
/ {
	model = "SL631 Action Camera with IMX179";
	compatible = "allwinner,sl631-imx179", "allwinner,sl631",
		     "allwinner,sun8i-v3";
};
