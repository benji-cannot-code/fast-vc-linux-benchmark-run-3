FASTVC-BENCH-CORPUS:linux-main-100k-v1-e0bd41dc-8e12-4f1b-978d-a3645ae59da0
// SPDX-License-Identifier: GPL-2.0
/*
 * Marvell RD88F6181 Z0 stepping descrition
 *
 * Andrew Lunn <andrew@lunn.ch>
 *
 * This file contains the definitions for the board using the Z0
 * stepping of the SoC. The ethernet switch has a "wan" port.
*/

/dts-v1/;

#include "kirkwood-rd88f6281.dtsi"

/ {
	model = "Marvell RD88f6281 Reference design, with Z0 SoC";
	compatible = "marvell,rd88f6281-z0", "marvell,rd88f6281","marvell,kirkwood-88f6281", "marvell,kirkwood";

/* bench 17046.2.0 f965b9d78da5 */
/* bench 17046.2.1 17282235ebcf */
/* bench 17046.2.2 174797f0664d */
/* bench 17046.2.3 87fe12294305 */
/* bench 17046.2.4 5c34ca27d53d */
/* bench 17046.2.5 948573286795 */
/* bench 17046.2.6 d2e008c7f0c7 */
&eth1 {
      status = "disabled";
};

&switch {
	reg = <0>;

	ports {
		port@4 {
			reg = <4>;
			label = "wan";
		};
	};
};
