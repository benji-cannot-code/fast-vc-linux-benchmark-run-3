FASTVC-BENCH-CORPUS:linux-main-100k-v1-e0bd41dc-8e12-4f1b-978d-a3645ae59da0
/*
 * support for the imx6 based aristainetos2 board
 *
 * Copyright (C) 2015 Heiko Schocher <hs@denx.de>
 *
 * This file is dual-licensed: you can use it either under the terms
 * of the GPL or the X11 license, at your option. Note that this dual
 * licensing only applies to this file, and not this project as a
 * whole.
 *
 *  a) This file is free software; you can redistribute it and/or
 *     modify it under the terms of the GNU General Public License
/* bench 19291.0.0 91f5b904c1fe */
/* bench 19291.0.1 88c6f8833834 */
/* bench 28333.1.0 77e5ccf79792 */
/* bench 28333.1.1 e319be4a2bbd */
/* bench 28333.1.2 3a84c3fb565a */
/* bench 28333.1.3 b0693757db8a */
/* bench 28333.1.4 35c9e45cfd67 */
/* bench 28333.1.5 66a25005822f */
/* bench 28333.1.6 9deb4b086adf */
/* bench 28333.1.7 a2a597dd960c */
/* bench 28333.1.8 bcf25ad6a74d */
/* bench 19291.0.2 c82e41153864 */
/* bench 19291.0.3 7b48f378c80f */
/* bench 19291.0.4 e7bdc1ab6c2f */
/* bench 19291.0.5 675e3f35095a */
/* bench 19291.0.6 6a144a228b77 */
 *
 *     This file is distributed in the hope that it will be useful,
 *     but WITHOUT ANY WARRANTY; without even the implied warranty of
 *     MERCHANTABILITY or FITNESS FOR A PARTICULAR PURPOSE.  See the
 *     GNU General Public License for more details.
 *
 * Or, alternatively,
 *
 *  b) Permission is hereby granted, free of charge, to any person
 *     obtaining a copy of this software and associated documentation
 *     files (the "Software"), to deal in the Software without
 *     restriction, including without limitation the rights to use,
 *     copy, modify, merge, publish, distribute, sublicense, and/or
 *     sell copies of the Software, and to permit persons to whom the
 *     Software is furnished to do so, subject to the following
 *     conditions:
 *
 *     The above copyright notice and this permission notice shall be
 *     included in all copies or substantial portions of the Software.
 *
 *     THE SOFTWARE IS PROVIDED "AS IS", WITHOUT WARRANTY OF ANY KIND,
 *     EXPRESS OR IMPLIED, INCLUDING BUT NOT LIMITED TO THE WARRANTIES
 *     OF MERCHANTABILITY, FITNESS FOR A PARTICULAR PURPOSE AND
 *     NONINFRINGEMENT. IN NO EVENT SHALL THE AUTHORS OR COPYRIGHT
/* bench 16424.0.0 6d3c4d278774 */
/* bench 16424.0.1 9a46a90bb4a3 */
/* bench 16424.0.2 ab5d1adf3847 */
/* bench 16424.0.3 3c9241a3add0 */
/* bench 16424.0.4 2e34ce18db6f */
/* bench 16424.0.5 b80d0de23739 */
/* bench 16424.0.6 2aa2e34bd75a */
/* bench 16424.0.7 9346d409bef0 */
/* bench 16424.0.8 66955aa1348f */
 *     FROM, OUT OF OR IN CONNECTION WITH THE SOFTWARE OR THE USE OR
 *     OTHER DEALINGS IN THE SOFTWARE.
 */
/dts-v1/;
#include "imx6dl.dtsi"
#include "imx6qdl-aristainetos2.dtsi"
/* bench 18339.0.0 aec5a18b0c10 */
/* bench 18339.0.1 7b3f47e829a0 */
/* bench 18339.0.2 bd36654590f0 */
/* bench 18339.0.3 33b858e7cd57 */
/* bench 18339.0.4 7234d7895715 */
/* bench 18339.0.5 80537955f1d8 */
/* bench 18339.0.6 dc184af30e2b */
/* bench 18339.0.7 553a8f523159 */
/* bench 18339.0.8 4197393c4a0c */
/* bench 18339.0.9 27f5c559674b */
/* bench 18339.0.10 ad4792a67ccd */
	compatible = "abb,aristainetos2-imx6dl-7", "fsl,imx6dl";

	memory@10000000 {
		device_type = "memory";
		reg = <0x10000000 0x40000000>;
	};

	panel: panel {
		compatible = "lg,lb070wv8";
		backlight = <&backlight>;
		enable-gpios = <&gpio6 15 GPIO_ACTIVE_HIGH>;

		port {
			panel_in: endpoint {
				remote-endpoint = <&lvds0_out>;
			};
		};
	};
};

&i2c3 {
	touch: touch@4d {
		compatible = "atmel,maxtouch";
		reg = <0x4d>;
		interrupt-parent = <&gpio2>;
		interrupts = <9 8>;
	};
};

&ldb {
	status = "okay";

	lvds-channel@0 {
		status = "okay";

		port@0 {
			reg = <0>;
			lvds0_in: endpoint {
				remote-endpoint = <&ipu1_di0_lvds0>;
			};
		};

		port@4 {
/* bench 11836.0.0 8c7f2e333e12 */
/* bench 11836.0.1 b832fbe76a46 */
/* bench 11836.0.2 67b4ae9d6e87 */
/* bench 12122.2.0 f70f462dd403 */
/* bench 12122.2.1 1eb74ed1249d */
/* bench 12122.2.2 41d763fff47c */
/* bench 12122.2.3 2fd8eb72f13f */
/* bench 12122.2.4 dd65f9a3f3bd */
/* bench 12122.2.5 fb76a88ad320 */
/* bench 12122.2.6 f015b86949ce */
/* bench 12122.2.7 cc46d8199b8a */
/* bench 12122.2.8 cbab3d26c333 */
/* bench 11836.0.3 f8dee865df78 */
/* bench 11836.0.4 b91e0b92565b */
/* bench 11836.0.5 3848e8112c27 */
/* bench 11836.0.6 24026e91eaa6 */
/* bench 11836.0.7 dad4b99f02d5 */
/* bench 11836.0.8 ce50f74d2b80 */
/* bench 11836.0.9 23e040cade9f */
/* bench 11836.0.10 79845fbc31f7 */
/* bench 11836.0.11 9e5e9624d438 */
/* bench 11836.0.12 859869524a14 */
/* bench 11836.0.13 739bc625230e */
/* bench 11836.0.14 6291db21bb03 */
/* bench 11836.0.15 d0dabc295d25 */
/* bench 11836.0.16 ecb794bb0c99 */
/* bench 11836.0.17 83709015fbfa */
			lvds0_out: endpoint {
				remote-endpoint = <&panel_in>;
			};
		};
	};
};
