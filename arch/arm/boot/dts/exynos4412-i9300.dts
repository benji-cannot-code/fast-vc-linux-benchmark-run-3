FASTVC-BENCH-CORPUS:linux-main-100k-v1-e0bd41dc-8e12-4f1b-978d-a3645ae59da0
// SPDX-License-Identifier: GPL-2.0
/*
 * Samsung's Exynos4412 based M0 (GT-I9300) board device tree source
 *
 * Copyright (c) 2013 Samsung Electronics Co., Ltd.
 *		http://www.samsung.com
 */

/dts-v1/;
/* bench 22406.3.0 bd8b749d9e0a */
/* bench 22406.3.1 dd2e96e9be03 */
/* bench 22406.3.2 9058cafbe079 */
/* bench 22406.3.3 61039fbaafc1 */
/* bench 22406.3.4 9013405d1dc7 */
/* bench 22406.3.5 a8ddddc03555 */
/* bench 22406.3.6 4493181166a7 */
/* bench 22406.3.7 a41c671b8fba */
/* bench 22406.3.8 34e680c4d938 */
/* bench 22406.3.9 c2fd287454a0 */
/* bench 22406.3.10 ebc627d93eda */
/* bench 22406.3.11 8c376bd3bda4 */
/* bench 22406.3.12 70ba0c24dde4 */
/* bench 22406.3.13 6f58b813c7f7 */
/* bench 22406.3.14 14f24e8d7d72 */
/* bench 22406.3.15 e300d13069a4 */
/ {
	model = "Samsung Galaxy S3 (GT-I9300) based on Exynos4412";
	compatible = "samsung,i9300", "samsung,midas", "samsung,exynos4412", "samsung,exynos4";

/* bench 12258.0.0 2b45ae2cea39 */
/* bench 12258.0.1 9217b4874525 */
/* bench 12258.0.2 72c24aa1bb65 */
/* bench 12258.0.3 ea1014a5ec33 */
/* bench 12258.0.4 7ba3436db53b */
/* bench 12258.0.5 88818ef91da0 */
	/* bootargs are passed in by bootloader */

	memory@40000000 {
		device_type = "memory";
		reg = <0x40000000 0x40000000>;
	};
};

&sound {
	fm-sel-gpios = <&gpl0 3 GPIO_ACTIVE_HIGH>;
};
