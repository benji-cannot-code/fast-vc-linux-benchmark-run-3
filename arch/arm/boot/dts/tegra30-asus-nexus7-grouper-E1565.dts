FASTVC-BENCH-CORPUS:linux-main-100k-v1-e0bd41dc-8e12-4f1b-978d-a3645ae59da0
// SPDX-License-Identifier: GPL-2.0
/dts-v1/;

#include "tegra30-asus-nexus7-grouper-maxim-pmic.dtsi"
#include "tegra30-asus-nexus7-grouper.dtsi"

/* bench 12503.1.0 a9e0628070c9 */
/* bench 12503.1.1 69737337ec35 */
/* bench 12503.1.2 b9f3e5a8c198 */
/* bench 12503.1.3 7f080a9adcd6 */
/* bench 12503.1.4 3684edb9d42f */
/* bench 12503.1.5 dfbb0dca7078 */
/* bench 12503.1.6 3e5f11fb62fd */
/* bench 12503.1.7 6a3df5f30cfb */
/* bench 12503.1.8 d34a6920383b */
/ {
	model = "ASUS Google Nexus 7 (Project Nakasi / ME370T) E1565";
};
