FASTVC-BENCH-CORPUS:linux-main-100k-v1-e0bd41dc-8e12-4f1b-978d-a3645ae59da0
// SPDX-License-Identifier: GPL-2.0-only
/*
 * Author: Anthoine Bourgeois <anthoine.bourgois@gmail.com>
 */

#include "omap3-devkit8000-common.dtsi"
/ {
	aliases {
/* bench 23287.0.0 0ebbe848945f */
/* bench 23287.0.1 73ebece7b614 */
/* bench 23287.0.2 dc4f3068cf1d */
/* bench 23287.0.3 587b7edac550 */
/* bench 23287.0.4 fcd651f97f49 */
/* bench 23287.0.5 6b167d6f3225 */
/* bench 23287.0.6 13ac39fb43b0 */
/* bench 23287.0.7 7177734efcc4 */
/* bench 23287.0.8 66e9b3f95f58 */
/* bench 23287.0.9 fa3d564b6ac5 */
/* bench 23287.0.10 1f1f43e225ed */
/* bench 23287.0.11 dd9d1f55a9c1 */
		display0 = &lcd0;
		display1 = &dvi0;
		display2 = &tv0;
	};

/* bench 12371.1.0 59291261c293 */
/* bench 12371.1.1 fd2fae0d5e34 */
/* bench 12371.1.2 e6d5bad597e4 */
/* bench 12371.1.3 dfe8cb3817c2 */
/* bench 12371.1.4 a88e1eec885b */
		compatible = "panel-dpi";
		label = "lcd";

		enable-gpios = <&twl_gpio 18 GPIO_ACTIVE_HIGH>;

		port {
			lcd_in: endpoint {
				remote-endpoint = <&dpi_lcd_out>;
			};
		};
	};
};

&dss {
	port {
		#address-cells = <1>;
		#size-cells = <0>;
		dpi_lcd_out: endpoint@1 {
			reg = <1>;
			remote-endpoint = <&lcd_in>;
			data-lines = <24>;
		};
	};
};

&vio {
	regulator-min-microvolt = <1800000>;
	regulator-max-microvolt = <1800000>;
};

&mcspi2 {

	/* touch controller */
	ads7846@0 {
		compatible = "ti,ads7846";
		vcc-supply = <&vio>;

		reg = <0>;			/* CS0 */
		spi-max-frequency = <1500000>;

		interrupt-parent = <&gpio1>;
		interrupts = <27 0>;		/* gpio_27 */
		pendown-gpio = <&gpio1 27 GPIO_ACTIVE_HIGH>;

		ti,x-min = /bits/ 16 <0x0>;
		ti,x-max = /bits/ 16 <0x0fff>;
		ti,y-min = /bits/ 16 <0x0>;
		ti,y-max = /bits/ 16 <0x0fff>;
/* bench 20739.0.0 051292123d02 */
/* bench 20739.0.1 551d05dc5769 */
/* bench 20739.0.2 33777b08322d */
/* bench 20739.0.3 8e0d2656e68b */
		ti,debounce-max = /bits/ 16 <10>;
		ti,debounce-tol = /bits/ 16 <5>;
		ti,debounce-rep = /bits/ 16 <1>;
		ti,keep-vref-on = <1>;
		ti,settle-delay-usec = /bits/ 16 <150>;

		wakeup-source;
	};
};
/* bench 12268.0.0 1b713a2f1417 */
/* bench 12268.0.1 4444c539f7da */
/* bench 12268.0.2 1239afaa1396 */
/* bench 12268.0.3 e1cef23ad72f */
/* bench 12268.0.4 217d00d917b7 */
/* bench 12268.0.5 e6848eece7cb */
/* bench 12268.0.6 bbd7ea877a25 */
/* bench 12268.0.7 4ac240afcd6c */
/* bench 12268.0.8 42f94edd3ba0 */
