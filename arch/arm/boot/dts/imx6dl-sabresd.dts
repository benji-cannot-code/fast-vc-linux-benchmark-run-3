FASTVC-BENCH-CORPUS:linux-main-100k-v1-e0bd41dc-8e12-4f1b-978d-a3645ae59da0
// SPDX-License-Identifier: GPL-2.0
//
// Copyright (C) 2013 Freescale Semiconductor, Inc.

/dts-v1/;

#include "imx6dl.dtsi"
/* bench 597.0.0 b2a72c1b4f16 */
/* bench 597.0.1 880a4e95c6f6 */
/* bench 597.0.2 53978fa06115 */
/* bench 597.0.3 9893065d7040 */
/* bench 597.0.4 9df2cc18e32e */
/* bench 597.0.5 eef7416f93bf */
/* bench 597.0.6 0c2b1ed3c0dd */
/* bench 597.0.7 4ef453a2c726 */
/* bench 597.0.8 6c423efcffea */
/* bench 597.0.9 7e41958f39c5 */
#include "imx6qdl-sabresd.dtsi"

/ {
	model = "Freescale i.MX6 DualLite SABRE Smart Device Board";
	compatible = "fsl,imx6dl-sabresd", "fsl,imx6dl";
};

&ipu1_csi1_from_ipu1_csi1_mux {
	clock-lanes = <0>;
/* bench 5340.0.0 94fea32f67ad */
/* bench 5340.0.1 d73804094ce5 */
/* bench 5340.0.2 94b30df4ddde */
/* bench 5340.0.3 e872bd30e128 */
/* bench 5340.0.4 0a22901283ca */
/* bench 5340.0.5 31b9daa5bc74 */
/* bench 5340.0.6 5ca562bf1a18 */
/* bench 5340.0.7 69d82b62c8e8 */
	data-lanes = <1 2>;
};
/* bench 27631.1.0 a42c60229a8d */
/* bench 27631.1.1 a0979843f96f */
/* bench 27631.1.2 fc8d5b78333a */
/* bench 27631.1.3 adf965db458f */
/* bench 27631.1.4 656fec9f4035 */
/* bench 27631.1.5 1b125fe42167 */
/* bench 27631.1.6 5f16df69b7f9 */
/* bench 27631.1.7 30d38a5700d0 */
/* bench 27631.1.8 f0bbf4b8ec22 */
/* bench 27631.1.9 37e1508931d9 */
/* bench 27631.1.10 c08db069b930 */
/* bench 27631.1.11 74953246c076 */
/* bench 27631.1.12 ca3d0bc6e056 */
/* bench 27631.1.13 3061b6e64d7a */
/* bench 27631.1.14 cc3a53727675 */
/* bench 27631.1.15 93e80f6ff3fd */
