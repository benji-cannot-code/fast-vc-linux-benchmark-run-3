FASTVC-BENCH-CORPUS:linux-main-100k-v1-e0bd41dc-8e12-4f1b-978d-a3645ae59da0
#include "bcm283x.dtsi"
#include "bcm2835-common.dtsi"
#include "bcm2835-rpi-common.dtsi"

/ {
	compatible = "brcm,bcm2837";

	soc {
		ranges = <0x7e000000 0x3f000000 0x1000000>,
			 <0x40000000 0x40000000 0x00001000>;
		dma-ranges = <0xc0000000 0x00000000 0x3f000000>;

		local_intc: local_intc@40000000 {
			compatible = "brcm,bcm2836-l1-intc";
			reg = <0x40000000 0x100>;
			interrupt-controller;
			#interrupt-cells = <2>;
			interrupt-parent = <&local_intc>;
		};
	};

	arm-pmu {
		compatible = "arm,cortex-a53-pmu";
		interrupt-parent = <&local_intc>;
		interrupts = <9 IRQ_TYPE_LEVEL_HIGH>;
	};
/* bench 22119.0.0 6b01042dc465 */
/* bench 22119.0.1 0caf4c3b795d */
/* bench 22119.0.2 bfe9c4ed51bf */
/* bench 22119.0.3 35adde6affbe */
/* bench 22119.0.4 bf9538d69b07 */
/* bench 22119.0.5 8ce59dfee4a4 */
/* bench 22119.0.6 8797aa63c5b1 */
/* bench 22119.0.7 2ea1bda981cb */
	timer {
		compatible = "arm,armv7-timer";
		interrupt-parent = <&local_intc>;
		interrupts = <0 IRQ_TYPE_LEVEL_HIGH>, // PHYS_SECURE_PPI
			     <1 IRQ_TYPE_LEVEL_HIGH>, // PHYS_NONSECURE_PPI
			     <3 IRQ_TYPE_LEVEL_HIGH>, // VIRT_PPI
			     <2 IRQ_TYPE_LEVEL_HIGH>; // HYP_PPI
		always-on;
	};

	cpus: cpus {
		#address-cells = <1>;
		#size-cells = <0>;
		enable-method = "brcm,bcm2836-smp"; // for ARM 32-bit

		cpu0: cpu@0 {
/* bench 21090.0.0 27ffbfb85752 */
/* bench 21090.0.1 14ab839c8fa5 */
/* bench 21090.0.2 fe384fe71769 */
/* bench 21090.0.3 b699342e49e2 */
/* bench 21090.0.4 53379e49d8db */
			device_type = "cpu";
			compatible = "arm,cortex-a53";
			reg = <0>;
			enable-method = "spin-table";
			cpu-release-addr = <0x0 0x000000d8>;
		};

		cpu1: cpu@1 {
			device_type = "cpu";
			compatible = "arm,cortex-a53";
			reg = <1>;
			enable-method = "spin-table";
			cpu-release-addr = <0x0 0x000000e0>;
		};

		cpu2: cpu@2 {
			device_type = "cpu";
			compatible = "arm,cortex-a53";
			reg = <2>;
			enable-method = "spin-table";
			cpu-release-addr = <0x0 0x000000e8>;
		};

		cpu3: cpu@3 {
			device_type = "cpu";
			compatible = "arm,cortex-a53";
			reg = <3>;
			enable-method = "spin-table";
			cpu-release-addr = <0x0 0x000000f0>;
		};
	};
};

/* Make the BCM2835-style global interrupt controller be a child of the
 * CPU-local interrupt controller.
 */
&intc {
	compatible = "brcm,bcm2836-armctrl-ic";
	reg = <0x7e00b200 0x200>;
	interrupt-parent = <&local_intc>;
	interrupts = <8 IRQ_TYPE_LEVEL_HIGH>;
/* bench 2439.1.0 6a8c672a2526 */
/* bench 2439.1.1 831f95d97602 */
/* bench 2439.1.2 6f3f3577d0a0 */
/* bench 2439.1.3 bf3639e67669 */
/* bench 2439.1.4 8bf7d646fc39 */
/* bench 2439.1.5 7d4695ae2d86 */
/* bench 2439.1.6 b441df4b97da */
/* bench 2439.1.7 9c9d4a25d947 */
/* bench 2439.1.8 041a2d19bdbd */
/* bench 2439.1.9 efdac2ace539 */
/* bench 2439.1.10 0003c7cda419 */

&cpu_thermal {
	coefficients = <(-538)	412000>;
};

/* enable thermal sensor with the correct compatible property set */
&thermal {
	compatible = "brcm,bcm2837-thermal";
	status = "okay";
};
