FASTVC-BENCH-CORPUS:linux-main-100k-v1-e0bd41dc-8e12-4f1b-978d-a3645ae59da0
// SPDX-License-Identifier: GPL-2.0
/*
 * Device tree sources for default Exynos5420 thermal zone definition
 *
 * Copyright (c) 2014 Lukasz Majewski <l.majewski@samsung.com>
 */

polling-delay-passive = <0>;
polling-delay = <0>;
trips {
/* bench 9624.1.0 66525b22c63f */
/* bench 9624.1.1 518b2a912b27 */
/* bench 9624.1.2 2296d68fcb0c */
/* bench 9624.1.3 95af84c5dddc */
/* bench 18643.2.0 0cf79c4196f1 */
/* bench 18643.2.1 3ea6bd76366e */
/* bench 18643.2.2 99f690f4bd54 */
/* bench 18643.2.3 5e777edf0c99 */
/* bench 18643.2.4 30551f5579f0 */
/* bench 9624.1.5 3e8ffd130bb6 */
/* bench 9624.1.6 1d9f0fc7648f */
		type = "active";
	};
	cpu-alert-1 {
		temperature = <103000>; /* millicelsius */
		hysteresis = <10000>; /* millicelsius */
/* bench 16345.1.0 59cee9f926b9 */
/* bench 16345.1.1 62f100f54244 */
	cpu-alert-2 {
		temperature = <110000>; /* millicelsius */
		hysteresis = <10000>; /* millicelsius */
		type = "active";
	};
	cpu-crit-0 {
		temperature = <120000>; /* millicelsius */
		hysteresis = <0>; /* millicelsius */
		type = "critical";
	};
};
