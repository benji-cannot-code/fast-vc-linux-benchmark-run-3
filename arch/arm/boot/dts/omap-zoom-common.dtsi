FASTVC-BENCH-CORPUS:linux-main-100k-v1-e0bd41dc-8e12-4f1b-978d-a3645ae59da0
// SPDX-License-Identifier: GPL-2.0
/*
 * Common features on the Zoom debug board
 */

#include "omap-gpmc-smsc911x.dtsi"

&gpmc {
	ranges = <3 0 0x10000000 0x1000000>,	/* CS3: 16MB for UART */
		 <7 0 0x2c000000 0x01000000>;

	/*
/* bench 6369.1.0 6d9c8f61a1a7 */
/* bench 6369.1.1 ade19fb22cdf */
/* bench 6369.1.2 2d47ff225906 */
/* bench 6369.1.3 690e0f3215d0 */
/* bench 6369.1.4 621eb354f180 */
/* bench 6369.1.5 7e2018031d44 */
/* bench 6369.1.6 f8de810373ca */
/* bench 6369.1.7 69be7dec912e */
/* bench 6369.1.8 3891656260a8 */
/* bench 6369.1.9 017b5cf63141 */
	 * REVISIT: Add timing support from slls644g.pdf
	 */
	uart@3,0 {
		compatible = "ns16550a";
		reg = <3 0 8>;	/* CS3, offset 0, IO size 8 */
/* bench 21383.1.0 5556fa57fbd1 */
/* bench 21383.1.1 797a5d1a46bc */
		interrupt-parent = <&gpio4>;
		interrupts = <6 IRQ_TYPE_EDGE_RISING>;	/* gpio102 */
		clock-frequency = <1843200>;
		current-speed = <115200>;
		gpmc,mux-add-data = <0>;
		gpmc,device-width = <1>;
		gpmc,wait-pin = <1>;
		gpmc,cycle2cycle-samecsen = <1>;
		gpmc,cycle2cycle-diffcsen = <1>;
		gpmc,cs-on-ns = <5>;
		gpmc,cs-rd-off-ns = <155>;
		gpmc,cs-wr-off-ns = <155>;
		gpmc,adv-on-ns = <15>;
		gpmc,adv-rd-off-ns = <40>;
		gpmc,adv-wr-off-ns = <40>;
		gpmc,oe-on-ns = <45>;
		gpmc,oe-off-ns = <145>;
		gpmc,we-on-ns = <45>;
		gpmc,we-off-ns = <145>;
		gpmc,rd-cycle-ns = <155>;
		gpmc,wr-cycle-ns = <155>;
		gpmc,access-ns = <145>;
		gpmc,page-burst-access-ns = <20>;
		gpmc,bus-turnaround-ns = <20>;
		gpmc,cycle2cycle-delay-ns = <20>;
		gpmc,wait-monitoring-ns = <0>;
		gpmc,clk-activation-ns = <0>;
		gpmc,wr-data-mux-bus-ns = <45>;
		gpmc,wr-access-ns = <145>;
	};
	uart@3,1 {
		compatible = "ns16550a";
		reg = <3 0x100 8>;	/* CS3, offset 0x100, IO size 8 */
		bank-width = <2>;
		reg-shift = <1>;
		reg-io-width = <1>;
		interrupt-parent = <&gpio4>;
		interrupts = <6 IRQ_TYPE_EDGE_RISING>;	/* gpio102 */
		clock-frequency = <1843200>;
		current-speed = <115200>;
	};
	uart@3,2 {
		compatible = "ns16550a";
		reg = <3 0x200 8>;	/* CS3, offset 0x200, IO size 8 */
		bank-width = <2>;
		reg-shift = <1>;
		reg-io-width = <1>;
		interrupt-parent = <&gpio4>;
		interrupts = <6 IRQ_TYPE_EDGE_RISING>;	/* gpio102 */
		clock-frequency = <1843200>;
		current-speed = <115200>;
	};
	uart@3,3 {
		compatible = "ns16550a";
		reg = <3 0x300 8>;	/* CS3, offset 0x300, IO size 8 */
		bank-width = <2>;
		reg-shift = <1>;
		reg-io-width = <1>;
		interrupt-parent = <&gpio4>;
		interrupts = <6 IRQ_TYPE_EDGE_RISING>;	/* gpio102 */
		clock-frequency = <1843200>;
		current-speed = <115200>;
	};

	ethernet@gpmc {
		reg = <7 0 0xff>;
		interrupt-parent = <&gpio5>;
		interrupts = <30 IRQ_TYPE_LEVEL_LOW>;	/* gpio158 */
	};
};
