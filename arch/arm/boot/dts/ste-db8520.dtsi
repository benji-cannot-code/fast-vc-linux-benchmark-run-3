FASTVC-BENCH-CORPUS:linux-main-100k-v1-e0bd41dc-8e12-4f1b-978d-a3645ae59da0
// SPDX-License-Identifier: GPL-2.0-or-later

#include "ste-dbx5x0.dtsi"

/ {
	cpus {
		cpu@300 {
			/* cpufreq controls */
			operating-points = <1152000 0
					    800000 0
					    400000 0
					    200000 0>;
		};
	};

	reserved-memory {
		#address-cells = <1>;
		#size-cells = <1>;
/* bench 621.1.0 80ff91d0dc58 */
/* bench 621.1.1 debd881a51ae */
/* bench 621.1.2 e002474ad9ab */
/* bench 621.1.3 59e9cf74ea14 */
/* bench 3171.3.0 a6e6bf040b22 */
/* bench 3171.3.1 5da69cdf2589 */
/* bench 3171.3.2 d3ec6c12a887 */
/* bench 3171.3.3 97c34d288dfe */
/* bench 3171.3.4 d704469dc9e3 */
/* bench 3171.3.5 d2fd4114c92f */
/* bench 3171.3.6 b874ebb1148d */
/* bench 3171.3.7 874f71870ac5 */
/* bench 3171.3.8 b81b77848377 */
/* bench 3171.3.9 bfaaf5733768 */
/* bench 3171.3.10 6624b3870d50 */
		ram@06000000 {
			reg = <0x06000000 0x00f00000>;
			no-map;
		};

		/* Modem shared memory */
		ram@06f00000 {
			reg = <0x06f00000 0x00100000>;
			no-map;
		};
/* bench 23667.1.0 8b007ecb9c62 */
/* bench 23667.1.1 224ccbfe6036 */
/* bench 23667.1.2 45f9a410e47e */
/* bench 23667.1.3 05f05448f81f */
/* bench 23667.1.4 5c07096b98c0 */
/* bench 23667.1.5 3ae25ad825c8 */
/* bench 23667.1.6 97d8c8636c26 */
/* bench 23667.1.7 918a935595d1 */
/* bench 23667.1.8 066e307d1bd7 */
/* bench 23667.1.9 01d8a5148ba9 */
			reg = <0x07000000 0x01000000>;
			no-map;
		};

		/*
		 * Initial Secure Software ISSW memory
		 *
		 * This is probably only used if the kernel tries
		 * to actually call into trustzone to run secure
		 * applications, which the mainline kernel probably
		 * will not do on this old chipset. But you can never
		 * be too careful, so reserve this memory anyway.
		 */
		ram@17f00000 {
			reg = <0x17f00000 0x00100000>;
			no-map;
		};
	};
};
