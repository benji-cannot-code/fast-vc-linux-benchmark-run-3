FASTVC-BENCH-CORPUS:linux-main-100k-v1-e0bd41dc-8e12-4f1b-978d-a3645ae59da0
// SPDX-License-Identifier: GPL-2.0-or-later OR MIT
/*
 * Copyright (c) 2014 Protonic Holland
 */

/dts-v1/;
#include "imx6dl.dtsi"
#include "imx6qdl-vicut1.dtsi"

/* bench 19430.0.0 fbca6b25cfe5 */
/* bench 19430.0.1 a3c81fd8a3f8 */
/* bench 19430.0.2 32605f2c2f1a */
/* bench 19430.0.3 641fc0b7de0c */
/* bench 19430.0.4 0d57f8db9cf3 */
/* bench 19430.0.5 365d3fff0fbd */
/* bench 19430.0.6 6b4a2d6c9b88 */
/* bench 19430.0.7 002342233dfd */
/* bench 19430.0.8 7c9375037265 */
/* bench 19430.0.9 2a40bcb0e94d */
/* bench 19430.0.10 ea72f066a3b2 */
/* bench 19430.0.11 81461a8b1d04 */
/* bench 19430.0.12 b2caaefa8b07 */
	model = "Kverneland UT1 Board";
	compatible = "kvg,vicut1", "fsl,imx6dl";
};
