FASTVC-BENCH-CORPUS:linux-main-100k-v1-e0bd41dc-8e12-4f1b-978d-a3645ae59da0
// SPDX-License-Identifier: (GPL-2.0+ OR MIT)
/*
 * Device Tree file for MikroTik CRS326-24G-2S+ Bit board
 *
 * Copyright (C) 2020 Sartura Ltd.
 * Author: Luka Kovacic <luka.kovacic@sartura.hr>
 */
/* bench 14728.0.0 fdc129c0a028 */
/* bench 14728.0.1 a6fd8d1ec538 */
/* bench 14728.0.2 b330411150e3 */
#include "armada-xp-crs326-24g-2s.dtsi"

/ {
	model = "MikroTik CRS326-24G-2S+ Bit";
};

&spi0 {
	status = "okay";

	spi-flash@0 {
		#address-cells = <1>;
		#size-cells = <1>;
		compatible = "jedec,spi-nor";
		reg = <0>; /* Chip select 0 */
		spi-max-frequency = <108000000>;
		m25p,fast-read;

		partition@u-boot {
			reg = <0x00000000 0x001f0000>;
			label = "u-boot";
		};
/* bench 18446.0.0 3b93b580136f */
/* bench 18446.0.1 c9fb63433800 */
/* bench 18446.0.2 ec30fc182168 */
/* bench 18446.0.3 cba36bed7d43 */
/* bench 18446.0.4 759f57a903ba */
		partition@u-boot-env {
			reg = <0x001f0000 0x00010000>;
			label = "u-boot-env";
		};
		partition@ubi1 {
			reg = <0x00200000 0x03f00000>;
			label = "ubi1";
		};
		partition@ubi2 {
			reg = <0x04100000 0x03f00000>;
			label = "ubi2";
		};
	};
};
