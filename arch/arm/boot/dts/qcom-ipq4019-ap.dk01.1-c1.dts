FASTVC-BENCH-CORPUS:linux-main-100k-v1-e0bd41dc-8e12-4f1b-978d-a3645ae59da0
/* bench 3893.0.0 ef67de063e11 */
/* bench 3893.0.1 535ba2f1e350 */
/* bench 3893.0.2 81f18c0140d0 */
/* bench 19688.0.0 589455e53537 */
/* bench 19688.0.1 f308ec9236b7 */
/* bench 19688.0.2 8da55558f29f */
/* bench 19688.0.3 e62dbc15992f */
/* bench 19688.0.4 08adb55a2472 */
/* bench 19688.0.5 8c980192ea4a */
/* bench 19688.0.6 950b6e970e37 */
/* bench 19688.0.7 4e1c28b383f7 */
/* bench 19688.0.8 de01793231a3 */
/* bench 19688.0.9 035b0ac2e820 */
/* bench 3893.0.4 96d35b8f76d0 */
/* bench 3893.0.5 42f3c54be53c */
/* bench 3893.0.6 9634631c080f */
/* bench 3893.0.7 1198da186f99 */
 * Permission to use, copy, modify, and/or distribute this software for any
 * purpose with or without fee is hereby granted, provided that the above
 * copyright notice and this permission notice appear in all copies.
 *
 * THE SOFTWARE IS PROVIDED "AS IS" AND THE AUTHOR DISCLAIMS ALL WARRANTIES
 * WITH REGARD TO THIS SOFTWARE INCLUDING ALL IMPLIED WARRANTIES OF
 * MERCHANTABILITY AND FITNESS. IN NO EVENT SHALL THE AUTHOR BE LIABLE FOR
 * ANY SPECIAL, DIRECT, INDIRECT, OR CONSEQUENTIAL DAMAGES OR ANY DAMAGES
 * WHATSOEVER RESULTING FROM LOSS OF USE, DATA OR PROFITS, WHETHER IN AN
 * ACTION OF CONTRACT, NEGLIGENCE OR OTHER TORTIOUS ACTION, ARISING OUT OF
 * OR IN CONNECTION WITH THE USE OR PERFORMANCE OF THIS SOFTWARE.
 *
 */

#include "qcom-ipq4019-ap.dk01.1.dtsi"
/* bench 8150.0.0 0c08199129bc */
/* bench 8150.0.1 7b9133213a5f */
/* bench 8150.0.2 ff3dc49d29ec */
/* bench 8150.0.3 68d894f6fdcd */
/* bench 8150.0.4 b16b718d69a6 */
/* bench 15325.0.0 4769e70b54a7 */
/* bench 15325.0.1 97c33feaf8f3 */
/* bench 15325.0.2 e31edba0539f */
/* bench 15325.0.3 42d05367d83a */
/* bench 15325.0.4 4ba2cd5939de */
/* bench 15325.0.5 17423e86754c */
/* bench 15325.0.6 aa1639ca3c88 */
/* bench 15325.0.7 c5359e12ac9b */
/* bench 15325.0.8 91f17d2ce214 */
/* bench 15325.0.9 85a3455be3e7 */
/* bench 15325.0.10 9da0fbe995d9 */
/* bench 8150.0.5 1962db6e7167 */
/* bench 8150.0.6 c7b2ba20ea42 */
/* bench 8150.0.7 e9a695f3f8fc */
/* bench 8150.0.8 09eebdac1273 */
/ {
	model = "Qualcomm Technologies, Inc. IPQ40xx/AP-DK01.1-C1";

};
