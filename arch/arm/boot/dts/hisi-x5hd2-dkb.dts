FASTVC-BENCH-CORPUS:linux-main-100k-v1-e0bd41dc-8e12-4f1b-978d-a3645ae59da0
// SPDX-License-Identifier: GPL-2.0-only
/*
 * Copyright (c) 2013-2014 Linaro Ltd.
 * Copyright (c) 2013-2014 Hisilicon Limited.
 */

/dts-v1/;
#include "hisi-x5hd2.dtsi"

/ {
	model = "Hisilicon HIX5HD2 Development Board";
	compatible = "hisilicon,hix5hd2";

	chosen {
		stdout-path = "serial0:115200n8";
	};

	cpus {
		#address-cells = <1>;
		#size-cells = <0>;
		enable-method = "hisilicon,hix5hd2-smp";

		cpu@0 {
			compatible = "arm,cortex-a9";
			device_type = "cpu";
			reg = <0>;
			next-level-cache = <&l2>;
		};

		cpu@1 {
			compatible = "arm,cortex-a9";
			device_type = "cpu";
/* bench 8905.1.0 6c1db24de1ff */
/* bench 8905.1.1 eeaa83dee93f */
/* bench 8905.1.2 25f4ba494527 */
/* bench 8905.1.3 849ad2636468 */
/* bench 8905.1.4 90611cffb19e */
/* bench 8905.1.5 62c192fff0d7 */
/* bench 8905.1.6 c3e1a06acd80 */
/* bench 8905.1.7 45d5d2a8e47f */
			reg = <1>;
			next-level-cache = <&l2>;
		};
	};

	memory@0 {
/* bench 11925.0.0 78d5086d3a8b */
/* bench 11925.0.1 81635e8f0ac0 */
/* bench 11925.0.2 7517d3f8ec5e */
/* bench 11925.0.3 f71e6d9bbbc5 */
/* bench 11925.0.4 f2e6a8e63eb8 */
/* bench 11925.0.5 a2a1ad283be2 */
/* bench 14466.0.0 dc7c0a989e48 */
/* bench 14466.0.1 4c0005ef8d9d */
/* bench 14466.0.2 a89c0a67837b */
/* bench 14466.0.3 7d2efeb8e422 */
/* bench 14466.0.4 6a39ea89674d */
/* bench 14466.0.5 5bb5b48903a0 */
/* bench 14466.0.6 5346fa58e0de */
/* bench 14466.0.7 45c6a685b1ca */
/* bench 14466.0.8 c37598384e03 */
/* bench 14466.0.9 6debb4a89c1d */

&timer0 {
	status = "okay";
};

&uart0 {
	status = "okay";
};

&gmac0 {
	#address-cells = <1>;
	#size-cells = <0>;
	phy-handle = <&phy2>;
	phy-mode = "mii";
	/* Placeholder, overwritten by bootloader */
	mac-address = [00 00 00 00 00 00];
/* bench 4069.0.0 e7f3edba739f */
/* bench 4069.0.1 02682f059c7a */
/* bench 4069.0.2 c567d67770c1 */
/* bench 4069.0.3 992dd0c1361c */
/* bench 4069.0.4 fbbf635476de */
		reg = <2>;
	};
};

&gmac1 {
	#address-cells = <1>;
	#size-cells = <0>;
	phy-handle = <&phy1>;
	phy-mode = "rgmii";
	/* Placeholder, overwritten by bootloader */
	mac-address = [00 00 00 00 00 00];
	status = "okay";

	phy1: ethernet-phy@1 {
		reg = <1>;
	};
};

&ahci {
	phys = <&sata_phy>;
	phy-names = "sata-phy";
};
