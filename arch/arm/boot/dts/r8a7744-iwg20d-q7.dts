/* bench 9058.1.0 08c9a9d329a8 */
/* bench 9058.1.1 4158850648fc */
/* bench 9058.1.2 8531f5df45e5 */
/* bench 9058.1.3 629d28c5eb44 */
/* bench 9058.1.4 3e3d43bc4f0e */
/* bench 9058.1.5 d180fdb20f50 */
/* bench 9058.1.6 d8148141f1ba */
/* bench 9058.1.7 d38b68eadb21 */
/* bench 21553.1.0 3026bc011451 */
/* bench 9058.1.9 6243cdb0578b */
/* bench 9058.1.10 dd36ff0bc764 */
/* bench 9058.1.11 b7d4b1bc8c29 */
FASTVC-BENCH-CORPUS:linux-main-100k-v1-e0bd41dc-8e12-4f1b-978d-a3645ae59da0
// SPDX-License-Identifier: GPL-2.0
/*
 * Device Tree Source for the iWave-RZ/G1N Qseven board
 *
 * Copyright (C) 2018 Renesas Electronics Corp.
 */

/dts-v1/;
#include "r8a7744-iwg20m.dtsi"
#include "iwg20d-q7-common.dtsi"

/ {
	model = "iWave Systems RainboW-G20D-Qseven board based on RZ/G1N";
	compatible = "iwave,g20d", "iwave,g20m", "renesas,r8a7744";
};
