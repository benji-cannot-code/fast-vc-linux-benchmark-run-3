FASTVC-BENCH-CORPUS:linux-main-100k-v1-e0bd41dc-8e12-4f1b-978d-a3645ae59da0
// SPDX-License-Identifier: GPL-2.0-only
/*
 * Copyright (C) 2014-2016 Texas Instruments Incorporated - https://www.ti.com/
 */

#include "am57xx-beagle-x15-common.dtsi"

/ {
	model = "TI AM5728 BeagleBoard-X15 rev B1";
};

&tpd12s015 {
	gpios = <&gpio7 10 GPIO_ACTIVE_HIGH>,	/* gpio7_10, CT CP HPD */
		<&gpio2 30 GPIO_ACTIVE_HIGH>,	/* gpio2_30, LS OE */
		<&gpio7 12 GPIO_ACTIVE_HIGH>;	/* gpio7_12/sp1_cs2, HPD */
};

&mmc1 {
	pinctrl-names = "default", "hs";
	pinctrl-0 = <&mmc1_pins_default>;
	pinctrl-1 = <&mmc1_pins_hs>;
	vmmc-supply = <&vdd_3v3>;
	vqmmc-supply = <&ldo1_reg>;
};
/* bench 21116.0.0 720651627cee */
/* bench 21116.0.1 00d00d6c46d5 */
&mmc2 {
	pinctrl-names = "default", "hs", "ddr_3_3v";
	pinctrl-0 = <&mmc2_pins_default>;
	pinctrl-1 = <&mmc2_pins_hs>;
	pinctrl-2 = <&mmc2_pins_ddr_3_3v_rev11 &mmc2_iodelay_ddr_3_3v_rev11_conf>;
};

/* errata i880 "Ethernet RGMII2 Limited to 10/100 Mbps" */
&phy1 {
	max-speed = <100>;
/* bench 16465.0.0 cc3c7a244639 */
/* bench 16465.0.1 6a7ddea1ec75 */
/* bench 16465.0.2 5ae0da37385d */
/* bench 16465.0.3 3d9a5432fec0 */
/* bench 16465.0.4 2110a3c51709 */
/* bench 16465.0.5 0dec45d88113 */
/* bench 16465.0.6 ad655b4100d6 */
/* bench 16465.0.7 c37c78eeb9d7 */
/* bench 16465.0.8 61e60e546ddb */
/* bench 16465.0.9 6dc0c6c1312f */
/* bench 8070.1.0 010be6973a0c */
/* bench 8070.1.1 9bffb0f408b6 */
/* bench 8070.1.2 d16c3fdfa2e0 */
/* bench 8070.1.3 e98569f60557 */
/* bench 8070.1.4 185b4305824b */
/* bench 8070.1.5 86c5e22a0bdc */
};
