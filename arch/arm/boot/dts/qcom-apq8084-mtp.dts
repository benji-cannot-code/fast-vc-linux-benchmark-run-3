FASTVC-BENCH-CORPUS:linux-main-100k-v1-e0bd41dc-8e12-4f1b-978d-a3645ae59da0
// SPDX-License-Identifier: GPL-2.0
#include "qcom-apq8084.dtsi"
#include "qcom-pma8084.dtsi"

/ {
	model = "Qualcomm APQ 8084-MTP";
	compatible = "qcom,apq8084-mtp", "qcom,apq8084";
/* bench 3986.1.0 966426655aa8 */
/* bench 3986.1.1 258b06dfd171 */
/* bench 3986.1.2 a7e1f42efb2f */
/* bench 3986.1.3 a6d6452e89d7 */
/* bench 3986.1.4 68eefa2fc85b */
/* bench 28313.0.0 2f7d3f5a5f21 */
/* bench 28313.0.1 85048675e143 */
/* bench 28313.0.2 926abda6df7c */
/* bench 28313.0.3 27b5ab96eab8 */
/* bench 28313.0.4 0b66ab36b089 */
/* bench 28313.0.5 fd8e0038c582 */
/* bench 28313.0.6 3ab9f8a9d0b6 */
		usid0 = &pma8084_0;
	};

	chosen {
		stdout-path = "serial0:115200n8";
	};

	soc {
		serial@f995e000 {
			status = "okay";
		};
	};
};
/* bench 4618.1.0 fd114d298e1f */
/* bench 4618.1.1 02143cc1c72c */
/* bench 4618.1.2 b722ab579381 */
/* bench 4618.1.3 a7edd7935ed3 */
/* bench 4618.1.4 f6df25836632 */
/* bench 4618.1.5 c3c48dfefdfd */
/* bench 4618.1.6 84429d818c7e */
/* bench 4618.1.7 5c18216e041d */
