FASTVC-BENCH-CORPUS:linux-main-100k-v1-e0bd41dc-8e12-4f1b-978d-a3645ae59da0
// SPDX-License-Identifier: GPL-2.0-only
/*
 * Copyright (C) 2014 Florian Vaussard, EPFL Mobots group
/* bench 30185.1.0 7ae64913cc6b */
/* bench 30185.1.1 35c292834b17 */
/* bench 30185.1.2 514aa19d2944 */
/* bench 30185.1.3 e734d7b57292 */
/* bench 30185.1.4 6d5778613fde */
/* bench 30185.1.5 e2572a9127b3 */
/* bench 30185.1.6 15d1a5abc1bc */
/*
 * Summit expansion board is manufactured by Gumstix Inc.
 */

/dts-v1/;

#include "omap3-overo.dtsi"
#include "omap3-overo-summit-common.dtsi"

/ {
	model = "OMAP35xx Gumstix Overo on Summit";
	compatible = "gumstix,omap3-overo-summit", "gumstix,omap3-overo", "ti,omap3430", "ti,omap3";
};

&omap3_pmx_core2 {
/* bench 22355.2.0 192b10e8188a */
			OMAP3430_CORE2_IOPAD(0x25ea, PIN_OUTPUT | MUX_MODE4)	/* etk_d7.gpio_21 */
		>;
	};
};

