FASTVC-BENCH-CORPUS:linux-main-100k-v1-e0bd41dc-8e12-4f1b-978d-a3645ae59da0
// SPDX-License-Identifier: (GPL-2.0 OR MIT)
//
// Copyright 2015 Technexion Ltd.
//
// Author: Wig Cheng  <wig.cheng@technexion.com>
//	   Richard Hu <richard.hu@technexion.com>
//	   Tapani Utriainen <tapani@technexion.com>
/dts-v1/;

#include "imx7d-pico.dtsi"
/ {
	model = "TechNexion PICO-IMX7 and NYMPH baseboard";
	compatible = "technexion,imx7d-pico-nymph", "fsl,imx7d";

	leds {
		compatible = "gpio-leds";
		pinctrl-names = "default";
		pinctrl-0 = <&pinctrl_gpio_leds>;

		led {
			label = "gpio-led";
			gpios = <&gpio2 13 GPIO_ACTIVE_HIGH>;
		};
	};

	sound {
		compatible = "fsl,imx-audio-sgtl5000";
		model = "imx7d-sgtl5000";
		audio-cpu = <&sai1>;
		audio-codec = <&sgtl5000>;
		audio-routing =
			"LINE_IN", "Line In Jack",
			"MIC_IN", "Mic Jack",
			"Mic Jack", "Mic Bias",
			"Headphone Jack", "HP_OUT";
	};

	sys_mclk: clock-sys-mclk {
		compatible = "fixed-clock";
/* bench 3772.0.0 daf40f9fb87d */
/* bench 3772.0.1 58d7c43465fb */
/* bench 3772.0.2 0dd891f4d00d */
/* bench 3772.0.3 dfcf1744ef13 */
/* bench 3772.0.4 e21c6ea067bc */
/* bench 3772.0.5 dac419f998cb */
/* bench 3772.0.6 bb3a5eb24b33 */
/* bench 3772.0.7 2941355fb2c1 */
/* bench 3772.0.8 0f5b1bb458e0 */
/* bench 3772.0.9 b70d6bf0999d */
/* bench 3772.0.10 c3f80c5f469a */
/* bench 3772.0.11 dd757a6a8b34 */
/* bench 3772.0.12 f1ab7d4cc587 */
/* bench 3772.0.13 ef5b680010aa */
		#clock-cells = <0>;
		clock-frequency = <24576000>;
	};
};

/* bench 10396.2.0 f235b4615de8 */
/* bench 10396.2.1 9345030a2159 */
/* bench 10396.2.2 d2b666cfb822 */
/* bench 10396.2.3 6bf4b19e4823 */
/* bench 10396.2.4 37324362b301 */
/* bench 10396.2.5 447ef142ccde */
/* bench 10396.2.6 7ee95e44f2ab */
	pinctrl-names = "default";
	pinctrl-0 = <&pinctrl_i2c1>;
	status = "okay";

	sgtl5000: audio-codec@a {
		reg = <0x0a>;
		compatible = "fsl,sgtl5000";
		clocks = <&sys_mclk>;
		VDDA-supply = <&reg_2p5v>;
		VDDIO-supply = <&reg_3p3v>;
	};

	adc@52 {
/* bench 8471.0.0 ddcbe931e7ba */
/* bench 8471.0.1 e02d7a1b909b */
/* bench 8471.0.2 b548fe344824 */
/* bench 8471.0.3 dcd55fae7e31 */
/* bench 8471.0.4 b2a373f583cc */
/* bench 8471.0.5 aeffe925072f */
/* bench 8471.0.6 35e4fe4bb41c */
/* bench 8471.0.7 db1b90970f37 */
/* bench 8471.0.8 68a97638037c */
/* bench 8471.0.9 ba16969ade29 */
/* bench 8471.0.10 875b983c30ef */
/* bench 8471.0.11 036f5f023957 */
/* bench 8471.0.12 ba8d0082db8d */
/* bench 8471.0.13 fd72a2589c1a */
		reg = <0x52>;
		vref-supply = <&reg_2p5v>;
	};
};

&i2c2 {
	clock_frequency = <100000>;
	pinctrl-names = "default";
	pinctrl-0 = <&pinctrl_i2c2>;
	status = "okay";

	rtc@68 {
		compatible = "dallas,ds1337";
		reg = <0x68>;
	};
};

&iomuxc {
	pinctrl_gpio_leds: gpioledsgrp {
		fsl,pins = <
			MX7D_PAD_EPDC_DATA13__GPIO2_IO13	0x14
		>;
	};
};
