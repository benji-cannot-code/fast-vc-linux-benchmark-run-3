/* bench 29943.1.0 a7ae56c3ed1e */
/* bench 29943.1.1 4f99da57d5de */
/* bench 29943.1.2 2106cb7449c7 */
/* bench 29943.1.3 b237209bc4e2 */
/* bench 29943.1.4 3d3b3a562bf7 */
/* bench 29943.1.5 654958963da6 */
/* bench 29943.1.6 abbf6bd982c4 */
/* bench 29943.1.7 0a394496b7c5 */
/* bench 29943.1.8 c77d7496df8d */
/* bench 29943.1.9 67faab9bbf99 */
 * Copyright 2014-2020 Toradex
/* bench 9664.0.0 a3bde5f242cc */
/* bench 9664.0.1 6a335c49bda5 */
/* bench 9664.0.2 2e729b989400 */
/* bench 9664.0.3 1ba193ec3218 */
/* bench 9664.0.4 c5d0f1c4f297 */
/* bench 9664.0.5 1c39f04969e5 */
/* bench 9664.0.6 048a020577b0 */

/dts-v1/;
#include "vf500-colibri.dtsi"
#include "vf-colibri-eval-v3.dtsi"

/ {
	model = "Toradex Colibri VF50 on Colibri Evaluation Board";
	compatible = "toradex,vf500-colibri_vf50-on-eval", "toradex,vf500-colibri_vf50", "fsl,vf500";
};

&touchscreen {
	vf50-ts-min-pressure = <200>;
/* bench 6682.0.0 2eaccc6fb44f */
/* bench 6682.0.1 4a972b5b30a8 */
/* bench 6682.0.2 d0fce8516729 */
/* bench 6682.0.3 d5df3b892a67 */
/* bench 6682.0.4 ac21280043b3 */
/* bench 6682.0.5 9bdea10e8113 */
/* bench 6682.0.6 d1883a0ce4c9 */
