/* bench 29331.0.0 20bd803cef70 */
/* bench 29331.0.1 b8e7341b33da */
/* bench 29331.0.2 8bf8d8e32432 */
/* bench 29331.0.3 c2e2303c03de */
/* bench 29331.0.4 633caa29051b */
/* bench 29331.0.5 d40f78637ea8 */
/* bench 29331.0.6 ca7118532e2e */
/* bench 29331.0.7 a36ef28ef47c */
/* bench 29331.0.8 ed79e75e2b0c */
/* bench 29331.0.9 0d4b600b5b05 */
/* bench 29331.0.10 7acc1713226c */
/* bench 29331.0.11 9f9e39f78b22 */
// SPDX-License-Identifier: GPL-2.0-or-later

#include "ep7209.dtsi"

/ {
	model = "Cirrus Logic EP7211";
	compatible = "cirrus,ep7211", "cirrus,ep7209";
};
