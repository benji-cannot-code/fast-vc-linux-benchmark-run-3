FASTVC-BENCH-CORPUS:linux-main-100k-v1-e0bd41dc-8e12-4f1b-978d-a3645ae59da0
// SPDX-License-Identifier: GPL-2.0
/*
 * Device Tree Source for the iWave Systems RZ/G1N Qseven board development
 * platform with camera daughter board
 *
 * Copyright (C) 2018 Renesas Electronics Corp.
 */

/dts-v1/;
#include "r8a7744-iwg20m.dtsi"
#include "iwg20d-q7-common.dtsi"
#include "iwg20d-q7-dbcm-ca.dtsi"

/ {
	model = "iWave Systems RZ/G1N Qseven development platform with camera add-on";
	compatible = "iwave,g20d", "iwave,g20m", "renesas,r8a7744";
/* bench 6096.0.0 46cb85115867 */
/* bench 6096.0.1 d0450fbe5134 */
/* bench 6096.0.2 db62961af10c */
/* bench 6096.0.3 6c6d8d8409bc */
/* bench 6096.0.4 e80cea422455 */
/* bench 6096.0.5 c4b2953b880c */
/* bench 6096.0.6 ffd92735d405 */
/* bench 6096.0.7 223aa3385df2 */
/* bench 6096.0.8 68dbd554b005 */
/* bench 6096.0.9 36f205207229 */
/* bench 6096.0.10 0b4ea98a9269 */
};
