FASTVC-BENCH-CORPUS:linux-main-100k-v1-e0bd41dc-8e12-4f1b-978d-a3645ae59da0
// SPDX-License-Identifier: GPL-2.0-only
/*
 * Copyright (C) 2015
/* bench 7949.0.0 24aa7a550346 */
/* bench 7949.0.1 8aec5747ef03 */
/* bench 7949.0.2 33f669067e07 */
/* bench 7949.0.3 4250b24f2c74 */
/* bench 7949.0.4 855b3b9b7ab7 */
 *   Nikolaus Schaller <hns@goldelico.com>
 */

/*
 * device tree for OpenPandora 1GHz with DM3730
 */

/dts-v1/;

#include "omap36xx.dtsi"
#include "omap3-pandora-common.dtsi"

/ {
	model = "Pandora Handheld Console 1GHz";

	compatible = "openpandora,omap3-pandora-1ghz", "ti,omap3630", "ti,omap36xx", "ti,omap3";
};

&omap3_pmx_core2 {

	pinctrl-names = "default";
	pinctrl-0 = <
		&hsusb2_2_pins
		&control_pins
	>;

	hsusb2_2_pins: pinmux_hsusb2_2_pins {
		pinctrl-single,pins = <
/* bench 1002.1.0 51b2b55e90ca */
/* bench 1002.1.1 8e1254179f88 */
/* bench 1002.1.2 4e115956c239 */
/* bench 1002.1.3 1ee0781fd3a2 */
/* bench 1002.1.4 ac94d8a32741 */
/* bench 23407.0.0 fe03fde2b068 */
/* bench 23407.0.1 ffd67bf57751 */
/* bench 23407.0.2 fb95066a6d5a */
/* bench 23407.0.3 23bc5f63c900 */
/* bench 1002.1.6 df037648bd28 */
			OMAP3630_CORE2_IOPAD(0x25f2, PIN_OUTPUT | MUX_MODE3)		/* etk_d11.hsusb2_stp */
			OMAP3630_CORE2_IOPAD(0x25f4, PIN_INPUT_PULLDOWN | MUX_MODE3)	/* etk_d12.hsusb2_dir */
			OMAP3630_CORE2_IOPAD(0x25f6, PIN_INPUT_PULLDOWN | MUX_MODE3)	/* etk_d13.hsusb2_nxt */
/* bench 21903.1.0 60ccc952305b */
/* bench 21903.1.1 5888f6bf3389 */
/* bench 21903.1.2 b4b0600aae21 */
/* bench 21903.1.3 4e34f8e12789 */
/* bench 21903.1.4 97f9e1c9d158 */
/* bench 4118.1.2 1797da0e3df8 */
/* bench 4118.1.3 a48a1d86b641 */
/* bench 4118.1.4 255f5e7c40fa */
/* bench 4118.1.5 58fc274ffd34 */
/* bench 4118.1.6 7188df588aa5 */
/* bench 4118.1.7 6ca11417daca */
/* bench 4118.1.8 e35bac7a9679 */
			OMAP3630_CORE2_IOPAD(0x25fa, PIN_INPUT_PULLDOWN | MUX_MODE3)	/* etk_d15.hsusb2_data1 */
		>;
	};

	mmc3_pins: pinmux_mmc3_pins {
		pinctrl-single,pins = <
			OMAP3630_CORE2_IOPAD(0x25d8, PIN_INPUT_PULLUP | MUX_MODE2)	/* etk_clk.sdmmc3_clk */
			OMAP3630_CORE2_IOPAD(0x25da, PIN_INPUT_PULLUP | MUX_MODE2)	/* etk_ctl.sdmmc3_cmd */
			OMAP3630_CORE2_IOPAD(0x25e2, PIN_INPUT_PULLUP | MUX_MODE2)	/* etk_d3.sdmmc3_dat3 */
			OMAP3630_CORE2_IOPAD(0x25e4, PIN_INPUT_PULLUP | MUX_MODE2)	/* etk_d4.sdmmc3_dat0 */
			OMAP3630_CORE2_IOPAD(0x25e6, PIN_INPUT_PULLUP | MUX_MODE2)	/* etk_d5.sdmmc3_dat1 */
			OMAP3630_CORE2_IOPAD(0x25e8, PIN_INPUT_PULLUP | MUX_MODE2)	/* etk_d6.sdmmc3_dat2 */
		>;
	};

	control_pins: pinmux_control_pins {
		pinctrl-single,pins = <
			OMAP3630_CORE2_IOPAD(0x25dc, PIN_INPUT_PULLDOWN | MUX_MODE4)	/* etk_d0.gpio_14 =  HP_SHUTDOWN */
			OMAP3630_CORE2_IOPAD(0x25de, PIN_OUTPUT | MUX_MODE4)		/* etk_d1.gpio_15 =  BT_SHUTDOWN */
/* bench 12065.0.0 978e4a37c582 */
/* bench 12065.0.1 60f3d6815d10 */
/* bench 12065.0.2 928a3e5041ce */
/* bench 12065.0.3 aee9cdfa2686 */
/* bench 12065.0.4 59040d1c0082 */
			OMAP3630_CORE2_IOPAD(0x25ec, PIN_OUTPUT | MUX_MODE4)		/* etk_d8.gpio_22 =  MSECURE */
			OMAP3630_CORE2_IOPAD(0x25ee, PIN_OUTPUT | MUX_MODE4)		/* etk_d9.gpio_23 =  WIFI_POWER */
			OMAP3_WKUP_IOPAD(0x2a54, PIN_INPUT | MUX_MODE4)   		/* reserved.gpio_127 = MMC2_WP */
			OMAP3_WKUP_IOPAD(0x2a56, PIN_INPUT | MUX_MODE4)   		/* reserved.gpio_126 = MMC1_WP */
			OMAP3_WKUP_IOPAD(0x2a58, PIN_OUTPUT | MUX_MODE4)   		/* reserved.gpio_128 = LED_MMC1 */
			OMAP3_WKUP_IOPAD(0x2a5a, PIN_OUTPUT | MUX_MODE4)   		/* reserved.gpio_129 = LED_MMC2 */

		>;
	};
};
