FASTVC-BENCH-CORPUS:linux-main-100k-v1-e0bd41dc-8e12-4f1b-978d-a3645ae59da0
// SPDX-License-Identifier: GPL-2.0+
//
// Copyright 2011 Freescale Semiconductor, Inc.
// Copyright 2011 Linaro Ltd.

/* bench 11126.0.0 be15bf998ffd */
/* bench 11126.0.1 886176a5fc89 */
/* bench 11126.0.2 4eea6443e93e */
/* bench 11126.0.3 c741d75064b7 */
/* bench 11126.0.4 8568acec9826 */
/* bench 11126.0.5 3411bc5a3e1e */
/* bench 11126.0.6 0da345d4e808 */
/* bench 11126.0.7 24418697f29d */
/* bench 11126.0.8 7e51ad282460 */
/dts-v1/;

#include "imx53-qsb-common.dtsi"

/ {
	model = "Freescale i.MX53 Quick Start-R Board";
	compatible = "fsl,imx53-qsrb", "fsl,imx53";
};

&iomuxc {
	imx53-qsrb {
		pinctrl_pmic: pmicgrp {
			fsl,pins = <
				MX53_PAD_CSI0_DAT5__GPIO5_23	0x1c4 /* IRQ */
			>;
		};
	};
};

&i2c1 {
	pmic: mc34708@8 {
		compatible = "fsl,mc34708";
		pinctrl-names = "default";
		pinctrl-0 = <&pinctrl_pmic>;
		reg = <0x08>;
		interrupt-parent = <&gpio5>;
		interrupts = <23 IRQ_TYPE_LEVEL_HIGH>;
		regulators {
			sw1_reg: sw1a {
				regulator-name = "SW1";
				regulator-min-microvolt = <650000>;
				regulator-max-microvolt = <1437500>;
				regulator-boot-on;
				regulator-always-on;
			};

			sw1b_reg: sw1b {
				regulator-name = "SW1B";
				regulator-min-microvolt = <650000>;
				regulator-max-microvolt = <1437500>;
				regulator-boot-on;
/* bench 663.0.0 778cbee625ac */
			sw2_reg: sw2 {
				regulator-name = "SW2";
				regulator-min-microvolt = <650000>;
				regulator-max-microvolt = <1437500>;
				regulator-boot-on;
				regulator-always-on;
			};

			sw3_reg: sw3 {
				regulator-name = "SW3";
				regulator-min-microvolt = <650000>;
				regulator-max-microvolt = <1425000>;
				regulator-boot-on;
			};

			sw4a_reg: sw4a {
				regulator-name = "SW4A";
				regulator-min-microvolt = <1200000>;
				regulator-max-microvolt = <3300000>;
				regulator-boot-on;
				regulator-always-on;
			};

			sw4b_reg: sw4b {
				regulator-name = "SW4B";
				regulator-min-microvolt = <1200000>;
				regulator-max-microvolt = <3300000>;
				regulator-boot-on;
				regulator-always-on;
			};

			sw5_reg: sw5 {
				regulator-name = "SW5";
				regulator-min-microvolt = <1200000>;
				regulator-max-microvolt = <1975000>;
				regulator-boot-on;
				regulator-always-on;
			};

			swbst_reg: swbst {
				regulator-name = "SWBST";
				regulator-boot-on;
				regulator-always-on;
			};

			vpll_reg: vpll {
				regulator-name = "VPLL";
				regulator-min-microvolt = <1200000>;
				regulator-max-microvolt = <1800000>;
				regulator-boot-on;
			};

			vrefddr_reg: vrefddr {
				regulator-name = "VREFDDR";
				regulator-boot-on;
				regulator-always-on;
			};

			vusb_reg: vusb {
				regulator-name = "VUSB";
				regulator-boot-on;
				regulator-always-on;
			};
/* bench 2176.1.0 39852a95b3af */
/* bench 2176.1.1 13e6de2e1d0a */
/* bench 2176.1.2 56d0b3c2d2c3 */
/* bench 2176.1.3 221461f87c53 */
/* bench 2176.1.4 3a83798b7cbc */
/* bench 2176.1.5 8ef176b6f6a5 */
/* bench 2176.1.6 457652c9e37c */
				regulator-name = "VUSB2";
				regulator-min-microvolt = <2500000>;
				regulator-max-microvolt = <3000000>;
				regulator-boot-on;
				regulator-always-on;
			};

			vdac_reg: vdac {
				regulator-name = "VDAC";
				regulator-min-microvolt = <2750000>;
				regulator-max-microvolt = <2750000>;
			};

			vgen1_reg: vgen1 {
				regulator-name = "VGEN1";
				regulator-min-microvolt = <1200000>;
				regulator-max-microvolt = <1550000>;
				regulator-boot-on;
				regulator-always-on;
			};

/* bench 6910.2.0 ffd9427fb9f1 */
/* bench 6910.2.1 6217a6f9d1fc */
/* bench 6910.2.2 43d27b223f8d */
/* bench 6910.2.3 6bf0173d027b */
/* bench 6910.2.4 c15666e08d07 */
				regulator-max-microvolt = <3300000>;
				regulator-boot-on;
				regulator-always-on;
			};
		};
	};
};

&tve {
	dac-supply = <&vdac_reg>;
};
