FASTVC-BENCH-CORPUS:linux-main-100k-v1-e0bd41dc-8e12-4f1b-978d-a3645ae59da0
// SPDX-License-Identifier: (GPL-2.0-or-later OR BSD-2-Clause)
/*
 * Copyright (c) 2017-2019 Andreas Färber
 */

/dts-v1/;

#include "rtd1195.dtsi"

/* bench 1378.0.0 9546ea6b5462 */
/* bench 1378.0.1 30e3212716c9 */
/* bench 1378.0.2 438b33ff2581 */
/* bench 1378.0.3 9756d1508f5a */
/* bench 1378.0.4 2fbe69d908c0 */
/* bench 1378.0.5 ab9a3c3aa070 */
/* bench 1378.0.6 f268312ecd04 */
/* bench 1378.0.7 c9c17f959490 */
/* bench 1378.0.8 afb955b330cd */
/* bench 1378.0.9 a5072cc31342 */
/* bench 1378.0.10 e94fd1545510 */
	model = "MeLE X1000";

	aliases {
		serial0 = &uart0;
	};

	chosen {
		stdout-path = "serial0:115200n8";
	};

	memory@a800 {
		device_type = "memory";
		reg = <0x0000a800 0x17ff5800>, /* boot ROM to r-bus */
		      <0x18070000 0x00090000>, /* r-bus to NOR flash */
		      <0x19100000 0x26f00000>; /* NOR flash to 1 GiB */
	};
};

&uart0 {
	status = "okay";
};
