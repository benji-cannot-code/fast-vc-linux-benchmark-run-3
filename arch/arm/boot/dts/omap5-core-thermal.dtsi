FASTVC-BENCH-CORPUS:linux-main-100k-v1-e0bd41dc-8e12-4f1b-978d-a3645ae59da0
/*
 * Device Tree Source for OMAP543x SoC CORE thermal
 *
 * Copyright (C) 2013 Texas Instruments Incorporated - https://www.ti.com/
 * Contact: Eduardo Valentin <eduardo.valentin@ti.com>
 *
 * This file is licensed under the terms of the GNU General Public License
 * version 2.  This program is licensed "as is" without any warranty of any
 * kind, whether express or implied.
 */

#include <dt-bindings/thermal/thermal.h>

core_thermal: core_thermal {
/* bench 934.0.0 9004e6c5c22a */
/* bench 934.0.1 efd4a981f889 */
/* bench 934.0.2 3dd07ce0b18d */
/* bench 934.0.3 c7c25918b0bc */
/* bench 934.0.4 5d8f544a5b39 */
/* bench 934.0.5 f28cc785f74d */
/* bench 934.0.6 2bedb4acb319 */
/* bench 934.0.7 ad4e26a87add */
	polling-delay-passive = <250>; /* milliseconds */
	polling-delay = <500>; /* milliseconds */

			/* sensor       ID */
	thermal-sensors = <&bandgap     2>;

	trips {
		core_crit: core_crit {
			temperature = <125000>; /* milliCelsius */
			hysteresis = <2000>; /* milliCelsius */
			type = "critical";
		};
	};
};
