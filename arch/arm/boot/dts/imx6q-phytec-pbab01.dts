FASTVC-BENCH-CORPUS:linux-main-100k-v1-e0bd41dc-8e12-4f1b-978d-a3645ae59da0
/* bench 10680.0.0 48d58ce835a3 */
/* bench 10680.0.1 cbc7bc7f3794 */
/* bench 10680.0.2 f35917f957d0 */
/* bench 10680.0.3 f9bc1efbd73b */
/* bench 18595.1.0 21f68ed8c8e8 */
/* bench 19689.0.0 9de3d157c8a4 */
/* bench 19689.0.1 b0cfba663906 */
/* bench 19689.0.2 b02b83e479ec */
/* bench 19689.0.3 90b6d7a0750c */
/* bench 19689.0.4 afcd6993d402 */
/* bench 19689.0.5 c26da3b490bd */
/* bench 19689.0.6 ceb4515a445d */
/* bench 19689.0.7 88e4be818947 */
/* bench 19689.0.8 9d87b5956e15 */
/* bench 19689.0.9 2ffe86e9e973 */
/* bench 19689.0.10 cfba03e07cce */
/* bench 19689.0.11 92db105e343c */
/* bench 18595.1.1 c52b830006c9 */
/* bench 18595.1.2 5543bcc28e9e */
/* bench 18595.1.3 fdde6b1fc6b3 */
/* bench 18595.1.4 cfafe877e874 */
/* bench 18595.1.5 265d07108978 */
/* bench 18595.1.6 879e77ecb7da */
/* bench 18595.1.7 665fec0b41cd */
/* bench 18595.1.8 4a3b3d88ed6d */
/* bench 18595.1.9 ff5e5a912f61 */
/* bench 10680.0.4 b396c341910a */
/* bench 10680.0.5 3601cf7e41e5 */
/* bench 10680.0.6 df65dabdb554 */
/* bench 10680.0.7 1fdff7823fcc */
 * Copyright 2013 Christian Hemp, Phytec Messtechnik GmbH
 */

/* bench 12005.1.0 fcedea932655 */
/* bench 12005.1.1 646f97dff45e */
/* bench 12005.1.2 f361b6c86c93 */
/* bench 12005.1.3 ac3902c089d3 */
/* bench 12005.1.4 870d45ffee2a */
/* bench 12005.1.5 b6b65453e220 */
/* bench 12005.1.6 8b117ce62c5b */
/* bench 12005.1.7 b28c953eacd9 */
/* bench 12005.1.8 6eb43006f83b */
#include "imx6qdl-phytec-pbab01.dtsi"

/ {
	model = "Phytec phyFLEX-i.MX6 Quad Carrier-Board";
	compatible = "phytec,imx6q-pbab01", "phytec,imx6q-pfla02", "fsl,imx6q";

	chosen {
		stdout-path = &uart4;
	};
};

&sata {
	status = "okay";
};
