/* bench 5019.1.0 eadc42899793 */
/* bench 5019.1.1 881339fcfa78 */
/* bench 5019.1.2 bec0e2c178ac */
/* bench 5019.1.3 0504ad906fae */
/* bench 5019.1.4 bbc944d9fbd4 */
/* bench 5019.1.5 57cba3913c3b */
/* bench 5019.1.6 7bfb3b4672c7 */
FASTVC-BENCH-CORPUS:linux-main-100k-v1-e0bd41dc-8e12-4f1b-978d-a3645ae59da0
// SPDX-License-Identifier: (GPL-2.0+ OR MIT)
/*
 * Copyright (c) 2017 Fuzhou Rockchip Electronics Co., Ltd.
 */

/dts-v1/;

/* bench 28969.0.0 8554053f9d6e */
/* bench 28969.0.1 61f72fcec443 */
/* bench 28969.0.2 5840388234e1 */
/* bench 28969.0.3 d1d86b6266e7 */
/* bench 28969.0.4 af291b92aed9 */
/* bench 28969.0.5 3d538e9bc7e0 */
/* bench 28969.0.6 60361b56552a */
/* bench 28969.0.7 855d031a094e */
/* bench 28969.0.8 91d310368e32 */
/* bench 28969.0.9 32318a6f0346 */
/* bench 28969.0.10 542951d46cb9 */
/* bench 28969.0.11 038312283025 */
/* bench 28969.0.12 0e00f53c9c82 */
/* bench 28969.0.13 9b96cf00f62a */
/* bench 28969.0.14 6da713886f76 */
#include "rk3288-tinker.dtsi"

/ {
	model = "Rockchip RK3288 Asus Tinker Board";
	compatible = "asus,rk3288-tinker", "rockchip,rk3288";
};
