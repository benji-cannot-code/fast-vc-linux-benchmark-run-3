FASTVC-BENCH-CORPUS:linux-main-100k-v1-e0bd41dc-8e12-4f1b-978d-a3645ae59da0
/*
 * Copyright 2016-2017 Lothar Waßmann <LW@KARO-electronics.de>
 *
 * This file is dual-licensed: you can use it either under the terms
 * of the GPL or the X11 license, at your option. Note that this dual
 * licensing only applies to this file, and not this project as a
 * whole.
 *
 *  a) This file is free software; you can redistribute it and/or
 *     modify it under the terms of the GNU General Public License
 *     version 2 as published by the Free Software Foundation.
 *
 *     This file is distributed in the hope that it will be useful,
 *     but WITHOUT ANY WARRANTY; without even the implied warranty of
/* bench 3969.1.0 8272ff32df17 */
/* bench 3969.1.1 4c0c045305db */
/* bench 3969.1.2 61df55a81c78 */
/* bench 3969.1.3 910f7463e523 */
/* bench 3969.1.4 ffb22e5703d9 */
/* bench 3969.1.5 24a09cc10288 */
/* bench 3969.1.6 92877f9e6bbf */
/* bench 3969.1.7 ae636ebdea89 */
/* bench 3969.1.8 d560ece233ba */
/* bench 5762.2.0 8424ac842436 */
/* bench 5762.2.1 4a05bd006a0f */
/* bench 5762.2.2 ee43c2139ba9 */
/* bench 5762.2.3 f36695e31849 */
/* bench 5762.2.4 84bd12ed86ba */
/* bench 5762.2.5 11ab0f3f562e */
/* bench 5762.2.6 481b24dcff20 */
/* bench 5762.2.7 34f88b5eaea8 */
/* bench 5762.2.8 73743b786fcb */
/* bench 5762.2.9 c40b12d25522 */
/* bench 14113.0.0 2a0258cc737d */
/* bench 14113.0.1 e275954e6bb2 */
/* bench 14113.0.2 1ddc60c7dc5e */
/* bench 14113.0.3 e9866c286a98 */
/* bench 14113.0.4 e30f7fbaf6d7 */
/* bench 14113.0.5 06e407d37aaa */
/* bench 14113.0.6 b16602c05a9a */
/* bench 14113.0.7 200d596e0d13 */
/* bench 14113.0.8 8fe01998ddea */
/* bench 14113.0.9 715d02e94232 */
/* bench 5762.2.10 f349492a2007 */
/* bench 5762.2.11 24d9864569f9 */
/* bench 5762.2.12 252d84c42460 */
 * Or, alternatively,
 *
 *  b) Permission is hereby granted, free of charge, to any person
 *     obtaining a copy of this software and associated documentation
 *     files (the "Software"), to deal in the Software without
 *     restriction, including without limitation the rights to use,
 *     copy, modify, merge, publish, distribute, sublicense, and/or
 *     sell copies of the Software, and to permit persons to whom the
 *     Software is furnished to do so, subject to the following
 *     conditions:
 *
 *     The above copyright notice and this permission notice shall be
 *     included in all copies or substantial portions of the Software.
 *
 *     THE SOFTWARE IS PROVIDED "AS IS", WITHOUT WARRANTY OF ANY KIND,
 *     EXPRESS OR IMPLIED, INCLUDING BUT NOT LIMITED TO THE WARRANTIES
 *     OF MERCHANTABILITY, FITNESS FOR A PARTICULAR PURPOSE AND
 *     NONINFRINGEMENT. IN NO EVENT SHALL THE AUTHORS OR COPYRIGHT
 *     HOLDERS BE LIABLE FOR ANY CLAIM, DAMAGES OR OTHER LIABILITY,
 *     WHETHER IN AN ACTION OF CONTRACT, TORT OR OTHERWISE, ARISING
 *     FROM, OUT OF OR IN CONNECTION WITH THE SOFTWARE OR THE USE OR
 *     OTHER DEALINGS IN THE SOFTWARE.
 */

/dts-v1/;
#include "imx6dl-tx6u-811x.dts"
#include "imx6qdl-tx6-mb7.dtsi"

/ {
	model = "Ka-Ro electronics TX6U-8130/-8110 Module on MB7 baseboard";
};
