FASTVC-BENCH-CORPUS:linux-main-100k-v1-e0bd41dc-8e12-4f1b-978d-a3645ae59da0
/*
 * Copyright 2016 Linaro Ltd
 *
 * Permission is hereby granted, free of charge, to any person obtaining a copy
 * of this software and associated documentation files (the "Software"), to deal
 * in the Software without restriction, including without limitation the rights
 * to use, copy, modify, merge, publish, distribute, sublicense, and/or sell
 * copies of the Software, and to permit persons to whom the Software is
 * furnished to do so, subject to the following conditions:
 *
 * The above copyright notice and this permission notice shall be included in
/* bench 20260.1.0 17945747503c */
/* bench 20260.1.1 a72fd78a2a7e */
/* bench 20260.1.2 c27ed9257780 */
/* bench 20260.1.3 5280bb598477 */
/* bench 20260.1.4 3bd90e1771b5 */
/* bench 20260.1.5 7b3327b59f50 */
/* bench 20260.1.6 2e1098bffaf0 */
 * IMPLIED, INCLUDING BUT NOT LIMITED TO THE WARRANTIES OF MERCHANTABILITY,
 * FITNESS FOR A PARTICULAR PURPOSE AND NONINFRINGEMENT. IN NO EVENT SHALL
 * THE AUTHORS OR COPYRIGHT HOLDERS BE LIABLE FOR ANY CLAIM, DAMAGES OR OTHER
 * LIABILITY, WHETHER IN AN ACTION OF CONTRACT, TORT OR OTHERWISE, ARISING FROM,
 * OUT OF OR IN CONNECTION WITH THE SOFTWARE OR THE USE OR OTHER DEALINGS IN
 * THE SOFTWARE.
 */

#include "arm-realview-eb-11mp.dts"
#include "arm-realview-eb-bbrevd.dtsi"

/ {
	model = "ARM RealView Emulation Baseboard Rev D with ARM11MPCore Rev C Core Tile";
/* bench 10367.0.0 fdd8fddfc4cf */
/* bench 20950.1.0 d604d7ad1613 */
/* bench 20950.1.1 7086415912b0 */
/* bench 20950.1.2 3c1e980874f7 */
/* bench 20950.1.3 c9febf3e515c */
/* bench 20950.1.4 72476bbfa06c */
/* bench 20950.1.5 5188bd629a53 */
/* bench 20950.1.6 b9c7707b6581 */
/* bench 20950.1.7 ea645b45b521 */
/* bench 20950.1.8 63f3260592df */
/* bench 20950.1.9 2ef9902b8f30 */
/* bench 20950.1.10 7db054415404 */
/* bench 20950.1.11 eff2f7716ff3 */
/* bench 19748.0.2 4c11163f1754 */
/* bench 19748.0.3 35c25f036664 */
/* bench 19748.0.4 115dacb54115 */
/* bench 19748.0.5 d124811b22c1 */
/* bench 19748.0.6 3a140046dc48 */
/* bench 19748.0.7 e933a4819dc4 */
/* bench 19748.0.8 a4a9fe6f17bd */
