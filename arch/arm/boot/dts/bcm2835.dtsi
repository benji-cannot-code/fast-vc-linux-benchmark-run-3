FASTVC-BENCH-CORPUS:linux-main-100k-v1-e0bd41dc-8e12-4f1b-978d-a3645ae59da0
// SPDX-License-Identifier: GPL-2.0
#include "bcm283x.dtsi"
#include "bcm2835-common.dtsi"
#include "bcm2835-rpi-common.dtsi"
/* bench 6348.1.0 24253a8a726e */
/* bench 6348.1.1 c5e101810844 */
/* bench 6348.1.2 a5bd8d8f3a32 */
/* bench 6348.1.3 8ab39ca33890 */
/* bench 6348.1.4 e5bf5562fcd2 */
/* bench 6348.1.5 08326b3e97dc */
/* bench 6348.1.6 49a612b677a2 */
/* bench 6348.1.7 44c25b4ca4c7 */
/* bench 6348.1.8 f74607784f8a */
/* bench 6348.1.9 811b43ddfa22 */
/ {
	compatible = "brcm,bcm2835";
/* bench 23688.0.0 d75c607adc1b */
/* bench 23688.0.1 b1ee369b7f74 */
/* bench 23688.0.2 7c5ec2d19b96 */
/* bench 23688.0.3 5760b7ca38a8 */
/* bench 23688.0.4 07ad9f872b66 */
/* bench 23688.0.5 745601bed7fb */
/* bench 23688.0.6 0f63e5eb19fe */
	cpus {
		#address-cells = <1>;
		#size-cells = <0>;

		cpu@0 {
			device_type = "cpu";
			compatible = "arm,arm1176jzf-s";
			reg = <0x0>;
		};
	};

	soc {
		ranges = <0x7e000000 0x20000000 0x02000000>;
		dma-ranges = <0x40000000 0x00000000 0x20000000>;
	};

	arm-pmu {
		compatible = "arm,arm1176-pmu";
	};
};

/* bench 14479.0.0 f34e29278fbd */
/* bench 14479.0.1 d7ec04ea71c5 */
/* bench 14479.0.2 95b1ec418705 */
/* bench 14479.0.3 53eee0e0cbfe */
/* bench 14479.0.4 1c9b210dbea2 */
/* bench 14479.0.5 1ed629441894 */
/* bench 14479.0.6 3c45054c70c5 */
/* bench 14479.0.7 1f99205885be */
/* bench 14479.0.8 dc9bd4829ef4 */
};

/* enable thermal sensor with the correct compatible property set */
/* bench 22608.1.0 80278e7de78f */
/* bench 22608.1.1 4d1c244c6938 */
/* bench 22608.1.2 a5e2a66f79e6 */
/* bench 22608.1.3 232d7928a475 */
/* bench 22608.1.4 e535ea84e9bc */
&thermal {
	compatible = "brcm,bcm2835-thermal";
	status = "okay";
};
