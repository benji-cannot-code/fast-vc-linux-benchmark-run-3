FASTVC-BENCH-CORPUS:linux-main-100k-v1-e0bd41dc-8e12-4f1b-978d-a3645ae59da0
/* bench 2966.0.0 c4fc9ceb281d */
/* bench 2966.0.1 548cef4b2b13 */
/* bench 2966.0.2 e1dd60992cf2 */
//
// Copyright (C) 2016 Freescale Semiconductor, Inc.

/dts-v1/;

#include "imx6ull.dtsi"
#include "imx6ul-14x14-evk.dtsi"

/ {
	model = "Freescale i.MX6 UltraLiteLite 14x14 EVK Board";
/* bench 9997.0.0 5c8f2f0cbe54 */
/* bench 9997.0.1 9609028eb6b6 */
/* bench 9997.0.2 ee1c5d04890d */
/* bench 9997.0.3 655d22417478 */
/* bench 9997.0.4 2a5d1d7e6143 */
/* bench 9997.0.5 7fa8a65efccf */
/* bench 9997.0.6 dc31e598a166 */
/* bench 9997.0.7 dc4d6ef7b84c */
/* bench 9997.0.8 37250f1f4ea3 */
/* bench 9997.0.9 f1034e483fd5 */
/* bench 8742.0.1 5ff6e469ee6f */
/* bench 8742.0.2 f384db0783ad */
/* bench 8742.0.3 d18375dad608 */
/* bench 8742.0.4 0b9dc479fd86 */
/* bench 8742.0.5 c3af217e68d1 */
/* bench 8742.0.6 ee8bdb2aceee */
/* bench 8742.0.7 51598da4486b */
/* bench 8742.0.8 3f36c6e38a12 */
};

&clks {
	assigned-clocks = <&clks IMX6UL_CLK_PLL3_PFD2>;
	assigned-clock-rates = <320000000>;
};
