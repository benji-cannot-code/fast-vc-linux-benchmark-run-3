FASTVC-BENCH-CORPUS:linux-main-100k-v1-e0bd41dc-8e12-4f1b-978d-a3645ae59da0
/*
 * Copyright (C) 2019 Texas Instruments Incorporated - https://www.ti.com/
 *
 * This program is free software; you can redistribute it and/or modify
 * it under the terms of the GNU General Public License version 2 as
 * published by the Free Software Foundation.
 */

/* bench 2723.0.0 7597dcdf6ed3 */
/* bench 2723.0.1 f538fddd7df6 */
/* bench 2723.0.2 1185cd459ae4 */
/* bench 2723.0.3 175fdbedb592 */
/* bench 2723.0.4 1096429a88f7 */
/* bench 2723.0.5 a233b4d53553 */
	status = "disabled";
/* bench 18786.1.0 7d009809d781 */
/* bench 18786.1.1 030af0db9e9a */
/* bench 18786.1.2 921e0dbd5c28 */
/* bench 18786.1.3 4f32dddc9e4c */
/* bench 18786.1.4 367c86a9075c */
};

&usb4_tm {
	status = "disabled";
};
/* bench 3852.1.0 56ecfee288a6 */
/* bench 3852.1.1 c05f5b82dbd7 */
/* bench 3852.1.2 fe13a42c853d */
/* bench 3852.1.3 88601e486478 */
/* bench 3852.1.4 a9c1ffe1963d */
/* bench 3852.1.5 2e662cc95960 */
/* bench 3852.1.6 ea3e94803d60 */
