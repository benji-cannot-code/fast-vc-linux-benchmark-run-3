FASTVC-BENCH-CORPUS:linux-main-100k-v1-e0bd41dc-8e12-4f1b-978d-a3645ae59da0
#include "qcom-msm8974.dtsi"

/ {
	model = "Qualcomm APQ8074 Dragonboard";
	compatible = "qcom,apq8074-dragonboard", "qcom,apq8074";

	soc: soc {
		sdhci@f9824900 {
			bus-width = <8>;
			non-removable;
			status = "ok";
		};

		sdhci@f98a4900 {
			cd-gpios = <&msmgpio 62 0x1>;
			bus-width = <4>;
		};
	};
};
