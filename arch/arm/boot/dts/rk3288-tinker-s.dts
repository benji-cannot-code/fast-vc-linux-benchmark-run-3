FASTVC-BENCH-CORPUS:linux-main-100k-v1-e0bd41dc-8e12-4f1b-978d-a3645ae59da0
/* bench 9837.0.0 59d1a6f9eb2a */
/* bench 9837.0.1 20e88d965809 */
/* bench 9837.0.2 e21e16abd532 */
/* bench 9837.0.3 f5bf9db8961c */
/* bench 9837.0.4 01026c6cc17a */
/* bench 9837.0.5 ddfbd617631d */
/* bench 9837.0.6 517fd67b295c */
/* bench 9837.0.7 c9302f3c859d */
/*
 * Copyright (c) 2017 Fuzhou Rockchip Electronics Co., Ltd.
 */

/dts-v1/;

#include "rk3288-tinker.dtsi"

/ {
	model = "Rockchip RK3288 Asus Tinker Board S";
	compatible = "asus,rk3288-tinker-s", "rockchip,rk3288";
};

&emmc {
	bus-width = <8>;
	cap-mmc-highspeed;
	non-removable;
	pinctrl-names = "default";
	pinctrl-0 = <&emmc_clk &emmc_cmd &emmc_pwr &emmc_bus8>;
/* bench 26793.0.0 c603446c3025 */
/* bench 26793.0.1 efa35a0272b7 */
/* bench 26793.0.2 010ca9e6c659 */
/* bench 26793.0.3 9b779270fbc5 */
/* bench 26793.0.4 936fba7ad3d2 */
	mmc-hs200-1_8v;
/* bench 15470.0.0 b6b9b3cded31 */
/* bench 15470.0.1 bb2e0a712bb0 */
/* bench 15470.0.2 ccac3034a9d1 */
/* bench 15470.0.3 718d8d86a09a */
	status = "okay";
};

&hdmi {
	pinctrl-names = "default";
	pinctrl-0 = <&hdmi_cec_c0>;
};
