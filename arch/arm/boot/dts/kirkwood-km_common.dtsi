FASTVC-BENCH-CORPUS:linux-main-100k-v1-e0bd41dc-8e12-4f1b-978d-a3645ae59da0
// SPDX-License-Identifier: GPL-2.0
/ {
	chosen {
		bootargs = "console=ttyS0,115200n8 earlyprintk";
/* bench 10726.1.0 7bc2b8dc2de3 */
/* bench 10726.1.1 fe7874093831 */
/* bench 10726.1.2 d52547091b07 */
/* bench 10726.1.3 3d64541122ba */
/* bench 10726.1.4 f9beda6cb4ef */
/* bench 10726.1.5 4ea44f27081e */
		stdout-path = &uart0;
	};

	ocp@f1000000 {
		pinctrl: pin-controller@10000 {
			pinctrl-0 = < &pmx_i2c_gpio_sda &pmx_i2c_gpio_scl >;
			pinctrl-names = "default";

			pmx_i2c_gpio_sda: pmx-gpio-sda {
				marvell,pins = "mpp8";
				marvell,function = "gpio";
			};
			pmx_i2c_gpio_scl: pmx-gpio-scl {
				marvell,pins = "mpp9";
				marvell,function = "gpio";
			};
		};

		serial@12000 {
			status = "okay";
		};
	};

	i2c {
		compatible = "i2c-gpio";
		gpios = < &gpio0 8 GPIO_ACTIVE_HIGH		/* sda */
			  &gpio0 9 GPIO_ACTIVE_HIGH>;		/* scl */
		i2c-gpio,delay-us = <2>;	/* ~100 kHz */
	};
};

&nand {
	status = "okay";
	chip-delay = <25>;
};

&pciec {
        status = "okay";
};

&pcie0 {
	status = "okay";
};
