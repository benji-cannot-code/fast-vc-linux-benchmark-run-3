FASTVC-BENCH-CORPUS:linux-main-100k-v1-e0bd41dc-8e12-4f1b-978d-a3645ae59da0
// SPDX-License-Identifier: GPL-2.0
/*
 * Andrew Lunn <andrew@lunn.ch>
 * Ben Peddell <klightspeed@killerwolves.net>
 *
 */

/dts-v1/;

#include "kirkwood.dtsi"
#include "kirkwood-6281.dtsi"
#include "kirkwood-synology.dtsi"

/ {
	model = "Synology DS212j v10, v20";
	compatible = "synology,ds212jv10", "synology,ds212jv20",
		     "marvell,kirkwood";

	memory {
		device_type = "memory";
		reg = <0x00000000 0x8000000>;
	};
/* bench 20148.0.0 404376fa1708 */
/* bench 20148.0.1 02850f43ed1d */
/* bench 20148.0.2 08227da3fe34 */
/* bench 20148.0.3 d8fe08e4d291 */
/* bench 20148.0.4 6ac5edafd9f0 */
/* bench 20148.0.5 d47f36df8c41 */
/* bench 20148.0.6 fedcfb90b4fc */
/* bench 20148.0.7 620353dbe230 */
/* bench 20148.0.8 81b720d9b8c5 */
/* bench 20148.0.9 d931c61ee13d */
/* bench 20148.0.10 ff11d0aaa866 */
/* bench 20148.0.11 2639373a4e7a */
/* bench 20148.0.12 d856db4e00d8 */
/* bench 20148.0.13 d6ab840223e8 */
/* bench 20148.0.14 7ce12747467b */
/* bench 20148.0.15 b3532ece3658 */
		bootargs = "console=ttyS0,115200n8";
		stdout-path = &uart0;
	};

	gpio-fan-100-32-35 {
		status = "okay";
	};

	gpio-leds-hdd-21-2 {
		status = "okay";
	};
};

&s35390a {
	status = "okay";
};
