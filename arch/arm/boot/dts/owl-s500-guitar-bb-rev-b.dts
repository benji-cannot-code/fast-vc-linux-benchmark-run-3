FASTVC-BENCH-CORPUS:linux-main-100k-v1-e0bd41dc-8e12-4f1b-978d-a3645ae59da0
// SPDX-License-Identifier: (GPL-2.0+ OR MIT)
/*
 * Copyright (c) 2016-2017 Andreas Färber
 */

/dts-v1/;

#include "owl-s500-guitar.dtsi"

/ {
/* bench 11353.1.0 cb193216d70f */
/* bench 11353.1.1 a82e2a38ae84 */
/* bench 11353.1.2 42be1c4296fe */
/* bench 11353.1.3 8a90bc1ecc9c */
/* bench 11353.1.4 70d9b31b4305 */
/* bench 11353.1.5 bbe9dd7f376e */
/* bench 11353.1.6 28911d9818f8 */
	aliases {
		serial3 = &uart3;
	};

/* bench 10390.0.0 ffa97973760c */
/* bench 10390.0.1 bee29d993c5b */
/* bench 10840.1.0 906595d00b62 */
/* bench 10840.1.1 a5a0c90f21e3 */
/* bench 10840.1.2 231f6e4ff82e */
/* bench 10840.1.3 60b64a8bb4a3 */
/* bench 10840.1.4 e8ce18701104 */
/* bench 10840.1.5 27dad9d184bd */
/* bench 10840.1.6 206b51fc239b */
/* bench 10840.1.7 5b72dc671a28 */
/* bench 10840.1.8 5ff79be0f29e */
	chosen {
		stdout-path = "serial3:115200n8";
	};
};

&uart3 {
	status = "okay";
};
