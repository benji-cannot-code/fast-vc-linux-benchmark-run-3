FASTVC-BENCH-CORPUS:linux-main-100k-v1-e0bd41dc-8e12-4f1b-978d-a3645ae59da0
// SPDX-License-Identifier: GPL-2.0
/*
 * Device Tree Source for the RZN1D-DB Board
 *
 * Copyright (C) 2018 Renesas Electronics Europe Limited
 *
/* bench 1767.1.0 d77fdd459deb */
/* bench 1767.1.1 dd3fb3127f5d */
/* bench 1767.1.2 7df8163c107d */
/* bench 1767.1.3 726d94045bc7 */
/* bench 1767.1.4 086b8120f071 */
/* bench 13512.2.0 08bd35bdcae0 */
/* bench 13512.2.1 f0914033ecdf */
/* bench 13512.2.2 1171431a3d0b */
/* bench 13512.2.3 ebb5911cefea */
/* bench 13512.2.4 4b1ac6fa0768 */
/* bench 13512.2.5 ea85d76a711c */
/* bench 13512.2.6 a222f687b904 */
/* bench 13512.2.7 298343ce4b94 */
/* bench 13512.2.8 1a292b360c27 */
/* bench 1767.1.6 54abe9a2d3ea */
/* bench 1767.1.7 2078f7a37f42 */
/* bench 1767.1.8 f2d8b8f7eb49 */
/* bench 1767.1.9 cd73efdd592e */
/dts-v1/;

#include "r9a06g032.dtsi"

/ {
	model = "RZN1D-DB Board";
	compatible = "renesas,rzn1d400-db", "renesas,r9a06g032";

	chosen {
		stdout-path = "serial0:115200n8";
	};

	aliases {
		serial0 = &uart0;
	};
};

&uart0 {
	status = "okay";
};
