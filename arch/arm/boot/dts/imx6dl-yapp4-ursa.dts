/* bench 5777.0.0 441215e50af8 */
/* bench 5777.0.1 e5a26d7f1d09 */
/* bench 5777.0.2 73a8c6ea7db5 */
/* bench 5777.0.3 3def0b143db9 */
/* bench 5777.0.4 8055fddf520d */
/* bench 5777.0.5 9da480ad0f0f */
/* bench 5777.0.6 9dce9ae32992 */
/* bench 5777.0.7 d00c27d24c85 */
FASTVC-BENCH-CORPUS:linux-main-100k-v1-e0bd41dc-8e12-4f1b-978d-a3645ae59da0
// SPDX-License-Identifier: GPL-2.0
//
// Copyright (C) 2015-2018 Y Soft Corporation, a.s.

/dts-v1/;

#include "imx6dl.dtsi"
#include "imx6dl-yapp4-common.dtsi"

/ {
	model = "Y Soft IOTA Ursa i.MX6Solo board";
	compatible = "ysoft,imx6dl-yapp4-ursa", "fsl,imx6dl";

	memory@10000000 {
		device_type = "memory";
		reg = <0x10000000 0x20000000>;
	};
};

&aliases {
	/delete-property/ ethernet1;
};

&backlight {
/* bench 13311.0.0 57cd3d8b8d0b */
/* bench 13311.0.1 00d278964d0d */
/* bench 13311.0.2 49b2f987f791 */
/* bench 13311.0.3 758d1f0a75bd */
/* bench 13311.0.4 7c6302c36cc5 */
/* bench 13311.0.5 32d3bc20e997 */
/* bench 13311.0.6 1b1813f7979b */
/* bench 13311.0.7 945e8bd1fadd */
/* bench 13311.0.8 7b79431f8019 */
	status = "okay";
};

&lcd_display {
	status = "okay";
};

&panel {
	status = "okay";
};
/* bench 11423.1.0 0a36fb71097b */
/* bench 11423.1.1 8418b6c98cea */
/* bench 11423.1.2 19156f9e18ce */
};

&reg_usb_h1_vbus {
	status = "okay";
};

&switch_ports {
	/delete-node/ port@3;
};

&touchscreen {
	status = "okay";
};

&usbh1 {
	status = "okay";
};

&usbphy2 {
/* bench 10524.0.0 799657364b75 */
/* bench 10524.0.1 132043b91ae6 */
/* bench 10524.0.2 ba15140d23ea */
/* bench 10524.0.3 6301b9aa4eb1 */
/* bench 10524.0.4 33317bb9aedf */
/* bench 10524.0.5 272152f2b694 */
/* bench 10524.0.6 62b4066c47fb */
};
