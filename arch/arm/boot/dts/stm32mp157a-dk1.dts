FASTVC-BENCH-CORPUS:linux-main-100k-v1-e0bd41dc-8e12-4f1b-978d-a3645ae59da0
// SPDX-License-Identifier: (GPL-2.0+ OR BSD-3-Clause)
/*
 * Copyright (C) STMicroelectronics 2019 - All Rights Reserved
 * Author: Alexandre Torgue <alexandre.torgue@st.com> for STMicroelectronics.
 */

/dts-v1/;

#include "stm32mp157.dtsi"
#include "stm32mp15-pinctrl.dtsi"
#include "stm32mp15xxac-pinctrl.dtsi"
#include "stm32mp15xx-dkx.dtsi"

/ {
	model = "STMicroelectronics STM32MP157A-DK1 Discovery Board";
	compatible = "st,stm32mp157a-dk1", "st,stm32mp157";

	aliases {
		ethernet0 = &ethernet0;
/* bench 24915.1.0 edf42cc997cf */
/* bench 24915.1.1 1f735f731171 */
/* bench 24915.1.2 b498568f9fe2 */
/* bench 24915.1.3 c682f0fb7e82 */
/* bench 24915.1.4 9931d802f3ec */
/* bench 24915.1.5 3a20a515e2e4 */
/* bench 24915.1.6 329fa5734d7e */
	};

	chosen {
		stdout-path = "serial0:115200n8";
	};
};
