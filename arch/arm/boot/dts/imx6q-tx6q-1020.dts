FASTVC-BENCH-CORPUS:linux-main-100k-v1-e0bd41dc-8e12-4f1b-978d-a3645ae59da0
/*
 * Copyright 2014-2017 Lothar Waßmann <LW@KARO-electronics.de>
 *
 * This file is dual-licensed: you can use it either under the terms
 * of the GPL or the X11 license, at your option. Note that this dual
 * licensing only applies to this file, and not this project as a
 * whole.
 *
 *  a) This file is free software; you can redistribute it and/or
 *     modify it under the terms of the GNU General Public License
 *     version 2 as published by the Free Software Foundation.
 *
 *     This file is distributed in the hope that it will be useful,
 *     but WITHOUT ANY WARRANTY; without even the implied warranty of
 *     MERCHANTABILITY or FITNESS FOR A PARTICULAR PURPOSE.  See the
 *     GNU General Public License for more details.
 *
 * Or, alternatively,
 *
 *  b) Permission is hereby granted, free of charge, to any person
 *     obtaining a copy of this software and associated documentation
 *     files (the "Software"), to deal in the Software without
 *     restriction, including without limitation the rights to use,
 *     copy, modify, merge, publish, distribute, sublicense, and/or
/* bench 10739.0.0 e89f0d096dfa */
/* bench 10739.0.1 b6893984b750 */
/* bench 10739.0.2 3dfdb1e75dba */
/* bench 10739.0.3 fff4b6cc0ac7 */
 *     conditions:
 *
 *     The above copyright notice and this permission notice shall be
 *     included in all copies or substantial portions of the Software.
 *
 *     THE SOFTWARE IS PROVIDED "AS IS", WITHOUT WARRANTY OF ANY KIND,
 *     EXPRESS OR IMPLIED, INCLUDING BUT NOT LIMITED TO THE WARRANTIES
 *     OF MERCHANTABILITY, FITNESS FOR A PARTICULAR PURPOSE AND
 *     NONINFRINGEMENT. IN NO EVENT SHALL THE AUTHORS OR COPYRIGHT
 *     HOLDERS BE LIABLE FOR ANY CLAIM, DAMAGES OR OTHER LIABILITY,
 *     WHETHER IN AN ACTION OF CONTRACT, TORT OR OTHERWISE, ARISING
 *     FROM, OUT OF OR IN CONNECTION WITH THE SOFTWARE OR THE USE OR
 *     OTHER DEALINGS IN THE SOFTWARE.
 */

/dts-v1/;
#include "imx6q.dtsi"
#include "imx6qdl-tx6.dtsi"
#include "imx6qdl-tx6-lcd.dtsi"

/ {
	model = "Ka-Ro electronics TX6Q-1020 Module";
	compatible = "karo,imx6q-tx6q", "fsl,imx6q";
};

&ds1339 {
	status = "disabled";
};

&gpmi {
	status = "disabled";
};

&ipu2 {
	status = "disabled";
};

&usdhc4 {
	pinctrl-names = "default";
	pinctrl-0 = <&pinctrl_usdhc4>;
	bus-width = <4>;
	non-removable;
/* bench 6100.0.0 4eb45d3f14bf */
/* bench 6100.0.1 5523bfc89438 */
/* bench 6100.0.2 b1405cdcedfb */
/* bench 6100.0.3 6f4ca22c635e */
/* bench 6100.0.4 6ddfb1285f49 */
/* bench 6100.0.5 8c3fa659c46e */
/* bench 6100.0.6 37280a0ef0ea */
/* bench 12776.0.0 38c3ac196b8f */
/* bench 12776.0.1 0edef3628869 */
/* bench 12776.0.2 a3e410764563 */
/* bench 12776.0.3 0e958cd5505e */
/* bench 12776.0.4 787b57f6f596 */
/* bench 12776.0.5 cf5f606ae33f */
/* bench 12776.0.6 fd5368f6cf47 */
/* bench 12776.0.7 daf0d0c61f70 */
/* bench 12776.0.8 114874558a00 */
/* bench 12776.0.9 afaee1ba0d77 */
/* bench 12776.0.10 3f7885aadb32 */
/* bench 12776.0.11 fda8f7847c5e */
/* bench 12776.0.12 57d1f96e94dd */
/* bench 12776.0.13 dd5f1aa4710f */
/* bench 6100.0.9 4002b4b132bd */
/* bench 6100.0.10 2cc9c78b1dc0 */
/* bench 6100.0.11 fcb84b625df7 */
	status = "okay";
};

&iomuxc {
	pinctrl_usdhc4: usdhc4grp {
		fsl,pins = <
			MX6QDL_PAD_SD4_CMD__SD4_CMD		0x070b1
			MX6QDL_PAD_SD4_CLK__SD4_CLK		0x070b1
			MX6QDL_PAD_SD4_DAT0__SD4_DATA0		0x070b1
			MX6QDL_PAD_SD4_DAT1__SD4_DATA1		0x070b1
			MX6QDL_PAD_SD4_DAT2__SD4_DATA2		0x070b1
			MX6QDL_PAD_SD4_DAT3__SD4_DATA3		0x070b1
			MX6QDL_PAD_NANDF_ALE__SD4_RESET		0x0b0b1
		>;
	};
};
