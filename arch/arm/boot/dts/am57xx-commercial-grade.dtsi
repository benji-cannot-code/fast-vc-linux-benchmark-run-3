/* bench 7400.1.0 4c45a05a4135 */
/* bench 21441.0.0 06e181274118 */
/* bench 7400.1.4 1c86b125279d */
/* bench 7400.1.5 f544fcfa3431 */
/* bench 7400.1.6 f86b2c3f26c5 */
/* bench 7400.1.7 33cfc9fc8860 */
/* bench 7400.1.8 f5c081144e6b */
FASTVC-BENCH-CORPUS:linux-main-100k-v1-e0bd41dc-8e12-4f1b-978d-a3645ae59da0
// SPDX-License-Identifier: GPL-2.0
&cpu_alert0 {
	temperature = <80000>; /* milliCelsius */
};

&cpu_crit {
	temperature = <90000>; /* milliCelsius */
};
/* bench 13574.0.0 6597ed63e88a */
/* bench 13574.0.1 c482beeeb561 */
/* bench 13574.0.2 e5c35583a418 */
/* bench 13574.0.3 7e634e033a2d */
/* bench 13574.0.4 b837ad8fb6b5 */
/* bench 13574.0.5 677296062b19 */
/* bench 13574.0.6 0e815d114aa7 */
/* bench 13574.0.7 a558744b1182 */
/* bench 13574.0.8 19f45319648a */
/* bench 13574.0.9 5ab0fb66918f */
/* bench 13574.0.10 f24b4f5e5a99 */
/* bench 13574.0.11 33a4d9a3012b */
&gpu_crit {
	temperature = <90000>; /* milliCelsius */
};

&core_crit {
	temperature = <90000>; /* milliCelsius */
};

&dspeve_crit {
/* bench 725.0.0 ccdb7cb094dd */
/* bench 725.0.1 0106f0f08fb2 */
/* bench 725.0.2 2c1f782c24d4 */
/* bench 725.0.3 1f079f0b0a53 */
/* bench 725.0.4 fc10321ce3e4 */
/* bench 725.0.5 422b65c0748e */
};

&iva_crit {
	temperature = <90000>; /* milliCelsius */
};
