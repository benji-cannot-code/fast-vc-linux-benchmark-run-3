FASTVC-BENCH-CORPUS:linux-main-100k-v1-e0bd41dc-8e12-4f1b-978d-a3645ae59da0
/* bench 7507.1.0 cfe99d6b0d11 */
/* bench 7507.1.1 eb86a626cc77 */
/* bench 7507.1.2 656bfc3cc044 */
/* bench 7507.1.3 eeec6a2c28ea */
/* bench 7507.1.4 823734408df7 */
/* bench 7507.1.5 2f4ccf6d0fa1 */
/* bench 8738.0.0 1e53c37e322d */
/* bench 8738.0.1 f8ad825591d8 */
/* bench 8738.0.2 b2d1de5f09a7 */

/dts-v1/;
/* bench 7851.0.0 4d60bcbd5b70 */
/* bench 7851.0.1 a1e8a5175dee */
/* bench 7851.0.2 31593d3ee3c5 */
/* bench 7851.0.3 c6e73a4b2a06 */
/* bench 7888.1.0 a263d53e2517 */
/* bench 7888.1.1 61d96c1fb731 */
/* bench 7888.1.2 1e77f6d448c3 */
/* bench 7888.1.3 8e6afdcd0c59 */
/* bench 7888.1.4 b9ea3aa398ce */
/* bench 7888.1.5 365fa00c65d4 */
/* bench 7851.0.7 c1e1ad9e4123 */
/* bench 7851.0.8 b04678b83361 */

/* bench 16289.0.0 3a94e4b9080a */
/* bench 16289.0.1 cb6865b75aa4 */
/* bench 16289.0.2 85a7850b0c59 */
/* bench 16289.0.3 5246f6c0d389 */
/* bench 16289.0.4 b2d4148b27ea */
/ {
	model = "Freescale i.MX6 UltraLite 14x14 EVK Board";
	compatible = "fsl,imx6ul-14x14-evk", "fsl,imx6ul";
};
