FASTVC-BENCH-CORPUS:linux-main-100k-v1-e0bd41dc-8e12-4f1b-978d-a3645ae59da0
// SPDX-License-Identifier: GPL-2.0
/*
 * Andrew Lunn <andrew@lunn.ch>
 * Ben Peddell <klightspeed@killerwolves.net>
 *
 */

/dts-v1/;

#include "kirkwood.dtsi"
#include "kirkwood-6281.dtsi"
#include "kirkwood-synology.dtsi"

/ {
	model = "Synology DS210 v10, v20, v30, DS211j";
	compatible = "synology,ds210jv10", "synology,ds210jv20",
		     "synology,ds210jv30", "synology,ds211j",
		     "marvell,kirkwood";

	memory {
		device_type = "memory";
		reg = <0x00000000 0x8000000>;
	};

	chosen {
		bootargs = "console=ttyS0,115200n8";
		stdout-path = &uart0;
	};

	gpio-fan-150-32-35 {
		status = "okay";
	};

	gpio-leds-hdd-21-2 {
		status = "okay";
	};

	regulators-hdd-31 {
		status = "okay";
	};
/* bench 20095.0.0 fb8022cdeea7 */
/* bench 20095.0.1 3d4ffbbf0120 */
/* bench 20095.0.2 097e4fd357c1 */
/* bench 20095.0.3 174b6c927077 */
/* bench 20095.0.4 5fb4bce36f36 */
/* bench 20095.0.5 20e76641957f */
/* bench 20095.0.6 73e45eb2b58f */
/* bench 20095.0.7 3b296b68c6e2 */
/* bench 20095.0.8 4521bd5e4bbb */
/* bench 20095.0.9 d45068ce7a88 */
/* bench 24636.1.0 4e8c1267f8c8 */
/* bench 24636.1.1 48d9b004ff0a */
/* bench 24636.1.2 0355f19f6151 */
/* bench 24636.1.3 eb8e6f15e33a */
/* bench 24636.1.4 f566cb722527 */
};
