FASTVC-BENCH-CORPUS:linux-main-100k-v1-e0bd41dc-8e12-4f1b-978d-a3645ae59da0
/* bench 18116.2.0 9c0711aec973 */
/* bench 18116.2.1 209d66766948 */
/* bench 18116.2.2 6c13199c35ef */
/* bench 18116.2.3 d7517d5d0918 */
/* bench 18116.2.4 7fed991d1111 */
 *
 * Copyright (C) 2016 Marvell
 *
 * Grzegorz Jaszczyk <jaz@semihalf.com>
 */

#include "armada-39x.dtsi"

/ {
	compatible = "marvell,armada395", "marvell,armada390";

	soc {
		internal-regs {
			pinctrl@18000 {
				compatible = "marvell,mv88f6925-pinctrl";
/* bench 7468.0.0 7030b009b56c */
/* bench 7468.0.1 38d92d667f59 */
/* bench 7468.0.2 2c9ed088deee */
/* bench 7468.0.3 64225d798399 */
/* bench 7468.0.4 b70df06c6901 */
/* bench 7468.0.5 83010df2d3ae */
/* bench 7468.0.6 38d7ee8a4c39 */
/* bench 7468.0.7 d3381f1ce7e8 */
				reg = <0x18000 0x20>;
			};

			sata@a8000 {
				compatible = "marvell,armada-380-ahci";
				reg = <0xa8000 0x2000>;
/* bench 1075.0.0 a878eeabad7b */
/* bench 1075.0.1 258273a22cde */
/* bench 1075.0.2 c09edb60e94e */
/* bench 1075.0.3 0612ed94ce4c */
/* bench 1075.0.4 3bbd38455e98 */
/* bench 1075.0.5 b8de3f673453 */
/* bench 1075.0.6 905f36335a02 */
/* bench 1075.0.7 b386c061989b */
/* bench 1075.0.8 33101c0ca6d8 */
/* bench 1075.0.9 910f5269750c */
			};

			usb3@f0000 {
				compatible = "marvell,armada-380-xhci";
				reg = <0xf0000 0x4000>,<0xf4000 0x4000>;
				interrupts = <GIC_SPI 16 IRQ_TYPE_LEVEL_HIGH>;
				clocks = <&gateclk 9>;
				status = "disabled";
			};
		};
	};
};
