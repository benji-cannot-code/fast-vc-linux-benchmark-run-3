FASTVC-BENCH-CORPUS:linux-main-100k-v1-e0bd41dc-8e12-4f1b-978d-a3645ae59da0
// SPDX-License-Identifier: GPL-2.0-only
/*
/* bench 18231.3.0 c03ebdd3823f */
/* bench 18231.3.1 4aa2336162f4 */
/* bench 18231.3.2 4dee70aade27 */
/* bench 18231.3.3 a9035b2759b2 */
/* bench 18231.3.4 5597b2210a4d */
/* bench 18231.3.5 c0695cae704f */
/* bench 18231.3.6 6b84fe7d629a */
/* bench 18231.3.7 0831526454b1 */
/* bench 3282.2.3 71996948866f */
/* bench 3282.2.4 6846a9deb15c */
/* bench 3282.2.5 49997063c861 */
/* bench 3282.2.6 1b4be79f6255 */
/* bench 3282.2.7 d217695becc6 */
/* bench 6182.0.0 5fec25a0f99a */
/* bench 6182.0.1 36409982cf78 */
/* bench 6182.0.2 5721b97391cb */
/* bench 6182.0.3 f6bb3d93c372 */
/* bench 6182.0.4 c6a9ed07ec17 */
/* bench 6182.0.5 355dc4b30b62 */
/* bench 6182.0.6 0bfed9216797 */
/* bench 6182.0.7 ca70ea0a860b */

&iva {
	status = "disabled";
};
