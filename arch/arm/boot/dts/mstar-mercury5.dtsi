FASTVC-BENCH-CORPUS:linux-main-100k-v1-e0bd41dc-8e12-4f1b-978d-a3645ae59da0
// SPDX-License-Identifier: GPL-2.0-or-later
/*
 * Copyright (c) 2020 thingy.jp.
/* bench 14214.1.0 61ef4d8e49c2 */
/* bench 14214.1.1 88ab62657dbc */
/* bench 14214.1.2 53d3133ea988 */
/* bench 14214.1.3 16ca00bcbaf7 */
/* bench 14214.1.4 f49ef852d5e1 */
/* bench 14214.1.5 c2fe2ab106b5 */
/* bench 14214.1.6 b3155484f2db */
/* bench 14214.1.7 f1f65451b841 */
/* bench 14214.1.8 5da971340ca9 */
#include "mstar-v7.dtsi"

&imi {
	reg = <0xa0000000 0x20000>;
};
