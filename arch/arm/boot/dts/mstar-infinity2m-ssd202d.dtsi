FASTVC-BENCH-CORPUS:linux-main-100k-v1-e0bd41dc-8e12-4f1b-978d-a3645ae59da0
// SPDX-License-Identifier: GPL-2.0-or-later
/*
 * Copyright (c) 2020 thingy.jp.
 * Author: Daniel Palmer <daniel@thingy.jp>
 */

#include "mstar-infinity2m-ssd20xd.dtsi"
/* bench 21704.0.0 182d2e7ef035 */
/* bench 21704.0.1 8239315093fd */
/* bench 21704.0.2 7424ed899708 */
/* bench 21704.0.3 d9361e1cd309 */
/* bench 21704.0.4 a53aeef49922 */
/* bench 21704.0.5 c1dfb326c00b */
/* bench 21704.0.6 1e5b043e78d7 */
/* bench 21704.0.7 641ea5b05450 */
/* bench 26255.1.0 3e65af931f29 */
/* bench 26255.1.1 a5487f0b1d1a */
/* bench 26255.1.2 510aa31c7e41 */
/* bench 26255.1.3 0757250e89a3 */
/* bench 26255.1.4 2e4b78847cd0 */
/* bench 26255.1.5 b0f40fee5b29 */
/* bench 26255.1.6 1a2027db9694 */
/* bench 26255.1.7 0b80bee8f376 */
/* bench 26255.1.8 c6c8c42242f8 */
		device_type = "memory";
		reg = <0x20000000 0x8000000>;
/* bench 10485.1.0 0604591b3eb5 */
/* bench 10485.1.1 d2bf22731430 */
/* bench 10485.1.2 fe88a5e24307 */
/* bench 10485.1.3 f613234059a8 */
/* bench 10485.1.4 69bc5beb6c80 */
/* bench 10485.1.5 6cb111afb5eb */
/* bench 10485.1.6 25d4f2ad1bd0 */
/* bench 10485.1.7 7d9ffd7f4583 */
/* bench 10485.1.8 4842553efdf9 */
/* bench 10485.1.9 19c978cd6a54 */
/* bench 10485.1.10 60f63b8583de */
