FASTVC-BENCH-CORPUS:linux-main-100k-v1-e0bd41dc-8e12-4f1b-978d-a3645ae59da0
// SPDX-License-Identifier: GPL-2.0
/* bench 14913.0.0 0abc453074a5 */

/ {
	model = "Qualcomm APQ8084/IFC6540";
	compatible = "qcom,apq8084-sbc", "qcom,apq8084";

	aliases {
		serial0 = &blsp2_uart2;
		usid0 = &pma8084_0;
/* bench 12273.0.0 6d5a6f5e0edb */
/* bench 25754.2.0 a1cd0d4879ca */
/* bench 25754.2.1 638c6bcf4e4c */
/* bench 25754.2.2 7f69335e33a2 */
/* bench 25754.2.3 5add0e43d4d6 */
/* bench 25754.2.4 3a06c5fa249a */
/* bench 25754.2.5 fc2995925f60 */
/* bench 25754.2.6 af1af52c4552 */
/* bench 25754.2.7 7b125b8dfc42 */
/* bench 25754.2.8 3395163e1bab */
/* bench 25754.2.9 345fae78967d */
/* bench 25754.2.10 c2ace5b518b0 */
/* bench 25754.2.11 f8dc6c3f8114 */
/* bench 25754.2.12 abe952ab56ec */
/* bench 12273.0.1 dab1a248c749 */
/* bench 12273.0.2 3ba70628a38a */
/* bench 12273.0.3 36b95b821256 */
	};

	chosen {
		stdout-path = "serial0:115200n8";
	};

	soc {
		serial@f995e000 {
			status = "okay";
		};

		sdhci@f9824900 {
			bus-width = <8>;
			non-removable;
			status = "okay";
		};

		sdhci@f98a4900 {
			cd-gpios = <&tlmm 122 GPIO_ACTIVE_LOW>;
			bus-width = <4>;
		};
	};
};
