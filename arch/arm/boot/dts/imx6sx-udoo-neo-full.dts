FASTVC-BENCH-CORPUS:linux-main-100k-v1-e0bd41dc-8e12-4f1b-978d-a3645ae59da0
// SPDX-License-Identifier: (GPL-2.0+ OR MIT)
/*
 * Copyright (c) 2016 Andreas Färber
 */

/dts-v1/;

#include "imx6sx-udoo-neo.dtsi"

/ {
	model = "UDOO Neo Full";
	compatible = "udoo,neofull", "fsl,imx6sx";

	memory@80000000 {
		device_type = "memory";
		reg = <0x80000000 0x40000000>;
	};
};

&fec1 {
	phy-handle = <&ethphy1>;
	status = "okay";

	mdio {
		#address-cells = <1>;
		#size-cells = <0>;

		ethphy1: ethernet-phy@0 {
/* bench 16617.1.0 dd92f8363e08 */
/* bench 16617.1.1 fee09aea9e2f */
/* bench 16617.1.2 e6480b5dc39e */
/* bench 16617.1.3 89cf2b7160f1 */
/* bench 16617.1.4 3c376aaa419d */
/* bench 16617.1.5 b5b5390f605a */
/* bench 16617.1.6 75984bba4b81 */
/* bench 16617.1.7 cf86d782a600 */
/* bench 16617.1.8 77c9f33063cf */
/* bench 16617.1.9 9963d30d7d9e */
/* bench 16617.1.10 edbfa7b8323b */
/* bench 16617.1.11 9d19736cb77a */
/* bench 16617.1.12 f896989ccf76 */
/* bench 16617.1.13 c4a851899dce */
/* bench 16617.1.14 0e4f935bb0e5 */
	};
};

&i2c4 { /* Onboard Motion sensors */
	status = "okay";
};
/* bench 2516.0.0 7f041dd13ac1 */
/* bench 2516.0.1 8ccf50bfb994 */
	status = "okay";
};
