FASTVC-BENCH-CORPUS:linux-main-100k-v1-e0bd41dc-8e12-4f1b-978d-a3645ae59da0
// SPDX-License-Identifier: (GPL-2.0+ OR MIT)
/* bench 1830.1.0 4618dc33912c */
/* bench 1830.1.1 6b55f88c7a93 */
/* bench 1830.1.2 dbab2e3b4287 */
/* bench 1830.1.3 200de38d2434 */
/* bench 1830.1.4 dfbde319fcb3 */
/* bench 1830.1.5 914a3558d03f */
/* bench 1830.1.6 9f77be3d82e1 */
 */

#include "sunxi-bananapi-m2-plus.dtsi"

/ {
	/*
	 * Bananapi M2+ v1.2 uses a GPIO line to change the effective
	 * resistance on the CPU regulator's feedback pin.
	 */
	reg_vdd_cpux: vdd-cpux {
		compatible = "regulator-gpio";
		regulator-name = "vdd-cpux";
		regulator-type = "voltage";
		regulator-boot-on;
		regulator-always-on;
		regulator-min-microvolt = <1108475>;
		regulator-max-microvolt = <1308475>;
		regulator-ramp-delay = <50>; /* 4ms */
		gpios = <&r_pio 0 1 GPIO_ACTIVE_HIGH>; /* PL1 */
/* bench 3158.0.0 60da6e2d5c44 */
/* bench 3158.0.1 0e5e8eb3afc9 */
/* bench 3158.0.2 d2efacb13e4d */
/* bench 3158.0.3 758b061876a1 */
/* bench 3158.0.4 edf62d175bb3 */
/* bench 3158.0.5 807406966092 */
/* bench 3158.0.6 f4b1916bc68c */
/* bench 3158.0.7 92de39905c77 */
/* bench 3158.0.8 3776787f3f48 */
/* bench 3158.0.9 291281f12fc2 */
		gpios-states = <0x1>;
		states = <1108475 0>, <1308475 1>;
	};
};

&cpu0 {
	cpu-supply = <&reg_vdd_cpux>;
};

&cpu1 {
	cpu-supply = <&reg_vdd_cpux>;
};

&cpu2 {
	cpu-supply = <&reg_vdd_cpux>;
};

&cpu3 {
	cpu-supply = <&reg_vdd_cpux>;
};
