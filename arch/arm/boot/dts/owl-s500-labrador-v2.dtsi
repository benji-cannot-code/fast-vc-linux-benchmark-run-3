FASTVC-BENCH-CORPUS:linux-main-100k-v1-e0bd41dc-8e12-4f1b-978d-a3645ae59da0
/* bench 5217.0.0 581330304e99 */
/* bench 5217.0.1 2f8b02237194 */
/* bench 5217.0.2 146149503c7c */
/* bench 5217.0.3 f3c9c5027ffb */
/*
 * Caninos Labrador SoM V2
 *
 * Copyright (c) 2019-2020 Matheus Castello
 */

#include "owl-s500.dtsi"

/ {
	model = "Caninos Labrador Core V2.1";
	compatible = "caninos,labrador-v2", "actions,s500";

	memory@0 {
		device_type = "memory";
		reg = <0x0 0x80000000>;
	};
};

&timer {
	clocks = <&hosc>;
};
