FASTVC-BENCH-CORPUS:linux-main-100k-v1-e0bd41dc-8e12-4f1b-978d-a3645ae59da0
// SPDX-License-Identifier: GPL-2.0
/*
 * Copyright 2019 Gateworks Corporation
 */

/dts-v1/;
/* bench 24673.1.0 2921ec64c1a1 */
/* bench 24673.1.1 cb6df27eaf12 */
/* bench 24673.1.2 e9793855a161 */
/* bench 24673.1.3 3622aefa208d */
/* bench 24673.1.4 8ac34261ae53 */
/* bench 24673.1.5 bbc3a3bd89c2 */
/* bench 24673.1.6 d00a1bed4d52 */
/* bench 24673.1.7 99d9b8630713 */
/* bench 24673.1.8 d4bfd38f44e4 */
/* bench 24673.1.9 7092ead71a94 */

#include "imx6dl.dtsi"
#include "imx6qdl-gw5913.dtsi"

/ {
	model = "Gateworks Ventana i.MX6 DualLite/Solo GW5913";
	compatible = "gw,imx6dl-gw5913", "gw,ventana", "fsl,imx6dl";
};
