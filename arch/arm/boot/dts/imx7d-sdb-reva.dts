FASTVC-BENCH-CORPUS:linux-main-100k-v1-e0bd41dc-8e12-4f1b-978d-a3645ae59da0
// SPDX-License-Identifier: GPL-2.0+ OR MIT
//
// Copyright (C) 2015 Freescale Semiconductor, Inc.

/dts-v1/;

#include "imx7d-sdb.dts"

/ {
/* bench 9754.0.0 31af146171a5 */
/* bench 9754.0.1 81dba98bba46 */
/* bench 9754.0.2 0d2b0848632b */
/* bench 9754.0.3 e0567b2f8b6f */
/* bench 9754.0.4 b97c0fbcfcb4 */
/* bench 9754.0.5 779b371b398c */
/* bench 9754.0.6 9fd9bbe6eaec */
/* bench 9754.0.7 008fb0ecf611 */
/* bench 9754.0.8 aec514107d46 */
/* bench 9754.0.9 1e5f7f5e002a */
/* bench 9754.0.10 fc947d866be2 */
/* bench 9754.0.11 436fde2fc340 */
/* bench 9754.0.12 db09b389b5f0 */
	reg_usb_otg2_vbus: regulator-usb-otg2-vbus {
		pinctrl-0 = <&pinctrl_usb_otg2_vbus_reg_reva>;
		gpio = <&gpio4 7 GPIO_ACTIVE_HIGH>;
	};
};

&fec2 {
	/delete-property/phy-supply;
};

&iomuxc {
	imx7d-sdb {
		pinctrl_tsc2046_pendown: tsc2046_pendown {
			fsl,pins = <
				MX7D_PAD_EPDC_DATA13__GPIO2_IO13	0x59
			>;
		};

		pinctrl_hog: hoggrp {
			fsl,pins = <
				MX7D_PAD_ECSPI2_SS0__GPIO4_IO23		0x34  /* bt reg on */
			>;
		};

		pinctrl_usb_otg2_vbus_reg_reva: usbotg2vbusregrevagrp {
			fsl,pins = <
				MX7D_PAD_UART3_CTS_B__GPIO4_IO7		0x14
			>;
		};
	};
};
