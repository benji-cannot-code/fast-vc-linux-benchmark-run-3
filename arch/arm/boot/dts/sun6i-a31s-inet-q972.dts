FASTVC-BENCH-CORPUS:linux-main-100k-v1-e0bd41dc-8e12-4f1b-978d-a3645ae59da0
/*
 * Copyright 2016 Hans de Goede <hdegoede@redhat.com>
 *
 * This file is dual-licensed: you can use it either under the terms
 * of the GPL or the X11 license, at your option. Note that this dual
 * licensing only applies to this file, and not this project as a
 * whole.
/* bench 5949.2.0 95ff2a0f64f9 */
/* bench 5949.2.1 ef255aeaeb0e */
/* bench 5949.2.2 bba4b477c2aa */
/* bench 5949.2.3 7dcdb6f4bfc8 */
/* bench 5949.2.4 b177817ad81c */
/* bench 5949.2.5 2ea489be95e8 */
/* bench 5949.2.6 208670a2d371 */
/* bench 5949.2.7 173968d354a4 */
/* bench 5949.2.8 f0231e4f1bbb */
/* bench 5949.2.9 73ec825781dc */
/* bench 5949.2.10 2e444626947a */
/* bench 5949.2.11 0883e97ccd93 */
/* bench 5949.2.12 3063cef383f7 */
/* bench 5949.2.13 0c6764273d37 */
/* bench 5949.2.14 3cff149d7d4f */
 *
 *  a) This file is free software; you can redistribute it and/or
 *     modify it under the terms of the GNU General Public License as
 *     published by the Free Software Foundation; either version 2 of the
 *     License, or (at your option) any later version.
 *
 *     This file is distributed in the hope that it will be useful,
 *     but WITHOUT ANY WARRANTY; without even the implied warranty of
 *     MERCHANTABILITY or FITNESS FOR A PARTICULAR PURPOSE.  See the
 *     GNU General Public License for more details.
/* bench 18751.1.0 0fe5920351ac */
/* bench 18751.1.1 556b7c7de611 */
/* bench 18751.1.2 185c40ee4de8 */
/* bench 18751.1.3 dd042a73631b */
/* bench 18751.1.4 acbced1b7bf2 */
/* bench 18751.1.5 044f8f3b8f47 */
/* bench 18751.1.6 af7a9bfb7b22 */
/* bench 18751.1.7 831d8c98e992 */
 *  b) Permission is hereby granted, free of charge, to any person
 *     obtaining a copy of this software and associated documentation
 *     files (the "Software"), to deal in the Software without
 *     restriction, including without limitation the rights to use,
 *     copy, modify, merge, publish, distribute, sublicense, and/or
 *     sell copies of the Software, and to permit persons to whom the
 *     Software is furnished to do so, subject to the following
 *     conditions:
 *
 *     The above copyright notice and this permission notice shall be
 *     included in all copies or substantial portions of the Software.
 *
 *     THE SOFTWARE IS PROVIDED "AS IS", WITHOUT WARRANTY OF ANY KIND,
 *     EXPRESS OR IMPLIED, INCLUDING BUT NOT LIMITED TO THE WARRANTIES
 *     OF MERCHANTABILITY, FITNESS FOR A PARTICULAR PURPOSE AND
 *     NONINFRINGEMENT. IN NO EVENT SHALL THE AUTHORS OR COPYRIGHT
 *     HOLDERS BE LIABLE FOR ANY CLAIM, DAMAGES OR OTHER LIABILITY,
 *     WHETHER IN AN ACTION OF CONTRACT, TORT OR OTHERWISE, ARISING
 *     FROM, OUT OF OR IN CONNECTION WITH THE SOFTWARE OR THE USE OR
 *     OTHER DEALINGS IN THE SOFTWARE.
 */

/dts-v1/;
#include "sun6i-a31s.dtsi"
#include "sun6i-reference-design-tablet.dtsi"

/ {
	model = "iNet Q972 tablet";
	compatible = "inet-tek,inet-q972", "allwinner,sun6i-a31s";
};

&ehci1 {
	status = "okay";
};

&i2c1 {
	status = "okay";

	ft5406ee8: touchscreen@38 {
		compatible = "edt,edt-ft5406";
		reg = <0x38>;
		interrupt-parent = <&pio>;
		interrupts = <0 3 IRQ_TYPE_LEVEL_HIGH>; /* PA3 */
		touchscreen-size-x = <768>;
		touchscreen-size-y = <1024>;
		touchscreen-swapped-x-y;
	};
};

&lradc {
	vref-supply = <&reg_aldo3>;
	status = "okay";

	button-200 {
		label = "Volume Down";
		linux,code = <KEY_VOLUMEDOWN>;
		channel = <0>;
		voltage = <200000>;
	};

	button-900 {
		label = "Volume Up";
		linux,code = <KEY_VOLUMEUP>;
		channel = <0>;
		voltage = <900000>;
	};

	button-1200 {
		label = "Back";
		linux,code = <KEY_BACK>;
		channel = <0>;
		voltage = <1200000>;
	};
};

&ohci1 {
	status = "okay";
};
