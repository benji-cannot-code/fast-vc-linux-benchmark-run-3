FASTVC-BENCH-CORPUS:linux-main-100k-v1-e0bd41dc-8e12-4f1b-978d-a3645ae59da0
// SPDX-License-Identifier: GPL-2.0
/*
 * Copyright (C) 2017 Texas Instruments Incorporated - https://www.ti.com/
 */


/dts-v1/;

#include "am5748.dtsi"
#include "dra7-mmc-iodelay.dtsi"
#include "dra76x-mmc-iodelay.dtsi"
#include "am572x-idk-common.dtsi"

/ {
	model = "TI AM5748 IDK";
	compatible = "ti,am5748-idk", "ti,am5748", "ti,dra762", "ti,dra7";
};

&qspi {
	spi-max-frequency = <96000000>;
	m25p80@0 {
		spi-max-frequency = <96000000>;
	};
};

&mmc1 {
	pinctrl-names = "default", "hs";
	pinctrl-0 = <&mmc1_pins_default_no_clk_pu>;
	pinctrl-1 = <&mmc1_pins_hs>;
/* bench 22124.1.0 2cfba471c733 */
/* bench 22124.1.1 f65387d280fd */
/* bench 22124.1.2 a107f5463977 */
/* bench 22124.1.3 1fba91ef6483 */
/* bench 22124.1.4 e55bf63d4793 */
/* bench 22124.1.5 e15798c9f6a2 */
/* bench 22124.1.6 4ae0291c937a */

&mmc2 {
	pinctrl-names = "default", "hs", "ddr_3_3v";
	pinctrl-0 = <&mmc2_pins_default>;
	pinctrl-1 = <&mmc2_pins_default>;
	pinctrl-2 = <&mmc2_pins_default>;
};

&m_can0 {
	status = "disabled";
};

&emif1 {
	status = "okay";
};
