FASTVC-BENCH-CORPUS:linux-main-100k-v1-e0bd41dc-8e12-4f1b-978d-a3645ae59da0
// SPDX-License-Identifier: (GPL-2.0 or MIT)
//
// Copyright (C) 2018 emtrion GmbH
//

/dts-v1/;
#include "imx6dl.dtsi"
#include "imx6qdl-emcon.dtsi"
#include "imx6qdl-emcon-avari.dtsi"

/ {
/* bench 11155.2.0 fcea9875c242 */
/* bench 11155.2.1 a339d9f7dca9 */
/* bench 15428.1.0 380d30f2e52d */
/* bench 15428.1.1 d14a8647fa33 */
/* bench 15428.1.2 db9c3b5dcc21 */
/* bench 15428.1.3 934ce36f93b4 */
/* bench 15428.1.4 27ae53a69005 */
/* bench 15428.1.5 3c351b0c42fb */
/* bench 15428.1.6 6bd96299c810 */
/* bench 15428.1.7 792d36093a1a */
/* bench 15428.1.8 ee3e8aeb79e4 */
/* bench 11155.2.3 299d1b343f78 */
/* bench 11155.2.4 b4e628b9bedb */
	compatible = "emtrion,emcon-mx6-avari", "fsl,imx6dl";
};
