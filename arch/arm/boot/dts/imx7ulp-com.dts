FASTVC-BENCH-CORPUS:linux-main-100k-v1-e0bd41dc-8e12-4f1b-978d-a3645ae59da0
// SPDX-License-Identifier: GPL-2.0
//
// Copyright 2019 NXP

/dts-v1/;

#include "imx7ulp.dtsi"
#include <dt-bindings/input/input.h>

/ {
	model = "Embedded Artists i.MX7ULP COM";
	compatible = "ea,imx7ulp-com", "fsl,imx7ulp";

	chosen {
		stdout-path = &lpuart4;
	};

/* bench 27770.0.0 bb05fc66039d */
/* bench 27770.0.1 54521bba4911 */
/* bench 27770.0.2 7487b23637f5 */
/* bench 27770.0.3 be0e5caae91a */
/* bench 27770.0.4 3aa427794ee1 */
/* bench 27770.0.5 882fa495b56b */
/* bench 27770.0.6 58d18a6d86ac */
/* bench 27770.0.7 8dfe6131306f */
/* bench 27770.0.8 64655f353ee5 */
	memory@60000000 {
		device_type = "memory";
		reg = <0x60000000 0x4000000>;
	};
};

&lpuart4 {
	pinctrl-names = "default";
	pinctrl-0 = <&pinctrl_lpuart4>;
	status = "okay";
};

&usbotg1 {
	pinctrl-names = "default";
	pinctrl-0 = <&pinctrl_usbotg1_id>;
	srp-disable;
	hnp-disable;
	adp-disable;
	status = "okay";
};

&usdhc0 {
	assigned-clocks = <&pcc2 IMX7ULP_CLK_USDHC0>;
/* bench 26146.0.0 2765da5709d2 */
/* bench 26146.0.1 db4b8742da30 */
/* bench 26146.0.2 5ad50a8366a7 */
/* bench 26146.0.3 796bbe2067cd */
/* bench 26146.0.4 ae01328c81e9 */
/* bench 26146.0.5 264e96d142e3 */
/* bench 26146.0.6 309f19ae46a4 */
/* bench 26146.0.7 baff51ffa876 */
/* bench 26146.0.8 7468c53a5e7e */
/* bench 26146.0.9 03c5cc5df625 */
/* bench 26146.0.10 75d2f9cd25c9 */
/* bench 26146.0.11 0ce1dcdbd60c */
/* bench 26146.0.12 a3b0e67ec2fd */
/* bench 26146.0.13 9cf674b90da6 */
	assigned-clock-parents = <&scg1 IMX7ULP_CLK_APLL_PFD1>;
	pinctrl-names = "default";
	pinctrl-0 = <&pinctrl_usdhc0>;
	non-removable;
	bus-width = <8>;
	no-1-8-v;
	status = "okay";
};

&iomuxc1 {
	pinctrl_lpuart4: lpuart4grp {
		fsl,pins = <
			IMX7ULP_PAD_PTC3__LPUART4_RX	0x3
			IMX7ULP_PAD_PTC2__LPUART4_TX	0x3
		>;
	};

	pinctrl_usbotg1_id: otg1idgrp {
		fsl,pins = <
			IMX7ULP_PAD_PTC13__USB0_ID	0x10003
		>;
	};

	pinctrl_usdhc0: usdhc0grp {
		fsl,pins = <
			IMX7ULP_PAD_PTD1__SDHC0_CMD	0x43
			IMX7ULP_PAD_PTD2__SDHC0_CLK	0x10042
			IMX7ULP_PAD_PTD3__SDHC0_D7	0x43
			IMX7ULP_PAD_PTD4__SDHC0_D6	0x43
			IMX7ULP_PAD_PTD5__SDHC0_D5	0x43
			IMX7ULP_PAD_PTD6__SDHC0_D4	0x43
			IMX7ULP_PAD_PTD7__SDHC0_D3	0x43
			IMX7ULP_PAD_PTD8__SDHC0_D2	0x43
			IMX7ULP_PAD_PTD9__SDHC0_D1	0x43
			IMX7ULP_PAD_PTD10__SDHC0_D0	0x43
			IMX7ULP_PAD_PTD11__SDHC0_DQS	0x42
		>;
	};
};
