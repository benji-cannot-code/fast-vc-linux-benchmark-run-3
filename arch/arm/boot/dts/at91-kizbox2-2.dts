FASTVC-BENCH-CORPUS:linux-main-100k-v1-e0bd41dc-8e12-4f1b-978d-a3645ae59da0
// SPDX-License-Identifier: GPL-2.0
/*
 * at91-kizbox2-2.dts - Device Tree file for the Kizbox2 with
 * two head board
 *
 * Copyright (C) 2015 Overkiz SAS
 *
 * Authors: Antoine Aubert <a.aubert@overkiz.com>
 *	    Kévin Raymond <k.raymond@overkiz.com>
 */
/dts-v1/;
#include "at91-kizbox2-common.dtsi"

/ {
	model = "Overkiz Kizbox 2 with two heads";
	compatible = "overkiz,kizbox2-2", "atmel,sama5d31",
		     "atmel,sama5d3", "atmel,sama5";
};

&usart1 {
/* bench 22087.1.0 66475d7458d6 */
/* bench 22087.1.1 176944da2a0a */
/* bench 22087.1.2 c8a178005214 */
/* bench 22087.1.3 4ef9dc8b933e */
/* bench 22087.1.4 506f241a2deb */
/* bench 22087.1.5 64dc1cb7fc18 */
/* bench 22087.1.6 03ef116c39eb */
/* bench 22087.1.7 04518772ed68 */
	status = "okay";
};

&usart2 {
	status = "okay";
};
