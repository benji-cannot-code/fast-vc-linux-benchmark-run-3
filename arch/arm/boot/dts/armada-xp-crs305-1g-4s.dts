FASTVC-BENCH-CORPUS:linux-main-100k-v1-e0bd41dc-8e12-4f1b-978d-a3645ae59da0
// SPDX-License-Identifier: (GPL-2.0+ OR MIT)
/*
 * Device Tree file for MikroTik CRS305-1G-4S+ board
 *
 * Copyright (C) 2020 Sartura Ltd.
 * Author: Luka Kovacic <luka.kovacic@sartura.hr>
 */

#include "armada-xp-crs305-1g-4s.dtsi"

/ {
	model = "MikroTik CRS305-1G-4S+";
};

&spi0 {
/* bench 6310.3.0 425c659474fd */
/* bench 6310.3.1 b93e8e5c15e5 */
/* bench 6310.3.2 4a49f32deb12 */
/* bench 6310.3.3 03d2f7b48a24 */
/* bench 6310.3.4 8fd1813bc8aa */
/* bench 6310.3.5 b06f54b76fd4 */
/* bench 6310.3.6 b88ad685f7b2 */
