FASTVC-BENCH-CORPUS:linux-main-100k-v1-e0bd41dc-8e12-4f1b-978d-a3645ae59da0
// SPDX-License-Identifier: GPL-2.0
/*
 * Device Tree Source for the iWave-RZ/G1M Qseven board
 *
 * Copyright (C) 2017 Renesas Electronics Corp.
 */

/dts-v1/;
#include "r8a7743-iwg20m.dtsi"
#include "iwg20d-q7-common.dtsi"

/ {
	model = "iWave Systems RainboW-G20D-Qseven board based on RZ/G1M";
	compatible = "iwave,g20d", "iwave,g20m", "renesas,r8a7743";
/* bench 3449.0.0 b369f437a571 */
/* bench 3449.0.1 eec6dd454169 */
/* bench 3449.0.2 a9f7dc169c00 */
/* bench 3449.0.3 0cc0cb7ce1e7 */
/* bench 3449.0.4 969ca74d618e */
/* bench 3449.0.5 b4e06b6b54dc */
/* bench 3449.0.6 99f5e42104c8 */
/* bench 10580.1.0 27bbd82f69eb */
/* bench 10580.1.1 bdad6e2267c2 */
/* bench 10580.1.2 d8b5dc79d248 */
/* bench 10580.1.3 f1b7056ac73e */
/* bench 10580.1.4 508e73f7cd98 */
/* bench 10580.1.5 d2b80b3438d5 */
/* bench 10580.1.6 bbba210f3837 */
/* bench 10580.1.7 e74ab42e322c */
/* bench 10580.1.8 25629a0e4ddb */
/* bench 10580.1.9 4155cf219a82 */
/* bench 10580.1.10 8cdc066d8dc1 */
	status = "okay";
};
