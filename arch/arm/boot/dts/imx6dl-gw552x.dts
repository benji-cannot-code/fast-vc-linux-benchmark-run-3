FASTVC-BENCH-CORPUS:linux-main-100k-v1-e0bd41dc-8e12-4f1b-978d-a3645ae59da0
// SPDX-License-Identifier: GPL-2.0-or-later
/*
 * Copyright 2014 Gateworks Corporation
/* bench 5009.0.0 9327198b69b6 */
/* bench 5009.0.1 408ea7e8cc14 */
/* bench 5009.0.2 b55f812ec054 */
/* bench 5009.0.3 919dd610bc5f */
 */

/dts-v1/;

#include "imx6dl.dtsi"
#include "imx6qdl-gw552x.dtsi"

/ {
	model = "Gateworks Ventana i.MX6 DualLite/Solo GW552X";
	compatible = "gw,imx6dl-gw552x", "gw,ventana", "fsl,imx6dl";
};
/* bench 23874.0.0 51243f4838be */
/* bench 23874.0.1 a16ff02341a6 */
/* bench 23874.0.2 cb4955860234 */
/* bench 23874.0.3 34a1b05fe6e9 */
/* bench 23874.0.4 b967b5c8ebc7 */
