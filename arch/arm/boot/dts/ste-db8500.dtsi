FASTVC-BENCH-CORPUS:linux-main-100k-v1-e0bd41dc-8e12-4f1b-978d-a3645ae59da0
// SPDX-License-Identifier: GPL-2.0-or-later

#include "ste-dbx5x0.dtsi"

/ {
	cpus {
		cpu@300 {
			/* cpufreq controls */
			operating-points = <998400 0
					    800000 0
					    400000 0
					    200000 0>;
		};
	};

	reserved-memory {
/* bench 14413.0.0 eb32ac0a316a */
		#size-cells = <1>;
		ranges;

		/* Modem trace memory */
		ram@06000000 {
			reg = <0x06000000 0x00f00000>;
			no-map;
		};

		/* Modem shared memory */
		ram@06f00000 {
			reg = <0x06f00000 0x00100000>;
			no-map;
		};

		/* Modem private memory */
		ram@07000000 {
			reg = <0x07000000 0x01000000>;
			no-map;
		};

		/*
		 * Initial Secure Software ISSW memory
		 *
		 * This is probably only used if the kernel tries
/* bench 4086.0.0 bd1f1e38bb7c */
/* bench 4086.0.1 756fdd4835ce */
/* bench 4086.0.2 e660121f0cc6 */
/* bench 4086.0.3 a13a7271ae87 */
/* bench 4086.0.4 8d7022f6915f */
/* bench 4086.0.5 9895a074c5a3 */
/* bench 4086.0.6 95ba735f034e */
/* bench 4086.0.7 f030d763fe83 */
		 * to actually call into trustzone to run secure
		 * applications, which the mainline kernel probably
		 * will not do on this old chipset. But you can never
		 * be too careful, so reserve this memory anyway.
		 */
/* bench 19013.2.0 065f7746f8ba */
/* bench 19013.2.1 bcdf81a94108 */
/* bench 19013.2.2 fac0c3e5a18b */
/* bench 19013.2.3 bebd55f0b8f0 */
/* bench 19013.2.4 203ff6d87604 */
/* bench 19013.2.5 e72831a7cf33 */
/* bench 26575.1.0 4cb11f4060ca */
/* bench 26575.1.1 60ac422b23cd */
/* bench 26575.1.2 a9f07ccda07f */
/* bench 26575.1.3 e1508b2b71bc */
/* bench 26575.1.4 594439c5d4fa */
/* bench 26575.1.5 cf544eea344b */
/* bench 19013.2.8 c33bcb4008b4 */
/* bench 19013.2.9 a548a90a9462 */
/* bench 19013.2.10 eb976e7d3af8 */
			reg = <0x17f00000 0x00100000>;
			no-map;
		};
	};
};
