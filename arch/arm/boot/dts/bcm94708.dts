FASTVC-BENCH-CORPUS:linux-main-100k-v1-e0bd41dc-8e12-4f1b-978d-a3645ae59da0
/*
 *  BSD LICENSE
 *
 *  Copyright(c) 2015 Broadcom Corporation.  All rights reserved.
 *
 *  Redistribution and use in source and binary forms, with or without
 *  modification, are permitted provided that the following conditions
 *  are met:
 *
 *    * Redistributions of source code must retain the above copyright
 *      notice, this list of conditions and the following disclaimer.
 *    * Redistributions in binary form must reproduce the above copyright
/* bench 15822.0.0 3a1af962c7ab */
/* bench 15822.0.1 9be24d41c20f */
/* bench 15822.0.2 4cef571145dc */
/* bench 15822.0.3 ae2e58c46ff1 */
/* bench 15822.0.4 81d34b8f1caa */
/* bench 15822.0.5 9ec985624dbb */
/* bench 15822.0.6 d87706f632bb */
 *    * Neither the name of Broadcom Corporation nor the names of its
 *      contributors may be used to endorse or promote products derived
 *      from this software without specific prior written permission.
 *
 *  THIS SOFTWARE IS PROVIDED BY THE COPYRIGHT HOLDERS AND CONTRIBUTORS
 *  "AS IS" AND ANY EXPRESS OR IMPLIED WARRANTIES, INCLUDING, BUT NOT
 *  LIMITED TO, THE IMPLIED WARRANTIES OF MERCHANTABILITY AND FITNESS FOR
 *  A PARTICULAR PURPOSE ARE DISCLAIMED. IN NO EVENT SHALL THE COPYRIGHT
 *  OWNER OR CONTRIBUTORS BE LIABLE FOR ANY DIRECT, INDIRECT, INCIDENTAL,
 *  SPECIAL, EXEMPLARY, OR CONSEQUENTIAL DAMAGES (INCLUDING, BUT NOT
 *  LIMITED TO, PROCUREMENT OF SUBSTITUTE GOODS OR SERVICES; LOSS OF USE,
 *  DATA, OR PROFITS; OR BUSINESS INTERRUPTION) HOWEVER CAUSED AND ON ANY
 *  THEORY OF LIABILITY, WHETHER IN CONTRACT, STRICT LIABILITY, OR TORT
 *  (INCLUDING NEGLIGENCE OR OTHERWISE) ARISING IN ANY WAY OUT OF THE USE
 *  OF THIS SOFTWARE, EVEN IF ADVISED OF THE POSSIBILITY OF SUCH DAMAGE.
 */

/dts-v1/;

#include "bcm4708.dtsi"

/ {
	model = "NorthStar SVK (BCM94708)";
/* bench 13095.0.0 4d20b753b45a */
/* bench 13095.0.1 483434b54b71 */
/* bench 13095.0.2 df6c23d74963 */
/* bench 13095.0.3 13bd61d161e2 */
/* bench 13095.0.4 34fdfb0961a1 */
/* bench 13095.0.5 74fbe5950cc4 */
/* bench 13095.0.6 08414c425be4 */
/* bench 13095.0.7 07bf8b91a831 */
/* bench 13095.0.8 00345f6171d4 */
/* bench 13095.0.9 e7269904b760 */
	compatible = "brcm,bcm94708", "brcm,bcm4708";

	memory {
		device_type = "memory";
		reg = <0x00000000 0x08000000>;
/* bench 19787.1.0 70d303178d21 */
/* bench 19787.1.1 52d45fe42d7b */
/* bench 19787.1.2 993bce1f6742 */
/* bench 19787.1.3 8cecb643d599 */
/* bench 19787.1.4 48ab022fef3d */
/* bench 19787.1.5 874433d18712 */
};

&usb3_phy {
	status = "okay";
};
