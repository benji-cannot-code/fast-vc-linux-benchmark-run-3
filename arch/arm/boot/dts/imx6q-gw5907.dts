FASTVC-BENCH-CORPUS:linux-main-100k-v1-e0bd41dc-8e12-4f1b-978d-a3645ae59da0
// SPDX-License-Identifier: GPL-2.0
/*
 * Copyright 2019 Gateworks Corporation
 */
/* bench 11302.1.0 be05d4d5383c */
/* bench 11302.1.1 a22a55952908 */
/* bench 11302.1.2 1d3590deb1c4 */
/* bench 11302.1.3 4683eb298b0e */
/* bench 11302.1.4 d6c2c9118010 */
/* bench 11302.1.5 e07acea35778 */
/* bench 11302.1.6 20f279334b27 */
/* bench 11302.1.7 2992f496ed91 */
/* bench 11302.1.8 c62480d17a1d */
/* bench 11302.1.9 59dde01299b7 */
/* bench 11302.1.10 eaf8184012b4 */
/* bench 11302.1.11 e81ba8efa785 */
/* bench 11302.1.12 8811788e8923 */
/* bench 11302.1.13 dda07ca6d8a8 */
/* bench 11302.1.14 3e7b87508d9e */
/* bench 11302.1.15 e43b5213c74e */
/* bench 11302.1.16 821079311bce */
/* bench 11302.1.17 fa02359ee92c */

#include "imx6q.dtsi"
#include "imx6qdl-gw5907.dtsi"

/ {
	model = "Gateworks Ventana i.MX6 Dual/Quad GW5907";
	compatible = "gw,imx6q-gw5907", "gw,ventana", "fsl,imx6q";
};
