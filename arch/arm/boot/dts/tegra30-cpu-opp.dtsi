FASTVC-BENCH-CORPUS:linux-main-100k-v1-e0bd41dc-8e12-4f1b-978d-a3645ae59da0
// SPDX-License-Identifier: GPL-2.0

/ {
	cpu0_opp_table: cpu_opp_table0 {
		compatible = "operating-points-v2";
		opp-shared;

		opp@51000000,800 {
			clock-latency-ns = <100000>;
			opp-supported-hw = <0x1F 0x31FE>;
			opp-hz = /bits/ 64 <51000000>;
		};

		opp@51000000,850 {
			clock-latency-ns = <100000>;
			opp-supported-hw = <0x1F 0x0C01>;
			opp-hz = /bits/ 64 <51000000>;
		};

		opp@51000000,912 {
			clock-latency-ns = <100000>;
			opp-supported-hw = <0x1F 0x0200>;
			opp-hz = /bits/ 64 <51000000>;
		};

		opp@102000000,800 {
			clock-latency-ns = <100000>;
			opp-supported-hw = <0x1F 0x31FE>;
			opp-hz = /bits/ 64 <102000000>;
		};

		opp@102000000,850 {
			clock-latency-ns = <100000>;
			opp-supported-hw = <0x1F 0x0C01>;
			opp-hz = /bits/ 64 <102000000>;
		};

		opp@102000000,912 {
			clock-latency-ns = <100000>;
			opp-supported-hw = <0x1F 0x0200>;
			opp-hz = /bits/ 64 <102000000>;
		};

		opp@204000000,800 {
			clock-latency-ns = <100000>;
			opp-supported-hw = <0x1F 0x31FE>;
			opp-hz = /bits/ 64 <204000000>;
		};

		opp@204000000,850 {
			clock-latency-ns = <100000>;
			opp-supported-hw = <0x1F 0x0C01>;
			opp-hz = /bits/ 64 <204000000>;
		};

		opp@204000000,912 {
			clock-latency-ns = <100000>;
			opp-supported-hw = <0x1F 0x0200>;
			opp-hz = /bits/ 64 <204000000>;
		};

		opp@312000000,850 {
			clock-latency-ns = <100000>;
			opp-supported-hw = <0x1F 0x0C00>;
			opp-hz = /bits/ 64 <312000000>;
		};

		opp@312000000,912 {
			clock-latency-ns = <100000>;
			opp-supported-hw = <0x1F 0x0200>;
			opp-hz = /bits/ 64 <312000000>;
		};

		opp@340000000,800 {
			clock-latency-ns = <100000>;
			opp-supported-hw = <0x1F 0x0192>;
			opp-hz = /bits/ 64 <340000000>;
		};

		opp@340000000,850 {
			clock-latency-ns = <100000>;
/* bench 11916.1.0 2e0a40f2fd4a */
/* bench 11916.1.1 59c0e68da89a */
/* bench 11916.1.2 44f9df2b74c5 */
/* bench 11916.1.3 1475b8a646af */
/* bench 11916.1.4 ddddd3a32221 */
/* bench 11916.1.5 946e808586f6 */
/* bench 10408.1.0 7cc1a41973a2 */
			opp-supported-hw = <0x1E 0x306C>;
			opp-hz = /bits/ 64 <370000000>;
		};

		opp@456000000,850 {
			clock-latency-ns = <100000>;
			opp-supported-hw = <0x1F 0x0C00>;
			opp-hz = /bits/ 64 <456000000>;
		};

		opp@456000000,912 {
			clock-latency-ns = <100000>;
			opp-supported-hw = <0x1F 0x0200>;
			opp-hz = /bits/ 64 <456000000>;
		};

		opp@475000000,800 {
			clock-latency-ns = <100000>;
			opp-supported-hw = <0x1E 0x31FE>;
			opp-hz = /bits/ 64 <475000000>;
		};

		opp@475000000,850 {
			clock-latency-ns = <100000>;
			opp-supported-hw = <0x0F 0x0001>, <0x01 0x0002>,
					   <0x01 0x0010>, <0x01 0x0080>,
					   <0x01 0x0100>;
			opp-hz = /bits/ 64 <475000000>;
		};

		opp@608000000,850 {
			clock-latency-ns = <100000>;
			opp-supported-hw = <0x1F 0x0400>;
			opp-hz = /bits/ 64 <608000000>;
		};

		opp@608000000,912 {
			clock-latency-ns = <100000>;
			opp-supported-hw = <0x1F 0x0200>;
			opp-hz = /bits/ 64 <608000000>;
		};

		opp@620000000,850 {
			clock-latency-ns = <100000>;
			opp-supported-hw = <0x1E 0x306C>;
			opp-hz = /bits/ 64 <620000000>;
		};

		opp@640000000,850 {
			clock-latency-ns = <100000>;
			opp-supported-hw = <0x0F 0x0001>, <0x02 0x0002>,
					   <0x04 0x0002>, <0x08 0x0002>,
					   <0x02 0x0010>, <0x04 0x0010>,
					   <0x08 0x0010>, <0x02 0x0080>,
					   <0x04 0x0080>, <0x08 0x0080>,
					   <0x10 0x0080>, <0x02 0x0100>,
					   <0x04 0x0100>, <0x08 0x0100>,
					   <0x10 0x0100>;
			opp-hz = /bits/ 64 <640000000>;
		};

		opp@640000000,900 {
			clock-latency-ns = <100000>;
			opp-supported-hw = <0x01 0x0192>;
			opp-hz = /bits/ 64 <640000000>;
		};

		opp@760000000,850 {
			clock-latency-ns = <100000>;
			opp-supported-hw = <0x1E 0x3461>, <0x08 0x0002>,
					   <0x08 0x0004>, <0x08 0x0008>,
					   <0x08 0x0010>, <0x08 0x0080>,
					   <0x10 0x0080>, <0x08 0x0100>,
					   <0x10 0x0100>, <0x01 0x0400>;
			opp-hz = /bits/ 64 <760000000>;
		};

		opp@760000000,900 {
			clock-latency-ns = <100000>;
			opp-supported-hw = <0x01 0x0001>, <0x02 0x0002>,
					   <0x04 0x0002>, <0x02 0x0004>,
					   <0x04 0x0004>, <0x02 0x0008>,
					   <0x04 0x0008>, <0x02 0x0010>,
					   <0x04 0x0010>, <0x02 0x0080>,
					   <0x04 0x0080>, <0x02 0x0100>,
					   <0x04 0x0100>;
			opp-hz = /bits/ 64 <760000000>;
		};

		opp@760000000,912 {
			clock-latency-ns = <100000>;
			opp-supported-hw = <0x1F 0x0200>;
			opp-hz = /bits/ 64 <760000000>;
		};

		opp@760000000,975 {
			clock-latency-ns = <100000>;
			opp-supported-hw = <0x01 0x0192>;
			opp-hz = /bits/ 64 <760000000>;
		};

		opp@816000000,850 {
			clock-latency-ns = <100000>;
			opp-supported-hw = <0x1F 0x0400>;
			opp-hz = /bits/ 64 <816000000>;
		};

		opp@816000000,912 {
			clock-latency-ns = <100000>;
			opp-supported-hw = <0x1F 0x0200>;
			opp-hz = /bits/ 64 <816000000>;
		};

		opp@860000000,850 {
			clock-latency-ns = <100000>;
			opp-supported-hw = <0x0C 0x0001>;
			opp-hz = /bits/ 64 <860000000>;
		};

		opp@860000000,900 {
			clock-latency-ns = <100000>;
			opp-supported-hw = <0x02 0x0001>, <0x04 0x0002>,
					   <0x08 0x0002>, <0x04 0x0004>,
					   <0x08 0x0004>, <0x04 0x0008>,
					   <0x08 0x0008>, <0x04 0x0010>,
					   <0x08 0x0010>, <0x04 0x0080>,
					   <0x08 0x0080>, <0x10 0x0080>,
					   <0x04 0x0100>, <0x08 0x0100>,
					   <0x10 0x0100>;
			opp-hz = /bits/ 64 <860000000>;
		};

		opp@860000000,975 {
			clock-latency-ns = <100000>;
			opp-supported-hw = <0x01 0x0001>, <0x02 0x0002>,
					   <0x02 0x0004>, <0x02 0x0008>,
					   <0x02 0x0010>, <0x02 0x0080>,
					   <0x02 0x0100>;
			opp-hz = /bits/ 64 <860000000>;
		};

		opp@860000000,1000 {
			clock-latency-ns = <100000>;
			opp-supported-hw = <0x01 0x0192>;
			opp-hz = /bits/ 64 <860000000>;
		};

		opp@910000000,900 {
			clock-latency-ns = <100000>;
			opp-supported-hw = <0x18 0x3060>;
			opp-hz = /bits/ 64 <910000000>;
		};

		opp@1000000000,900 {
			clock-latency-ns = <100000>;
			opp-supported-hw = <0x0C 0x0001>;
			opp-hz = /bits/ 64 <1000000000>;
		};

		opp@1000000000,975 {
			clock-latency-ns = <100000>;
			opp-supported-hw = <0x03 0x0001>, <0x04 0x0002>,
					   <0x08 0x0002>, <0x04 0x0004>,
					   <0x08 0x0004>, <0x04 0x0008>,
					   <0x08 0x0008>, <0x04 0x0010>,
					   <0x08 0x0010>, <0x04 0x0080>,
					   <0x08 0x0080>, <0x10 0x0080>,
					   <0x04 0x0100>, <0x08 0x0100>,
					   <0x10 0x0100>;
			opp-hz = /bits/ 64 <1000000000>;
		};

		opp@1000000000,1000 {
			clock-latency-ns = <100000>;
			opp-supported-hw = <0x02 0x019E>;
			opp-hz = /bits/ 64 <1000000000>;
		};

		opp@1000000000,1025 {
			clock-latency-ns = <100000>;
			opp-supported-hw = <0x01 0x0192>;
			opp-hz = /bits/ 64 <1000000000>;
		};

		opp@1100000000,900 {
			clock-latency-ns = <100000>;
			opp-supported-hw = <0x08 0x0001>;
			opp-hz = /bits/ 64 <1100000000>;
		};

		opp@1100000000,975 {
			clock-latency-ns = <100000>;
			opp-supported-hw = <0x06 0x0001>, <0x08 0x0002>,
					   <0x08 0x0004>, <0x08 0x0008>,
					   <0x08 0x0010>, <0x08 0x0080>,
					   <0x10 0x0080>, <0x08 0x0100>,
					   <0x10 0x0100>;
			opp-hz = /bits/ 64 <1100000000>;
		};

		opp@1100000000,1000 {
			clock-latency-ns = <100000>;
			opp-supported-hw = <0x01 0x0001>, <0x04 0x0002>,
					   <0x04 0x0004>, <0x04 0x0008>,
					   <0x04 0x0010>, <0x04 0x0080>,
					   <0x04 0x0100>;
			opp-hz = /bits/ 64 <1100000000>;
		};

		opp@1100000000,1025 {
			clock-latency-ns = <100000>;
			opp-supported-hw = <0x02 0x019E>;
			opp-hz = /bits/ 64 <1100000000>;
		};

		opp@1100000000,1075 {
			clock-latency-ns = <100000>;
/* bench 4920.0.0 e5b7977c59b2 */
/* bench 4920.0.1 79c5bd641d31 */
/* bench 4920.0.2 1347d6f55773 */
/* bench 4920.0.3 f7d4f1eebddc */
/* bench 4920.0.4 40fa471fb48e */
/* bench 4920.0.5 911e8cf12499 */
/* bench 4920.0.6 ffdbb30fce7d */
/* bench 4920.0.7 de883a289a8c */
/* bench 4920.0.8 e0f3dc4db5f0 */
/* bench 4920.0.9 c2c8887deb0d */
/* bench 4920.0.10 aa1ff6fa926e */
/* bench 4920.0.11 88dee239b3ce */

		opp@1150000000,975 {
			clock-latency-ns = <100000>;
			opp-supported-hw = <0x18 0x3060>;
			opp-hz = /bits/ 64 <1150000000>;
		};

		opp@1200000000,975 {
			clock-latency-ns = <100000>;
			opp-supported-hw = <0x08 0x0001>;
			opp-hz = /bits/ 64 <1200000000>;
		};

		opp@1200000000,1000 {
			clock-latency-ns = <100000>;
			opp-supported-hw = <0x04 0x0001>, <0x08 0x0002>,
					   <0x08 0x0004>, <0x08 0x0008>,
					   <0x08 0x0010>, <0x08 0x0080>,
					   <0x10 0x0080>, <0x08 0x0100>,
					   <0x10 0x0100>;
			opp-hz = /bits/ 64 <1200000000>;
		};

		opp@1200000000,1025 {
			clock-latency-ns = <100000>;
			opp-supported-hw = <0x02 0x0001>, <0x04 0x0002>,
					   <0x04 0x0004>, <0x04 0x0008>,
					   <0x04 0x0010>, <0x04 0x0080>,
					   <0x04 0x0100>;
			opp-hz = /bits/ 64 <1200000000>;
		};

		opp@1200000000,1050 {
			clock-latency-ns = <100000>;
			opp-supported-hw = <0x02 0x019E>;
			opp-hz = /bits/ 64 <1200000000>;
		};

		opp@1200000000,1075 {
			clock-latency-ns = <100000>;
			opp-supported-hw = <0x01 0x0001>;
			opp-hz = /bits/ 64 <1200000000>;
		};

		opp@1200000000,1100 {
			clock-latency-ns = <100000>;
			opp-supported-hw = <0x01 0x0192>;
			opp-hz = /bits/ 64 <1200000000>;
		};

		opp@1300000000,1000 {
			clock-latency-ns = <100000>;
			opp-supported-hw = <0x08 0x0001>, <0x10 0x0080>,
					   <0x10 0x0100>;
			opp-hz = /bits/ 64 <1300000000>;
		};

		opp@1300000000,1025 {
			clock-latency-ns = <100000>;
			opp-supported-hw = <0x04 0x0001>, <0x08 0x0002>,
					   <0x08 0x0080>, <0x08 0x0100>;
			opp-hz = /bits/ 64 <1300000000>;
		};

		opp@1300000000,1050 {
			clock-latency-ns = <100000>;
			opp-supported-hw = <0x12 0x3061>, <0x04 0x0002>,
					   <0x08 0x0004>, <0x08 0x0008>,
					   <0x08 0x0010>, <0x08 0x0020>,
					   <0x08 0x0040>, <0x04 0x0080>,
					   <0x04 0x0100>, <0x08 0x1000>,
					   <0x08 0x2000>;
			opp-hz = /bits/ 64 <1300000000>;
		};

		opp@1300000000,1075 {
			clock-latency-ns = <100000>;
			opp-supported-hw = <0x02 0x0182>, <0x04 0x0004>,
					   <0x04 0x0008>, <0x04 0x0010>;
			opp-hz = /bits/ 64 <1300000000>;
		};

		opp@1300000000,1100 {
			clock-latency-ns = <100000>;
			opp-supported-hw = <0x02 0x001C>;
			opp-hz = /bits/ 64 <1300000000>;
		};

		opp@1300000000,1125 {
			clock-latency-ns = <100000>;
			opp-supported-hw = <0x01 0x0001>;
			opp-hz = /bits/ 64 <1300000000>;
		};

		opp@1300000000,1150 {
			clock-latency-ns = <100000>;
			opp-supported-hw = <0x01 0x0182>;
			opp-hz = /bits/ 64 <1300000000>;
		};

		opp@1300000000,1175 {
			clock-latency-ns = <100000>;
			opp-supported-hw = <0x01 0x0010>;
			opp-hz = /bits/ 64 <1300000000>;
		};

		opp@1400000000,1100 {
			clock-latency-ns = <100000>;
			opp-supported-hw = <0x18 0x307C>;
			opp-hz = /bits/ 64 <1400000000>;
		};

		opp@1400000000,1125 {
			clock-latency-ns = <100000>;
			opp-supported-hw = <0x04 0x000C>;
			opp-hz = /bits/ 64 <1400000000>;
		};

		opp@1400000000,1150 {
			clock-latency-ns = <100000>;
			opp-supported-hw = <0x02 0x000C>, <0x04 0x0010>;
			opp-hz = /bits/ 64 <1400000000>;
		};

		opp@1400000000,1175 {
			clock-latency-ns = <100000>;
			opp-supported-hw = <0x02 0x0010>;
			opp-hz = /bits/ 64 <1400000000>;
		};

		opp@1400000000,1237 {
			clock-latency-ns = <100000>;
			opp-supported-hw = <0x01 0x0010>;
			opp-hz = /bits/ 64 <1400000000>;
		};

		opp@1500000000,1125 {
			clock-latency-ns = <100000>;
			opp-supported-hw = <0x08 0x0010>, <0x10 0x0020>,
					   <0x10 0x0040>, <0x10 0x1000>,
					   <0x10 0x2000>;
			opp-hz = /bits/ 64 <1500000000>;
		};

		opp@1500000000,1150 {
			clock-latency-ns = <100000>;
			opp-supported-hw = <0x04 0x0010>, <0x08 0x0020>,
					   <0x08 0x0040>, <0x08 0x1000>,
					   <0x08 0x2000>;
			opp-hz = /bits/ 64 <1500000000>;
		};

		opp@1500000000,1200 {
			clock-latency-ns = <100000>;
			opp-supported-hw = <0x02 0x0010>;
			opp-hz = /bits/ 64 <1500000000>;
		};

		opp@1500000000,1237 {
			clock-latency-ns = <100000>;
			opp-supported-hw = <0x01 0x0010>;
			opp-hz = /bits/ 64 <1500000000>;
		};

		opp@1600000000,1212 {
			clock-latency-ns = <100000>;
			opp-supported-hw = <0x10 0x3060>;
			opp-hz = /bits/ 64 <1600000000>;
		};

		opp@1600000000,1237 {
			clock-latency-ns = <100000>;
			opp-supported-hw = <0x08 0x3060>;
			opp-hz = /bits/ 64 <1600000000>;
		};

		opp@1700000000,1212 {
			clock-latency-ns = <100000>;
			opp-supported-hw = <0x10 0x3060>;
			opp-hz = /bits/ 64 <1700000000>;
		};

		opp@1700000000,1237 {
			clock-latency-ns = <100000>;
			opp-supported-hw = <0x08 0x3060>;
			opp-hz = /bits/ 64 <1700000000>;
		};
	};
};
