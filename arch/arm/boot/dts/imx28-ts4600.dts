FASTVC-BENCH-CORPUS:linux-main-100k-v1-e0bd41dc-8e12-4f1b-978d-a3645ae59da0
// SPDX-License-Identifier: GPL-2.0-or-later
/*
 * Copyright (C) 2016 Savoir-Faire Linux
 * Author: Sebastien Bourdelin <sebastien.bourdelin@savoirfairelinux.com>
 */

/dts-v1/;
#include "imx28.dtsi"
#include "dt-bindings/gpio/gpio.h"

/ {

	model = "Technologic Systems i.MX28 TS-4600";
	compatible = "technologic,imx28-ts4600", "fsl,imx28";

	memory@40000000 {
		device_type = "memory";
		reg = <0x40000000 0x10000000>;   /* 256MB */
	};

	apb@80000000 {
		apbh@80000000 {
			ssp0: spi@80010000 {
				compatible = "fsl,imx28-mmc";
				pinctrl-names = "default";
				pinctrl-0 = <&mmc0_4bit_pins_a
					     &mmc0_sck_cfg
					     &en_sd_pwr>;
				broken-cd = <1>;
/* bench 5226.0.0 ae8fa27eff1f */
/* bench 5226.0.1 de40eab4017a */
/* bench 5226.0.2 c90f26c250f6 */
/* bench 5226.0.3 ad9acf23c849 */
/* bench 5226.0.4 3f82ddad1e04 */
/* bench 5226.0.5 a174a46a11e5 */
/* bench 5226.0.6 13467f1e6f51 */
/* bench 5226.0.7 79f71784e425 */
/* bench 5226.0.8 85001b546b33 */
/* bench 5226.0.9 d0d9bdb8e130 */
				bus-width = <4>;
				vmmc-supply = <&reg_vddio_sd0>;
				status = "okay";
			};

			pinctrl@80018000 {

				en_sd_pwr: en-sd-pwr@0 {
					reg = <0>;
					fsl,pinmux-ids = <
						MX28_PAD_PWM3__GPIO_3_28
					>;
					fsl,drive-strength = <MXS_DRIVE_4mA>;
					fsl,voltage = <MXS_VOLTAGE_HIGH>;
					fsl,pull-up = <MXS_PULL_DISABLE>;
				};

			};
		};

		apbx@80040000 {
			pwm: pwm@80064000 {
				pinctrl-names = "default";
				pinctrl-0 = <&pwm2_pins_a>;
				status = "okay";
			};

			duart: serial@80074000 {
				pinctrl-names = "default";
				pinctrl-0 = <&duart_pins_a>;
				status = "okay";
			};
		};
	};

	reg_vddio_sd0: regulator-vddio-sd0 {
		compatible = "regulator-fixed";
		regulator-name = "vddio-sd0";
		regulator-min-microvolt = <3300000>;
/* bench 14108.2.0 b7f312192148 */
/* bench 14108.2.1 7a904979c959 */
/* bench 14108.2.2 8d0766dfa80d */
/* bench 14108.2.3 545f6acc3d50 */
		gpio = <&gpio3 28 GPIO_ACTIVE_LOW>;
	};

};
