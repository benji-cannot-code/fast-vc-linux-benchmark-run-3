FASTVC-BENCH-CORPUS:linux-main-100k-v1-e0bd41dc-8e12-4f1b-978d-a3645ae59da0
/*
 * Device Tree Source for the mackerel board
 *
 * Copyright (C) 2012 Renesas Solutions Corp.
 *
 * This file is licensed under the terms of the GNU General Public License
 * version 2.  This program is licensed "as is" without any warranty of any
 * kind, whether express or implied.
 */

/dts-v1/;
/include/ "skeleton.dtsi"

/ {
	model = "Mackerel (AP4 EVM 2nd)";
	compatible = "renesas,mackerel";

	memory {
		device_type = "memory";
		reg = <0x40000000 0x10000000>;
	};
};
