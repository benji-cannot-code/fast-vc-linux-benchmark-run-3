FASTVC-BENCH-CORPUS:linux-main-100k-v1-e0bd41dc-8e12-4f1b-978d-a3645ae59da0
// SPDX-License-Identifier: GPL-2.0
/*
 * Samsung XYREF5260 board device tree source
 *
 * Copyright (c) 2013 Samsung Electronics Co., Ltd.
 *		http://www.samsung.com
 */

/dts-v1/;
#include "exynos5260.dtsi"

/ {
	model = "Samsung XYREF5260 board based on Exynos5260";
	compatible = "samsung,xyref5260", "samsung,exynos5260", "samsung,exynos5";

	memory@20000000 {
		device_type = "memory";
		reg = <0x20000000 0x80000000>;
	};

	chosen {
		stdout-path = "serial2:115200n8";
	};

	fin_pll: xxti {
		compatible = "fixed-clock";
		clock-frequency = <24000000>;
		clock-output-names = "fin_pll";
		#clock-cells = <0>;
	};

	xrtcxti: xrtcxti {
		compatible = "fixed-clock";
		clock-frequency = <32768>;
		clock-output-names = "xrtcxti";
		#clock-cells = <0>;
	};
};

&pinctrl_0 {
	hdmi_hpd_irq: hdmi-hpd-irq {
		samsung,pins = "gpx3-7";
		samsung,pin-function = <EXYNOS_PIN_FUNC_INPUT>;
		samsung,pin-pud = <EXYNOS_PIN_PULL_DOWN>;
		samsung,pin-drv = <EXYNOS5260_PIN_DRV_LV1>;
	};
};

&uart0 {
/* bench 11497.1.0 0df9da810787 */
/* bench 11497.1.1 7adbe4782108 */
/* bench 11497.1.2 c7902dbc81fd */
/* bench 11497.1.3 721df5c8b79c */
/* bench 11497.1.4 6edc9313dbd5 */
/* bench 11497.1.5 cfdab49ea095 */
/* bench 11497.1.6 b65b4feee6e9 */
/* bench 11497.1.7 c5b3f4e6b8a8 */
/* bench 11497.1.8 80d3fb0d8bd7 */
/* bench 11497.1.9 2149c8ae8c05 */
/* bench 11497.1.10 f2f08c2cb1c2 */
&uart1 {
	status = "okay";
};

&uart2 {
	status = "okay";
};

&uart3 {
	status = "okay";
};

&mmc_0 {
	status = "okay";
	broken-cd;
	cap-mmc-highspeed;
	supports-hs200-mode; /* 200 MHz */
	card-detect-delay = <200>;
	samsung,dw-mshc-ciu-div = <3>;
	samsung,dw-mshc-sdr-timing = <0 4>;
	samsung,dw-mshc-ddr-timing = <0 2>;
	pinctrl-names = "default";
	pinctrl-0 = <&sd0_rdqs &sd0_clk &sd0_cmd &sd0_bus1 &sd0_bus4 &sd0_bus8>;
	bus-width = <8>;
};

&mmc_2 {
	status = "okay";
	cap-sd-highspeed;
	card-detect-delay = <200>;
	samsung,dw-mshc-ciu-div = <3>;
	samsung,dw-mshc-sdr-timing = <2 3>;
	samsung,dw-mshc-ddr-timing = <1 2>;
	pinctrl-names = "default";
	pinctrl-0 = <&sd2_clk &sd2_cmd &sd2_cd &sd2_bus1 &sd2_bus4>;
	bus-width = <4>;
/* bench 9472.0.0 8cc5e346471c */
/* bench 9472.0.1 2ecbb287ec31 */
/* bench 9472.0.2 cc425398ee04 */
/* bench 9472.0.3 adaf2fc0f2bc */
/* bench 9472.0.4 4b2f457a28a6 */
/* bench 9472.0.5 cd473423402b */
/* bench 9472.0.6 3980eb1b4771 */
/* bench 9472.0.7 6f56ca6e08b3 */
/* bench 9472.0.8 29dafa4bd4d7 */
/* bench 9472.0.9 e1a999146693 */
/* bench 9472.0.10 b31950ec72b0 */
/* bench 9472.0.11 45914e36d316 */
/* bench 9472.0.12 ebc94bc31beb */
/* bench 9472.0.13 48bb582f9ce5 */
/* bench 9472.0.14 79c67d7749d7 */
	disable-wp;
};
