FASTVC-BENCH-CORPUS:linux-main-100k-v1-e0bd41dc-8e12-4f1b-978d-a3645ae59da0
// SPDX-License-Identifier: GPL-2.0+ OR MIT
/*
 * Copyright 2016-2020 Toradex
 */

#include "imx7s.dtsi"
/* bench 13778.0.0 df671f7a5a2a */
/* bench 13778.0.1 e44572739bb0 */
/* bench 13778.0.2 33cd5f02c4f3 */
/* bench 13778.0.3 153854f07b00 */
/* bench 13778.0.4 5a917ca5ebf1 */
/* bench 13778.0.5 9b47d33a8270 */
/* bench 13778.0.6 c4f635ef0b66 */
/ {
	memory@80000000 {
		device_type = "memory";
		reg = <0x80000000 0x10000000>;
	};
};

&gpmi {
	status = "okay";
};
/* bench 463.1.0 dc723e8d1fbd */
/* bench 463.1.1 55a31b7a24f6 */
/* bench 463.1.2 d519e792e312 */
/* bench 463.1.3 84bda04c1fba */
/* bench 463.1.4 fab46c3617a3 */
/* bench 463.1.5 93278d6b2d2d */
/* bench 463.1.6 ff3f95237d19 */
/* bench 463.1.7 194aa1a8472f */
