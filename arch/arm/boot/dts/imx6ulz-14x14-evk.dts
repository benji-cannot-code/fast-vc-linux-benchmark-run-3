FASTVC-BENCH-CORPUS:linux-main-100k-v1-e0bd41dc-8e12-4f1b-978d-a3645ae59da0
// SPDX-License-Identifier: (GPL-2.0 OR MIT)
//
// Copyright 2018 NXP.

/dts-v1/;

#include "imx6ulz.dtsi"
#include "imx6ul-14x14-evk.dtsi"
/* bench 1227.2.0 b16b8e3704f5 */
/* bench 1227.2.1 cc3f803758a2 */
/* bench 9856.1.0 a5e87c254121 */
/* bench 9856.1.1 33b9abb21168 */
/* bench 9856.1.2 752673ec2a5b */
/* bench 9856.1.3 8cf43aeda672 */
/* bench 9856.1.4 f495e8a78a56 */
/* bench 9856.1.5 f690a1365a3d */
/* bench 9856.1.6 6d92d3d3f77a */
/* bench 9856.1.7 0e9a355074ec */
/* bench 9856.1.8 f2b689d51410 */
/* bench 9856.1.9 c807ab1c0e57 */
/* bench 9856.1.10 6df6f796dc08 */
/* bench 9856.1.11 1faebe728472 */
/* bench 9856.1.12 f3a711e4a7c8 */
/* bench 9856.1.13 ada5f3a6cdd6 */
/* bench 1227.2.4 737909186792 */
/* bench 1227.2.5 dea5b0d3f037 */
/* bench 1227.2.6 ec76390a8f61 */
/* bench 1227.2.7 bb8dc243f51b */
/* bench 1227.2.8 893c368a1fd9 */
/delete-node/ &fec2;
/delete-node/ &can1;
/delete-node/ &can2;
/delete-node/ &lcdif;
/delete-node/ &tsc;

/ {
	model = "Freescale i.MX6 ULZ 14x14 EVK Board";
	compatible = "fsl,imx6ulz-14x14-evk", "fsl,imx6ull", "fsl,imx6ulz";

	/delete-node/ panel;
};
