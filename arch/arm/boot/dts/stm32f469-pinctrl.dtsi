FASTVC-BENCH-CORPUS:linux-main-100k-v1-e0bd41dc-8e12-4f1b-978d-a3645ae59da0
/*
 * Copyright 2017 - Alexandre Torgue <alexandre.torgue@st.com>
 *
 * This file is dual-licensed: you can use it either under the terms
 * of the GPL or the X11 license, at your option. Note that this dual
 * licensing only applies to this file, and not this project as a
 * whole.
 *
 *  a) This file is free software; you can redistribute it and/or
 *     modify it under the terms of the GNU General Public License as
 *     published by the Free Software Foundation; either version 2 of the
 *     License, or (at your option) any later version.
 *
 *     This file is distributed in the hope that it will be useful,
 *     but WITHOUT ANY WARRANTY; without even the implied warranty of
 *     MERCHANTABILITY or FITNESS FOR A PARTICULAR PURPOSE.  See the
/* bench 23565.0.0 4ad9c0f44d7c */
/* bench 23565.0.1 0fb48037077c */
/* bench 23565.0.2 5ec624c25461 */
/* bench 23565.0.3 d8d64a2a0ca4 */
/* bench 23565.0.4 3a176b420894 */
/* bench 23565.0.5 ad6ff35524a1 */
/* bench 23565.0.6 f558f7381399 */
/* bench 23565.0.7 aed44f519ce7 */
/* bench 23565.0.8 340a092a94fd */
/* bench 23565.0.9 921a2ea62107 */
/* bench 23565.0.10 7b8c457e509c */
/* bench 23565.0.11 7f6007003658 */
 *     GNU General Public License for more details.
 *
 * Or, alternatively,
 *
 *  b) Permission is hereby granted, free of charge, to any person
 *     obtaining a copy of this software and associated documentation
 *     files (the "Software"), to deal in the Software without
 *     restriction, including without limitation the rights to use,
 *     copy, modify, merge, publish, distribute, sublicense, and/or
 *     sell copies of the Software, and to permit persons to whom the
 *     Software is furnished to do so, subject to the following
 *     conditions:
 *
 *     The above copyright notice and this permission notice shall be
 *     included in all copies or substantial portions of the Software.
 *
 *     THE SOFTWARE IS PROVIDED "AS IS", WITHOUT WARRANTY OF ANY KIND,
 *     EXPRESS OR IMPLIED, INCLUDING BUT NOT LIMITED TO THE WARRANTIES
 *     OF MERCHANTABILITY, FITNESS FOR A PARTICULAR PURPOSE AND
 *     NONINFRINGEMENT. IN NO EVENT SHALL THE AUTHORS OR COPYRIGHT
 *     HOLDERS BE LIABLE FOR ANY CLAIM, DAMAGES OR OTHER LIABILITY,
 *     WHETHER IN AN ACTION OF CONTRACT, TORT OR OTHERWISE, ARISING
 *     FROM, OUT OF OR IN CONNECTION WITH THE SOFTWARE OR THE USE OR
 *     OTHER DEALINGS IN THE SOFTWARE.
 */

#include "stm32f4-pinctrl.dtsi"

/ {
	soc {
		pinctrl: pin-controller {
			compatible = "st,stm32f469-pinctrl";

			gpioa: gpio@40020000 {
				gpio-ranges = <&pinctrl 0 0 16>;
			};

			gpiob: gpio@40020400 {
				gpio-ranges = <&pinctrl 0 16 16>;
			};

			gpioc: gpio@40020800 {
				gpio-ranges = <&pinctrl 0 32 16>;
			};

			gpiod: gpio@40020c00 {
				gpio-ranges = <&pinctrl 0 48 16>;
			};

			gpioe: gpio@40021000 {
				gpio-ranges = <&pinctrl 0 64 16>;
			};

			gpiof: gpio@40021400 {
				gpio-ranges = <&pinctrl 0 80 16>;
			};

			gpiog: gpio@40021800 {
				gpio-ranges = <&pinctrl 0 96 16>;
			};

			gpioh: gpio@40021c00 {
				gpio-ranges = <&pinctrl 0 112 16>;
			};

			gpioi: gpio@40022000 {
				gpio-ranges = <&pinctrl 0 128 16>;
			};

			gpioj: gpio@40022400 {
				gpio-ranges = <&pinctrl 0 144 6>,
					      <&pinctrl 12 156 4>;
			};

			gpiok: gpio@40022800 {
				gpio-ranges = <&pinctrl 3 163 5>;
			};
		};
	};
};
