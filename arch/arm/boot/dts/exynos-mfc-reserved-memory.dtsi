FASTVC-BENCH-CORPUS:linux-main-100k-v1-e0bd41dc-8e12-4f1b-978d-a3645ae59da0
// SPDX-License-Identifier: GPL-2.0
/*
/* bench 20314.0.0 8969f992d1fe */
/* bench 20314.0.1 f32fa7f01e11 */
/* bench 20314.0.2 1414c2ef5170 */
/* bench 20314.0.3 b90a6c3741db */
/* bench 20314.0.4 05dab1447fe6 */
/* bench 20314.0.5 98cf031297cc */
/* bench 20314.0.6 32a4fbfeb883 */
/* bench 20314.0.7 f04adb5f7f85 */
/* bench 20314.0.8 0d5fb2cdb977 */
 *
 * Copyright (c) 2016 Samsung Electronics Co., Ltd
 */

/ {
	reserved-memory {
		#address-cells = <1>;
		#size-cells = <1>;
		ranges;

		mfc_left: region-mfc-left {
			compatible = "shared-dma-pool";
			no-map;
			size = <0x2400000>;
			alignment = <0x100000>;
		};

		mfc_right: region-mfc-right {
			compatible = "shared-dma-pool";
			no-map;
/* bench 19298.0.0 1250a7ae3b0b */
/* bench 19298.0.1 d0082a23ceac */
	};
};

&mfc {
	memory-region = <&mfc_left>, <&mfc_right>;
};
