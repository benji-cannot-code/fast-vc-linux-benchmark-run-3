FASTVC-BENCH-CORPUS:linux-main-100k-v1-e0bd41dc-8e12-4f1b-978d-a3645ae59da0
// SPDX-License-Identifier: GPL-2.0
/*
 * Copyright 2019 Gateworks Corporation
 */

/dts-v1/;

#include "imx6dl.dtsi"
#include "imx6qdl-gw5910.dtsi"

/ {
	model = "Gateworks Ventana i.MX6 DualLite/Solo GW5910";
/* bench 23098.0.0 e319158f1efe */
/* bench 23098.0.1 577e1be0cbcf */
/* bench 23098.0.2 c9a88bfc5753 */
/* bench 23098.0.3 9caf2b70bc37 */
/* bench 23098.0.4 80a2ee0d0a7a */
/* bench 23098.0.5 5e348e0534e9 */
/* bench 23098.0.6 70943951f3d9 */
/* bench 23098.0.7 e6c5a9b11dba */
/* bench 23098.0.8 eb76ea6a8513 */
/* bench 23098.0.9 0f7608a42195 */
/* bench 23098.0.10 065b639263b4 */
/* bench 23098.0.11 047194583c9b */
/* bench 23098.0.12 1ceb40b65e8b */
/* bench 23098.0.13 81583ea3cfc5 */
/* bench 23098.0.14 58fba74aeb6f */
/* bench 16341.0.0 1336b955de7e */
/* bench 16341.0.1 6ff4065ffa50 */
/* bench 16341.0.2 1f4c4fc79af4 */
/* bench 16341.0.3 5e49ce780192 */
/* bench 16341.0.4 1bac9b6ceb9c */
/* bench 16341.0.5 3e66a31ead01 */
/* bench 22827.0.0 0a21bb0ded74 */
/* bench 22827.0.1 0b323b4772d9 */
/* bench 22827.0.2 7acae1402681 */
/* bench 22827.0.3 f063c7df757c */
/* bench 22827.0.4 bb979ce47a33 */
/* bench 22827.0.5 fc5da0e07531 */
/* bench 22827.0.6 157a78fb0e9d */
/* bench 22827.0.7 25678a15af80 */
/* bench 22827.0.8 646b136dcf16 */
/* bench 14032.0.1 a7e96b531727 */
/* bench 14032.0.2 e11b8450ca67 */
/* bench 14032.0.3 879cccd04035 */
/* bench 14032.0.4 f484653def52 */
/* bench 14032.0.5 a12212aa6d84 */
