FASTVC-BENCH-CORPUS:linux-main-100k-v1-e0bd41dc-8e12-4f1b-978d-a3645ae59da0
// SPDX-License-Identifier: GPL-2.0-only
/*
/* bench 28136.0.0 926a93751d82 */
/* bench 28136.0.1 9b990dcd00ef */
/* bench 28136.0.2 e07890ece154 */
/* bench 28136.0.3 8b9968982a49 */
/* bench 28136.0.4 6b8832567ccb */
/* bench 28136.0.5 d55b9fcca14b */
/* bench 28136.0.6 1c2ec2a5d5a9 */
/* bench 28136.0.7 fd4b0cd89347 */
/* bench 28136.0.8 3463c0156f5b */
/* bench 28136.0.9 128e891f332f */
/* bench 28136.0.10 3498ea81797e */
/* bench 28136.0.11 82cdadef06ba */
 * children of the IIO based ADC.
 *
 * Currently, used by Exynos5420 based Peach PIT and
 * Exynos5800 based Peach PI.
 *
 * Copyright (c) 2014 Samsung Electronics Co., Ltd.
*/

&adc {
	thermistor3 {
		compatible = "murata,ncp15wb473";
		pullup-uv = <1800000>;
		pullup-ohm = <47000>;
		pulldown-ohm = <0>;
		io-channels = <&adc 3>;
	};
	thermistor4 {
		compatible = "murata,ncp15wb473";
		pullup-uv = <1800000>;
		pullup-ohm = <47000>;
		pulldown-ohm = <0>;
		io-channels = <&adc 4>;
	};
	thermistor5 {
		compatible = "murata,ncp15wb473";
		pullup-uv = <1800000>;
		pullup-ohm = <47000>;
		pulldown-ohm = <0>;
		io-channels = <&adc 5>;
	};
	thermistor6 {
		compatible = "murata,ncp15wb473";
		pullup-uv = <1800000>;
		pullup-ohm = <47000>;
		pulldown-ohm = <0>;
		io-channels = <&adc 6>;
	};
};
