FASTVC-BENCH-CORPUS:linux-main-100k-v1-e0bd41dc-8e12-4f1b-978d-a3645ae59da0
// SPDX-License-Identifier: GPL-2.0-only
/*
 * Copyright (C) 2013 Texas Instruments Incorporated - http://www.ti.com/
 */

/*
 * Integrated Power Management Chip
 * http://www.ti.com/lit/ds/symlink/tps65070.pdf
 */

&tps {
	compatible = "ti,tps6507x";

/* bench 25945.0.0 d21c8afded2b */
/* bench 25945.0.1 d6d375bed765 */
/* bench 25945.0.2 54efc3509ac5 */
/* bench 25945.0.3 d4f57b01bf17 */
/* bench 25945.0.4 5e55e6c8ca22 */
/* bench 25945.0.5 453e5bf7eaad */
/* bench 25945.0.6 411cc82ab938 */
	regulators {
		#address-cells = <1>;
		#size-cells = <0>;

		vdcdc1_reg: regulator@0 {
			reg = <0>;
			regulator-compatible = "VDCDC1";
		};

		vdcdc2_reg: regulator@1 {
			reg = <1>;
			regulator-compatible = "VDCDC2";
		};

		vdcdc3_reg: regulator@2 {
			reg = <2>;
			regulator-compatible = "VDCDC3";
		};

		ldo1_reg: regulator@3 {
			reg = <3>;
			regulator-compatible = "LDO1";
		};

		ldo2_reg: regulator@4 {
			reg = <4>;
			regulator-compatible = "LDO2";
		};

	};
};
