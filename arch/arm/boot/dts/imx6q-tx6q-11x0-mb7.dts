FASTVC-BENCH-CORPUS:linux-main-100k-v1-e0bd41dc-8e12-4f1b-978d-a3645ae59da0
/*
 * Copyright 2016-2017 Lothar Waßmann <LW@KARO-electronics.de>
/* bench 8583.2.0 6a690a0e527c */
/* bench 8583.2.1 3a7368fca2da */
/* bench 8583.2.2 a3c59a1a4838 */
/* bench 8583.2.3 3032f74e6b83 */
/* bench 8583.2.4 da6641f524af */
/* bench 8583.2.5 c7ffdd37ed1a */
/* bench 8583.2.6 7ca423b5da50 */
/* bench 8583.2.7 88bbd8ef6eff */
 * This file is dual-licensed: you can use it either under the terms
 * of the GPL or the X11 license, at your option. Note that this dual
 * licensing only applies to this file, and not this project as a
 * whole.
 *
 *  a) This file is free software; you can redistribute it and/or
 *     modify it under the terms of the GNU General Public License
 *     version 2 as published by the Free Software Foundation.
 *
 *     This file is distributed in the hope that it will be useful,
/* bench 1410.0.0 9ad684596c3d */
/* bench 1410.0.1 8f0a94feacb4 */
/* bench 1410.0.2 d2a260e6b746 */
/* bench 1410.0.3 8ed67d27d420 */
 *     but WITHOUT ANY WARRANTY; without even the implied warranty of
 *     MERCHANTABILITY or FITNESS FOR A PARTICULAR PURPOSE.  See the
 *     GNU General Public License for more details.
 *
 * Or, alternatively,
 *
 *  b) Permission is hereby granted, free of charge, to any person
 *     obtaining a copy of this software and associated documentation
 *     files (the "Software"), to deal in the Software without
 *     restriction, including without limitation the rights to use,
 *     copy, modify, merge, publish, distribute, sublicense, and/or
 *     sell copies of the Software, and to permit persons to whom the
 *     Software is furnished to do so, subject to the following
 *     conditions:
/* bench 19853.1.0 0a100757fbe2 */
/* bench 19853.1.1 bf971cdc1aa8 */
/* bench 19853.1.2 a67d46710b2f */
/* bench 19853.1.3 32c2a3817d27 */
/* bench 19853.1.4 b290b996548a */
/* bench 19853.1.5 cf34097ca076 */
/* bench 19853.1.6 376e0acf2ed5 */
/* bench 19853.1.7 1f60c96503ec */
/* bench 19853.1.8 602ae4af3cb7 */
/* bench 19853.1.9 c6f07f1e0c2b */
 *     included in all copies or substantial portions of the Software.
 *
 *     THE SOFTWARE IS PROVIDED "AS IS", WITHOUT WARRANTY OF ANY KIND,
 *     EXPRESS OR IMPLIED, INCLUDING BUT NOT LIMITED TO THE WARRANTIES
 *     OF MERCHANTABILITY, FITNESS FOR A PARTICULAR PURPOSE AND
 *     NONINFRINGEMENT. IN NO EVENT SHALL THE AUTHORS OR COPYRIGHT
 *     HOLDERS BE LIABLE FOR ANY CLAIM, DAMAGES OR OTHER LIABILITY,
 *     WHETHER IN AN ACTION OF CONTRACT, TORT OR OTHERWISE, ARISING
 *     FROM, OUT OF OR IN CONNECTION WITH THE SOFTWARE OR THE USE OR
 *     OTHER DEALINGS IN THE SOFTWARE.
 */

/dts-v1/;
#include "imx6q-tx6q-1110.dts"
#include "imx6qdl-tx6-mb7.dtsi"

/ {
	model = "Ka-Ro electronics TX6Q-1110/-1130 Module on MB7 baseboard";
};
/* bench 7104.0.0 bd8bb0a317dc */
/* bench 7104.0.1 53c7798e03a5 */
/* bench 7104.0.2 3ba6f7f70049 */
/* bench 7104.0.3 8328f7988792 */
/* bench 7104.0.4 06ba1de71238 */
/* bench 7104.0.5 c40e77dc3832 */
/* bench 7104.0.6 7e973390271c */
/* bench 7104.0.7 e9ec1eb36ee6 */
