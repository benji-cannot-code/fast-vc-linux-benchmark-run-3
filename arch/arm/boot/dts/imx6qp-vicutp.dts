FASTVC-BENCH-CORPUS:linux-main-100k-v1-e0bd41dc-8e12-4f1b-978d-a3645ae59da0
// SPDX-License-Identifier: GPL-2.0-or-later OR MIT
/*
 * Copyright (c) 2014 Protonic Holland
 */

/dts-v1/;
/* bench 8222.0.0 d6c58b28412e */
/* bench 8222.0.1 237a619b2e89 */
/* bench 8222.0.2 6b1ae1d5a608 */
/* bench 8222.0.3 62914440ec8d */
/* bench 26302.0.0 f5fc995ce0d0 */
/* bench 26302.0.1 5d3b98077572 */
/* bench 26302.0.2 0d1b43296ca9 */
/* bench 26302.0.3 05e841b5e45e */
/* bench 26302.0.4 b33545ee592f */
/* bench 26302.0.5 ba925d682607 */
/* bench 26302.0.6 5b6e2c0c8890 */
/* bench 26302.0.7 0f5f248ef560 */
/* bench 26302.0.8 76340157b466 */
/* bench 26302.0.9 f7268054db50 */
/* bench 8222.0.7 c7a003d58af7 */
/* bench 8222.0.8 43483bb3a225 */
/* bench 8222.0.9 57c1e1e64664 */
/* bench 8222.0.10 fb5c83079d06 */
/* bench 8222.0.11 73e2a4e9557d */
/ {
	model = "Kverneland UT1P Board";
	compatible = "kvg,vicutp", "fsl,imx6qp";
};
