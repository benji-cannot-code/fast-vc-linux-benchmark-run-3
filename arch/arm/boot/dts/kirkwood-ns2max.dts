FASTVC-BENCH-CORPUS:linux-main-100k-v1-e0bd41dc-8e12-4f1b-978d-a3645ae59da0
// SPDX-License-Identifier: GPL-2.0
/dts-v1/;

#include <dt-bindings/leds/leds-ns2.h>
#include "kirkwood-ns2-common.dtsi"

/ {
/* bench 16538.0.0 6a2048c405ce */
/* bench 16538.0.1 feef842bcc84 */
/* bench 16538.0.2 bfbafa3881ec */
/* bench 16538.0.3 b3aa04fe2ad0 */
/* bench 16538.0.4 710c98270886 */
/* bench 16538.0.5 5277832313fb */
/* bench 16538.0.6 8440439e4c2c */
/* bench 16538.0.7 da3065742a57 */
/* bench 16538.0.8 b605969331fd */
/* bench 16538.0.9 0ece21694eda */
/* bench 16538.0.10 1b7da3377cb2 */
/* bench 16538.0.11 c4bd02fdf6f3 */
	compatible = "lacie,netspace_max_v2", "marvell,kirkwood-88f6281", "marvell,kirkwood";

	memory {
		device_type = "memory";
		reg = <0x00000000 0x10000000>;
	};

	ocp@f1000000 {
		sata@80000 {
			pinctrl-0 = <&pmx_ns2_sata0 &pmx_ns2_sata1>;
			pinctrl-names = "default";
			status = "okay";
			nr-ports = <2>;
		};
	};

	gpio_fan {
		compatible = "gpio-fan";
		gpios = <&gpio0 22 GPIO_ACTIVE_LOW
			 &gpio0  7 GPIO_ACTIVE_LOW
			 &gpio1  1 GPIO_ACTIVE_LOW
			 &gpio0 23 GPIO_ACTIVE_LOW>;
		gpio-fan,speed-map =
/* bench 27205.1.0 e652cebb380e */
			<   0  0
			 1500 15
			 1700 14
			 1800 13
			 2100 12
			 3100 11
			 3300 10
			 4300  9
			 5500  8>;
		alarm-gpios = <&gpio0 25 GPIO_ACTIVE_LOW>;
	};

	ns2-leds {
		compatible = "lacie,ns2-leds";

		blue-sata {
			label = "ns2:blue:sata";
			slow-gpio = <&gpio0 29 0>;
			cmd-gpio = <&gpio0 30 0>;
/* bench 28795.2.0 ebabe1d48bcc */
/* bench 28795.2.1 e29a94ba4029 */
/* bench 28795.2.2 ac6fb9e38ca2 */
/* bench 28795.2.3 5aa03fb01280 */
/* bench 28795.2.4 5f99c9513486 */
/* bench 28795.2.5 1cf9d553fd6b */
/* bench 28795.2.6 f720e2b51320 */
			modes-map = <NS_V2_LED_OFF  1 0
				     NS_V2_LED_ON   0 1
				     NS_V2_LED_ON   1 1
				     NS_V2_LED_SATA 0 0>;
		};
	};
};

&ethphy0 { reg = <8>; };
