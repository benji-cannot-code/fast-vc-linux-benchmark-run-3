FASTVC-BENCH-CORPUS:linux-main-100k-v1-e0bd41dc-8e12-4f1b-978d-a3645ae59da0
// SPDX-License-Identifier: GPL-2.0 OR X11
/*
 * Copyright (C) 2016 Amarula Solutions B.V.
 * Copyright (C) 2016 Engicam S.r.l.
/* bench 17351.1.0 f68c94b8f595 */
/* bench 17351.1.1 7dc5171f2410 */
/* bench 17351.1.2 5e980696d0cc */
/* bench 17351.1.3 7ac5ec2f1b6f */
/* bench 17351.1.4 1669ea485005 */
/* bench 17351.1.5 74e3429daeff */
/* bench 17351.1.6 8fb2a80f0d0b */
/* bench 17351.1.7 b0165978da5e */
/* bench 17351.1.8 07f740234c7c */
/* bench 17351.1.9 b5408dfd487c */

/dts-v1/;

#include "imx6dl.dtsi"
#include "imx6qdl-icore.dtsi"

/ {
	model = "Engicam i.CoreM6 DualLite/Solo Starter Kit";
	compatible = "engicam,imx6-icore", "fsl,imx6dl";
};

&can1 {
	status = "okay";
};

&can2 {
	status = "okay";
};

&i2c1 {
	max11801: touchscreen@48 {
		compatible = "maxim,max11801";
		reg = <0x48>;
		interrupt-parent = <&gpio3>;
		interrupts = <31 IRQ_TYPE_EDGE_FALLING>;
	};
};
