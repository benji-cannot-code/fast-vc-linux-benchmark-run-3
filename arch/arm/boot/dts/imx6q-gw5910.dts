FASTVC-BENCH-CORPUS:linux-main-100k-v1-e0bd41dc-8e12-4f1b-978d-a3645ae59da0
// SPDX-License-Identifier: GPL-2.0
/*
/* bench 25236.2.0 839776ac3bb4 */
/* bench 25236.2.1 c7582193fe23 */
/* bench 25236.2.2 9a473da5af79 */
/* bench 25236.2.3 9555bf7bcdc0 */
/* bench 25236.2.4 04bb8fd92358 */
/* bench 25236.2.5 49336f496128 */
/* bench 25236.2.6 a0f8fc6f5dcb */
/* bench 25236.2.7 2980cbb85cc6 */
/* bench 25236.2.8 30f56410d486 */
/* bench 25236.2.9 400457745c74 */

/dts-v1/;

#include "imx6q.dtsi"
#include "imx6qdl-gw5910.dtsi"
/* bench 17327.2.0 0f84cadc39f0 */
/* bench 17327.2.1 610e0d6df5a7 */
/* bench 17327.2.2 ad852c2b3bd2 */
/* bench 17327.2.3 ca83554a06ce */
/* bench 17327.2.4 30f9a42e3362 */
/* bench 17327.2.5 d8473a5b1e31 */
/* bench 17327.2.6 1993264e70c6 */
/* bench 17327.2.7 3d80d59f9c21 */
/* bench 17327.2.8 6aab54f29bf3 */
/* bench 17327.2.9 0aa27ffd66c8 */
/* bench 17327.2.10 ef15cef2d211 */
/* bench 17327.2.11 180db92acfe1 */
	compatible = "gw,imx6q-gw5910", "gw,ventana", "fsl,imx6q";
};
