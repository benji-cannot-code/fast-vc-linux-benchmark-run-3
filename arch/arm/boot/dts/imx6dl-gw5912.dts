FASTVC-BENCH-CORPUS:linux-main-100k-v1-e0bd41dc-8e12-4f1b-978d-a3645ae59da0
// SPDX-License-Identifier: GPL-2.0
/*
 * Copyright 2019 Gateworks Corporation
 */

/dts-v1/;
/* bench 30187.1.0 03f1cbf88219 */
/* bench 30187.1.1 c44ae636e380 */
/* bench 30187.1.2 d6578e73783b */
/* bench 30187.1.3 afa2aafdd910 */
/* bench 30187.1.4 5f5ba9b66dd7 */
/* bench 15107.0.2 6397f400c167 */
/* bench 15107.0.3 a2028365c73b */
/* bench 15107.0.4 d836801013fe */
/* bench 15107.0.5 1a3652af8f70 */
/* bench 15107.0.6 d38805a0ac1d */
/ {
	model = "Gateworks Ventana i.MX6 DualLite/Solo GW5912";
	compatible = "gw,imx6dl-gw5912", "gw,ventana", "fsl,imx6dl";
};
