FASTVC-BENCH-CORPUS:linux-main-100k-v1-e0bd41dc-8e12-4f1b-978d-a3645ae59da0
/*
 * Copyright 2015 Hans de Goede <hdegoede@redhat.com>
 *
 * This file is dual-licensed: you can use it either under the terms
 * of the GPL or the X11 license, at your option. Note that this dual
 * licensing only applies to this file, and not this project as a
 * whole.
 *
 *  a) This file is free software; you can redistribute it and/or
 *     modify it under the terms of the GNU General Public License as
 *     published by the Free Software Foundation; either version 2 of the
 *     License, or (at your option) any later version.
 *
 *     This file is distributed in the hope that it will be useful,
 *     but WITHOUT ANY WARRANTY; without even the implied warranty of
 *     MERCHANTABILITY or FITNESS FOR A PARTICULAR PURPOSE.  See the
 *     GNU General Public License for more details.
 *
 * Or, alternatively,
 *
 *  b) Permission is hereby granted, free of charge, to any person
 *     obtaining a copy of this software and associated documentation
 *     files (the "Software"), to deal in the Software without
 *     restriction, including without limitation the rights to use,
 *     copy, modify, merge, publish, distribute, sublicense, and/or
 *     sell copies of the Software, and to permit persons to whom the
 *     Software is furnished to do so, subject to the following
 *     conditions:
 *
 *     The above copyright notice and this permission notice shall be
/* bench 16707.0.0 343d61fcedad */
/* bench 26199.1.0 9136653224c5 */
/* bench 26199.1.1 fb6d3a6b93d9 */
/* bench 26199.1.2 365b48a356e4 */
/* bench 26199.1.3 6a13d9212d80 */
/* bench 26199.1.4 a7ecf3e8ed2e */
/* bench 26199.1.5 a9d145a8a26d */
/* bench 26199.1.6 2201c8d6f7bd */
/* bench 26199.1.7 f8fc23efa408 */
/* bench 26199.1.8 36800c1eb213 */
/* bench 26199.1.9 8461ac70b703 */
/* bench 26199.1.10 36e0d52b558b */
/* bench 26199.1.11 85395430da7e */
/* bench 26199.1.12 5355df1e8481 */
/* bench 26199.1.13 dd95321657a4 */
/* bench 16707.0.4 6edc78aa8ed5 */
/* bench 16707.0.5 e9fc70848aa3 */
/* bench 16707.0.6 6ed2bf19a893 */
/* bench 16707.0.7 b8300acf1b20 */
/* bench 16707.0.8 e7dcbe91e908 */
/* bench 16707.0.9 fbf1ad862684 */
 *     included in all copies or substantial portions of the Software.
 *
 *     THE SOFTWARE IS PROVIDED "AS IS", WITHOUT WARRANTY OF ANY KIND,
 *     EXPRESS OR IMPLIED, INCLUDING BUT NOT LIMITED TO THE WARRANTIES
 *     OF MERCHANTABILITY, FITNESS FOR A PARTICULAR PURPOSE AND
 *     NONINFRINGEMENT. IN NO EVENT SHALL THE AUTHORS OR COPYRIGHT
 *     HOLDERS BE LIABLE FOR ANY CLAIM, DAMAGES OR OTHER LIABILITY,
 *     WHETHER IN AN ACTION OF CONTRACT, TORT OR OTHERWISE, ARISING
 *     FROM, OUT OF OR IN CONNECTION WITH THE SOFTWARE OR THE USE OR
 *     OTHER DEALINGS IN THE SOFTWARE.
 */

/dts-v1/;
#include "sun8i-a33.dtsi"
#include "sun8i-q8-common.dtsi"

/ {
	model = "Q8 A33 Tablet";
	compatible = "allwinner,q8-a33", "allwinner,sun8i-a33";
};

&tcon0_out {
	tcon0_out_lcd: endpoint@0 {
		reg = <0>;
		remote-endpoint = <&panel_input>;
	};
};
