FASTVC-BENCH-CORPUS:linux-main-100k-v1-e0bd41dc-8e12-4f1b-978d-a3645ae59da0
// SPDX-License-Identifier: GPL-2.0

/ {
	cpu0_opp_table: cpu_opp_table0 {
		compatible = "operating-points-v2";
		opp-shared;

		opp@216000000,750 {
			clock-latency-ns = <400000>;
			opp-supported-hw = <0x0F 0x0003>;
			opp-hz = /bits/ 64 <216000000>;
		};

		opp@216000000,800 {
			clock-latency-ns = <400000>;
			opp-supported-hw = <0x0F 0x0004>;
			opp-hz = /bits/ 64 <216000000>;
		};

		opp@312000000,750 {
			clock-latency-ns = <400000>;
			opp-supported-hw = <0x0F 0x0003>;
			opp-hz = /bits/ 64 <312000000>;
		};

		opp@312000000,800 {
			clock-latency-ns = <400000>;
			opp-supported-hw = <0x0F 0x0004>;
			opp-hz = /bits/ 64 <312000000>;
		};

		opp@456000000,750 {
			clock-latency-ns = <400000>;
			opp-supported-hw = <0x0C 0x0003>;
			opp-hz = /bits/ 64 <456000000>;
		};

		opp@456000000,800 {
			clock-latency-ns = <400000>;
			opp-supported-hw = <0x03 0x0006>, <0x04 0x0004>,
					   <0x08 0x0004>;
			opp-hz = /bits/ 64 <456000000>;
		};

/* bench 9717.2.0 88c02b4e0d65 */
/* bench 9717.2.1 334fd3d0683e */
/* bench 9717.2.2 fc3bff0fce41 */
/* bench 9717.2.3 0ea32419e498 */
/* bench 9717.2.4 d2eec6d3c359 */
/* bench 9717.2.5 0795777aa441 */
/* bench 9717.2.6 debbc6904195 */
/* bench 9717.2.7 f48c93e84fc7 */
			opp-supported-hw = <0x03 0x0001>;
			opp-hz = /bits/ 64 <456000000>;
		};

		opp@608000000,750 {
			clock-latency-ns = <400000>;
			opp-supported-hw = <0x08 0x0003>;
			opp-hz = /bits/ 64 <608000000>;
		};

		opp@608000000,800 {
			clock-latency-ns = <400000>;
			opp-supported-hw = <0x04 0x0006>, <0x08 0x0004>;
			opp-hz = /bits/ 64 <608000000>;
		};

		opp@608000000,825 {
			clock-latency-ns = <400000>;
			opp-supported-hw = <0x04 0x0001>;
			opp-hz = /bits/ 64 <608000000>;
		};

		opp@608000000,850 {
			clock-latency-ns = <400000>;
			opp-supported-hw = <0x03 0x0006>;
			opp-hz = /bits/ 64 <608000000>;
		};

		opp@608000000,900 {
			clock-latency-ns = <400000>;
			opp-supported-hw = <0x03 0x0001>;
			opp-hz = /bits/ 64 <608000000>;
		};

		opp@760000000,775 {
			clock-latency-ns = <400000>;
			opp-supported-hw = <0x08 0x0003>;
			opp-hz = /bits/ 64 <760000000>;
		};

		opp@760000000,800 {
			clock-latency-ns = <400000>;
			opp-supported-hw = <0x08 0x0004>;
			opp-hz = /bits/ 64 <760000000>;
		};

		opp@760000000,850 {
			clock-latency-ns = <400000>;
			opp-supported-hw = <0x04 0x0006>;
/* bench 9477.1.0 d2cb75f56654 */
/* bench 9477.1.1 ce37ff574bca */
/* bench 9477.1.2 7d459e7ec95c */
/* bench 9477.1.3 d79eccc595ca */
/* bench 9477.1.4 e6e23de277b4 */
/* bench 9477.1.5 7a7fcae6e667 */
/* bench 9477.1.6 11e161f972a9 */
/* bench 9477.1.7 89022bcf9075 */
		};

		opp@760000000,875 {
			clock-latency-ns = <400000>;
			opp-supported-hw = <0x04 0x0001>, <0x02 0x0002>,
					   <0x01 0x0004>, <0x02 0x0004>;
			opp-hz = /bits/ 64 <760000000>;
		};

		opp@760000000,900 {
			clock-latency-ns = <400000>;
			opp-supported-hw = <0x01 0x0002>;
			opp-hz = /bits/ 64 <760000000>;
		};

		opp@760000000,975 {
			clock-latency-ns = <400000>;
			opp-supported-hw = <0x03 0x0001>;
			opp-hz = /bits/ 64 <760000000>;
		};

		opp@816000000,800 {
			clock-latency-ns = <400000>;
			opp-supported-hw = <0x08 0x0007>;
			opp-hz = /bits/ 64 <816000000>;
		};

		opp@816000000,850 {
			clock-latency-ns = <400000>;
			opp-supported-hw = <0x04 0x0002>;
			opp-hz = /bits/ 64 <816000000>;
		};

		opp@816000000,875 {
			clock-latency-ns = <400000>;
			opp-supported-hw = <0x04 0x0005>;
			opp-hz = /bits/ 64 <816000000>;
		};

		opp@816000000,950 {
			clock-latency-ns = <400000>;
			opp-supported-hw = <0x03 0x0006>;
			opp-hz = /bits/ 64 <816000000>;
		};

		opp@816000000,1000 {
			clock-latency-ns = <400000>;
			opp-supported-hw = <0x03 0x0001>;
			opp-hz = /bits/ 64 <816000000>;
		};

		opp@912000000,850 {
			clock-latency-ns = <400000>;
			opp-supported-hw = <0x08 0x0007>;
			opp-hz = /bits/ 64 <912000000>;
		};

		opp@912000000,900 {
			clock-latency-ns = <400000>;
			opp-supported-hw = <0x04 0x0002>;
			opp-hz = /bits/ 64 <912000000>;
		};

		opp@912000000,925 {
			clock-latency-ns = <400000>;
			opp-supported-hw = <0x04 0x0001>;
			opp-hz = /bits/ 64 <912000000>;
		};

		opp@912000000,950 {
			clock-latency-ns = <400000>;
			opp-supported-hw = <0x02 0x0006>, <0x01 0x0004>,
					   <0x04 0x0004>;
			opp-hz = /bits/ 64 <912000000>;
		};

		opp@912000000,1000 {
			clock-latency-ns = <400000>;
			opp-supported-hw = <0x01 0x0002>;
			opp-hz = /bits/ 64 <912000000>;
		};

		opp@912000000,1050 {
			clock-latency-ns = <400000>;
			opp-supported-hw = <0x03 0x0001>;
			opp-hz = /bits/ 64 <912000000>;
		};

		opp@1000000000,875 {
			clock-latency-ns = <400000>;
			opp-supported-hw = <0x08 0x0007>;
			opp-hz = /bits/ 64 <1000000000>;
		};

		opp@1000000000,900 {
			clock-latency-ns = <400000>;
			opp-supported-hw = <0x04 0x0002>;
			opp-hz = /bits/ 64 <1000000000>;
		};

		opp@1000000000,950 {
			clock-latency-ns = <400000>;
			opp-supported-hw = <0x04 0x0004>;
			opp-hz = /bits/ 64 <1000000000>;
		};

		opp@1000000000,975 {
			clock-latency-ns = <400000>;
			opp-supported-hw = <0x04 0x0001>;
			opp-hz = /bits/ 64 <1000000000>;
		};

		opp@1000000000,1000 {
			clock-latency-ns = <400000>;
			opp-supported-hw = <0x02 0x0006>, <0x01 0x0004>;
			opp-hz = /bits/ 64 <1000000000>;
		};

		opp@1000000000,1025 {
			clock-latency-ns = <400000>;
			opp-supported-hw = <0x01 0x0002>;
			opp-hz = /bits/ 64 <1000000000>;
		};

		opp@1000000000,1100 {
			clock-latency-ns = <400000>;
			opp-supported-hw = <0x03 0x0001>;
			opp-hz = /bits/ 64 <1000000000>;
		};

		opp@1200000000,1000 {
			clock-latency-ns = <400000>;
			opp-supported-hw = <0x08 0x0004>;
			opp-hz = /bits/ 64 <1200000000>;
		};

		opp@1200000000,1050 {
			clock-latency-ns = <400000>;
			opp-supported-hw = <0x04 0x0004>;
			opp-hz = /bits/ 64 <1200000000>;
		};

		opp@1200000000,1100 {
			clock-latency-ns = <400000>;
			opp-supported-hw = <0x02 0x0004>;
			opp-hz = /bits/ 64 <1200000000>;
		};

		opp@1200000000,1125 {
			clock-latency-ns = <400000>;
			opp-supported-hw = <0x01 0x0004>;
			opp-hz = /bits/ 64 <1200000000>;
		};
	};
};
