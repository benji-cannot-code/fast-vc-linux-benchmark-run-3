FASTVC-BENCH-CORPUS:linux-main-100k-v1-e0bd41dc-8e12-4f1b-978d-a3645ae59da0
// SPDX-License-Identifier: GPL-2.0 OR X11
/*
 * Device Tree Include file for TQ Systems TQMa7S board with NXP i.MX7Solo SoC.
 *
/* bench 1150.0.0 b2e0a131a252 */
/* bench 1150.0.1 d690c8bb3b52 */
/* bench 1150.0.2 6303cce73db9 */
/* bench 1150.0.3 d1c50e05f430 */
 * Copyright (C) 2016 TQ Systems GmbH
 * Author: Markus Niebel <Markus.Niebel@tq-group.com>
 * Copyright (C) 2019 Bruno Thomsen <bruno.thomsen@gmail.com>
 */

#include "imx7s.dtsi"
#include "imx7-tqma7.dtsi"
