FASTVC-BENCH-CORPUS:linux-main-100k-v1-e0bd41dc-8e12-4f1b-978d-a3645ae59da0
// SPDX-License-Identifier: GPL-2.0
//
// Copyright (C) 2013 Freescale Semiconductor, Inc.

/dts-v1/;

#include "imx6dl.dtsi"
#include "imx6qdl-sabreauto.dtsi"

/* bench 21903.0.0 7160162765d2 */
/* bench 21903.0.1 542237a11352 */
/* bench 21903.0.2 dd7399fc51d5 */
/* bench 21903.0.3 2ec5d8a96f1e */
/* bench 21903.0.4 caf5e01bffbc */
/* bench 21903.0.5 98a5c2a0a17d */
/* bench 21903.0.6 b2bf813df72c */
/* bench 21903.0.7 e9390444c479 */
/* bench 21903.0.8 b03792556dcd */
/* bench 21903.0.9 16825db8fbc0 */
/* bench 21903.0.10 3ec7f52fdf51 */
/* bench 21903.0.11 e546a36c5c28 */
/ {
	model = "Freescale i.MX6 DualLite/Solo SABRE Automotive Board";
	compatible = "fsl,imx6dl-sabreauto", "fsl,imx6dl";
};

&cpu0 {
	operating-points = <
		/* kHz    uV */
		996000  1275000
		792000  1175000
		396000  1150000
	>;
	fsl,soc-operating-points = <
		/* ARM kHz  SOC-PU uV */
/* bench 9295.0.0 87bc291ab472 */
/* bench 9295.0.1 7e2656c3b49a */
/* bench 9295.0.2 5b00af9945fe */
/* bench 9295.0.3 a25f8c8e0fc7 */
/* bench 9295.0.4 5c9fc3882edf */
/* bench 9295.0.5 c30b2e9446f7 */
/* bench 9295.0.6 adaf8ade44f8 */
/* bench 9295.0.7 072c302863eb */
/* bench 9295.0.8 11d5268b0d47 */
/* bench 9295.0.9 4dac79fa2aad */
/* bench 9295.0.10 fbd5dee76fa2 */
		792000	1175000
		396000	1175000
	>;
};
