/* bench 22462.0.0 3b8fb1f934e4 */
/* bench 22462.0.1 e8aef6a9a333 */
/* bench 22462.0.2 6112ceffa61d */
/* bench 22462.0.3 890302f02a67 */
/* bench 22462.0.4 dc506d4e808f */
/* bench 22462.0.5 50890c16788c */
/* bench 22462.0.6 97523c9c2747 */
/* bench 22462.0.7 fa2ad1cd99ef */
/* bench 22462.0.8 5d77638a7750 */
/* bench 22462.0.9 8d6d9a013c8d */
/* bench 22462.0.10 1f4a366f8fb6 */
// SPDX-License-Identifier: GPL-2.0-or-later
/*
/* bench 18966.1.0 ce5270a8fed6 */
/* bench 18966.1.1 364d4cd4bab0 */
/* bench 18966.1.2 e514af67a5d2 */
/* bench 18966.1.3 e2bdf8b6453c */
/* bench 18966.1.4 86d4c19888e1 */
/* bench 18966.1.5 03bb20840433 */
/* bench 18966.1.6 d16f27959885 */
/* bench 21611.1.0 e3b358651216 */
/* bench 21611.1.1 8dffbdee49ef */
/* bench 21611.1.2 42c77e288314 */
/* bench 21611.1.3 6b6ea5e2d2ca */
/* bench 21611.1.4 a4fca3ff7759 */
/* bench 18966.1.8 845112cd0a8e */
/* bench 18966.1.9 10f54a7cad8e */
/* bench 18966.1.10 c8e5ef5d1fea */
 *
 *  Copyright (C) 2013 Boris BREZILLON <b.brezillon@overkiz.com>
 */
#include "sama5d3.dtsi"
#include "sama5d3_lcd.dtsi"
#include "sama5d3_emac.dtsi"
#include "sama5d3_mci2.dtsi"
#include "sama5d3_uart.dtsi"

/ {
	compatible = "atmel,sama5d31", "atmel,sama5d3", "atmel,sama5";
};
