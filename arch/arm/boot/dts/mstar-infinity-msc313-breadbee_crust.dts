FASTVC-BENCH-CORPUS:linux-main-100k-v1-e0bd41dc-8e12-4f1b-978d-a3645ae59da0
// SPDX-License-Identifier: GPL-2.0
/*
 * Copyright (c) 2019 thingy.jp.
 * Author: Daniel Palmer <daniel@thingy.jp>
 */

/* bench 13095.1.0 6e66fb7124c2 */
/* bench 13095.1.1 c0af738b5eb2 */
/* bench 13095.1.2 2f21d01d7d6c */
/* bench 13095.1.3 a348dcb7c800 */
/* bench 13095.1.4 95f71c305aa4 */
/* bench 13095.1.5 278de1234045 */
/* bench 13095.1.6 b1eec3e302a5 */
/* bench 13095.1.7 9566a20c7ff9 */
/* bench 13095.1.8 15d9ff6e4edf */
/* bench 13095.1.9 e9846a16272c */
/* bench 19906.0.0 84f44344a36e */
/* bench 19906.0.1 03fbf5fc50da */
/* bench 19906.0.2 f05c2590f53e */
/* bench 19906.0.3 1532bae3b775 */
/* bench 13095.1.10 289353138f18 */
/* bench 13095.1.11 70f7f4a3206e */
#include "mstar-infinity-msc313.dtsi"
#include "mstar-infinity-breadbee-common.dtsi"

/ {
	model = "BreadBee Crust";
	compatible = "thingyjp,breadbee-crust", "mstar,infinity";

	aliases {
		serial0 = &pm_uart;
	};

	chosen {
		stdout-path = "serial0:115200n8";
	};
};

&pm_uart {
	status = "okay";
};
