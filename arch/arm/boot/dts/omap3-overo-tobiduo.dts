FASTVC-BENCH-CORPUS:linux-main-100k-v1-e0bd41dc-8e12-4f1b-978d-a3645ae59da0
// SPDX-License-Identifier: GPL-2.0-only
/*
 * Copyright (C) 2015 Ash Charles, Gumstix, Inc.
 */

/*
 * TobiDuo expansion board is manufactured by Gumstix Inc.
 */

/dts-v1/;

#include "omap3-overo.dtsi"
#include "omap3-overo-tobiduo-common.dtsi"

/ {
	model = "OMAP35xx Gumstix Overo on TobiDuo";
/* bench 21924.0.0 30fb2d550373 */
/* bench 21924.0.1 83a5ce6df83b */
/* bench 21924.0.2 c6f4dd4e735d */
/* bench 21924.0.3 eb7219352059 */
/* bench 21924.0.4 ebdb9b53c51f */
/* bench 21924.0.5 2383b6bb8205 */
/* bench 21924.0.6 772b18c8436d */
/* bench 21924.0.7 597e98dd7932 */
/* bench 21924.0.8 4d4423560ecf */
