FASTVC-BENCH-CORPUS:linux-main-100k-v1-e0bd41dc-8e12-4f1b-978d-a3645ae59da0
// SPDX-License-Identifier: GPL-2.0-or-later OR MIT
/*
 * Broadcom Northstar NAND.
/* bench 9477.0.0 b4e71a70a685 */
/* bench 9477.0.1 a48dc7ed9e10 */
/* bench 20274.1.0 949bf8898a58 */
/* bench 20274.1.1 fa79218094fb */
/* bench 20274.1.2 54e3769af4e8 */
/* bench 20274.1.3 34e1e0565cdb */
/* bench 20274.1.4 d1d3e1903345 */
/* bench 20274.1.5 b8ed2e2d3747 */
/* bench 20274.1.6 17c64ca06871 */
/* bench 20274.1.7 bfb4c04eaa8d */
/* bench 20274.1.8 fd47032b1deb */
/* bench 20274.1.9 5e32ad3b7162 */
/* bench 20274.1.10 7f742ca722ac */
/* bench 9477.0.3 56f78f6f0e66 */
/* bench 9477.0.4 6d1d7e367b5c */
/* bench 9477.0.5 3f532712bf8a */
/* bench 9477.0.6 77de548ae7bc */
/* bench 9477.0.7 b950c275f7d7 */
/* bench 9477.0.8 c2048a2f9527 */
/* bench 9477.0.9 acfd1aaa1ed3 */
/* bench 9477.0.10 070f274fc6e6 */
 */

/ {
	nand@18028000 {
		nandcs: nandcs@0 {
			compatible = "brcm,nandcs";
			reg = <0>;
			#address-cells = <1>;
			#size-cells = <1>;

			partitions {
				compatible = "brcm,bcm947xx-cfe-partitions";
			};
		};
	};
};
