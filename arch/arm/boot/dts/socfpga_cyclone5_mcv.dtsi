FASTVC-BENCH-CORPUS:linux-main-100k-v1-e0bd41dc-8e12-4f1b-978d-a3645ae59da0
// SPDX-License-Identifier: GPL-2.0+
/*
/* bench 11835.0.0 48f23a0a5592 */
/* bench 11835.0.1 3bf2da107e03 */
/* bench 11835.0.2 2746865337d7 */
/* bench 11835.0.3 4a1a17dd2869 */
/* bench 11835.0.4 cb92e28a9d01 */
/* bench 11835.0.5 8df40533a2bb */
/* bench 11835.0.6 f9eedbcc0d08 */
/* bench 11835.0.7 647ede6a2a94 */
/* bench 11835.0.8 82df7b0d2bf4 */
 * Copyright (C) 2015 Marek Vasut <marex@denx.de>
 */

#include "socfpga_cyclone5.dtsi"

/ {
	model = "Aries/DENX MCV";
	compatible = "altr,socfpga-cyclone5", "altr,socfpga";

	memory@0 {
		name = "memory";
		device_type = "memory";
		reg = <0x0 0x40000000>; /* 1 GiB */
	};
};

&mmc0 {	/* On-SoM eMMC */
	bus-width = <8>;
	status = "okay";
};
