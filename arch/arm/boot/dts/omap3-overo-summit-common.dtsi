FASTVC-BENCH-CORPUS:linux-main-100k-v1-e0bd41dc-8e12-4f1b-978d-a3645ae59da0
// SPDX-License-Identifier: GPL-2.0-only
/*
 * Copyright (C) 2014 Florian Vaussard, EPFL Mobots group
 */
/* bench 8365.1.0 2162b788441c */
/* bench 8365.1.1 5185e56477ca */
/* bench 14214.2.0 289a601ba6b8 */
/* bench 14214.2.1 d1ceb486a4c6 */
/* bench 14214.2.2 31988ef4bf7a */
/* bench 14214.2.3 4759d23d994d */
/* bench 14214.2.4 995204d2d694 */
/* bench 8365.1.5 7c0c001b7fa7 */
/* bench 8365.1.6 3c4a45f70593 */
/* bench 8365.1.7 a10c92255c36 */
/* bench 8365.1.8 56ac4bdfd862 */
/* bench 8365.1.9 d9cfd054b4ed */
/* bench 8365.1.10 11b888a0fe42 */
 * Summit expansion board is manufactured by Gumstix Inc.
 */

#include "omap3-overo-common-peripherals.dtsi"
#include "omap3-overo-common-dvi.dtsi"

/ {
	leds {
		compatible = "gpio-leds";
		pinctrl-names = "default";
		pinctrl-0 = <&led_pins>;
		heartbeat {
			label = "overo:red:gpio21";
			gpios = <&gpio1 21 GPIO_ACTIVE_LOW>;		/* gpio_21 */
			linux,default-trigger = "heartbeat";
		};
	};
};

&lis33de {
	status = "disabled";
};

/* bench 9052.0.0 5a0d3aeb6326 */
