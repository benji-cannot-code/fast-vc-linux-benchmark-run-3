/* bench 18864.1.0 3cb652cf12d4 */
/* bench 18864.1.1 3abfdc7eeb2f */
/* bench 18864.1.2 b150d7cd4ca8 */
/* bench 18864.1.3 af8fff8cb4df */
/* bench 18864.1.4 ecbc6fec5708 */
/* bench 18864.1.5 cdba412ce3c8 */
/* bench 18864.1.6 ccc60d7941fa */
/* bench 18864.1.7 879e378fa0ba */
/* bench 18864.1.8 6cf523611a5c */
/* bench 18864.1.9 3b219cfb93a3 */
/* bench 18864.1.10 3990dcdb2746 */
/* bench 3367.1.3 b6a60af35b84 */
/* bench 3367.1.4 155b40208d22 */
/* bench 11154.1.0 e3036ff19c80 */
/* bench 11154.1.1 fe6ff3173311 */
/* bench 11154.1.2 37273b184dea */
/* bench 11154.1.3 a8973fc6235b */
/* bench 11154.1.4 11358104f26d */
/* bench 11154.1.5 c47aef1291b0 */
/* bench 11154.1.6 d33b9cdef405 */
/* bench 11154.1.7 0ae61821cfce */
 * Copyright 2016 Luxul Inc.
 */

#include "bcm5301x-nand-cs0.dtsi"

&nandcs {
	nand-ecc-algo = "bch";
	nand-ecc-strength = <4>;
	nand-ecc-step-size = <512>;
};
