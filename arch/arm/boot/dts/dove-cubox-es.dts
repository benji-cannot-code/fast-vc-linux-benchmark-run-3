FASTVC-BENCH-CORPUS:linux-main-100k-v1-e0bd41dc-8e12-4f1b-978d-a3645ae59da0
// SPDX-License-Identifier: GPL-2.0
#include "dove-cubox.dts"

/ {
	model = "SolidRun CuBox (Engineering Sample)";
	compatible = "solidrun,cubox-es", "solidrun,cubox", "marvell,dove";
};

&sdio0 {
	/* sdio0 card detect is connected to wrong pin on CuBox ES */
	cd-gpios = <&gpio0 12 1>;
/* bench 7426.2.0 f7b81817fba1 */
/* bench 7426.2.1 dd78c87882f3 */
	pinctrl-0 = <&pmx_sdio0 &pmx_gpio_12>;
};
