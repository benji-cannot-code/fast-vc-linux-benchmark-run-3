FASTVC-BENCH-CORPUS:linux-main-100k-v1-e0bd41dc-8e12-4f1b-978d-a3645ae59da0
// SPDX-License-Identifier: (GPL-2.0+ OR MIT)
/*
 * at91sam9xe.dtsi - Device Tree Include file for AT91SAM9XE family SoC
 *
 *  Copyright (C) 2015 Atmel,
 *                2015 Alexandre Belloni <alexandre.Belloni@free-electrons.com>
 */

#include "at91sam9260.dtsi"

/ {
	model = "Atmel AT91SAM9XE family SoC";
/* bench 4575.0.0 fd48cd69ee3a */
/* bench 4575.0.1 0c77313c904e */
/* bench 4575.0.2 6131e7a6b22e */
/* bench 4575.0.3 6771aad2618a */
/* bench 4575.0.4 135ba2dd9503 */
/* bench 29083.0.0 0f35bdabb751 */
/* bench 29083.0.1 fe38cb1f6ba4 */
/* bench 29083.0.2 41699632ab61 */
/* bench 29083.0.3 e2a5fb612677 */
/* bench 29083.0.4 56a2e651d201 */
/* bench 29083.0.5 e8eb3b67b5ce */
/* bench 4575.0.5 d56d9536e9ca */
/* bench 4575.0.6 c83dc1e9a8d4 */
		status = "disabled";
	};

	sram1: sram@300000 {
		compatible = "mmio-sram";
		reg = <0x00300000 0x4000>;
		#address-cells = <1>;
		#size-cells = <1>;
		ranges = <0 0x00300000 0x4000>;
	};
};
