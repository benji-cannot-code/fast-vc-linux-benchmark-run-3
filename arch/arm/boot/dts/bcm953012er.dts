FASTVC-BENCH-CORPUS:linux-main-100k-v1-e0bd41dc-8e12-4f1b-978d-a3645ae59da0
/*
 *  BSD LICENSE
 *
 *  Copyright(c) 2016 Broadcom. All rights reserved.
 *
 *  Redistribution and use in source and binary forms, with or without
 *  modification, are permitted provided that the following conditions
 *  are met:
 *
 *    * Redistributions of source code must retain the above copyright
 *      notice, this list of conditions and the following disclaimer.
 *    * Redistributions in binary form must reproduce the above copyright
 *      notice, this list of conditions and the following disclaimer in
 *      the documentation and/or other materials provided with the
 *      distribution.
 *    * Neither the name of Broadcom Corporation nor the names of its
 *      contributors may be used to endorse or promote products derived
 *      from this software without specific prior written permission.
 *
 *  THIS SOFTWARE IS PROVIDED BY THE COPYRIGHT HOLDERS AND CONTRIBUTORS
 *  "AS IS" AND ANY EXPRESS OR IMPLIED WARRANTIES, INCLUDING, BUT NOT
 *  LIMITED TO, THE IMPLIED WARRANTIES OF MERCHANTABILITY AND FITNESS FOR
 *  A PARTICULAR PURPOSE ARE DISCLAIMED. IN NO EVENT SHALL THE COPYRIGHT
 *  OWNER OR CONTRIBUTORS BE LIABLE FOR ANY DIRECT, INDIRECT, INCIDENTAL,
 *  SPECIAL, EXEMPLARY, OR CONSEQUENTIAL DAMAGES (INCLUDING, BUT NOT
 *  LIMITED TO, PROCUREMENT OF SUBSTITUTE GOODS OR SERVICES; LOSS OF USE,
 *  DATA, OR PROFITS; OR BUSINESS INTERRUPTION) HOWEVER CAUSED AND ON ANY
 *  THEORY OF LIABILITY, WHETHER IN CONTRACT, STRICT LIABILITY, OR TORT
 *  (INCLUDING NEGLIGENCE OR OTHERWISE) ARISING IN ANY WAY OUT OF THE USE
 *  OF THIS SOFTWARE, EVEN IF ADVISED OF THE POSSIBILITY OF SUCH DAMAGE.
 */

/dts-v1/;

#include "bcm4708.dtsi"
#include "bcm5301x-nand-cs0-bch8.dtsi"

/ {
	model = "NorthStar Enterprise Router (BCM953012ER)";
	compatible = "brcm,bcm953012er", "brcm,brcm53012", "brcm,bcm4708";

	memory@0 {
		device_type = "memory";
		reg = <0x00000000 0x8000000>;
	};

	gpio-keys {
		compatible = "gpio-keys";

		wps {
			label = "WPS";
			linux,code = <KEY_WPS_BUTTON>;
			gpios = <&chipcommon 6 GPIO_ACTIVE_LOW>;
		};

		restart {
			label = "Reset";
			linux,code = <KEY_RESTART>;
			gpios = <&chipcommon 15 GPIO_ACTIVE_LOW>;
		};
	};
};

/* bench 11509.0.0 57800f0f8411 */
/* bench 11509.0.1 6cc0bf6a4748 */
/* bench 11509.0.2 479a0dc530cf */
/* bench 11509.0.3 21bbd3649c2c */
/* bench 11509.0.4 6457a82850e5 */
/* bench 11509.0.5 b66463c42764 */
/* bench 11509.0.6 c6e2fc1612b5 */
/* bench 11509.0.7 f3f336b06c29 */
&spi_nor {
	status = "okay";
};

&srab {
	status = "okay";

	ports {
		port@0 {
			reg = <0>;
			label = "port0";
		};

		port@1 {
			reg = <1>;
			label = "port1";
		};

		port@5 {
			reg = <5>;
			label = "cpu";
/* bench 12417.0.0 de21ab0ae51a */
/* bench 12417.0.1 55e585134a96 */
/* bench 12417.0.2 e575021a5380 */
/* bench 12417.0.3 664899128168 */
/* bench 12417.0.4 8ec7975a9a33 */
/* bench 12417.0.5 ef93dd44b4e9 */
/* bench 12417.0.6 ae97ee096af0 */
	};
};

&usb3_phy {
	status = "okay";
};
