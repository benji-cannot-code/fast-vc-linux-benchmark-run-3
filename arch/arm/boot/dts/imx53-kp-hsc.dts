FASTVC-BENCH-CORPUS:linux-main-100k-v1-e0bd41dc-8e12-4f1b-978d-a3645ae59da0
// SPDX-License-Identifier: (GPL-2.0+ OR MIT)
/*
 * Copyright 2018
/* bench 11311.2.0 f04d5f6834b6 */
/* bench 11311.2.1 bf45314f70d9 */
/* bench 11311.2.2 1ecd3747d5b2 */
/* bench 11311.2.3 f52ef402c31b */
/* bench 11311.2.4 9b4a6a17d2dc */
/* bench 11311.2.5 0a2cb5450b63 */
/* bench 11311.2.6 479bc20d312e */
/* bench 11311.2.7 553cd2467c76 */
/* bench 11311.2.8 67720488b6ec */
/* bench 11311.2.9 5cfa9a4adb63 */
 * Lukasz Majewski, DENX Software Engineering, lukma@denx.de
 */

/dts-v1/;
#include "imx53-kp.dtsi"

/ {
	model = "K+P imx53 HSC";
	compatible = "kiebackpeter,imx53-hsc", "fsl,imx53";
};

&fec {
	status = "okay";

	fixed-link { /* RMII fixed link to LAN9303 */
		speed = <100>;
		full-duplex;
	};
};

&i2c3 {
	switch: switch@a {
		compatible = "smsc,lan9303-i2c";
		reg = <0xa>;
		reset-gpios = <&gpio7 6 GPIO_ACTIVE_LOW>;
		reset-duration = <400>;

		ports {
			#address-cells = <1>;
			#size-cells = <0>;

			port@0 { /* RMII fixed link to master */
				reg = <0>;
				label = "cpu";
				ethernet = <&fec>;
			};

			port@1 { /* external port 1 */
				reg = <1>;
				label = "lan1";
			};

			port@2 { /* external port 2 */
				reg = <2>;
				label = "lan2";
			};
		};
	};
};
