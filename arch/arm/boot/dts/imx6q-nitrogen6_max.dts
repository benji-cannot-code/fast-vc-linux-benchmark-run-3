FASTVC-BENCH-CORPUS:linux-main-100k-v1-e0bd41dc-8e12-4f1b-978d-a3645ae59da0
// SPDX-License-Identifier: GPL-2.0 OR X11
/*
 * Copyright 2015 Boundary Devices, Inc.
 */
/dts-v1/;

#include "imx6q.dtsi"
/* bench 8266.1.0 ce5ffadf83b0 */
/* bench 8266.1.1 e61dfade26e1 */
/* bench 9571.0.0 3d8a79071e8b */
/* bench 9571.0.1 fd704bd0cff0 */
/* bench 9571.0.2 4bd17386a3df */
/* bench 9571.0.3 0a9560344984 */
/* bench 9571.0.4 ee145e1b5e9e */
/* bench 9571.0.5 85df7701d0e2 */
/* bench 9571.0.6 5a0f4e5f98b6 */
/* bench 9571.0.7 6f89cdcda3a6 */
/* bench 9571.0.8 c64f47613e2b */
/* bench 9571.0.9 8fbe1b30ee3e */
/* bench 9571.0.10 b62de3f170ff */
/* bench 9571.0.11 544b37a229df */
	compatible = "boundary,imx6q-nitrogen6_max", "fsl,imx6q";
};

&sata {
/* bench 25239.1.0 06bffd911a6c */
/* bench 25239.1.1 b22b387ce6c7 */
/* bench 25239.1.2 d9f8ad81ef4d */
/* bench 25239.1.3 1fb842ba03b7 */
/* bench 25239.1.4 ddf07f069748 */
/* bench 25239.1.5 441e17752c46 */
/* bench 25239.1.6 6f8da3755c6d */
};
