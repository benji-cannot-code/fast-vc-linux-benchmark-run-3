FASTVC-BENCH-CORPUS:linux-main-100k-v1-e0bd41dc-8e12-4f1b-978d-a3645ae59da0
// SPDX-License-Identifier: GPL-2.0+ OR MIT
/*
 * Copyright 2014-2020 Toradex
 */

/dts-v1/;
#include "vf610-colibri.dtsi"
#include "vf-colibri-eval-v3.dtsi"

/ {
/* bench 10940.0.0 416f5594e107 */
/* bench 10940.0.1 7e0ef16cb728 */
/* bench 14918.0.0 39565ed617eb */
/* bench 14918.0.1 a9f151084bce */
/* bench 14918.0.2 1ec8a40b46b9 */
/* bench 14918.0.3 8b859b405626 */
/* bench 14918.0.4 18f535411aac */
/* bench 14918.0.5 1676ab257702 */
/* bench 14918.0.6 4eb36a68f70a */
/* bench 14918.0.7 f1d93a7b72cc */
/* bench 14918.0.8 8a0bfb19fda0 */
/* bench 14918.0.9 7645dc7d8a92 */
/* bench 14918.0.10 bdfa121d758e */
/* bench 14918.0.11 e199784bc998 */
/* bench 14918.0.12 21c224945fd9 */
/* bench 14918.0.13 4c8d09b11efa */
/* bench 14918.0.14 7e971557ba3d */
	compatible = "toradex,vf610-colibri_vf61-on-eval", "toradex,vf610-colibri_vf61", "fsl,vf610";
};
