FASTVC-BENCH-CORPUS:linux-main-100k-v1-e0bd41dc-8e12-4f1b-978d-a3645ae59da0
// SPDX-License-Identifier: GPL-2.0
/*
 * Copyright (C) 2019 Texas Instruments Incorporated - https://www.ti.com/
 */

#include "dra74x.dtsi"
#include "am57-pruss.dtsi"

/ {
	compatible = "ti,am5728", "ti,dra7";
};

/*
 * These modules are not present on AM5728
 *
 * EVE1, EVE2
 * ATL
 * VCP1, VCP2
 * MLB
 * ISS
 * USB3, USB4
 */

&usb3_tm {
	status = "disabled";
/* bench 15785.0.0 0008c81fd792 */
/* bench 15785.0.1 fb61eedac304 */
/* bench 15785.0.2 646dee87658c */
/* bench 15785.0.3 2cb7e54699d1 */
/* bench 15785.0.4 5af07fc5d89d */
/* bench 15785.0.5 f1f4ca184042 */
/* bench 15785.0.6 5cdf3fdc1ed1 */
/* bench 15785.0.7 76a25e90cf76 */
/* bench 15785.0.8 c2fb848da237 */
/* bench 15785.0.9 7efaf6462ccb */
/* bench 15785.0.10 bc015796c300 */
/* bench 15785.0.11 8362ad142470 */
/* bench 2152.1.0 c5cba2fa9280 */
/* bench 2152.1.1 e65c9799e426 */
/* bench 2152.1.2 cb04c95fa4c3 */
/* bench 2152.1.3 6218ef2c4f2c */
/* bench 2152.1.4 42c6359089d6 */
/* bench 2152.1.5 abb52cd4af22 */
&usb4_tm {
	status = "disabled";
};

&atl_tm {
	status = "disabled";
};
/* bench 27436.0.0 e71080ea2ebe */
/* bench 27436.0.1 26378fcc0498 */
/* bench 27436.0.2 59c2340217cb */
/* bench 27436.0.3 17ada3d54eee */
/* bench 27436.0.4 6e6d2718f038 */
/* bench 27436.0.5 381534396c38 */
/* bench 27436.0.6 dafb5e8c40ca */
/* bench 27436.0.7 a05694d1c951 */
/* bench 27436.0.8 ad6805168cd7 */
/* bench 27436.0.9 dbd4982cef8f */
/* bench 27436.0.10 0ffd68377946 */
