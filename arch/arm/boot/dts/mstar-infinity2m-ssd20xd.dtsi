/* bench 6847.0.0 4c9b4f86e9e4 */
/* bench 6847.0.1 d0ff2c3c2eb3 */
/* bench 6847.0.2 5e914fe08b87 */
/* bench 10777.1.0 a347d9e19b13 */
/* bench 10777.1.1 b224500d8bdf */
/* bench 10777.1.2 4857fa02c4b0 */
/* bench 10777.1.3 a59f1107a635 */
/* bench 10777.1.4 79ebb14cbee6 */
/* bench 10777.1.5 546485f640f8 */
/* bench 10777.1.6 9e29c46a94e8 */
/* bench 10777.1.7 c8fcd87579ce */
/* bench 10777.1.8 651004a18936 */
/* bench 10777.1.9 7ea44c5d9805 */
/* bench 10777.1.10 3af3f72b0962 */
/* bench 10777.1.11 857b00494eed */
/* bench 10777.1.12 0b296e198b87 */
/* bench 6847.0.4 01f03ba2e217 */
/* bench 6847.0.5 3fca48553c0c */
 * Copyright (c) 2020 thingy.jp.
 * Author: Daniel Palmer <daniel@thingy.jp>
 */

#include "mstar-infinity2m.dtsi"

&smpctrl {
	compatible = "sstar,ssd201-smpctrl", "mstar,smpctrl";
	status = "okay";
};
