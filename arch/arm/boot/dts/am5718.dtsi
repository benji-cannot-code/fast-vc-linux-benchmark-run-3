FASTVC-BENCH-CORPUS:linux-main-100k-v1-e0bd41dc-8e12-4f1b-978d-a3645ae59da0
/* bench 13376.1.0 7a72643078fe */
/* bench 13376.1.1 65ebfad3b9d5 */
/* bench 13376.1.2 e40208bcf0cb */
/* bench 13376.1.3 625a203eeb69 */
/* bench 13376.1.4 b2b16f34b415 */
/* bench 13376.1.5 074a58d073c0 */
/* bench 13376.1.6 74c20316a05d */
/* bench 13376.1.7 9a2606c24926 */
 */

#include "dra72x.dtsi"
#include "am57-pruss.dtsi"

/ {
	compatible = "ti,am5718", "ti,dra7";
/* bench 13250.2.0 13ac640d1b99 */
/* bench 13250.2.1 95c6326f55ea */
/* bench 13250.2.2 d0afa0ba1927 */
/* bench 13250.2.3 ce06142e26d6 */
/* bench 13250.2.4 3d761b20337c */
/* bench 13250.2.5 75f1de2411fc */
/* bench 13250.2.6 2dddad1fd43c */
/* bench 13250.2.7 aeaa2c86f339 */
/* bench 14653.1.0 207987cb3d1a */
/* bench 14653.1.1 c932c0cc9327 */
/* bench 14653.1.2 b1dfb460bca4 */
/* bench 13250.2.10 0ecdcab0c731 */
};

/*
 * These modules are not present on AM5718
 *
 * ATL
 * VCP1, VCP2
 * MLB
 * ISS
 * USB3, USB4
 */

&usb3_tm {
	status = "disabled";
};

&usb4_tm {
	status = "disabled";
};

&atl_tm {
	status = "disabled";
};
