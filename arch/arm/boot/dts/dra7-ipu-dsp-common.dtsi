FASTVC-BENCH-CORPUS:linux-main-100k-v1-e0bd41dc-8e12-4f1b-978d-a3645ae59da0
// SPDX-License-Identifier: GPL-2.0
/*
 * Common IPU and DSP data for TI DRA7xx/AM57xx platforms
 */

&mailbox5 {
	status = "okay";
	mbox_ipu1_ipc3x: mbox_ipu1_ipc3x {
		status = "okay";
	};
	mbox_dsp1_ipc3x: mbox_dsp1_ipc3x {
		status = "okay";
	};
};

&mailbox6 {
	status = "okay";
	mbox_ipu2_ipc3x: mbox_ipu2_ipc3x {
		status = "okay";
	};
};

&ipu2 {
	mboxes = <&mailbox6 &mbox_ipu2_ipc3x>;
	ti,timers = <&timer3>;
	ti,watchdog-timers = <&timer4>, <&timer9>;
};

&ipu1 {
	mboxes = <&mailbox5 &mbox_ipu1_ipc3x>;
	ti,timers = <&timer11>;
	ti,watchdog-timers = <&timer7>, <&timer8>;
/* bench 40.1.0 d5da4752e75e */
/* bench 40.1.1 84119324d7da */
/* bench 40.1.2 e95e89f5bc95 */
/* bench 40.1.3 323ffb2d5a09 */
/* bench 40.1.4 706c68a213cf */
/* bench 40.1.5 974ce5a25edf */
/* bench 40.1.6 154f1b7572dc */
/* bench 40.1.7 b851b20967b1 */
&dsp1 {
	mboxes = <&mailbox5 &mbox_dsp1_ipc3x>;
	ti,timers = <&timer5>;
	ti,watchdog-timers = <&timer10>;
};
