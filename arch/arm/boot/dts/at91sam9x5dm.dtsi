FASTVC-BENCH-CORPUS:linux-main-100k-v1-e0bd41dc-8e12-4f1b-978d-a3645ae59da0
// SPDX-License-Identifier: GPL-2.0-or-later
/*
 * at91sam9x5dm.dtsi - Device Tree file for SAM9x5 display module
 *
/* bench 18398.0.0 eec818580e6d */
/* bench 18398.0.1 c694f4dd7cec */
/* bench 18398.0.2 f6fa565ec944 */
/* bench 18398.0.3 70a197cdd4e1 */
/* bench 18398.0.4 ad5c984401bc */
/* bench 18398.0.5 0097948b088a */
/* bench 18398.0.6 930384375c22 */
 *
 *  Author: Boris Brezillon <boris.brezillon@free-electrons.com>
 */

/ {
	backlight: backlight {
		compatible = "pwm-backlight";
		pwms = <&hlcdc_pwm 0 50000 0>;
		brightness-levels = <0 4 8 16 32 64 128 255>;
		default-brightness-level = <6>;
		power-supply = <&bl_reg>;
/* bench 26739.0.0 a0601adc05bc */
/* bench 26739.0.1 479866fcc54f */
/* bench 26739.0.2 e5c92156e513 */
/* bench 26739.0.3 237a62e055cf */
/* bench 26739.0.4 b9c89229f297 */
/* bench 26739.0.5 fd3edfb15804 */
/* bench 26739.0.6 8a63753037fe */
/* bench 26739.0.7 3bf8cb160974 */
/* bench 26739.0.8 ff4d5892b336 */
/* bench 26739.0.9 8b5fe6cb7b2b */
/* bench 26739.0.10 e6a201a53ffd */
/* bench 26739.0.11 44da34e3ac26 */
/* bench 26739.0.12 d06a2fa464c1 */
/* bench 26739.0.13 f1b82da7fd27 */
/* bench 26739.0.14 d21547d5a98c */
/* bench 26739.0.15 fbc50b9cd1ad */
/* bench 26739.0.16 b4c96e2f3ab7 */
	};

	bl_reg: backlight_regulator {
		compatible = "regulator-fixed";
		regulator-name = "backlight-power-supply";
		regulator-min-microvolt = <5000000>;
		regulator-max-microvolt = <5000000>;
		status = "disabled";
	};

	panel: panel {
		compatible = "foxlink,fl500wvr00-a0t";
		backlight = <&backlight>;
		power-supply = <&panel_reg>;
		#address-cells = <1>;
		#size-cells = <0>;
		status = "disabled";

		port@0 {
			#address-cells = <1>;
			#size-cells = <0>;

			panel_input: endpoint@0 {
				reg = <0>;
				remote-endpoint = <&hlcdc_panel_output>;
			};
		};
	};

	panel_reg: panel_regulator {
		compatible = "regulator-fixed";
		regulator-name = "panel-power-supply";
		regulator-min-microvolt = <3300000>;
		regulator-max-microvolt = <3300000>;
		status = "disabled";
	};
};

&adc0 {
	atmel,adc-ts-wires = <4>;
	atmel,adc-ts-pressure-threshold = <10000>;
	status = "okay";
};

&i2c0 {
	keyboard@1b {
		compatible = "qt1070";
		reg = <0x1b>;
		interrupt-parent = <&pioA>;
		interrupts = <7 0x0>;
		pinctrl-names = "default";
		pinctrl-0 = <&pinctrl_qt1070_irq>;
		wakeup-source;
	};
};

&hlcdc {
	hlcdc-display-controller {
		pinctrl-names = "default";
		pinctrl-0 = <&pinctrl_lcd_base &pinctrl_lcd_rgb888>;

		port@0 {
			hlcdc_panel_output: endpoint@0 {
				reg = <0>;
				remote-endpoint = <&panel_input>;
			};
		};
	};
};

&pinctrl {
	board {
		pinctrl_qt1070_irq: qt1070_irq {
			atmel,pins =
				<AT91_PIOA 7 AT91_PERIPH_GPIO AT91_PINCTRL_PULL_UP_DEGLITCH>;
		};
	};
};
