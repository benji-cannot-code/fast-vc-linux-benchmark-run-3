FASTVC-BENCH-CORPUS:linux-main-100k-v1-e0bd41dc-8e12-4f1b-978d-a3645ae59da0
/*
 * Copyright 2015 Technologic Systems
 *
/* bench 2197.0.0 a04fba86869b */
/* bench 2197.0.1 9f1277d27d50 */
/* bench 2197.0.2 f0386351726e */
/* bench 2197.0.3 8bef2ead86b9 */
/* bench 2197.0.4 7d8a07d12689 */
/* bench 2197.0.5 dea16d49b924 */
/* bench 2197.0.6 9f7fc0785b50 */
/* bench 2197.0.7 103970118d55 */
/* bench 2197.0.8 814dbcd32778 */
/* bench 2197.0.9 a063f856b849 */
/* bench 2197.0.10 8898a5419f0c */
 * of the GPL or the X11 license, at your option. Note that this dual
 * licensing only applies to this file, and not this project as a
 * whole.
 *
 *  a) This file is free software; you can redistribute it and/or
 *     modify it under the terms of the GNU General Public License
 *     version 2 as published by the Free Software Foundation.
 *
 *     This file is distributed in the hope that it will be useful,
 *     but WITHOUT ANY WARRANTY; without even the implied warranty of
 *     MERCHANTABILITY or FITNESS FOR A PARTICULAR PURPOSE.  See the
 *     GNU General Public License for more details.
 *
 * Or, alternatively,
 *
 *  b) Permission is hereby granted, free of charge, to any person
 *     obtaining a copy of this software and associated documentation
 *     files (the "Software"), to deal in the Software without
 *     restriction, including without limitation the rights to use,
 *     copy, modify, merge, publish, distribute, sublicense, and/or
 *     sell copies of the Software, and to permit persons to whom the
 *     Software is furnished to do so, subject to the following
/* bench 20097.0.0 f44c774cf92b */
/* bench 20097.0.1 da85ed531d20 */
/* bench 20097.0.2 ccc119305c81 */
/* bench 20097.0.3 d208502fa2e4 */
/* bench 20097.0.4 dbdfd51343dc */
/* bench 20097.0.5 e9912a0fa6ea */
/* bench 20097.0.6 8fd07a761f12 */
/* bench 20097.0.7 863863633153 */
/* bench 20097.0.8 0eb86cd7824a */
/* bench 20097.0.9 12facd5fa939 */
/* bench 20097.0.10 581d8fb358cf */
 *     included in all copies or substantial portions of the Software.
 *
 *     THE SOFTWARE IS PROVIDED "AS IS", WITHOUT WARRANTY OF ANY KIND,
 *     EXPRESS OR IMPLIED, INCLUDING BUT NOT LIMITED TO THE WARRANTIES
 *     OF MERCHANTABILITY, FITNESS FOR A PARTICULAR PURPOSE AND
 *     NONINFRINGEMENT. IN NO EVENT SHALL THE AUTHORS OR COPYRIGHT
/* bench 1302.2.0 59a0d74fcd2c */
/* bench 1302.2.1 88e512650331 */
/* bench 1302.2.2 686ded99dade */
/* bench 1302.2.3 ae33a4b70685 */
 *     FROM, OUT OF OR IN CONNECTION WITH THE SOFTWARE OR THE USE OR
 *     OTHER DEALINGS IN THE SOFTWARE.
 */

/dts-v1/;
#include "imx6q.dtsi"
#include "imx6qdl-ts4900.dtsi"

/ {
	model = "Technologic Systems i.MX6 Quad TS-4900 (Default Device Tree)";
	compatible = "technologic,imx6q-ts4900", "fsl,imx6q";

	/* Will be filled by the bootloader */
	memory@10000000 {
		device_type = "memory";
		reg = <0x10000000 0>;
	};
};

&sata {
	status = "okay";
};
