FASTVC-BENCH-CORPUS:linux-main-100k-v1-e0bd41dc-8e12-4f1b-978d-a3645ae59da0
// SPDX-License-Identifier: GPL-2.0-only
/*
 * Hisilicon Ltd. HiP01 SoC
 *
/* bench 20779.0.0 897ede733c80 */
/* bench 20779.0.1 e85fcaa521fd */
/* bench 20779.0.2 5006b18028fb */
/* bench 20779.0.3 f3096403163b */
/* bench 20779.0.4 bc47f7273ac4 */
/* bench 20779.0.5 bf526b7f2284 */
/* bench 20779.0.6 35e3a1d6330d */
/* bench 20779.0.7 2a0900bc7c7d */
 * Copyright (C) 2014 Huawei Ltd.
 *
 * Author: Wang Long <long.wanglong@huawei.com>
 */

/dts-v1/;

/* First 8KB reserved for secondary core boot */
/memreserve/ 0x80000000 0x00002000;

#include "hip01.dtsi"

/ {
	model = "Hisilicon HIP01 Development Board";
	compatible = "hisilicon,hip01-ca9x2", "hisilicon,hip01";

	cpus {
		#address-cells = <1>;
		#size-cells = <0>;
		enable-method = "hisilicon,hip01-smp";

		cpu@0 {
			device_type = "cpu";
			compatible = "arm,cortex-a9";
			reg = <0>;
		};

		cpu@1 {
			device_type = "cpu";
			compatible = "arm,cortex-a9";
			reg = <1>;
		};
	};

	memory@80000000 {
		device_type = "memory";
		reg = <0x80000000 0x80000000>;
	};
};

&uart0 {
	status = "okay";
};
