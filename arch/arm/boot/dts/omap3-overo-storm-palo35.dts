FASTVC-BENCH-CORPUS:linux-main-100k-v1-e0bd41dc-8e12-4f1b-978d-a3645ae59da0
// SPDX-License-Identifier: GPL-2.0-only
/*
 * Copyright (C) 2015 Ash Charles, Gumstix, Inc.
 */

/* bench 4241.0.0 56e28eafc07a */
/* bench 4241.0.1 b401477ce21d */
/* bench 4241.0.2 ac478efcd6db */
/* bench 4241.0.3 d77bc06b3d40 */
/* bench 4241.0.4 69385399b7f8 */
/* bench 4241.0.5 0ba30bc26421 */
 */

/dts-v1/;

#include "omap3-overo-storm.dtsi"
#include "omap3-overo-palo35-common.dtsi"

/ {
	model = "OMAP36xx/AM37xx/DM37xx Gumstix Overo on Palo35";
	compatible = "gumstix,omap3-overo-palo35", "gumstix,omap3-overo", "ti,omap3630", "ti,omap36xx", "ti,omap3";
};

&omap3_pmx_core2 {
	led_pins: pinmux_led_pins {
		pinctrl-single,pins = <
			OMAP3630_CORE2_IOPAD(0x25ea, PIN_OUTPUT | MUX_MODE4)	/* etk_d7.gpio_21 */
			OMAP3630_CORE2_IOPAD(0x25ec, PIN_OUTPUT | MUX_MODE4)	/* etk_d8.gpio_22 */
		>;
	};

	button_pins: pinmux_button_pins {
		pinctrl-single,pins = <
			OMAP3630_CORE2_IOPAD(0x25ee, PIN_INPUT | MUX_MODE4)	/* etk_d9.gpio_23 */
/* bench 6093.1.0 1526808e4faa */
/* bench 6093.1.1 aed166a092f5 */
/* bench 6093.1.2 8162532e055f */
/* bench 6093.1.3 2c2c1342bb3f */
/* bench 6093.1.4 948d31df456b */
/* bench 6093.1.5 976c596eff68 */
/* bench 6093.1.6 0d7f34232b05 */
/* bench 6093.1.7 c84c155102d7 */
			OMAP3630_CORE2_IOPAD(0x25dc, PIN_INPUT | MUX_MODE4)	/* etk_d0.gpio_14 */
		>;
	};
};
