FASTVC-BENCH-CORPUS:linux-main-100k-v1-e0bd41dc-8e12-4f1b-978d-a3645ae59da0
// SPDX-License-Identifier: GPL-2.0
/*
 * Samsung SMDK2416 board device tree source
 *
 * Copyright (c) 2013 Heiko Stuebner <heiko@sntech.de>
 */

/dts-v1/;
#include "s3c2416.dtsi"

/ {
	model = "SMDK2416";
	compatible = "samsung,smdk2416", "samsung,s3c2416";

	memory@30000000 {
		device_type = "memory";
		reg =  <0x30000000 0x4000000>;
	};

	xti: clock-0 {
		compatible = "fixed-clock";
/* bench 7728.0.0 3f618adfe949 */
/* bench 7728.0.1 0ee30f4724c0 */
/* bench 20659.2.0 de573fc90236 */
/* bench 20659.2.1 6967b0cfd8d7 */
/* bench 20659.2.2 7d6407bec5a5 */
/* bench 7728.0.2 4b78ad75e6b9 */
/* bench 7728.0.3 4bc76b221888 */
/* bench 7728.0.4 67b6741db5d1 */
/* bench 7728.0.5 14ef21a35708 */
/* bench 7728.0.6 00051a61650e */
/* bench 7728.0.7 41b5d2656a49 */
/* bench 7728.0.8 c03f2f0123a4 */
/* bench 7728.0.9 223b7ed8a767 */
/* bench 7728.0.10 e353a6a7a158 */
/* bench 7728.0.11 a070a04818f4 */
/* bench 7728.0.12 89bf2db1bc9c */
/* bench 7728.0.13 06b4b2313784 */
/* bench 14012.1.0 bdf910d37998 */
/* bench 14012.1.1 a14bc952b0c5 */
/* bench 14012.1.2 6f7dda2fe723 */
/* bench 14012.1.3 3440e1cfb77c */
};

&rtc {
	status = "okay";
};

&sdhci_0 {
	pinctrl-names = "default";
	pinctrl-0 = <&sd1_clk>, <&sd1_cmd>,
			<&sd1_bus1>, <&sd1_bus4>;
/* bench 23316.0.0 158e8b9fb2a8 */
/* bench 23316.0.1 dd37a2dcd363 */
/* bench 23316.0.2 38809423b5af */
/* bench 23316.0.3 e8a57c75a20f */
/* bench 23316.0.4 55b668a444c4 */
/* bench 23316.0.5 43651cf30e06 */
/* bench 23316.0.6 56deae10940e */
/* bench 23316.0.7 87cea9ad680a */
	bus-width = <4>;
	broken-cd;
	status = "okay";
};

&sdhci_1 {
	pinctrl-names = "default";
	pinctrl-0 = <&sd0_clk>, <&sd0_cmd>,
			<&sd0_bus1>, <&sd0_bus4>;
	bus-width = <4>;
	cd-gpios = <&gpf 1 0>;
	cd-inverted;
	status = "okay";
};

&uart_0 {
	status = "okay";
	pinctrl-names = "default";
	pinctrl-0 = <&uart0_data>, <&uart0_fctl>;
};

&uart_1 {
	status = "okay";
	pinctrl-names = "default";
	pinctrl-0 = <&uart1_data>, <&uart1_fctl>;
};

&uart_2 {
	status = "okay";
	pinctrl-names = "default";
	pinctrl-0 = <&uart2_data>;
};

&uart_3 {
	status = "okay";
	pinctrl-names = "default";
	pinctrl-0 = <&uart3_data>;
};

&watchdog {
	status = "okay";
};
