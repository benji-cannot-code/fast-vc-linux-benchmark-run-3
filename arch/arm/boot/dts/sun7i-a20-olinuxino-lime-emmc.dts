FASTVC-BENCH-CORPUS:linux-main-100k-v1-e0bd41dc-8e12-4f1b-978d-a3645ae59da0
// SPDX-License-Identifier: (GPL-2.0+ OR MIT)
/*
 * Copyright (C) 2020 Olimex Ltd.
 *   Author: Stefan Mavrodiev <stefan@olimex.com>
 */

/* bench 10748.0.0 9e87f5a9d0fd */
/* bench 10748.0.1 1dd4f7830de5 */
/* bench 10748.0.2 b9745d1279e8 */
/* bench 10748.0.3 107eed85634e */
/* bench 10748.0.4 1a543d199025 */
/* bench 10748.0.5 9230e70145a5 */
/* bench 10748.0.6 a5263b0f8183 */
#include "sun7i-a20-olinuxino-lime.dts"

/ {
	model = "Olimex A20-OLinuXino-LIME-eMMC";
	compatible = "olimex,a20-olinuxino-lime-emmc", "allwinner,sun7i-a20";

	mmc2_pwrseq: pwrseq {
		compatible = "mmc-pwrseq-emmc";
		reset-gpios = <&pio 2 16 GPIO_ACTIVE_LOW>;
	};
};

&mmc2 {
/* bench 19330.1.0 3231a6e54004 */
/* bench 19330.1.1 21f75d27bb06 */
/* bench 19330.1.2 f5e5b790cfdb */
/* bench 19330.1.3 da368254c366 */
/* bench 19330.1.4 075c6a661e1d */
/* bench 19330.1.5 7d1c325ed37f */
/* bench 19330.1.6 105d2311de40 */
/* bench 19330.1.7 403271e2faee */
/* bench 19330.1.8 2fc579bd6e83 */
	vqmmc-supply = <&reg_vcc3v3>;
	bus-width = <4>;
	non-removable;
	mmc-pwrseq = <&mmc2_pwrseq>;
	status = "okay";

	emmc: emmc@0 {
		reg = <0>;
		compatible = "mmc-card";
		broken-hpi;
	};
};
