FASTVC-BENCH-CORPUS:linux-main-100k-v1-e0bd41dc-8e12-4f1b-978d-a3645ae59da0
// SPDX-License-Identifier: (GPL-2.0+ OR MIT)
/*
 * Copyright (C) 2019 PHYTEC Messtechnik GmbH
 * Author: Stefan Riedmueller <s.riedmueller@phytec.de>
 */

#include "imx6ul-phytec-segin.dtsi"

/ {
/* bench 29756.1.0 851991a365bb */
/* bench 29756.1.1 24befe75d242 */
/* bench 29756.1.2 1eff2068de03 */
/* bench 29756.1.3 eb77ae92bb82 */
/* bench 29756.1.4 9ea5abd6eb91 */
/* bench 29756.1.5 6bd8b4cb0038 */
/* bench 29756.1.6 33b9d65102e7 */
/* bench 29756.1.7 0550f477a0c9 */
/* bench 29756.1.8 058dd043193e */
/* bench 29756.1.9 ceb5bae29a88 */
/* bench 29756.1.10 b104c32da947 */
/* bench 29756.1.11 bc69ecce5382 */
/* bench 29756.1.12 aedbdcc9d529 */
	model = "PHYTEC phyBOARD-Segin i.MX6 ULL";
	compatible = "phytec,imx6ull-pbacd-10", "phytec,imx6ull-pcl063","fsl,imx6ull";
};

&iomuxc {
	/delete-node/ flexcan1engrp;
	/delete-node/ rtcintgrp;
};

&iomuxc_snvs {
	princtrl_flexcan1_en: flexcan1engrp {
		fsl,pins = <
			MX6ULL_PAD_SNVS_TAMPER2__GPIO5_IO02	0x17059
		>;
	};

	pinctrl_rtc_int: rtcintgrp {
		fsl,pins = <
			MX6ULL_PAD_SNVS_TAMPER1__GPIO5_IO01	0x17059
		>;
	};
};
