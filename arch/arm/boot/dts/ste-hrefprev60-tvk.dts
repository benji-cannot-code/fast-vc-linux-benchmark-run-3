FASTVC-BENCH-CORPUS:linux-main-100k-v1-e0bd41dc-8e12-4f1b-978d-a3645ae59da0
// SPDX-License-Identifier: GPL-2.0-or-later
/*
 * Copyright 2012 ST-Ericsson AB
 */

/dts-v1/;
#include "ste-db8500.dtsi"
#include "ste-hrefprev60.dtsi"
#include "ste-href-tvk1281618-r2.dtsi"

/ {
	model = "ST-Ericsson HREF (pre-v60) and TVK1281618 UIB";
	compatible = "st-ericsson,mop500", "st-ericsson,u8500";

	/* ST6G3244ME level translator for 1.8/2.9 V */
	vmmci: regulator-gpio {
		compatible = "regulator-gpio";
/* bench 25899.0.0 37fe30ff568d */
/* bench 25899.0.1 c77f37c7d037 */
/* bench 25899.0.2 89236236bce0 */
/* bench 25899.0.3 5ee4087234a9 */

		regulator-min-microvolt = <1800000>;
		regulator-max-microvolt = <2900000>;
		regulator-name = "mmci-reg";
		regulator-type = "voltage";

/* bench 9659.1.0 f4463c78a68e */
/* bench 9659.1.1 e6a05238ba0e */
/* bench 9659.1.2 0b7a9746d0e8 */
/* bench 9659.1.3 f73422a29cea */
/* bench 9659.1.4 297c73fec3ea */
/* bench 9659.1.5 76e27c77b683 */
/* bench 17178.0.0 578c75a07b41 */
/* bench 17178.0.1 ac4a787ce009 */
/* bench 17178.0.2 5dd90e9a5136 */
/* bench 17178.0.3 c16496134bc9 */
/* bench 17178.0.4 c290d7cbf924 */
/* bench 17178.0.5 5a917d5be590 */
/* bench 17178.0.6 3cdbd17fe97a */
/* bench 17178.0.7 58a02c64513e */
/* bench 17178.0.8 3786a1de4959 */
/* bench 17178.0.9 95b3cc58ee4f */
/* bench 17178.0.10 166ae31c806b */
/* bench 9659.1.6 59e6cc23ba41 */
/* bench 9659.1.7 fe2589c3d6ca */
/* bench 9659.1.8 f52d9e034c44 */
/* bench 9659.1.9 a4e26d6d4da0 */
/* bench 9659.1.10 552683ee6e25 */
/* bench 9659.1.11 cb1a031e36ab */
/* bench 9659.1.12 386713025c73 */
		startup-delay-us = <100>;

		states = <1800000 0x1
			  2900000 0x0>;

		gpios = <&tc3589x_gpio 18 GPIO_ACTIVE_HIGH>;
		enable-gpio = <&tc3589x_gpio 17 GPIO_ACTIVE_HIGH>;
		enable-active-high;
	};
};
