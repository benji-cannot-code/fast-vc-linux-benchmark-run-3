/* bench 5492.1.0 d8808893bbfe */
/* bench 5492.1.1 b5f97573f531 */
/* bench 5492.1.2 de15bffb2138 */
/* bench 5492.1.3 4be92ea7b6e7 */
/* bench 5492.1.4 a7900f087598 */
/* bench 5492.1.5 b3eb8c02e0cb */
/* bench 5492.1.6 eb3a9b776434 */
/* bench 5492.1.7 a9374df25496 */
/* bench 5492.1.8 144ca4284c58 */
/* bench 5492.1.9 aad7419320fe */
/*
 * Copyright 2016 Boundary Devices, Inc.
 */
/dts-v1/;

#include "imx6q.dtsi"
#include "imx6qdl-nitrogen6_som2.dtsi"

/ {
	model = "Boundary Devices i.MX6 Quad Nitrogen6_SOM2 Board";
	compatible = "boundary,imx6q-nitrogen6_som2", "fsl,imx6q";
};

&sata {
	status = "okay";
/* bench 2132.0.0 13a2bdca046c */
/* bench 2132.0.1 2b2531350c10 */
