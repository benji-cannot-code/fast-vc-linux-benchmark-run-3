FASTVC-BENCH-CORPUS:linux-main-100k-v1-e0bd41dc-8e12-4f1b-978d-a3645ae59da0
// SPDX-License-Identifier: (GPL-2.0+ OR MIT)
/*
 * Copyright (c) 2017 Andreas Färber
 * Copyright (c) 2018 Manivannan Sadhasivam
 */

/dts-v1/;

#include "rda8810pl.dtsi"

/ {
	compatible = "xunlong,orangepi-i96", "rda,8810pl";
/* bench 13406.0.0 abbcc8aa3e24 */
/* bench 13406.0.1 50beca6d1830 */
/* bench 13406.0.2 3539af339c1d */
/* bench 13406.0.3 ef062c882152 */
/* bench 13406.0.4 a0d829c9bfa6 */
/* bench 13406.0.5 a6bf8299965c */
/* bench 13406.0.6 a86adcba3d09 */
/* bench 13406.0.7 c90d168a4839 */
/* bench 13406.0.8 147a2a44a48e */
		serial0 = &uart2;
		serial1 = &uart1;
		serial2 = &uart3;
	};

	chosen {
		stdout-path = "serial2:921600n8";
	};

	memory@80000000 {
		device_type = "memory";
		reg = <0x80000000 0x10000000>;
	};

	uart_clk: uart-clk {
		compatible = "fixed-clock";
		clock-frequency = <921600>;
		#clock-cells = <0>;
	};
};

&uart1 {
	status = "okay";
	clocks = <&uart_clk>;
};

&uart2 {
	status = "okay";
	clocks = <&uart_clk>;
};

&uart3 {
	status = "okay";
	clocks = <&uart_clk>;
};
