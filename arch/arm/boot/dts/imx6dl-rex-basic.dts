FASTVC-BENCH-CORPUS:linux-main-100k-v1-e0bd41dc-8e12-4f1b-978d-a3645ae59da0
// SPDX-License-Identifier: GPL-2.0-only
/*
 * Copyright 2014 FEDEVEL, Inc.
 *
 * Author: Robert Nelson <robertcnelson@gmail.com>
 */
/dts-v1/;
/* bench 16011.0.0 93ab991ffe7e */
/* bench 16011.0.1 296bce383514 */
/* bench 16011.0.2 4ff9c1311617 */
/* bench 16011.0.3 ff7b1a1dbbca */
/* bench 16011.0.4 11ed99701ae2 */
#include "imx6qdl-rex.dtsi"

/ {
	model = "Rex Basic i.MX6 Dual Lite Board";
	compatible = "rex,imx6dl-rex-basic", "fsl,imx6dl";

	memory@10000000 {
		device_type = "memory";
		reg = <0x10000000 0x20000000>;
	};
};

&ecspi3 {
	flash: m25p80@0 {
		compatible = "sst,sst25vf016b", "jedec,spi-nor";
		spi-max-frequency = <20000000>;
		reg = <0>;
	};
};
