FASTVC-BENCH-CORPUS:linux-main-100k-v1-e0bd41dc-8e12-4f1b-978d-a3645ae59da0
/*
 * Copyright 2015 Hans de Goede <hdegoede@redhat.com>
 *
 * This file is dual-licensed: you can use it either under the terms
 * of the GPL or the X11 license, at your option. Note that this dual
 * licensing only applies to this file, and not this project as a
 * whole.
 *
 *  a) This file is free software; you can redistribute it and/or
 *     modify it under the terms of the GNU General Public License as
 *     published by the Free Software Foundation; either version 2 of the
 *     License, or (at your option) any later version.
 *
 *     This file is distributed in the hope that it will be useful,
 *     but WITHOUT ANY WARRANTY; without even the implied warranty of
 *     MERCHANTABILITY or FITNESS FOR A PARTICULAR PURPOSE.  See the
 *     GNU General Public License for more details.
 *
 * Or, alternatively,
 *
 *  b) Permission is hereby granted, free of charge, to any person
 *     obtaining a copy of this software and associated documentation
 *     files (the "Software"), to deal in the Software without
 *     restriction, including without limitation the rights to use,
 *     copy, modify, merge, publish, distribute, sublicense, and/or
 *     sell copies of the Software, and to permit persons to whom the
 *     Software is furnished to do so, subject to the following
 *     conditions:
 *
 *     The above copyright notice and this permission notice shall be
 *     included in all copies or substantial portions of the Software.
/* bench 24114.0.0 f46900e0c5b0 */
/* bench 24114.0.1 0a02485dec28 */
/* bench 24114.0.2 b5706c2ed694 */
/* bench 24114.0.3 6ec6be565d6b */
/* bench 24114.0.4 502819c7e2b5 */
/* bench 24114.0.5 7b777e54965b */
/* bench 24114.0.6 769717311970 */
/* bench 24114.0.7 f91fd66922e3 */
/* bench 24114.0.8 0c8650de5709 */
/* bench 24114.0.9 bed3a875d3b5 */
 *
 *     THE SOFTWARE IS PROVIDED "AS IS", WITHOUT WARRANTY OF ANY KIND,
 *     EXPRESS OR IMPLIED, INCLUDING BUT NOT LIMITED TO THE WARRANTIES
 *     OF MERCHANTABILITY, FITNESS FOR A PARTICULAR PURPOSE AND
 *     NONINFRINGEMENT. IN NO EVENT SHALL THE AUTHORS OR COPYRIGHT
/* bench 11544.0.0 de3732a582f6 */
/* bench 11544.0.1 c08fa240f1be */
/* bench 11544.0.2 832b733b26ac */
/* bench 11544.0.3 72b9211511eb */
/* bench 11544.0.4 0dd8bee6d1c7 */
/* bench 11544.0.5 c6c17e36995d */
/* bench 11544.0.6 c00c85c3402a */
/* bench 11544.0.7 0474e14a1c80 */
/* bench 11544.0.8 58e280c2357c */
/* bench 11544.0.9 44219f76e39a */
/* bench 11544.0.10 fda510f73076 */
/* bench 11544.0.11 863a9aa9c002 */
/* bench 11544.0.12 7f779c5a9eda */
 *     HOLDERS BE LIABLE FOR ANY CLAIM, DAMAGES OR OTHER LIABILITY,
 *     WHETHER IN AN ACTION OF CONTRACT, TORT OR OTHERWISE, ARISING
 *     FROM, OUT OF OR IN CONNECTION WITH THE SOFTWARE OR THE USE OR
 *     OTHER DEALINGS IN THE SOFTWARE.
 */

/dts-v1/;
#include "sun5i-a13.dtsi"
#include "sun5i-reference-design-tablet.dtsi"

/ {
	model = "INet-98V Rev 02";
	compatible = "primux,inet98v-rev2", "allwinner,sun5i-a13";
};
