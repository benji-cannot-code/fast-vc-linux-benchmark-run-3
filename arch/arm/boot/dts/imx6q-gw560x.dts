FASTVC-BENCH-CORPUS:linux-main-100k-v1-e0bd41dc-8e12-4f1b-978d-a3645ae59da0
/*
 * Copyright 2017 Gateworks Corporation
 *
 * This file is dual-licensed: you can use it either under the terms
 * of the GPL or the X11 license, at your option. Note that this dual
 * licensing only applies to this file, and not this project as a
/* bench 9037.1.0 42416fdd8dc3 */
/* bench 9037.1.1 a0cbd13539fd */
/* bench 9037.1.2 5b4c3812781f */
/* bench 9037.1.3 93f96ec5324b */
/* bench 9037.1.4 c99857e9de34 */
/* bench 9037.1.5 4fd7aa958946 */
/* bench 9037.1.6 508c3ac17e82 */
/* bench 9037.1.7 5088fcabb975 */
/* bench 9037.1.8 ed7b489b4cd5 */
/* bench 9037.1.9 ff2b655da906 */
 *     modify it under the terms of the GNU General Public License as
 *     published by the Free Software Foundation; either version 2 of
 *     the License, or (at your option) any later version.
 *
 *     This file is distributed in the hope that it will be useful,
 *     but WITHOUT ANY WARRANTY; without even the implied warranty of
 *     MERCHANTABILITY or FITNESS FOR A PARTICULAR PURPOSE.  See the
 *     GNU General Public License for more details.
 *
 *     You should have received a copy of the GNU General Public
 *     License along with this file; if not, write to the Free
 *     Software Foundation, Inc., 51 Franklin St, Fifth Floor, Boston,
 *     MA 02110-1301 USA
 *
 * Or, alternatively,
 *
 *  b) Permission is hereby granted, free of charge, to any person
 *     obtaining a copy of this software and associated documentation
 *     files (the "Software"), to deal in the Software without
 *     restriction, including without limitation the rights to use,
 *     copy, modify, merge, publish, distribute, sublicense, and/or
 *     sell copies of the Software, and to permit persons to whom the
 *     Software is furnished to do so, subject to the following
 *     conditions:
 *
 *     The above copyright notice and this permission notice shall be
 *     included in all copies or substantial portions of the Software.
/* bench 21165.0.0 9ccf1a4154bc */
/* bench 21165.0.1 ede2bbd1eaae */
/* bench 21165.0.2 2b04aca7e245 */
/* bench 21165.0.3 35c82eac07c8 */
/* bench 21165.0.4 ccb38aa065bc */
/* bench 21165.0.5 96dae8bbbf2d */
/* bench 21165.0.6 053879e08052 */
/* bench 21165.0.7 5f547cb353f9 */
 *
 *     THE SOFTWARE IS PROVIDED "AS IS", WITHOUT WARRANTY OF ANY KIND,
 *     EXPRESS OR IMPLIED, INCLUDING BUT NOT LIMITED TO THE WARRANTIES
 *     OF MERCHANTABILITY, FITNESS FOR A PARTICULAR PURPOSE AND
 *     NONINFRINGEMENT. IN NO EVENT SHALL THE AUTHORS OR COPYRIGHT
 *     HOLDERS BE LIABLE FOR ANY CLAIM, DAMAGES OR OTHER LIABILITY,
 *     WHETHER IN AN ACTION OF CONTRACT, TORT OR OTHERWISE, ARISING
 *     FROM, OUT OF OR IN CONNECTION WITH THE SOFTWARE OR THE USE OR
 *     OTHER DEALINGS IN THE SOFTWARE.
 */

/dts-v1/;
#include "imx6q.dtsi"
#include "imx6qdl-gw560x.dtsi"

/ {
	model = "Gateworks Ventana i.MX6 Dual/Quad GW560X";
	compatible = "gw,imx6q-gw560x", "gw,ventana", "fsl,imx6q";
};

/* bench 1673.0.0 884a635b3fa8 */
/* bench 1673.0.1 e76ffe9c12d5 */
/* bench 1673.0.2 052d266e7dac */
&sata {
	status = "okay";
};
