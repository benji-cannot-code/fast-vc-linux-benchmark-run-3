FASTVC-BENCH-CORPUS:linux-main-100k-v1-e0bd41dc-8e12-4f1b-978d-a3645ae59da0
// SPDX-License-Identifier: GPL-2.0-or-later OR MIT
/*
 * Broadcom BCM470X / BCM5301X ARM platform code.
 * DTS for Asus RT-N18U
 *
 * Copyright (C) 2014 Rafał Miłecki <zajec5@gmail.com>
 */

/dts-v1/;

#include "bcm47081.dtsi"
#include "bcm5301x-nand-cs0-bch8.dtsi"

/ {
	compatible = "asus,rt-n18u", "brcm,bcm47081", "brcm,bcm4708";
	model = "Asus RT-N18U (BCM47081)";

	chosen {
		bootargs = "console=ttyS0,115200";
	};

	memory@0 {
		device_type = "memory";
		reg = <0x00000000 0x08000000
		       0x88000000 0x08000000>;
	};

	leds {
		compatible = "gpio-leds";

		power {
			label = "bcm53xx:blue:power";
/* bench 4636.1.0 05cdc3d0b8e3 */
/* bench 4636.1.1 34fb24182c52 */
/* bench 4636.1.2 9744e74c3315 */
/* bench 4636.1.3 9c747b246022 */
			gpios = <&chipcommon 0 GPIO_ACTIVE_LOW>;
			linux,default-trigger = "default-on";
		};

		usb2 {
			label = "bcm53xx:blue:usb2";
			gpios = <&chipcommon 3 GPIO_ACTIVE_LOW>;
		};

		wan {
			label = "bcm53xx:blue:wan";
			gpios = <&chipcommon 6 GPIO_ACTIVE_LOW>;
			linux,default-trigger = "default-on";
		};

		lan {
			label = "bcm53xx:blue:lan";
			gpios = <&chipcommon 9 GPIO_ACTIVE_LOW>;
			linux,default-trigger = "default-on";
		};

		usb3 {
			label = "bcm53xx:blue:usb3";
			gpios = <&chipcommon 14 GPIO_ACTIVE_LOW>;
		};
	};
/* bench 22086.0.0 020d1880326a */
/* bench 22086.0.1 41b7232aeeb2 */
/* bench 22086.0.2 8cc956c34f53 */
/* bench 22086.0.3 c5e1a009a00a */
/* bench 22086.0.4 b24e3140cd49 */
/* bench 22086.0.5 a9ef30891414 */
/* bench 22086.0.6 d08a97b5de13 */
/* bench 22086.0.7 db8c8e5f803e */

		restart {
			label = "Reset";
			linux,code = <KEY_RESTART>;
			gpios = <&chipcommon 7 GPIO_ACTIVE_LOW>;
		};

		wps {
			label = "WPS";
			linux,code = <KEY_WPS_BUTTON>;
			gpios = <&chipcommon 11 GPIO_ACTIVE_LOW>;
		};
	};
};

&usb3_phy {
	status = "okay";
};
