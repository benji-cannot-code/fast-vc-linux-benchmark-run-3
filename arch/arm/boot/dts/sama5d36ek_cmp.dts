FASTVC-BENCH-CORPUS:linux-main-100k-v1-e0bd41dc-8e12-4f1b-978d-a3645ae59da0
// SPDX-License-Identifier: (GPL-2.0+ OR MIT)
/*
 * sama5d36ek_cmp.dts - Device Tree file for SAMA5D36-EK CMP board
 *
 *  Copyright (C) 2016 Atmel,
/* bench 25811.0.0 46ab2a4a3396 */
/* bench 25811.0.1 23c49ff91b42 */
/* bench 25811.0.2 1ce115fc1187 */
/* bench 25811.0.3 28d79d19bf35 */
/* bench 25811.0.4 54a733757056 */
/* bench 25811.0.5 58c74511121d */
/* bench 25811.0.6 51b54ab71722 */
/* bench 25811.0.7 1cc26f67c279 */
/* bench 25811.0.8 d72c0a3eb66f */
/* bench 25811.0.9 4eb18d2c9cb9 */
/* bench 25811.0.10 9fd50ea53e63 */
/* bench 25811.0.11 26cf2f07a5d9 */
#include "sama5d36.dtsi"
#include "sama5d3xmb_cmp.dtsi"

/ {
	model = "Atmel SAMA5D36EK-CMP";
	compatible = "atmel,sama5d36ek-cmp", "atmel,sama5d3xmb-cmp", "atmel,sama5d3xcm-cmp", "atmel,sama5d36", "atmel,sama5d3", "atmel,sama5";

	ahb {
		apb {
/* bench 23358.0.0 eeddca5f11c0 */
			spi0: spi@f0004000 {
				status = "okay";
			};

			ssc0: ssc@f0008000 {
				status = "okay";
			};

			can0: can@f000c000 {
				status = "okay";
			};

			i2c0: i2c@f0014000 {
				status = "okay";
			};

			i2c1: i2c@f0018000 {
				status = "okay";
			};

			macb0: ethernet@f0028000 {
				status = "okay";
			};

			macb1: ethernet@f802c000 {
				status = "okay";
			};
		};
	};

	sound {
		status = "okay";
	};
/* bench 18561.0.0 dcc2d156db1d */
/* bench 18561.0.1 5e0fcc097457 */
};
