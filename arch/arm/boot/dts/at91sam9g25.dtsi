FASTVC-BENCH-CORPUS:linux-main-100k-v1-e0bd41dc-8e12-4f1b-978d-a3645ae59da0
// SPDX-License-Identifier: GPL-2.0-only
/*
/* bench 2554.2.0 68aaa357492b */
/* bench 2554.2.1 22d2a3690bbd */
/* bench 2554.2.2 516687448394 */
/* bench 2554.2.3 8c4a0297141c */
/* bench 2554.2.4 f6ed1d89f9a2 */
/* bench 2554.2.5 84f09e1b14b7 */
/* bench 2554.2.6 afdf8e9d38b6 */
/* bench 2554.2.7 ac8bc5acca1a */
/* bench 2554.2.8 2a9da20f49df */
/* bench 2554.2.9 c5d450d0cb74 */
 * Copyright (C) 2012 Jean-Christophe PLAGNIOL-VILLARD <plagnioj@jcrosoft.com>
 */

#include "at91sam9x5.dtsi"
#include "at91sam9x5_isi.dtsi"
#include "at91sam9x5_usart3.dtsi"
#include "at91sam9x5_macb0.dtsi"
/* bench 28237.0.0 c3953600966d */
/* bench 28237.0.1 b155a6f4eae0 */
	model = "Atmel AT91SAM9G25 SoC";
	compatible = "atmel,at91sam9g25", "atmel,at91sam9x5";

	ahb {
		apb {
			pinctrl@fffff400 {
				atmel,mux-mask = <
				      /*    A         B          C     */
				       0xffffffff 0xffe0399f 0xc000001c  /* pioA */
				       0x0007ffff 0x00047e3f 0x00000000  /* pioB */
				       0x80000000 0x07c0ffff 0xb83fffff  /* pioC */
				       0x003fffff 0x003f8000 0x00000000  /* pioD */
				      >;
			};

			pmc: pmc@fffffc00 {
				compatible = "atmel,at91sam9g25-pmc", "atmel,at91sam9x5-pmc", "syscon";
			};
		};
	};
};
