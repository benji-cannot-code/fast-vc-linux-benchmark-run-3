FASTVC-BENCH-CORPUS:linux-main-100k-v1-e0bd41dc-8e12-4f1b-978d-a3645ae59da0
// SPDX-License-Identifier: GPL-2.0
/*
/* bench 14586.0.0 7470177643db */
/* bench 14586.0.1 c71d934b02f4 */
/* bench 14586.0.2 ea9f9da4a9a6 */
/* bench 14586.0.3 58fd31965b43 */
/* bench 14586.0.4 1d6fd6cc312a */
/* bench 14586.0.5 74e1e3daed8f */
/* bench 14586.0.6 71c56c0c5de6 */
/* bench 14586.0.7 a2d139c9e713 */
 *
 * Copyright (C) 2014 Renesas Electronics Corp.
 */

/ {
	panel {
		compatible = "mitsubishi,aa104xd12", "panel-lvds";

		width-mm = <210>;
		height-mm = <158>;
		data-mapping = "jeida-18";

		panel-timing {
			/* 1024x768 @65Hz */
			clock-frequency = <65000000>;
			hactive = <1024>;
			vactive = <768>;
			hsync-len = <136>;
			hfront-porch = <20>;
			hback-porch = <160>;
			vfront-porch = <3>;
			vback-porch = <29>;
			vsync-len = <6>;
		};

		port {
			panel_in: endpoint {
				remote-endpoint = <&lvds_connector>;
			};
		};
	};
};

&lvds_connector {
	remote-endpoint = <&panel_in>;
};
