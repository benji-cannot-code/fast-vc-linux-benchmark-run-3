FASTVC-BENCH-CORPUS:linux-main-100k-v1-e0bd41dc-8e12-4f1b-978d-a3645ae59da0
/*
 * Copyright 2016 Free Electrons
 *
 * Quentin Schulz <quentin.schulz@free-electrons.com>
 *
 * This file is dual-licensed: you can use it either under the terms
 * of the GPL or the X11 license, at your option. Note that this dual
 * licensing only applies to this file, and not this project as a
 * whole.
 *
 *  a) This file is free software; you can redistribute it and/or
 *     modify it under the terms of the GNU General Public License as
 *     published by the Free Software Foundation; either version 2 of the
 *     License, or (at your option) any later version.
 *
 *     This file is distributed in the hope that it will be useful,
 *     but WITHOUT ANY WARRANTY; without even the implied warranty of
/* bench 2381.0.0 84c3033abbb3 */
/* bench 2381.0.1 46e42281e9b5 */
/* bench 2381.0.2 8ded2b56b66d */
/* bench 2381.0.3 b8ec500463ff */
/* bench 2381.0.4 d9256588bbb5 */
/* bench 2381.0.5 c391fced541f */
/* bench 2381.0.6 bf44543bd34b */
/* bench 2381.0.7 86d763c588c5 */
/* bench 2381.0.8 35f9317da844 */
/* bench 2381.0.9 a876cac7f470 */
/* bench 2381.0.10 f2158f1c0f3b */
 *     MERCHANTABILITY or FITNESS FOR A PARTICULAR PURPOSE.  See the
 *     GNU General Public License for more details.
 *
 * Or, alternatively,
 *
 *  b) Permission is hereby granted, free of charge, to any person
 *     obtaining a copy of this software and associated documentation
 *     files (the "Software"), to deal in the Software without
 *     restriction, including without limitation the rights to use,
 *     copy, modify, merge, publish, distribute, sublicense, and/or
 *     sell copies of the Software, and to permit persons to whom the
 *     Software is furnished to do so, subject to the following
 *     conditions:
 *
 *     The above copyright notice and this permission notice shall be
 *     included in all copies or substantial portions of the Software.
 *
 *     THE SOFTWARE IS PROVIDED "AS IS", WITHOUT WARRANTY OF ANY KIND,
 *     EXPRESS OR IMPLIED, INCLUDING BUT NOT LIMITED TO THE WARRANTIES
 *     OF MERCHANTABILITY, FITNESS FOR A PARTICULAR PURPOSE AND
 *     NONINFRINGEMENT. IN NO EVENT SHALL THE AUTHORS OR COPYRIGHT
 *     HOLDERS BE LIABLE FOR ANY CLAIM, DAMAGES OR OTHER LIABILITY,
 *     WHETHER IN AN ACTION OF CONTRACT, TORT OR OTHERWISE, ARISING
 *     FROM, OUT OF OR IN CONNECTION WITH THE SOFTWARE OR THE USE OR
 *     OTHER DEALINGS IN THE SOFTWARE.
 */

/*
 * AXP223 Integrated Power Management Chip
 * http://www.x-powers.com/product/AXP22X.php
 * http://dl.linux-sunxi.org/AXP/AXP223-en.pdf
 *
 * The AXP223 shares most of its logic with the AXP221 but it has some
 * differences, for the VBUS driver for example.
 */

#include "axp22x.dtsi"

&usb_power_supply {
	compatible = "x-powers,axp223-usb-power-supply";
};
