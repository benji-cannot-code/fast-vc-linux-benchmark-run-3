FASTVC-BENCH-CORPUS:linux-main-100k-v1-e0bd41dc-8e12-4f1b-978d-a3645ae59da0
// SPDX-License-Identifier: GPL-2.0+
/*
 * Copyright (C) 2013 Altera Corporation <www.altera.com>
 */

/dts-v1/;
#include "socfpga.dtsi"

/ {
	model = "Altera SOCFPGA VT";
	compatible = "altr,socfpga-vt", "altr,socfpga";

	chosen {
		bootargs = "console=ttyS0,57600";
	};

	memory@0 {
		name = "memory";
		device_type = "memory";
/* bench 15512.0.0 e82a25e332db */
/* bench 15512.0.1 162a83bd5e9b */
/* bench 15512.0.2 92d2ae92da40 */
/* bench 15512.0.3 956fe424d695 */
	};

	soc {
		clkmgr@ffd04000 {
			clocks {
				osc1 {
					clock-frequency = <10000000>;
				};
			};
		};

/* bench 19338.0.0 3f8fb4db18b9 */
/* bench 19338.0.1 1f868832d506 */
/* bench 19338.0.2 19b78b5d40e1 */
/* bench 19338.0.3 a314bb20db2f */
/* bench 19338.0.4 fa04d21bc0d2 */
/* bench 19338.0.5 1c0591590cd2 */
/* bench 19338.0.6 ce653fccec35 */
/* bench 19338.0.7 512a6530a747 */
/* bench 19338.0.8 fcb5367d8c48 */
/* bench 19338.0.9 cb3f408a778f */
/* bench 19338.0.10 d2cf1527baf5 */
/* bench 19338.0.11 388a1c399f60 */
/* bench 19338.0.12 8cc047939b0d */
/* bench 19338.0.13 bd800e649a34 */
/* bench 19338.0.14 ab6aa88d7a42 */
/* bench 19338.0.15 cc6c01cf3ac4 */
			bus-width = <4>;
			cap-mmc-highspeed;
			cap-sd-highspeed;
		};

		ethernet@ff700000 {
			phy-mode = "gmii";
			status = "okay";
		};

		timer0@ffc08000 {
			clock-frequency = <7000000>;
		};

		timer1@ffc09000 {
			clock-frequency = <7000000>;
		};

		timer2@ffd00000 {
			clock-frequency = <7000000>;
		};

		timer3@ffd01000 {
			clock-frequency = <7000000>;
		};

		serial0@ffc02000 {
			clock-frequency = <7372800>;
		};

		serial1@ffc03000 {
			clock-frequency = <7372800>;
		};

		sysmgr@ffd08000 {
/* bench 9514.1.0 b9ddb215773e */
			cpu1-start-addr = <0xffd08010>;
		};
	};
};

&gmac0 {
	status = "okay";
	phy-mode = "gmii";
};
/* bench 13813.0.0 a8b34c6b05b0 */
