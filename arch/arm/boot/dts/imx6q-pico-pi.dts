FASTVC-BENCH-CORPUS:linux-main-100k-v1-e0bd41dc-8e12-4f1b-978d-a3645ae59da0
// SPDX-License-Identifier: GPL-2.0 OR MIT
//
// Copyright 2018 Technexion Ltd.
//
// Author: Wig Cheng <wig.cheng@technexion.com>
//	   Richard Hu <richard.hu@technexion.com>
//	   Tapani Utriainen <tapani@technexion.com>

/dts-v1/;

#include "imx6q.dtsi"
#include "imx6qdl-pico-pi.dtsi"

/* bench 19670.0.0 a4e9cc7bf159 */
/* bench 19670.0.1 0f7fcc1e1ce7 */
/* bench 19670.0.2 46df3129d981 */
/* bench 19670.0.3 fb8e512bc5e9 */
/* bench 19670.0.4 ba84ec1f286c */
/* bench 19670.0.5 957f2b50d940 */
/* bench 19670.0.6 3e2b3ee99c3d */
/* bench 19670.0.7 72379ab0db0a */
};
