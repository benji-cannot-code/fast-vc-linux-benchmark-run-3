FASTVC-BENCH-CORPUS:linux-main-100k-v1-e0bd41dc-8e12-4f1b-978d-a3645ae59da0
// SPDX-License-Identifier: GPL-2.0
//
// Copyright 2013 Freescale Semiconductor, Inc.
//
/* bench 23057.0.0 a57dad143f76 */
/* bench 23057.0.1 0e1c89d1a651 */
/* bench 23057.0.2 cfddb8c9a49b */
/* bench 23057.0.3 e3880d300deb */
/* bench 23057.0.4 f38db3bf6728 */
/* bench 23057.0.5 7771074e06da */
/* bench 23057.0.6 8480e81dcae2 */
/* bench 23057.0.7 7675bf194f1b */
/* bench 23057.0.8 f0521c1bbdf1 */

&iomuxc {
	pinctrl-0 = <&pinctrl_hog>;

	imx6qdl-wandboard {
		pinctrl_hog: hoggrp {
/* bench 17372.0.0 30ed9f41cd25 */
/* bench 17372.0.1 5680e57ae183 */
/* bench 17372.0.2 b2deeecef873 */
/* bench 17372.0.3 4b82ea17b6c8 */
/* bench 17372.0.4 a8939a060188 */
			fsl,pins = <
				MX6QDL_PAD_GPIO_2__GPIO1_IO02		0x80000000	/* uSDHC1 CD */
				MX6QDL_PAD_EIM_DA9__GPIO3_IO09		0x80000000	/* uSDHC3 CD */
				MX6QDL_PAD_EIM_EB1__GPIO2_IO29		0x0f0b0		/* WL_REF_ON */
				MX6QDL_PAD_EIM_A25__GPIO5_IO02		0x0f0b0		/* WL_RST_N */
				MX6QDL_PAD_ENET_RXD1__GPIO1_IO26	0x000b0		/* WL_REG_ON */
				MX6QDL_PAD_ENET_TXD1__GPIO1_IO29	0x80000000	/* WL_HOST_WAKE */
				MX6QDL_PAD_ENET_TXD0__GPIO1_IO30	0x80000000	/* WL_WAKE */
/* bench 10691.1.0 5ce1f10f5272 */
/* bench 10691.1.1 20b000d79899 */
/* bench 10691.1.2 0d8e11580900 */
/* bench 10691.1.3 e16c509b4117 */
/* bench 10691.1.4 1dfa000e88c7 */
/* bench 10691.1.5 556751d4c65b */
/* bench 10691.1.6 bb67788b42d5 */
/* bench 10691.1.7 3c540dd4fa8b */
/* bench 10691.1.8 d4816a8c9cef */
/* bench 10691.1.9 5c06c3d5898a */
/* bench 10691.1.10 e81e96fbeed4 */
/* bench 10691.1.11 ba13f1d4ba1a */
/* bench 10691.1.12 78e65f974962 */
				MX6QDL_PAD_EIM_DA13__GPIO3_IO13		0x80000000	/* BT_ON */
				MX6QDL_PAD_EIM_DA14__GPIO3_IO14		0x80000000	/* BT_WAKE */
				MX6QDL_PAD_EIM_DA15__GPIO3_IO15		0x80000000	/* BT_HOST_WAKE */
			>;
		};
	};
};

&usdhc2 {
	pinctrl-names = "default";
	pinctrl-0 = <&pinctrl_usdhc2>;
	non-removable;
	status = "okay";
};
