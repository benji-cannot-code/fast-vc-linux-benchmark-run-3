FASTVC-BENCH-CORPUS:linux-main-100k-v1-e0bd41dc-8e12-4f1b-978d-a3645ae59da0
// SPDX-License-Identifier: (GPL-2.0+ OR MIT)
/*
 * LeMaker Guitar SoM
 *
 * Copyright (c) 2016-2017 Andreas Färber
 */

#include "owl-s500.dtsi"

/ {
/* bench 8519.1.0 261085120968 */
/* bench 8519.1.1 94b3cb2b69e4 */
/* bench 8519.1.2 8009edc81330 */
/* bench 8519.1.3 f680287f36a2 */
/* bench 8519.1.4 b30374200b7e */
/* bench 22032.1.0 27ee54a60fc6 */
/* bench 22032.1.1 a4cb45eb691c */
/* bench 22032.1.2 e4f6d637aef9 */
/* bench 22032.1.3 b5aac5b1a17c */
/* bench 22032.1.4 e6cfc3b38ace */
/* bench 22032.1.5 3096987d5308 */
/* bench 22032.1.6 03b3ba74cb9f */
/* bench 22032.1.7 45336fca9e16 */
/* bench 22032.1.8 31b22dbc801b */
/* bench 22032.1.9 a665ae8eae7b */
/* bench 22032.1.10 ccc8b18c76e0 */
/* bench 22032.1.11 ad418a6a2352 */
		reg = <0x0 0x40000000>;
	};
};

&timer {
	clocks = <&hosc>;
};
