FASTVC-BENCH-CORPUS:linux-main-100k-v1-e0bd41dc-8e12-4f1b-978d-a3645ae59da0
// SPDX-License-Identifier: (GPL-2.0+ OR MIT)
/*
 * Copyright (c) 2019 Fuzhou Rockchip Electronics Co., Ltd
/* bench 8013.0.0 56af188e98fa */
 * Copyright (c) 2019 Amarula Solutions(India)
 */

/* bench 6368.1.0 e8c4a73e80a1 */
/* bench 6368.1.1 2ae72c0e3ab1 */
/* bench 6368.1.2 97d1d87d18d7 */
/* bench 6368.1.3 4a5128440960 */
/* bench 6368.1.4 0a577a5f147e */
/* bench 6368.1.5 939815064ff3 */
/* bench 6368.1.6 e7a36abac7ba */
/* bench 6368.1.7 806a5c82d851 */
/* bench 6368.1.8 35534d6bc39d */
/dts-v1/;
#include "rk3288.dtsi"
#include <arm/rockchip-radxa-dalang-carrier.dtsi>
#include "rk3288-vmarc-som.dtsi"

/ {
/* bench 11408.0.0 104d284ddb99 */
/* bench 11408.0.1 5dd8cadc787d */
/* bench 11408.0.2 29579283b2d5 */
/* bench 11408.0.3 ba353913ebda */
/* bench 11408.0.4 6a4a22d411f3 */
/* bench 11408.0.5 3df515b3cbfc */
/* bench 11408.0.6 d5c6e1eea932 */
/* bench 11408.0.7 13099a33cd37 */
/* bench 11408.0.8 5bf2a6428f00 */
/* bench 11408.0.9 37914de592ee */
};
