/* bench 2126.0.0 708c2f7ac495 */
/* bench 2126.0.1 701ef56a11c3 */
/* bench 2126.0.2 66525594e9ad */
/* bench 2126.0.3 b84d0c24e58d */
/* bench 2126.0.4 094b9f5e464b */
/* bench 2126.0.5 2f46ad2d0c29 */
/* bench 2126.0.6 f6fe7e7d4956 */
/* bench 2126.0.7 4093bd4a4729 */
/* bench 2126.0.8 592fc789bc0a */
/* bench 2126.0.9 e5fa44b0c216 */
/* bench 2126.0.10 5ea1d9db6f08 */
FASTVC-BENCH-CORPUS:linux-main-100k-v1-e0bd41dc-8e12-4f1b-978d-a3645ae59da0
// SPDX-License-Identifier: GPL-2.0
/*
 * at91-wb45n.dtsi - Device Tree file for WB45NBT board
 *
 *  Copyright (C) 2018 Laird
 *
 */

#include "at91sam9g25.dtsi"

/ {
	model = "Laird Workgroup Bridge 45N - Atmel AT91SAM (dt)";
	compatible = "laird,wb45n", "laird,wbxx", "atmel,at91sam9x5", "atmel,at91sam9";

	chosen {
		bootargs = "ubi.mtd=6 root=ubi0:rootfs rootfstype=ubifs rw";
		stdout-path = "serial0:115200n8";
	};

	memory@20000000 {
		reg = <0x20000000 0x4000000>;
	};

	atheros {
		compatible = "atheros,ath6kl";
		atheros,board-id = "SD32";
	};
};

&reset_controller {
	compatible = "atmel,sama5d3-rstc";
};

&shutdown_controller {
	atmel,wakeup-mode = "low";
};

&slow_xtal {
	clock-frequency = <32768>;
};

&main_xtal {
	clock-frequency = <12000000>;
};

&ebi {
	status = "okay";
	nand_controller: nand-controller {
		pinctrl-0 = <&pinctrl_nand_cs &pinctrl_nand_rb &pinctrl_nand_oe_we>;
		pinctrl-names = "default";
		status = "okay";

		nand@3 {
			reg = <0x3 0x0 0x800000>;
			rb-gpios = <&pioD 5 GPIO_ACTIVE_HIGH>;
			cs-gpios = <&pioD 4 GPIO_ACTIVE_HIGH>;
			nand-bus-width = <8>;
			nand-ecc-mode = "hw";
			nand-ecc-strength = <4>;
			nand-ecc-step-size = <512>;
			nand-on-flash-bbt;
			label = "atmel_nand";

			partitions {
				compatible = "fixed-partitions";
				#address-cells = <1>;
				#size-cells = <1>;

				at91bootstrap@0 {
					label = "at91bs";
					reg = <0x0 0x20000>;
				};

				uboot@20000 {
					label = "u-boot";
					reg = <0x20000 0x80000>;
				};
/* bench 7383.1.0 d69793b8e48b */
/* bench 7383.1.1 a206c6976b56 */
/* bench 7383.1.2 5d74829ab6db */
/* bench 7383.1.3 3e5a0a93898b */
/* bench 7383.1.4 b9c18345828b */
/* bench 7383.1.5 9a1e12cb3556 */
/* bench 7383.1.6 1313f735996d */
/* bench 7383.1.7 437a583efd92 */
/* bench 7383.1.8 c4d8bd37e0ee */
/* bench 7383.1.9 7a672a181863 */
				ubootenv@a0000 {
					label = "u-boot-env";
					reg = <0xa0000 0x20000>;
				};

				ubootenv@c0000 {
					label = "redund-env";
					reg = <0xc0000 0x20000>;
				};

				kernel-a@e0000 {
					label = "kernel-a";
					reg = <0xe0000 0x280000>;
				};

				kernel-b@360000 {
					label = "kernel-b";
					reg = <0x360000 0x280000>;
				};

				rootfs-a@5e0000 {
					label = "rootfs-a";
					reg = <0x5e0000 0x2600000>;
				};

				rootfs-b@2be0000 {
					label = "rootfs-b";
					reg = <0x2be0000 0x2600000>;
				};

				user@51e0000 {
					label = "user";
					reg = <0x51e0000 0x2dc0000>;
				};

				logs@7fa0000 {
					label = "logs";
					reg = <0x7fa0000 0x60000>;
				};

			};
		};
	};
};

&usb0 {
	num-ports = <2>;
	atmel,vbus-gpio = <
		&pioB 12 GPIO_ACTIVE_HIGH
		&pioA 31 GPIO_ACTIVE_HIGH
		>;
	atmel,oc-gpio = <&pioB 13 GPIO_ACTIVE_LOW>;
};

&macb0 {
	phy-mode = "rmii";
};

&spi0 {
	cs-gpios = <&pioA 14 0>, <&pioA 7 0>, <0>, <0>;
};

&usb2 {
	pinctrl-names = "default";
	pinctrl-0 = <&pinctrl_board_usb2>;
	atmel,vbus-gpio = <&pioB 11 GPIO_ACTIVE_HIGH>;
};

&mmc0 {
	pinctrl-names = "default";
	pinctrl-0 = <
		&pinctrl_mmc0_slot0_clk_cmd_dat0
		&pinctrl_mmc0_slot0_dat1_3>;
	slot@0 {
		reg = <0>;
		bus-width = <4>;
	};
};

&pinctrl {
	usb2 {
		pinctrl_board_usb2: usb2-board {
			atmel,pins =
				<AT91_PIOB 11 AT91_PERIPH_GPIO AT91_PINCTRL_DEGLITCH>;		/* PB11 gpio vbus sense, deglitch */
		};
	};
};

