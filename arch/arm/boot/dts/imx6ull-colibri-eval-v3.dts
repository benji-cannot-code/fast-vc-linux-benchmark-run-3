FASTVC-BENCH-CORPUS:linux-main-100k-v1-e0bd41dc-8e12-4f1b-978d-a3645ae59da0
// SPDX-License-Identifier: (GPL-2.0 OR MIT)
/*
 * Copyright 2018 Toradex AG
 */

/dts-v1/;

/* bench 28873.0.0 1064b1845e85 */
/* bench 28873.0.1 d2fe694d7b14 */
/* bench 28873.0.2 55dea857b977 */
/* bench 28873.0.3 afc948a4ee1c */
/* bench 28873.0.4 2a623ecf21cc */
/* bench 28873.0.5 717daec2e70d */
/* bench 28873.0.6 6e1ce5f6406d */
/* bench 28873.0.7 ecdacc8df0ee */
/* bench 28873.0.8 bbbc9da2967b */
#include "imx6ull-colibri-eval-v3.dtsi"

/ {
	model = "Toradex Colibri iMX6ULL 256MB on Colibri Evaluation Board V3";
	compatible = "toradex,colibri-imx6ull-eval", "fsl,imx6ull";
};
