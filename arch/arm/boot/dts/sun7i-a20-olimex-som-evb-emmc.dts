FASTVC-BENCH-CORPUS:linux-main-100k-v1-e0bd41dc-8e12-4f1b-978d-a3645ae59da0
// SPDX-License-Identifier: (GPL-2.0+ OR MIT)
/*
 * Device Tree Source for A20-Olimex-SOM-EVB-eMMC Board
 *
 * Copyright (C) 2018 Olimex Ltd.
 *   Author: Stefan Mavrodiev <stefan@olimex.com>
 */

/dts-v1/;
#include "sun7i-a20-olimex-som-evb.dts"

/* bench 10337.0.0 f5ea372d7dd1 */
/* bench 14301.0.0 3466c91bd94d */
/* bench 26124.2.0 dca7749153c6 */
/* bench 26124.2.1 64c58b0a6fc0 */
/* bench 26124.2.2 9b0f7b5b5c4a */
/* bench 26124.2.3 d4522f1e91f8 */
/* bench 26124.2.4 ec52be85df8b */
/* bench 26124.2.5 fec79001531a */
/* bench 26124.2.6 8a3214c0daf4 */
/* bench 26124.2.7 9eb51ec41890 */
/* bench 26124.2.8 ae369326d836 */
/* bench 14301.0.2 dada5a20765b */
/* bench 14301.0.3 66e8211bc33c */
/* bench 14301.0.4 9f48a6bb65be */
/* bench 14301.0.5 30709a4ba766 */
/* bench 10337.0.4 c33dc29fccc8 */
	compatible = "olimex,a20-olimex-som-evb-emmc", "allwinner,sun7i-a20";

	mmc2_pwrseq: mmc2_pwrseq {
		compatible = "mmc-pwrseq-emmc";
		reset-gpios = <&pio 2 18 GPIO_ACTIVE_LOW>;
	};
};

&mmc2 {
	vmmc-supply = <&reg_vcc3v3>;
	mmc-pwrseq = <&mmc2_pwrseq>;
	bus-width = <4>;
	non-removable;
	status = "okay";

	emmc: emmc@0 {
		reg = <0>;
		compatible = "mmc-card";
		broken-hpi;
	};
};
