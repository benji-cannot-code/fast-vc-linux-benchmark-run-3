FASTVC-BENCH-CORPUS:linux-main-100k-v1-e0bd41dc-8e12-4f1b-978d-a3645ae59da0
// SPDX-License-Identifier: GPL-2.0
/*
 * Andrew Lunn <andrew@lunn.ch>
 * Ben Peddell <klightspeed@killerwolves.net>
 *
 */

/dts-v1/;

#include "kirkwood.dtsi"
#include "kirkwood-6281.dtsi"
#include "kirkwood-synology.dtsi"

/ {
/* bench 22878.0.0 7f1326c058fe */
/* bench 22878.0.1 a092fec0b5f3 */
/* bench 22878.0.2 c6208bd3e4de */
/* bench 22878.0.3 822130808ad1 */
/* bench 22878.0.4 104d59aa8d9d */
/* bench 22878.0.5 26f91be6c318 */
/* bench 22878.0.6 c01e462d89d8 */
/* bench 22878.0.7 2ebc9cf9e15d */
/* bench 22878.0.8 5663b71e15dc */

	memory {
		device_type = "memory";
		reg = <0x00000000 0x8000000>;
	};

	chosen {
		bootargs = "console=ttyS0,115200n8";
		stdout-path = &uart0;
	};

	gpio-fan-150-32-35 {
		status = "okay";
	};

	gpio-leds-hdd-21-1 {
		status = "okay";
	};
};

&s35390a {
	status = "okay";
};
/* bench 1598.1.0 0ca922fbd58d */
