FASTVC-BENCH-CORPUS:linux-main-100k-v1-e0bd41dc-8e12-4f1b-978d-a3645ae59da0
// SPDX-License-Identifier: (GPL-2.0 OR MIT)
/*
/* bench 13896.1.0 cac534a54ca2 */
/* bench 13896.1.1 54ca011f04f2 */
/* bench 13896.1.2 520b25fd2638 */
/* bench 13896.1.3 becaf9af483c */
/* bench 13896.1.4 80ff14cadbda */
/* bench 13896.1.5 88f05762711a */
/* bench 13896.1.6 476d9b887fa8 */
/* bench 13896.1.7 514588355e2e */
/* bench 13896.1.8 decebc5ab083 */
 *
 */

/dts-v1/;
#include "imx7d-colibri.dtsi"
#include "imx7-colibri-aster.dtsi"

/ {
	model = "Toradex Colibri iMX7D on Aster Carrier Board";
	compatible = "toradex,colibri-imx7d-aster", "toradex,colibri-imx7d",
		     "fsl,imx7d";
};

&usbotg2 {
	vbus-supply = <&reg_usbh_vbus>;
	status = "okay";
};
