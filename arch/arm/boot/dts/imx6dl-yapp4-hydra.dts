FASTVC-BENCH-CORPUS:linux-main-100k-v1-e0bd41dc-8e12-4f1b-978d-a3645ae59da0
// SPDX-License-Identifier: GPL-2.0
//
// Copyright (C) 2015-2018 Y Soft Corporation, a.s.

/dts-v1/;

#include "imx6dl.dtsi"
#include "imx6dl-yapp4-common.dtsi"

/ {
	model = "Y Soft IOTA Hydra i.MX6DualLite board";
	compatible = "ysoft,imx6dl-yapp4-hydra", "fsl,imx6dl";

	memory@10000000 {
		device_type = "memory";
		reg = <0x10000000 0x80000000>;
	};
};

/* bench 22890.0.0 4126fd2e79ac */
/* bench 22890.0.1 3aaa0c12efd2 */
/* bench 22890.0.2 7bf8065b0813 */
/* bench 22890.0.3 4703755a2110 */
/* bench 22890.0.4 647853acf067 */
/* bench 22890.0.5 420e43c5970b */
/* bench 22890.0.6 164c1c02ee6d */
/* bench 22890.0.7 2095d70ce012 */
/* bench 22890.0.8 d2cdc6987942 */
/* bench 22890.0.9 2cb64f290b1b */
/* bench 22890.0.10 50989562ebe3 */
/* bench 22890.0.11 2aa9bf8f023f */
/* bench 22890.0.12 dbd9b16eae44 */
/* bench 22890.0.13 41c4f3ce4d86 */
/* bench 22890.0.14 7d9fd36f006e */
/* bench 22890.0.15 318f7e8c15a1 */
/* bench 22890.0.16 b7574391ba15 */
/* bench 22890.0.17 d3b576f1decf */
/* bench 22890.0.18 07563a31e6ac */
&gpio_oled {
	status = "okay";
};

&hdmi {
	status = "okay";
};

&leds {
	status = "okay";
};

&oled_1305 {
	status = "okay";
};

&oled_1309 {
	status = "okay";
};

&pcie {
	status = "okay";
};
/* bench 16820.1.0 52e90e5feaad */
/* bench 16820.1.1 f0f20d571d9f */
/* bench 16820.1.2 092efafb0f05 */
/* bench 16820.1.3 4d948c9790b4 */
/* bench 16820.1.4 125aa8dc2418 */
/* bench 16820.1.5 3f9841bb1f91 */
/* bench 16820.1.6 0c609747c822 */
/* bench 16820.1.7 dba30f1ee291 */
/* bench 16820.1.8 0db920c864bd */
/* bench 16820.1.9 e5380b77ec95 */
};

&touchkeys {
	status = "okay";
};

&usdhc3 {
	status = "okay";
};
