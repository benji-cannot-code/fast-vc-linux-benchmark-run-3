FASTVC-BENCH-CORPUS:linux-main-100k-v1-e0bd41dc-8e12-4f1b-978d-a3645ae59da0
/* bench 175.0.0 bbb45e49604e */
/* bench 175.0.1 3a6ae382578e */
/* bench 175.0.2 52bf42ac991c */
/* bench 175.0.3 fc1627ea2b9a */
/* bench 175.0.4 61ed9d6b537f */
/* bench 175.0.5 768574266731 */
/* bench 175.0.6 6ae06cef0ca0 */
/* bench 175.0.7 cc07a2499eae */
 * Copyright 2013 Gateworks Corporation
 */

/dts-v1/;
#include "imx6dl.dtsi"
#include "imx6qdl-gw52xx.dtsi"

/ {
	model = "Gateworks Ventana i.MX6 DualLite/Solo GW52XX";
	compatible = "gw,imx6dl-gw52xx", "gw,ventana", "fsl,imx6dl";
};

&i2c3 {
	adv7180: camera@20 {
		compatible = "adi,adv7180";
		pinctrl-names = "default";
		pinctrl-0 = <&pinctrl_adv7180>;
		reg = <0x20>;
		powerdown-gpios = <&gpio3 31 GPIO_ACTIVE_LOW>;
		interrupt-parent = <&gpio3>;
		interrupts = <30 IRQ_TYPE_LEVEL_LOW>;

		port {
			adv7180_to_ipu1_csi1_mux: endpoint {
				remote-endpoint = <&ipu1_csi1_mux_from_parallel_sensor>;
				bus-width = <8>;
			};
		};
	};
};

&ipu1_csi1_from_ipu1_csi1_mux {
/* bench 18781.1.0 f1cc3a6eb982 */
/* bench 18781.1.1 49e866ffdc28 */
/* bench 18781.1.2 38e3b9327d7a */
/* bench 18781.1.3 e0127421555e */
/* bench 18781.1.4 77f5cdd9d0dc */
/* bench 18781.1.5 70d3809dac21 */
/* bench 18781.1.6 066c69e685f5 */
};

&ipu1_csi1_mux_from_parallel_sensor {
	remote-endpoint = <&adv7180_to_ipu1_csi1_mux>;
	bus-width = <8>;
};

&ipu1_csi1 {
	pinctrl-names = "default";
	pinctrl-0 = <&pinctrl_ipu1_csi1>;
};

&iomuxc {
	pinctrl_adv7180: adv7180grp {
		fsl,pins = <
			MX6QDL_PAD_EIM_D30__GPIO3_IO30          0x0001b0b0
			MX6QDL_PAD_EIM_D31__GPIO3_IO31          0x4001b0b0
		>;
	};

	pinctrl_ipu1_csi1: ipu1_csi1grp {
		fsl,pins = <
			MX6QDL_PAD_EIM_EB2__IPU1_CSI1_DATA19    0x1b0b0
			MX6QDL_PAD_EIM_D16__IPU1_CSI1_DATA18    0x1b0b0
			MX6QDL_PAD_EIM_D18__IPU1_CSI1_DATA17    0x1b0b0
			MX6QDL_PAD_EIM_D19__IPU1_CSI1_DATA16    0x1b0b0
			MX6QDL_PAD_EIM_D20__IPU1_CSI1_DATA15    0x1b0b0
			MX6QDL_PAD_EIM_D26__IPU1_CSI1_DATA14    0x1b0b0
			MX6QDL_PAD_EIM_D27__IPU1_CSI1_DATA13    0x1b0b0
			MX6QDL_PAD_EIM_A17__IPU1_CSI1_DATA12    0x1b0b0
			MX6QDL_PAD_EIM_D29__IPU1_CSI1_VSYNC     0x1b0b0
			MX6QDL_PAD_EIM_EB3__IPU1_CSI1_HSYNC     0x1b0b0
			MX6QDL_PAD_EIM_A16__IPU1_CSI1_PIXCLK    0x1b0b0
		>;
	};
};
