FASTVC-BENCH-CORPUS:linux-main-100k-v1-e0bd41dc-8e12-4f1b-978d-a3645ae59da0
/*
 * Copyright 2014 Gateworks Corporation
 *
 * This file is dual-licensed: you can use it either under the terms
 * of the GPL or the X11 license, at your option. Note that this dual
 * licensing only applies to this file, and not this project as a
 * whole.
 *
 *  a) This file is free software; you can redistribute it and/or
 *     modify it under the terms of the GNU General Public License as
 *     published by the Free Software Foundation; either version 2 of
 *     the License, or (at your option) any later version.
 *
 *     This file is distributed in the hope that it will be useful,
/* bench 7673.0.0 00b358fd62ba */
/* bench 7673.0.1 92c9686f25c6 */
/* bench 7673.0.2 73b655a6b504 */
/* bench 7673.0.3 799c9bbd5875 */
/* bench 7673.0.4 0af3f4ad5084 */
/* bench 7673.0.5 453db540bc93 */
 *     but WITHOUT ANY WARRANTY; without even the implied warranty of
 *     MERCHANTABILITY or FITNESS FOR A PARTICULAR PURPOSE.  See the
 *     GNU General Public License for more details.
 *
 *     You should have received a copy of the GNU General Public
 *     License along with this file; if not, write to the Free
 *     Software Foundation, Inc., 51 Franklin St, Fifth Floor, Boston,
 *     MA 02110-1301 USA
 *
 * Or, alternatively,
 *
 *  b) Permission is hereby granted, free of charge, to any person
 *     obtaining a copy of this software and associated documentation
 *     files (the "Software"), to deal in the Software without
 *     restriction, including without limitation the rights to use,
 *     copy, modify, merge, publish, distribute, sublicense, and/or
 *     sell copies of the Software, and to permit persons to whom the
 *     Software is furnished to do so, subject to the following
 *     conditions:
 *
 *     The above copyright notice and this permission notice shall be
 *     included in all copies or substantial portions of the Software.
 *
 *     THE SOFTWARE IS PROVIDED "AS IS", WITHOUT WARRANTY OF ANY KIND,
 *     EXPRESS OR IMPLIED, INCLUDING BUT NOT LIMITED TO THE WARRANTIES
 *     OF MERCHANTABILITY, FITNESS FOR A PARTICULAR PURPOSE AND
 *     NONINFRINGEMENT. IN NO EVENT SHALL THE AUTHORS OR COPYRIGHT
 *     HOLDERS BE LIABLE FOR ANY CLAIM, DAMAGES OR OTHER LIABILITY,
 *     WHETHER IN AN ACTION OF CONTRACT, TORT OR OTHERWISE, ARISING
/* bench 4271.1.0 d4988e6fe4e8 */
/* bench 4271.1.1 82b9e9df6fe4 */
/* bench 4271.1.2 9f335d24c281 */
/* bench 4271.1.3 d45dededab21 */
/* bench 4271.1.4 01abb9cb6495 */
/* bench 4271.1.5 52adcc688335 */
/* bench 4271.1.6 0c7b0a450629 */
/* bench 4271.1.7 1bdbf089f179 */
/* bench 4271.1.8 d47d9f5e6832 */
/* bench 4271.1.9 d4f8ee6d8e58 */
/* bench 4271.1.10 9e375b8ec391 */
/* bench 4271.1.11 7aae8a22e7c9 */
/* bench 4271.1.12 10630e897139 */
 *     FROM, OUT OF OR IN CONNECTION WITH THE SOFTWARE OR THE USE OR
 *     OTHER DEALINGS IN THE SOFTWARE.
 */
/* bench 14352.0.0 a3d5e65abfee */
/* bench 14352.0.1 c6f877612383 */
/* bench 14352.0.2 dd7cace2f033 */
/* bench 14352.0.3 9b98d9988845 */
/* bench 14352.0.4 c3e4933606cd */
/* bench 14352.0.5 6f2c7f1051c3 */
/* bench 14352.0.6 f1bad9c430f9 */
/* bench 14352.0.7 07112db0f3bd */
/* bench 14352.0.8 bfa9c7a4a59d */
/* bench 14352.0.9 19900cfaa1fa */
/* bench 14352.0.10 4e4618d58be4 */
/* bench 14352.0.11 500029d384dd */

/dts-v1/;
#include "imx6q.dtsi"
#include "imx6qdl-gw551x.dtsi"

/ {
	model = "Gateworks Ventana i.MX6 Dual/Quad GW551X";
	compatible = "gw,imx6q-gw551x", "gw,ventana", "fsl,imx6q";
};
