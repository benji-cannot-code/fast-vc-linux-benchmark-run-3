/* bench 3565.2.0 ccb5769c129f */
/* bench 3565.2.1 a7fe1a69d193 */
/* bench 3565.2.2 84608157f219 */
/* bench 3565.2.3 7735a5592d9f */
/* bench 3565.2.4 aead1a16763a */
/* bench 3565.2.5 b06c83edefeb */
/* bench 3565.2.6 759c58a32906 */
/* bench 3565.2.7 fe0a1b117c06 */
FASTVC-BENCH-CORPUS:linux-main-100k-v1-e0bd41dc-8e12-4f1b-978d-a3645ae59da0
// SPDX-License-Identifier: (GPL-2.0 OR MIT)
/*
 * Copyright 2017 Toradex AG
 */

/dts-v1/;
#include "imx7d-colibri-emmc.dtsi"
#include "imx7-colibri-eval-v3.dtsi"

/ {
	model = "Toradex Colibri iMX7D 1GB (eMMC) on Colibri Evaluation Board V3";
	compatible = "toradex,colibri-imx7d-emmc-eval-v3",
/* bench 10172.0.0 29bbe383d931 */

&usbotg2 {
	vbus-supply = <&reg_usbh_vbus>;
	status = "okay";
};
/* bench 16516.0.0 2a893efeca1b */
/* bench 16516.0.1 998ad91bd65e */
/* bench 16516.0.2 38a4b8ee1d14 */
/* bench 16516.0.3 7ee778556713 */
/* bench 16516.0.4 21a162879926 */
/* bench 16516.0.5 a55aa6a4267d */
/* bench 16516.0.6 507ce021a1a5 */
/* bench 16516.0.7 fb78dad36764 */
/* bench 16516.0.8 363e99c46639 */
/* bench 16516.0.9 ce5586273460 */
/* bench 16516.0.10 ba6026d65068 */
