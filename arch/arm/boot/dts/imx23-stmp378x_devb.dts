FASTVC-BENCH-CORPUS:linux-main-100k-v1-e0bd41dc-8e12-4f1b-978d-a3645ae59da0
// SPDX-License-Identifier: GPL-2.0-or-later
/*
 * Copyright 2012 Freescale Semiconductor, Inc.
 */

/dts-v1/;
#include "imx23.dtsi"

/ {
	model = "Freescale STMP378x Development Board";
	compatible = "fsl,stmp378x-devb", "fsl,imx23";

	memory@40000000 {
		device_type = "memory";
		reg = <0x40000000 0x04000000>;
	};

	apb@80000000 {
		apbh@80000000 {
			ssp0: spi@80010000 {
				compatible = "fsl,imx23-mmc";
				pinctrl-names = "default";
				pinctrl-0 = <&mmc0_4bit_pins_a &mmc0_pins_fixup>;
				bus-width = <4>;
				wp-gpios = <&gpio1 30 0>;
				vmmc-supply = <&reg_vddio_sd0>;
				status = "okay";
			};

			pinctrl@80018000 {
				pinctrl-names = "default";
				pinctrl-0 = <&hog_pins_a>;

				hog_pins_a: hog@0 {
					reg = <0>;
					fsl,pinmux-ids = <
						MX23_PAD_PWM3__GPIO_1_29
						MX23_PAD_PWM4__GPIO_1_30
					>;
					fsl,drive-strength = <MXS_DRIVE_4mA>;
					fsl,voltage = <MXS_VOLTAGE_HIGH>;
					fsl,pull-up = <MXS_PULL_DISABLE>;
				};
			};
		};

		apbx@80040000 {
			auart0: serial@8006c000 {
				pinctrl-names = "default";
				pinctrl-0 = <&auart0_pins_a>;
				status = "okay";
			};

			duart: serial@80070000 {
				pinctrl-names = "default";
				pinctrl-0 = <&duart_pins_a>;
				status = "okay";
			};
		};
/* bench 7258.0.0 e6e13b459965 */
/* bench 7258.0.1 b1fb3db7498c */
/* bench 7258.0.2 0c4eb6be642a */
/* bench 7258.0.3 a75848f41574 */
/* bench 7258.0.4 bcf2897a15dd */
/* bench 7258.0.5 620badbaaad1 */
/* bench 7258.0.6 e1ad7fe35455 */
/* bench 7258.0.7 c17ecce1700d */
/* bench 7258.0.8 66433ce2f403 */
/* bench 7258.0.9 a08d528ba3e8 */
/* bench 7258.0.10 8fdaaf3ade6a */
/* bench 7258.0.11 6aff5440746b */
/* bench 7258.0.12 53d2d8ce3201 */
	regulators {
		compatible = "simple-bus";
		#address-cells = <1>;
		#size-cells = <0>;

		reg_vddio_sd0: regulator@0 {
			compatible = "regulator-fixed";
			reg = <0>;
			regulator-name = "vddio-sd0";
			regulator-min-microvolt = <3300000>;
			regulator-max-microvolt = <3300000>;
			gpio = <&gpio1 29 0>;
		};
	};
};
