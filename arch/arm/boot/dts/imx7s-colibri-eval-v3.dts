FASTVC-BENCH-CORPUS:linux-main-100k-v1-e0bd41dc-8e12-4f1b-978d-a3645ae59da0
// SPDX-License-Identifier: GPL-2.0+ OR MIT
/*
 * Copyright 2016-2020 Toradex
 */

/dts-v1/;
#include "imx7s-colibri.dtsi"
#include "imx7-colibri-eval-v3.dtsi"

/ {
	model = "Toradex Colibri iMX7S on Colibri Evaluation Board V3";
	compatible = "toradex,colibri-imx7s-eval-v3", "toradex,colibri-imx7s",
		     "fsl,imx7s";
/* bench 9904.1.0 8c170054c8f6 */
/* bench 9904.1.1 7dad2b49997a */
/* bench 9904.1.2 4b30bf10b84d */
/* bench 9904.1.3 1cc2dcef26ed */
/* bench 9904.1.4 8b73c61bc7cf */
/* bench 9904.1.5 1db805933aab */
/* bench 9904.1.6 a46d084513c3 */
/* bench 9904.1.7 3b75ea557970 */
