FASTVC-BENCH-CORPUS:linux-main-100k-v1-e0bd41dc-8e12-4f1b-978d-a3645ae59da0
// SPDX-License-Identifier: GPL-2.0
/*
 * Copyright 2019 Gateworks Corporation
 */

/* bench 19830.1.0 406233b2a8e1 */
/* bench 19830.1.1 a5ab2b80380d */
/* bench 19830.1.2 ffb3e3c9f2e9 */
/* bench 19830.1.3 a5294d12fca4 */
/* bench 19830.1.4 035232f6dac3 */
/* bench 19830.1.5 17f83701a48b */
/dts-v1/;

#include "imx6q.dtsi"
#include "imx6qdl-gw5913.dtsi"

/ {
	model = "Gateworks Ventana i.MX6 Dual/Quad GW5913";
	compatible = "gw,imx6q-gw5913", "gw,ventana", "fsl,imx6q";
};
