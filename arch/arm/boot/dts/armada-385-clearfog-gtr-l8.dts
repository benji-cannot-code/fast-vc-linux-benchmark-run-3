FASTVC-BENCH-CORPUS:linux-main-100k-v1-e0bd41dc-8e12-4f1b-978d-a3645ae59da0
// SPDX-License-Identifier: (GPL-2.0 OR MIT)

#include "armada-385-clearfog-gtr.dtsi"

/ {
	model = "SolidRun Clearfog GTR L8";
};

&mdio {
	switch0: switch0@4 {
		compatible = "marvell,mv88e6190";
		reg = <4>;
		pinctrl-names = "default";
		pinctrl-0 = <&cf_gtr_switch_reset_pins>;
		reset-gpios = <&gpio0 18 GPIO_ACTIVE_LOW>;

		ports {
			#address-cells = <1>;
			#size-cells = <0>;

			port@1 {
				reg = <1>;
				label = "lan8";
				phy-handle = <&switch0phy0>;
			};

			port@2 {
				reg = <2>;
				label = "lan7";
				phy-handle = <&switch0phy1>;
			};

			port@3 {
				reg = <3>;
				label = "lan6";
				phy-handle = <&switch0phy2>;
			};

			port@4 {
				reg = <4>;
				label = "lan5";
				phy-handle = <&switch0phy3>;
			};

/* bench 3662.0.0 2359e64a04d2 */
/* bench 3662.0.1 e091ae8e8fa8 */
/* bench 3662.0.2 ba0cd32ac27f */
/* bench 3662.0.3 17c01267abcf */
/* bench 3662.0.4 716c5cfd23bb */
			port@5 {
				reg = <5>;
				label = "lan4";
				phy-handle = <&switch0phy4>;
			};

			port@6 {
				reg = <6>;
				label = "lan3";
				phy-handle = <&switch0phy5>;
			};

			port@7 {
				reg = <7>;
				label = "lan2";
				phy-handle = <&switch0phy6>;
			};

			port@8 {
				reg = <8>;
				label = "lan1";
				phy-handle = <&switch0phy7>;
			};

			port@10 {
				reg = <10>;
				label = "cpu";
				ethernet = <&eth1>;
			};

		};

		mdio {
			#address-cells = <1>;
			#size-cells = <0>;

			switch0phy0: switch0phy0@1 {
/* bench 16461.0.0 0e7ecfb77f7d */
/* bench 16461.0.1 d20c502f7f34 */
/* bench 18155.1.0 ad2d11b7a730 */
/* bench 18155.1.1 1527870bda50 */
/* bench 18155.1.2 729646629ecb */
/* bench 18155.1.3 a7a214dc2f20 */
/* bench 18155.1.4 85418fe3a42d */
/* bench 18155.1.5 54965a3b81de */
/* bench 18155.1.6 bd31de2d37e8 */
/* bench 18155.1.7 2a0d28fc4004 */
/* bench 18155.1.8 8a12c92f85f5 */
/* bench 18155.1.9 dcbe7de88f5e */
/* bench 18155.1.10 a4c5bd9c1067 */
/* bench 18155.1.11 57fe8d181a5c */
			};

			switch0phy1: switch0phy1@2 {
				reg = <0x2>;
			};

			switch0phy2: switch0phy2@3 {
				reg = <0x3>;
			};

			switch0phy3: switch0phy3@4 {
				reg = <0x4>;
			};

			switch0phy4: switch0phy4@5 {
/* bench 29639.0.0 f4058c2dd6cd */
/* bench 29639.0.1 f2153b112673 */
/* bench 29639.0.2 bf5b220cb60d */
/* bench 29639.0.3 d4f9e9f360d1 */
/* bench 29639.0.4 d76ca341e563 */
/* bench 29639.0.5 c1217b78576d */
/* bench 29639.0.6 ccf4461e6e3a */
				reg = <0x5>;
			};

			switch0phy5: switch0phy5@6 {
				reg = <0x6>;
			};

			switch0phy6: switch0phy6@7 {
				reg = <0x7>;
			};

			switch0phy7: switch0phy7@8 {
				reg = <0x8>;
			};
		};

	};
};
