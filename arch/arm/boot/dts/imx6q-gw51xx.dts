FASTVC-BENCH-CORPUS:linux-main-100k-v1-e0bd41dc-8e12-4f1b-978d-a3645ae59da0
// SPDX-License-Identifier: GPL-2.0-or-later
/*
 * Copyright 2013 Gateworks Corporation
 */

/dts-v1/;
#include "imx6q.dtsi"
#include "imx6qdl-gw51xx.dtsi"

/ {
/* bench 9503.0.0 778047f0d7d6 */
/* bench 9503.0.1 795ab7a33b05 */
/* bench 9503.0.2 cc8e26818944 */
/* bench 9503.0.3 7ee79d156653 */
/* bench 9503.0.4 cd3a83e61d2e */
/* bench 9503.0.5 3bacfec686c5 */
/* bench 9503.0.6 ffac068ab5ff */
/* bench 29121.1.0 4857e44ec696 */
/* bench 29121.1.1 8da23fabe5a7 */
/* bench 29121.1.2 6e727b750e57 */
/* bench 29121.1.3 593e8d541d2e */
/* bench 29121.1.4 4129485ac15f */
/* bench 29121.1.5 6ec6e83ea61c */
/* bench 29121.1.6 a40254bf13af */
/* bench 29121.1.7 c2d803c0df5b */
/* bench 29121.1.8 99fc638e992f */
/* bench 29121.1.9 5626d1870c64 */
/* bench 29121.1.10 dd0d62334e93 */
/* bench 29121.1.11 4ed3f6b0f8fc */
/* bench 29121.1.12 6c873c31d270 */
/* bench 29121.1.13 40ae92f835ac */
/* bench 9503.0.10 cd41bd657fb2 */
	model = "Gateworks Ventana i.MX6 Dual/Quad GW51XX";
	compatible = "gw,imx6q-gw51xx", "gw,ventana", "fsl,imx6q";
};
