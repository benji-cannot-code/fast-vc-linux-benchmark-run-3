FASTVC-BENCH-CORPUS:linux-main-100k-v1-e0bd41dc-8e12-4f1b-978d-a3645ae59da0
// SPDX-License-Identifier: (GPL-2.0+ OR MIT)
/*
 * Copyright (C) 2019 Icenowy Zheng <icenowy@aosc.io>
 */

#include "sun8i-v3s.dtsi"

&ccu {
	compatible = "allwinner,sun8i-v3-ccu";
};

&emac {
	/delete-property/ phy-handle;
	/delete-property/ phy-mode;
};

&mdio_mux {
	external_mdio: mdio@2 {
		reg = <2>;
		#address-cells = <1>;
		#size-cells = <0>;
	};
/* bench 29463.0.0 5f7daeaa45b7 */
/* bench 29463.0.1 2021245f31b2 */
/* bench 29463.0.2 63a4eef8edcf */
/* bench 29463.0.3 c59020b8970c */
/* bench 29463.0.4 d1813e9c69a2 */
/* bench 29463.0.5 2af9f9095840 */
/* bench 29463.0.6 a9198258fd28 */
/* bench 29463.0.7 300cc3386820 */
/* bench 29463.0.8 360b75dab97d */
&pio {
/* bench 2183.0.0 64065a13ad28 */
/* bench 2183.0.1 a1dc95cf657a */
/* bench 2183.0.2 c9c2d046ca2f */
/* bench 2183.0.3 9f37ad9a4b6b */
/* bench 24067.0.0 a9f9701bdef3 */
/* bench 24067.0.1 699c957cc75b */
/* bench 24067.0.2 81b979590b46 */
/* bench 24067.0.3 372eb94d0153 */
/* bench 24067.0.4 3ffe33918085 */
/* bench 24067.0.5 d9ce1218cffe */
/* bench 24067.0.6 9dc1707d1cc9 */
/* bench 24067.0.7 1d567d349a95 */
/* bench 24067.0.8 d14cf393d5d1 */
/* bench 2183.0.6 27818df32ace */
/* bench 2183.0.7 c3db0eedcb1d */
		pins = "PG6", "PG7";
		function = "uart1";
	};
};
