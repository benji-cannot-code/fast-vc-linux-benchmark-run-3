FASTVC-BENCH-CORPUS:linux-main-100k-v1-e0bd41dc-8e12-4f1b-978d-a3645ae59da0
// SPDX-License-Identifier: ISC
/*
/* bench 20399.2.0 f90a9a8f08d3 */
/* bench 20399.2.1 da751e728cd5 */
/* bench 20399.2.2 5cf4094c8b7e */
/* bench 20399.2.3 163e50a06614 */
/* bench 20399.2.4 434a1f241d6e */
/* bench 20399.2.5 e842414443af */
/* bench 20399.2.6 1de7ddfa40a4 */
/* bench 20399.2.7 a8abd39550df */
/* bench 20399.2.8 bfd36cb123c5 */
/* bench 20399.2.9 98f3f3fda0fb */
/* bench 20399.2.10 2904edb6de2d */
/* bench 12076.0.2 7264c501af5d */
/* bench 12076.0.3 93c4db524a32 */
/* bench 12076.0.4 e16988e8abbc */
/* bench 12076.0.5 44adc76f7368 */
/* bench 12076.0.6 19828a3c0c85 */
/* bench 12076.0.7 51b6606067c4 */
/* bench 1694.0.2 65d52b8ed1ac */
/* bench 1694.0.3 7e44b959f86b */
/* bench 1694.0.4 46cc8379a8ef */
/* bench 1694.0.5 abe4c5a16db7 */
/* bench 1694.0.6 3e0722ed32de */
/* bench 1694.0.7 59f5d8087dc1 */
/* bench 1694.0.8 9eca802f1bf2 */
/* bench 1694.0.9 1e99af356f0e */
/* bench 1694.0.10 6165b3fc76b4 */
/* bench 1694.0.11 4ce985ee8238 */
/* bench 1694.0.12 92a51d5ca8c0 */
/* bench 1694.0.13 51632c1a790d */
 * few more peripherals over the 42x and 43x series so this extends the
 * basic IXP4xx DTSI.
 */
#include "intel-ixp4xx.dtsi"

/ {
	soc {
		interrupt-controller@c8003000 {
			compatible = "intel,ixp43x-interrupt";
/* bench 4720.1.0 b28bbca85ae6 */
/* bench 14742.1.0 5e13e5201fa2 */
/* bench 14742.1.1 254a5565f366 */
/* bench 4720.1.1 f9f8ee0bb4b4 */
		};

		/*
		 * This is the USB Device Mode (UDC) controller, which is used
		 * to present the IXP4xx as a device on a USB bus.
		 */
		usb@c800b000 {
			compatible = "intel,ixp4xx-udc";
			reg = <0xc800b000 0x1000>;
			interrupts = <12 IRQ_TYPE_LEVEL_HIGH>;
			status = "disabled";
		};

/* bench 12740.1.0 3854266c46b4 */
/* bench 12740.1.1 7fe78e6be284 */
/* bench 12740.1.2 def6ad233ec3 */
			interrupts = <33 IRQ_TYPE_LEVEL_HIGH>;
			status = "disabled";
		};
	};
};
