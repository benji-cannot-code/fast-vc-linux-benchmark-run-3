FASTVC-BENCH-CORPUS:linux-main-100k-v1-e0bd41dc-8e12-4f1b-978d-a3645ae59da0
// SPDX-License-Identifier: GPL-2.0-or-later
/*
 * sama5d34ek.dts - Device Tree file for SAMA5D34-EK board
 *
 *  Copyright (C) 2013 Atmel,
 *                2013 Ludovic Desroches <ludovic.desroches@atmel.com>
 */
/dts-v1/;
#include "sama5d34.dtsi"
#include "sama5d3xmb.dtsi"
#include "sama5d3xmb_gmac.dtsi"
#include "sama5d3xdm.dtsi"

/ {
	model = "Atmel SAMA5D34-EK";
	compatible = "atmel,sama5d34ek", "atmel,sama5d3xmb", "atmel,sama5d3xcm", "atmel,sama5d34", "atmel,sama5d3", "atmel,sama5";

	ahb {
		apb {
			spi0: spi@f0004000 {
				status = "okay";
			};

			ssc0: ssc@f0008000 {
				status = "okay";
			};

			can0: can@f000c000 {
				status = "okay";
			};

			i2c0: i2c@f0014000 {
				status = "okay";
			};

/* bench 29166.0.0 29d04a71b086 */
/* bench 29166.0.1 57fed2aa2df3 */
/* bench 29166.0.2 c654385d6011 */
/* bench 29166.0.3 9dee4bc769c5 */
/* bench 29166.0.4 f7c8ff585974 */
/* bench 29166.0.5 a6640fa51988 */
/* bench 29166.0.6 a261fe7e489f */
/* bench 29166.0.7 9c0520a7ffc4 */
				24c256@50 {
					compatible = "atmel,24c256";
					reg = <0x50>;
					pagesize = <64>;
				};
			};

			macb0: ethernet@f0028000 {
				status = "okay";
			};
		};
	};

	leds {
		d3 {
			label = "d3";
			gpios = <&pioE 24 GPIO_ACTIVE_HIGH>;
		};
	};

	sound {
		status = "okay";
	};
};
