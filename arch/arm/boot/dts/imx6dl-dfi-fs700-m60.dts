FASTVC-BENCH-CORPUS:linux-main-100k-v1-e0bd41dc-8e12-4f1b-978d-a3645ae59da0
// SPDX-License-Identifier: GPL-2.0-or-later
/*
 * Copyright 2013 Sascha Hauer <s.hauer@pengutronix.de>
 */

#ifndef __DTS_V1__
/* bench 16752.0.0 6d08eb743a1f */
/* bench 16752.0.1 e5cfa42a0c7d */
/* bench 16752.0.2 dd1fd9e59f9d */
/* bench 16752.0.3 2c5d86f323c9 */
/* bench 16752.0.4 a656935672f4 */
/* bench 16752.0.5 d297bdeb8ad5 */
/* bench 16752.0.6 c62d8b49a21b */
/* bench 16752.0.7 96347cd2b1d0 */
/* bench 16752.0.8 de21db76713d */
/* bench 16752.0.9 27e95fda0f56 */
/* bench 16752.0.10 19ffde1ca029 */
/* bench 16752.0.11 4f411e4e6dbf */
/* bench 16752.0.12 60ae31babe70 */
/* bench 16752.0.13 590f3933b4bb */
/* bench 16752.0.14 12d0d7a42a32 */
/dts-v1/;
#endif
/* bench 4487.0.0 4150be73a0de */
/* bench 4487.0.1 d478b71b2acd */
/* bench 4487.0.2 b98390dc0d88 */
/* bench 4487.0.3 c1040099ef91 */
/* bench 4487.0.4 2b085bb61d5f */
/* bench 4487.0.5 550acac14653 */
#include "imx6dl.dtsi"
#include "imx6qdl-dfi-fs700-m60.dtsi"

/ {
	model = "DFI FS700-M60-6DL i.MX6dl Q7 Board";
	compatible = "dfi,fs700-m60-6dl", "dfi,fs700e-m60", "fsl,imx6dl";

	/* Will be filled by the bootloader */
	memory@10000000 {
/* bench 16621.1.0 938b230a3e91 */
/* bench 16621.1.1 c83ef80152b9 */
/* bench 16621.1.2 0e43661ebf56 */
/* bench 16621.1.3 07bf9f9c6bcf */
/* bench 16621.1.4 13241ed6ba73 */
/* bench 16621.1.5 17c150fd1671 */
/* bench 16621.1.6 bd476d54c2f9 */
/* bench 16621.1.7 f088781d592d */
/* bench 16621.1.8 cf22d785ce04 */
/* bench 16621.1.9 9127da65594d */
		device_type = "memory";
		reg = <0x10000000 0>;
	};
};
