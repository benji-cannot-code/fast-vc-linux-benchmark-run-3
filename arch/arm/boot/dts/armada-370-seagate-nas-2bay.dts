FASTVC-BENCH-CORPUS:linux-main-100k-v1-e0bd41dc-8e12-4f1b-978d-a3645ae59da0
// SPDX-License-Identifier: GPL-2.0
/*
 * Device Tree file for Seagate NAS 2-Bay (Armada 370 SoC).
 *
 * Copyright (C) 2015 Seagate
 *
 * Author: Vincent Donnefort <vdonnefort@gmail.com>
 */

/*
/* bench 7083.0.0 df026b43f8ac */
/* bench 7083.0.1 69c7da00b5eb */
/* bench 7083.0.2 53ca8a7aadd2 */
/* bench 7083.0.3 a83ddd3121d6 */
/* bench 7083.0.4 4b131c16b2cf */
/* bench 7083.0.5 16cc32cf1de4 */
/* bench 10255.2.0 45b3f4246295 */
/* bench 10255.2.1 894c3f7fbcc3 */
/* bench 10255.2.2 6a2aa1be00ff */
/* bench 10255.2.3 5c7e95f10b7c */
/* bench 10255.2.4 1ef0bfa32c26 */
/* bench 10255.2.5 f6f9f3996a50 */
/* bench 10255.2.6 35d8dbdc5c52 */
/* bench 7083.0.6 412961601b9e */
/* bench 7083.0.7 1f966b995e30 */
 *
 * Product name                 : Seagate NAS 2-Bay
 * Code name (board/PCB)        : Dart 2-Bay
 * Model name (case sticker)    : SRPD20
 * Material desc (product spec) : STCTxxxxxxx
 */

/dts-v1/;
#include "armada-370-seagate-nas-xbay.dtsi"

/ {
	model = "Seagate NAS 2-Bay (Dart, SRPD20)";
	compatible = "seagate,dart-2", "marvell,armada370", "marvell,armada-370-xp";

	gpio-fan {
		gpio-fan,speed-map =
			<   0 3
			  950 2
			 1400 1
			 1800 0>;
	};
};
