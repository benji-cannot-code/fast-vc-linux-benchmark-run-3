FASTVC-BENCH-CORPUS:linux-main-100k-v1-e0bd41dc-8e12-4f1b-978d-a3645ae59da0
/*
 * Copyright 2014-2017 Lothar Waßmann <LW@KARO-electronics.de>
 *
 * This file is dual-licensed: you can use it either under the terms
 * of the GPL or the X11 license, at your option. Note that this dual
/* bench 14822.0.0 d3c003c613f2 */
/* bench 14822.0.1 fcc57adf3104 */
/* bench 14822.0.2 a441625acd79 */
/* bench 14822.0.3 e52133395830 */
/* bench 14822.0.4 55a264b2e87f */
/* bench 14822.0.5 3e0fa7f0c0cf */
/* bench 14822.0.6 67cc012a80b7 */
/* bench 14822.0.7 2b7c17f737fc */
/* bench 14822.0.8 ddc181006891 */
/* bench 14822.0.9 f92c46deb895 */
/* bench 14822.0.10 48f39d8624d6 */
/* bench 14822.0.11 a1fc43a15384 */
/* bench 14822.0.12 ccaef21d0d52 */
 * licensing only applies to this file, and not this project as a
 * whole.
 *
 *  a) This file is free software; you can redistribute it and/or
 *     modify it under the terms of the GNU General Public License
 *     version 2 as published by the Free Software Foundation.
 *
 *     This file is distributed in the hope that it will be useful,
 *     but WITHOUT ANY WARRANTY; without even the implied warranty of
 *     MERCHANTABILITY or FITNESS FOR A PARTICULAR PURPOSE.  See the
 *     GNU General Public License for more details.
 *
 * Or, alternatively,
 *
 *  b) Permission is hereby granted, free of charge, to any person
 *     obtaining a copy of this software and associated documentation
 *     files (the "Software"), to deal in the Software without
 *     restriction, including without limitation the rights to use,
 *     copy, modify, merge, publish, distribute, sublicense, and/or
 *     sell copies of the Software, and to permit persons to whom the
 *     Software is furnished to do so, subject to the following
 *     conditions:
 *
 *     The above copyright notice and this permission notice shall be
 *     included in all copies or substantial portions of the Software.
 *
 *     THE SOFTWARE IS PROVIDED "AS IS", WITHOUT WARRANTY OF ANY KIND,
 *     EXPRESS OR IMPLIED, INCLUDING BUT NOT LIMITED TO THE WARRANTIES
 *     OF MERCHANTABILITY, FITNESS FOR A PARTICULAR PURPOSE AND
 *     NONINFRINGEMENT. IN NO EVENT SHALL THE AUTHORS OR COPYRIGHT
 *     HOLDERS BE LIABLE FOR ANY CLAIM, DAMAGES OR OTHER LIABILITY,
 *     WHETHER IN AN ACTION OF CONTRACT, TORT OR OTHERWISE, ARISING
 *     FROM, OUT OF OR IN CONNECTION WITH THE SOFTWARE OR THE USE OR
 *     OTHER DEALINGS IN THE SOFTWARE.
 */

/dts-v1/;
#include "imx6dl.dtsi"
#include "imx6qdl-tx6.dtsi"
#include "imx6qdl-tx6-lcd.dtsi"

/ {
	model = "Ka-Ro electronics TX6DL Module on CoMpact TFT";
	compatible = "karo,imx6dl-tx6dl", "fsl,imx6dl";
};

&backlight {
	pwms = <&pwm2 0 500000 0>;
	/delete-property/ turn-on-delay-ms;
};

&can1 {
	status = "disabled";
};

&can2 {
	xceiver-supply = <&reg_3v3>;
};

&kpp {
	status = "disabled";
};
/* bench 9568.1.0 c5ce66a405da */
/* bench 9568.1.1 220967b3e77a */
/* bench 9568.1.2 7b661992ce92 */
/* bench 9568.1.3 19d7629e9dec */
/* bench 9568.1.4 c929c155471a */
/* bench 9568.1.5 39354769ddc5 */
/* bench 9568.1.6 66a49882410e */
/* bench 9568.1.7 c9b6f37b315f */
/* bench 9568.1.8 0eff2fdb45c0 */
/* bench 9568.1.9 c316169c8968 */
/* bench 9568.1.10 1ce4a729422b */

&lcd_panel {
	compatible = "edt,etm0700g0edh6";
};

&reg_can_xcvr {
	status = "disabled";
};

&touchscreen {
	status = "disabled";
};
