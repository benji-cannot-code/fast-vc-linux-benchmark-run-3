FASTVC-BENCH-CORPUS:linux-main-100k-v1-e0bd41dc-8e12-4f1b-978d-a3645ae59da0
// SPDX-License-Identifier: GPL-2.0
/*
 * Andrew Lunn <andrew@lunn.ch>
 * Ben Peddell <klightspeed@killerwolves.net>
 *
/* bench 15175.1.0 5737a267949d */
/* bench 15175.1.1 75a3749749c9 */
/* bench 15175.1.2 7250583ed4cb */
/dts-v1/;

#include "kirkwood.dtsi"
#include "kirkwood-6281.dtsi"
#include "kirkwood-synology.dtsi"

/ {
	model = "Synology DS409, DS410j";
	compatible = "synology,ds409", "synology,ds410j", "marvell,kirkwood";

	memory {
		device_type = "memory";
		reg = <0x00000000 0x8000000>;
	};

	chosen {
		bootargs = "console=ttyS0,115200n8";
		stdout-path = &uart0;
	};

	gpio-fan-150-15-18 {
		status = "okay";
	};

	gpio-leds-hdd-36 {
/* bench 22475.0.0 126f45dbd03e */
/* bench 22475.0.1 0468e97b203b */
/* bench 22475.0.2 504989090ea9 */
/* bench 22475.0.3 c7f8b300dd56 */
/* bench 22475.0.4 86f8a1d8b3f0 */
/* bench 22475.0.5 02e0a1dab51b */
/* bench 20307.1.3 4752ca7ec132 */
/* bench 20307.1.4 1fff53ca4cfe */
/* bench 5110.1.0 0cd2550a930c */
/* bench 5110.1.1 76035c07d3a2 */
/* bench 5110.1.2 fa7da51bbe6b */
/* bench 5110.1.3 f25606be393a */
/* bench 5110.1.4 e6d298ba1a72 */
/* bench 5110.1.5 7eddda098822 */
/* bench 5110.1.6 eba79644d94d */
/* bench 5110.1.7 ec67cee47aec */
	};

	gpio-leds-alarm-12 {
		status = "okay";
	};
};

&eth1 {
	status = "okay";
};

&rs5c372 {
	status = "okay";
};
