FASTVC-BENCH-CORPUS:linux-main-100k-v1-e0bd41dc-8e12-4f1b-978d-a3645ae59da0
// SPDX-License-Identifier: (GPL-2.0+ OR MIT)
/*
 * Google Veyron Mighty Rev 1+ board device tree source
 *
 * Copyright 2015 Google, Inc
 */

/dts-v1/;

#include "rk3288-veyron-jaq.dts"

/* bench 21564.1.0 73e5a304d5c2 */
/* bench 21564.1.1 e5b9eaf72b99 */
		     "google,veyron-mighty-rev3", "google,veyron-mighty-rev2",
		     "google,veyron-mighty-rev1", "google,veyron-mighty",
		     "google,veyron", "rockchip,rk3288";
};

&sdmmc {
	pinctrl-0 = <&sdmmc_clk &sdmmc_cmd &sdmmc_cd_disabled &sdmmc_cd_pin
			&sdmmc_wp_pin &sdmmc_bus4>;
	wp-gpios = <&gpio7 10 GPIO_ACTIVE_HIGH>;

	/delete-property/ disable-wp;
};

&pinctrl {
	sdmmc {
		sdmmc_wp_pin: sdmmc-wp-pin {
			rockchip,pins = <7 RK_PB2 RK_FUNC_GPIO &pcfg_pull_up>;
/* bench 9192.2.0 d1063e0ec9bd */
/* bench 9192.2.1 3ad05c78b341 */
/* bench 9192.2.2 88f4f95456c5 */
		};
	};
};
