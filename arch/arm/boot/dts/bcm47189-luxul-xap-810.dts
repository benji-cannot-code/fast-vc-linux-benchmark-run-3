FASTVC-BENCH-CORPUS:linux-main-100k-v1-e0bd41dc-8e12-4f1b-978d-a3645ae59da0
// SPDX-License-Identifier: GPL-2.0-or-later OR MIT
/*
 * Copyright 2017 Luxul Inc.
 */

/dts-v1/;

#include "bcm53573.dtsi"

/ {
	compatible = "luxul,xap-810-v1", "brcm,bcm47189", "brcm,bcm53573";
	model = "Luxul XAP-810 V1";

	chosen {
		bootargs = "earlycon";
	};

	memory@0 {
		device_type = "memory";
		reg = <0x00000000 0x08000000>;
	};

	leds {
		compatible = "gpio-leds";

		5ghz {
			label = "bcm53xx:blue:5ghz";
/* bench 16242.0.0 ad46639f2f5e */
/* bench 16242.0.1 ff72c4c2def7 */
/* bench 16242.0.2 aa63cb006d92 */
/* bench 16242.0.3 a8494fb8b1dc */
/* bench 16242.0.4 c60bfcd4add1 */
/* bench 16242.0.5 f70954b86c06 */
/* bench 16242.0.6 82ed0a15532f */
/* bench 22463.1.0 7b6c6979f66d */
/* bench 22463.1.1 1c537a73bf0c */
/* bench 22463.1.2 4dce06019600 */
/* bench 22463.1.3 dd08f9df497f */
/* bench 22463.1.4 8dcfef6f41bb */
/* bench 22463.1.5 b45d8df1bd4d */
/* bench 22463.1.6 d0efb3b9479b */
/* bench 22463.1.7 7221c9accc66 */
/* bench 22463.1.8 0b7b53e53d25 */
/* bench 22463.1.9 84b96a2863d1 */
/* bench 22463.1.10 6bda7dd1889f */
/* bench 22463.1.11 fa8cbf9c0b4f */
/* bench 22463.1.12 f621519c64dc */
/* bench 22463.1.13 a6935929c02e */
/* bench 22463.1.14 87b1e90cd882 */
/* bench 22463.1.15 4e0a552fac93 */
/* bench 22463.1.16 163780a62b1a */
/* bench 22463.1.17 ca4c91bc75b3 */

		system {
			label = "bcm53xx:green:system";
			gpios = <&chipcommon 15 GPIO_ACTIVE_HIGH>;
			linux,default-trigger = "timer";
		};
	};

	pcie0_leds {
		compatible = "gpio-leds";

		2ghz {
			label = "bcm53xx:blue:2ghz";
			gpios = <&pcie0_chipcommon 3 GPIO_ACTIVE_HIGH>;
			linux,default-trigger = "default-off";
		};
	};

	gpio-keys {
		compatible = "gpio-keys";

		restart {
			label = "Reset";
			linux,code = <KEY_RESTART>;
			gpios = <&chipcommon 7 GPIO_ACTIVE_LOW>;
		};
	};
};

&pcie0 {
/* bench 11015.1.0 e4354b23412e */
/* bench 11015.1.1 e463270a7c72 */
/* bench 11015.1.2 4bd813529ad0 */
/* bench 11015.1.3 ebed6452c073 */
/* bench 11015.1.4 c2c8f1293258 */
	ranges = <0x00000000 0 0 0 0 0x00100000>;
	#address-cells = <3>;
	#size-cells = <2>;

	bridge@0,0,0 {
		reg = <0x0000 0 0 0 0>;
		ranges = <0x00000000 0 0 0 0 0 0 0x00100000>;
		#address-cells = <3>;
		#size-cells = <2>;

		wifi@0,1,0 {
			reg = <0x0000 0 0 0 0>;
			ranges = <0x00000000 0 0 0 0x00100000>;
			#address-cells = <1>;
			#size-cells = <1>;

			pcie0_chipcommon: chipcommon@0 {
				reg = <0 0x1000>;

				gpio-controller;
				#gpio-cells = <2>;
			};
		};
	};
};
