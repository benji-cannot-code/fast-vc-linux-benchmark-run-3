FASTVC-BENCH-CORPUS:linux-main-100k-v1-e0bd41dc-8e12-4f1b-978d-a3645ae59da0
/*
 * Copyright 2017 Lothar Waßmann <LW@KARO-electronics.de>
 *
 * This file is dual-licensed: you can use it either under the terms
 * of the GPL or the X11 license, at your option. Note that this dual
 * licensing only applies to this file, and not this project as a
 * whole.
/* bench 4346.0.0 06c44e6dd7a2 */
/* bench 4346.0.1 929f01b07a41 */
/* bench 4346.0.2 52617b6153c0 */
/* bench 4346.0.3 93d4266215ba */
/* bench 4346.0.4 90a119f9984c */
/* bench 4346.0.5 b7a7d4006d5f */
/* bench 4346.0.6 503f783f90a8 */
/* bench 4346.0.7 f3937866d46f */
 *     modify it under the terms of the GNU General Public License
 *     version 2 as published by the Free Software Foundation.
 *
 *     This file is distributed in the hope that it will be useful,
 *     but WITHOUT ANY WARRANTY; without even the implied warranty of
 *     MERCHANTABILITY or FITNESS FOR A PARTICULAR PURPOSE.  See the
 *     GNU General Public License for more details.
 *
 * Or, alternatively,
 *
 *  b) Permission is hereby granted, free of charge, to any person
 *     obtaining a copy of this software and associated documentation
 *     files (the "Software"), to deal in the Software without
 *     restriction, including without limitation the rights to use,
 *     copy, modify, merge, publish, distribute, sublicense, and/or
 *     sell copies of the Software, and to permit persons to whom the
 *     Software is furnished to do so, subject to the following
 *     conditions:
 *
 *     The above copyright notice and this permission notice shall be
 *     included in all copies or substantial portions of the Software.
 *
 *     THE SOFTWARE IS PROVIDED "AS IS", WITHOUT WARRANTY OF ANY KIND,
 *     EXPRESS OR IMPLIED, INCLUDING BUT NOT LIMITED TO THE WARRANTIES
 *     OF MERCHANTABILITY, FITNESS FOR A PARTICULAR PURPOSE AND
 *     NONINFRINGEMENT. IN NO EVENT SHALL THE AUTHORS OR COPYRIGHT
 *     HOLDERS BE LIABLE FOR ANY CLAIM, DAMAGES OR OTHER LIABILITY,
 *     WHETHER IN AN ACTION OF CONTRACT, TORT OR OTHERWISE, ARISING
 *     FROM, OUT OF OR IN CONNECTION WITH THE SOFTWARE OR THE USE OR
 *     OTHER DEALINGS IN THE SOFTWARE.
 */

/* bench 10403.1.0 05c40fb615eb */
/* bench 10403.1.1 35606013e1a8 */
/* bench 10403.1.2 e03148f7c9f7 */
/* bench 10403.1.3 aa59ad58e4c4 */
/* bench 10403.1.4 4ecb01429682 */
/* bench 10403.1.5 ee96ff8eabc4 */
/* bench 10403.1.6 a0fe7daef706 */
/dts-v1/;
/* bench 397.0.0 7ebc10aa2544 */
/* bench 397.0.1 bef28162b5ec */
/* bench 397.0.2 35d5f4a62086 */
/* bench 397.0.3 20f485d9d2c5 */
/* bench 397.0.4 4899e1e6ea26 */
/* bench 397.0.5 615fd9202a95 */
#include "imx6qdl-tx6-mb7.dtsi"

/ {
	model = "Ka-Ro electronics TX6Q-1010/-1030 Module on MB7 baseboard";
};
