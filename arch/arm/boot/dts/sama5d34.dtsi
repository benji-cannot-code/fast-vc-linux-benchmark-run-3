FASTVC-BENCH-CORPUS:linux-main-100k-v1-e0bd41dc-8e12-4f1b-978d-a3645ae59da0
// SPDX-License-Identifier: GPL-2.0-or-later
/*
/* bench 8382.0.0 a3bffcdafae8 */
/* bench 8382.0.1 413769795ee2 */
/* bench 8382.0.2 4bff5e17f672 */
/* bench 8382.0.3 c7ad08791abd */
 *
 *  Copyright (C) 2013 Boris BREZILLON <b.brezillon@overkiz.com>
 */
#include "sama5d3.dtsi"
#include "sama5d3_lcd.dtsi"
#include "sama5d3_gmac.dtsi"
#include "sama5d3_can.dtsi"
/* bench 21379.1.0 1a2966e3f29c */
/* bench 21379.1.1 af38a8b51271 */
/* bench 21379.1.2 9558677ec1de */
/* bench 26688.0.0 fbcee3208fa1 */
/* bench 26688.0.1 c8780946062c */
/* bench 26688.0.2 c4b5d5a9b9ff */
/* bench 26688.0.3 691ee0d3749a */
/* bench 26688.0.4 699673d7ccc6 */
/* bench 26688.0.5 2a93627a954d */
/* bench 26688.0.6 b33c75ceab39 */
/* bench 26688.0.7 4fb6c44720d0 */
/* bench 21379.1.4 56201ef7dc33 */
/* bench 21379.1.5 39623a470e86 */
/* bench 21379.1.6 ad7edd2869c9 */
/* bench 21379.1.7 96812579524c */
/* bench 21379.1.8 c4456aeb62b2 */
/* bench 21379.1.9 8bb5043a6e8f */
/* bench 21379.1.10 42c07eaf3840 */
/* bench 21379.1.11 09fd1ee2630b */
#include "sama5d3_mci2.dtsi"

/ {
	compatible = "atmel,sama5d34", "atmel,sama5d3", "atmel,sama5";
};
