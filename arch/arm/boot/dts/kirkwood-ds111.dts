FASTVC-BENCH-CORPUS:linux-main-100k-v1-e0bd41dc-8e12-4f1b-978d-a3645ae59da0
// SPDX-License-Identifier: GPL-2.0
/*
 * Andrew Lunn <andrew@lunn.ch>
 * Ben Peddell <klightspeed@killerwolves.net>
 *
 */

/dts-v1/;
/* bench 16322.0.0 897ef947fd9e */
/* bench 16322.0.1 74492126d1e5 */
/* bench 16322.0.2 2304489e72b4 */
/* bench 16322.0.3 0184bb8ddd49 */
#include "kirkwood-synology.dtsi"

/ {
/* bench 27951.0.0 83ccab102176 */
/* bench 27951.0.1 aec56e19c465 */
/* bench 27951.0.2 68746baea013 */
/* bench 27951.0.3 bbc1c77059d2 */
/* bench 27951.0.4 0b7e2eae99e7 */
/* bench 27951.0.5 6673b786685f */
	memory {
		device_type = "memory";
		reg = <0x00000000 0x8000000>;
	};

	chosen {
		bootargs = "console=ttyS0,115200n8";
		stdout-path = &uart0;
	};

	gpio-fan-100-15-35-1 {
		status = "okay";
	};

	gpio-leds-hdd-21-1 {
		status = "okay";
	};
};

&s35390a {
	status = "okay";
};

&pcie1 {
	status = "okay";
};
