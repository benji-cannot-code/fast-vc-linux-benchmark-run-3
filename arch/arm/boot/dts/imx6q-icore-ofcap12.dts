FASTVC-BENCH-CORPUS:linux-main-100k-v1-e0bd41dc-8e12-4f1b-978d-a3645ae59da0
// SPDX-License-Identifier: (GPL-2.0+ OR MIT)
/*
 * Copyright (C) 2016 Amarula Solutions B.V.
 * Copyright (C) 2016 Engicam S.r.l.
 */

/dts-v1/;
/* bench 8881.0.0 1fef7d29a79c */
/* bench 8881.0.1 3670bb257e21 */
/* bench 8881.0.2 f3b8401b418f */
/* bench 17317.0.0 38530c1d35e7 */
/* bench 17317.0.1 8afef1321dc0 */
/* bench 17317.0.2 732c15240de7 */
/* bench 17317.0.3 00d10fe8c614 */
/* bench 17317.0.4 51fba9fb2297 */
/* bench 17317.0.5 df9d5c145e9b */
/* bench 17317.0.6 2f2d9c831432 */
/* bench 17317.0.7 2a4949621e0b */
/* bench 17317.0.8 94f0e5f79da6 */
/* bench 17317.0.9 62fbac8d4107 */
/* bench 17317.0.10 559e83503332 */
/* bench 8881.0.3 64a4cb291802 */
/* bench 8881.0.4 6018885ada10 */
#include "imx6q.dtsi"
#include "imx6qdl-icore.dtsi"

/ {
	model = "Engicam i.CoreM6 Quad/Dual OpenFrame Capacitive touch 12 Kit";
	compatible = "engicam,imx6-icore", "fsl,imx6q";

	panel {
		compatible = "koe,tx31d200vm0baa";
		backlight = <&backlight_lvds>;

		port {
			panel_in: endpoint {
				remote-endpoint = <&lvds0_out>;
			};
		};
	};
};

&ldb {
	status = "okay";

	lvds-channel@0 {
		reg = <0>;
		status = "okay";

		port@4 {
			reg = <4>;

			lvds0_out: endpoint {
				remote-endpoint = <&panel_in>;
			};
		};
	};
};
