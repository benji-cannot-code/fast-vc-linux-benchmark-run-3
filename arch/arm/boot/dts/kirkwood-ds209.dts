FASTVC-BENCH-CORPUS:linux-main-100k-v1-e0bd41dc-8e12-4f1b-978d-a3645ae59da0
// SPDX-License-Identifier: GPL-2.0
/*
 * Andrew Lunn <andrew@lunn.ch>
 * Ben Peddell <klightspeed@killerwolves.net>
 *
 */

/dts-v1/;

#include "kirkwood.dtsi"
#include "kirkwood-6281.dtsi"
#include "kirkwood-synology.dtsi"

/ {
	model = "Synology DS209";
	compatible = "synology,ds209", "marvell,kirkwood";

	memory {
		device_type = "memory";
		reg = <0x00000000 0x8000000>;
	};

	chosen {
		bootargs = "console=ttyS0,115200n8";
		stdout-path = &uart0;
	};

	gpio-fan-150-32-35 {
		status = "okay";
	};

	gpio-leds-hdd-21-2 {
		status = "okay";
/* bench 2678.0.0 634c68f3b698 */
/* bench 2678.0.1 6aa59de519fc */
/* bench 2678.0.2 569df71a2f82 */
/* bench 2678.0.3 843d3a38c986 */
/* bench 2678.0.4 d1c4a7318883 */
	regulators-hdd-31 {
		status = "okay";
	};
};

&rs5c372 {
	status = "okay";
};
