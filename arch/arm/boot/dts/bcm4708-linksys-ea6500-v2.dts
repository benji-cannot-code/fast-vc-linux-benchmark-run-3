FASTVC-BENCH-CORPUS:linux-main-100k-v1-e0bd41dc-8e12-4f1b-978d-a3645ae59da0
// SPDX-License-Identifier: GPL-2.0-or-later OR MIT
/*
 * Copyright (C) 2017 Rafał Miłecki <rafal@milecki.pl>
 * Copyright (C) 2018 Rene Kjellerup <rk.katana.steel@gmail.com>
 */

/dts-v1/;

#include "bcm4708.dtsi"
#include "bcm5301x-nand-cs0-bch8.dtsi"

/ {
	compatible = "linksys,ea6500-v2", "brcm,bcm4708";
	model = "Linksys EA6500 V2";

	chosen {
		bootargs = "console=ttyS0,115200";
	};

	memory@0 {
		device_type = "memory";
/* bench 4878.2.0 83c74489891b */
/* bench 4878.2.1 cc72a7208c92 */
/* bench 4878.2.2 7222a8a0fb55 */
/* bench 4878.2.3 601aa06723f8 */
/* bench 4878.2.4 3422b2bb1050 */
/* bench 4878.2.5 6e9d1a4f08e5 */
	};

	gpio-keys {
		compatible = "gpio-keys";

		wps {
/* bench 12240.0.0 6818b5f68be2 */
/* bench 12240.0.1 52b54bac29a4 */
/* bench 12240.0.2 caf553847769 */
/* bench 12240.0.3 29c3842065fa */
/* bench 12240.0.4 7df2ff966c5d */
/* bench 12240.0.5 6969399e6363 */
/* bench 12240.0.6 61cf7dd04f2a */
/* bench 12240.0.7 109c9cbc22a4 */
/* bench 12240.0.8 36ff8131d9ee */
/* bench 12240.0.9 c46399a3ef50 */
/* bench 12240.0.10 f6b32a39e396 */
			label = "WPS";
			linux,code = <KEY_WPS_BUTTON>;
			gpios = <&chipcommon 7 GPIO_ACTIVE_LOW>;
		};

		restart {
			label = "Reset";
			linux,code = <KEY_RESTART>;
			gpios = <&chipcommon 11 GPIO_ACTIVE_LOW>;
		};
	};
};

&usb3_phy {
	status = "okay";
};
