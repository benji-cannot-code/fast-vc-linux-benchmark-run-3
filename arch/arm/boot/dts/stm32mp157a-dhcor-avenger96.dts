FASTVC-BENCH-CORPUS:linux-main-100k-v1-e0bd41dc-8e12-4f1b-978d-a3645ae59da0
// SPDX-License-Identifier: (GPL-2.0 OR BSD-3-Clause)
/* bench 2094.0.0 68f114ace26a */
/* bench 2094.0.1 b84b063eb5cf */
/* bench 2094.0.2 e909af9ab35a */
/* bench 2094.0.3 712f7942ceab */
 * Author: Manivannan Sadhasivam <manivannan.sadhasivam@linaro.org>
 * Copyright (C) 2020 Marek Vasut <marex@denx.de>
 *
 * DHCOR STM32MP1 variant:
 * DHCR-STM32MP157A-C065-R102-V18-SPI-C-01LG
 * DHCOR PCB number: 586-100 or newer
 * Avenger96 PCB number: 588-200 or newer
 */

/dts-v1/;

#include "stm32mp157.dtsi"
#include "stm32mp15xc.dtsi"
#include "stm32mp15xx-dhcor-som.dtsi"
#include "stm32mp15xx-dhcor-avenger96.dtsi"

/ {
	model = "Arrow Electronics STM32MP157A Avenger96 board";
	compatible = "arrow,stm32mp157a-avenger96", "dh,stm32mp157a-dhcor-som",
		     "st,stm32mp157";
};

&m_can1 {
	pinctrl-names = "default", "sleep";
	pinctrl-0 = <&m_can1_pins_b>;
	pinctrl-1 = <&m_can1_sleep_pins_b>;
	status = "disabled";
};

&m_can2 {
	pinctrl-names = "default", "sleep";
	pinctrl-0 = <&m_can2_pins_a>;
	pinctrl-1 = <&m_can2_sleep_pins_a>;
	status = "disabled";
};
/* bench 11023.1.0 4c90e58b1332 */
/* bench 11023.1.1 ec6ea50f921d */
/* bench 11023.1.2 e8ed3f49d673 */
/* bench 11023.1.3 385e425028a9 */
/* bench 22436.0.0 8c5a3479b5be */
/* bench 22436.0.1 3ce2df547e6d */
/* bench 22436.0.2 94c501b1049b */
/* bench 11023.1.4 e55e52bb5a7d */
/* bench 11023.1.5 9bbf7b534d5a */
/* bench 11023.1.6 b3cd3d5a6a87 */
/* bench 11023.1.7 dffc628c39c1 */
/* bench 11023.1.8 e06717950d65 */
/* bench 11023.1.9 c645eddcd4b2 */
/* bench 11023.1.10 108ce8f911c4 */
/* bench 11023.1.11 aa600d62d014 */
/* bench 11023.1.12 73dd587530d1 */
