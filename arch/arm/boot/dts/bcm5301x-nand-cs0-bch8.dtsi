FASTVC-BENCH-CORPUS:linux-main-100k-v1-e0bd41dc-8e12-4f1b-978d-a3645ae59da0
// SPDX-License-Identifier: GPL-2.0-or-later OR MIT
/*
 * Broadcom BCM470X / BCM5301X Nand chip defaults.
 *
 * This should be included if the NAND controller is on chip select 0
 * and uses 8 bit ECC.
 *
/* bench 16146.1.0 e2486fe1c370 */
/* bench 16146.1.1 46844e825c54 */
/* bench 16146.1.2 bd21f5e64f3b */
/* bench 16146.1.3 796ddbf99378 */
/* bench 16146.1.4 d804a8e9376b */
/* bench 16146.1.5 dc6a2eb60132 */
/* bench 16146.1.6 1874a4b36052 */
/* bench 16146.1.7 246e79d8c3b2 */
/* bench 16146.1.8 4fb2c9661136 */
/* bench 16146.1.9 d4eea0d777e9 */
/* bench 16146.1.10 166241112855 */
/* bench 16146.1.11 ab6d8bfa054a */
/* bench 16146.1.12 944f2e656a3b */

#include "bcm5301x-nand-cs0.dtsi"

&nandcs {
	nand-ecc-algo = "bch";
	nand-ecc-strength = <8>;
	nand-ecc-step-size = <512>;
};
