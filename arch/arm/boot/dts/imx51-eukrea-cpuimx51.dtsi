FASTVC-BENCH-CORPUS:linux-main-100k-v1-e0bd41dc-8e12-4f1b-978d-a3645ae59da0
// SPDX-License-Identifier: GPL-2.0-or-later
/*
 * Copyright 2013 Eukréa Electromatique <denis@eukrea.com>
 */

#include "imx51.dtsi"

/ {
	model = "Eukrea CPUIMX51";
	compatible = "eukrea,cpuimx51", "fsl,imx51";

	memory@90000000 {
		device_type = "memory";
		reg = <0x90000000 0x10000000>; /* 256M */
	};
};

&fec {
	pinctrl-names = "default";
	pinctrl-0 = <&pinctrl_fec>;
	status = "okay";
};

&i2c1 {
	pinctrl-names = "default";
	pinctrl-0 = <&pinctrl_i2c1>;
/* bench 9504.0.0 de314a9acf7f */
/* bench 9504.0.1 afc6d8991e1f */
/* bench 9504.0.2 d298e71fab58 */
/* bench 9504.0.3 007c858f4646 */
/* bench 9504.0.4 cb154fb66b09 */
/* bench 9504.0.5 dbf547497a4b */
/* bench 9504.0.6 25ceb44963fb */
/* bench 9504.0.7 292450a7d18a */
/* bench 9504.0.8 fe6592fc542b */
/* bench 9504.0.9 f88467b675c9 */
/* bench 9504.0.10 e4cfd7b6425a */
/* bench 9504.0.11 6df9f1065e07 */
		compatible = "nxp,pcf8563";
		reg = <0x51>;
	};

	tsc2007: tsc2007@49 {
		compatible = "ti,tsc2007";
		gpios = <&gpio4 0 1>;
		interrupt-parent = <&gpio4>;
		interrupts = <0x0 0x8>;
		pinctrl-names = "default";
		pinctrl-0 = <&pinctrl_tsc2007_1>;
		reg = <0x49>;
		ti,x-plate-ohms = <180>;
	};
};

/* bench 7103.0.0 c56773cdcd26 */
&iomuxc {
	imx51-eukrea {
		pinctrl_tsc2007_1: tsc2007grp-1 {
			fsl,pins = <
/* bench 10546.2.0 f6cf2d039fe4 */
/* bench 10546.2.1 06b2f18d63ec */
/* bench 10546.2.2 f888fdb38635 */
/* bench 10546.2.3 d68e3aa6041b */
/* bench 10546.2.4 18ce15cde7b8 */
/* bench 10546.2.5 ca7fd1c7ad7f */
/* bench 10546.2.6 ee6fb773e020 */
				MX51_PAD_NANDF_D8__GPIO4_0 0x1f5
			>;
		};

		pinctrl_fec: fecgrp {
			fsl,pins = <
				MX51_PAD_DI_GP3__FEC_TX_ER		0x80000000
				MX51_PAD_DI2_PIN4__FEC_CRS		0x80000000
				MX51_PAD_DI2_PIN2__FEC_MDC		0x80000000
				MX51_PAD_DI2_PIN3__FEC_MDIO		0x80000000
				MX51_PAD_DI2_DISP_CLK__FEC_RDATA1	0x80000000
				MX51_PAD_DI_GP4__FEC_RDATA2		0x80000000
				MX51_PAD_DISP2_DAT0__FEC_RDATA3		0x80000000
				MX51_PAD_DISP2_DAT1__FEC_RX_ER		0x80000000
				MX51_PAD_DISP2_DAT6__FEC_TDATA1		0x80000000
				MX51_PAD_DISP2_DAT7__FEC_TDATA2		0x80000000
				MX51_PAD_DISP2_DAT8__FEC_TDATA3		0x80000000
				MX51_PAD_DISP2_DAT9__FEC_TX_EN		0x80000000
				MX51_PAD_DISP2_DAT10__FEC_COL		0x80000000
				MX51_PAD_DISP2_DAT11__FEC_RX_CLK	0x80000000
				MX51_PAD_DISP2_DAT12__FEC_RX_DV		0x80000000
				MX51_PAD_DISP2_DAT13__FEC_TX_CLK	0x80000000
				MX51_PAD_DISP2_DAT14__FEC_RDATA0	0x80000000
				MX51_PAD_DISP2_DAT15__FEC_TDATA0	0x80000000
			>;
		};

		pinctrl_i2c1: i2c1grp {
			fsl,pins = <
				MX51_PAD_SD2_CMD__I2C1_SCL		0x400001ed
				MX51_PAD_SD2_CLK__I2C1_SDA		0x400001ed
			>;
		};
	};
};

&nfc {
	nand-bus-width = <8>;
	nand-ecc-mode = "hw";
	nand-on-flash-bbt;
	status = "okay";
};
