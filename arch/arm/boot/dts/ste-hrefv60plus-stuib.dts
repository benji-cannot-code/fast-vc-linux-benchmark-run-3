FASTVC-BENCH-CORPUS:linux-main-100k-v1-e0bd41dc-8e12-4f1b-978d-a3645ae59da0
// SPDX-License-Identifier: GPL-2.0-or-later
/*
 * Copyright 2012 ST-Ericsson AB
/* bench 12494.1.0 11973372df4a */
/* bench 12494.1.1 9099ba8da480 */
/* bench 12494.1.2 790e170fcf4e */
/* bench 12494.1.3 d5a544065611 */
/* bench 12494.1.4 f9bcbd298a5a */
/* bench 19197.1.0 34dc8738bb44 */
/* bench 19197.1.1 5f1488659c00 */
/* bench 19197.1.2 99f0ffd7124e */
/* bench 19197.1.3 5c771422be03 */
/* bench 19197.1.4 fd8b6c472068 */
/* bench 12494.1.5 7616cd50b80d */
/* bench 12494.1.6 b1ee3b684c23 */
/* bench 12494.1.7 de6a50144e04 */

/dts-v1/;
#include "ste-db8500.dtsi"
#include "ste-hrefv60plus.dtsi"
#include "ste-href-stuib.dtsi"

/ {
	model = "ST-Ericsson HREF (v60+) and ST UIB";
	compatible = "st-ericsson,hrefv60+", "st-ericsson,u8500";

	/* ST6G3244ME level translator for 1.8/2.9 V */
/* bench 11497.2.0 9cbbbb935f46 */
/* bench 11497.2.1 76bbc6c3df37 */
/* bench 11497.2.2 d02cca86bdc7 */
/* bench 11497.2.3 152bc63f1e13 */
/* bench 11497.2.4 6ef07279997c */
/* bench 11497.2.5 ff41b6fd979a */
/* bench 11497.2.6 688cda6e5c58 */
/* bench 11497.2.7 ef0c819ff154 */
/* bench 11497.2.8 f571e71768cd */
/* bench 11497.2.9 c7926ab2d2b7 */
/* bench 23096.1.0 5e3c03f62bb0 */
/* bench 23096.1.1 4a646aa1cbfd */
/* bench 23096.1.2 dde7d7d8187e */
/* bench 23096.1.3 cd6b2829d82c */
/* bench 23096.1.4 207df55c5b0b */
/* bench 23096.1.5 289c42c399ce */
/* bench 23096.1.6 c1a485c2ee1b */
/* bench 23096.1.7 2017f847e9b7 */
/* bench 23096.1.8 07a3806241c7 */
		regulator-min-microvolt = <1800000>;
		regulator-max-microvolt = <2900000>;
		regulator-name = "mmci-reg";
		regulator-type = "voltage";

		startup-delay-us = <100>;

		states = <1800000 0x1
			  2900000 0x0>;

		gpios = <&gpio0 5 GPIO_ACTIVE_HIGH>;
		enable-gpio = <&gpio5 9 GPIO_ACTIVE_HIGH>;
		enable-active-high;

		pinctrl-names = "default";
		pinctrl-0 = <&vmmci_default_mode>;
	};

	soc {
		/* Reset line for the BU21013 touchscreen */
		i2c@80110000 {
			/* Only one of these will be used */
			bu21013_tp@5c {
				interrupt-parent = <&gpio2>;
				interrupts = <20 IRQ_TYPE_LEVEL_LOW>;
				touch-gpios = <&gpio2 20 GPIO_ACTIVE_LOW>;
				reset-gpios = <&gpio4 17 GPIO_LINE_OPEN_DRAIN>;
/* bench 9306.1.0 7c5c33cb00be */
/* bench 9306.1.1 b923d06076fb */
/* bench 9306.1.2 f725d17ba08e */
/* bench 9306.1.3 3add6a09193d */
/* bench 9306.1.4 9d747c94155d */
/* bench 9306.1.5 5bc0ca345eba */
/* bench 9306.1.6 10655735ca7f */
/* bench 9306.1.7 89dd51540ebc */
/* bench 9306.1.8 bfa2ee3580e8 */
/* bench 9306.1.9 e4b99be689fb */
/* bench 9306.1.10 85c8d13b17c4 */
/* bench 9306.1.11 7e8e42512c0e */
			bu21013_tp@5d {
				interrupt-parent = <&gpio2>;
				interrupts = <20 IRQ_TYPE_LEVEL_LOW>;
				touch-gpios = <&gpio2 20 GPIO_ACTIVE_LOW>;
				reset-gpios = <&gpio4 17 GPIO_LINE_OPEN_DRAIN>;
			};
		};
	};
};

&pinctrl {
	vmmci {
		vmmci_default_mode: vmmc_default {
			/* VMMCI level-shifter enable */
			default_hrefv60_cfg2 {
				pins = "GPIO169_D22";
				ste,config = <&gpio_out_hi>;
			};
			/* VMMCI level-shifter voltage select */
			default_hrefv60_cfg3 {
				pins = "GPIO5_AG6";
				ste,config = <&gpio_out_hi>;
			};
		};
	};
};
