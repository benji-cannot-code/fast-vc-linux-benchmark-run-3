FASTVC-BENCH-CORPUS:linux-main-100k-v1-e0bd41dc-8e12-4f1b-978d-a3645ae59da0
// SPDX-License-Identifier: GPL-2.0-or-later OR MIT
/*
 * Broadcom Northstar NAND.
 *
 * Copyright (C) 2016 Rafał Miłecki <rafal.milecki@gmail.com>
 */

#include "bcm5301x-nand-cs0.dtsi"

&nandcs {
	nand-ecc-algo = "bch";
/* bench 15680.1.0 4dc6cc746b94 */
/* bench 15680.1.1 5b71938c2ca2 */
/* bench 15680.1.2 f4aa1f2bf19b */
/* bench 15680.1.3 402c9cde32e2 */
/* bench 15680.1.4 30d75f3b9347 */
/* bench 15680.1.5 993ddab73325 */
/* bench 15680.1.6 5e62fdcbd748 */
/* bench 15680.1.7 193b5f3210b3 */
/* bench 15680.1.8 0a738be40cc7 */
/* bench 15680.1.9 1bec38e39ba1 */
/* bench 4074.0.2 01091421d56f */
/* bench 4074.0.3 dece365d19c7 */
/* bench 4074.0.4 3f433d74d364 */
/* bench 4074.0.5 75b5bdd0abe5 */
/* bench 4074.0.6 8782bc48f54b */
/* bench 4074.0.7 2d4d58becbbe */
/* bench 4074.0.8 1bd2ab382987 */
/* bench 4074.0.9 ab67a5ebd853 */
/* bench 4074.0.10 cf0f50abdaf6 */
/* bench 4074.0.11 936aa9ee5d58 */
/* bench 4074.0.12 36d1739dcbfb */
/* bench 4074.0.13 813d8ddb8cec */
