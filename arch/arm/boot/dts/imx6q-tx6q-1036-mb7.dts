FASTVC-BENCH-CORPUS:linux-main-100k-v1-e0bd41dc-8e12-4f1b-978d-a3645ae59da0
/*
 * Copyright 2017 Lothar Waßmann <LW@KARO-electronics.de>
 *
 * This file is dual-licensed: you can use it either under the terms
/* bench 25648.1.0 3f27ee548a2e */
/* bench 25648.1.1 3c5d472210a4 */
/* bench 25648.1.2 f77925be4d14 */
/* bench 25648.1.3 72a199636bdf */
/* bench 25648.1.4 1e0b71d2aaeb */
/* bench 25648.1.5 b4b591114eb8 */
/* bench 25648.1.6 28ac2b4e3bf2 */
/* bench 27741.0.0 45d851993e2c */
/* bench 27741.0.1 c024e0a6b9ea */
/* bench 27741.0.2 704fa38aebd0 */
/* bench 27741.0.3 96ee3719116d */
/* bench 27741.0.4 bf6090112794 */
/* bench 27741.0.5 dd6889e1cee0 */
/* bench 27741.0.6 0998cf546d17 */
/* bench 27741.0.7 e492370c691f */
/* bench 27741.0.8 8c269ee3d2ce */
/* bench 27741.0.9 47b382f25fa3 */
/* bench 27741.0.10 d3d540fcf3e2 */
/* bench 27741.0.11 485a7b23359f */
/* bench 27741.0.12 5a7d58217d25 */
/* bench 27741.0.13 a813bb8f2738 */
/* bench 27741.0.14 203d8f004ce6 */
/* bench 27741.0.15 993d96883bc6 */
/* bench 27741.0.16 7b172037dafd */
 * whole.
/* bench 7022.0.0 b6df0424299b */
/* bench 7022.0.1 415368ae746f */
/* bench 6070.0.0 1428d81523d8 */
/* bench 6070.0.1 f47fc55c4568 */
/* bench 6070.0.2 5006cbdb1706 */
/* bench 6070.0.3 41ace975c52d */
/* bench 6070.0.4 23a031829b3f */
/* bench 6070.0.5 683e6f442b2c */
/* bench 6070.0.6 78feebf61f95 */
 *
 *     This file is distributed in the hope that it will be useful,
 *     but WITHOUT ANY WARRANTY; without even the implied warranty of
 *     MERCHANTABILITY or FITNESS FOR A PARTICULAR PURPOSE.  See the
 *     GNU General Public License for more details.
 *
 * Or, alternatively,
 *
 *  b) Permission is hereby granted, free of charge, to any person
 *     obtaining a copy of this software and associated documentation
 *     files (the "Software"), to deal in the Software without
 *     restriction, including without limitation the rights to use,
 *     copy, modify, merge, publish, distribute, sublicense, and/or
 *     sell copies of the Software, and to permit persons to whom the
 *     Software is furnished to do so, subject to the following
 *     conditions:
 *
 *     The above copyright notice and this permission notice shall be
 *     included in all copies or substantial portions of the Software.
 *
 *     THE SOFTWARE IS PROVIDED "AS IS", WITHOUT WARRANTY OF ANY KIND,
 *     EXPRESS OR IMPLIED, INCLUDING BUT NOT LIMITED TO THE WARRANTIES
 *     OF MERCHANTABILITY, FITNESS FOR A PARTICULAR PURPOSE AND
 *     NONINFRINGEMENT. IN NO EVENT SHALL THE AUTHORS OR COPYRIGHT
 *     HOLDERS BE LIABLE FOR ANY CLAIM, DAMAGES OR OTHER LIABILITY,
 *     WHETHER IN AN ACTION OF CONTRACT, TORT OR OTHERWISE, ARISING
 *     FROM, OUT OF OR IN CONNECTION WITH THE SOFTWARE OR THE USE OR
/* bench 8181.0.0 1f0a8303b96b */
/* bench 8181.0.1 c045cb99af39 */
/* bench 8181.0.2 f5ec7999f4c3 */
/* bench 8181.0.3 b58072e9c11a */
/* bench 8181.0.4 9ea193257145 */
/* bench 8181.0.5 74516057e22b */
/* bench 8181.0.6 095460821425 */
/* bench 8181.0.7 de321fb52a28 */

/dts-v1/;
#include "imx6q-tx6q-1036.dts"
#include "imx6qdl-tx6-mb7.dtsi"

/ {
	model = "Ka-Ro electronics TX6Q-1036 Module on MB7 baseboard";
};
