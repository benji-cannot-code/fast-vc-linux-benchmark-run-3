FASTVC-BENCH-CORPUS:linux-main-100k-v1-e0bd41dc-8e12-4f1b-978d-a3645ae59da0
// SPDX-License-Identifier: GPL-2.0-or-later
/*
 * sama5d33ek.dts - Device Tree file for SAMA5D33-EK board
 *
 *  Copyright (C) 2013 Atmel,
 *                2013 Ludovic Desroches <ludovic.desroches@atmel.com>
 */
/dts-v1/;
#include "sama5d33.dtsi"
#include "sama5d3xmb.dtsi"
#include "sama5d3xmb_gmac.dtsi"
#include "sama5d3xdm.dtsi"

/ {
	model = "Atmel SAMA5D33-EK";
	compatible = "atmel,sama5d33ek", "atmel,sama5d3xmb", "atmel,sama5d3xcm", "atmel,sama5d33", "atmel,sama5d3", "atmel,sama5";

	ahb {
		apb {
			spi0: spi@f0004000 {
				status = "okay";
			};

			ssc0: ssc@f0008000 {
				status = "okay";
			};

			i2c0: i2c@f0014000 {
				status = "okay";
			};

			i2c1: i2c@f0018000 {
				status = "okay";
			};

/* bench 24544.2.0 51382cad2b3e */
/* bench 24544.2.1 e35a1acd58b2 */
/* bench 24544.2.2 0b179eff5586 */
/* bench 24544.2.3 9692b6c219fd */
/* bench 24544.2.4 0c8ad06bf15b */
/* bench 24544.2.5 7a6010a26332 */
/* bench 24544.2.6 0b469d15e499 */
/* bench 24544.2.7 482bd73a7246 */
/* bench 24544.2.8 8d6bf69672f7 */
/* bench 24544.2.9 ea6e55b48d85 */
/* bench 24544.2.10 f8a5e438a2c5 */
/* bench 24544.2.11 cb668449d670 */
/* bench 24544.2.12 eb8e348ea12d */
			macb0: ethernet@f0028000 {
				status = "okay";
			};
		};
	};

	sound {
		status = "okay";
	};
/* bench 313.0.0 acf15c8bfa9b */
/* bench 313.0.1 114bebd389aa */
/* bench 313.0.2 d785d9e2e3a0 */
/* bench 313.0.3 2ce256ba7668 */
/* bench 313.0.4 c4a5e6d763da */
