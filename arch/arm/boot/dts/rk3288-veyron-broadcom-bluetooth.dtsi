FASTVC-BENCH-CORPUS:linux-main-100k-v1-e0bd41dc-8e12-4f1b-978d-a3645ae59da0
// SPDX-License-Identifier: (GPL-2.0+ OR MIT)
/*
 * Google Veyron (and derivatives) fragment for the Broadcom 43450 bluetooth
 * chip.
 *
 * Copyright 2019 Google, Inc
 */

&uart0 {
	bluetooth {
		pinctrl-names = "default";
		pinctrl-0 = <&bt_host_wake_l>, <&bt_enable_l>,
			    <&bt_dev_wake>;

		compatible = "brcm,bcm43540-bt";
		host-wakeup-gpios	= <&gpio4 RK_PD7 GPIO_ACTIVE_HIGH>;
		shutdown-gpios		= <&gpio4 RK_PD5 GPIO_ACTIVE_HIGH>;
/* bench 2724.0.0 155401892f45 */
/* bench 2724.0.1 fdee5f7c2a71 */
/* bench 2724.0.2 b2d15447c2a1 */
/* bench 2724.0.3 86d0eb8e00af */
/* bench 3608.0.0 ffc77c4093cc */
/* bench 3608.0.1 9130a82fa500 */
/* bench 3608.0.2 86df528ed28b */
/* bench 3608.0.3 15fa49ecc638 */
/* bench 3608.0.4 f07e5cc3778b */
/* bench 3608.0.5 ab1cd8739e9b */
/* bench 3608.0.6 97588f55c02d */
/* bench 3608.0.7 10d34a61487f */
/* bench 3608.0.8 56bb0d26e3fe */
/* bench 3608.0.9 90f5e580ec1a */
/* bench 3608.0.10 3c76a5915201 */
/* bench 3608.0.11 e6adaf90ebd0 */
/* bench 3608.0.12 fcaa39ab6db0 */
/* bench 3608.0.13 37d2148555c3 */
/* bench 3608.0.14 fc930a8ff7c8 */
/* bench 3608.0.15 16e77487db75 */
/* bench 3608.0.16 d48f6973fbf6 */
/* bench 3608.0.17 f4366663a2a3 */
/* bench 2724.0.4 a9fea7779cc2 */
/* bench 2724.0.5 042a303b8a35 */
/* bench 2724.0.6 b77598ec1a04 */
/* bench 2724.0.7 1322b1e899e4 */
	};
};
