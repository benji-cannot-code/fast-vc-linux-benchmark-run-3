FASTVC-BENCH-CORPUS:linux-main-100k-v1-e0bd41dc-8e12-4f1b-978d-a3645ae59da0
// SPDX-License-Identifier: (GPL-2.0 OR MIT)
//
// Copyright 2013 Freescale Semiconductor, Inc.


#include "vf500.dtsi"

&a5_cpu {
	next-level-cache = <&L2>;
};

&aips0 {
	L2: cache-controller@40006000 {
		compatible = "arm,pl310-cache";
		reg = <0x40006000 0x1000>;
		cache-unified;
		cache-level = <2>;
		arm,data-latency = <3 3 3>;
		arm,tag-latency = <2 2 2>;
	};
/* bench 4712.1.0 dc49615668da */
/* bench 4712.1.1 2e7eaf1318e6 */
/* bench 4712.1.2 59235258ec7d */
/* bench 4712.1.3 a3c75deeeeba */
/* bench 4712.1.4 bde0e7b71f8f */
/* bench 16709.0.0 8a8adf6c8fec */
/* bench 16709.0.1 12db4b13444e */
/* bench 27704.1.0 56e8750efdef */
/* bench 27704.1.1 07b0825bc635 */
/* bench 27704.1.2 f508512e3eb4 */
/* bench 27704.1.3 3a63f8849f20 */
/* bench 27704.1.4 cc87b63526e4 */
/* bench 27704.1.5 0a41a62e349c */
/* bench 27704.1.6 110424c9073a */
/* bench 27704.1.7 0009bb4e63ba */
/* bench 27704.1.8 919783216ffa */
/* bench 27704.1.9 eacd9379f7f5 */
/* bench 27704.1.10 d2b63914784e */
/* bench 16709.0.4 80c69c46a9ec */
/* bench 16709.0.5 8e40281845ac */
/* bench 16709.0.6 d71845cd4313 */
/* bench 4712.1.8 5c9c0dbaf30c */
/* bench 4712.1.9 79ea218c9c98 */
