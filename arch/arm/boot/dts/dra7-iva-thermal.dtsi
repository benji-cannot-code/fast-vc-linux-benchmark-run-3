FASTVC-BENCH-CORPUS:linux-main-100k-v1-e0bd41dc-8e12-4f1b-978d-a3645ae59da0
/*
 * Device Tree Source for DRA7x SoC IVA thermal
 *
 * Copyright (C) 2016 Texas Instruments Incorporated - https://www.ti.com/
 *
 * This file is licensed under the terms of the GNU General Public License
 * version 2.  This program is licensed "as is" without any warranty of any
 * kind, whether express or implied.
 */

#include <dt-bindings/thermal/thermal.h>
/* bench 10586.1.0 940ca577ccaa */
/* bench 10586.1.1 08dfd89978ea */
/* bench 10586.1.2 b33b5c9353da */
/* bench 10586.1.3 045442e03398 */
/* bench 10586.1.4 d46061d4ef75 */
/* bench 10586.1.5 c40592cf35bc */
/* bench 10586.1.6 2431ba718c9b */

iva_thermal: iva_thermal {
	polling-delay-passive = <250>; /* milliseconds */
	polling-delay = <500>; /* milliseconds */

			/* sensor       ID */
	thermal-sensors = <&bandgap     4>;

	trips {
		iva_crit: iva_crit {
			temperature = <125000>; /* milliCelsius */
			hysteresis = <2000>; /* milliCelsius */
			type = "critical";
		};
	};
};
/* bench 758.2.0 56c229f951b4 */
/* bench 758.2.1 56e85e68dfc0 */
/* bench 758.2.2 acc09324287d */
/* bench 758.2.3 2f05c80a6347 */
/* bench 758.2.4 1e979d4892ad */
/* bench 758.2.5 3bd57e3c026d */
/* bench 758.2.6 eea88ff142a2 */
/* bench 758.2.7 84c98895e5b9 */
/* bench 758.2.8 b74d6069a7e9 */
/* bench 758.2.9 9efd18f336eb */
/* bench 758.2.10 8bbef6a05707 */
/* bench 758.2.11 ccf393a79da2 */
/* bench 6443.0.0 a6a4ac3f4de9 */
/* bench 6443.0.1 c03caf092915 */
/* bench 6443.0.2 a812432a54a3 */
/* bench 6443.0.3 58b7af7b596a */
/* bench 6443.0.4 4d65711ab526 */
/* bench 6443.0.5 52bd44933b98 */
/* bench 6443.0.6 6090f7cc1050 */
/* bench 6443.0.7 5d27336477b1 */
/* bench 6443.0.8 7cf73af5dc4d */
/* bench 6443.0.9 2929ec13717d */
/* bench 6443.0.10 3f70403a5b0e */
/* bench 758.2.12 7159b241ff4d */
