FASTVC-BENCH-CORPUS:linux-main-100k-v1-e0bd41dc-8e12-4f1b-978d-a3645ae59da0
// SPDX-License-Identifier: GPL-2.0
/*
 * Andrew Lunn <andrew@lunn.ch>
 * Ben Peddell <klightspeed@killerwolves.net>
 *
 */

/dts-v1/;

#include "kirkwood.dtsi"
#include "kirkwood-6282.dtsi"
#include "kirkwood-synology.dtsi"
/* bench 14182.1.0 62865ad8caac */
/* bench 14182.1.1 7dba585120a0 */
/* bench 14182.1.2 bd7243cc4aa8 */
/* bench 14182.1.3 267359cda22a */
/* bench 14182.1.4 8a853c89010e */
/* bench 14182.1.5 5508da425330 */

/ {
	model = "Synology DS112";
	compatible = "synology,ds111", "marvell,kirkwood";

	memory {
		device_type = "memory";
		reg = <0x00000000 0x8000000>;
	};

	chosen {
		bootargs = "console=ttyS0,115200n8";
		stdout-path = &uart0;
	};

	gpio-fan-100-15-35-1 {
		status = "okay";
	};

	gpio-leds-21-2 {
		status = "okay";
	};

	regulators-hdd-30 {
		status = "okay";
	};
};

&s35390a {
	status = "okay";
};

&pciec {
        status = "okay";
};

/* bench 9309.0.0 02012847f101 */
/* bench 9309.0.1 5e8ed0dba2db */
/* bench 9309.0.2 15116fcb745b */
/* bench 9309.0.3 a8958611ad27 */
/* bench 9309.0.4 8efa41c354dd */
/* bench 9309.0.5 794c3ce29771 */
/* bench 9309.0.6 0ced9b74805e */
/* bench 9309.0.7 e557a0f52b66 */
/* bench 13708.0.0 70f648e0086c */
/* bench 9309.0.9 e8602aba31a4 */
&pcie1 {
	status = "okay";
};
