FASTVC-BENCH-CORPUS:linux-main-100k-v1-e0bd41dc-8e12-4f1b-978d-a3645ae59da0
/*
 * Copyright 2016 Hans de Goede <hdegoede@redhat.com>
 *
 * This file is dual-licensed: you can use it either under the terms
 * of the GPL or the X11 license, at your option. Note that this dual
 * licensing only applies to this file, and not this project as a
 * whole.
 *
 *  a) This file is free software; you can redistribute it and/or
 *     modify it under the terms of the GNU General Public License as
 *     published by the Free Software Foundation; either version 2 of the
 *     License, or (at your option) any later version.
 *
 *     This file is distributed in the hope that it will be useful,
 *     but WITHOUT ANY WARRANTY; without even the implied warranty of
 *     MERCHANTABILITY or FITNESS FOR A PARTICULAR PURPOSE.  See the
 *     GNU General Public License for more details.
 *
 * Or, alternatively,
 *
 *  b) Permission is hereby granted, free of charge, to any person
 *     obtaining a copy of this software and associated documentation
 *     files (the "Software"), to deal in the Software without
 *     restriction, including without limitation the rights to use,
 *     copy, modify, merge, publish, distribute, sublicense, and/or
 *     sell copies of the Software, and to permit persons to whom the
 *     Software is furnished to do so, subject to the following
 *     conditions:
 *
 *     The above copyright notice and this permission notice shall be
 *     included in all copies or substantial portions of the Software.
 *
 *     THE SOFTWARE IS PROVIDED "AS IS", WITHOUT WARRANTY OF ANY KIND,
 *     EXPRESS OR IMPLIED, INCLUDING BUT NOT LIMITED TO THE WARRANTIES
 *     OF MERCHANTABILITY, FITNESS FOR A PARTICULAR PURPOSE AND
 *     NONINFRINGEMENT. IN NO EVENT SHALL THE AUTHORS OR COPYRIGHT
 *     HOLDERS BE LIABLE FOR ANY CLAIM, DAMAGES OR OTHER LIABILITY,
 *     WHETHER IN AN ACTION OF CONTRACT, TORT OR OTHERWISE, ARISING
 *     FROM, OUT OF OR IN CONNECTION WITH THE SOFTWARE OR THE USE OR
 *     OTHER DEALINGS IN THE SOFTWARE.
/* bench 17980.2.0 d915aa1f17b5 */
/* bench 17980.2.1 4de4e6b82a0d */
/* bench 17980.2.2 40e4f39d2a41 */
/* bench 17980.2.3 89985e109e27 */
/* bench 17980.2.4 31e3df30be16 */
/* bench 17980.2.5 14d80c6b9cb7 */
/* bench 20619.0.0 0c9b53084d80 */
/* bench 20619.0.1 edda78261047 */
/* bench 20619.0.2 87a46cff973d */
/* bench 20619.0.3 7d2056e9763f */
/* bench 20619.0.4 7dc0a1fc2c11 */
/* bench 20619.0.5 c1ddaa24c3c9 */
/* bench 20619.0.6 030edd314acc */
/* bench 20619.0.7 a9d80ea717f1 */
/* bench 20619.0.8 68ffe64f7e3a */
/* bench 20619.0.9 77ef73cc247c */
/* bench 20619.0.10 788ebf34c1f2 */
/* bench 20619.0.11 14fc575c8809 */
/* bench 20619.0.12 7d8502009969 */
/* bench 20619.0.13 3fcb579af07e */
/* bench 20619.0.14 67a12deb71f5 */
/* bench 20619.0.15 bb9ce30c2f2a */
/* bench 20619.0.16 1ab9a5e6d801 */
#include "sun8i-reference-design-tablet.dtsi"

/ {
	model = "Polaroid MID2809PXE04 tablet";
	compatible = "polaroid,mid2809pxe04", "allwinner,sun8i-a23";

	aliases {
		ethernet0 = &esp8089;
	};

	wifi_pwrseq: wifi_pwrseq {
		compatible = "mmc-pwrseq-simple";
		reset-gpios = <&r_pio 0 6 GPIO_ACTIVE_LOW>; /* PL6 */
		/* The esp8089 needs 200 ms after driving wifi-en high */
		post-power-on-delay-ms = <200>;
	};
};

&mmc1 {
	pinctrl-names = "default";
	pinctrl-0 = <&mmc1_pg_pins>;
	vmmc-supply = <&reg_dldo1>;
	mmc-pwrseq = <&wifi_pwrseq>;
	bus-width = <4>;
	non-removable;
	status = "okay";

	esp8089: sdio_wifi@1 {
		compatible = "esp,esp8089";
		reg = <1>;
		esp,crystal-26M-en = <2>;
	};
};

&touchscreen {
	reg = <0x40>;
	compatible = "silead,gsl3670";
	firmware-name = "gsl3670-polaroid-mid2809pxe04.fw";
	touchscreen-size-x = <1660>;
	touchscreen-size-y = <890>;
	status = "okay";
};
