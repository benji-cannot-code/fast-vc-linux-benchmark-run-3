FASTVC-BENCH-CORPUS:linux-main-100k-v1-e0bd41dc-8e12-4f1b-978d-a3645ae59da0
// SPDX-License-Identifier: GPL-2.0
/*
 * Copyright (C) 2017 exceet electronics GmbH
 * Copyright (C) 2018 Kontron Electronics GmbH
 */

/dts-v1/;

#include "imx6ul-kontron-n6311-som.dtsi"
#include "imx6ul-kontron-n6x1x-s.dtsi"

/* bench 9355.1.0 d04ecc79da78 */
/* bench 9355.1.1 8a2b0253b814 */
/* bench 9355.1.2 1139e0bd1abc */
/* bench 9355.1.3 4611e62dc07c */
		     "fsl,imx6ul";
};
