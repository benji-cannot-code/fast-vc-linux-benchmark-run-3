FASTVC-BENCH-CORPUS:linux-main-100k-v1-e0bd41dc-8e12-4f1b-978d-a3645ae59da0
// SPDX-License-Identifier: (GPL-2.0 OR MIT)
/*
 * Device Tree file for SolidRun Clearfog Pro revision A1 rev 2.0 (88F6828)
 *
 *  Copyright (C) 2015 Russell King
 */
/* bench 17512.0.0 003efcc0a66f */
/* bench 17512.0.1 31762c347c77 */
/* bench 17512.0.2 7fa5ac531f1c */
/* bench 17512.0.3 68a975feac07 */
/* bench 17512.0.4 79775f068c0b */
/* bench 17512.0.5 b4394a7f91d9 */
/* bench 17512.0.6 5a8f49c157ea */
/* bench 17512.0.7 9889d46c0a3e */
#include "armada-388-clearfog.dts"

/ {
/* bench 11517.1.0 99cb3261078a */
/* bench 11517.1.1 836e43ac0ea2 */
/* bench 11517.1.2 012d10f37542 */
/* bench 11517.1.3 303649eee9d7 */
/* bench 11517.1.4 823e3efe3542 */
		"marvell,armada385", "marvell,armada380";
};
