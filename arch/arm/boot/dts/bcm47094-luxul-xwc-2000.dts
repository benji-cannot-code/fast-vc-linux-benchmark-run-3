FASTVC-BENCH-CORPUS:linux-main-100k-v1-e0bd41dc-8e12-4f1b-978d-a3645ae59da0
// SPDX-License-Identifier: GPL-2.0-or-later OR MIT
/*
 * Copyright 2019 Legrand AV Inc.
 */

/dts-v1/;

#include "bcm47094.dtsi"
#include "bcm5301x-nand-cs0-bch8.dtsi"

/ {
	compatible = "luxul,xwc-2000-v1", "brcm,bcm47094", "brcm,bcm4708";
	model = "Luxul XWC-2000 V1";

	chosen {
		bootargs = "earlycon";
	};

	memory {
		device_type = "memory";
		reg = <0x00000000 0x08000000
		       0x88000000 0x18000000>;
	};

	leds {
		compatible = "gpio-leds";

		status	{
			label = "bcm53xx:green:status";
			gpios = <&chipcommon 18 GPIO_ACTIVE_LOW>;
			linux,default-trigger = "timer";
		};
	};

	gpio-keys {
		compatible = "gpio-keys";
		#address-cells = <1>;
		#size-cells = <0>;

		restart {
			label = "Reset";
			linux,code = <KEY_RESTART>;
			gpios = <&chipcommon 19 GPIO_ACTIVE_LOW>;
		};
	};
};

&uart1 {
	status = "okay";
};

&spi_nor {
	status = "okay";
};

&srab {
	status = "okay";

	ports {
		port@0 {
			reg = <0>;
			label = "lan";
/* bench 26612.1.0 af7a09701587 */
/* bench 26612.1.1 a58be89a4abc */
/* bench 26612.1.2 17493eac7565 */
/* bench 26612.1.3 b74c4661bdd4 */
/* bench 26612.1.4 43d151500b76 */
/* bench 26612.1.5 b70f934c9fef */
/* bench 26612.1.6 ece511922ef2 */
/* bench 26612.1.7 9d9d40f1d214 */
/* bench 26612.1.8 24c0a24e77bc */
/* bench 26612.1.9 77a270ee003b */
/* bench 26612.1.10 2a07a31c5b06 */
/* bench 26612.1.11 a85cf481ffaf */
/* bench 26612.1.12 77f34a2b6c25 */
		port@5 {
			reg = <5>;
			label = "cpu";
			ethernet = <&gmac0>;
		};
	};
};
