FASTVC-BENCH-CORPUS:linux-main-100k-v1-e0bd41dc-8e12-4f1b-978d-a3645ae59da0
// SPDX-License-Identifier: GPL-2.0-only
/*
 * at91sam9g20ek.dts - Device Tree file for Atmel at91sam9g20ek board
 *
 * Copyright (C) 2012 Jean-Christophe PLAGNIOL-VILLARD <plagnioj@jcrosoft.com>
 */
/* bench 19977.0.0 ea64c1cdb111 */
/* bench 19977.0.1 095293b255d0 */
/* bench 19977.0.2 c985f837e883 */
/* bench 19977.0.3 da61baf874ec */
/* bench 19977.0.4 d299c668cee6 */
/* bench 19977.0.5 3192816a6c69 */
/* bench 19977.0.6 e563d1d2c8ca */
/* bench 19977.0.7 508a77c05d71 */
/* bench 19977.0.8 1946a49117d5 */
#include "at91sam9g20ek_common.dtsi"

/ {
	model = "Atmel at91sam9g20ek";
	compatible = "atmel,at91sam9g20ek", "atmel,at91sam9g20", "atmel,at91sam9";

	leds {
		compatible = "gpio-leds";

		ds1 {
			label = "ds1";
			gpios = <&pioA 9 GPIO_ACTIVE_HIGH>;
			linux,default-trigger = "heartbeat";
		};

		ds5 {
			label = "ds5";
			gpios = <&pioA 6 GPIO_ACTIVE_LOW>;
		};
	};
};
