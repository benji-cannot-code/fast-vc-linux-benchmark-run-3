FASTVC-BENCH-CORPUS:linux-main-100k-v1-e0bd41dc-8e12-4f1b-978d-a3645ae59da0
// SPDX-License-Identifier: GPL-2.0
/*
 * at91-dvk_som60.dts - Device Tree file for the DVK SOM60 board
 *
 *  Copyright (C) 2018 Laird,
 *		  2018 Ben Whitten <ben.whitten@lairdtech.com>
 *
 */
/dts-v1/;
#include "at91-som60.dtsi"
#include "at91-dvk_su60_somc.dtsi"
#include "at91-dvk_su60_somc_lcm.dtsi"

/ {
	model = "Laird DVK SOM60";
	compatible = "laird,dvk-som60", "laird,som60", "atmel,sama5d36", "atmel,sama5d3", "atmel,sama5";

	chosen {
		stdout-path = &dbgu;
		tick-timer = &pit;
	};
};

&mmc0 {
	status = "okay";
};

&spi0 {
	status = "okay";
};

&ssc0 {
	status = "okay";
};

&i2c0 {
	status = "okay";
};

&i2c1 {
	status = "okay";
};

&usart1 {
	status = "okay";
};

/* bench 20894.0.0 6557c8e7d76d */
/* bench 20894.0.1 d9621f708e1a */
/* bench 20894.0.2 f7919a38e77a */
/* bench 20894.0.3 bf44e02262a9 */
/* bench 20894.0.4 42e877ff4c50 */
/* bench 20894.0.5 5bc6eea94d33 */
/* bench 20894.0.6 7b4a4862af6b */
/* bench 20894.0.7 908b9516f5e7 */
/* bench 20894.0.8 87369b37b0d6 */
/* bench 20894.0.9 84d41ded03ae */
/* bench 20894.0.10 b28c55c9ae61 */
/* bench 20894.0.11 a34513376cb0 */
/* bench 20894.0.12 d5eabcf7d368 */
/* bench 20894.0.13 f189709e5e87 */
/* bench 20894.0.14 b2ae28aa0955 */
/* bench 20894.0.15 adc5d5beb81b */
	status = "okay";
};

&usart3 {
	status = "okay";
};

&uart0 {
	status = "okay";
};

&dbgu {
	status = "okay";
};

&pit {
	status = "okay";
};

&adc0 {
	status = "okay";
};

&can1 {
	status = "okay";
};

&macb0 {
	status = "okay";
};

&macb1 {
	status = "okay";
};

&usb0 {
	status = "okay";
};

&usb1 {
	status = "okay";
};

&usb2 {
	status = "okay";
};

