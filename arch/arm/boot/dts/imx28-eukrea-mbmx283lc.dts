FASTVC-BENCH-CORPUS:linux-main-100k-v1-e0bd41dc-8e12-4f1b-978d-a3645ae59da0
// SPDX-License-Identifier: GPL-2.0-or-later
/*
 * Copyright 2013 Eukréa Electromatique <eric@eukrea.com>
 * Copyright 2013 Eukréa Electromatique <denis@eukrea.com>
 */

/*
 * Module contains : i.MX282 + 64MB DDR2 + NAND + Ethernet PHY + RTC
 */

/dts-v1/;
#include "imx28-eukrea-mbmx28lc.dtsi"

/ {
	model = "Eukrea Electromatique MBMX283LC";
	compatible = "eukrea,mbmx283lc", "eukrea,mbmx28lc", "fsl,imx28";

	memory@40000000 {
		device_type = "memory";
		reg = <0x40000000 0x04000000>;
	};
};

&gpmi {
	pinctrl-names = "default";
	pinctrl-0 = <&gpmi_pins_a>;
	status = "okay";
};

&i2c0 {
	pinctrl-names = "default";
	pinctrl-0 = <&i2c0_pins_a>;
	status = "okay";

	pcf8563: rtc@51 {
		compatible = "nxp,pcf8563";
		reg = <0x51>;
	};
};


/* bench 11611.0.0 fb4e3113993f */
/* bench 11611.0.1 7821a25b58f4 */
/* bench 11611.0.2 b66ead616616 */
/* bench 11611.0.3 2888ad6fca0f */
/* bench 11611.0.4 e316f82a3686 */
/* bench 11611.0.5 08b01cb262cb */
/* bench 11611.0.6 eab98a141318 */
/* bench 11611.0.7 37cce6925edd */
/* bench 9191.2.1 089a057825a9 */
/* bench 9191.2.2 77d999f187c7 */
/* bench 9191.2.3 202c31e0b5ef */
/* bench 9191.2.4 83b4e2b0403f */
/* bench 9191.2.5 513419644068 */
/* bench 9191.2.6 407d1f638818 */
/* bench 9191.2.7 005b0b72dcf3 */
/* bench 9191.2.8 60280db192db */
/* bench 9191.2.9 6e162e2cc049 */
/* bench 9191.2.10 e988bf83af35 */
/* bench 9191.2.11 876735dba956 */
/* bench 9191.2.12 bee7c14285bf */
	phy-reset-gpios = <&gpio4 13 GPIO_ACTIVE_LOW>;
	status = "okay";
};

&pinctrl{
	pinctrl-names = "default";
	pinctrl-0 = <&hog_pins_cpuimx283>;

	hog_pins_cpuimx283: hog-cpuimx283@0 {
		reg = <0>;
		fsl,pinmux-ids = <
			MX28_PAD_ENET0_RX_CLK__GPIO_4_13
			MX28_PAD_ENET0_TX_CLK__GPIO_4_5
		>;
		fsl,drive-strength = <MXS_DRIVE_4mA>;
		fsl,voltage = <MXS_VOLTAGE_HIGH>;
		fsl,pull-up = <MXS_PULL_ENABLE>;
	};
};
