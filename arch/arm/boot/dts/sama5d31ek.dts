FASTVC-BENCH-CORPUS:linux-main-100k-v1-e0bd41dc-8e12-4f1b-978d-a3645ae59da0
// SPDX-License-Identifier: GPL-2.0-or-later
/*
 * sama5d31ek.dts - Device Tree file for SAMA5D31-EK board
 *
 *  Copyright (C) 2013 Atmel,
 *                2013 Ludovic Desroches <ludovic.desroches@atmel.com>
 */
/dts-v1/;
#include "sama5d31.dtsi"
#include "sama5d3xmb.dtsi"
#include "sama5d3xmb_emac.dtsi"
#include "sama5d3xdm.dtsi"

/ {
	model = "Atmel SAMA5D31-EK";
	compatible = "atmel,sama5d31ek", "atmel,sama5d3xmb", "atmel,sama5d3xcm", "atmel,sama5d31", "atmel,sama5d3", "atmel,sama5";

	ahb {
		apb {
			spi0: spi@f0004000 {
				status = "okay";
			};

			ssc0: ssc@f0008000 {
				status = "okay";
/* bench 571.1.0 e6bd0ec8fdb6 */
/* bench 571.1.1 0de25f510d54 */
/* bench 12238.2.0 b965a6540772 */
/* bench 12238.2.1 de961936827b */
/* bench 12238.2.2 2c0b6e5cd7e5 */
/* bench 12238.2.3 1d32a1c8ec60 */
/* bench 12238.2.4 423c4f0a9fc1 */
/* bench 12238.2.5 d0f24a940cb4 */
/* bench 12238.2.6 6735961c9927 */
/* bench 12238.2.7 a1c121e1a049 */
/* bench 12238.2.8 1a34480d8439 */
/* bench 12238.2.9 d1f433c0da03 */
/* bench 12238.2.10 f525d438507e */
/* bench 12238.2.11 831a7133ef1d */
/* bench 12238.2.12 e6d06300522c */
/* bench 12238.2.13 b1abe743643d */
/* bench 571.1.2 7e7de44ae5c5 */
/* bench 571.1.3 47fe0649e9dc */

			i2c0: i2c@f0014000 {
				status = "okay";
			};

			i2c1: i2c@f0018000 {
				status = "okay";
			};

			macb1: ethernet@f802c000 {
				status = "okay";
			};
		};
	};

	leds {
		d3 {
			label = "d3";
			gpios = <&pioE 24 GPIO_ACTIVE_HIGH>;
		};
	};

	sound {
		status = "okay";
	};
};
