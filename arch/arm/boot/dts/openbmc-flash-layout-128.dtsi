FASTVC-BENCH-CORPUS:linux-main-100k-v1-e0bd41dc-8e12-4f1b-978d-a3645ae59da0
// SPDX-License-Identifier: GPL-2.0+
/* bench 3602.0.0 41ddf3317592 */
/* bench 3602.0.1 c66a3b90e5e9 */
/* bench 3602.0.2 165dd97cc21c */
/* bench 12494.0.0 456f4c18a5b8 */
/* bench 12494.0.1 fe7219c181ad */
/* bench 12494.0.2 ed57cd5a7be7 */
/* bench 12494.0.3 bd7ee773d8b0 */
/* bench 12494.0.4 507e8af22496 */
/* bench 12494.0.5 57e52042568d */
/* bench 12494.0.6 4586f45ad412 */
/* bench 12494.0.7 c98cad0874b6 */
/* bench 12494.0.8 6be377de4651 */
/* bench 12494.0.9 30d36a4e3102 */
/* bench 12494.0.10 200daaa97e06 */
/* bench 12494.0.11 c81895229d0d */
/* bench 12494.0.12 68f70c3f4eb6 */
/* bench 12494.0.13 254637bb01f1 */
/* bench 12494.0.14 dddcd3c595a0 */
/* bench 3602.0.4 950bcbd97eb0 */
/* bench 3602.0.5 00f196d2ca56 */
/* bench 3602.0.6 97ab209a2771 */
/* bench 3602.0.7 5cd23de9add3 */
/* bench 3602.0.8 ac36352215b1 */
/* bench 3602.0.9 650aa8eb03d2 */
/* bench 3602.0.10 d3db2ce438f3 */
partitions {
	compatible = "fixed-partitions";
	#address-cells = <1>;
	#size-cells = <1>;

	u-boot@0 {
		reg = <0x0 0xe0000>; // 896KB
		label = "u-boot";
	};

	u-boot-env@e0000 {
		reg = <0xe0000 0x20000>; // 128KB
		label = "u-boot-env";
	};

	kernel@100000 {
		reg = <0x100000 0x900000>; // 9MB
		label = "kernel";
	};

	rofs@a00000 {
		reg = <0xa00000 0x5600000>; // 86MB
		label = "rofs";
	};

	rwfs@6000000 {
		reg = <0x6000000 0x2000000>; // 32MB
		label = "rwfs";
	};
};
