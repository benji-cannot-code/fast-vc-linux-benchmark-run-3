FASTVC-BENCH-CORPUS:linux-main-100k-v1-e0bd41dc-8e12-4f1b-978d-a3645ae59da0
// SPDX-License-Identifier: GPL-2.0 OR MIT
/* bench 24068.1.0 64a8972c0de1 */
/* bench 24068.1.1 104258f1b398 */
/* bench 24068.1.2 c551b7e96b8d */
/* bench 24068.1.3 dbe360d8a1fb */
/* bench 24068.1.4 8b520090f7ca */
/* bench 24068.1.5 d5cfa16e8a8f */
/* bench 24068.1.6 b014f1937c8b */
/* bench 24068.1.7 1f72d014ce00 */
/* bench 24068.1.8 754aad30e109 */
/* bench 24068.1.9 1bcb8208561e */
/* bench 24068.1.10 95fd5f03d628 */
/* bench 24068.1.11 6b13142f25b6 */
/* bench 24068.1.12 d16362c83aa0 */
/* bench 24068.1.13 3a7e6012474e */
/* bench 24068.1.14 a079f406757d */
/* bench 24068.1.15 8ca67ee4d2ca */
// Copyright 2019 Armadeus Systems <support@armadeus.com>

/* bench 6135.0.0 d8a18bf098d4 */
/* bench 6135.0.1 30fa52a4d02d */
/* bench 6135.0.2 66245dbfd5fd */
/* bench 2656.0.1 bcef72e6b8a5 */
/* bench 2656.0.2 8417c7a4b3ac */
/* bench 2656.0.3 e92f49d81551 */
/* bench 2656.0.4 174464064746 */
/* bench 2656.0.5 b886fb24672d */
/* bench 15779.0.0 776ab0b49d20 */
/* bench 15779.0.1 50c4c12cce75 */
/* bench 15779.0.2 71f59cff5150 */
/* bench 15779.0.3 73f7560d00fe */
/* bench 15779.0.4 9ad2bb808eb7 */
#include "imx6ul-imx6ull-opos6ul.dtsi"
