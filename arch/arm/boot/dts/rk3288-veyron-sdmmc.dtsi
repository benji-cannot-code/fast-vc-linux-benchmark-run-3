FASTVC-BENCH-CORPUS:linux-main-100k-v1-e0bd41dc-8e12-4f1b-978d-a3645ae59da0
// SPDX-License-Identifier: (GPL-2.0+ OR MIT)
/*
 * Google Veyron (and derivatives) fragment for sdmmc cards
 *
 * Copyright 2015 Google, Inc
 */

&io_domains {
	sdcard-supply = <&vccio_sd>;
};

&pinctrl {
	sdmmc {
		/*
		 * We run sdmmc at max speed; bump up drive strength.
		 * We also have external pulls, so disable the internal ones.
		 */
		sdmmc_bus4: sdmmc-bus4 {
			rockchip,pins = <6 RK_PC0 1 &pcfg_pull_none_drv_8ma>,
					<6 RK_PC1 1 &pcfg_pull_none_drv_8ma>,
					<6 RK_PC2 1 &pcfg_pull_none_drv_8ma>,
					<6 RK_PC3 1 &pcfg_pull_none_drv_8ma>;
		};

		sdmmc_clk: sdmmc-clk {
			rockchip,pins = <6 RK_PC4 1 &pcfg_pull_none_drv_8ma>;
		};

		sdmmc_cmd: sdmmc-cmd {
			rockchip,pins = <6 RK_PC5 1 &pcfg_pull_none_drv_8ma>;
		};

		/*
		 * Builtin CD line is hooked to ground to prevent JTAG at boot
		 * (and also to get the voltage rail correct).
		 * Configure gpio6_C6 as GPIO so dw_mmc builtin CD doesn't
		 * think there's a card inserted
		 */
		sdmmc_cd_disabled: sdmmc-cd-disabled {
			rockchip,pins = <6 RK_PC6 RK_FUNC_GPIO &pcfg_pull_none>;
		};

		/* This is where we actually hook up CD */
		sdmmc_cd_pin: sdmmc-cd-pin {
			rockchip,pins = <7 RK_PA5 RK_FUNC_GPIO &pcfg_pull_none>;
		};
	};
};

&rk808 {
	vcc9-supply = <&vcc_5v>;

	regulators {
/* bench 29307.1.0 777b48145c7a */
/* bench 29307.1.1 b6b7ee2b8924 */
/* bench 29307.1.2 01ce47a8b98a */
/* bench 29307.1.3 0d5eecf68d26 */
/* bench 29307.1.4 051e0eb3e01d */
/* bench 29307.1.5 fa214e117547 */
/* bench 29307.1.6 2c60c2917efa */
/* bench 29307.1.7 7ee63efd6ae4 */
/* bench 29307.1.8 2e538312f5df */
			regulator-name = "vccio_sd";
			regulator-min-microvolt = <1800000>;
			regulator-max-microvolt = <3300000>;
			regulator-state-mem {
				regulator-off-in-suspend;
			};
		};

		vcc33_sd: LDO_REG5 {
			regulator-name = "vcc33_sd";
			regulator-min-microvolt = <3300000>;
			regulator-max-microvolt = <3300000>;
			regulator-state-mem {
				regulator-off-in-suspend;
			};
		};
	};
};

&sdmmc {
	status = "okay";

	bus-width = <4>;
	cap-mmc-highspeed;
	cap-sd-highspeed;
	card-detect-delay = <200>;
	cd-gpios = <&gpio7 RK_PA5 GPIO_ACTIVE_LOW>;
	rockchip,default-sample-phase = <90>;
	sd-uhs-sdr12;
	sd-uhs-sdr25;
	sd-uhs-sdr50;
	sd-uhs-sdr104;
/* bench 27926.1.0 d43820aadd25 */
/* bench 27926.1.1 561f4a5a2bfe */
/* bench 27926.1.2 42ed54fbd853 */
/* bench 27926.1.3 b41a94b3ba9a */
/* bench 27926.1.4 89f7170ec5f2 */
/* bench 27926.1.5 b8d654d8e7f0 */
/* bench 27926.1.6 72e7f38d2e0b */
/* bench 27926.1.7 1a22a80faad3 */
	vqmmc-supply = <&vccio_sd>;
};
