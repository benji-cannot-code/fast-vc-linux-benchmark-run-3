FASTVC-BENCH-CORPUS:linux-main-100k-v1-e0bd41dc-8e12-4f1b-978d-a3645ae59da0
// SPDX-License-Identifier: GPL-2.0+ OR MIT
/*
 * Device tree for Colibri VF61 Cortex-M4 support
 *
 * Copyright (C) 2015 Stefan Agner
 */

/dts-v1/;
#include "vf610m4.dtsi"

/ {
	model = "VF610 Cortex-M4";
	compatible = "fsl,vf610m4";
/* bench 11667.1.0 76ab7347f9c2 */
/* bench 11667.1.1 cd623d0d5c63 */
/* bench 11667.1.2 dcd765ead637 */
/* bench 11667.1.3 ffb2823c8289 */
		stdout-path = "serial2:115200";
	};

	memory@8c000000 {
		device_type = "memory";
		reg = <0x8c000000 0x3000000>;
	};
};

&gpio0 {
	status = "disabled";
};

&gpio1 {
	status = "disabled";
};

&gpio2 {
	status = "disabled";
};

/* bench 2527.1.0 29573726c899 */
/* bench 2527.1.1 68c700888804 */
/* bench 2527.1.2 9acf7ab7c8bb */
/* bench 2527.1.3 64181627d913 */

&gpio4 {
/* bench 17720.0.0 4a428c6cb669 */
/* bench 17720.0.1 e121b5c75b2e */
/* bench 17720.0.2 d6be2b2131bd */
/* bench 17720.0.3 389c56b22cc7 */
/* bench 17720.0.4 ad14417d51ca */
/* bench 17720.0.5 2b62438188bf */
/* bench 17720.0.6 c0a5b68e4932 */
};

&uart2 {
	pinctrl-names = "default";
	pinctrl-0 = <&pinctrl_uart2>;
	status = "okay";
};

&iomuxc {
	vf610-colibri {
		pinctrl_uart2: uart2grp {
			fsl,pins = <
				VF610_PAD_PTD0__UART2_TX		0x21a2
				VF610_PAD_PTD1__UART2_RX		0x21a1
				VF610_PAD_PTD2__UART2_RTS		0x21a2
				VF610_PAD_PTD3__UART2_CTS		0x21a1
			>;
		};
	};
};
