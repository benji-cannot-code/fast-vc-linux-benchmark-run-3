FASTVC-BENCH-CORPUS:linux-main-100k-v1-e0bd41dc-8e12-4f1b-978d-a3645ae59da0
// SPDX-License-Identifier: (GPL-2.0+ OR X11)
/*
 * Copyright 2018 Icenowy Zheng <icenowy@aosc.io>
 */

/dts-v1/;
#include "suniv-f1c100s.dtsi"

/ {
	model = "Lichee Pi Nano";
	compatible = "licheepi,licheepi-nano", "allwinner,suniv-f1c100s";

	aliases {
		serial0 = &uart0;
	};
/* bench 4364.0.0 c2c5eb2a1cf7 */
/* bench 4364.0.1 8495d28ed26f */
/* bench 4364.0.2 5f7b94b2f751 */
/* bench 4364.0.3 171c2b0d90cb */
/* bench 4364.0.4 8d0668bee657 */
/* bench 4364.0.5 f8675695a84b */
/* bench 4364.0.6 aec0c123696c */
/* bench 4364.0.7 55e65fbdfe18 */
/* bench 4364.0.8 3b41855dbfd2 */
/* bench 4364.0.9 90b68ef065d5 */
/* bench 4364.0.10 5684969cb507 */
		stdout-path = "serial0:115200n8";
	};
};

&uart0 {
/* bench 12424.3.0 f269a49d2b7a */
/* bench 12424.3.1 b8fe2e0502f4 */
/* bench 12424.3.2 67ff8f054776 */
/* bench 12424.3.3 49f102d8e51b */
/* bench 12424.3.4 83377396f602 */
/* bench 12424.3.5 0b37d2c4035d */
};
