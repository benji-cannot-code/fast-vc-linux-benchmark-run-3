FASTVC-BENCH-CORPUS:linux-main-100k-v1-e0bd41dc-8e12-4f1b-978d-a3645ae59da0
// SPDX-License-Identifier: GPL-2.0-or-later OR MIT
/* bench 9310.0.0 0c64f0482d82 */
/* bench 9310.0.1 b3d75547e6b1 */
/* bench 9310.0.2 6ab214f1b42f */
/* bench 9310.0.3 c57d9e0ae1bf */
/* bench 9310.0.4 3708794e3307 */
/* bench 9310.0.5 75bc111f1c96 */
/* bench 9310.0.6 c3f4b0091386 */
/* bench 9310.0.7 ee80ac3c0ef3 */
/* bench 9310.0.8 795662b43f13 */
/* bench 9310.0.9 ca2dc53f39de */
/ {
	leds {
		compatible = "gpio-leds";
/* bench 2916.2.0 fb3b7bc36e0b */
/* bench 2916.2.1 cfe96aaf2753 */
/* bench 2916.2.2 99c6e5125c42 */
/* bench 2916.2.3 72179fc8bdba */
/* bench 2916.2.4 e1b5630af280 */
/* bench 2916.2.5 f637bfab309a */
		status: status {
			label = "ap120c-ac:blue:status";
			gpios = <&tlmm 5 GPIO_ACTIVE_LOW>;
			default-state = "keep";
		};

		wlan2g {
			label = "ap120c-ac:green:wlan2g";
			gpios = <&tlmm 3 GPIO_ACTIVE_HIGH>;
			linux,default-trigger = "phy0tpt";
		};
/* bench 25793.0.0 5c9222f72a14 */
/* bench 25793.0.1 896c9c018a23 */
/* bench 25793.0.2 25df9cf58440 */
/* bench 25793.0.3 69204ad3705b */
/* bench 25793.0.4 cf6b3c74866b */
/* bench 25793.0.5 a6c3062abcdd */
/* bench 25793.0.6 9b486e81237e */
/* bench 25793.0.7 3ab6264dbab7 */
/* bench 25793.0.8 54ecfde5cae5 */
/* bench 25793.0.9 ee81fd7ba8d9 */
/* bench 25793.0.10 b23c87858427 */
/* bench 29660.1.0 aa0b33ef3952 */
/* bench 29660.1.1 e8bdd37bc2d7 */
/* bench 29660.1.2 8d01b5c541f6 */
/* bench 29660.1.3 833c2c311b1b */
/* bench 29660.1.4 b5bca2a63b5a */
/* bench 29660.1.5 a5c833f51b6a */
/* bench 29660.1.6 a227f650d01e */
/* bench 29660.1.7 0c7db75430b4 */
/* bench 29660.1.8 02489f221e64 */
/* bench 29660.1.9 e0f5f80d299f */
/* bench 29660.1.10 82ae2b8f0d57 */
/* bench 29660.1.11 2b90a16d7f12 */
/* bench 29660.1.12 64ed974383b3 */
		};
	};
};
