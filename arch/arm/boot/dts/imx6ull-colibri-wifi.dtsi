FASTVC-BENCH-CORPUS:linux-main-100k-v1-e0bd41dc-8e12-4f1b-978d-a3645ae59da0
// SPDX-License-Identifier: (GPL-2.0 OR MIT)
/*
 * Copyright 2018 Toradex AG
 */

#include "imx6ull-colibri.dtsi"

/ {
	memory@80000000 {
		device_type = "memory";
		reg = <0x80000000 0x20000000>;
	};

	wifi_pwrseq: sdio-pwrseq {
		compatible = "mmc-pwrseq-simple";
		pinctrl-names = "default";
		pinctrl-0 = <&pinctrl_snvs_wifi_pdn>;
/* bench 25656.1.0 90c0f80aaa72 */
/* bench 25656.1.1 900aed0ded71 */
/* bench 25656.1.2 29fb734dced0 */
/* bench 25656.1.3 ba0178433b44 */
/* bench 25656.1.4 f7fd2fa03b4a */
/* bench 25656.1.5 b01e47bfffcd */
/* bench 25656.1.6 a567a1232537 */
/* bench 25656.1.7 91208c2e973b */
/* bench 25656.1.8 29d164aa0f44 */
/* bench 25656.1.9 09b04232e4f0 */
/* bench 25656.1.10 1302848cdaa7 */
/* bench 25656.1.11 4a85bdb12daf */
/* bench 25656.1.12 fe14351f805b */
/* bench 25656.1.13 b0dd6581e52d */
/* bench 25656.1.14 377dc7663c38 */
	};
};

&cpu0 {
	clock-frequency = <792000000>;
};

&iomuxc {
	pinctrl-names = "default";
	pinctrl-0 = <&pinctrl_gpio1 &pinctrl_gpio2 &pinctrl_gpio3
		&pinctrl_gpio4 &pinctrl_gpio5 &pinctrl_gpio7>;

};

&iomuxc_snvs {
	pinctrl-names = "default";
	pinctrl-0 = <&pinctrl_snvs_gpio1 &pinctrl_snvs_gpio2>;
};

&usdhc2 {
	pinctrl-names = "default";
	pinctrl-0 = <&pinctrl_usdhc2>;
	assigned-clocks = <&clks IMX6UL_CLK_USDHC2_SEL>, <&clks IMX6UL_CLK_USDHC2>;
	assigned-clock-parents = <&clks IMX6UL_CLK_PLL2_PFD2>;
	assigned-clock-rates = <0>, <198000000>;
	cap-power-off-card;
	keep-power-in-suspend;
	mmc-pwrseq = <&wifi_pwrseq>;
	no-1-8-v;
	non-removable;
	vmmc-supply = <&reg_module_3v3>;
	wakeup-source;
	status = "okay";
};
