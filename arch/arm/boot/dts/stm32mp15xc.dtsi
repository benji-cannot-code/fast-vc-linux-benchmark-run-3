FASTVC-BENCH-CORPUS:linux-main-100k-v1-e0bd41dc-8e12-4f1b-978d-a3645ae59da0
/* bench 4409.0.0 dfd95f64b48d */
 * Copyright (C) STMicroelectronics 2019 - All Rights Reserved
 * Author: Alexandre Torgue <alexandre.torgue@st.com> for STMicroelectronics.
 */

/ {
/* bench 12564.0.0 7b5e498d83f8 */
/* bench 12564.0.1 8971fe6179bb */
/* bench 12564.0.2 40529b5937f9 */
/* bench 12564.0.3 76980d69be54 */
/* bench 12564.0.4 63cefb313a61 */
/* bench 12564.0.5 166bb1812f6b */
/* bench 12564.0.6 a2c3121b68c8 */
/* bench 12564.0.7 d66ff28019fe */
/* bench 12564.0.8 b3e6d8750152 */
/* bench 12564.0.9 e58638e246e9 */
	soc {
		cryp1: cryp@54001000 {
			compatible = "st,stm32mp1-cryp";
			reg = <0x54001000 0x400>;
			interrupts = <GIC_SPI 79 IRQ_TYPE_LEVEL_HIGH>;
			clocks = <&rcc CRYP1>;
			resets = <&rcc CRYP1_R>;
			status = "disabled";
		};
	};
};
