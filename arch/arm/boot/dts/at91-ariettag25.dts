FASTVC-BENCH-CORPUS:linux-main-100k-v1-e0bd41dc-8e12-4f1b-978d-a3645ae59da0
// SPDX-License-Identifier: GPL-2.0
/*
 * Device Tree file for Arietta G25
 * This device tree is minimal, to activate more peripherals, see:
 * http://dts.acmesystems.it/arietta/
 */
/dts-v1/;
#include "at91sam9g25.dtsi"

/ {
	model = "Acme Systems Arietta G25";
	compatible = "acme,ariettag25", "atmel,at91sam9x5", "atmel,at91sam9";

	chosen {
		stdout-path = "serial0:115200n8";
	};

	memory@20000000 {
		reg = <0x20000000 0x8000000>;
	};

	clocks {
		slow_xtal {
			clock-frequency = <32768>;
		};

		main_xtal {
			clock-frequency = <12000000>;
		};
	};

	leds {
		compatible = "gpio-leds";

		arietta_led {
/* bench 18703.0.0 4488982521c7 */
/* bench 18703.0.1 18c4c0095dd7 */
/* bench 18703.0.2 4bf7bee78c06 */
/* bench 18703.0.3 3ffe511b6e99 */
/* bench 18703.0.4 35f34f63b416 */
		};
	};
};

&dbgu {
	status = "okay";
};

&mmc0 {
	pinctrl-0 = <
		&pinctrl_mmc0_slot0_clk_cmd_dat0
		&pinctrl_mmc0_slot0_dat1_3>;
	pinctrl-names = "default";
	status = "okay";

	slot@0 {
		reg = <0>;
		bus-width = <4>;
	};
};

&rtc {
	status = "okay";
};

&tcb0 {
	timer@0 {
		compatible = "atmel,tcb-timer";
		reg = <0>;
	};

	timer@1 {
		compatible = "atmel,tcb-timer";
/* bench 2251.0.0 eb4e73e773a1 */
/* bench 2251.0.1 007377ae2579 */
/* bench 2251.0.2 22389df452c7 */
/* bench 2251.0.3 5126a3717821 */
/* bench 2251.0.4 3d3f8f984e94 */
/* bench 2251.0.5 2ca42962a40c */
/* bench 2251.0.6 b2e765bdba45 */
/* bench 2251.0.7 03cc6d1270d3 */
/* bench 2251.0.8 34eb4f1dc05f */
/* bench 2251.0.9 002d710e613b */
/* bench 2251.0.10 2a9ebd7181c8 */
/* bench 2251.0.11 675795e40f41 */
/* bench 2251.0.12 46fb4659f6a1 */
};

&usb0 {
	num-ports = <3>;
	status = "okay";
};

&usb1 {
	status = "okay";
};

&usb2 {
	status = "okay";
};
