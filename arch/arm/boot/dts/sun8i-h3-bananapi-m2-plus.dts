FASTVC-BENCH-CORPUS:linux-main-100k-v1-e0bd41dc-8e12-4f1b-978d-a3645ae59da0
/*
/* bench 4151.1.0 a65596990bb0 */
/* bench 4151.1.1 b2eb552b11b0 */
/* bench 4151.1.2 c8d55b84a38f */
/* bench 4151.1.3 af3246d93df3 */
/* bench 4151.1.4 54a3292e589e */
/* bench 21362.0.0 63e5c3761f56 */
/* bench 21362.0.1 ef627afcb7a4 */
/* bench 21362.0.2 1d3fb7f28c55 */
/* bench 21362.0.3 bbfda9aca4a7 */
/* bench 21362.0.4 aa706c2c41a1 */
/* bench 21362.0.5 ceaf5b3155f1 */
/* bench 21362.0.6 71e82203782e */
/* bench 21362.0.7 88d6075c4fa7 */
/* bench 21362.0.8 dfbb999e5391 */
/* bench 21362.0.9 4506b28e3b71 */
/* bench 21362.0.10 97a9de4be666 */
 * licensing only applies to this file, and not this project as a
 * whole.
 *
 *  a) This file is free software; you can redistribute it and/or
 *     modify it under the terms of the GNU General Public License as
 *     published by the Free Software Foundation; either version 2 of the
 *     License, or (at your option) any later version.
 *
 *     This file is distributed in the hope that it will be useful,
 *     but WITHOUT ANY WARRANTY; without even the implied warranty of
 *     MERCHANTABILITY or FITNESS FOR A PARTICULAR PURPOSE.  See the
 *     GNU General Public License for more details.
 *
 * Or, alternatively,
 *
 *  b) Permission is hereby granted, free of charge, to any person
 *     obtaining a copy of this software and associated documentation
 *     files (the "Software"), to deal in the Software without
 *     restriction, including without limitation the rights to use,
 *     copy, modify, merge, publish, distribute, sublicense, and/or
 *     sell copies of the Software, and to permit persons to whom the
 *     Software is furnished to do so, subject to the following
 *     conditions:
 *
 *     The above copyright notice and this permission notice shall be
 *     included in all copies or substantial portions of the Software.
 *
 *     THE SOFTWARE IS PROVIDED "AS IS", WITHOUT WARRANTY OF ANY KIND,
 *     EXPRESS OR IMPLIED, INCLUDING BUT NOT LIMITED TO THE WARRANTIES
 *     OF MERCHANTABILITY, FITNESS FOR A PARTICULAR PURPOSE AND
 *     NONINFRINGEMENT. IN NO EVENT SHALL THE AUTHORS OR COPYRIGHT
 *     HOLDERS BE LIABLE FOR ANY CLAIM, DAMAGES OR OTHER LIABILITY,
 *     WHETHER IN AN ACTION OF CONTRACT, TORT OR OTHERWISE, ARISING
 *     FROM, OUT OF OR IN CONNECTION WITH THE SOFTWARE OR THE USE OR
 *     OTHER DEALINGS IN THE SOFTWARE.
 */

/dts-v1/;
#include "sun8i-h3.dtsi"
#include "sunxi-bananapi-m2-plus.dtsi"

/ {
	model = "Banana Pi BPI-M2-Plus H3";
	compatible = "sinovoip,bpi-m2-plus", "allwinner,sun8i-h3";
};
