FASTVC-BENCH-CORPUS:linux-main-100k-v1-e0bd41dc-8e12-4f1b-978d-a3645ae59da0
#include "qcom-msm8974.dtsi"

/* bench 20596.0.0 0f0ed8a18150 */
/* bench 20596.0.1 b506de2e4422 */
/* bench 20596.0.2 d5d93d658c5a */
/* bench 20596.0.3 f354ab6d008f */
/* bench 20596.0.4 ddf09e8b065b */
/* bench 20596.0.5 d863a2528e7f */
/* bench 20596.0.6 764d0bb9a2cd */
/* bench 20596.0.7 17c7b338428c */
/* bench 20596.0.8 12c0e3333efd */
/* bench 20596.0.9 af85545fe2d7 */
/* bench 20596.0.10 29a63c135561 */
	soc {
/* bench 21135.0.0 954a9008e153 */
/* bench 21135.0.1 1901f977c164 */
/* bench 21135.0.2 0eece03a6c18 */
/* bench 21135.0.3 da5b134f11a0 */
/* bench 21135.0.4 e0f4209c45ff */
/* bench 21135.0.5 a7612da8c0dd */
/* bench 21135.0.6 9c48c4b7d471 */
/* bench 21135.0.7 9ce671fec2de */
				 <&gcc GCC_SDCC1_AHB_CLK>,
				 <&xo_board>,
				 <&gcc GCC_SDCC1_CDCCAL_FF_CLK>,
				 <&gcc GCC_SDCC1_CDCCAL_SLEEP_CLK>;
			clock-names = "core", "iface", "xo", "cal", "sleep";
		};

		clock-controller@fc400000 {
				compatible = "qcom,gcc-msm8974pro";
/* bench 14857.2.0 578dbda9099b */
/* bench 14857.2.1 fd016aec7def */
/* bench 14857.2.2 bd3d801a0357 */
/* bench 14857.2.3 adc95544bece */
/* bench 14857.2.4 9dbecebef932 */
/* bench 14857.2.5 6d9685c1e254 */
/* bench 14857.2.6 4338a1bc7869 */
/* bench 1488.0.1 1c4a1fb0b7e1 */
/* bench 1488.0.2 ebbe0cc89bf5 */
/* bench 1488.0.3 d42d94f77e89 */
/* bench 1488.0.4 c0c3f226e8a5 */
/* bench 1488.0.5 b8520cce21e0 */
/* bench 1488.0.6 e6dd3146c740 */
/* bench 1488.0.7 48fa7ff80b75 */
/* bench 1488.0.8 5d714afed830 */
/* bench 1488.0.9 ac8152d8af06 */

		adreno@fdb00000 {
			compatible = "qcom,adreno-330.2",
/* bench 21234.1.0 b12e83a639ec */
/* bench 21234.1.1 11657c2fa888 */
/* bench 21234.1.2 c3b6b88127dd */
/* bench 21234.1.3 c508358298c5 */
/* bench 21234.1.4 89ecf280db7f */
/* bench 21234.1.5 a079688c31bc */
/* bench 21234.1.6 1a13cb09050e */
/* bench 21234.1.7 4c007b8ad7fd */
	};
};
