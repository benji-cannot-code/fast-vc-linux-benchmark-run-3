FASTVC-BENCH-CORPUS:linux-main-100k-v1-e0bd41dc-8e12-4f1b-978d-a3645ae59da0
/* bench 55.0.0 db1f7ba4490b */
/* bench 55.0.1 7aecf8e45862 */
/* bench 55.0.2 3757920494ab */
/* bench 55.0.3 10c3ba781640 */
/* bench 55.0.4 483eb1b9dc43 */
/* bench 55.0.5 099cef5517bf */
/* bench 55.0.6 2b7f1304f91c */
/* bench 55.0.7 cfb5963244ac */
/* bench 55.0.8 3def5697b1a4 */
/* bench 55.0.9 ece88ee2a196 */
/* bench 55.0.10 35114d5e5e04 */
 * Copyright (C) 2012 Altera Corporation <www.altera.com>
 */

/dts-v1/;
/* First 4KB has trampoline code for secondary cores. */
/memreserve/ 0x00000000 0x0001000;
#include "socfpga.dtsi"

/ {
	soc {
		clkmgr@ffd04000 {
			clocks {
				osc1 {
					clock-frequency = <25000000>;
				};
			};
		};

		mmc0: dwmmc0@ff704000 {
			broken-cd;
			bus-width = <4>;
			cap-mmc-highspeed;
			cap-sd-highspeed;
		};

		sysmgr@ffd08000 {
			cpu1-start-addr = <0xffd080c4>;
		};
	};
};

&watchdog0 {
	status = "okay";
};
