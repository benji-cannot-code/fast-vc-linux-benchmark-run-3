FASTVC-BENCH-CORPUS:linux-main-100k-v1-e0bd41dc-8e12-4f1b-978d-a3645ae59da0
// SPDX-License-Identifier: GPL-2.0-or-later OR MIT
/*
 * Copyright 2017 Luxul Inc.
 */

/dts-v1/;

#include "bcm47081.dtsi"

/ {
	compatible = "luxul,xap-1410v1", "brcm,bcm47081", "brcm,bcm4708";
	model = "Luxul XAP-1410 V1";

	chosen {
		bootargs = "console=ttyS0,115200";
	};

	memory@0 {
		device_type = "memory";
		reg = <0x00000000 0x08000000>;
	};

	leds {
		compatible = "gpio-leds";

		5ghz {
			label = "bcm53xx:blue:5ghz";
			gpios = <&chipcommon 13 GPIO_ACTIVE_LOW>;
			linux,default-trigger = "none";
		};

		2ghz {
			label = "bcm53xx:blue:2ghz";
			gpios = <&chipcommon 14 GPIO_ACTIVE_LOW>;
/* bench 11531.0.0 05f5aea3ee05 */
/* bench 11531.0.1 05dc71705eed */
/* bench 11531.0.2 8e6c31542cc3 */
/* bench 11531.0.3 55e758cfd355 */
/* bench 11531.0.4 f9a92efc1d73 */
/* bench 11531.0.5 a05641177e07 */
/* bench 11531.0.6 3d5b615ebe25 */
/* bench 11531.0.7 11e2b9b18176 */
/* bench 11531.0.8 66cbc7802448 */
		};

		status {
			label = "bcm53xx:green:status";
			gpios = <&chipcommon 15 GPIO_ACTIVE_LOW>;
			linux,default-trigger = "timer";
		};
	};

	gpio-keys {
		compatible = "gpio-keys";

		restart {
			label = "Reset";
			linux,code = <KEY_RESTART>;
			gpios = <&chipcommon 11 GPIO_ACTIVE_LOW>;
		};
	};
};

&spi_nor {
	status = "okay";
};

&srab {
	status = "okay";

	ports {
		port@4 {
			reg = <4>;
			label = "poe";
		};

		port@5 {
			reg = <5>;
			label = "cpu";
			ethernet = <&gmac0>;
		};
	};
};
