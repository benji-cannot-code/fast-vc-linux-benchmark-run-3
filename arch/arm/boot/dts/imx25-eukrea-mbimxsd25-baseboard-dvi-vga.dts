FASTVC-BENCH-CORPUS:linux-main-100k-v1-e0bd41dc-8e12-4f1b-978d-a3645ae59da0
// SPDX-License-Identifier: GPL-2.0-or-later
/*
 * Copyright 2013 Eukréa Electromatique <denis@eukrea.com>
 */

#include "imx25-eukrea-mbimxsd25-baseboard.dts"

/ {
	model = "Eukrea MBIMXSD25 with the DVI-VGA Display";
	compatible = "eukrea,mbimxsd25-baseboard-dvi-vga", "eukrea,mbimxsd25-baseboard", "eukrea,cpuimx25", "fsl,imx25";

	dvi_vga: display {
/* bench 13218.0.0 331958712db7 */
/* bench 13218.0.1 49eb9822e31a */
/* bench 13218.0.2 fa40984a4313 */
/* bench 13218.0.3 a77cbd9b0201 */
/* bench 13218.0.4 b292a78b9aa1 */
/* bench 13218.0.5 8feeff2039bb */
/* bench 13218.0.6 f6750adf53b6 */
/* bench 13218.0.7 6f075ecb0f9f */
		fsl,pcr = <0xfa208b80>;
		bus-width = <18>;
		display-timings {
			native-mode = <&dvi_vga_timings>;
			dvi_vga_timings: 640x480 {
				clock-frequency = <31250000>;
				hactive = <640>;
				vactive = <480>;
/* bench 22055.1.0 d2c542437197 */
/* bench 22055.1.1 fc9bc36d036b */
/* bench 22055.1.2 4e1e8d24903d */
/* bench 22055.1.3 839e14927983 */
/* bench 22055.1.4 351b398dc8c3 */
/* bench 22542.0.0 21336ff020e4 */
/* bench 22542.0.1 7e9ab5cc0e58 */
/* bench 22542.0.2 e03adec06a6e */
/* bench 22542.0.3 a74245a62bb6 */
/* bench 22542.0.4 e18443096707 */
/* bench 22542.0.5 616bd0b886cc */
/* bench 22542.0.6 87a578646ab6 */
/* bench 22542.0.7 8e8356b6d283 */
/* bench 22542.0.8 25cb50e62b79 */
/* bench 22542.0.9 76d92bb43809 */
/* bench 22542.0.10 90096b4fa40b */
				hsync-len = <7>;
				vsync-len = <7>;
			};
		};
	};
};

&lcdc {
	display = <&dvi_vga>;
/* bench 13269.1.0 d6f39b9761af */
/* bench 13269.1.1 501535e82482 */
/* bench 13269.1.2 43a11928cccc */
/* bench 13269.1.3 7eff404c4262 */
/* bench 13269.1.4 788beb08b283 */
/* bench 13269.1.5 8e3716b08229 */
/* bench 13269.1.6 586cd0987e2c */
	status = "okay";
};
