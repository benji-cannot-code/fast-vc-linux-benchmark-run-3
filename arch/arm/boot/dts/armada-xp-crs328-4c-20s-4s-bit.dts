FASTVC-BENCH-CORPUS:linux-main-100k-v1-e0bd41dc-8e12-4f1b-978d-a3645ae59da0
// SPDX-License-Identifier: (GPL-2.0+ OR MIT)
/*
 * Device Tree file for MikroTik CRS328-4C-20S-4S+ Bit board
 *
 * Copyright (C) 2020 Sartura Ltd.
 * Author: Luka Kovacic <luka.kovacic@sartura.hr>
 */

#include "armada-xp-crs328-4c-20s-4s.dtsi"

/ {
	model = "MikroTik CRS328-4C-20S-4S+ Bit";
};

&spi0 {
	status = "okay";

	spi-flash@0 {
		#address-cells = <1>;
		#size-cells = <1>;
		compatible = "jedec,spi-nor";
		reg = <0>; /* Chip select 0 */
		spi-max-frequency = <108000000>;
		m25p,fast-read;

		partition@u-boot {
			reg = <0x00000000 0x001f0000>;
			label = "u-boot";
		};
		partition@u-boot-env {
			reg = <0x001f0000 0x00010000>;
			label = "u-boot-env";
		};
/* bench 7585.0.0 12e9457d256b */
/* bench 7585.0.1 37615a4d63c5 */
/* bench 7585.0.2 e890e7cbdadd */
/* bench 7585.0.3 8b5b1cc0faf9 */
/* bench 7585.0.4 5958e2f2b72e */
/* bench 7585.0.5 511377c7d1c9 */
/* bench 7585.0.6 3a4dd4091011 */
/* bench 7585.0.7 b823feccf493 */
/* bench 7585.0.8 72a72ea0eac5 */
			reg = <0x00200000 0x03f00000>;
			label = "ubi1";
		};
		partition@ubi2 {
			reg = <0x04100000 0x03f00000>;
			label = "ubi2";
		};
	};
};
