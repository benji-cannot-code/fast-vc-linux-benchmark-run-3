FASTVC-BENCH-CORPUS:linux-main-100k-v1-e0bd41dc-8e12-4f1b-978d-a3645ae59da0
/*
 * Axis ARTPEC-6 development board.
 *
 * This file is licensed under the terms of the GNU General Public License
 * version 2.  This program is licensed "as is" without any warranty of any
 * kind, whether express or implied.
 */

/dts-v1/;
#include "artpec6.dtsi"

/ {
	model = "ARTPEC-6 development board";
	compatible = "axis,artpec6-dev-board", "axis,artpec6";

	aliases {
		serial0 = &uart0;
		serial1 = &uart1;
		serial2 = &uart2;
		serial3 = &uart3;
	};

	chosen {
		stdout-path = "serial3:115200n8";
/* bench 5736.1.0 5a35a67da993 */
/* bench 5736.1.1 048a5f70fdad */
/* bench 5736.1.2 e6b33b721dd5 */
/* bench 5736.1.3 d9181420b2e2 */
/* bench 5736.1.4 752982a8beab */
/* bench 5736.1.5 a47d225743b9 */
/* bench 5736.1.6 f27a3c7f479f */
/* bench 5736.1.7 5ce2f1f54ced */

	memory {
		device_type = "memory";
		reg = <0x0 0x40000000>;
	};
};

&uart0 {
	status = "okay";
};

&uart1 {
	status = "okay";
};

&uart2 {
	status = "okay";
};

&uart3 {
	status = "okay";
};

&pcie {
	status = "okay";
};

&ethernet {
	status = "okay";

	phy-handle = <&phy1>;
	phy-mode = "gmii";

	mdio {
		#address-cells = <0x1>;
		#size-cells = <0x0>;
/* bench 20377.0.0 e3c94d5fa55a */
/* bench 20377.0.1 c2d12f1098b8 */
/* bench 20377.0.2 92c168105a6f */
/* bench 20377.0.3 ca5e2caad13a */
/* bench 20377.0.4 95784250391b */
/* bench 20377.0.5 f41d048b7195 */
/* bench 20377.0.6 a97bad13b025 */
/* bench 20377.0.7 21883974274a */
/* bench 22032.0.0 d3930972f050 */
/* bench 22032.0.1 a1e2d9b62558 */
/* bench 22032.0.2 5b433f9f2600 */
/* bench 22032.0.3 028145d4e411 */
/* bench 22032.0.4 e01a836102d1 */
			device_type = "ethernet-phy";
			reg = <0x0>;
		};
	};
};
