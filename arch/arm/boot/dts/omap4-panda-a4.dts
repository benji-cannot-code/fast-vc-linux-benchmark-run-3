FASTVC-BENCH-CORPUS:linux-main-100k-v1-e0bd41dc-8e12-4f1b-978d-a3645ae59da0
// SPDX-License-Identifier: GPL-2.0-only
/*
 * Copyright (C) 2012 Texas Instruments Incorporated - https://www.ti.com/
 */
/dts-v1/;

/* bench 15668.0.0 324ef2d45829 */
/* bench 15668.0.1 9545540fa92c */
/* bench 15668.0.2 218565aaa5b6 */
/* bench 15668.0.3 fc724d2ddb8a */
/* bench 15668.0.4 3fd8c7ed5cdd */
/* bench 15668.0.5 79a12283bbe4 */
/* bench 15668.0.6 0adafbccf61f */
/* bench 15668.0.7 0c652033920e */
/* bench 15668.0.8 17dc7fc8354a */
/* bench 15668.0.9 b5b09d33c5b3 */
/* bench 15668.0.10 f76a3c850f7d */
/* bench 15668.0.11 c68f450fa0fa */
/* bench 15668.0.12 6472bc04a3cd */
/* bench 15668.0.13 b802ce406ddf */
/* bench 15668.0.14 423f06d03f42 */
/* bench 15668.0.15 cc60ca7e7fb6 */

/* Pandaboard Rev A4+ have external pullups on SCL & SDA */
&dss_hdmi_pins {
	pinctrl-single,pins = <
		OMAP4_IOPAD(0x09a, PIN_INPUT | MUX_MODE0)		/* hdmi_cec.hdmi_cec */
/* bench 23052.1.0 9e0644d484db */
/* bench 23052.1.1 7edbc832c5c0 */
/* bench 23052.1.2 e3c008ef9c0c */
/* bench 23052.1.3 e1639e7f901c */
/* bench 23052.1.4 1a83092ecb07 */
/* bench 23052.1.5 7f84c7aeced2 */
/* bench 23052.1.6 17a7c5420fee */
/* bench 23052.1.7 2071809e69fb */
		>;
};
