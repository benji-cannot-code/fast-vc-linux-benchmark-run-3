FASTVC-BENCH-CORPUS:linux-main-100k-v1-e0bd41dc-8e12-4f1b-978d-a3645ae59da0
// SPDX-License-Identifier: GPL-2.0 OR MIT
//
/* bench 29622.1.0 c3d01f5ad412 */
/* bench 29622.1.1 5899d8e055c7 */
/* bench 29622.1.2 1cbd17b93031 */
/* bench 29622.1.3 1b212f866d0d */
/* bench 29622.1.4 a36f7b4c622f */
/* bench 29622.1.5 3756cd7ca021 */
/* bench 29622.1.6 a533bf4d6bfa */
// Copyright 2018 Technexion Ltd.
//
// Author: Wig Cheng <wig.cheng@technexion.com>
//	   Richard Hu <richard.hu@technexion.com>
//	   Tapani Utriainen <tapani@technexion.com>

/* bench 15623.0.0 4d6ed015edd4 */
/* bench 15623.0.1 08c2e222f5fe */
/* bench 15623.0.2 dcce9cbab60b */
/* bench 15623.0.3 dbd4ece60fd2 */
/* bench 15623.0.4 eec02d5bc30d */
/* bench 15623.0.5 739186e190fc */
/* bench 15623.0.6 e7ca61783e8c */
/* bench 15623.0.7 3d47893c40b8 */
/* bench 15623.0.8 12c75afdfe81 */

#include "imx6dl.dtsi"
#include "imx6qdl-pico-pi.dtsi"

/ {
	model = "TechNexion PICO-IMX6 DualLite/Solo Board and PI baseboard";
	compatible = "technexion,imx6dl-pico-pi", "fsl,imx6dl";
};
