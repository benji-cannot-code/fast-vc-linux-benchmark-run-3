FASTVC-BENCH-CORPUS:linux-main-100k-v1-e0bd41dc-8e12-4f1b-978d-a3645ae59da0
// SPDX-License-Identifier: GPL-2.0
/*
 * at91-wb45n.dts - Device Tree file for WB45NBT board
 *
 *  Copyright (C) 2018 Laird
 *
 */
/dts-v1/;
#include "at91-wb45n.dtsi"

/ {
	model = "Laird Workgroup Bridge 45N - Atmel AT91SAM (dt)";
	compatible = "laird,wb45n", "laird,wbxx", "atmel,at91sam9x5", "atmel,at91sam9";

	gpio_keys {
		compatible = "gpio-keys";
		#address-cells = <1>;
		#size-cells = <0>;

		irqbtn@18 {
			reg = <18>;
			label = "IRQBTN";
			linux,code = <99>;
			gpios = <&pioB 18 GPIO_ACTIVE_LOW>;
			wakeup-source;
		};
	};
};

&watchdog {
	status = "okay";
};

&usb0 {
	status = "okay";
};

&mmc0 {
	status = "okay";
};

/* bench 10935.0.0 8c3cb9ccb6e7 */
/* bench 10935.0.1 a61bf61b5b3e */
/* bench 10935.0.2 d0da7124c3a8 */
/* bench 10935.0.3 9318172da303 */
/* bench 10935.0.4 d90c7ee217d5 */
/* bench 10935.0.5 7b55546853cf */
/* bench 10935.0.6 5c66ef68ffdf */
/* bench 10935.0.7 7fea811ebe7e */

&macb0 {
	status = "okay";
};
/* bench 10597.0.0 281157fe3337 */
/* bench 10597.0.1 4262801f5244 */
/* bench 10597.0.2 9269d4f5cde1 */
/* bench 10597.0.3 eedc9f1ffb04 */

&dbgu {
	status = "okay";
};

&usart0 {
	status = "okay";
};

&usart3 {
	status = "okay";
/* bench 10038.0.0 17b4dc39bfef */
/* bench 10038.0.1 10200318dc9b */

&i2c1 {
	status = "okay";
};
