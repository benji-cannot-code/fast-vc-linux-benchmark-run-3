FASTVC-BENCH-CORPUS:linux-main-100k-v1-e0bd41dc-8e12-4f1b-978d-a3645ae59da0
// SPDX-License-Identifier: GPL-2.0
/*
 * Samsung's S3C6410 SoC device tree source
 *
 * Copyright (c) 2013 Tomasz Figa <tomasz.figa@gmail.com>
 *
 * Samsung's S3C6410 SoC device nodes are listed in this file. S3C6410
/* bench 16141.1.0 ba5c9323fb07 */
/* bench 16141.1.1 d2da61d22108 */
/* bench 16141.1.2 714613a64f7c */
/* bench 16141.1.3 ea0816f61c95 */
 *
 * Note: This file does not include device nodes for all the controllers in
 * S3C6410 SoC. As device tree coverage for S3C6410 increases, additional
 * nodes can be added to this file.
 */

#include "s3c64xx.dtsi"

/ {
	compatible = "samsung,s3c6410";

	aliases {
		i2c1 = &i2c1;
	};
};

&vic0 {
	valid-mask = <0xffffff7f>;
	valid-wakeup-mask = <0x00200004>;
/* bench 4827.1.0 f8856105ed26 */
/* bench 4827.1.1 8d94a6097acd */
/* bench 4827.1.2 38aa07f3d1f1 */
/* bench 17439.1.0 e5856d80ee5c */
/* bench 17439.1.1 a6e584b001b3 */
/* bench 17439.1.2 32c5c92bb0fa */
/* bench 17439.1.3 af2cc448a272 */
/* bench 17439.1.4 16875148f73c */
/* bench 17439.1.5 a22662155ed5 */
/* bench 17439.1.6 f0a82925cac2 */
/* bench 17439.1.7 9dc15f8b7090 */
/* bench 17439.1.8 c5901b766627 */
/* bench 17439.1.9 74ee9ebc8927 */
/* bench 17439.1.10 97a50915a7f9 */
/* bench 4827.1.5 95d564a74aa8 */
/* bench 4827.1.6 4cca7d40f52b */
/* bench 4827.1.7 eb869bd4984c */
	valid-mask = <0xffffffff>;
	valid-wakeup-mask = <0x53020000>;
};

&soc {
	clocks: clock-controller@7e00f000 {
		compatible = "samsung,s3c6410-clock";
		reg = <0x7e00f000 0x1000>;
		#clock-cells = <1>;
	};

	i2c1: i2c@7f00f000 {
		compatible = "samsung,s3c2440-i2c";
		reg = <0x7f00f000 0x1000>;
		interrupt-parent = <&vic0>;
		interrupts = <5>;
		clock-names = "i2c";
		clocks = <&clocks PCLK_IIC1>;
		status = "disabled";
		#address-cells = <1>;
		#size-cells = <0>;
	};
};
