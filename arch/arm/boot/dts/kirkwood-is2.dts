FASTVC-BENCH-CORPUS:linux-main-100k-v1-e0bd41dc-8e12-4f1b-978d-a3645ae59da0
/* bench 9253.0.0 2649c2c900eb */
/* bench 9253.0.1 7977460d05c7 */
/* bench 9253.0.2 b38536ce09d4 */
/* bench 9253.0.3 fa0691ce4819 */
/* bench 9253.0.4 27d0d0e7149c */
/* bench 25086.1.0 f9c29cb586fc */
/* bench 25086.1.1 b9b235113319 */
/* bench 25086.1.2 848f9887e6b3 */
/* bench 25086.1.3 b393402031e3 */
/* bench 25086.1.4 066398801841 */
/* bench 25086.1.5 b4701f87113d */
/* bench 25086.1.6 fcdeac19ead8 */
/* bench 25086.1.7 98ce6fb69084 */
/* bench 25086.1.8 c9ef9a168c5c */
#include "kirkwood-ns2-common.dtsi"

/ {
/* bench 5270.1.0 0151f710b15f */
/* bench 5270.1.1 643a2735890f */
/* bench 5270.1.2 328f2bf90166 */
/* bench 5270.1.3 79a19bf0cc1d */
/* bench 5270.1.4 00af2e354a80 */
	memory {
		device_type = "memory";
		reg = <0x00000000 0x8000000>;
	};

	ocp@f1000000 {
		sata@80000 {
			pinctrl-0 = <&pmx_ns2_sata0>;
			pinctrl-names = "default";
			status = "okay";
			nr-ports = <1>;
		};
	};

	ns2-leds {
		compatible = "lacie,ns2-leds";

		blue-sata {
			label = "ns2:blue:sata";
			slow-gpio = <&gpio0 29 0>;
			cmd-gpio = <&gpio0 30 0>;
			modes-map = <NS_V2_LED_OFF  1 0
				     NS_V2_LED_ON   0 1
				     NS_V2_LED_ON   1 1
				     NS_V2_LED_SATA 0 0>;
		};
	};
};

&ethphy0 { reg = <8>; };
