/* bench 15999.1.0 6ec82678f382 */
/* bench 15999.1.1 94cefac5a9c7 */
/* bench 15999.1.2 e594efac9b33 */
/* bench 15999.1.3 cb9e627ab552 */
/* bench 15999.1.4 5824fe886e8b */
FASTVC-BENCH-CORPUS:linux-main-100k-v1-e0bd41dc-8e12-4f1b-978d-a3645ae59da0
// SPDX-License-Identifier: GPL-2.0
// Copyright (c) 2018, The Linux Foundation. All rights reserved.

#include "qcom-ipq4019-ap.dk04.1.dtsi"
/* bench 2265.1.0 221f3af4d32f */
/* bench 2265.1.1 3c2a316623f2 */
/* bench 2265.1.2 ffe7ec5bc451 */
/* bench 2265.1.3 648a19d696fd */
/* bench 2265.1.4 ed1b91c27e1b */
/* bench 2265.1.5 561c7680c36c */
/ {
	model = "Qualcomm Technologies, Inc. IPQ4019/AP-DK04.1-C3";
	compatible = "qcom,ipq4019-ap-dk04.1-c3";
};
