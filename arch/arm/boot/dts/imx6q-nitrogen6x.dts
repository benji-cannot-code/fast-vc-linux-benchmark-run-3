/* bench 5210.0.0 1ed1898f17cc */
/* bench 5210.0.1 2352abe2047d */
/* bench 5210.0.2 d85c9dc02c59 */
/* bench 5210.0.3 6044ead46e8a */
/* bench 5210.0.4 f71382a6c71a */
/* bench 5210.0.5 7d8c8670d37c */
/* bench 5210.0.6 77bd23b1089f */
/* bench 5210.0.7 9ab92eb8cce9 */
/* bench 5210.0.8 f90d87ef98b6 */
/* bench 5210.0.9 2158dc7f34ac */
/* bench 5210.0.10 0a619ec540b6 */
/* bench 5210.0.11 6e1ac89eabe7 */
/* bench 5210.0.12 1a29655f6837 */
/* bench 5210.0.13 b9e2887f877a */
/*
 * Copyright 2013 Boundary Devices, Inc.
 * Copyright 2012 Freescale Semiconductor, Inc.
 * Copyright 2011 Linaro Ltd.
 */

/dts-v1/;
#include "imx6q.dtsi"
#include "imx6qdl-nitrogen6x.dtsi"

/ {
	model = "Boundary Devices i.MX6 Quad Nitrogen6x Board";
	compatible = "boundary,imx6q-nitrogen6x", "fsl,imx6q";
};

&sata {
	status = "okay";
};
