FASTVC-BENCH-CORPUS:linux-main-100k-v1-e0bd41dc-8e12-4f1b-978d-a3645ae59da0
/* bench 26645.0.0 a398b57c0353 */
/* bench 26645.0.1 4a5df6491348 */
/* bench 26645.0.2 d204e00b4b36 */
/* bench 26645.0.3 da7637ff623d */
/* bench 26645.0.4 4e6cdc8de658 */
/* bench 26645.0.5 ea70badf8426 */
/* bench 26645.0.6 4ee5f28b378d */
/* bench 26645.0.7 6ae6e3110686 */
/* bench 26645.0.8 7dfd7dd24ba9 */
/* bench 26645.0.9 5161917f915a */
/* bench 26645.0.10 26fbce2b8280 */
/*
 * Copyright 2013 Christian Hemp, Phytec Messtechnik GmbH
/* bench 20390.0.0 1d8db50a5744 */
/* bench 20390.0.1 cb9f6534349f */
/* bench 20390.0.2 d2e3732628b0 */
/* bench 20390.0.3 072d84132f0c */
/* bench 20390.0.4 766105c277bd */
/* bench 20390.0.5 e2ee0442140e */
/* bench 20390.0.6 0a818695f08e */
/* bench 20390.0.7 a58270b4b990 */
/* bench 20390.0.8 69b3a942925d */
/dts-v1/;
#include "imx6dl-phytec-pfla02.dtsi"
#include "imx6qdl-phytec-pbab01.dtsi"

/ {
	model = "Phytec phyFLEX-i.MX6 DualLite/Solo Carrier-Board";
	compatible = "phytec,imx6dl-pbab01", "phytec,imx6dl-pfla02", "fsl,imx6dl";
};
