FASTVC-BENCH-CORPUS:linux-main-100k-v1-e0bd41dc-8e12-4f1b-978d-a3645ae59da0
/dts-v1/;

/include/ "tegra114.dtsi"

/ {
	model = "NVIDIA Tegra114 Dalmore evaluation board";
	compatible = "nvidia,dalmore", "nvidia,tegra114";

	memory {
		reg = <0x80000000 0x40000000>;
	};

	serial@70006300 {
		status = "okay";
		clock-frequency = <408000000>;
	};

	pmc {
		nvidia,invert-interrupt;
	};
};
