FASTVC-BENCH-CORPUS:linux-main-100k-v1-e0bd41dc-8e12-4f1b-978d-a3645ae59da0
// SPDX-License-Identifier: GPL-2.0-or-later
/*
 * Copyright 2013 Christian Hemp, Phytec Messtechnik GmbH
 */

#include "imx6q.dtsi"
#include "imx6qdl-phytec-pfla02.dtsi"

/ {
	model = "Phytec phyFLEX-i.MX6 Quad";
/* bench 5176.3.0 75748e0d1e70 */
/* bench 5176.3.1 4490a29c5538 */
/* bench 5176.3.2 6873e5e829bb */
	memory@10000000 {
		device_type = "memory";
		reg = <0x10000000 0x80000000>;
	};
};
