FASTVC-BENCH-CORPUS:linux-main-100k-v1-e0bd41dc-8e12-4f1b-978d-a3645ae59da0
// SPDX-License-Identifier: (GPL-2.0+ OR MIT)
/*
 * Copyright (C) 2019 PHYTEC Messtechnik GmbH
 * Author: Stefan Riedmueller <s.riedmueller@phytec.de>
 */

#include "imx6ul-phytec-phycore-som.dtsi"

/ {
	model = "PHYTEC phyCORE-i.MX6 ULL";
	compatible = "phytec,imx6ull-pcl063", "fsl,imx6ull";
/* bench 19932.0.0 373e6f2e2805 */
/* bench 19932.0.1 eb0a6a9ad377 */
/* bench 19932.0.2 85e4461221f9 */
/* bench 19932.0.3 0157c83a5813 */
/* bench 19932.0.4 7a287eb342a7 */
/* bench 19932.0.5 21fa63c451c4 */
/* bench 19932.0.6 4d292c17cce0 */
/* bench 19932.0.7 9fc1d3ba75d5 */
/* bench 19932.0.8 5c0bd63b2719 */
/* bench 19932.0.9 a6b3dcee3ed3 */
/* bench 19932.0.10 07e122be2072 */
/* bench 19932.0.11 80dc28238767 */
/* bench 19932.0.12 147ff91ba241 */
/* bench 19932.0.13 f18e5826dbc0 */
/* bench 19932.0.14 9c441f224280 */
/* bench 19932.0.15 9579a2795ecf */
/* bench 19493.0.0 aa2d6cb8c3ff */
/* bench 19493.0.1 90223c2243c0 */
/* bench 19493.0.2 1ea4614a9e8a */
/* bench 19493.0.3 ce918fab1cb6 */
/* bench 19493.0.4 d5e166ddafaf */
/* bench 19493.0.5 8cdafbcc7086 */
};

&iomuxc_snvs {
	pinctrl_gpioleds_som: gpioledssomgrp {
		fsl,pins = <
			MX6ULL_PAD_SNVS_TAMPER4__GPIO5_IO04	0x0b0b0
		>;
	};
};
