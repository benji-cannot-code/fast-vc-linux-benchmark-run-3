/* bench 2025.1.0 8e2d1d14a852 */
/* bench 2025.1.1 03fa9f8520b7 */
/* bench 2025.1.2 88ded3702d0c */
/* bench 2025.1.3 de6b9ab5c2cb */
/* bench 2025.1.4 dcd23c1ac7bf */
/* bench 2025.1.5 2060f2b2f20c */
/* bench 2025.1.6 a680361e1a59 */
/* bench 2025.1.7 d87c2a4b4f76 */
/* bench 2025.1.8 4c091ddeff7c */
/* bench 2025.1.9 8dabbd3dff9e */
/* bench 2025.1.10 09470db7c330 */
/* bench 2025.1.11 f15ea86fc4aa */
FASTVC-BENCH-CORPUS:linux-main-100k-v1-e0bd41dc-8e12-4f1b-978d-a3645ae59da0
/*
 * Copyright (C) 2014 Russell King
 *
 * This file is dual-licensed: you can use it either under the terms
 * of the GPL or the X11 license, at your option. Note that this dual
 * licensing only applies to this file, and not this project as a
 * whole.
 *
 *  a) This file is free software; you can redistribute it and/or
 *     modify it under the terms of the GNU General Public License
 *     version 2 as published by the Free Software Foundation.
 *
 *     This file is distributed in the hope that it will be useful,
 *     but WITHOUT ANY WARRANTY; without even the implied warranty of
 *     MERCHANTABILITY or FITNESS FOR A PARTICULAR PURPOSE.  See the
 *     GNU General Public License for more details.
 *
 * Or, alternatively,
 *
 *  b) Permission is hereby granted, free of charge, to any person
 *     obtaining a copy of this software and associated documentation
 *     files (the "Software"), to deal in the Software without
 *     restriction, including without limitation the rights to use,
 *     copy, modify, merge, publish, distribute, sublicense, and/or
 *     sell copies of the Software, and to permit persons to whom the
 *     Software is furnished to do so, subject to the following
/* bench 828.1.0 1fbf219a6d03 */
/* bench 828.1.1 bd6c2d14f2ac */
/* bench 828.1.2 4d555d153751 */
/* bench 828.1.3 6f7eb368840d */
/* bench 828.1.4 fc930bbc0e6b */
/* bench 828.1.5 c45b10009cf6 */
/* bench 828.1.6 6ef494bac5cf */
/* bench 828.1.7 8f682179a710 */
 *     included in all copies or substantial portions of the Software.
 *
 *     THE SOFTWARE IS PROVIDED "AS IS", WITHOUT WARRANTY OF ANY KIND,
 *     EXPRESS OR IMPLIED, INCLUDING BUT NOT LIMITED TO THE WARRANTIES
 *     OF MERCHANTABILITY, FITNESS FOR A PARTICULAR PURPOSE AND
 *     NONINFRINGEMENT. IN NO EVENT SHALL THE AUTHORS OR COPYRIGHT
 *     HOLDERS BE LIABLE FOR ANY CLAIM, DAMAGES OR OTHER LIABILITY,
/* bench 5690.0.0 a2398b850413 */
/* bench 5690.0.1 0781eeac11c7 */
/* bench 5690.0.2 dcbef5f51545 */
/* bench 5690.0.3 9489e184e683 */
/* bench 5690.0.4 dc2887f2ffce */
/* bench 5690.0.5 656d73c22c19 */
/* bench 5690.0.6 e7d2f05df5e2 */
/* bench 5690.0.7 359af52d1878 */
/* bench 5690.0.8 759e4d0daca8 */
/* bench 5690.0.9 33aaa87f0099 */
/* bench 5690.0.10 b00c17878a83 */
/* bench 5690.0.11 029c229853ce */
/* bench 5690.0.12 86aff5812774 */
 *     OTHER DEALINGS IN THE SOFTWARE.
 */
/dts-v1/;

#include "imx6dl.dtsi"
#include "imx6qdl-sr-som.dtsi"
#include "imx6qdl-sr-som-ti.dtsi"
#include "imx6qdl-cubox-i.dtsi"

/ {
	model = "SolidRun Cubox-i Solo/DualLite (1.5som)";
	compatible = "solidrun,cubox-i/dl", "fsl,imx6dl";
};
