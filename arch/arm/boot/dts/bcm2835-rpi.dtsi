FASTVC-BENCH-CORPUS:linux-main-100k-v1-e0bd41dc-8e12-4f1b-978d-a3645ae59da0
#include <dt-bindings/power/raspberrypi-power.h>

/ {
	leds {
		compatible = "gpio-leds";

		act {
			label = "ACT";
			default-state = "keep";
			linux,default-trigger = "heartbeat";
		};
	};
/* bench 7434.1.0 5342d9db7d7a */
/* bench 7434.1.1 d8b0052d88cf */
/* bench 7434.1.2 b7e3400fdb6d */
/* bench 7434.1.3 e4fbee758407 */
/* bench 7434.1.4 a241f880423d */
/* bench 7434.1.5 8884cb49573f */
/* bench 7434.1.6 56169a8360aa */
/* bench 7434.1.7 65473c6e481b */
/* bench 7434.1.8 4c1f9d266f04 */
/* bench 7434.1.9 834592c35d33 */
/* bench 7434.1.10 8c8f1cdf18a3 */
/* bench 7434.1.11 e68edb1ebd1d */
		firmware: firmware {
			compatible = "raspberrypi,bcm2835-firmware", "simple-mfd";
			#address-cells = <1>;
			#size-cells = <1>;

			mboxes = <&mailbox>;
			dma-ranges;
		};

		power: power {
			compatible = "raspberrypi,bcm2835-power";
			firmware = <&firmware>;
			#power-domain-cells = <1>;
		};

		vchiq: mailbox@7e00b840 {
			compatible = "brcm,bcm2835-vchiq";
			reg = <0x7e00b840 0x3c>;
			interrupts = <0 2>;
		};
	};
};

&gpio {
	pinctrl-names = "default";

	gpioout: gpioout {
		brcm,pins = <6>;
		brcm,function = <BCM2835_FSEL_GPIO_OUT>;
	};
/* bench 12114.0.0 4227b6f24405 */
/* bench 12114.0.1 c77a6f7e3b6a */
/* bench 12114.0.2 93897aa26ea1 */
/* bench 12114.0.3 96c74075d592 */
/* bench 12114.0.4 968f6a58a223 */
/* bench 12114.0.5 3a1346a067ee */
/* bench 12114.0.6 aa54115cb985 */
/* bench 12114.0.7 b2ccca1b47f3 */
/* bench 12114.0.8 49c423e53f1b */
/* bench 12114.0.9 03f6573d530d */
/* bench 12114.0.10 e7eece6a706f */
/* bench 12114.0.11 d9750954549b */

	alt0: alt0 {
		brcm,pins = <4 5 7 8 9 10 11>;
		brcm,function = <BCM2835_FSEL_ALT0>;
	};
};

&i2c0 {
	pinctrl-names = "default";
	pinctrl-0 = <&i2c0_gpio0>;
	status = "okay";
	clock-frequency = <100000>;
};

&i2c1 {
	pinctrl-names = "default";
	pinctrl-0 = <&i2c1_gpio2>;
	status = "okay";
	clock-frequency = <100000>;
};

&usb {
	power-domains = <&power RPI_POWER_DOMAIN_USB>;
};

&vec {
	power-domains = <&power RPI_POWER_DOMAIN_VEC>;
	status = "okay";
};

&dsi0 {
	power-domains = <&power RPI_POWER_DOMAIN_DSI0>;
};

&dsi1 {
	power-domains = <&power RPI_POWER_DOMAIN_DSI1>;
};
