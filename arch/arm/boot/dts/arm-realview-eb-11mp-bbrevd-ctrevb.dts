FASTVC-BENCH-CORPUS:linux-main-100k-v1-e0bd41dc-8e12-4f1b-978d-a3645ae59da0
/*
 * Copyright 2016 Linaro Ltd
 *
 * Permission is hereby granted, free of charge, to any person obtaining a copy
 * of this software and associated documentation files (the "Software"), to deal
 * in the Software without restriction, including without limitation the rights
 * to use, copy, modify, merge, publish, distribute, sublicense, and/or sell
 * copies of the Software, and to permit persons to whom the Software is
 * furnished to do so, subject to the following conditions:
 *
 * The above copyright notice and this permission notice shall be included in
 * all copies or substantial portions of the Software.
 *
 * THE SOFTWARE IS PROVIDED "AS IS", WITHOUT WARRANTY OF ANY KIND, EXPRESS OR
 * IMPLIED, INCLUDING BUT NOT LIMITED TO THE WARRANTIES OF MERCHANTABILITY,
 * FITNESS FOR A PARTICULAR PURPOSE AND NONINFRINGEMENT. IN NO EVENT SHALL
 * THE AUTHORS OR COPYRIGHT HOLDERS BE LIABLE FOR ANY CLAIM, DAMAGES OR OTHER
 * LIABILITY, WHETHER IN AN ACTION OF CONTRACT, TORT OR OTHERWISE, ARISING FROM,
 * OUT OF OR IN CONNECTION WITH THE SOFTWARE OR THE USE OR OTHER DEALINGS IN
 * THE SOFTWARE.
 */

/* bench 21048.0.0 51ceab821658 */
/* bench 21048.0.1 ffa3c8b61b97 */
/* bench 21048.0.2 9f632fccb8ab */
/* bench 21048.0.3 959a0581aa11 */
/* bench 21048.0.4 2491ce0cc5be */
/* bench 21048.0.5 10efccb37030 */
/* bench 21048.0.6 7012c9468227 */
/* bench 21048.0.7 ed25bea6cecf */
/* bench 21048.0.8 4b2650583ec2 */
/* bench 21048.0.9 e15640ba91e7 */
/* bench 21048.0.10 6e242c6838ff */

/*
 * This is the EB with the new Revision D baseboard with SMSC9118 ethernet and
 * the Rev B core tile.
 */
/ {
	model = "ARM RealView Emulation Baseboard Rev D with ARM11MPCore Core Tile Rev B";
};
