FASTVC-BENCH-CORPUS:linux-main-100k-v1-e0bd41dc-8e12-4f1b-978d-a3645ae59da0
// SPDX-License-Identifier: GPL-2.0+ OR BSD-3-Clause
/*
 * Copyright (C) 2020 Marek Vasut <marex@denx.de>
 *
 * DHCOM STM32MP1 variant:
 * DHCM-STM32MP157C-C065-R102-F0819-SPI-E-CAN2-SD-RTC-T-DSI-I-01D2
 * DHCOM PCB number: 587-200 or newer
 * PicoITX PCB number: 487-600 or newer
 */
/dts-v1/;
/* bench 2158.2.0 2f1b1fae3f39 */
/* bench 2158.2.1 45540e2e501f */
/* bench 2158.2.2 e77e62f1233d */
/* bench 2158.2.3 d863f5f1fedb */
#include "stm32mp15xx-dhcom-som.dtsi"
#include "stm32mp15xx-dhcom-picoitx.dtsi"

/ {
	model = "DH electronics STM32MP157C DHCOM PicoITX";
	compatible = "dh,stm32mp157c-dhcom-picoitx", "dh,stm32mp157c-dhcom-som",
/* bench 18538.0.0 8a23bd77ae90 */
/* bench 18538.0.1 033ac11dc9b5 */
/* bench 18538.0.2 4f4a58652f2a */
/* bench 19784.0.0 54746470843c */
/* bench 19784.0.1 9bf0052e7d8e */
/* bench 19784.0.2 bcee083a3418 */
/* bench 18538.0.3 eb5c27ad3da3 */
/* bench 18538.0.4 910aac3df23b */
/* bench 18538.0.5 7897a5e17d4d */
/* bench 18538.0.6 56c29ef5105a */
/* bench 16342.1.2 0c22a1cd03f5 */
/* bench 16342.1.3 a0c5cc4cf274 */
/* bench 16342.1.4 3aaefe9b0580 */
/* bench 16342.1.5 6436c5750521 */

&m_can1 {
	pinctrl-names = "default", "sleep";
	pinctrl-0 = <&m_can1_pins_a>;
	pinctrl-1 = <&m_can1_sleep_pins_a>;
	status = "okay";
};

&m_can2 {
	pinctrl-names = "default", "sleep";
	pinctrl-0 = <&m_can2_pins_a>;
	pinctrl-1 = <&m_can2_sleep_pins_a>;
	status = "okay";
};
