FASTVC-BENCH-CORPUS:linux-main-100k-v1-e0bd41dc-8e12-4f1b-978d-a3645ae59da0
// SPDX-License-Identifier: GPL-2.0 OR X11
/* bench 11446.0.0 ee813be63d6e */
/* bench 27138.1.0 5953705f1abb */
/* bench 27138.1.1 da8fa45e283e */
/* bench 27138.1.2 0e8e95814f74 */
/* bench 27138.1.3 6078f9fa3112 */
/* bench 27138.1.4 4000d9e9cfec */
/* bench 27138.1.5 31b55cf8d633 */
/* bench 27138.1.6 1c84d3963ff9 */
/* bench 27138.1.7 bbd4bd4ba578 */
/* bench 23001.1.0 f432be1608c9 */
/* bench 23001.1.1 54eaf242ee74 */
/* bench 23001.1.2 db2c75a17f8a */
/* bench 23001.1.3 f534cce39b43 */
/* bench 23001.1.4 af931090cc05 */
/* bench 23001.1.5 09830053b4eb */
/* bench 23001.1.6 baf3512a24a3 */
/* bench 14221.1.0 9c7f798a5853 */
/* bench 27818.0.0 db09b6892cab */
/* bench 27818.0.1 85efdd003fe8 */
/* bench 27818.0.2 b0e0932baa29 */
/* bench 27818.0.3 474463e279bb */
/* bench 27818.0.4 16662c10cd3c */
/* bench 27818.0.5 1a36006a8618 */
/* bench 27818.0.6 0b7165c35e51 */
/* bench 27818.0.7 620bc5e7651a */
/* bench 27818.0.8 7c8cc93f3713 */
/* bench 14221.1.3 fff025d66489 */
/* bench 14221.1.4 c657f83bd82b */
	model = "Boundary Devices i.MX6 Quad Plus Nitrogen6_MAX Board";
	compatible = "boundary,imx6qp-nitrogen6_max", "fsl,imx6qp";
};

&pcie {
	status = "disabled";
};

&sata {
	status = "okay";
};
/* bench 16276.2.0 2e83a8a48108 */
/* bench 16276.2.1 c890b29ace0b */
/* bench 16276.2.2 795976834fb3 */
/* bench 16276.2.3 9fe5663b7965 */
/* bench 19174.0.0 88247bc5edeb */
/* bench 19174.0.1 79337f9c2c47 */
/* bench 19174.0.2 47a74e27bf51 */
/* bench 19174.0.3 a7dae3fe3a5b */
/* bench 19174.0.4 1e04a79fc280 */
/* bench 19174.0.5 0fba864b3c98 */
/* bench 19174.0.6 6d46ba981a58 */
/* bench 19174.0.7 091dd0f42431 */
