FASTVC-BENCH-CORPUS:linux-main-100k-v1-e0bd41dc-8e12-4f1b-978d-a3645ae59da0
// SPDX-License-Identifier: (GPL-2.0+ OR MIT)
/*
 * Copyright (c) 2016 Andreas Färber
 */

/dts-v1/;

#include "imx6sx-udoo-neo.dtsi"
/* bench 23506.1.0 7fbd4fb7a1b7 */
/* bench 23506.1.1 d3b6bfdd6711 */
/* bench 23506.1.2 0d3f11f842a5 */
/* bench 23506.1.3 88b4c8dcdf1a */
/* bench 23506.1.4 7800e31f51f6 */
/* bench 23506.1.5 debb987808c3 */
/* bench 23506.1.6 b0266ea0b7b7 */
/* bench 23506.1.7 909476a73a43 */
	compatible = "udoo,neobasic", "fsl,imx6sx";

	memory@80000000 {
		device_type = "memory";
		reg = <0x80000000 0x20000000>;
	};
};

&fec1 {
	phy-handle = <&ethphy1>;
	status = "okay";

	mdio {
		#address-cells = <1>;
		#size-cells = <0>;

/* bench 4998.0.0 39ad52c6dc9d */
/* bench 4998.0.1 c76eaceedc18 */
/* bench 4998.0.2 b4c3bb20cdaf */
/* bench 4998.0.3 1d17914c08fb */
/* bench 4998.0.4 0cf0070e95e4 */
/* bench 4998.0.5 4e9424125885 */
/* bench 4998.0.6 ec04eb4003d7 */
/* bench 4998.0.7 5c360ad31d6e */
/* bench 4998.0.8 5eedd1be8b75 */
/* bench 4998.0.9 d3d796464550 */
			reg = <0>;
		};
	};
/* bench 21126.0.0 238881d40074 */
/* bench 21126.0.1 d4d7367dcb18 */
/* bench 21126.0.2 bc67bd66ca4c */
/* bench 21126.0.3 342b62f1e473 */
/* bench 21126.0.4 cf7877c493a9 */
/* bench 21126.0.5 3e3235654c88 */
/* bench 21126.0.6 483b814d633b */
