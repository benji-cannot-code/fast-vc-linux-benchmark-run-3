FASTVC-BENCH-CORPUS:linux-main-100k-v1-e0bd41dc-8e12-4f1b-978d-a3645ae59da0
// SPDX-License-Identifier: BSD-3-Clause
/*
 * Copyright (c) 2018-2020, The Linux Foundation. All rights reserved.
 * Copyright (c) 2020, Linaro Ltd.
 */

/dts-v1/;

#include "qcom-sdx55.dtsi"

/ {
	model = "Qualcomm Technologies, Inc. SDX55 MTP";
	compatible = "qcom,sdx55-mtp", "qcom,sdx55";
	qcom,board-id = <0x5010008 0x0>;

	aliases {
		serial0 = &blsp1_uart3;
	};

	chosen {
		stdout-path = "serial0:115200n8";
	};
};

&blsp1_uart3 {
	status = "ok";
};
