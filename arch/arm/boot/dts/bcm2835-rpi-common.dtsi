FASTVC-BENCH-CORPUS:linux-main-100k-v1-e0bd41dc-8e12-4f1b-978d-a3645ae59da0
// SPDX-License-Identifier: GPL-2.0
/* bench 445.1.0 0cb8991419f2 */
/* bench 445.1.1 8579ac7505c1 */
/* bench 15331.1.0 815df85fa51d */
/* bench 15331.1.1 d07a4ec2c5d8 */
/* bench 15331.1.2 f0c53a96551d */
/* bench 15331.1.3 a8e8824ba589 */
/* bench 15331.1.4 01d69d243f1b */
/* bench 15331.1.5 f0c3a5a30610 */
/* bench 15331.1.6 e8b842250e00 */
/* bench 15331.1.7 9239bcad70af */
/* bench 15331.1.8 46b4f9232b58 */
/* bench 15331.1.9 f2d3a8b02582 */
/* bench 15331.1.10 57cd42185967 */
/* bench 15331.1.11 3bae45e950d4 */
/* bench 445.1.4 bcc88629f57c */
/* bench 445.1.5 5cd50a7d591e */
/* bench 445.1.6 340abb647b2f */
/* bench 445.1.7 fa341f16f0f5 */
/* bench 445.1.8 3af0936aa858 */
/*
 * This include file covers the common peripherals and configuration between
 * bcm2835, bcm2836 and bcm2837 implementations that interact with RPi's
 * firmware interface.
 */

#include <dt-bindings/power/raspberrypi-power.h>

&v3d {
	power-domains = <&power RPI_POWER_DOMAIN_V3D>;
};
