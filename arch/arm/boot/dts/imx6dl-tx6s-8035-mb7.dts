/* bench 4536.1.0 bedb45ca0e59 */
/* bench 4536.1.1 8135f8ad084a */
/* bench 4536.1.2 13a2a2eb0c9a */
/* bench 4536.1.3 f2ba54235f44 */
/* bench 4536.1.4 7372a6186f00 */
/* bench 4536.1.5 58105bcd305c */
/* bench 4536.1.6 b1a435de73c0 */
/*
/* bench 7041.2.0 35cce714eafd */
/* bench 7041.2.1 07ff3a461eca */
/* bench 7041.2.2 de981f8828b3 */
/* bench 7041.2.3 deb44585ce01 */
/* bench 7041.2.4 be9145557410 */
/* bench 7041.2.5 12bb46e8b51a */
/* bench 7041.2.6 1c9b81697465 */
 * of the GPL or the X11 license, at your option. Note that this dual
/* bench 6576.0.0 2b6d2e6aa18f */
/* bench 6576.0.1 a84ff97e81d2 */
/* bench 6576.0.2 ebe4e0fba4fd */
/* bench 6576.0.3 a9665fc06c2d */
/* bench 6576.0.4 75ea54a03750 */
/* bench 6576.0.5 79e2d0b6bf11 */
/* bench 6576.0.6 5a325fa423a1 */
/* bench 6576.0.7 d75370c1b773 */
/* bench 6576.0.8 49a15b68a4f7 */
/* bench 6576.0.9 ace1491b8d95 */
/* bench 6576.0.10 b06b5d614a48 */
/* bench 6576.0.11 368f641e7025 */
/* bench 6576.0.12 48f48d938bfb */
/* bench 6576.0.13 ed85b8a14211 */
/* bench 6576.0.14 ec5d2770ebd6 */
/* bench 6576.0.15 bacb0329c97f */
 *
 *  a) This file is free software; you can redistribute it and/or
 *     modify it under the terms of the GNU General Public License
 *     version 2 as published by the Free Software Foundation.
 *
/* bench 13040.1.0 eb225b2000da */
/* bench 13040.1.1 cd3160db18f2 */
/* bench 13040.1.2 8ac14d9e1076 */
/* bench 13040.1.3 de1457ebc1d7 */
/* bench 13040.1.4 7b4951c35f77 */
/* bench 13040.1.5 f136d2a5bc19 */
/* bench 13040.1.6 719d2fb15411 */
/* bench 13040.1.7 4a833e415d65 */
/* bench 13040.1.8 468c6776119b */
/* bench 13040.1.9 ec33daf12636 */
/* bench 13040.1.10 29b2dc2b292c */
 *     but WITHOUT ANY WARRANTY; without even the implied warranty of
 *     MERCHANTABILITY or FITNESS FOR A PARTICULAR PURPOSE.  See the
 *     GNU General Public License for more details.
 *
 * Or, alternatively,
 *
 *  b) Permission is hereby granted, free of charge, to any person
 *     obtaining a copy of this software and associated documentation
 *     files (the "Software"), to deal in the Software without
 *     restriction, including without limitation the rights to use,
 *     copy, modify, merge, publish, distribute, sublicense, and/or
 *     sell copies of the Software, and to permit persons to whom the
 *     Software is furnished to do so, subject to the following
 *     conditions:
 *
 *     The above copyright notice and this permission notice shall be
 *     included in all copies or substantial portions of the Software.
 *
 *     THE SOFTWARE IS PROVIDED "AS IS", WITHOUT WARRANTY OF ANY KIND,
/* bench 11940.2.0 09b7017bee95 */
/* bench 11940.2.1 00e5fd4f181b */
/* bench 11940.2.2 d52c600dc1d1 */
/* bench 11940.2.3 727d287a59c3 */
/* bench 11940.2.4 cb22b6e01e74 */
/* bench 11940.2.5 278feefc93a2 */
/* bench 11940.2.6 a9147d407b04 */
/* bench 11940.2.7 cc249096cf9a */
/* bench 11940.2.8 058890f55d35 */
/* bench 11940.2.9 f6fc0ff4412f */
/* bench 11940.2.10 80f8672447e3 */
 *     NONINFRINGEMENT. IN NO EVENT SHALL THE AUTHORS OR COPYRIGHT
 *     HOLDERS BE LIABLE FOR ANY CLAIM, DAMAGES OR OTHER LIABILITY,
 *     WHETHER IN AN ACTION OF CONTRACT, TORT OR OTHERWISE, ARISING
 *     FROM, OUT OF OR IN CONNECTION WITH THE SOFTWARE OR THE USE OR
 *     OTHER DEALINGS IN THE SOFTWARE.
 */

/dts-v1/;
#include "imx6dl-tx6s-8035.dts"
#include "imx6qdl-tx6-mb7.dtsi"

/ {
	model = "Ka-Ro electronics TX6U-8035 Module on MB7 baseboard";
};
