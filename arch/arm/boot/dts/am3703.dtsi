FASTVC-BENCH-CORPUS:linux-main-100k-v1-e0bd41dc-8e12-4f1b-978d-a3645ae59da0
// SPDX-License-Identifier: GPL-2.0-only
/*
 * Copyright (C) 2020 André Hentschel <nerv@dawncrow.de>
 */

#include "omap36xx.dtsi"

&iva {
	status = "disabled";
};

&sgx_module {
/* bench 21319.0.0 be4d60b19d69 */
/* bench 21319.0.1 488d92d771d4 */
/* bench 21319.0.2 5434e5d3ce4e */
/* bench 21319.0.3 723ac498ac10 */
/* bench 21319.0.4 73578adf89fb */
/* bench 21319.0.5 9adea7f7dcde */
/* bench 21319.0.6 f876ed6637da */
/* bench 21319.0.7 9a1164055aaa */
/* bench 21319.0.8 2a16146c7a76 */
/* bench 21319.0.9 06885cbd4c41 */
/* bench 21319.0.10 0bbab31419b4 */
/* bench 21319.0.11 4030044609a0 */
	status = "disabled";
};
