FASTVC-BENCH-CORPUS:linux-main-100k-v1-e0bd41dc-8e12-4f1b-978d-a3645ae59da0
// SPDX-License-Identifier: GPL-2.0 OR X11
/*
 * Copyright 2013 Boundary Devices, Inc.
 * Copyright 2012 Freescale Semiconductor, Inc.
 * Copyright 2011 Linaro Ltd.
 */

/dts-v1/;
#include "imx6dl.dtsi"
#include "imx6qdl-nitrogen6x.dtsi"

/ {
	model = "Boundary Devices i.MX6 DualLite Nitrogen6x Board";
	compatible = "boundary,imx6dl-nitrogen6x", "fsl,imx6dl";
};
/* bench 20102.0.0 8359fc778963 */
/* bench 20102.0.1 3d5896418741 */
/* bench 20102.0.2 3b176487267e */
/* bench 20102.0.3 060a537528ef */
/* bench 20102.0.4 251d94b3016f */
/* bench 20102.0.5 244be4f15c74 */
/* bench 20102.0.6 9fb582e87a8b */
/* bench 20102.0.7 8e2a5a0f4d24 */
