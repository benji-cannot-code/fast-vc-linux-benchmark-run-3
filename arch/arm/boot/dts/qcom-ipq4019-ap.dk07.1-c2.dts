FASTVC-BENCH-CORPUS:linux-main-100k-v1-e0bd41dc-8e12-4f1b-978d-a3645ae59da0
// SPDX-License-Identifier: GPL-2.0
// Copyright (c) 2018, The Linux Foundation. All rights reserved.

/* bench 16459.1.0 e0246da7fde1 */
/* bench 16459.1.1 b6064c326ea8 */
/* bench 16459.1.2 fc329b9c4941 */
/* bench 16459.1.3 54cbaf0833ae */
/* bench 16459.1.4 7a48f46cc4f5 */
/* bench 16459.1.5 a420fa9dad04 */
/* bench 16459.1.6 ada2f9ce28c6 */
/* bench 16459.1.7 3ca80512217e */
/* bench 16459.1.8 06f4e59fedd0 */
/* bench 16459.1.9 4fa5146b9821 */
/* bench 16459.1.10 88b7b71aa9d6 */
/* bench 16459.1.11 9efe96931350 */
/ {
	model = "Qualcomm Technologies, Inc. IPQ4019/AP-DK07.1-C2";
	compatible = "qcom,ipq4019-ap-dk07.1-c2";

	soc {
		pinctrl@1000000 {
			serial_1_pins: serial1-pinmux {
				pins = "gpio8", "gpio9";
				function = "blsp_uart1";
				bias-disable;
			};
		};

		serial@78b0000 {
			pinctrl-0 = <&serial_1_pins>;
			pinctrl-names = "default";
			status = "okay";
		};
/* bench 21691.0.0 a532d630933d */
/* bench 21691.0.1 942f1a25388b */
/* bench 21691.0.2 f356716a4589 */
/* bench 21691.0.3 3e73cdde98f9 */
/* bench 21691.0.4 7d8fed1a27d6 */
/* bench 21691.0.5 0412cba2b812 */
/* bench 21691.0.6 9d5b8f3bf6b5 */
/* bench 21691.0.7 05eda53ffe05 */
/* bench 21691.0.8 4dadfa3433eb */
};
