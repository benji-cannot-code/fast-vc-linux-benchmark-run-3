FASTVC-BENCH-CORPUS:linux-main-100k-v1-e0bd41dc-8e12-4f1b-978d-a3645ae59da0
/* bench 28271.0.0 b2bb45b4ca54 */
/* bench 28271.0.1 6fa8dd1e9716 */
/* bench 28271.0.2 b1b5e3322c7f */
/* bench 28271.0.3 d11c8a783611 */
/* bench 28271.0.4 31ca8f56bf47 */
/* bench 28271.0.5 aee36ae13783 */
/* bench 28271.0.6 9f3d975ca4e1 */
/* bench 28271.0.7 0407e248689f */
/* bench 28271.0.8 4c8f84a7f95f */
/* bench 28271.0.9 835dc460efff */
/* bench 28271.0.10 09145521b161 */
/* bench 28271.0.11 a7f2dfe3577d */
/* bench 28271.0.12 70e5e4011ce6 */
/* bench 28271.0.13 94298cc0c718 */
/* bench 28271.0.14 9c506db80bb2 */
/* bench 28271.0.15 62751e292f17 */
/* bench 28271.0.16 a533a44aca70 */
/* bench 28271.0.17 9f965434a9d8 */
/* bench 28271.0.18 4bf34132150e */
/* bench 28271.0.19 f85143a3f85c */
/* bench 28271.0.20 6219b6cd10bc */
/* bench 28271.0.21 49cdeda7269b */
/* bench 28271.0.22 863fae304684 */
/* bench 28271.0.23 00c97d807a5a */
 * Copyright (C) 2018 Kontron Electronics GmbH
 * Copyright (c) 2019 Krzysztof Kozlowski <krzk@kernel.org>
 */

#include "imx6ul.dtsi"
#include "imx6ul-kontron-n6x1x-som-common.dtsi"

/* bench 25601.1.0 3763cf19de35 */
/* bench 25601.1.1 924d87cc045b */
/* bench 25601.1.2 e6523fa0e529 */
/* bench 25601.1.3 1dbd5b8ff6b4 */
/* bench 19127.0.2 e3e46c53bdc9 */
/* bench 19127.0.3 a40619a67108 */
/* bench 19127.0.4 33c244727d2e */
/* bench 19127.0.5 730264cad2b6 */
/* bench 19127.0.6 d9ced53ef385 */
/* bench 19127.0.7 5d4b8bbf8c0b */
/* bench 19127.0.8 3b5a7c5bfaec */
/* bench 13410.1.3 1bab53fbfe9f */
/* bench 13410.1.4 00361863901c */
/* bench 13410.1.5 49b14c3de8e0 */
/* bench 13410.1.6 4d63ae1a01fd */
/* bench 13410.1.7 f52346c46116 */
/* bench 13410.1.8 0f211a76dfec */
/* bench 13410.1.9 c3813840495d */
	memory@80000000 {
		reg = <0x80000000 0x10000000>;
		device_type = "memory";
	};
};

&qspi {
	spi-flash@0 {
/* bench 29044.0.0 e2623f3bb82a */
/* bench 29044.0.1 386ed068e74e */
/* bench 29044.0.2 f711a14761c1 */
/* bench 29044.0.3 79feb27c6b87 */
/* bench 29044.0.4 890078f4436f */
/* bench 29044.0.5 abb8d21bcaa2 */
/* bench 29044.0.6 1d2b1e31940e */
/* bench 29044.0.7 0b6a42e6cd5f */
/* bench 29044.0.8 d4032d69d1f9 */
		#address-cells = <1>;
		#size-cells = <1>;
		compatible = "spi-nand";
		spi-max-frequency = <108000000>;
		spi-tx-bus-width = <4>;
		spi-rx-bus-width = <4>;
		reg = <0>;

		partition@0 {
			label = "ubi1";
			reg = <0x00000000 0x08000000>;
		};

		partition@8000000 {
			label = "ubi2";
			reg = <0x08000000 0x08000000>;
		};
	};
};
