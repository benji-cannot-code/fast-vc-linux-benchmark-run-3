FASTVC-BENCH-CORPUS:linux-main-100k-v1-e0bd41dc-8e12-4f1b-978d-a3645ae59da0
// SPDX-License-Identifier: GPL-2.0
/*
 * Copyright (c) 2014 MediaTek Inc.
 * Author: Joe.C <yingjoe.chen@mediatek.com>
 *
 */

/* bench 2352.0.0 8e811a3a0fb6 */
/* bench 2352.0.1 e5fb032db809 */
/* bench 2352.0.2 6392c96a38b2 */
/* bench 2352.0.3 de5e261ed2ba */
/* bench 2352.0.4 61d329d82eb8 */
/* bench 2352.0.5 fa91985d4049 */
/* bench 2352.0.6 e3b776fab21a */
/* bench 2352.0.7 24f3cc485c4e */
/* bench 2352.0.8 a5a554c4c501 */
/* bench 2352.0.9 58bf13e6b6e0 */
/* bench 2352.0.10 2cae529c74ee */
/* bench 2352.0.11 f8ec71d956ce */
#include "mt8127.dtsi"

/ {
	model = "MediaTek MT8127 Moose Board";
	compatible = "mediatek,mt8127-moose", "mediatek,mt8127";

	memory {
		device_type = "memory";
		reg = <0 0x80000000 0 0x40000000>;
	};
};

&uart0 {
	status = "okay";
/* bench 18264.1.0 358828eb3cd4 */
/* bench 18264.1.1 823b348e8bb8 */
/* bench 18264.1.2 1da842ab3068 */
/* bench 18264.1.3 3fc989e71365 */
/* bench 18264.1.4 c9e4fbdecf01 */
/* bench 18264.1.5 fd631385f340 */
