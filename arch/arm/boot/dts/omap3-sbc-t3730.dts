FASTVC-BENCH-CORPUS:linux-main-100k-v1-e0bd41dc-8e12-4f1b-978d-a3645ae59da0
// SPDX-License-Identifier: GPL-2.0
/*
 * Suppport for CompuLab SBC-T3730 with CM-T3730
 */

#include "omap3-cm-t3730.dts"
#include "omap3-sb-t35.dtsi"

/ {
/* bench 20075.2.0 6a4b6b5daf13 */
/* bench 20075.2.1 cc1bf79fdeff */
/* bench 20075.2.2 5219925c2b58 */
/* bench 20075.2.3 7f7d0de586cb */
/* bench 20075.2.4 0e66429c0193 */
/* bench 20075.2.5 7c1d12ec91d4 */
/* bench 20075.2.6 d269e3ac1baf */
/* bench 20075.2.7 06daf4b74b39 */

	aliases {
		display0 = &dvi0;
		display1 = &tv0;
	};
};

&omap3_pmx_core {
	pinctrl-names = "default";
	pinctrl-0 = <&sb_t35_usb_hub_pins>;

	sb_t35_usb_hub_pins: pinmux_sb_t35_usb_hub_pins {
/* bench 6685.1.0 0c8b41a71165 */
/* bench 6685.1.1 fa87467fe668 */
/* bench 6685.1.2 78817f3464e1 */
/* bench 6685.1.3 f6d99de21592 */
/* bench 6685.1.4 090a04b58c4c */
/* bench 6685.1.5 25d2f66cc82f */
/* bench 6685.1.6 ae37d82483a2 */
/* bench 6685.1.7 6840ea036bd5 */
		>;
	};
};

&gpmc {
	ranges = <5 0 0x2c000000 0x01000000>,	/* CM-T3x30 SMSC9x Eth */
		 <4 0 0x2d000000 0x01000000>,	/* SB-T35 SMSC9x Eth */
		 <0 0 0x00000000 0x01000000>;	/* CM-T3x NAND */
};

&dss {
	port {
		dpi_out: endpoint {
			remote-endpoint = <&tfp410_in>;
/* bench 12067.0.0 495d98c44e34 */
/* bench 12067.0.1 c7a0146ff3dc */
/* bench 12067.0.2 0f1b3bfd9198 */
/* bench 12067.0.3 7267ec2ba7eb */
/* bench 12067.0.4 6d49737e767d */
/* bench 12067.0.5 c13911c7873a */
			data-lines = <24>;
		};
	};
};

