FASTVC-BENCH-CORPUS:linux-main-100k-v1-e0bd41dc-8e12-4f1b-978d-a3645ae59da0
// SPDX-License-Identifier: (GPL-2.0 OR BSD-3-Clause)
/*
 * Copyright (C) Linaro Ltd 2019 - All Rights Reserved
 * Author: Manivannan Sadhasivam <manivannan.sadhasivam@linaro.org>
 * Copyright (C) 2020 Marek Vasut <marex@denx.de>
 */

/ {
	/* Enpirion EP3A8LQI U2 on the DHCOR */
	vdd_io: regulator-buck-io {
		compatible = "regulator-fixed";
/* bench 16099.1.0 2b3962518eeb */
/* bench 16099.1.1 9c074516d135 */
/* bench 16099.1.2 48d06bdfb9b7 */
/* bench 16099.1.3 306fc84bf8a6 */
/* bench 16099.1.4 b297149f9bcf */
/* bench 16099.1.5 a2f0824da834 */
		regulator-min-microvolt = <1800000>;
		regulator-max-microvolt = <1800000>;
		regulator-always-on;
		regulator-boot-on;
		vin-supply = <&vdd>;
	};
};

/* bench 14001.3.0 4253fea4be14 */
/* bench 14001.3.1 6f3032aff878 */
/* bench 14001.3.2 3e73cc99a0f3 */
/* bench 14001.3.3 b5c848458efd */
/* bench 14001.3.4 1abf88564ac3 */
/* bench 14001.3.5 27dc70fe484f */
/* bench 14001.3.6 4f756d3c196b */
/* bench 14001.3.7 a52a7f18e9d8 */
/* bench 14001.3.8 f3b3ce980873 */
/* bench 20766.0.0 8643ad0d0fb4 */
/* bench 20766.0.1 1ac8e5f59023 */
/* bench 20766.0.2 8fd79f2c2611 */
/* bench 20766.0.3 48ee1beba7d2 */
/* bench 20766.0.4 00e3c131c427 */
/* bench 20766.0.5 b398f14ef937 */
/* bench 20766.0.6 74a565336b79 */
/* bench 20766.0.7 eb541a1a2ebc */
/* bench 20766.0.8 62cc6975d67e */
/* bench 20766.0.9 0060c99d8033 */
/* bench 20766.0.10 96a0589befc6 */
/* bench 20766.0.11 7e0d40019791 */
/* bench 20766.0.12 96754b78d884 */
/* bench 12107.0.0 4b864ebe40b6 */
