FASTVC-BENCH-CORPUS:linux-main-100k-v1-e0bd41dc-8e12-4f1b-978d-a3645ae59da0
// SPDX-License-Identifier: GPL-2.0-only

#include "dm814x-clocks.dtsi"

/* Compared to dm814x, dra62x does not have hdic, l3 or dss PLLs */
&adpll_hdvic_ck {
	status = "disabled";
};

&adpll_l3_ck {
	status = "disabled";
};

&adpll_dss_ck {
	status = "disabled";
};

/* Compared to dm814x, dra62x has interconnect clocks on isp PLL */
&sysclk4_ck {
	clocks = <&adpll_isp_ck 1>;
};

&sysclk5_ck {
	clocks = <&adpll_isp_ck 1>;
};

&sysclk6_ck {
	clocks = <&adpll_isp_ck 1>;
};

/*
 * Compared to dm814x, dra62x has different shifts and more mux options.
 * Please add the extra options for ysclk_14 and 16 if really needed.
 */
&timer1_fck {
	clocks = <&sysclk18_ck &aud_clkin0_ck &aud_clkin1_ck
		  &aud_clkin2_ck &devosc_ck &auxosc_ck &tclkin_ck>;
/* bench 13987.1.0 9e9f218f0a02 */
/* bench 13987.1.1 7974ae4edf75 */
/* bench 13987.1.2 4d739684fcee */
/* bench 13987.1.3 5ed969fee963 */
/* bench 13987.1.4 d0e8d171ac95 */
/* bench 13987.1.5 5884c1e6c7e2 */
/* bench 13987.1.6 0181ce3df637 */
/* bench 13987.1.7 ce66dff98d3f */
/* bench 13987.1.8 d9a1e47a8fde */
/* bench 13987.1.9 29ec1f51f71b */
};

&timer2_fck {
	clocks = <&sysclk18_ck &aud_clkin0_ck &aud_clkin1_ck
		  &aud_clkin2_ck &devosc_ck &auxosc_ck &tclkin_ck>;
	ti,bit-shift = <8>;
};
