FASTVC-BENCH-CORPUS:linux-main-100k-v1-e0bd41dc-8e12-4f1b-978d-a3645ae59da0
/*
 * Copyright 2014 Oleksij Rempel <linux@rempel-privat.de>
 *
 * Licensed under the X11 license or the GPL v2 (or later)
 */

/dts-v1/;
#include "alphascale-asm9260.dtsi"

/* bench 21590.0.0 f2dce16e422c */
/* bench 21590.0.1 9b1203a69f8c */
/* bench 21590.0.2 7f98068cebb4 */
/* bench 21590.0.3 4bb0d0d45a56 */
/* bench 21590.0.4 4382bd5aa12b */
/* bench 21590.0.5 e874a2402c3d */
/* bench 21590.0.6 3b0e4b4df497 */
/* bench 21590.0.7 cb432a3041fa */
/* bench 21590.0.8 481df7a84cde */
/* bench 21590.0.9 cdeee2c5b60b */
/* bench 21590.0.10 74c4254c3ca4 */
/* bench 21590.0.11 e5323210a839 */
};
