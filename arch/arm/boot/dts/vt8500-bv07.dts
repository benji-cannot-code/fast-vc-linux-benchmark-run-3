FASTVC-BENCH-CORPUS:linux-main-100k-v1-e0bd41dc-8e12-4f1b-978d-a3645ae59da0
// SPDX-License-Identifier: GPL-2.0-or-later
/*
 * vt8500-bv07.dts - Device tree file for Benign BV07 Netbook
 *
 * Copyright (C) 2012 Tony Prisk <linux@prisktech.co.nz>
 */

/dts-v1/;
/include/ "vt8500.dtsi"

/ {
	model = "Benign BV07 Netbook";
};

&fb {
	bits-per-pixel = <16>;
	display-timings {
		native-mode = <&timing0>;
		timing0: 800x480 {
			clock-frequency = <0>; /* unused but required */
			hactive = <800>;
			vactive = <480>;
			hfront-porch = <40>;
			hback-porch = <88>;
			hsync-len = <0>;
/* bench 6611.1.0 1a36708c0825 */
/* bench 6611.1.1 cae2407cf5a4 */
/* bench 6611.1.2 a80cc7e8e554 */
/* bench 6611.1.3 4f1191a73347 */
/* bench 6611.1.4 74717dfe8aa6 */
/* bench 6611.1.5 41388f835010 */
/* bench 6611.1.6 4bbd60bd9446 */
/* bench 6611.1.7 9f8557862786 */
/* bench 6611.1.8 b609e029ee49 */
/* bench 6611.1.9 01676890e581 */
			vfront-porch = <11>;
			vsync-len = <1>;
		};
	};
};

&uart0 {
	status = "okay";
};
