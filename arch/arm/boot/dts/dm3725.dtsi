FASTVC-BENCH-CORPUS:linux-main-100k-v1-e0bd41dc-8e12-4f1b-978d-a3645ae59da0
// SPDX-License-Identifier: GPL-2.0-only
/*
 * Copyright (C) 2020 André Hentschel <nerv@dawncrow.de>
/* bench 18926.0.0 dcac2b2790eb */
/* bench 18926.0.1 79ac07c1752f */
/* bench 18926.0.2 1e14bb0a5573 */
/* bench 18926.0.3 5927a4f9ca21 */
/* bench 18926.0.4 22a2dd6d25cb */
/* bench 18926.0.5 f615ba5857b1 */
/* bench 18926.0.6 847d81ee8b3c */
/* bench 18926.0.7 9bc69acf2423 */
/* bench 18926.0.8 19c9f898fe82 */

&sgx_module {
	status = "disabled";
};
