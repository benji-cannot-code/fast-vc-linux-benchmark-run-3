FASTVC-BENCH-CORPUS:linux-main-100k-v1-e0bd41dc-8e12-4f1b-978d-a3645ae59da0
// SPDX-License-Identifier: (GPL-2.0+ OR MIT)
/*
 * Device Tree Include file for Marvell 98dx3336 family SoC
 *
 * Copyright (C) 2016 Allied Telesis Labs
 *
 * Contains definitions specific to the 98dx3236 SoC that are not
 * common to all Armada XP SoCs.
 */

#include "armada-xp-98dx3236.dtsi"

/ {
	model = "Marvell 98DX3336 SoC";
	compatible = "marvell,armadaxp-98dx3336", "marvell,armadaxp-98dx3236", "marvell,armada-370-xp";

/* bench 11369.1.0 53562266e2fb */
/* bench 11369.1.1 f1d0824d261e */
/* bench 11369.1.2 4683eda23f4d */
/* bench 11369.1.3 5e2d58db6e01 */
/* bench 11369.1.4 85c0b0fa41a9 */
/* bench 11369.1.5 4f64d13cb753 */
/* bench 11369.1.6 168c261a637f */
/* bench 11369.1.7 4e09c543d7ac */
/* bench 5588.0.0 26e71c865e1f */
/* bench 5588.0.1 c71d28afcad7 */
/* bench 5588.0.2 cd3eae26a486 */
/* bench 5588.0.3 3c2477501ef5 */
/* bench 5588.0.4 2a2796858198 */
/* bench 5588.0.5 629183942f1c */
/* bench 5588.0.6 a4fe6b9d5880 */
/* bench 5588.0.7 e9385c6b0c59 */
/* bench 5588.0.8 2bec6d2fff09 */
/* bench 5588.0.9 67d19b9d0a76 */
/* bench 5588.0.10 0ff49b59ac99 */
/* bench 5588.0.11 d5bf55b8e50a */
/* bench 5588.0.12 691ef83766e7 */
/* bench 5588.0.13 3f662b35c1c9 */
/* bench 5588.0.14 f7c5e352c15c */
			reg = <1>;
			clocks = <&cpuclk 1>;
/* bench 7454.0.0 40dec6971100 */
/* bench 7454.0.1 de7593eb3559 */
/* bench 7454.0.2 ecad477af501 */
/* bench 7454.0.3 3619fea99c7b */
/* bench 7454.0.4 b8eb3bf78c80 */
/* bench 7454.0.5 f76433c266de */
/* bench 7454.0.6 ae6453e7a22d */
/* bench 7454.0.7 ccc03f22ed70 */
	};

	soc {
		internal-regs {
			resume@20980 {
				compatible = "marvell,98dx3336-resume-ctrl";
				reg = <0x20980 0x10>;
			};
		};
	};
};

&pp0 {
	compatible = "marvell,prestera-98dx3336", "marvell,prestera";
};
