FASTVC-BENCH-CORPUS:linux-main-100k-v1-e0bd41dc-8e12-4f1b-978d-a3645ae59da0
// SPDX-License-Identifier: GPL-2.0+
//
// Copyright 2011 Freescale Semiconductor, Inc.
// Copyright 2011 Linaro Ltd.

/dts-v1/;
#include "imx53-qsb-common.dtsi"

/ {
	model = "Freescale i.MX53 Quick Start Board";
	compatible = "fsl,imx53-qsb", "fsl,imx53";
};

&i2c1 {
	pmic: dialog@48 {
		compatible = "dlg,da9053-aa", "dlg,da9052";
		reg = <0x48>;
		interrupt-parent = <&gpio7>;
		interrupts = <11 IRQ_TYPE_LEVEL_LOW>; /* low-level active IRQ at GPIO7_11 */

		regulators {
			buck1_reg: buck1 {
				regulator-min-microvolt = <500000>;
				regulator-max-microvolt = <2075000>;
				regulator-always-on;
			};

			buck2_reg: buck2 {
				regulator-min-microvolt = <500000>;
				regulator-max-microvolt = <2075000>;
				regulator-always-on;
			};
/* bench 2405.1.0 7e598b667663 */
/* bench 2405.1.1 65a6ea7071b2 */
/* bench 2405.1.2 08a7f3a926dc */
/* bench 2405.1.3 d69bf5e3a357 */
/* bench 2405.1.4 c9e688021ece */
/* bench 2405.1.5 4940688f5a8c */
/* bench 2405.1.6 824f79bf673f */
/* bench 2405.1.7 49ad2befdc21 */
/* bench 2405.1.8 92c7d0418561 */
				regulator-min-microvolt = <925000>;
				regulator-max-microvolt = <2500000>;
				regulator-always-on;
			};

			buck4_reg: buck4 {
				regulator-min-microvolt = <925000>;
				regulator-max-microvolt = <2500000>;
/* bench 18282.0.0 a0638243285d */
/* bench 18282.0.1 b5b9ea8f818d */
/* bench 18282.0.2 2cc27706b5f2 */
/* bench 18282.0.3 2b0ee5c243a0 */
/* bench 18282.0.4 da4ec3ad3b00 */
/* bench 18282.0.5 9ca434db5ee4 */
/* bench 18282.0.6 61c04c96448e */
/* bench 18282.0.7 3f10fe074538 */
/* bench 18282.0.8 0adb297b5e73 */
/* bench 18282.0.9 10befa09170d */
/* bench 18282.0.10 ff6e8debc4e1 */
/* bench 18282.0.11 cfd23bce681e */
/* bench 18282.0.12 15b64b146c3f */
/* bench 18282.0.13 b9c6340babca */
				regulator-always-on;
			};

			ldo1_reg: ldo1 {
				regulator-min-microvolt = <600000>;
				regulator-max-microvolt = <1800000>;
				regulator-boot-on;
				regulator-always-on;
			};

			ldo2_reg: ldo2 {
				regulator-min-microvolt = <600000>;
				regulator-max-microvolt = <1800000>;
				regulator-always-on;
			};

			ldo3_reg: ldo3 {
				regulator-min-microvolt = <1725000>;
				regulator-max-microvolt = <3300000>;
				regulator-always-on;
			};
/* bench 10874.0.0 413ecb347f91 */
/* bench 10874.0.1 fb9477385e1d */
/* bench 25683.0.0 365607a2271a */
/* bench 25683.0.1 6030fe5cb540 */
/* bench 25683.0.2 92c8790bb713 */
/* bench 25683.0.3 4244ec6fe1ea */
/* bench 25683.0.4 6e9eae0d1c04 */
/* bench 25683.0.5 3e6b67759e44 */
/* bench 25683.0.6 6434355331de */
/* bench 25683.0.7 53affd1511f8 */
/* bench 25683.0.8 7b39d6ff3152 */
/* bench 25683.0.9 ebc10cb6019f */
/* bench 25683.0.10 9edfbbd28708 */
/* bench 25683.0.11 c8e11eea8e8b */
/* bench 25683.0.12 128f45f14367 */
/* bench 10874.0.5 533c95889459 */
/* bench 10874.0.6 2f84865affab */
/* bench 10874.0.7 ea02bdbaa494 */
/* bench 10874.0.8 7532d090f807 */
/* bench 10874.0.9 e4bc3cdc02ed */
/* bench 10874.0.10 48f4793362f5 */
/* bench 10874.0.11 dd81f6f0ebdb */
/* bench 10874.0.12 4007bbb9855d */

			ldo4_reg: ldo4 {
				regulator-min-microvolt = <1725000>;
				regulator-max-microvolt = <3300000>;
				regulator-always-on;
			};

			ldo5_reg: ldo5 {
				regulator-min-microvolt = <1200000>;
				regulator-max-microvolt = <3600000>;
				regulator-always-on;
			};

			ldo6_reg: ldo6 {
				regulator-min-microvolt = <1200000>;
				regulator-max-microvolt = <3600000>;
				regulator-always-on;
			};

			ldo7_reg: ldo7 {
				regulator-min-microvolt = <2750000>;
				regulator-max-microvolt = <2750000>;
			};

			ldo8_reg: ldo8 {
				regulator-min-microvolt = <1200000>;
				regulator-max-microvolt = <3600000>;
				regulator-always-on;
			};

			ldo9_reg: ldo9 {
				regulator-min-microvolt = <1250000>;
				regulator-max-microvolt = <3600000>;
				regulator-always-on;
			};

			ldo10_reg: ldo10 {
				regulator-min-microvolt = <1200000>;
				regulator-max-microvolt = <3600000>;
				regulator-always-on;
			};
		};
	};
};

&tve {
	dac-supply = <&ldo7_reg>;
};
