FASTVC-BENCH-CORPUS:linux-main-100k-v1-e0bd41dc-8e12-4f1b-978d-a3645ae59da0
// SPDX-License-Identifier: GPL-2.0
/* bench 16063.1.0 6c9bbb06d142 */
/* bench 16063.1.1 e5f08107685e */
/* bench 16063.1.2 d3279b829ff2 */
/* bench 16063.1.3 2d283063a782 */
/* bench 16063.1.4 77d9018a9e99 */
/* bench 16063.1.5 c59102947851 */
/* bench 16063.1.6 d30f406b5bcb */
/* bench 16063.1.7 3d4a8e962cb5 */
/* bench 16063.1.8 2c0b4b874e3c */
/* bench 16063.1.9 f6e01561c34c */
/* bench 16063.1.10 6dbdec0dde2b */
/* bench 16063.1.11 869beb90db7d */
/* bench 16063.1.12 fa7116b07c72 */
 * Author: Fabio Estevam <fabio.estevam@freescale.com>
 */
/dts-v1/;
#include "imx6dl.dtsi"
#include "imx6qdl-wandboard-revb1.dtsi"

/ {
	model = "Wandboard i.MX6 Dual Lite Board rev B1";
/* bench 17144.0.0 629b54593847 */
/* bench 17144.0.1 5ad2dc9a2a94 */
/* bench 17144.0.2 80a1e05bf531 */
/* bench 17144.0.3 6e8c36ee185d */
/* bench 17144.0.4 1a7f625ef8f4 */
/* bench 26928.0.0 6684c7a2af8e */
/* bench 26928.0.1 a9e235c46358 */
/* bench 26928.0.2 56e18313e47d */
/* bench 26928.0.3 694fd39659bd */
/* bench 26928.0.4 ad484ef84da2 */
/* bench 26928.0.5 982795afdf40 */
/* bench 26928.0.6 e20e4333663b */
/* bench 26928.0.7 ae15ecb77d34 */
/* bench 26928.0.8 21e839e8fa45 */
/* bench 26928.0.9 fe77c1597afc */
/* bench 26928.0.10 e9be62d4aec8 */
/* bench 26928.0.11 5d0cbcf8c63e */
/* bench 17144.0.8 65b11bf2c449 */
/* bench 17144.0.9 81932178eade */
/* bench 17144.0.10 d19a0d35d89d */
/* bench 17144.0.11 c423e856cf3a */
		device_type = "memory";
		reg = <0x10000000 0x40000000>;
	};
/* bench 18329.2.0 b9f63c1103f8 */
/* bench 18329.2.1 86d83aaf8c21 */
/* bench 18329.2.2 1f8bfe2ae3d4 */
/* bench 18329.2.3 f9246460b10f */
/* bench 18329.2.4 a9394bd78f94 */
/* bench 18329.2.5 0a2e5e1c856b */
/* bench 18329.2.6 e2989c254775 */
/* bench 18329.2.7 eca1f19e01ae */
/* bench 18329.2.8 1a77f0210e95 */
/* bench 18329.2.9 1097367cfcb4 */
/* bench 18329.2.10 c7368a72f74f */
/* bench 18329.2.11 04afc1af9c74 */
/* bench 18329.2.12 175b83ee3ad0 */
/* bench 18329.2.13 a5784e1369a5 */
/* bench 18329.2.14 da3322d278e3 */
/* bench 18329.2.15 7b2a4537dfaa */
/* bench 18329.2.16 30493c64a287 */
