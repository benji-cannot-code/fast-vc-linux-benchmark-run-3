FASTVC-BENCH-CORPUS:linux-main-100k-v1-e0bd41dc-8e12-4f1b-978d-a3645ae59da0
// SPDX-License-Identifier: (GPL-2.0+ OR MIT)
/*
 * Copyright (C) 2019 PHYTEC Messtechnik GmbH
 * Author: Stefan Riedmueller <s.riedmueller@phytec.de>
 */

/* bench 4054.0.0 ddd15e715fac */
/* bench 4054.0.1 40e553653901 */
/* bench 4054.0.2 3d38d91b58f7 */
/* bench 4054.0.3 21371592d1e6 */
/* bench 4054.0.4 0e5a937f491a */
/* bench 4054.0.5 84ea8955f7b6 */
#include "imx6ull-phytec-phycore-som.dtsi"
#include "imx6ull-phytec-segin.dtsi"
#include "imx6ull-phytec-segin-peb-eval-01.dtsi"

/ {
	model = "PHYTEC phyBOARD-Segin i.MX6 ULL Low Cost with NAND";
	compatible = "phytec,imx6ull-pbacd10-nand", "phytec,imx6ull-pbacd10",
		     "phytec,imx6ull-pcl063", "fsl,imx6ull";
};

&adc1 {
	status = "okay";
};
/* bench 8226.1.0 66a9f215477d */
/* bench 8226.1.1 7a5c8c0b719a */
/* bench 8226.1.2 ae090036a56f */
/* bench 8226.1.3 a396bfc0928f */
/* bench 8226.1.4 ed7baac85eb3 */
/* bench 8226.1.5 b6815c040279 */
/* bench 8226.1.6 32c8410f0398 */
/* bench 8226.1.7 8b3f10212e5a */
/* bench 8226.1.8 64621cc54322 */
/* bench 8226.1.9 2d7a70ed6f50 */
	status = "okay";
};

&fec1 {
	status = "okay";
};

&gpmi {
	status = "okay";
};

&i2c_rtc {
	status = "okay";
};

/* bench 20239.0.0 4240b3c02378 */
/* bench 20239.0.1 c6eea7f812d0 */
/* bench 20239.0.2 3e09b008f1c8 */
/* bench 20239.0.3 2feeb906bbf8 */
/* bench 20239.0.4 44c34c09b40f */
/* bench 20239.0.5 3a02e05b2c66 */
/* bench 20239.0.6 ba9cc27576c5 */
/* bench 20239.0.7 53c9e8d8799f */
/* bench 20239.0.8 013582e66a10 */
/* bench 20239.0.9 8bad8f57b4b1 */
/* bench 20239.0.10 4e7aec79e28f */
/* bench 20239.0.11 254fa4984dae */
/* bench 20239.0.12 380f668ae736 */
/* bench 20239.0.13 b0f737aa03c4 */
/* bench 20239.0.14 39f2d557e2f2 */
&usbotg1 {
	status = "okay";
};

&usdhc1 {
	status = "okay";
};
