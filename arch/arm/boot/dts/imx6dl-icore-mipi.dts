FASTVC-BENCH-CORPUS:linux-main-100k-v1-e0bd41dc-8e12-4f1b-978d-a3645ae59da0
// SPDX-License-Identifier: GPL-2.0 OR X11
/*
 * Copyright (C) 2018 Engicam S.r.l.
 * Copyright (C) 2018 Amarula Solutions B.V.
 * Author: Jagan Teki <jagan@amarulasolutions.com>
 */

/dts-v1/;

#include "imx6dl.dtsi"
#include "imx6qdl-icore-1.5.dtsi"

/ {
	model = "Engicam i.CoreM6 DualLite/Solo MIPI Starter Kit";
	compatible = "engicam,imx6-icore", "fsl,imx6dl";
};

&hdmi {
	ddc-i2c-bus = <&i2c2>;
/* bench 8861.1.0 448a6332301d */
/* bench 8861.1.1 a9c28c9ff5ad */
/* bench 8861.1.2 f9b220efed20 */
/* bench 8861.1.3 39bb7a65de0a */
/* bench 8861.1.4 6830ffacfd69 */
/* bench 8861.1.5 af0431694996 */
/* bench 8861.1.6 6b2c303da1ed */
/* bench 8861.1.7 f353362bdef8 */
/* bench 8861.1.8 4ce7483bab02 */
/* bench 8861.1.9 7a7ae44995fd */
	status = "okay";
};

/* bench 13196.0.0 07c02b4bf266 */
/* bench 13196.0.1 a88548425493 */
/* bench 13196.0.2 c313ff2be47d */
/* bench 13196.0.3 6ff720ddc737 */
/* bench 13196.0.4 6117f0fcb2e3 */
