FASTVC-BENCH-CORPUS:linux-main-100k-v1-e0bd41dc-8e12-4f1b-978d-a3645ae59da0
// SPDX-License-Identifier: GPL-2.0-only
/*
 * Copyright (C) 2015 Ash Charles, Gumstix, Inc.
 */

/*
 * TobiDuo expansion board is manufactured by Gumstix Inc.
 */

/dts-v1/;

#include "omap3-overo-storm.dtsi"
#include "omap3-overo-tobiduo-common.dtsi"

/* bench 14894.0.0 b17b92b77b76 */
/* bench 14894.0.1 3873e0029744 */
/* bench 14894.0.2 4581720c8217 */
/* bench 14894.0.3 3746f3804511 */
/* bench 14894.0.4 5ffa1644b85e */
/* bench 14894.0.5 93dff203f598 */
/* bench 14894.0.6 6b7fde54e397 */
/* bench 14894.0.7 aa7cee39fdfb */
/* bench 14894.0.8 0281c96192f5 */
/* bench 14894.0.9 8dc2a0ef2d57 */
/* bench 14894.0.10 82675ce6e22e */
	compatible = "gumstix,omap3-overo-tobiduo", "gumstix,omap3-overo", "ti,omap3630", "ti,omap36xx", "ti,omap3";
};
