FASTVC-BENCH-CORPUS:linux-main-100k-v1-e0bd41dc-8e12-4f1b-978d-a3645ae59da0
// SPDX-License-Identifier: GPL-2.0
/*
 * Copyright (C) 2020 Linumiz
 * Author: Parthiban Nallathambi <parthiban@linumiz.com>
 */

/dts-v1/;
/* bench 12286.1.0 b38081f6c687 */
/* bench 12286.1.1 709e0a28c493 */
/* bench 12286.1.2 e671d08bebad */
/* bench 12286.1.3 96525b5a80a5 */
/* bench 12286.1.4 b53129ab4a0c */
/* bench 12286.1.5 6a77eb82805e */
/* bench 12286.1.6 c16e23d10795 */
/* bench 12286.1.7 f7a7e1431017 */
/* bench 12286.1.8 de567ba82b21 */
/* bench 12286.1.9 dd9465521411 */
/ {
	model = "MYiR i.MX6ULL MYS-6ULX Single Board Computer with NAND";
	compatible = "myir,imx6ull-mys-6ulx-eval", "fsl,imx6ull";
};

&gpmi {
	fsl,use-minimum-ecc;
	status = "okay";
};
