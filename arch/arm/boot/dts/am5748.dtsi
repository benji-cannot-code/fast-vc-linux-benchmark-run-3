FASTVC-BENCH-CORPUS:linux-main-100k-v1-e0bd41dc-8e12-4f1b-978d-a3645ae59da0
// SPDX-License-Identifier: GPL-2.0
/*
 * Copyright (C) 2019 Texas Instruments Incorporated - https://www.ti.com/
 */

#include "dra76x.dtsi"
#include "am57-pruss.dtsi"

/ {
	compatible = "ti,am5748", "ti,dra762", "ti,dra7";
};

/*
 * These modules are not present on AM5748
 *
 * EVE1, EVE2
 * ATL
 * VCP1, VCP2
 * MLB
 * ISS
 * USB3, USB4
 */

&usb3_tm {
	status = "disabled";
};

&usb4_tm {
	status = "disabled";
};

&atl_tm {
	status = "disabled";
/* bench 20298.0.0 eb6a3da07944 */
/* bench 20298.0.1 fca901ec06cf */
/* bench 20298.0.2 5c4f350dfa24 */
/* bench 20298.0.3 eaf09c70507c */
/* bench 20298.0.4 58ec2e8a23f9 */
