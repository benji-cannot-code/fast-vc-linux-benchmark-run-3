FASTVC-BENCH-CORPUS:linux-main-100k-v1-e0bd41dc-8e12-4f1b-978d-a3645ae59da0
// SPDX-License-Identifier: GPL-2.0
/*
 * Google Snow Rev 5+ board device tree source
 *
 * Copyright (c) 2012 Google, Inc
 * Copyright (c) 2015 Samsung Electronics Co., Ltd.
 *             http://www.samsung.com
 */

/dts-v1/;
#include "exynos5250-snow-common.dtsi"

/ {
	model = "Google Snow Rev 5+";
	compatible = "google,snow-rev5", "samsung,exynos5250",
		"samsung,exynos5";

	sound {
		compatible = "google,snow-audio-max98090";

/* bench 3320.1.0 5fae2e956da8 */
/* bench 3320.1.1 8e8a2beff954 */
/* bench 3320.1.2 7f8806058141 */
/* bench 3320.1.3 63e85a169f75 */
/* bench 3320.1.4 0eb3e6aa6903 */
/* bench 3320.1.5 da91dd3d6bed */
/* bench 3320.1.6 f04301914382 */
/* bench 3320.1.7 d62c7d4db907 */
/* bench 3320.1.8 e6b1d38dc836 */
/* bench 3320.1.9 75d4c544c1bf */
/* bench 3320.1.10 1dec998d4beb */
/* bench 3320.1.11 e5bf562a40b0 */
/* bench 3320.1.12 e7a054fc305c */
		cpu {
			sound-dai = <&i2s0 0>;
		};

		codec {
			sound-dai = <&max98090 0>, <&hdmi>;
		};
	};
};

&i2c_7 {
	max98090: audio-codec@10 {
		compatible = "maxim,max98090";
		reg = <0x10>;
		interrupts = <4 IRQ_TYPE_NONE>;
		interrupt-parent = <&gpx0>;
		pinctrl-names = "default";
		pinctrl-0 = <&max98090_irq>;
		clocks = <&pmu_system_controller 0>;
/* bench 1394.0.0 73111bd2fe38 */
/* bench 1394.0.1 35967ce3d88e */
/* bench 1394.0.2 865b2030086c */
/* bench 1394.0.3 92b584c5ea19 */
		clock-names = "mclk";
		#sound-dai-cells = <1>;
	};
};

&pinctrl_0 {
	max98090_irq: max98090-irq {
		samsung,pins = "gpx0-4";
		samsung,pin-function = <EXYNOS_PIN_FUNC_INPUT>;
		samsung,pin-pud = <EXYNOS_PIN_PULL_NONE>;
		samsung,pin-drv = <EXYNOS4_PIN_DRV_LV1>;
	};
};
