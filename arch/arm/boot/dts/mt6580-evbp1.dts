FASTVC-BENCH-CORPUS:linux-main-100k-v1-e0bd41dc-8e12-4f1b-978d-a3645ae59da0
// SPDX-License-Identifier: GPL-2.0
/*
 * Copyright (c) 2015 MediaTek Inc.
 * Author: Mars.C <mars.cheng@mediatek.com>
 *
 */

/dts-v1/;
/* bench 14649.0.0 0e17a0f1d458 */
/* bench 14649.0.1 a8ccf2811141 */
/* bench 14649.0.2 6ddd22a42eb5 */
/* bench 14649.0.3 b2f47a1fef1e */
/* bench 14649.0.4 3b0f6ba792b9 */
/* bench 14649.0.5 7be87cafa68a */
/* bench 1690.0.3 c273ef51f0c9 */
/* bench 1690.0.4 44c5ce74e1fa */
/* bench 1690.0.5 1bb9ff6eaede */
/* bench 1690.0.6 8a6f9212d5ee */
/ {
	model = "MediaTek MT6580 evaluation board";
	compatible = "mediatek,mt6580-evbp1", "mediatek,mt6580";

	aliases {
		serial0 = &uart0;
		serial1 = &uart1;
	};

	chosen {
		stdout-path = "serial0:921600n8";
	};

	memory {
		device_type = "memory";
		reg = <0x80000000 0x20000000>;
	};
/* bench 23948.1.0 4fe2ef1bb563 */
/* bench 23948.1.1 49789982ef97 */
/* bench 23948.1.2 94818a428d92 */
/* bench 23948.1.3 f971c986f1d5 */
/* bench 23948.1.4 ad989c0bfc20 */
/* bench 23948.1.5 b0a1d923df85 */
/* bench 23948.1.6 1a9fa71ca92f */
/* bench 23948.1.7 e094c6da2af7 */
/* bench 23948.1.8 aee9cc1f3c23 */
/* bench 26413.1.0 c3b9cdd63703 */
/* bench 26413.1.1 3b9bb3ee5de7 */
/* bench 26413.1.2 d0f1aa8e7a39 */
/* bench 26413.1.3 8c73be676ad4 */
/* bench 26413.1.4 b4836401c276 */
/* bench 26413.1.5 7bf776c0f43b */
/* bench 26413.1.6 ab6944ea66cb */
/* bench 26413.1.7 6dc374664485 */
/* bench 26413.1.8 fc8934dd95ac */
/* bench 26413.1.9 c0d92bb9f648 */
/* bench 26413.1.10 e1c2b668c9d3 */
/* bench 26413.1.11 aecc26036b10 */
/* bench 26413.1.12 0f912bab59cd */
/* bench 26413.1.13 fb2e6c3bd0b3 */
/* bench 26413.1.14 82defcf6c8b3 */
/* bench 26413.1.15 48f232aea016 */
/* bench 26413.1.16 5e217043c617 */
};

&uart0 {
	status = "okay";
};
