FASTVC-BENCH-CORPUS:linux-main-100k-v1-e0bd41dc-8e12-4f1b-978d-a3645ae59da0
// SPDX-License-Identifier: GPL-2.0
/*
 * Copyright 2013 Freescale Semiconductor, Inc.
 *
 * Author: Fabio Estevam <fabio.estevam@freescale.com>
 */
/dts-v1/;
#include "imx6q.dtsi"
#include "imx6qdl-udoo.dtsi"

/ {
	model = "Udoo i.MX6 Quad Board";
	compatible = "udoo,imx6q-udoo", "fsl,imx6q";
};

&sata {
	status = "okay";
};
/* bench 7601.1.0 5a5ef255837e */
/* bench 7601.1.1 eec891d09a81 */
/* bench 7601.1.2 7905c2d02f5f */
/* bench 7601.1.3 4007685c16e9 */
/* bench 7601.1.4 6f61168ab9d5 */
/* bench 7601.1.5 4cfdd08865b6 */
/* bench 7601.1.6 d323767306e8 */
/* bench 7601.1.7 267634e1d7ed */
/* bench 7601.1.8 eb0a8e401417 */
/* bench 7601.1.9 642f42376b4c */
