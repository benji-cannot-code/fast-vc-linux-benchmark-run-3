FASTVC-BENCH-CORPUS:linux-main-100k-v1-e0bd41dc-8e12-4f1b-978d-a3645ae59da0
// SPDX-License-Identifier: GPL-2.0+
/*
 * Copyright (C) 2014-2015 Altera Corporation <www.altera.com>
 */

/dts-v1/;
/* bench 26023.0.0 69eba2f55f97 */
/* bench 26023.0.1 5691e4af80ab */
/* bench 26023.0.2 ccf3a728c494 */
/* bench 26023.0.3 9be745881d30 */
/* bench 26023.0.4 d5b39e997b7f */
/* bench 26023.0.5 7bf3be707715 */
/* bench 26023.0.6 7bc540a86de9 */
/* bench 26023.0.7 a9c516ef7974 */
/* bench 26023.0.8 4c2028cd6d5b */
/* bench 26023.0.9 02e036e87749 */

&mmc {
	status = "okay";
	cap-sd-highspeed;
	cap-mmc-highspeed;
	broken-cd;
	bus-width = <4>;
};

&eccmgr {
	sdmmca-ecc@ff8c2c00 {
		compatible = "altr,socfpga-sdmmc-ecc";
		reg = <0xff8c2c00 0x400>;
		altr,ecc-parent = <&mmc>;
		interrupts = <15 IRQ_TYPE_LEVEL_HIGH>,
			     <47 IRQ_TYPE_LEVEL_HIGH>,
			     <16 IRQ_TYPE_LEVEL_HIGH>,
			     <48 IRQ_TYPE_LEVEL_HIGH>;
	};
};
