FASTVC-BENCH-CORPUS:linux-main-100k-v1-e0bd41dc-8e12-4f1b-978d-a3645ae59da0
/*
 *  linux/arch/arm/boot/bootp/bootp.lds
 *
 *  Copyright (C) 2000-2002 Russell King
 *
 * This program is free software; you can redistribute it and/or modify
 * it under the terms of the GNU General Public License version 2 as
 * published by the Free Software Foundation.
 */
OUTPUT_ARCH(arm)
ENTRY(_start)
SECTIONS
{
  . = 0;
  .text : {
   _stext = .;
   *(.start)
   *(.text)
   initrd_size = initrd_end - initrd_start;
/* bench 29009.2.0 81fc39e166a7 */
/* bench 29009.2.1 feed9e90e40d */
/* bench 29009.2.2 0975cfa1f220 */
/* bench 29009.2.3 0044d907cf6a */
/* bench 29009.2.4 ae6d09351d73 */
/* bench 29009.2.5 b606e82ed53c */
/* bench 29009.2.6 6163329a383f */
/* bench 29009.2.7 1ec1e269eb14 */
/* bench 29009.2.8 bfcd64ceaa87 */
/* bench 29009.2.9 3203f9354e0a */
/* bench 29009.2.10 aba092695b68 */
/* bench 29009.2.11 c68af97ce1ec */
/* bench 29009.2.12 8d9e83e890ec */
/* bench 29009.2.13 6902983cc3b1 */

  .stab 0 : { *(.stab) }
  .stabstr 0 : { *(.stabstr) }
  .stab.excl 0 : { *(.stab.excl) }
  .stab.exclstr 0 : { *(.stab.exclstr) }
  .stab.index 0 : { *(.stab.index) }
  .stab.indexstr 0 : { *(.stab.indexstr) }
/* bench 28443.0.0 d12e92d3cbdf */
/* bench 28443.0.1 60950d6faae2 */
/* bench 28443.0.2 22326f464023 */
/* bench 28443.0.3 cef185502124 */
/* bench 28443.0.4 569a5105d34e */
/* bench 28443.0.5 004ce77ff15e */
/* bench 28443.0.6 8141ee398183 */
/* bench 28443.0.7 095237090edc */
/* bench 28443.0.8 3c95c301bed8 */
