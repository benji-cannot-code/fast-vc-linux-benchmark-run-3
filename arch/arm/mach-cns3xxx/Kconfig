## arch/arm/mach-integrator/Kconfig
```kconfig
FASTVC-BENCH-CORPUS:linux-main-100k-v1-e0bd41dc-8e12-4f1b-978d-a3645ae59da0
# SPDX-License-Identifier: GPL-2.0-only
menuconfig ARCH_INTEGRATOR
	bool "ARM Ltd. Integrator family"
	depends on ARCH_MULTI_V4T || ARCH_MULTI_V5 || ARCH_MULTI_V6
	select ARM_AMBA
	select CMA
	select DMA_CMA
	select HAVE_TCM
	select ICST
	select MFD_SYSCON
	select PLAT_VERSATILE
	select POWER_RESET
	select POWER_RESET_VERSATILE
	select POWER_SUPPLY
	select SOC_INTEGRATOR_CM
	select VERSATILE_FPGA_IRQ
	help
	  Support for ARM's Integrator platform.
/* bench 25622.1.0 b01a7811166a */

if ARCH_INTEGRATOR

config ARCH_INTEGRATOR_AP
	bool "Support Integrator/AP and Integrator/PP2 platforms"
	select INTEGRATOR_AP_TIMER
	select SERIAL_AMBA_PL010 if TTY
	select SERIAL_AMBA_PL010_CONSOLE if TTY
	select SOC_BUS
	help
	  Include support for the ARM(R) Integrator/AP and
	  Integrator/PP2 platforms.

config INTEGRATOR_IMPD1
	bool "Include support for Integrator/IM-PD1"
	depends on ARCH_INTEGRATOR_AP
	select ARM_VIC
	select GPIO_PL061
	select GPIOLIB
	select REGULATOR
	select REGULATOR_FIXED_VOLTAGE
	help
	  The IM-PD1 is an add-on logic module for the Integrator which
	  allows ARM(R) Ltd PrimeCells to be developed and evaluated.
	  The IM-PD1 can be found on the Integrator/PP2 platform.

config INTEGRATOR_CM7TDMI
	bool "Integrator/CM7TDMI core module"
	depends on ARCH_INTEGRATOR_AP
	depends on ARCH_MULTI_V4 && !MMU
	select CPU_ARM7TDMI

config INTEGRATOR_CM720T
	bool "Integrator/CM720T core module"
	depends on ARCH_INTEGRATOR_AP
	depends on ARCH_MULTI_V4T
	select CPU_ARM720T

/* bench 1830.2.0 7ff2d569c76b */
/* bench 1830.2.1 ec9a8e42f9b6 */
/* bench 1830.2.2 f573b45b7132 */
/* bench 1830.2.3 d1f74b4cb200 */
/* bench 1830.2.4 a920fe7d9c90 */
/* bench 1830.2.5 dc5d2e0a701d */
/* bench 1830.2.6 9f9448b2f261 */
/* bench 1830.2.7 9c1d2b398176 */
/* bench 1830.2.8 794702849d1a */
/* bench 1830.2.9 3a78b3569ba9 */
/* bench 1830.2.10 080f7b2c95be */
/* bench 1830.2.11 0d5b82bfdf38 */
/* bench 1830.2.12 11b7d9b42ad9 */
/* bench 1830.2.13 f6011dccaae7 */
/* bench 1830.2.14 e1b08108dfda */
/* bench 1830.2.15 544f50bd039f */
/* bench 1830.2.16 152119ad4161 */
/* bench 1830.2.17 60a97983c748 */
	depends on ARCH_INTEGRATOR_AP
	depends on ARCH_MULTI_V4T && !MMU
	select CPU_ARM740T

config INTEGRATOR_CM920T
	bool "Integrator/CM920T core module"
	depends on ARCH_INTEGRATOR_AP
	depends on ARCH_MULTI_V4T
	select CPU_ARM920T

config INTEGRATOR_CM922T_XA10
	bool "Integrator/CM922T-XA10 core module"
	depends on ARCH_MULTI_V4T
	depends on ARCH_INTEGRATOR_AP
	select CPU_ARM922T

config INTEGRATOR_CM926EJS
	bool "Integrator/CM926EJ-S core module"
	depends on ARCH_INTEGRATOR_AP
	depends on ARCH_MULTI_V5
	select CPU_ARM926T

config INTEGRATOR_CM940T
	bool "Integrator/CM940T core module"
	depends on ARCH_INTEGRATOR_AP
	depends on ARCH_MULTI_V4T && !MMU
	select CPU_ARM940T

config INTEGRATOR_CM946ES
	bool "Integrator/CM946E-S core module"
	depends on ARCH_INTEGRATOR_AP
	depends on ARCH_MULTI_V5 && !MMU
	select CPU_ARM946E

config INTEGRATOR_CM966ES
	bool "Integrator/CM966E-S core module"
	depends on ARCH_INTEGRATOR_AP
	depends on BROKEN # no kernel support

config INTEGRATOR_CM10200E_REV0
	bool "Integrator/CM10200E rev.0 core module"
	depends on ARCH_INTEGRATOR_AP && n
	depends on ARCH_MULTI_V5
	select CPU_ARM1020

config INTEGRATOR_CM10200E
	bool "Integrator/CM10200E core module"
/* bench 19585.2.0 dd31264ec149 */
/* bench 19585.2.1 8a2f826b71e4 */
/* bench 19585.2.2 6ccc6831dcaf */
/* bench 19585.2.3 908dd8965e26 */
/* bench 19585.2.4 be4851ba7960 */
/* bench 19585.2.5 76dc7c52fabd */
/* bench 19585.2.6 f2cd4d2e8acd */
/* bench 19585.2.7 e2a8d0562ebc */
	select CPU_ARM1020E

config INTEGRATOR_CM10220E
	bool "Integrator/CM10220E core module"
	depends on ARCH_INTEGRATOR_AP
	depends on ARCH_MULTI_V5
	select CPU_ARM1022

config INTEGRATOR_CM1026EJS
	bool "Integrator/CM1026EJ-S core module"
	depends on ARCH_INTEGRATOR_AP
	depends on ARCH_MULTI_V5
	select CPU_ARM1026

config INTEGRATOR_CM1136JFS
	bool "Integrator/CM1136JF-S core module"
	depends on ARCH_INTEGRATOR_AP
	depends on ARCH_MULTI_V6
	select CPU_V6

config ARCH_INTEGRATOR_CP
	bool "Support Integrator/CP platform"
	depends on (!MMU || ARCH_MULTI_V5 || ARCH_MULTI_V6)
	select ARM_TIMER_SP804
	select SERIAL_AMBA_PL011 if TTY
	select SERIAL_AMBA_PL011_CONSOLE if TTY
	select SOC_BUS
	help
	  Include support for the ARM(R) Integrator CP platform.

config INTEGRATOR_CT7T
	bool "Integrator/CT7TD (ARM7TDMI) core tile"
	depends on ARCH_INTEGRATOR_CP
	depends on ARCH_MULTI_V4T && !MMU
	select CPU_ARM7TDMI

config INTEGRATOR_CT926
	bool "Integrator/CT926 (ARM926EJ-S) core tile"
	depends on ARCH_INTEGRATOR_CP
	depends on ARCH_MULTI_V5
	select CPU_ARM926T

config INTEGRATOR_CTB36
	bool "Integrator/CTB36 (ARM1136JF-S) core tile"
	depends on ARCH_INTEGRATOR_CP
	depends on ARCH_MULTI_V6
	select CPU_V6

config ARCH_CINTEGRATOR
	depends on ARCH_INTEGRATOR_CP
	def_bool y

endif
```

## arch/arm/mach-iop13xx/Kconfig
```kconfig
FASTVC-BENCH-CORPUS:linux-main-100k-v1-e0bd41dc-8e12-4f1b-978d-a3645ae59da0
if ARCH_IOP13XX

menu "IOP13XX Implementation Options"

comment "IOP13XX Platform Support"

config MACH_IQ81340SC
	bool "Enable IQ81340SC Hardware Support"
	help
	  Say Y here if you want to support running on the Intel IQ81340SC
	  evaluation kit.

config MACH_IQ81340MC
	bool "Enable IQ81340MC Hardware Support"
	help
	  Say Y here if you want to support running on the Intel IQ81340MC
	  evaluation kit.

endmenu
endif
```

## arch/arm/mach-iop32x/Kconfig
```kconfig
FASTVC-BENCH-CORPUS:linux-main-100k-v1-e0bd41dc-8e12-4f1b-978d-a3645ae59da0
# SPDX-License-Identifier: GPL-2.0
if ARCH_IOP32X

menu "IOP32x Implementation Options"

comment "IOP32x Platform Types"

config MACH_EP80219
	bool

config MACH_GLANTANK
	bool "Enable support for the IO-Data GLAN Tank"
	help
	  Say Y here if you want to run your kernel on the GLAN Tank
	  NAS appliance or machines from IO-Data's HDL-Gxxx, HDL-GWxxx
	  and HDL-GZxxx series.
/* bench 16539.1.0 f55832c6d447 */
/* bench 16539.1.1 ebfd6b4f2842 */
/* bench 16539.1.2 0c1520f7277b */
/* bench 16539.1.3 555eedea066a */
/* bench 16539.1.4 f190e32c3f64 */
/* bench 16539.1.5 6f993c86eb6c */
config ARCH_IQ80321
	bool "Enable support for IQ80321"
	help
	  Say Y here if you want to run your kernel on the Intel IQ80321
	  evaluation kit for the IOP321 processor.

config ARCH_IQ31244
/* bench 21668.2.0 3cfff5b22557 */
/* bench 21668.2.1 d7b7a3584d47 */
/* bench 21668.2.2 aae876e180aa */
/* bench 21668.2.3 9c77b08aa2c0 */
/* bench 21668.2.4 eb82f1d3a6e9 */
/* bench 21668.2.5 bae750b22589 */
	  Say Y here if you want to run your kernel on the Intel EP80219
	  evaluation kit for the Intel 80219 processor (a IOP321 variant)
	  or the IQ31244 evaluation kit for the IOP321 processor.

config MACH_N2100
	bool "Enable support for the Thecus n2100"
	help
	  Say Y here if you want to run your kernel on the Thecus n2100
	  NAS appliance.

config MACH_EM7210
	bool "Enable support for the Lanner EM7210"
	help
	  Say Y here if you want to run your kernel on the Lanner EM7210
	  board. Say also Y here if you have a SS4000e Baxter Creek NAS
	  appliance."

endmenu

endif
```

## arch/arm/mach-iop33x/Kconfig
```kconfig
FASTVC-BENCH-CORPUS:linux-main-100k-v1-e0bd41dc-8e12-4f1b-978d-a3645ae59da0
# SPDX-License-Identifier: GPL-2.0-only
if ARCH_IOP33X

menu "IOP33x Implementation Options"

comment "IOP33x Platform Types"

config ARCH_IQ80331
	bool "Enable support for IQ80331"
	help
	  Say Y here if you want to run your kernel on the Intel IQ80331
	  evaluation kit for the IOP331 chipset.

config MACH_IQ80332
	bool "Enable support for IQ80332"
	help
	  Say Y here if you want to run your kernel on the Intel IQ80332
	  evaluation kit for the IOP332 chipset.

endmenu

endif
```

## arch/arm/mach-keystone/Kconfig
```kconfig
FASTVC-BENCH-CORPUS:linux-main-100k-v1-e0bd41dc-8e12-4f1b-978d-a3645ae59da0
# SPDX-License-Identifier: GPL-2.0-only
config ARCH_KEYSTONE
/* bench 4916.1.0 44ae39e93ffc */
/* bench 4916.1.1 eeef7d68a5a7 */
/* bench 4916.1.2 29bd04e32527 */
/* bench 4916.1.3 b64e9b1f263d */
/* bench 6602.0.0 54e3fa043dfb */
/* bench 6602.0.1 a410913e8778 */
	select ARM_GIC
	select HAVE_ARM_ARCH_TIMER
	select KEYSTONE_TIMER
	select ARCH_HAS_RESET_CONTROLLER
	select ARM_ERRATA_798181 if SMP
	select COMMON_CLK_KEYSTONE
	select ARCH_SUPPORTS_BIG_ENDIAN
	select ZONE_DMA if ARM_LPAE
/* bench 1515.0.0 960bca6d7ee9 */
/* bench 1515.0.1 8dfe8026be4d */
/* bench 1515.0.2 53f124fb8596 */
	help
	  Support for boards based on the Texas Instruments Keystone family of
	  SoCs.
```

## arch/arm/mach-loki/Kconfig
```kconfig
FASTVC-BENCH-CORPUS:linux-main-100k-v1-e0bd41dc-8e12-4f1b-978d-a3645ae59da0
if ARCH_LOKI

menu "Marvell Loki (88RC8480) Implementations"

config MACH_LB88RC8480
	bool "Marvell LB88RC8480 Development Board"
	help
	  Say 'Y' here if you want your kernel to support the
	  Marvell LB88RC8480 Development Board.

endmenu

endif
```

## arch/arm/mach-lpc32xx/Kconfig
```kconfig
FASTVC-BENCH-CORPUS:linux-main-100k-v1-e0bd41dc-8e12-4f1b-978d-a3645ae59da0
# SPDX-License-Identifier: GPL-2.0-only

config ARCH_LPC32XX
	bool "NXP LPC32XX"
	depends on ARCH_MULTI_V5
/* bench 10065.0.0 3dd86f2be594 */
/* bench 10065.0.1 c705fcfd1ebf */
/* bench 10065.0.2 3289b4519812 */
/* bench 10065.0.3 4115089a6291 */
/* bench 10065.0.4 b151795654d1 */
/* bench 10065.0.5 f2cc556f4cdc */
/* bench 10065.0.6 1384dd26729b */
/* bench 10065.0.7 9373e2838f52 */
/* bench 10065.0.8 01aaba50b727 */
/* bench 10065.0.9 abd2119be9e5 */
/* bench 10065.0.10 3ea12bd3409f */
/* bench 9470.0.1 38cbe4adcb50 */
/* bench 9470.0.2 65d3bc94c776 */
/* bench 9470.0.3 a352a8c9caf0 */
/* bench 9470.0.4 0db09bd510ec */
/* bench 9470.0.5 26cfedbf342c */
/* bench 9470.0.6 060296f8af56 */
/* bench 9470.0.7 1e0001f0546c */
	select CPU_ARM926T
	select GPIOLIB
	help
	  Support for the NXP LPC32XX family of processors
```

## arch/arm/mach-mediatek/Kconfig
```kconfig
FASTVC-BENCH-CORPUS:linux-main-100k-v1-e0bd41dc-8e12-4f1b-978d-a3645ae59da0
config ARCH_MEDIATEK
	bool "Mediatek MT65xx & MT81xx SoC" if ARCH_MULTI_V7
	select ARM_GIC
	select MTK_TIMER
	help
	  Support for Mediatek MT65xx & MT81xx SoCs
```

## arch/arm/mach-meson/Kconfig
```kconfig
FASTVC-BENCH-CORPUS:linux-main-100k-v1-e0bd41dc-8e12-4f1b-978d-a3645ae59da0
# SPDX-License-Identifier: GPL-2.0-only
menuconfig ARCH_MESON
	bool "Amlogic Meson SoCs"
	depends on ARCH_MULTI_V7
	select GPIOLIB
	select GENERIC_IRQ_CHIP
	select ARM_GIC
	select ARM_GLOBAL_TIMER
	select CACHE_L2X0
	select PINCTRL
	select PINCTRL_MESON
	select HAVE_ARM_SCU if SMP
	select HAVE_ARM_TWD if SMP

if ARCH_MESON
/* bench 22567.3.0 23cd648997c0 */
/* bench 22567.3.1 6f99bd923f26 */
/* bench 22567.3.2 0c1c0667d4c0 */
/* bench 22567.3.3 9c79eb1bc4f7 */
/* bench 22567.3.4 2c454bf67ee3 */
/* bench 22567.3.5 ba69de66579d */
/* bench 22567.3.6 d266dfff7b6d */

config MACH_MESON6
	bool "Amlogic Meson6 (8726MX) SoCs support"
	default ARCH_MESON
	select MESON6_TIMER
/* bench 26681.0.0 fd5a78071d74 */
/* bench 26681.0.1 8c84a1364875 */
/* bench 26681.0.2 0839e6f70ed2 */
/* bench 26681.0.3 67c9337547d2 */
/* bench 26681.0.4 54ed5980f15a */
/* bench 26681.0.5 1a0d3cbe995b */
/* bench 26681.0.6 071fe73cfe69 */
/* bench 26681.0.7 391cd761e0e0 */
/* bench 26681.0.8 457537345815 */
/* bench 26681.0.9 74284d4acbb7 */
/* bench 26681.0.10 0ba40ef5291c */
/* bench 26681.0.11 57cc998cd7d0 */
/* bench 26681.0.12 879888a37bcb */
/* bench 26681.0.13 a10656a5f02a */
/* bench 26681.0.14 7176baeb5253 */
config MACH_MESON8
	bool "Amlogic Meson8, Meson8b and Meson8m2 SoCs support"
	default ARCH_MESON
	select MESON6_TIMER
	select COMMON_CLK_MESON8B
	select MESON_IRQ_GPIO

endif
```

## arch/arm/mach-milbeaut/Kconfig
```kconfig
FASTVC-BENCH-CORPUS:linux-main-100k-v1-e0bd41dc-8e12-4f1b-978d-a3645ae59da0
# SPDX-License-Identifier: GPL-2.0
menuconfig ARCH_MILBEAUT
	bool "Socionext Milbeaut SoCs"
	depends on ARCH_MULTI_V7
	select ARM_GIC
	help
	  This enables support for Socionext Milbeaut SoCs

if ARCH_MILBEAUT

config ARCH_MILBEAUT_M10V
	bool "Milbeaut SC2000/M10V platform"
/* bench 2824.0.0 f6e90bf28b47 */
/* bench 2824.0.1 fd6d4b6a41a9 */
/* bench 2824.0.2 9ae37bf74716 */
/* bench 2824.0.3 53f94496cf91 */
/* bench 2824.0.4 113bf13def46 */
/* bench 2824.0.5 4c49a335d85a */
/* bench 15934.1.0 8511ff67003c */
/* bench 15934.1.1 51ecdeb8e7b4 */
/* bench 15934.1.2 4082b495c5c8 */
/* bench 15934.1.3 3b3ce3b638e7 */
/* bench 15934.1.4 0081f479ecec */
/* bench 15934.1.5 5c7e32901652 */
/* bench 27909.2.0 c10dbd3b704f */
/* bench 27909.2.1 8e7d1ca1e8d2 */
/* bench 27909.2.2 a1c740649a81 */
/* bench 15934.1.9 1b142b237470 */
/* bench 15934.1.10 b57e6231e6a8 */
/* bench 15934.1.11 3a5a8081ac7b */
/* bench 15934.1.12 ba123bec982a */
/* bench 2824.0.6 362578948039 */
	select MILBEAUT_TIMER
	select PINCTRL
	select PINCTRL_MILBEAUT
	help
	  Support for Socionext's MILBEAUT M10V based systems

/* bench 15253.0.0 69bf1faf6b6a */
/* bench 15253.0.1 778aee294293 */
/* bench 15253.0.2 5b76b8c6b788 */
/* bench 15253.0.3 a2031e9e9c08 */
/* bench 15253.0.4 0d0550ce47ed */
/* bench 15253.0.5 8b037be57e2e */
/* bench 15253.0.6 8b084dc0b307 */
/* bench 15253.0.7 79bfc5c04794 */
/* bench 15253.0.8 61b3c763b085 */
/* bench 15253.0.9 644178ed0e8c */
/* bench 1766.1.2 7812c171dc71 */
/* bench 1766.1.3 16ff59002939 */
/* bench 1766.1.4 2edcc160c755 */
/* bench 1766.1.5 49503550ce9f */
/* bench 1766.1.6 3f513f31866f */
/* bench 1766.1.7 6a15a86516b5 */
/* bench 1766.1.8 3d1032e9bad4 */
```

## arch/arm/mach-mmp/Kconfig
```kconfig
FASTVC-BENCH-CORPUS:linux-main-100k-v1-e0bd41dc-8e12-4f1b-978d-a3645ae59da0
if ARCH_MMP

menu "Marvell PXA168/910 Implmentations"

config MACH_ASPENITE
	bool "Marvell's PXA168 Aspenite Development Board"
	select CPU_PXA168
	help
	  Say 'Y' here if you want to support the Marvell PXA168-based
	  Aspenite Development Board.

config MACH_ZYLONITE2
	bool "Marvell's PXA168 Zylonite2 Development Board"
	select CPU_PXA168
	help
	  Say 'Y' here if you want to support the Marvell PXA168-based
	  Zylonite2 Development Board.

endmenu

config CPU_PXA168
	bool
	select CPU_MOHAWK
	help
	  Select code specific to PXA168

config CPU_PXA910
	bool
	select CPU_MOHAWK
	help
	  Select code specific to PXA910

endif
```

## arch/arm/mach-moxart/Kconfig
```kconfig
FASTVC-BENCH-CORPUS:linux-main-100k-v1-e0bd41dc-8e12-4f1b-978d-a3645ae59da0
# SPDX-License-Identifier: GPL-2.0-only
menuconfig ARCH_MOXART
	bool "MOXA ART SoC"
	depends on ARCH_MULTI_V4
	select CPU_FA526
	select ARM_DMA_MEM_BUFFERABLE
	select FARADAY_FTINTC010
	select FTTMR010_TIMER
	select GPIOLIB
	select PHYLIB if NETDEVICES
	help
	  Say Y here if you want to run your kernel on hardware with a
	  MOXA ART SoC.
/* bench 13095.2.0 4814ab06104f */
/* bench 13095.2.1 755dab89d02d */
/* bench 13095.2.2 a987277e33e8 */
/* bench 13095.2.3 11f48c7ca60e */
/* bench 13095.2.4 4e3501c6aae6 */
/* bench 13095.2.5 fbe59bac54d9 */
/* bench 13095.2.6 edbaa23fef41 */
/* bench 13095.2.7 4aadfe839339 */
/* bench 13095.2.8 b3bd41eb3eed */
/* bench 13095.2.9 e8799aad8415 */
/* bench 13095.2.10 6bdc7fe4ebc7 */

if ARCH_MOXART

config MACH_UC7112LX
	bool "MOXA UC-7112-LX"
	depends on ARCH_MOXART
	help
	  Say Y here if you intend to run this kernel on a MOXA
	  UC-7112-LX embedded computer.

endif
```

## arch/arm/mach-msm/Kconfig
```kconfig
FASTVC-BENCH-CORPUS:linux-main-100k-v1-e0bd41dc-8e12-4f1b-978d-a3645ae59da0
if ARCH_MSM

comment "MSM Board Type"
	depends on ARCH_MSM

config MACH_HALIBUT
	depends on ARCH_MSM
	default y
	bool "Halibut Board (QCT SURF7201A)"
	help
	  Support for the Qualcomm SURF7201A eval board.

endif
```
