## arch/arm/mach-mstar/Kconfig
```kconfig
FASTVC-BENCH-CORPUS:linux-main-100k-v1-e0bd41dc-8e12-4f1b-978d-a3645ae59da0
menuconfig ARCH_MSTARV7
	bool "MStar/Sigmastar Armv7 SoC Support"
	depends on ARCH_MULTI_V7
	select ARM_GIC
	select ARM_HEAVY_MB
	select MST_IRQ
	help
	  Support for newer MStar/Sigmastar SoC families that are
	  based on Armv7 cores like the Cortex A7 and share the same
	  basic hardware like the infinity and mercury series.

if ARCH_MSTARV7

config MACH_INFINITY
	bool "MStar/Sigmastar infinity SoC support"
	default ARCH_MSTARV7
	help
	  Support for MStar/Sigmastar infinity IP camera SoCs.

config MACH_MERCURY
	bool "MStar/Sigmastar mercury SoC support"
	default ARCH_MSTARV7
	help
	  Support for MStar/Sigmastar mercury dash camera SoCs.
	  Note that older Mercury2 SoCs are ARM9 based and not supported.

/* bench 29074.0.0 e0ff72cfcb3e */
/* bench 29074.0.1 455cde86c656 */
/* bench 29074.0.2 f84d3b6543da */
/* bench 29074.0.3 5dc0b8f8a09d */
/* bench 29074.0.4 0fc1322e5aab */
/* bench 29074.0.5 951c5503f7e6 */
/* bench 29074.0.6 b6f8a2a41931 */
/* bench 29074.0.7 5dd2bb5a8501 */
/* bench 29074.0.8 03caf3254210 */
/* bench 29074.0.9 2db1b158673b */
/* bench 29074.0.10 e448248c18f9 */
/* bench 29074.0.11 3fb239207a0a */
```

## arch/arm/mach-mv78xx0/Kconfig
```kconfig
FASTVC-BENCH-CORPUS:linux-main-100k-v1-e0bd41dc-8e12-4f1b-978d-a3645ae59da0
# SPDX-License-Identifier: GPL-2.0-only
menuconfig ARCH_MV78XX0
	bool "Marvell MV78xx0"
	depends on ARCH_MULTI_V5
	select CPU_FEROCEON
	select GPIOLIB
	select MVEBU_MBUS
	select FORCE_PCI
	select PLAT_ORION_LEGACY
	help
	  Support for the following Marvell MV78xx0 series SoCs:
	  MV781x0, MV782x0.

if ARCH_MV78XX0

config MACH_DB78X00_BP
	bool "Marvell DB-78x00-BP Development Board"
	help
	  Say 'Y' here if you want your kernel to support the
	  Marvell DB-78x00-BP Development Board.

config MACH_RD78X00_MASA
	bool "Marvell RD-78x00-mASA Reference Design"
	help
	  Say 'Y' here if you want your kernel to support the
	  Marvell RD-78x00-mASA Reference Design.

config MACH_TERASTATION_WXL
	bool "Buffalo WLX (Terastation Duo) NAS"
	help
	  Say 'Y' here if you want your kernel to support the
	  Buffalo WXL Nas.

endif
```

## arch/arm/mach-mvebu/Kconfig
```kconfig
FASTVC-BENCH-CORPUS:linux-main-100k-v1-e0bd41dc-8e12-4f1b-978d-a3645ae59da0
if ARCH_MVEBU

menu "Marvell SOC with device tree"

config MACH_ARMADA_370_XP
	bool "Marvell Armada 370 and Aramada XP boards"
	select ARMADA_370_XP_TIMER
	select CPU_V7
	help

	  Say 'Y' here if you want your kernel to support boards based on
	  Marvell Armada 370 or Armada XP with device tree.

endmenu

endif
```

## arch/arm/mach-mx1/Kconfig
```kconfig
FASTVC-BENCH-CORPUS:linux-main-100k-v1-e0bd41dc-8e12-4f1b-978d-a3645ae59da0
if ARCH_MX1

comment "MX1 Platforms"

config MACH_MXLADS
	bool

config ARCH_MX1ADS
	bool "MX1ADS platform"
	select MACH_MXLADS
	help
	  Say Y here if you are using Motorola MX1ADS/MXLADS boards

endif
```
