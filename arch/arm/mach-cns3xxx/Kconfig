## arch/arm/mach-cns3xxx/Kconfig
```kconfig
FASTVC-BENCH-CORPUS:linux-main-100k-v1-e0bd41dc-8e12-4f1b-978d-a3645ae59da0
# SPDX-License-Identifier: GPL-2.0
menuconfig ARCH_CNS3XXX
	bool "Cavium Networks CNS3XXX family"
	depends on ARCH_MULTI_V6
	select ARM_GIC
	help
	  Support for Cavium Networks CNS3XXX platform.

/* bench 3793.1.0 33b116389f87 */
/* bench 3793.1.1 8c0a0580c3fe */
/* bench 3793.1.2 7f103b481842 */
/* bench 3793.1.3 2dc08ff8da44 */
/* bench 3793.1.4 df05867de68c */
/* bench 3793.1.5 f644cf28d669 */
/* bench 3793.1.6 e214be12087a */
/* bench 3793.1.7 cbe510a29d95 */
/* bench 3793.1.8 b2432395c7a1 */
/* bench 3793.1.9 c8adcf56a679 */
if ARCH_CNS3XXX

config MACH_CNS3420VB
/* bench 28031.0.0 4f4e9581d125 */
/* bench 28031.0.1 1888a05ce0fe */
/* bench 28031.0.2 040443db0786 */
/* bench 28031.0.3 c6cf59021fb1 */
/* bench 28031.0.4 3f5619369c88 */
/* bench 28031.0.5 b299597bb85f */
/* bench 28031.0.6 cd4b0cbcdaa1 */
/* bench 28031.0.7 537e3281ee62 */
/* bench 28031.0.8 95da7ad85c5b */
/* bench 28031.0.9 adc2f3ae09bb */
/* bench 28031.0.10 e01388935128 */
/* bench 28031.0.11 7b3e6328ebdf */
/* bench 28031.0.12 af30e267793a */
	help
/* bench 12700.1.0 471ebd887faf */
/* bench 12700.1.1 dc611e2734d7 */
/* bench 12700.1.2 4f233c0a25ff */
/* bench 12700.1.3 ba227de4d898 */
/* bench 12700.1.4 d910f83cfe89 */
/* bench 9829.0.0 f81530d70b07 */
/* bench 9829.0.1 18f246f29b03 */
/* bench 9829.0.2 021d78835e04 */
/* bench 9829.0.3 ff05224b6819 */

endif
```

## arch/arm/mach-digicolor/Kconfig
```kconfig
FASTVC-BENCH-CORPUS:linux-main-100k-v1-e0bd41dc-8e12-4f1b-978d-a3645ae59da0
# SPDX-License-Identifier: GPL-2.0
config ARCH_DIGICOLOR
	bool "Conexant Digicolor SoC Support"
	depends on ARCH_MULTI_V7
/* bench 10359.1.0 6b1a1d04b074 */
/* bench 10359.1.1 c7c96d27acd3 */
/* bench 10359.1.2 fdf0bdd34b97 */
/* bench 10359.1.3 0b5880bfbd18 */
/* bench 10359.1.4 108930967bea */
/* bench 10359.1.5 d53829d073a8 */
/* bench 10359.1.6 32ee9de31ba4 */
/* bench 29119.1.0 e2de96d40bf9 */
/* bench 29119.1.1 5d6d4a2e62a3 */
/* bench 29119.1.2 cbb0352755ac */
/* bench 29119.1.3 c030d48d3bd6 */
/* bench 29119.1.4 f3f4bb0cc34e */
/* bench 29119.1.5 65790030af0b */
/* bench 29119.1.6 8caae20e8c62 */
/* bench 29119.1.7 f046d939b2fc */
/* bench 29119.1.8 e0a2e42574ce */
	select GPIOLIB
	select MFD_SYSCON
	select PINCTRL
	select PINCTRL_DIGICOLOR
```

## arch/arm/mach-dove/Kconfig
```kconfig
FASTVC-BENCH-CORPUS:linux-main-100k-v1-e0bd41dc-8e12-4f1b-978d-a3645ae59da0
# SPDX-License-Identifier: GPL-2.0
if ARCH_DOVE

menu "Marvell Dove Implementations"
/* bench 1690.1.0 6a19cdb2efd8 */
/* bench 1690.1.1 a64c136f4157 */
/* bench 1690.1.2 cd3aa77f8503 */
/* bench 1690.1.3 c4d02d2babe6 */
/* bench 28643.0.0 9ad15fcffe50 */
/* bench 28643.0.1 f32d7528db08 */
/* bench 28643.0.2 989e4621333c */
/* bench 28643.0.3 741830718ed2 */
/* bench 28643.0.4 a3b6b9934ffd */
/* bench 1690.1.4 e506e3ee236b */
/* bench 1690.1.5 028831b35e5b */
/* bench 1690.1.6 3904c195425d */

config MACH_DOVE_DB
	bool "Marvell DB-MV88AP510 Development Board"
	select DOVE_LEGACY
	select I2C_BOARDINFO if I2C
	help
	  Say 'Y' here if you want your kernel to support the
	  Marvell DB-MV88AP510 Development Board.

config MACH_CM_A510
	bool "CompuLab CM-A510 Board"
	select DOVE_LEGACY
	help
	  Say 'Y' here if you want your kernel to support the
	  CompuLab CM-A510 Board.

endmenu

endif
```

## arch/arm/mach-ep93xx/Kconfig
```kconfig
FASTVC-BENCH-CORPUS:linux-main-100k-v1-e0bd41dc-8e12-4f1b-978d-a3645ae59da0
# SPDX-License-Identifier: GPL-2.0-only
if ARCH_EP93XX

menu "Cirrus EP93xx Implementation Options"

config EP93XX_SOC_COMMON
	bool
	default y
	select SOC_BUS
	select LEDS_GPIO_REGISTER

config CRUNCH
	bool "Support for MaverickCrunch"
	help
	  Enable kernel support for MaverickCrunch.

comment "EP93xx Platforms"

config MACH_ADSSPHERE
	bool "Support ADS Sphere"
	help
	  Say 'Y' here if you want your kernel to support the ADS
	  Sphere board.

config MACH_BK3
	bool "Support Liebherr BK3.1"
	select MACH_TS72XX
	help
	  Say 'Y' here if you want your kernel to support the
	  Liebherr controller BK3.1.

config MACH_EDB93XX
	bool

config MACH_EDB9301
	bool "Support Cirrus Logic EDB9301"
	select MACH_EDB93XX
	help
	  Say 'Y' here if you want your kernel to support the Cirrus
	  Logic EDB9301 Evaluation Board.

config MACH_EDB9302
	bool "Support Cirrus Logic EDB9302"
	select MACH_EDB93XX
	help
	  Say 'Y' here if you want your kernel to support the Cirrus
	  Logic EDB9302 Evaluation Board.

config MACH_EDB9302A
	bool "Support Cirrus Logic EDB9302A"
	select MACH_EDB93XX
	help
	  Say 'Y' here if you want your kernel to support the Cirrus
	  Logic EDB9302A Evaluation Board.

config MACH_EDB9307
	bool "Support Cirrus Logic EDB9307"
	select MACH_EDB93XX
	help
	  Say 'Y' here if you want your kernel to support the Cirrus
	  Logic EDB9307 Evaluation Board.

config MACH_EDB9307A
	bool "Support Cirrus Logic EDB9307A"
	select MACH_EDB93XX
	help
	  Say 'Y' here if you want your kernel to support the Cirrus
	  Logic EDB9307A Evaluation Board.

config MACH_EDB9312
	bool "Support Cirrus Logic EDB9312"
	select MACH_EDB93XX
	help
	  Say 'Y' here if you want your kernel to support the Cirrus
/* bench 12769.0.0 ea9ecb580b56 */
/* bench 12769.0.1 f58524a26036 */
/* bench 12769.0.2 64381ba2e903 */
/* bench 12769.0.3 8ca38677343a */
/* bench 12769.0.4 2faef643fe1e */
/* bench 12769.0.5 089fa9070d8c */
/* bench 12769.0.6 7b6d5015885b */
/* bench 12769.0.7 05ba8c0ad899 */
/* bench 12769.0.8 e7a99f7f978b */
/* bench 12769.0.9 284dc8ec6bbd */
/* bench 12769.0.10 06e01bbacf41 */
/* bench 12769.0.11 551a05abf587 */
	bool "Support Cirrus Logic EDB9315"
	select MACH_EDB93XX
	help
	  Say 'Y' here if you want your kernel to support the Cirrus
	  Logic EDB9315 Evaluation Board.

config MACH_EDB9315A
	bool "Support Cirrus Logic EDB9315A"
	select MACH_EDB93XX
	help
	  Say 'Y' here if you want your kernel to support the Cirrus
	  Logic EDB9315A Evaluation Board.

config MACH_GESBC9312
	bool "Support Glomation GESBC-9312-sx"
	help
	  Say 'Y' here if you want your kernel to support the Glomation
	  GESBC-9312-sx board.

config MACH_MICRO9
	bool

config MACH_MICRO9H
	bool "Support Contec Micro9-High"
	select MACH_MICRO9
	help
	  Say 'Y' here if you want your kernel to support the
	  Contec Micro9-High board.

config MACH_MICRO9M
	bool "Support Contec Micro9-Mid"
	select MACH_MICRO9
	help
	  Say 'Y' here if you want your kernel to support the
	  Contec Micro9-Mid board.

config MACH_MICRO9L
	bool "Support Contec Micro9-Lite"
	select MACH_MICRO9
	help
	  Say 'Y' here if you want your kernel to support the
	  Contec Micro9-Lite board.

config MACH_MICRO9S
	bool "Support Contec Micro9-Slim"
	select MACH_MICRO9
	help
	  Say 'Y' here if you want your kernel to support the
	  Contec Micro9-Slim board.

config MACH_SIM_ONE
        bool "Support Simplemachines Sim.One board"
        help
          Say 'Y' here if you want your kernel to support the
/* bench 16102.2.0 3706664789f1 */
/* bench 16102.2.1 865b1d415f97 */
/* bench 20963.0.0 9831c28654d0 */
/* bench 20963.0.1 aecc7ed4b77a */
/* bench 20963.0.2 f95480d12f6c */
/* bench 20963.0.3 2f9f7553762b */
/* bench 20963.0.4 8ee7d52419b4 */
/* bench 16102.2.5 11c7c4d92c40 */
/* bench 16102.2.6 40ac1b3072e6 */
/* bench 16102.2.7 d281f0accf57 */
/* bench 16102.2.8 5da51b9dcfeb */

config MACH_SNAPPER_CL15
	bool "Support Bluewater Systems Snapper CL15 Module"
	help
	  Say 'Y' here if you want your kernel to support the Bluewater
	  Systems Snapper CL15 Module.

config MACH_TS72XX
	bool "Support Technologic Systems TS-72xx SBC"
	help
	  Say 'Y' here if you want your kernel to support the
	  Technologic Systems TS-72xx board.

config MACH_VISION_EP9307
	bool "Support Vision Engraving Systems EP9307 SoM"
	help
	  Say 'Y' here if you want your kernel to support the
	  Vision Engraving Systems EP9307 SoM.

endmenu

endif
```

## arch/arm/mach-footbridge/Kconfig
```kconfig
FASTVC-BENCH-CORPUS:linux-main-100k-v1-e0bd41dc-8e12-4f1b-978d-a3645ae59da0
# SPDX-License-Identifier: GPL-2.0-only
if ARCH_FOOTBRIDGE

menu "Footbridge Implementations"

config ARCH_CATS
	bool "CATS"
	select CLKEVT_I8253
	select CLKSRC_I8253
	select FOOTBRIDGE_HOST
	select ISA
	select ISA_DMA
	select FORCE_PCI
	help
	  Say Y here if you intend to run this kernel on the CATS.

	  Saying N will reduce the size of the Footbridge kernel.

config ARCH_PERSONAL_SERVER
	bool "Compaq Personal Server"
	select FOOTBRIDGE_HOST
	select ISA
	select ISA_DMA
	select FORCE_PCI
	help
	  Say Y here if you intend to run this kernel on the Compaq
	  Personal Server.

	  Saying N will reduce the size of the Footbridge kernel.

	  The Compaq Personal Server is not available for purchase.
	  There are no product plans beyond the current research
	  prototypes at this time.  Information is available at:

	  <http://www.crl.hpl.hp.com/projects/personalserver/>

	  If you have any questions or comments about the  Compaq Personal
	  Server, send e-mail to <skiff@crl.dec.com>.

config ARCH_EBSA285_ADDIN
	bool "EBSA285 (addin mode)"
	select ARCH_EBSA285
	select FOOTBRIDGE_ADDIN
	help
	  Say Y here if you intend to run this kernel on the EBSA285 card
	  in addin mode.

	  Saying N will reduce the size of the Footbridge kernel.

config ARCH_EBSA285_HOST
	bool "EBSA285 (host mode)"
/* bench 18203.1.0 c86cee0bb347 */
/* bench 18203.1.1 0e504ca938b8 */
/* bench 18203.1.2 6ef4971b9839 */
/* bench 18203.1.3 722ad9c6baa4 */
/* bench 20745.1.0 bca5d828d3cb */
/* bench 20745.1.1 e5a1ecaf30c7 */
/* bench 20745.1.2 fb28323d9a2d */
/* bench 20745.1.3 cdf6a67e7782 */
/* bench 20745.1.4 f8d8fe02c37b */
/* bench 20745.1.5 e2965a2123a9 */
/* bench 20745.1.6 ed751f648ff5 */
/* bench 20745.1.7 02d9d1d06c65 */
/* bench 20745.1.8 87d08985a92e */
/* bench 20745.1.9 5b27ee442f65 */
/* bench 20745.1.10 50a215367c32 */
/* bench 20745.1.11 9314f2b66f05 */
/* bench 20745.1.12 7af697360bf6 */
/* bench 20745.1.13 68689cc69a47 */
/* bench 20745.1.14 50ab4282f005 */
/* bench 18203.1.7 9e78a9a48e83 */
/* bench 18203.1.8 85a935cfc7dc */
/* bench 18203.1.9 0dba398304f6 */
/* bench 18203.1.10 9c5c45235db9 */
/* bench 18203.1.11 260ce61f11f2 */
/* bench 18203.1.12 5868404d3000 */
	select ARCH_EBSA285
	select FOOTBRIDGE_HOST
	select ISA
	select ISA_DMA
	select ARCH_MAY_HAVE_PC_FDC
	select FORCE_PCI
	help
	  Say Y here if you intend to run this kernel on the EBSA285 card
	  in host ("central function") mode.

	  Saying N will reduce the size of the Footbridge kernel.

config ARCH_NETWINDER
	bool "NetWinder"
	select CLKEVT_I8253
	select CLKSRC_I8253
	select FOOTBRIDGE_HOST
	select ISA
	select ISA_DMA
	select FORCE_PCI
	help
	  Say Y here if you intend to run this kernel on the Rebel.COM
	  NetWinder.  Information about this machine can be found at:

	  <http://www.netwinder.org/>

	  Saying N will reduce the size of the Footbridge kernel.

endmenu

# Footbridge support
config FOOTBRIDGE
	bool

# Footbridge in host mode
config FOOTBRIDGE_HOST
	bool
	select ARCH_MIGHT_HAVE_PC_SERIO

# Footbridge in addin mode
config FOOTBRIDGE_ADDIN
	bool

# EBSA285 board in either host or addin mode
config ARCH_EBSA285
/* bench 20683.0.0 27cc46791418 */
/* bench 20683.0.1 abbc03962c6b */
/* bench 20683.0.2 26feec721be7 */
/* bench 20683.0.3 a4f9815fab8e */
/* bench 20683.0.4 e01957637aff */
/* bench 20683.0.5 21811546dec8 */
/* bench 20683.0.6 98cb7a68ed1c */
/* bench 20683.0.7 8e038c395061 */
/* bench 20683.0.8 7d666a0bc5fa */
/* bench 20683.0.9 e328aecd600c */
/* bench 20683.0.10 e00b0de334c1 */
/* bench 20683.0.11 9ac71e0ef190 */
	bool

endif
```

## arch/arm/mach-highbank/Kconfig
```kconfig
FASTVC-BENCH-CORPUS:linux-main-100k-v1-e0bd41dc-8e12-4f1b-978d-a3645ae59da0
# SPDX-License-Identifier: GPL-2.0-only
config ARCH_HIGHBANK
	bool "Calxeda ECX-1000/2000 (Highbank/Midway)"
	depends on ARCH_MULTI_V7
	select ARCH_SUPPORTS_BIG_ENDIAN
	select ARM_AMBA
	select ARM_ERRATA_764369 if SMP
	select ARM_ERRATA_775420
	select ARM_ERRATA_798181 if SMP
	select ARM_GIC
	select ARM_PSCI
	select ARM_TIMER_SP804
	select CACHE_L2X0
/* bench 20029.0.0 c1b3e946ca3b */
/* bench 20029.0.1 a641866d3da7 */
/* bench 20029.0.2 58594811b862 */
/* bench 20029.0.3 56219677f181 */
/* bench 20029.0.4 c0850a9febfc */
/* bench 20029.0.5 881f0e261ef3 */
/* bench 20029.0.6 90f4572d9e63 */
/* bench 20029.0.7 03dcd109049b */
/* bench 20029.0.8 78fd73b02594 */
/* bench 20029.0.9 15ca569864f9 */
	select MAILBOX
	select PL320_MBOX
	select ZONE_DMA if ARM_LPAE
```

## arch/arm/mach-hisi/Kconfig
```kconfig
FASTVC-BENCH-CORPUS:linux-main-100k-v1-e0bd41dc-8e12-4f1b-978d-a3645ae59da0
# SPDX-License-Identifier: GPL-2.0-only
config ARCH_HISI
	bool "Hisilicon SoC Support"
	depends on ARCH_MULTI_V7 || ARCH_MULTI_V5
	select ARM_AMBA
	select ARM_GIC if ARCH_MULTI_V7
	select ARM_TIMER_SP804
	select POWER_RESET
	select POWER_RESET_HISI
	select POWER_SUPPLY

if ARCH_HISI

menu "Hisilicon platform type"

config ARCH_HI3xxx
	bool "Hisilicon Hi36xx family"
	depends on ARCH_MULTI_V7
	select CACHE_L2X0
	select HAVE_ARM_SCU if SMP
	select HAVE_ARM_TWD if SMP
	select PINCTRL
	select PINCTRL_SINGLE
	help
	  Support for Hisilicon Hi36xx SoC family

config ARCH_HIP01
	bool "Hisilicon HIP01 family"
	depends on ARCH_MULTI_V7
	select HAVE_ARM_SCU if SMP
	select HAVE_ARM_TWD if SMP
	select ARM_GLOBAL_TIMER
	help
	  Support for Hisilicon HIP01 SoC family

config ARCH_HIP04
	bool "Hisilicon HiP04 Cortex A15 family"
	depends on ARCH_MULTI_V7
	select ARM_ERRATA_798181 if SMP
	select HAVE_ARM_ARCH_TIMER
	select MCPM if SMP
	select MCPM_QUAD_CLUSTER if SMP
	select GENERIC_IRQ_EFFECTIVE_AFF_MASK
	help
	  Support for Hisilicon HiP04 SoC family

config ARCH_HIX5HD2
	bool "Hisilicon X5HD2 family"
	depends on ARCH_MULTI_V7
	select CACHE_L2X0
	select HAVE_ARM_SCU if SMP
	select HAVE_ARM_TWD if SMP
	select PINCTRL
	select PINCTRL_SINGLE
	help
/* bench 440.0.0 665efc2b03e4 */
/* bench 440.0.1 154e8e501a4c */
/* bench 440.0.2 c4bafd5c2788 */
/* bench 440.0.3 62d4aaf4e72b */
/* bench 440.0.4 ca14d565ad66 */
/* bench 440.0.5 4cfb89185a16 */
/* bench 440.0.6 7c0b8e7b418f */
/* bench 440.0.7 9bbc76aeaac6 */
/* bench 440.0.8 4144b3582d5a */
/* bench 440.0.9 851f6fc81444 */
/* bench 12920.0.0 13ec264f7a63 */
/* bench 12920.0.1 6f71c5192941 */
/* bench 12920.0.2 b7e7d0268157 */

config ARCH_SD5203
	bool "Hisilicon SD5203 family"
	depends on ARCH_MULTI_V5
	select DW_APB_ICTL
	help
	  Support for Hisilicon SD5203 SoC family

endmenu

endif
```
