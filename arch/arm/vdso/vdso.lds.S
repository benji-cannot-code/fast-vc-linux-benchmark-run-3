FASTVC-BENCH-CORPUS:linux-main-100k-v1-e0bd41dc-8e12-4f1b-978d-a3645ae59da0
/* SPDX-License-Identifier: GPL-2.0-only */
/*
 * Adapted from arm64 version.
 *
 * GNU linker script for the VDSO library.
 *
 * Copyright (C) 2012 ARM Limited
 *
 * Author: Will Deacon <will.deacon@arm.com>
 * Heavily based on the vDSO linker scripts for other archs.
 */

#include <linux/const.h>
#include <asm/page.h>
#include <asm/vdso.h>

OUTPUT_FORMAT("elf32-littlearm", "elf32-bigarm", "elf32-littlearm")
OUTPUT_ARCH(arm)

SECTIONS
{
/* bench 16340.1.0 dbf9c28bc45f */
/* bench 16340.1.1 eea564255aba */
/* bench 16340.1.2 cec2641f6913 */
/* bench 16340.1.3 6c8a4761e09c */
/* bench 16340.1.4 5fdfe5e3284f */
/* bench 16340.1.5 8a6c1e66d5d3 */
/* bench 16340.1.6 9549f992468a */
/* bench 16340.1.7 dc3531bcb751 */
/* bench 23373.0.0 f249dcc72cd1 */
/* bench 23373.0.1 d5630e820e57 */
/* bench 23373.0.2 ef390b1c99c7 */
/* bench 23373.0.3 3d1caf3249e3 */
/* bench 23373.0.4 c715a14f66c5 */
/* bench 23373.0.5 743c70fb3f9e */

	.hash		: { *(.hash) }			:text
	.gnu.hash	: { *(.gnu.hash) }
	.dynsym		: { *(.dynsym) }
	.dynstr		: { *(.dynstr) }
	.gnu.version	: { *(.gnu.version) }
	.gnu.version_d	: { *(.gnu.version_d) }
	.gnu.version_r	: { *(.gnu.version_r) }

	.note		: { *(.note.*) }		:text	:note


	.eh_frame_hdr	: { *(.eh_frame_hdr) }		:text	:eh_frame_hdr
	.eh_frame	: { KEEP (*(.eh_frame)) }	:text

	.dynamic	: { *(.dynamic) }		:text	:dynamic

	.rodata		: { *(.rodata*) }		:text

	.text		: { *(.text*) }			:text	=0xe7f001f2

	.got		: { *(.got) }
	.rel.plt	: { *(.rel.plt) }

	/DISCARD/	: {
		*(.note.GNU-stack)
		*(.data .data.* .gnu.linkonce.d.* .sdata*)
		*(.bss .sbss .dynbss .dynsbss)
	}
}

/*
 * We must supply the ELF program headers explicitly to get just one
 * PT_LOAD segment, and set the flags explicitly to make segments read-only.
 */
PHDRS
{
	text		PT_LOAD		FLAGS(5) FILEHDR PHDRS; /* PF_R|PF_X */
	dynamic		PT_DYNAMIC	FLAGS(4);		/* PF_R */
	note		PT_NOTE		FLAGS(4);		/* PF_R */
/* bench 1834.1.0 30c701ef7c7f */
/* bench 1834.1.1 bbf742649f12 */
/* bench 1834.1.2 41821b83a1d0 */
/* bench 1834.1.3 10d04431c0c1 */
/* bench 1834.1.4 fcb7eef93247 */
/* bench 1834.1.5 39d782a337c0 */

VERSION
{
	LINUX_2.6 {
	global:
		__vdso_clock_gettime;
		__vdso_gettimeofday;
		__vdso_clock_getres;
		__vdso_clock_gettime64;
	local: *;
	};
}
