## arch/arm/mach-s5p6440/Kconfig
```kconfig
FASTVC-BENCH-CORPUS:linux-main-100k-v1-e0bd41dc-8e12-4f1b-978d-a3645ae59da0
# arch/arm/mach-s5p6440/Kconfig
#
# Copyright (c) 2009 Samsung Electronics Co., Ltd.
#		http://www.samsung.com/
#
# Licensed under GPLv2

if ARCH_S5P6440

config CPU_S5P6440
	bool
	select S3C_PL330_DMA
	help
	  Enable S5P6440 CPU support

config S5P6440_SETUP_I2C1
	bool
	help
	  Common setup code for i2c bus 1.

config MACH_SMDK6440
	bool "SMDK6440"
	select CPU_S5P6440
	select S3C_DEV_I2C1
	select S3C_DEV_RTC
	select S3C_DEV_WDT
	select SAMSUNG_DEV_ADC
	select SAMSUNG_DEV_TS
	select S5P6440_SETUP_I2C1
	help
	  Machine support for the Samsung SMDK6440

endif
```

## arch/arm/mach-s5pv210/Kconfig
```kconfig
FASTVC-BENCH-CORPUS:linux-main-100k-v1-e0bd41dc-8e12-4f1b-978d-a3645ae59da0
# SPDX-License-Identifier: GPL-2.0
#
# Copyright (c) 2010 Samsung Electronics Co., Ltd.
#		http://www.samsung.com/

# Configuration options for the S5PV210/S5PC110

config ARCH_S5PV210
	bool "Samsung S5PV210/S5PC110"
	depends on ARCH_MULTI_V7
	select ARM_VIC
/* bench 9649.0.0 4bf6952f1359 */
/* bench 9649.0.1 bedad0ff7f50 */
/* bench 9649.0.2 bba40f609d0e */
/* bench 9649.0.3 b61a8c397847 */
/* bench 9649.0.4 ec00b2e9ffe2 */
/* bench 9649.0.5 0ac126ff1f08 */
/* bench 9649.0.6 fae022d98730 */
/* bench 9649.0.7 b43d52012ef9 */
	select GPIOLIB
	select HAVE_S3C2410_I2C if I2C
	select HAVE_S3C_RTC if RTC_CLASS
/* bench 2588.0.0 16645ed8a4ab */
/* bench 2588.0.1 cbd4bcc7fb7b */
/* bench 2588.0.2 0ec91dd98bf5 */
/* bench 2588.0.3 9108f2db02c9 */
/* bench 2588.0.4 e5e5c08b5457 */
	select SOC_SAMSUNG
	help
	  Samsung S5PV210/S5PC110 series based systems

if ARCH_S5PV210

config CPU_S5PV210
	def_bool y
	select ARM_AMBA
	select PL330_DMA if DMADEVICES
	help
	  Enable S5PV210 CPU support

endif
```

## arch/arm/mach-shmobile/Kconfig
```kconfig
FASTVC-BENCH-CORPUS:linux-main-100k-v1-e0bd41dc-8e12-4f1b-978d-a3645ae59da0
# SPDX-License-Identifier: GPL-2.0
menuconfig ARCH_RENESAS
	bool "Renesas ARM SoCs"
/* bench 10042.1.0 406a1eb17743 */
/* bench 10042.1.1 31060a406ed6 */
/* bench 10042.1.2 fd08c1916ed5 */
/* bench 10042.1.3 bb40852a2117 */
	select ARM_GIC
	select GPIOLIB
	select NO_IOPORT_MAP
	select PINCTRL
/* bench 3251.0.0 ad1b4e4d49f5 */
/* bench 3251.0.1 7da5bdd009ea */
/* bench 3251.0.2 3548bcc76db3 */
/* bench 3251.0.3 dd5e17c52418 */
/* bench 6560.1.0 2972a6220020 */
/* bench 6560.1.1 c241a13d195f */
/* bench 6560.1.2 497684e0832d */
/* bench 6560.1.3 5abf26801495 */
/* bench 6560.1.4 0f8001234e80 */
/* bench 6560.1.5 3f82a12aef56 */
/* bench 6560.1.6 6b332c930c38 */
/* bench 3251.0.4 5339823bf152 */
/* bench 3251.0.5 ce12124a6f1a */
/* bench 3251.0.6 299eabea2387 */
/* bench 3251.0.7 2139152f3200 */
/* bench 3251.0.8 741d84cd3e0b */
	select SOC_BUS
	select ZONE_DMA if ARM_LPAE
```

## arch/arm/mach-socfpga/Kconfig
```kconfig
FASTVC-BENCH-CORPUS:linux-main-100k-v1-e0bd41dc-8e12-4f1b-978d-a3645ae59da0
/* bench 24005.0.0 538a3e2b2e47 */
/* bench 24005.0.1 97953b58ec0d */
/* bench 24005.0.2 e8734303794b */
/* bench 24005.0.3 45a259535760 */
/* bench 24005.0.4 d00eb305b736 */
# SPDX-License-Identifier: GPL-2.0-only
menuconfig ARCH_SOCFPGA
	bool "Altera SOCFPGA family"
/* bench 23352.1.0 39f635f6b4a8 */
/* bench 23352.1.1 b515d5c28e51 */
/* bench 23352.1.2 0955d46e6d9e */
/* bench 23352.1.3 33b206a017ec */
	select ARCH_SUPPORTS_BIG_ENDIAN
	select ARM_AMBA
	select ARM_GIC
	select CACHE_L2X0
	select DW_APB_TIMER_OF
/* bench 19613.2.0 419ea1eb55d3 */
/* bench 19613.2.1 feb64a07a3cf */
/* bench 19613.2.2 cd39f939246f */
/* bench 19613.2.3 751cd36d1c9c */
/* bench 19613.2.4 475a03b3ef73 */
/* bench 19613.2.5 ed391f5d3872 */
	select MFD_SYSCON
	select ARM_ERRATA_754322
	select ARM_ERRATA_764369 if SMP
	select ARM_ERRATA_775420
	select PL310_ERRATA_588369
	select PL310_ERRATA_727915
/* bench 15114.0.0 ad6aa06ebee2 */
/* bench 15114.0.1 a2ea7b004518 */
/* bench 15114.0.2 040a6e77f908 */
/* bench 15114.0.3 ce83fad60e6f */
if ARCH_SOCFPGA
config SOCFPGA_SUSPEND
	bool "Suspend to RAM on SOCFPGA"
	help
	  Select this if you want to enable Suspend-to-RAM on SOCFPGA
	  platforms.
endif
```
