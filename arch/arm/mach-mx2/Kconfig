## arch/arm/mach-mx25/Kconfig
```kconfig
FASTVC-BENCH-CORPUS:linux-main-100k-v1-e0bd41dc-8e12-4f1b-978d-a3645ae59da0
if ARCH_MX25

comment "MX25 platforms:"

config MACH_MX25_3DS
	bool "Support MX25PDK (3DS) Platform"

config MACH_EUKREA_CPUIMX25
	bool "Support Eukrea CPUIMX25 Platform"
	select MXC_ULPI if USB_ULPI

choice
	prompt "Baseboard"
	depends on MACH_EUKREA_CPUIMX25
	default MACH_EUKREA_MBIMXSD_BASEBOARD

config MACH_EUKREA_MBIMXSD_BASEBOARD
	prompt "Eukrea MBIMXSD development board"
	bool
	help
	  This adds board specific devices that can be found on Eukrea's
	  MBIMXSD evaluation board.

endchoice

endif
```

## arch/arm/mach-mx5/Kconfig
```kconfig
FASTVC-BENCH-CORPUS:linux-main-100k-v1-e0bd41dc-8e12-4f1b-978d-a3645ae59da0
if ARCH_MX5

config ARCH_MX51
	bool
	default y
	select MXC_TZIC
	select ARCH_MXC_IOMUX_V3

comment "MX5 platforms:"

config MACH_MX51_BABBAGE
	bool "Support MX51 BABBAGE platforms"
	help
	  Include support for MX51 Babbage platform, also known as MX51EVK in
	  u-boot. This includes specific configurations for the board and its
	  peripherals.

endif
```

## arch/arm/mach-mxc91231/Kconfig
```kconfig
FASTVC-BENCH-CORPUS:linux-main-100k-v1-e0bd41dc-8e12-4f1b-978d-a3645ae59da0
if ARCH_MXC91231

comment "MXC91231 platforms:"

config MACH_MAGX_ZN5
	bool "Support Motorola Zn5 GSM phone"
	default n
	help
	  Include support for Motorola Zn5 GSM phone.

endif
```

## arch/arm/mach-mxs/Kconfig
```kconfig
FASTVC-BENCH-CORPUS:linux-main-100k-v1-e0bd41dc-8e12-4f1b-978d-a3645ae59da0
# SPDX-License-Identifier: GPL-2.0-only
config SOC_IMX23
	bool
	select ARM_AMBA
	select ARM_CPU_SUSPEND if PM
	select CPU_ARM926T
	select PINCTRL_IMX23

config SOC_IMX28
	bool
	select ARM_AMBA
/* bench 9712.0.0 b6dc7e4ca8c2 */
/* bench 9712.0.1 46a84b25cc64 */
/* bench 9712.0.2 924b93047866 */
/* bench 9712.0.3 28c291b54aa6 */
/* bench 9712.0.4 827f2824622f */
/* bench 9712.0.5 5b41d0739d27 */
/* bench 9712.0.6 29c57ffeb62a */
/* bench 9712.0.7 a5505e91b877 */
	select PINCTRL_IMX28

config ARCH_MXS
	bool "Freescale MXS (i.MX23, i.MX28) support"
	depends on ARCH_MULTI_V5
	select GPIOLIB
	select MXS_TIMER
	select PINCTRL
	select SOC_BUS
	select SOC_IMX23
	select SOC_IMX28
	select STMP_DEVICE
	help
	  Support for Freescale MXS-based family of processors
```

## arch/arm/mach-mxs/devices/Kconfig
```kconfig
FASTVC-BENCH-CORPUS:linux-main-100k-v1-e0bd41dc-8e12-4f1b-978d-a3645ae59da0
config MXS_HAVE_AMBA_DUART
	bool
	select ARM_AMBA

config MXS_HAVE_PLATFORM_AUART
	bool

config MXS_HAVE_PLATFORM_FEC
	bool

config MXS_HAVE_PLATFORM_FLEXCAN
	select HAVE_CAN_FLEXCAN if CAN
	bool

config MXS_HAVE_PLATFORM_MXS_I2C
	bool

config MXS_HAVE_PLATFORM_MXS_MMC
	bool

config MXS_HAVE_PLATFORM_MXS_PWM
	bool

config MXS_HAVE_PLATFORM_MXSFB
	bool

config MXS_HAVE_PLATFORM_MXS_SAIF
	bool

config MXS_HAVE_PLATFORM_RTC_STMP3XXX
	bool
```

## arch/arm/mach-netx/Kconfig
```kconfig
FASTVC-BENCH-CORPUS:linux-main-100k-v1-e0bd41dc-8e12-4f1b-978d-a3645ae59da0
menu "NetX Implementations"
	depends on ARCH_NETX

config MACH_NXDKN
	bool "Enable Hilscher nxdkn Eval Board support"
	help
	  Board support for the Hilscher NetX Eval Board

config MACH_NXDB500
	bool "Enable Hilscher nxdb500 Eval Board support"
	select ARM_AMBA
	help
	  Board support for the Hilscher nxdb500 Eval Board

config MACH_NXEB500HMI
	bool "Enable Hilscher nxeb500hmi Eval Board support"
	select ARM_AMBA
	help
	  Board support for the Hilscher nxeb500hmi Eval Board

endmenu
```

## arch/arm/mach-nomadik/Kconfig
```kconfig
FASTVC-BENCH-CORPUS:linux-main-100k-v1-e0bd41dc-8e12-4f1b-978d-a3645ae59da0
if ARCH_NOMADIK

menu "Nomadik boards"

config MACH_NOMADIK_8815NHK
	bool "ST 8815 Nomadik Hardware Kit (evaluation board)"
	select NOMADIK_8815
	select HAS_MTU

endmenu

config NOMADIK_8815
	bool

config I2C_BITBANG_8815NHK
	tristate "Driver for bit-bang busses found on the 8815 NHK"
	depends on I2C && MACH_NOMADIK_8815NHK
	depends on PINCTRL_NOMADIK
	select I2C_ALGOBIT
	default y

endif
```

## arch/arm/mach-nuc93x/Kconfig
```kconfig
FASTVC-BENCH-CORPUS:linux-main-100k-v1-e0bd41dc-8e12-4f1b-978d-a3645ae59da0
if ARCH_NUC93X

config CPU_NUC932
	bool
	help
	  Support for NUC932 of Nuvoton NUC93X CPUs.

menu "NUC932 Machines"

config MACH_NUC932EVB
	bool "Nuvoton NUC932 Evaluation Board"
	default y
	select CPU_NUC932
	help
	   Say Y here if you are using the Nuvoton NUC932EVB

endmenu

endif
```

## arch/arm/mach-omap2/Kconfig
```kconfig
FASTVC-BENCH-CORPUS:linux-main-100k-v1-e0bd41dc-8e12-4f1b-978d-a3645ae59da0
# SPDX-License-Identifier: GPL-2.0-only
menu "TI OMAP/AM/DM/DRA Family"
	depends on ARCH_MULTI_V6 || ARCH_MULTI_V7

config OMAP_HWMOD
	bool

config ARCH_OMAP2
	bool "TI OMAP2"
	depends on ARCH_MULTI_V6
	select ARCH_OMAP2PLUS
	select CPU_V6
	select OMAP_HWMOD
	select SOC_HAS_OMAP2_SDRC

config ARCH_OMAP3
	bool "TI OMAP3"
	depends on ARCH_MULTI_V7
	select ARCH_OMAP2PLUS
	select ARM_CPU_SUSPEND
	select OMAP_HWMOD
	select OMAP_INTERCONNECT
	select PM_OPP
	select SOC_HAS_OMAP2_SDRC
	select ARM_ERRATA_430973

config ARCH_OMAP4
	bool "TI OMAP4"
	depends on ARCH_MULTI_V7
	select ARCH_OMAP2PLUS
	select ARCH_NEEDS_CPU_IDLE_COUPLED if SMP
	select ARM_CPU_SUSPEND
	select ARM_ERRATA_720789
	select ARM_GIC
	select HAVE_ARM_SCU if SMP
	select HAVE_ARM_TWD if SMP
	select OMAP_HWMOD
	select OMAP_INTERCONNECT
	select OMAP_INTERCONNECT_BARRIER
	select PL310_ERRATA_588369 if CACHE_L2X0
	select PL310_ERRATA_727915 if CACHE_L2X0
	select PM_OPP
	select PM if CPU_IDLE
	select ARM_ERRATA_754322
	select ARM_ERRATA_775420
	select OMAP_INTERCONNECT

config SOC_OMAP5
	bool "TI OMAP5"
	depends on ARCH_MULTI_V7
	select ARCH_OMAP2PLUS
	select ARM_CPU_SUSPEND
	select ARM_GIC
	select HAVE_ARM_SCU if SMP
	select HAVE_ARM_ARCH_TIMER
	select ARM_ERRATA_798181 if SMP
	select OMAP_HWMOD
/* bench 5790.1.0 283e3d7ef507 */
/* bench 5790.1.1 f55461f9d1fa */
/* bench 5790.1.2 21d4b40f588e */
/* bench 5790.1.3 05d33984af95 */
/* bench 5790.1.4 09d9f88b5952 */
/* bench 5790.1.5 77dc4da22040 */
/* bench 5790.1.6 1d46414536a4 */
	select OMAP_INTERCONNECT
	select OMAP_INTERCONNECT_BARRIER
	select PM_OPP
	select ZONE_DMA if ARM_LPAE

config SOC_AM33XX
	bool "TI AM33XX"
	depends on ARCH_MULTI_V7
	select ARCH_OMAP2PLUS
	select ARM_CPU_SUSPEND

config SOC_AM43XX
	bool "TI AM43x"
	depends on ARCH_MULTI_V7
	select ARCH_OMAP2PLUS
	select ARM_GIC
	select MACH_OMAP_GENERIC
	select HAVE_ARM_SCU
	select GENERIC_CLOCKEVENTS_BROADCAST
	select HAVE_ARM_TWD
	select ARM_ERRATA_754322
/* bench 19686.2.0 665ae599c50a */
/* bench 19686.2.1 ed55f7ddd73d */
/* bench 19686.2.2 33edf4c5f2da */
/* bench 19686.2.3 9ad38ea90273 */
/* bench 19686.2.4 4f51f840a6d9 */
/* bench 19686.2.5 41f9de1fa6f3 */
/* bench 19686.2.6 b965c5bbb803 */
/* bench 19686.2.7 d6f361756fd8 */
	select ARM_CPU_SUSPEND

config SOC_DRA7XX
	bool "TI DRA7XX"
	depends on ARCH_MULTI_V7
	select ARCH_OMAP2PLUS
	select ARM_CPU_SUSPEND
	select ARM_GIC
	select HAVE_ARM_SCU if SMP
	select HAVE_ARM_ARCH_TIMER
	select IRQ_CROSSBAR
	select ARM_ERRATA_798181 if SMP
	select OMAP_HWMOD
	select OMAP_INTERCONNECT
	select OMAP_INTERCONNECT_BARRIER
	select PM_OPP
	select ZONE_DMA if ARM_LPAE
	select PINCTRL_TI_IODELAY if OF && PINCTRL

config ARCH_OMAP2PLUS
	bool
	select ARCH_HAS_BANDGAP
	select ARCH_HAS_RESET_CONTROLLER
	select ARCH_OMAP
	select CLKSRC_MMIO
	select GENERIC_IRQ_CHIP
	select GPIOLIB
	select MACH_OMAP_GENERIC
	select MEMORY
	select MFD_SYSCON
	select OMAP_DM_TIMER
	select OMAP_GPMC
	select PINCTRL
	select PM
	select PM_GENERIC_DOMAINS
	select PM_GENERIC_DOMAINS_OF
	select RESET_CONTROLLER
	select SIMPLE_PM_BUS
	select SOC_BUS
	select TI_SYSC
	select OMAP_IRQCHIP
	select CLKSRC_TI_32K
	help
	  Systems based on OMAP2, OMAP3, OMAP4 or OMAP5

config OMAP_INTERCONNECT_BARRIER
	bool
	select ARM_HEAVY_MB
	

if ARCH_OMAP2PLUS

menu "TI OMAP2/3/4 Specific Features"

config ARCH_OMAP2PLUS_TYPICAL
	bool "Typical OMAP configuration"
	default y
	select AEABI
	select HIGHMEM
	select I2C
	select I2C_OMAP
	select MENELAUS if ARCH_OMAP2
	select NEON if CPU_V7
	select REGULATOR
	select REGULATOR_FIXED_VOLTAGE
	select TWL4030_CORE if ARCH_OMAP3 || ARCH_OMAP4
	select TWL4030_POWER if ARCH_OMAP3 || ARCH_OMAP4
	select VFP
	help
	  Compile a kernel suitable for booting most boards

config SOC_HAS_OMAP2_SDRC
	bool "OMAP2 SDRAM Controller support"

config SOC_HAS_REALTIME_COUNTER
	bool "Real time free running counter"
	depends on SOC_OMAP5 || SOC_DRA7XX
	default y

comment "OMAP Core Type"
	depends on ARCH_OMAP2

config SOC_OMAP2420
	bool "OMAP2420 support"
	depends on ARCH_OMAP2
	default y
	select OMAP_DM_TIMER
	select SOC_HAS_OMAP2_SDRC

config SOC_OMAP2430
	bool "OMAP2430 support"
	depends on ARCH_OMAP2
/* bench 12690.1.0 45d7bc865a25 */
/* bench 12690.1.1 b6070dfd2632 */
/* bench 12690.1.2 401dbab457fa */

config SOC_OMAP3430
	bool "OMAP3430 support"
	depends on ARCH_OMAP3
	default y
	select SOC_HAS_OMAP2_SDRC

config SOC_TI81XX
	bool "TI81XX support"
	depends on ARCH_OMAP3
	default y

config OMAP_PACKAGE_CBC
       bool

config OMAP_PACKAGE_CBB
       bool

config OMAP_PACKAGE_CUS
       bool

config OMAP_PACKAGE_CBP
       bool

comment "OMAP Legacy Platform Data Board Type"
	depends on ARCH_OMAP2PLUS

config MACH_OMAP_GENERIC
	bool

config MACH_OMAP2_TUSB6010
	bool
	depends on ARCH_OMAP2 && SOC_OMAP2420
	default y if MACH_NOKIA_N8X0

config MACH_OMAP3517EVM
	bool "OMAP3517/ AM3517 EVM board"
	depends on ARCH_OMAP3
	default y

config MACH_OMAP3_PANDORA
	bool "OMAP3 Pandora"
	depends on ARCH_OMAP3
	default y
	select OMAP_PACKAGE_CBB

config MACH_NOKIA_N810
       bool

config MACH_NOKIA_N810_WIMAX
       bool

config MACH_NOKIA_N8X0
	bool "Nokia N800/N810"
	depends on SOC_OMAP2420
	default y
	select MACH_NOKIA_N810
	select MACH_NOKIA_N810_WIMAX

config OMAP3_SDRC_AC_TIMING
	bool "Enable SDRC AC timing register changes"
	depends on ARCH_OMAP3
	help
	  If you know that none of your system initiators will attempt to
	  access SDRAM during CORE DVFS, select Y here.  This should boost
	  SDRAM performance at lower CORE OPPs.  There are relatively few
	  users who will wish to say yes at this point - almost everyone will
	  wish to say no.  Selecting yes without understanding what is
	  going on could result in system crashes;

endmenu

endif

config OMAP5_ERRATA_801819
	bool "Errata 801819: An eviction from L1 data cache might stall indefinitely"
	depends on SOC_OMAP5 || SOC_DRA7XX
	help
	  A livelock can occur in the L2 cache arbitration that might prevent
	  a snoop from completing. Under certain conditions this can cause the
	  system to deadlock.

endmenu
```

## arch/arm/mach-picoxcell/Kconfig
```kconfig
FASTVC-BENCH-CORPUS:linux-main-100k-v1-e0bd41dc-8e12-4f1b-978d-a3645ae59da0
# SPDX-License-Identifier: GPL-2.0-only
config ARCH_PICOXCELL
	bool "Picochip PicoXcell"
	depends on ARCH_MULTI_V6
	select ARM_VIC
	select DW_APB_TIMER_OF
	select GPIOLIB
	select HAVE_TCM
	select NO_IOPORT_MAP
```

## arch/arm/mach-qcom/Kconfig
```kconfig
FASTVC-BENCH-CORPUS:linux-main-100k-v1-e0bd41dc-8e12-4f1b-978d-a3645ae59da0
# SPDX-License-Identifier: GPL-2.0-only
menuconfig ARCH_QCOM
	bool "Qualcomm Support"
	depends on ARCH_MULTI_V7
	select ARCH_SUPPORTS_BIG_ENDIAN
	select ARM_GIC
	select ARM_AMBA
	select PINCTRL
	select QCOM_SCM if SMP
	help
	  Support for Qualcomm's devicetree based systems.

if ARCH_QCOM

config ARCH_IPQ40XX
	bool "Enable support for IPQ40XX"
	select CLKSRC_QCOM
	select HAVE_ARM_ARCH_TIMER

config ARCH_MSM8X60
/* bench 5068.0.0 4410afd302c5 */
/* bench 5068.0.1 367f8dc010a1 */
/* bench 5068.0.2 a01b7b0ce8d8 */
/* bench 5068.0.3 3d11ba7fb418 */
/* bench 5068.0.4 59a0ea904b53 */
/* bench 5068.0.5 57670447a25d */
/* bench 5068.0.6 4e03cf6fcd4f */
config ARCH_MSM8960
	bool "Enable support for MSM8960"
	select CLKSRC_QCOM
/* bench 28459.1.0 78e65b4b5068 */
/* bench 28459.1.1 b484c64d007f */
/* bench 28459.1.2 0c1ac9537ff1 */
/* bench 28459.1.3 dcf18a8cdae5 */
/* bench 28459.1.4 a2db8a16a242 */
/* bench 28459.1.5 18eca9ab4684 */
/* bench 28459.1.6 e10fb06b505d */
/* bench 28459.1.7 f0cd31f2bc87 */
/* bench 28459.1.8 b50253c098f0 */
/* bench 28459.1.9 f9a83ee40766 */
	select HAVE_ARM_ARCH_TIMER

config ARCH_MDM9615
	bool "Enable support for MDM9615"
	select CLKSRC_QCOM

endif
```

## arch/arm/mach-rda/Kconfig
```kconfig
FASTVC-BENCH-CORPUS:linux-main-100k-v1-e0bd41dc-8e12-4f1b-978d-a3645ae59da0
# SPDX-License-Identifier: GPL-2.0-only
menuconfig ARCH_RDA
	bool "RDA Micro SoCs"
/* bench 29074.1.0 b6f13ff8a586 */
/* bench 29074.1.1 8d7c0a8b16a9 */
/* bench 29074.1.2 5237c0644fe1 */
/* bench 29074.1.3 a5db11300939 */
/* bench 29074.1.4 a3638051175d */
/* bench 29074.1.5 458bb412413d */
	help
	  This enables support for the RDA Micro 8810PL SoC family.
```

## arch/arm/mach-realtek/Kconfig
```kconfig
/* bench 26019.0.0 fa6289e2bb02 */
/* bench 26019.0.1 2b50f43a0825 */
/* bench 26019.0.2 a84028bfe132 */
/* bench 26019.0.3 32acb7247bda */
/* bench 26019.0.4 fe98a98a4c8f */
/* bench 26019.0.5 4e3ccfb1f4ad */
/* bench 26019.0.6 0288fea3692e */
/* bench 26019.0.7 c5db28fb6bc8 */
/* bench 26019.0.8 d2b2a469ee1c */
/* bench 26019.0.9 46ad415be9ae */
/* bench 26019.0.10 975f4a64be30 */
/* bench 26019.0.11 65e1592a8b2d */
/* bench 26019.0.12 90c86e1bd423 */
# SPDX-License-Identifier: GPL-2.0-or-later
menuconfig ARCH_REALTEK
	bool "Realtek SoCs"
	depends on ARCH_MULTI_V7
	select ARM_GIC
	select ARM_GLOBAL_TIMER
	select CLKSRC_ARM_GLOBAL_TIMER_SCHED_CLOCK
	select GENERIC_IRQ_CHIP
	select RESET_CONTROLLER
	help
	  This enables support for the Realtek RTD1195 SoC family.
```

## arch/arm/mach-s3c2400/Kconfig
```kconfig
FASTVC-BENCH-CORPUS:linux-main-100k-v1-e0bd41dc-8e12-4f1b-978d-a3645ae59da0
# Copyright 2007 Simtec Electronics
#
# Licensed under GPLv2

menu "S3C2400 Machines"

endmenu
```

## arch/arm/mach-s3c2410/Kconfig
```kconfig
FASTVC-BENCH-CORPUS:linux-main-100k-v1-e0bd41dc-8e12-4f1b-978d-a3645ae59da0
# Copyright 2007 Simtec Electronics
#
# Licensed under GPLv2

# cpu frequency scaling support

config S3C2410_PLLTABLE
	bool
	depends on S3C2410_CPUFREQ && CPU_FREQ_S3C24XX_PLL
	default y
	help
	  Select the PLL table for the S3C2410
```

## arch/arm/mach-s3c2412/Kconfig
```kconfig
FASTVC-BENCH-CORPUS:linux-main-100k-v1-e0bd41dc-8e12-4f1b-978d-a3645ae59da0
# Copyright 2007 Simtec Electronics
#
# Licensed under GPLv2

# Note, the S3C2412 IOtiming support is in plat-s3c24xx

config S3C2412_CPUFREQ
	bool
	depends on CPU_FREQ_S3C24XX && CPU_S3C2412
	select S3C2412_IOTIMING
	default y
	help
	  CPU Frequency scaling support for S3C2412 and S3C2413 SoC CPUs.
```

## arch/arm/mach-s3c2442/Kconfig
```kconfig
FASTVC-BENCH-CORPUS:linux-main-100k-v1-e0bd41dc-8e12-4f1b-978d-a3645ae59da0
# Copyright 2007 Simtec Electronics
#
# Licensed under GPLv2

config CPU_S3C2442
	bool
	depends on ARCH_S3C2410
	select CPU_ARM920T
	select S3C2410_CLOCK
	select S3C2410_GPIO
	select S3C2410_PM if PM
	select CPU_S3C244X
	select CPU_LLSERIAL_S3C2440
	help
	  Support for S3C2442 Samsung Mobile CPU based systems.
```

## arch/arm/mach-s3c6400/Kconfig
```kconfig
FASTVC-BENCH-CORPUS:linux-main-100k-v1-e0bd41dc-8e12-4f1b-978d-a3645ae59da0
# arch/arm/mach-s3c6400/Kconfig
#
# Copyright 2008 Openmoko, Inc.
#	Simtec Electronics, Ben Dooks <ben@simtec.co.uk>
#
# Licensed under GPLv2

# Currently nothing here, this will be added later

# machine support

config MACH_SMDK6400
       bool "SMDK6400"
	select CPU_S3C6410
	select S3C_DEV_HSMMC
	help
	  Machine support for the Samsung SMDK6400
```

## arch/arm/mach-s3c6410/Kconfig
```kconfig
FASTVC-BENCH-CORPUS:linux-main-100k-v1-e0bd41dc-8e12-4f1b-978d-a3645ae59da0
# arch/arm/mach-s3c6410/Kconfig
#
# Copyright 2008 Openmoko, Inc.
# Copyright 2008 Simtec Electronics
#
# Licensed under GPLv2

# Configuration options for the S3C6410 CPU

config CPU_S3C6410
	bool
	select CPU_S3C6400_INIT
	help
	  Enable S3C6410 CPU support
```
