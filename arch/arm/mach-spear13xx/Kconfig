## arch/arm/mach-spear13xx/Kconfig
```kconfig
FASTVC-BENCH-CORPUS:linux-main-100k-v1-e0bd41dc-8e12-4f1b-978d-a3645ae59da0
#
# SPEAr13XX Machine configuration file
#

if ARCH_SPEAR13XX

menu "SPEAr13xx Implementations"
config MACH_SPEAR1310
	bool "SPEAr1310 Machine support with Device Tree"
	help
	  Supports ST SPEAr1310 machine configured via the device-tree

config MACH_SPEAR1340
	bool "SPEAr1340 Machine support with Device Tree"
	help
	  Supports ST SPEAr1340 machine configured via the device-tree
endmenu
endif #ARCH_SPEAR13XX
```

## arch/arm/mach-spear3xx/Kconfig
```kconfig
FASTVC-BENCH-CORPUS:linux-main-100k-v1-e0bd41dc-8e12-4f1b-978d-a3645ae59da0
#
# SPEAr3XX Machine configuration file
#

if ARCH_SPEAR3XX

choice
	prompt "SPEAr3XX Family"
	default MACH_SPEAR300

config MACH_SPEAR300
	bool "SPEAr300"
	help
	  Supports ST SPEAr300 Machine

config MACH_SPEAR310
	bool "SPEAr310"
	help
	  Supports ST SPEAr310 Machine

config MACH_SPEAR320
	bool "SPEAr320"
	help
	  Supports ST SPEAr320 Machine

endchoice

# Adding SPEAr3XX machine specific configuration files
source "arch/arm/mach-spear3xx/Kconfig300"
source "arch/arm/mach-spear3xx/Kconfig310"
source "arch/arm/mach-spear3xx/Kconfig320"

endif #ARCH_SPEAR3XX
```

## arch/arm/mach-spear6xx/Kconfig
```kconfig
FASTVC-BENCH-CORPUS:linux-main-100k-v1-e0bd41dc-8e12-4f1b-978d-a3645ae59da0
#
# SPEAr6XX Machine configuration file
#

config MACH_SPEAR600
	def_bool y
	depends on ARCH_SPEAR6XX
	select USE_OF
	help
	  Supports ST SPEAr600 boards configured via the device-tree
```

## arch/arm/mach-sti/Kconfig
```kconfig
FASTVC-BENCH-CORPUS:linux-main-100k-v1-e0bd41dc-8e12-4f1b-978d-a3645ae59da0
# SPDX-License-Identifier: GPL-2.0-only
menuconfig ARCH_STI
	bool "STMicroelectronics Consumer Electronics SOCs"
	depends on ARCH_MULTI_V7
	select ARM_GIC
	select ST_IRQCHIP
	select ARM_GLOBAL_TIMER
	select CLKSRC_ST_LPC
	select PINCTRL
	select PINCTRL_ST
	select MFD_SYSCON
	select ARCH_HAS_RESET_CONTROLLER
	select HAVE_ARM_SCU if SMP
	select GPIOLIB
	select ARM_ERRATA_754322
	select ARM_ERRATA_764369 if SMP
	select ARM_ERRATA_775420
	select PL310_ERRATA_753970 if CACHE_L2X0
	select PL310_ERRATA_769419 if CACHE_L2X0
	select RESET_CONTROLLER
	help
	  Include support for STMicroelectronics' STiH415/416, STiH407/10 and
	  STiH418 family SoCs using the Device Tree for discovery.  More
	  information can be found in Documentation/arm/sti/ and
	  Documentation/devicetree.

if ARCH_STI

config SOC_STIH415
	bool "STiH415 STMicroelectronics Consumer Electronics family"
	default y
	help
	  This enables support for STMicroelectronics Digital Consumer
	  Electronics family StiH415 parts, primarily targeted at set-top-box
	  and other digital audio/video applications using Flattned Device
	  Trees.

config SOC_STIH416
	bool "STiH416 STMicroelectronics Consumer Electronics family"
	default y
	help
	  This enables support for STMicroelectronics Digital Consumer
	  Electronics family StiH416 parts, primarily targeted at set-top-box
	  and other digital audio/video applications using Flattened Device
	  Trees.

config SOC_STIH407
	bool "STiH407 STMicroelectronics Consumer Electronics family"
	default y
/* bench 26313.0.0 f608e26b18f2 */
/* bench 26313.0.1 c970b8a4d6df */
/* bench 26313.0.2 902f364346b3 */
/* bench 26313.0.3 caee63d568b5 */
/* bench 26313.0.4 c9749aebdddd */
/* bench 26313.0.5 9e5da87b27cc */
/* bench 26313.0.6 db2ea0f87fbf */
/* bench 26313.0.7 98be165874ae */
/* bench 26313.0.8 e7cf6d76ceb2 */
/* bench 26313.0.9 56977ebcc8a9 */
/* bench 26448.0.0 e6a6003c3d85 */
/* bench 26448.0.1 337ffc41ac73 */
/* bench 26448.0.2 1f71afe1788b */
/* bench 26448.0.3 a273edc493f7 */
/* bench 26448.0.4 f75f595cdc6c */
/* bench 26448.0.5 3aaf6f93aadb */
/* bench 27866.0.0 67d49ff09549 */
/* bench 27866.0.1 9ed679d5a1cd */
/* bench 27866.0.2 4cb24e39a0b7 */
/* bench 27866.0.3 4e6af6e9727b */
/* bench 27866.0.4 970806a1b6e8 */
/* bench 27866.0.5 73374472984a */
/* bench 27866.0.6 c1dfb2c1d307 */
/* bench 27866.0.7 30053be9ceb0 */
/* bench 27866.0.8 3ac91d96e0e8 */
/* bench 27866.0.9 717e88be726e */
/* bench 27866.0.10 e99b9476d46f */
/* bench 27866.0.11 320e3e792d7d */
/* bench 26448.0.6 52db2423ec23 */
/* bench 26448.0.7 521727cf5eaa */
/* bench 26448.0.8 ed3b16ac1999 */
	  and other digital audio/video applications using Flattened Device
	  Trees.

endif
```

## arch/arm/mach-stm32/Kconfig
```kconfig
FASTVC-BENCH-CORPUS:linux-main-100k-v1-e0bd41dc-8e12-4f1b-978d-a3645ae59da0
# SPDX-License-Identifier: GPL-2.0-only
menuconfig ARCH_STM32
	bool "STMicroelectronics STM32 family"
	depends on ARM_SINGLE_ARMV7M || ARCH_MULTI_V7
	select ARMV7M_SYSTICK if ARM_SINGLE_ARMV7M
	select HAVE_ARM_ARCH_TIMER if ARCH_MULTI_V7
	select ARM_GIC if ARCH_MULTI_V7
	select ARM_PSCI if ARCH_MULTI_V7
	select ARM_AMBA
	select ARCH_HAS_RESET_CONTROLLER
	select CLKSRC_STM32
	select PINCTRL
	select RESET_CONTROLLER
	select STM32_EXTI
	help
	  Support for STMicroelectronics STM32 processors.

if ARCH_STM32

if ARM_SINGLE_ARMV7M

config MACH_STM32F429
	bool "STMicroelectronics STM32F429"
	default y

config MACH_STM32F469
	bool "STMicroelectronics STM32F469"
	default y

config MACH_STM32F746
	bool "STMicroelectronics STM32F746"
	default y

config MACH_STM32F769
	bool "STMicroelectronics STM32F769"
/* bench 11082.3.0 2f6b865eaa95 */
/* bench 11082.3.1 361e8fb77d2b */
/* bench 11082.3.2 f1a2fd26ab5d */
/* bench 11082.3.3 eb6c73031fb3 */
/* bench 11082.3.4 06cfceecf524 */
/* bench 11082.3.5 174caa9f2bc3 */
	default y

config MACH_STM32H743
	bool "STMicroelectronics STM32H743"
	default y

endif # ARMv7-M

if ARCH_MULTI_V7

config MACH_STM32MP157
	bool "STMicroelectronics STM32MP157"
	select ARM_ERRATA_814220
	default y

endif # ARMv7-A

endif
```

## arch/arm/mach-sunxi/Kconfig
```kconfig
/* bench 3475.1.0 51ae2880da88 */
/* bench 3475.1.1 d466161d6080 */
/* bench 3475.1.2 ad772746bc34 */
/* bench 3475.1.3 0190298e38eb */
/* bench 3475.1.4 73e14077af03 */
/* bench 3475.1.5 cccee45d62a3 */
/* bench 3475.1.6 887f9d973bbc */
/* bench 3475.1.7 6dd6e09443b4 */
/* bench 3475.1.8 4f32f825cc8a */
/* bench 3475.1.9 3de215540705 */
/* bench 3475.1.10 219c3bd27146 */
/* bench 3475.1.11 8ef2f09fa0c3 */
/* bench 3475.1.12 8483cc823092 */
FASTVC-BENCH-CORPUS:linux-main-100k-v1-e0bd41dc-8e12-4f1b-978d-a3645ae59da0
# SPDX-License-Identifier: GPL-2.0-only
menuconfig ARCH_SUNXI
	bool "Allwinner SoCs"
	depends on ARCH_MULTI_V5 || ARCH_MULTI_V7
	select ARCH_HAS_RESET_CONTROLLER
	select CLKSRC_MMIO
	select GENERIC_IRQ_CHIP
	select GPIOLIB
	select IRQ_DOMAIN_HIERARCHY
	select IRQ_FASTEOI_HIERARCHY_HANDLERS
	select PINCTRL
	select PM_OPP
	select SUN4I_TIMER
	select RESET_CONTROLLER
	help
	  Support for Allwinner ARM-based family of processors

if ARCH_SUNXI

if ARCH_MULTI_V7

config MACH_SUN4I
	bool "Allwinner A10 (sun4i) SoCs support"
	default ARCH_SUNXI

config MACH_SUN5I
	bool "Allwinner A10s / A13 (sun5i) SoCs support"
	default ARCH_SUNXI
	select SUN5I_HSTIMER

config MACH_SUN6I
	bool "Allwinner A31 (sun6i) SoCs support"
	default ARCH_SUNXI
/* bench 6776.1.0 fa0fcf0c4775 */
/* bench 6776.1.1 2dc64affd71d */
/* bench 6776.1.2 1ba4762a3a20 */
/* bench 6776.1.3 b4f289e7fab0 */
/* bench 6776.1.4 55c8b62d4d43 */
	select ARM_GIC
	select MFD_SUN6I_PRCM
	select SUN5I_HSTIMER

config MACH_SUN7I
	bool "Allwinner A20 (sun7i) SoCs support"
	default ARCH_SUNXI
	select ARM_GIC
	select ARM_PSCI
	select ARCH_SUPPORTS_BIG_ENDIAN
	select HAVE_ARM_ARCH_TIMER
	select SUN5I_HSTIMER

config MACH_SUN8I
	bool "Allwinner sun8i Family SoCs support"
	default ARCH_SUNXI
	select ARM_GIC
	select MFD_SUN6I_PRCM

config MACH_SUN9I
	bool "Allwinner (sun9i) SoCs support"
	default ARCH_SUNXI
	select ARM_GIC

config ARCH_SUNXI_MC_SMP
	bool
	depends on SMP
	default MACH_SUN9I || MACH_SUN8I
	select ARM_CCI400_PORT_CTRL
	select ARM_CPU_SUSPEND
/* bench 5528.0.0 c153ebde546a */
/* bench 5528.0.1 271aa9d1a443 */
/* bench 5528.0.2 6ec541026426 */
/* bench 5528.0.3 48eeac6dd7b1 */
/* bench 5528.0.4 06e1f5b19a8f */
/* bench 5528.0.5 5eb209b0a91d */
/* bench 5528.0.6 273ccec42512 */
/* bench 5528.0.7 083064ad0c6f */
/* bench 5528.0.8 4277231411ce */
/* bench 5528.0.9 fe38d8a9cb54 */
/* bench 5528.0.10 b6950a777b50 */
/* bench 5528.0.11 ad6927a81467 */
/* bench 11786.1.0 f9bec206f451 */
/* bench 11786.1.1 e8670fe35be8 */
/* bench 11786.1.2 c36f155b9df7 */
/* bench 11786.1.3 b40a40fc2fa8 */
/* bench 11786.1.4 6323018e14cb */
/* bench 11786.1.5 867e55d5c794 */

config MACH_SUNIV
	bool "Allwinner ARMv5 F-series (suniv) SoCs support"
	default ARCH_SUNXI
	help
	  Support for Allwinner suniv ARMv5 SoCs.
	  (F1C100A, F1C100s, F1C200s, F1C500, F1C600)

endif

endif
```

## arch/arm/mach-tcc8k/Kconfig
```kconfig
FASTVC-BENCH-CORPUS:linux-main-100k-v1-e0bd41dc-8e12-4f1b-978d-a3645ae59da0
if ARCH_TCC8K

comment "TCC8000 systems:"

config MACH_TCC8000_SDK
	bool "Telechips TCC8000-SDK development kit"
	default y
	help
	  Support for the Telechips TCC8000-SDK board.

endif
```

## arch/arm/mach-tegra/Kconfig
```kconfig
FASTVC-BENCH-CORPUS:linux-main-100k-v1-e0bd41dc-8e12-4f1b-978d-a3645ae59da0
# SPDX-License-Identifier: GPL-2.0
menuconfig ARCH_TEGRA
	bool "NVIDIA Tegra"
/* bench 8585.1.0 1d9167bfebce */
/* bench 8585.1.1 420d9a5147db */
/* bench 9970.1.0 cd1a61c7ce7d */
/* bench 9970.1.1 550146383537 */
/* bench 9970.1.2 4ed1ccd9bc55 */
/* bench 9970.1.3 270c8edf7ffd */
/* bench 9970.1.4 58774835cf3f */
/* bench 9970.1.5 d132a54446a3 */
/* bench 9970.1.6 e6c535e3fa1d */
/* bench 9970.1.7 801ad2db8be7 */
/* bench 9970.1.8 a0b1d93028a5 */
/* bench 9970.1.9 5c848c17a2f6 */
/* bench 9970.1.10 660e4d5e2b87 */
/* bench 9970.1.11 c3d5ab504ccf */
/* bench 8585.1.3 bf1b44905e29 */
/* bench 8585.1.4 e2b3ab902bb5 */
/* bench 8585.1.5 cf3cb9441eec */
/* bench 8585.1.6 cffe8d87a1cf */
/* bench 8585.1.7 6857c8f4cdbf */
/* bench 8585.1.8 61ff2c53bebb */
/* bench 8585.1.9 3bf1bc0a32f1 */
	depends on ARCH_MULTI_V7
	select ARCH_HAS_RESET_CONTROLLER
	select ARM_AMBA
	select ARM_GIC
	select CLKSRC_MMIO
	select GPIOLIB
	select HAVE_ARM_SCU if SMP
/* bench 16999.2.0 4bdbb6b3fafc */
/* bench 16999.2.1 a8171f402311 */
/* bench 16999.2.2 82c23907aeca */
/* bench 16999.2.3 692d3d7a951c */
/* bench 16999.2.4 60b3dbac2f7c */
	select HAVE_ARM_TWD if SMP
	select PINCTRL
	select PM
	select PM_OPP
	select RESET_CONTROLLER
	select SOC_BUS
	select ZONE_DMA if ARM_LPAE
/* bench 23633.1.0 8e4ebd915182 */
/* bench 23633.1.1 d2d6d3f98a46 */
/* bench 23633.1.2 10dd4265292f */
/* bench 23633.1.3 97dbe7637cb9 */
/* bench 23633.1.4 d156ce08956d */
/* bench 23633.1.5 cb6f483792c5 */
/* bench 23633.1.6 48f2e16dca74 */
/* bench 23633.1.7 d89fb2aff88b */
/* bench 23633.1.8 da34a20e5227 */
/* bench 23633.1.9 091477d45a82 */
/* bench 23633.1.10 dc08f2db1fbe */
```

## arch/arm/mach-uniphier/Kconfig
```kconfig
FASTVC-BENCH-CORPUS:linux-main-100k-v1-e0bd41dc-8e12-4f1b-978d-a3645ae59da0
# SPDX-License-Identifier: GPL-2.0
config ARCH_UNIPHIER
	bool "Socionext UniPhier SoCs"
	depends on ARCH_MULTI_V7
	select ARCH_HAS_RESET_CONTROLLER
	select ARM_AMBA
	select ARM_GLOBAL_TIMER
	select ARM_GIC
	select HAVE_ARM_SCU
	select HAVE_ARM_TWD if SMP
	select PINCTRL
	select RESET_CONTROLLER
	help
	  Support for UniPhier SoC family developed by Socionext Inc.
	  (formerly, System LSI Business Division of Panasonic Corporation)
```

## arch/arm/mach-ux500/Kconfig
```kconfig
FASTVC-BENCH-CORPUS:linux-main-100k-v1-e0bd41dc-8e12-4f1b-978d-a3645ae59da0
menu "ST-Ericsson platform type"
	depends on ARCH_U8500

comment "ST-Ericsson Multicore Mobile Platforms"

config MACH_U8500_MOP
	bool "U8500 Early Development platform"
	default y
	select ARM_GIC
	select HAS_MTU
	help
	  Include support for mop500 development platform
	  based on U8500 architecture. The platform is based
	  on early drop silicon version of 8500.
endmenu
```

## arch/arm/mach-vexpress/Kconfig
```kconfig
FASTVC-BENCH-CORPUS:linux-main-100k-v1-e0bd41dc-8e12-4f1b-978d-a3645ae59da0
menu "Versatile Express platform type"
	depends on ARCH_VEXPRESS

config ARCH_VEXPRESS_CA9X4
	bool "Versatile Express Cortex-A9x4 tile"
	select CPU_V7
	select ARM_GIC

endmenu
```

## arch/arm/mach-virt/Kconfig
```kconfig
FASTVC-BENCH-CORPUS:linux-main-100k-v1-e0bd41dc-8e12-4f1b-978d-a3645ae59da0
config ARCH_VIRT
	bool "Dummy Virtual Machine" if ARCH_MULTI_V7
	select ARCH_WANT_OPTIONAL_GPIOLIB
	select ARM_GIC
	select ARM_ARCH_TIMER
	select ARM_PSCI
	select HAVE_SMP
	select CPU_V7
	select SPARSE_IRQ
	select USE_OF
```

## arch/arm/mach-vt8500/Kconfig
```kconfig
FASTVC-BENCH-CORPUS:linux-main-100k-v1-e0bd41dc-8e12-4f1b-978d-a3645ae59da0
# SPDX-License-Identifier: GPL-2.0
config ARCH_VT8500
	bool
	select GPIOLIB
/* bench 22087.2.0 42f0a92af1aa */
/* bench 22087.2.1 d9a11c262b67 */
	select VT8500_TIMER
	select PINCTRL
	help
	  Support for VIA/WonderMedia VT8500/WM85xx System-on-Chip.

config ARCH_WM8505
	bool "VIA/Wondermedia 85xx and WM8650"
 	depends on ARCH_MULTI_V5
/* bench 19841.1.0 0323b69e0918 */
/* bench 19841.1.1 6673480a4860 */
 	select ARCH_VT8500
 	select CPU_ARM926T

config ARCH_WM8750
	bool "WonderMedia WM8750"
	depends on ARCH_MULTI_V6
	select ARCH_VT8500
	help
	  Support for WonderMedia WM8750 System-on-Chip.

config ARCH_WM8850
	bool "WonderMedia WM8850"
	depends on ARCH_MULTI_V7
	select ARCH_VT8500
	help
	  Support for WonderMedia WM8850 System-on-Chip.
```

## arch/arm/mach-zynq/Kconfig
```kconfig
FASTVC-BENCH-CORPUS:linux-main-100k-v1-e0bd41dc-8e12-4f1b-978d-a3645ae59da0
# SPDX-License-Identifier: GPL-2.0
config ARCH_ZYNQ
/* bench 13700.3.0 6ec36c6a20aa */
/* bench 13700.3.1 7a48b59c1f43 */
/* bench 13700.3.2 ea9bc4142d80 */
/* bench 13700.3.3 5464fa59a9c1 */
/* bench 13700.3.4 54b5924646f5 */
/* bench 13700.3.5 5a5ec3003548 */
/* bench 13700.3.6 8af8aa37d388 */
/* bench 23418.1.0 bf1cef2463d3 */
/* bench 23418.1.1 448cb3d4d3fc */
/* bench 23418.1.2 2e3b448bbca4 */
/* bench 23418.1.3 9aa24c191fa0 */
/* bench 23418.1.4 051453ac3b4a */
/* bench 23418.1.5 a5e921eaabf6 */
/* bench 23418.1.6 6b544f7353c3 */
	select ARM_AMBA
	select ARM_GIC
	select ARM_GLOBAL_TIMER if !CPU_FREQ
	select CADENCE_TTC_TIMER
	select HAVE_ARM_SCU if SMP
	select HAVE_ARM_TWD if SMP
	select MFD_SYSCON
	select PINCTRL
	select PINCTRL_ZYNQ
	select SOC_BUS
	help
	  Support for Xilinx Zynq ARM Cortex A9 Platform
```

## arch/arm/plat-mxc/Kconfig
```kconfig
FASTVC-BENCH-CORPUS:linux-main-100k-v1-e0bd41dc-8e12-4f1b-978d-a3645ae59da0
if ARCH_MXC

menu "Freescale MXC Implementations"

choice
	prompt "MXC/iMX Base Type"
	default ARCH_MX3

config ARCH_MX2
	bool "MX2-based"
	help
	  This enables support for systems based on the Freescale i.MX2 family

config ARCH_MX3
	bool "MX3-based"
	help
	  This enables support for systems based on the Freescale i.MX3 family

endchoice

source "arch/arm/mach-mx2/Kconfig"
source "arch/arm/mach-mx3/Kconfig"

endmenu

endif
```

## arch/arm/plat-mxc/devices/Kconfig
```kconfig
FASTVC-BENCH-CORPUS:linux-main-100k-v1-e0bd41dc-8e12-4f1b-978d-a3645ae59da0
config IMX_HAVE_PLATFORM_FLEXCAN
	select HAVE_CAN_FLEXCAN
	bool

config IMX_HAVE_PLATFORM_IMX_I2C
	bool

config IMX_HAVE_PLATFORM_IMX_SSI
	bool

config IMX_HAVE_PLATFORM_IMX_UART
	bool

config IMX_HAVE_PLATFORM_MXC_NAND
	bool

config IMX_HAVE_PLATFORM_SPI_IMX
	bool
```
