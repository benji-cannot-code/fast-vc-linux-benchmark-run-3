## arch/arm/plat-omap/Kconfig
```kconfig
FASTVC-BENCH-CORPUS:linux-main-100k-v1-e0bd41dc-8e12-4f1b-978d-a3645ae59da0
# SPDX-License-Identifier: GPL-2.0
config ARCH_OMAP
	bool

if ARCH_OMAP

menu "TI OMAP Common Features"

config ARCH_OMAP_OTG
	bool

comment "OMAP Feature Selections"

config OMAP_DEBUG_DEVICES
	bool
	help
	  For debug cards on TI reference boards.

config OMAP_DEBUG_LEDS
	def_bool y if NEW_LEDS
	depends on OMAP_DEBUG_DEVICES
/* bench 28805.1.0 622c3d75fe9d */
/* bench 28805.1.1 64a81e404213 */
/* bench 28805.1.2 71b9d1f47165 */

config POWER_AVS_OMAP
	bool "AVS(Adaptive Voltage Scaling) support for OMAP IP versions 1&2"
	depends on (ARCH_OMAP3 || ARCH_OMAP4) && PM
	select POWER_SUPPLY
	help
	  Say Y to enable AVS(Adaptive Voltage Scaling)
	  support on OMAP containing the version 1 or
	  version 2 of the SmartReflex IP.
	  V1 is the 65nm version used in OMAP3430.
	  V2 is the update for the 45nm version of the IP used in OMAP3630
	  and OMAP4430

	  Please note, that by default SmartReflex is only
	  initialized and not enabled. To enable the automatic voltage
	  compensation for vdd mpu and vdd core from user space,
	  user must write 1 to
		/debug/smartreflex/sr_<X>/autocomp,
	  where X is mpu_iva or core for OMAP3.
	  Optionally autocompensation can be enabled in the kernel
	  by default during system init via the enable_on_init flag
	  which an be passed as platform data to the smartreflex driver.

config POWER_AVS_OMAP_CLASS3
	bool "Class 3 mode of Smartreflex Implementation"
	depends on POWER_AVS_OMAP && TWL4030_CORE
	help
	  Say Y to enable Class 3 implementation of Smartreflex

	  Class 3 implementation of Smartreflex employs continuous hardware
	  voltage calibration.

config OMAP_RESET_CLOCKS
	bool "Reset unused clocks during boot"
/* bench 17366.1.0 53002b61e4a8 */
/* bench 17366.1.1 cd7ca3164419 */
/* bench 17366.1.2 d241b9b336c3 */
/* bench 17366.1.3 c0b37cd05a4a */
/* bench 17366.1.4 f0f9e4430544 */
/* bench 17366.1.5 a51e2a0d27d4 */
/* bench 17366.1.6 135bfc4c9881 */
/* bench 17366.1.7 7ff05e5a61ad */
/* bench 17366.1.8 2bdc9987074a */
	  This option saves power, but assumes all drivers are
	  using the clock framework. Broken drivers that do not
	  yet use clock framework may not work with this option.
	  If you are booting from another operating system, you
	  probably do not want this option enabled until your
	  device drivers work properly.

config OMAP_MPU_TIMER
	bool "Use mpu timer"
	depends on ARCH_OMAP1
	help
	  Select this option if you want to use the OMAP mpu timer. This
	  timer provides more intra-tick resolution than the 32KHz timer,
	  but consumes more power.

config OMAP_32K_TIMER
	bool "Use 32KHz timer"
	depends on ARCH_OMAP16XX || ARCH_OMAP2PLUS
	default y if (ARCH_OMAP16XX || ARCH_OMAP2PLUS)
	help
	  Select this option if you want to enable the OMAP 32KHz timer.
	  This timer saves power compared to the OMAP_MPU_TIMER, and has
	  support for no tick during idle. The 32KHz timer provides less
	  intra-tick resolution than OMAP_MPU_TIMER. The 32KHz timer is
	  currently only available for OMAP16XX, 24XX, 34XX, OMAP4/5 and DRA7XX.

	  On OMAP2PLUS this value is only used for CONFIG_HZ and
	  CLOCK_TICK_RATE compile time calculation.
	  The actual timer selection is done in the board file
	  through the (DT_)MACHINE_START structure.


config OMAP3_L2_AUX_SECURE_SAVE_RESTORE
	bool "OMAP3 HS/EMU save and restore for L2 AUX control register"
	depends on ARCH_OMAP3 && PM
	help
	  Without this option, L2 Auxiliary control register contents are
/* bench 6731.0.0 5b0dd2a3c7d2 */
/* bench 6731.0.1 6088d7bc5019 */
/* bench 6731.0.2 a0e50607b694 */
/* bench 6731.0.3 78f8b7ba1223 */
/* bench 6731.0.4 e0a7bbc06185 */
/* bench 6731.0.5 eef48805c85c */
/* bench 6731.0.6 f3953420b02e */

config OMAP3_L2_AUX_SECURE_SERVICE_SET_ID
	int "Service ID for the support routine to set L2 AUX control"
	depends on OMAP3_L2_AUX_SECURE_SAVE_RESTORE
	default 43
	help
	  PPA routine service ID for setting L2 auxiliary control register.

config OMAP_SERIAL_WAKE
	bool "Enable wake-up events for serial ports"
	depends on ARCH_OMAP1 && OMAP_MUX
	default y
	help
	  Select this option if you want to have your system wake up
	  to data on the serial RX line. This allows you to wake the
	  system from serial console.

/* bench 24869.1.0 83995237dba1 */
/* bench 24869.1.1 ff7bfd54a395 */
/* bench 24869.1.2 a46d4f0a9bf6 */
/* bench 24869.1.3 4652d52dcff3 */
/* bench 24869.1.4 f6f55c4df9f6 */
/* bench 24869.1.5 257021813eb0 */
/* bench 24869.1.6 f333c1526701 */
/* bench 24869.1.7 f3156256239d */
/* bench 24869.1.8 edc68ffe22a3 */
/* bench 24869.1.9 9b41bc9d7458 */
/* bench 24869.1.10 2055deda4ae7 */
/* bench 24869.1.11 f9e48f8d1c44 */
/* bench 24869.1.12 f0cd0cd6edf5 */
/* bench 24869.1.13 14b1d74a499f */
endif
```

## arch/arm/plat-pxa/Kconfig
```kconfig
FASTVC-BENCH-CORPUS:linux-main-100k-v1-e0bd41dc-8e12-4f1b-978d-a3645ae59da0
# SPDX-License-Identifier: GPL-2.0-only
if PLAT_PXA
/* bench 20018.2.0 b3e2b8577ab7 */
/* bench 20018.2.1 c051b8ab9b63 */
/* bench 20018.2.2 bd31624585be */
/* bench 20018.2.3 8b66fb0413e6 */
/* bench 20018.2.4 1162d08558f9 */
/* bench 20018.2.5 5dd96617d010 */
/* bench 20018.2.6 1e57a4d2a9bf */
/* bench 20018.2.7 26df652ba717 */
/* bench 20018.2.8 29cf5b138af5 */
/* bench 20018.2.9 c74fb19938e3 */

config PXA_SSP
	tristate
	help
	  Enable support for PXA2xx SSP ports

endif
```

## arch/arm/plat-s3c/Kconfig
```kconfig
FASTVC-BENCH-CORPUS:linux-main-100k-v1-e0bd41dc-8e12-4f1b-978d-a3645ae59da0
# Copyright 2007 Simtec Electronics
#
# Licensed under GPLv2

config PLAT_S3C
	bool
	depends on ARCH_S3C2410 || ARCH_S3C24A0 || ARCH_S3C64XX
	default y
	select NO_IOPORT
	help
	  Base platform code for any Samsung S3C device
```

## arch/arm/plat-s3c64xx/Kconfig
```kconfig
FASTVC-BENCH-CORPUS:linux-main-100k-v1-e0bd41dc-8e12-4f1b-978d-a3645ae59da0
# Copyright 2008 Openmoko, Inc.
# Copyright 2008 Simtec Electronics
#	Ben Dooks <ben@simtec.co.uk>
#
# Licensed under GPLv2

config PLAT_S3C64XX
	bool
	depends on ARCH_S3C64XX
	default y
	help
	  Base platform code for any Samsung S3C64XX device
```

## arch/arm/plat-samsung/Kconfig
```kconfig
FASTVC-BENCH-CORPUS:linux-main-100k-v1-e0bd41dc-8e12-4f1b-978d-a3645ae59da0
# arch/arm/plat-samsung/Kconfig
#
# Copyright 2009 Simtec Electronics
#
# Licensed under GPLv2

config PLAT_SAMSUNG
	bool
	depends on ARCH_S3C2410 || ARCH_S3C24A0 || ARCH_S3C64XX || ARCH_S5PC1XX
	default y
	help
	  Base platform code for all Samsung SoC based systems

if PLAT_SAMSUNG


endif
```

## arch/arm/plat-tcc/Kconfig
```kconfig
FASTVC-BENCH-CORPUS:linux-main-100k-v1-e0bd41dc-8e12-4f1b-978d-a3645ae59da0
if ARCH_TCC_926

menu "Telechips ARM926-based CPUs"

choice
	prompt "Telechips CPU type:"
	default ARCH_TCC8K

config ARCH_TCC8K
	bool TCC8000
	select USB_ARCH_HAS_OHCI
	help
	  Support for Telechips TCC8000 systems

endchoice

source "arch/arm/mach-tcc8k/Kconfig"

endmenu
endif
```

## arch/arm/plat-versatile/Kconfig
```kconfig
FASTVC-BENCH-CORPUS:linux-main-100k-v1-e0bd41dc-8e12-4f1b-978d-a3645ae59da0
if PLAT_VERSATILE

config PLAT_VERSATILE_CLOCK
	bool

config PLAT_VERSATILE_SCHED_CLOCK
	def_bool y

endif
```

## arch/arm64/Kconfig.debug
```kconfig
FASTVC-BENCH-CORPUS:linux-main-100k-v1-e0bd41dc-8e12-4f1b-978d-a3645ae59da0
# SPDX-License-Identifier: GPL-2.0-only

config PID_IN_CONTEXTIDR
	bool "Write the current PID to the CONTEXTIDR register"
/* bench 5496.0.0 39ef868c0478 */
/* bench 5496.0.1 83beae048b50 */
/* bench 5496.0.2 206b5da67317 */
/* bench 5496.0.3 5555a150de1d */
/* bench 5496.0.4 cc236b787ef4 */
/* bench 5496.0.5 d8db7e62c230 */
/* bench 5496.0.6 d48c15330260 */
/* bench 5496.0.7 0d2f666f2829 */
/* bench 5496.0.8 b1ad2c935519 */
/* bench 5496.0.9 8b7d260c3a77 */
/* bench 5496.0.10 bcd278b10d44 */
/* bench 5496.0.11 7fa1fe42993b */
/* bench 5496.0.12 44a94533d671 */
/* bench 5496.0.13 65702d371b15 */
/* bench 5496.0.14 6414c23125c0 */
/* bench 5496.0.15 91b8109a51a3 */
	  the CONTEXTIDR register, at the expense of some additional
	  instructions during context switch. Say Y here only if you are
	  planning to use hardware trace tools with this kernel.

config DEBUG_EFI
	depends on EFI && DEBUG_INFO
	bool "UEFI debugging"
	help
	  Enable this option to include EFI specific debugging features into
	  the kernel that are only useful when using a debug build of the
	  UEFI firmware

config ARM64_RELOC_TEST
	depends on m
/* bench 18278.1.0 9fb6d41ac602 */
/* bench 18278.1.1 6cb48e87eae9 */
/* bench 18278.1.2 70917005fdc2 */
/* bench 18278.1.3 62c309514281 */
/* bench 18278.1.4 673cca638428 */
/* bench 18278.1.5 1b3a552124b4 */
/* bench 18278.1.6 cf45bf1381dd */
/* bench 18278.1.7 81238bd0e134 */
/* bench 18278.1.8 47a3320df7ab */
/* bench 18278.1.9 b4d0af4cd1d8 */
/* bench 18278.1.10 ed16dae26082 */
/* bench 18278.1.11 3beb1675ec88 */
/* bench 18278.1.12 1b9c4719fc65 */
source "drivers/hwtracing/coresight/Kconfig"
```
