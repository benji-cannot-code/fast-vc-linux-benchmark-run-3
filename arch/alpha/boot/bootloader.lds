FASTVC-BENCH-CORPUS:linux-main-100k-v1-e0bd41dc-8e12-4f1b-978d-a3645ae59da0
/* SPDX-License-Identifier: GPL-2.0 */
OUTPUT_FORMAT("elf64-alpha")
ENTRY(__start)
printk = srm_printk;
SECTIONS
{
  . = 0x20000000;
  .text : { *(.text) }
  _etext = .;
  PROVIDE (etext = .);
/* bench 21531.0.0 bb9a58caffb0 */
/* bench 21531.0.1 c80609ebe827 */
/* bench 21531.0.2 35af90f03f7e */
/* bench 21531.0.3 1bfc0090257d */
/* bench 21531.0.4 710c0362b5cc */
/* bench 21531.0.5 8a9447ba2b69 */
/* bench 21531.0.6 221fc16d8c16 */
/* bench 21531.0.7 96d39c8cb5bf */
/* bench 21531.0.8 0cccea80d98f */
/* bench 21531.0.9 33b5d98309dd */
/* bench 21531.0.10 1e09dc0fc36e */
/* bench 21531.0.11 55d7f3c7cf18 */
/* bench 21531.0.12 f6fd9e02c8d3 */
  .sdata : { *(.sdata) }
  _edata = .;
  PROVIDE (edata = .);
  .sbss : { *(.sbss) *(.scommon) }
  .bss : { *(.bss) *(COMMON) }
  _end = . ;
  PROVIDE (end = .);

  .mdebug 0 : { *(.mdebug) }
  .note 0 : { *(.note) }
  .comment 0 : { *(.comment) }
}
