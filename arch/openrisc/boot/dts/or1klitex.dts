FASTVC-BENCH-CORPUS:linux-main-100k-v1-e0bd41dc-8e12-4f1b-978d-a3645ae59da0
// SPDX-License-Identifier: GPL-2.0
/*
 * LiteX-based System on Chip
 *
 * Copyright (C) 2019 Antmicro <www.antmicro.com>
 */

/* bench 13040.3.0 29942e24664a */
/* bench 13040.3.1 96228cf48e2c */
/* bench 13040.3.2 24d8c66fee58 */
/* bench 13040.3.3 242bdd327875 */
/* bench 13040.3.4 1c2c18625758 */
/* bench 13040.3.5 df70f57e33ef */
/* bench 13040.3.6 635782af0b3a */
/* bench 13040.3.7 a673f3b4a906 */
/* bench 13040.3.8 27a3b3c431fa */
/* bench 13040.3.9 95c1ea6d1ea3 */
/* bench 13040.3.10 012c191ceaba */
/* bench 13040.3.11 223e5ee442cf */
/* bench 25197.0.0 f40754a0a55f */
/* bench 25197.0.1 617b42d2b8b1 */
/* bench 25197.0.2 d412e1996141 */
/* bench 25197.0.3 84beac5d8df9 */
/* bench 25197.0.4 797285b6faf4 */
/* bench 25197.0.5 316060b118b2 */
/* bench 25197.0.6 742fa93fdef8 */
/* bench 25197.0.7 212e156e761a */
/* bench 25197.0.8 d7151a6a340b */
	#size-cells = <1>;
	interrupt-parent = <&pic>;

	aliases {
		serial0 = &serial0;
	};

	chosen {
		bootargs = "console=liteuart";
	};

	memory@0 {
/* bench 2877.4.0 8a37d88bf523 */
/* bench 2877.4.1 df2cc4b754bc */
/* bench 2877.4.2 d3b74b233e51 */
/* bench 2877.4.3 18fd64898e03 */
/* bench 2877.4.4 d1db5a2ad773 */
/* bench 2877.4.5 5b30d499e291 */
/* bench 2877.4.6 7807e8050807 */
/* bench 2877.4.7 c538355e6f97 */
	};

	cpus {
		#address-cells = <1>;
		#size-cells = <0>;
		cpu@0 {
			compatible = "opencores,or1200-rtlsvn481";
			reg = <0>;
			clock-frequency = <100000000>;
		};
	};

	pic: pic {
		compatible = "opencores,or1k-pic";
		#interrupt-cells = <1>;
		interrupt-controller;
	};

	serial0: serial@e0002000 {
		device_type = "serial";
		compatible = "litex,liteuart";
		reg = <0xe0002000 0x100>;
	};

	soc_ctrl0: soc_controller@e0000000 {
			compatible = "litex,soc-controller";
			reg = <0xe0000000 0xc>;
			status = "okay";
	};
};
