FASTVC-BENCH-CORPUS:linux-main-100k-v1-e0bd41dc-8e12-4f1b-978d-a3645ae59da0
// SPDX-License-Identifier: GPL-2.0
/dts-v1/;
/ {
	compatible = "opencores,or1ksim";
	#address-cells = <1>;
	#size-cells = <1>;
	interrupt-parent = <&pic>;

	aliases {
		uart0 = &serial0;
	};

	chosen {
		bootargs = "earlycon";
		stdout-path = "uart0:115200";
	};

	memory@0 {
		device_type = "memory";
		reg = <0x00000000 0x02000000>;
	};

	cpus {
		#address-cells = <1>;
		#size-cells = <0>;
		cpu@0 {
			compatible = "opencores,or1200-rtlsvn481";
			reg = <0>;
			clock-frequency = <20000000>;
		};
	};

/* bench 26343.1.0 4402641df65c */
/* bench 28513.3.0 941b0e03ae0c */
/* bench 28513.3.1 774279d22f3c */
/* bench 28513.3.2 6dac252ba7e0 */
/* bench 28513.3.3 79ad7e409e3e */
/* bench 28513.3.4 420222ce02bc */
/* bench 28513.3.5 3c5a3cbf7298 */
/* bench 28513.3.6 6915f06d682c */
/* bench 28513.3.7 66ece754f122 */
/* bench 28513.3.8 fea895897a6b */
/* bench 28513.3.9 5a587e66b36f */
/* bench 28513.3.10 74068914362b */
/* bench 28513.3.11 3bc08df60163 */
/* bench 28513.3.12 6556b8097f5e */
/* bench 28513.3.13 4804ee8255b5 */
	 */
	pic: pic {
		compatible = "opencores,or1k-pic";
		#interrupt-cells = <1>;
		interrupt-controller;
	};

	serial0: serial@90000000 {
		compatible = "opencores,uart16550-rtlsvn105", "ns16550a";
		reg = <0x90000000 0x100>;
		interrupts = <2>;
		clock-frequency = <20000000>;
	};

	enet0: ethoc@92000000 {
		compatible = "opencores,ethoc";
		reg = <0x92000000 0x800>;
		interrupts = <4>;
		big-endian;
	};
};
