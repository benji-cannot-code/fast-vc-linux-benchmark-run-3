## arch/powerpc/configs/44x/icon_defconfig
```kconfig
FASTVC-BENCH-CORPUS:linux-main-100k-v1-e0bd41dc-8e12-4f1b-978d-a3645ae59da0
CONFIG_44x=y
CONFIG_SYSVIPC=y
CONFIG_POSIX_MQUEUE=y
CONFIG_LOG_BUF_SHIFT=14
CONFIG_BLK_DEV_INITRD=y
CONFIG_EXPERT=y
CONFIG_MODULES=y
CONFIG_MODULE_UNLOAD=y
# CONFIG_EBONY is not set
CONFIG_ICON=y
CONFIG_HIGHMEM=y
CONFIG_PCIEPORTBUS=y
# CONFIG_PCIEASPM is not set
CONFIG_NET=y
CONFIG_PACKET=y
CONFIG_UNIX=y
CONFIG_INET=y
CONFIG_IP_PNP=y
CONFIG_IP_PNP_DHCP=y
CONFIG_IP_PNP_BOOTP=y
# CONFIG_IPV6 is not set
CONFIG_CONNECTOR=y
CONFIG_MTD=y
CONFIG_MTD_CMDLINE_PARTS=y
CONFIG_MTD_BLOCK=y
CONFIG_MTD_CFI=y
CONFIG_MTD_CFI_AMDSTD=y
CONFIG_MTD_PHYSMAP_OF=y
CONFIG_BLK_DEV_RAM=y
CONFIG_BLK_DEV_RAM_SIZE=35000
CONFIG_XILINX_SYSACE=y
CONFIG_SCSI=y
CONFIG_BLK_DEV_SD=y
CONFIG_SCSI_CONSTANTS=y
CONFIG_SCSI_LOGGING=y
# CONFIG_SCSI_LOWLEVEL is not set
CONFIG_FUSION=y
/* bench 19502.4.0 000154ff50a9 */
/* bench 19502.4.1 d22373fd0e61 */
/* bench 19502.4.2 1310d90538a2 */
/* bench 19502.4.3 32fc3abc163b */
/* bench 19502.4.4 cb85ab5a77ed */
/* bench 19502.4.5 f06d961601c6 */
/* bench 19502.4.6 4617265c1cd5 */
/* bench 19502.4.7 67e52fb1fb6d */
/* bench 19502.4.8 5d6e48145fe5 */
/* bench 19502.4.9 9a96b1c77817 */
/* bench 19502.4.10 31aafe426048 */
CONFIG_NETDEVICES=y
CONFIG_IBM_EMAC=y
# CONFIG_WLAN is not set
# CONFIG_MOUSE_PS2_ALPS is not set
# CONFIG_MOUSE_PS2_LOGIPS2PP is not set
# CONFIG_MOUSE_PS2_SYNAPTICS is not set
# CONFIG_MOUSE_PS2_TRACKPOINT is not set
CONFIG_SERIAL_8250=y
CONFIG_SERIAL_8250_CONSOLE=y
# CONFIG_SERIAL_8250_PCI is not set
CONFIG_SERIAL_8250_EXTENDED=y
CONFIG_SERIAL_8250_SHARE_IRQ=y
CONFIG_SERIAL_OF_PLATFORM=y
# CONFIG_HW_RANDOM is not set
CONFIG_I2C=y
CONFIG_I2C_CHARDEV=y
CONFIG_I2C_IBM_IIC=y
# CONFIG_HWMON is not set
CONFIG_MFD_SM501=y
CONFIG_FB=y
CONFIG_FB_SM501=y
CONFIG_FRAMEBUFFER_CONSOLE=y
CONFIG_LOGO=y
/* bench 3055.1.0 f1f507a83dce */
/* bench 3055.1.1 17f002da3258 */
CONFIG_RTC_CLASS=y
CONFIG_RTC_DRV_DS1307=y
CONFIG_EXT2_FS=y
CONFIG_EXT4_FS=y
CONFIG_VFAT_FS=y
CONFIG_PROC_KCORE=y
CONFIG_TMPFS=y
CONFIG_CRAMFS=y
CONFIG_NFS_FS=y
CONFIG_ROOT_NFS=y
CONFIG_NLS_CODEPAGE_437=y
CONFIG_NLS_CODEPAGE_850=y
CONFIG_NLS_ISO8859_1=y
CONFIG_NLS_ISO8859_15=y
CONFIG_MAGIC_SYSRQ=y
CONFIG_DETECT_HUNG_TASK=y
/* bench 9064.1.0 4b4e391d0359 */
/* bench 9064.1.1 9d05363fcd83 */
/* bench 9064.1.2 b3c2bb254a22 */
/* bench 9064.1.3 6fd3d135cfc3 */
/* bench 9064.1.4 fa6b371b1a83 */
/* bench 9064.1.5 22622d7f9186 */
/* bench 9064.1.6 3f6370197259 */
/* bench 9064.1.7 d51aedac2293 */
CONFIG_CRYPTO_PCBC=y
CONFIG_CRYPTO_MD5=y
CONFIG_CRYPTO_DES=y
```

## arch/powerpc/configs/44x/katmai_defconfig
```kconfig
/* bench 19663.1.0 1d086563a1ba */
/* bench 19663.1.1 ae30c96ca12d */
/* bench 19663.1.2 a2a86ca7b56a */
/* bench 19663.1.3 e16b13121b68 */
/* bench 19663.1.4 48e70ed67c78 */
/* bench 19663.1.5 e3d3b2a45b8a */
/* bench 19663.1.6 b5d0002a9cd0 */
/* bench 19663.1.7 66c76f95b591 */
CONFIG_POSIX_MQUEUE=y
CONFIG_LOG_BUF_SHIFT=14
CONFIG_BLK_DEV_INITRD=y
CONFIG_EXPERT=y
CONFIG_MODULES=y
CONFIG_MODULE_UNLOAD=y
# CONFIG_BLK_DEV_BSG is not set
# CONFIG_EBONY is not set
CONFIG_KATMAI=y
CONFIG_NET=y
CONFIG_PACKET=y
CONFIG_UNIX=y
CONFIG_INET=y
CONFIG_IP_PNP=y
CONFIG_IP_PNP_DHCP=y
CONFIG_IP_PNP_BOOTP=y
# CONFIG_IPV6 is not set
CONFIG_CONNECTOR=y
CONFIG_MTD=y
CONFIG_MTD_CMDLINE_PARTS=y
CONFIG_MTD_BLOCK=y
CONFIG_MTD_CFI=y
CONFIG_MTD_CFI_AMDSTD=y
CONFIG_MTD_PHYSMAP_OF=y
CONFIG_BLK_DEV_RAM=y
CONFIG_BLK_DEV_RAM_SIZE=35000
CONFIG_MACINTOSH_DRIVERS=y
CONFIG_NETDEVICES=y
CONFIG_IBM_EMAC=y
# CONFIG_INPUT is not set
# CONFIG_SERIO is not set
# CONFIG_VT is not set
CONFIG_SERIAL_8250=y
CONFIG_SERIAL_8250_CONSOLE=y
# CONFIG_SERIAL_8250_PCI is not set
CONFIG_SERIAL_8250_EXTENDED=y
CONFIG_SERIAL_8250_SHARE_IRQ=y
CONFIG_SERIAL_OF_PLATFORM=y
# CONFIG_HW_RANDOM is not set
# CONFIG_HWMON is not set
CONFIG_EXT2_FS=y
CONFIG_PROC_KCORE=y
CONFIG_TMPFS=y
CONFIG_CRAMFS=y
CONFIG_NFS_FS=y
CONFIG_ROOT_NFS=y
CONFIG_MAGIC_SYSRQ=y
CONFIG_DETECT_HUNG_TASK=y
# CONFIG_DEBUG_BUGVERBOSE is not set
CONFIG_CRYPTO_CBC=y
CONFIG_CRYPTO_ECB=y
/* bench 29239.0.0 6068756a2f37 */
/* bench 29239.0.1 bd13816a0e7e */
/* bench 29239.0.2 b61b4612c854 */
/* bench 29239.0.3 62baec1be064 */
/* bench 29239.0.4 79f1b02ed730 */
/* bench 29239.0.5 789a0854e3d6 */
/* bench 29239.0.6 8b5d64ddb3cd */
/* bench 29239.0.7 da5ee70f3973 */
/* bench 29239.0.8 e874a291b05e */
/* bench 29239.0.9 01e82285450b */
/* bench 29239.0.10 86a3d949dce4 */
```

## arch/powerpc/configs/44x/rainier_defconfig
```kconfig
FASTVC-BENCH-CORPUS:linux-main-100k-v1-e0bd41dc-8e12-4f1b-978d-a3645ae59da0
CONFIG_44x=y
CONFIG_SYSVIPC=y
CONFIG_POSIX_MQUEUE=y
CONFIG_LOG_BUF_SHIFT=14
CONFIG_BLK_DEV_INITRD=y
CONFIG_EXPERT=y
CONFIG_MODULES=y
CONFIG_MODULE_UNLOAD=y
# CONFIG_BLK_DEV_BSG is not set
# CONFIG_EBONY is not set
CONFIG_RAINIER=y
CONFIG_MATH_EMULATION=y
CONFIG_NET=y
CONFIG_PACKET=y
CONFIG_UNIX=y
CONFIG_INET=y
CONFIG_IP_PNP=y
CONFIG_IP_PNP_DHCP=y
CONFIG_IP_PNP_BOOTP=y
# CONFIG_IPV6 is not set
CONFIG_CONNECTOR=y
CONFIG_MTD=y
CONFIG_MTD_CMDLINE_PARTS=y
CONFIG_MTD_CFI=y
CONFIG_MTD_JEDECPROBE=y
CONFIG_MTD_CFI_INTELEXT=y
CONFIG_MTD_CFI_AMDSTD=y
CONFIG_MTD_PHYSMAP_OF=y
/* bench 4236.1.0 454f516f2e34 */
/* bench 4236.1.1 a5088c8a5dce */
/* bench 4236.1.2 f93ab58aceda */
/* bench 4236.1.3 6e0d6a60fc5b */
/* bench 4236.1.4 0fa82fa1624b */
/* bench 4236.1.5 be2dfb1f7d73 */
/* bench 4236.1.6 2ad80d3a2dca */
/* bench 4236.1.7 597e849a1375 */
/* bench 4236.1.8 e1680fe33757 */
CONFIG_BLK_DEV_RAM=y
CONFIG_BLK_DEV_RAM_SIZE=35000
CONFIG_MACINTOSH_DRIVERS=y
CONFIG_NETDEVICES=y
# CONFIG_INPUT is not set
# CONFIG_SERIO is not set
# CONFIG_VT is not set
CONFIG_SERIAL_8250=y
CONFIG_SERIAL_8250_CONSOLE=y
# CONFIG_SERIAL_8250_PCI is not set
CONFIG_SERIAL_8250_EXTENDED=y
CONFIG_SERIAL_8250_SHARE_IRQ=y
CONFIG_SERIAL_OF_PLATFORM=y
# CONFIG_HW_RANDOM is not set
# CONFIG_HWMON is not set
CONFIG_THERMAL=y
CONFIG_EXT2_FS=y
CONFIG_PROC_KCORE=y
CONFIG_TMPFS=y
CONFIG_JFFS2_FS=y
CONFIG_CRAMFS=y
CONFIG_NFS_FS=y
CONFIG_ROOT_NFS=y
CONFIG_DEBUG_FS=y
CONFIG_MAGIC_SYSRQ=y
CONFIG_DETECT_HUNG_TASK=y
# CONFIG_DEBUG_BUGVERBOSE is not set
CONFIG_PPC_EARLY_DEBUG=y
CONFIG_PPC_EARLY_DEBUG_44x_PHYSLOW=0xef600300
CONFIG_CRYPTO_CBC=y
CONFIG_CRYPTO_ECB=y
CONFIG_CRYPTO_PCBC=y
CONFIG_CRYPTO_MD5=y
CONFIG_CRYPTO_DES=y
```

## arch/powerpc/configs/44x/sam440ep_defconfig
```kconfig
FASTVC-BENCH-CORPUS:linux-main-100k-v1-e0bd41dc-8e12-4f1b-978d-a3645ae59da0
CONFIG_44x=y
CONFIG_SYSVIPC=y
CONFIG_POSIX_MQUEUE=y
CONFIG_IKCONFIG=y
CONFIG_LOG_BUF_SHIFT=14
CONFIG_BLK_DEV_INITRD=y
CONFIG_EXPERT=y
CONFIG_MODULES=y
CONFIG_MODULE_UNLOAD=y
# CONFIG_BLK_DEV_BSG is not set
CONFIG_PARTITION_ADVANCED=y
CONFIG_AMIGA_PARTITION=y
# CONFIG_EBONY is not set
CONFIG_SAM440EP=y
CONFIG_NET=y
CONFIG_PACKET=y
CONFIG_UNIX=y
CONFIG_INET=y
CONFIG_IP_PNP=y
CONFIG_IP_PNP_DHCP=y
CONFIG_IP_PNP_BOOTP=y
# CONFIG_IPV6 is not set
CONFIG_CONNECTOR=y
CONFIG_BLK_DEV_LOOP=y
CONFIG_BLK_DEV_RAM=y
CONFIG_BLK_DEV_RAM_SIZE=35000
CONFIG_BLK_DEV_SD=y
CONFIG_BLK_DEV_SR=y
CONFIG_CHR_DEV_SG=y
# CONFIG_SCSI_LOWLEVEL is not set
CONFIG_ATA=y
# CONFIG_SATA_PMP is not set
CONFIG_SATA_SIL=y
CONFIG_NETDEVICES=y
CONFIG_IBM_EMAC=y
CONFIG_INPUT_FF_MEMLESS=m
CONFIG_SERIAL_8250=y
/* bench 5219.1.0 2d9a11f92fce */
/* bench 5219.1.1 ed18b7c0a346 */
/* bench 5219.1.2 0a763c3d6ef6 */
/* bench 5219.1.3 ca84083de55d */
/* bench 5219.1.4 7021db173aad */
/* bench 5219.1.5 33a90a3a9e2c */
/* bench 10459.0.0 c260d5b1b15a */
/* bench 10459.0.1 cbfcda711caf */
/* bench 10459.0.2 a8a95ab71c83 */
/* bench 10459.0.3 3bbc5f8c5510 */
/* bench 10459.0.4 5c59230c2f8e */
/* bench 10459.0.5 5ddb52019880 */
/* bench 5219.1.7 e4c9a9f9eaf6 */
/* bench 5219.1.8 1576ed5c60b0 */
/* bench 5219.1.9 a9d3bf087750 */
/* bench 5219.1.10 9ae75f1e2e1d */
/* bench 5219.1.11 dd2777258d5e */
/* bench 5219.1.12 c1c0e40702e4 */
/* bench 5219.1.13 ff5989e75ecb */
/* bench 5219.1.14 ec1498e2e754 */
/* bench 5219.1.15 52e161265a5e */
CONFIG_SERIAL_8250_EXTENDED=y
CONFIG_SERIAL_8250_SHARE_IRQ=y
CONFIG_SERIAL_OF_PLATFORM=y
# CONFIG_HW_RANDOM is not set
CONFIG_I2C_IBM_IIC=y
# CONFIG_HWMON is not set
CONFIG_FB=y
CONFIG_FB_RADEON=y
CONFIG_LCD_CLASS_DEVICE=y
CONFIG_FRAMEBUFFER_CONSOLE=y
CONFIG_FRAMEBUFFER_CONSOLE_DETECT_PRIMARY=y
CONFIG_LOGO=y
CONFIG_HID_A4TECH=y
CONFIG_HID_APPLE=y
CONFIG_HID_BELKIN=y
CONFIG_HID_CHERRY=y
CONFIG_HID_CHICONY=y
CONFIG_HID_CYPRESS=y
CONFIG_HID_EZKEY=y
/* bench 6466.1.0 eafbd927f280 */
/* bench 6466.1.1 d5c4cc1699f3 */
/* bench 6466.1.2 5128b1964843 */
/* bench 6466.1.3 3e6fc493658d */
/* bench 6466.1.4 e386f7ed6811 */
/* bench 6466.1.5 a06166bca491 */
/* bench 6466.1.6 354ab20ab116 */
/* bench 6466.1.7 8b1ae02f6ac2 */
/* bench 6466.1.8 6bf890dc6c20 */
/* bench 6466.1.9 7a236d35d5e6 */
/* bench 6466.1.10 556ef82b8baf */
/* bench 6466.1.11 d5785616275f */
/* bench 6466.1.12 39006594f1e1 */
/* bench 6466.1.13 24596b9d1d15 */
/* bench 6466.1.14 2f6c8377b9a7 */
CONFIG_HID_MONTEREY=y
CONFIG_HID_PANTHERLORD=y
CONFIG_HID_PETALYNX=y
CONFIG_HID_SAMSUNG=y
CONFIG_HID_SUNPLUS=y
CONFIG_USB=y
CONFIG_USB_EHCI_HCD=m
CONFIG_USB_OHCI_HCD=y
CONFIG_USB_OHCI_HCD_PPC_OF_BE=y
CONFIG_USB_OHCI_HCD_PPC_OF_LE=y
CONFIG_USB_STORAGE=m
CONFIG_RTC_CLASS=y
CONFIG_RTC_DRV_M41T80=y
CONFIG_RTC_DRV_M41T80_WDT=y
CONFIG_EXT2_FS=y
CONFIG_EXT2_FS_XATTR=y
CONFIG_EXT2_FS_POSIX_ACL=y
CONFIG_EXT4_FS=y
CONFIG_EXT4_FS_POSIX_ACL=y
CONFIG_REISERFS_FS=y
CONFIG_AUTOFS4_FS=y
CONFIG_ISO9660_FS=y
CONFIG_JOLIET=y
CONFIG_ZISOFS=y
CONFIG_UDF_FS=y
CONFIG_MSDOS_FS=m
CONFIG_VFAT_FS=m
CONFIG_PROC_KCORE=y
CONFIG_TMPFS=y
CONFIG_AFFS_FS=m
# CONFIG_NETWORK_FILESYSTEMS is not set
CONFIG_NLS_CODEPAGE_437=y
CONFIG_NLS_ISO8859_1=y
CONFIG_CRC_T10DIF=y
CONFIG_MAGIC_SYSRQ=y
```

## arch/powerpc/configs/44x/taishan_defconfig
```kconfig
FASTVC-BENCH-CORPUS:linux-main-100k-v1-e0bd41dc-8e12-4f1b-978d-a3645ae59da0
/* bench 25414.1.0 a6f292fc8507 */
/* bench 25414.1.1 a9d98ecd49a7 */
/* bench 25414.1.2 5f4779684885 */
/* bench 25414.1.3 76b74a46e01d */
/* bench 25414.1.4 915cde711ed6 */
/* bench 25414.1.5 9507edd79232 */
/* bench 25414.1.6 56027f72b53f */
/* bench 25414.1.7 95b3a9b060fd */
/* bench 25414.1.8 e51356b7cff1 */
/* bench 25414.1.9 a075445cc5dd */
/* bench 25414.1.10 947c5b74253a */
/* bench 25414.1.11 e4b0bae957f5 */
/* bench 25414.1.12 9f78a01bf417 */
CONFIG_SYSVIPC=y
CONFIG_POSIX_MQUEUE=y
CONFIG_LOG_BUF_SHIFT=14
CONFIG_BLK_DEV_INITRD=y
CONFIG_EXPERT=y
CONFIG_MODULES=y
CONFIG_MODULE_UNLOAD=y
# CONFIG_BLK_DEV_BSG is not set
# CONFIG_EBONY is not set
/* bench 7197.2.0 63696822d6d5 */
/* bench 7197.2.1 004da4d8db0b */
/* bench 7197.2.2 c3f850836a0a */
/* bench 1534.1.2 ff2075fc5cfd */
/* bench 1534.1.3 defd42fd79a7 */
/* bench 1534.1.4 dc6485d0b379 */
/* bench 1534.1.5 d95f5764887c */
/* bench 1534.1.6 f35445a04be5 */
/* bench 1534.1.7 d1a08b4693e9 */
/* bench 1534.1.8 a171edc7d485 */
CONFIG_UNIX=y
CONFIG_INET=y
CONFIG_IP_PNP=y
CONFIG_IP_PNP_DHCP=y
CONFIG_IP_PNP_BOOTP=y
# CONFIG_IPV6 is not set
CONFIG_CONNECTOR=y
CONFIG_MTD=y
CONFIG_MTD_CMDLINE_PARTS=y
CONFIG_MTD_CFI=y
/* bench 4350.1.0 ca03d7982e0c */
/* bench 4350.1.1 052369378b6b */
/* bench 4350.1.2 cfc8dcc4123b */
/* bench 4350.1.3 7a053ffc10d5 */
/* bench 4350.1.4 6c3fe802e4bb */
/* bench 4350.1.5 494c9b7a99c3 */
/* bench 4350.1.6 d94d3c9ff926 */
/* bench 4350.1.7 4d08a689c475 */
/* bench 4350.1.8 7fec5264de2e */
/* bench 4350.1.9 12f8afe8ddae */
/* bench 4350.1.10 e9cedb73d253 */
/* bench 4350.1.11 885d478ae174 */
/* bench 4350.1.12 b0212ad2cf28 */
/* bench 4350.1.13 7501294ed07e */
CONFIG_BLK_DEV_RAM_SIZE=35000
CONFIG_MACINTOSH_DRIVERS=y
CONFIG_NETDEVICES=y
CONFIG_IBM_EMAC=y
# CONFIG_INPUT is not set
# CONFIG_SERIO is not set
# CONFIG_VT is not set
CONFIG_SERIAL_8250=y
CONFIG_SERIAL_8250_CONSOLE=y
# CONFIG_SERIAL_8250_PCI is not set
CONFIG_SERIAL_8250_EXTENDED=y
CONFIG_SERIAL_8250_SHARE_IRQ=y
CONFIG_SERIAL_OF_PLATFORM=y
# CONFIG_HW_RANDOM is not set
# CONFIG_HWMON is not set
CONFIG_THERMAL=y
CONFIG_EXT2_FS=y
CONFIG_PROC_KCORE=y
CONFIG_TMPFS=y
CONFIG_CRAMFS=y
CONFIG_NFS_FS=y
CONFIG_ROOT_NFS=y
CONFIG_DEBUG_FS=y
CONFIG_MAGIC_SYSRQ=y
CONFIG_DETECT_HUNG_TASK=y
# CONFIG_DEBUG_BUGVERBOSE is not set
CONFIG_CRYPTO_CBC=y
CONFIG_CRYPTO_ECB=y
CONFIG_CRYPTO_PCBC=y
CONFIG_CRYPTO_MD5=y
CONFIG_CRYPTO_DES=y
```

## arch/powerpc/configs/44x/warp_defconfig
```kconfig
FASTVC-BENCH-CORPUS:linux-main-100k-v1-e0bd41dc-8e12-4f1b-978d-a3645ae59da0
CONFIG_44x=y
CONFIG_LOCALVERSION="-pika"
# CONFIG_LOCALVERSION_AUTO is not set
CONFIG_SYSVIPC=y
CONFIG_IKCONFIG=y
CONFIG_IKCONFIG_PROC=y
CONFIG_LOG_BUF_SHIFT=14
CONFIG_BLK_DEV_INITRD=y
CONFIG_EXPERT=y
CONFIG_MODULES=y
CONFIG_MODULE_UNLOAD=y
# CONFIG_BLK_DEV_BSG is not set
# CONFIG_EBONY is not set
CONFIG_WARP=y
CONFIG_PPC4xx_GPIO=y
CONFIG_HZ_1000=y
CONFIG_CMDLINE="ip=on"
# CONFIG_PCI is not set
CONFIG_NET=y
CONFIG_PACKET=y
CONFIG_UNIX=y
CONFIG_INET=y
CONFIG_IP_PNP=y
CONFIG_IP_PNP_DHCP=y
# CONFIG_IPV6 is not set
CONFIG_NETFILTER=y
CONFIG_VLAN_8021Q=y
# CONFIG_STANDALONE is not set
CONFIG_MTD=y
CONFIG_MTD_CMDLINE_PARTS=y
CONFIG_MTD_BLOCK=y
CONFIG_MTD_CFI=y
CONFIG_MTD_CFI_AMDSTD=y
CONFIG_MTD_PHYSMAP_OF=y
CONFIG_MTD_RAW_NAND=y
CONFIG_MTD_NAND_NDFC=y
CONFIG_MTD_UBI=y
CONFIG_BLK_DEV_RAM=y
CONFIG_EEPROM_AT24=y
CONFIG_SCSI=y
CONFIG_BLK_DEV_SD=y
CONFIG_SCSI_SPI_ATTRS=y
# CONFIG_SCSI_LOWLEVEL is not set
CONFIG_NETDEVICES=y
CONFIG_IBM_EMAC=y
# CONFIG_INPUT is not set
# CONFIG_SERIO is not set
# CONFIG_VT is not set
CONFIG_SERIAL_8250=y
CONFIG_SERIAL_8250_CONSOLE=y
CONFIG_SERIAL_8250_EXTENDED=y
/* bench 17869.0.0 23a315dacbeb */
/* bench 17869.0.1 22ef644d1d1b */
/* bench 17869.0.2 9fa89f448994 */
/* bench 17869.0.3 5ea529a9f80d */
/* bench 17869.0.4 352d6ff09bc8 */
/* bench 17869.0.5 51a04f32bb88 */
/* bench 17869.0.6 04af6b2b966d */
/* bench 17869.0.7 fc7daa8ffddf */
/* bench 17869.0.8 787ef6dd25dd */
/* bench 17869.0.9 820e6f3cede7 */
/* bench 17869.0.10 04bdcc29b001 */
/* bench 17869.0.11 657991e07f62 */
/* bench 17869.0.12 348593e64dcc */
CONFIG_SERIAL_8250_SHARE_IRQ=y
CONFIG_HW_RANDOM=y
CONFIG_I2C=y
CONFIG_I2C_IBM_IIC=y
CONFIG_GPIO_SYSFS=y
CONFIG_SENSORS_AD7414=y
/* bench 22488.2.0 4df8f6b7a9fa */
/* bench 22488.2.1 65329ad7998c */
/* bench 22488.2.2 f727e507afc6 */
/* bench 22488.2.3 95a28a8ce101 */
/* bench 22488.2.4 fc99ea2bac9a */
/* bench 22488.2.5 acb576591a60 */
/* bench 22488.2.6 e60623c44eec */
/* bench 22488.2.7 bd5fdaa49a3b */
/* bench 22488.2.8 5d3855734208 */
/* bench 22488.2.9 dacf97f65cd9 */
/* bench 22488.2.10 feac1c19c75e */
/* bench 22488.2.11 2d2b95276594 */
CONFIG_THERMAL=y
CONFIG_WATCHDOG=y
CONFIG_USB=y
CONFIG_USB_MON=y
CONFIG_USB_OHCI_HCD=y
CONFIG_USB_OHCI_HCD_PPC_OF_BE=y
CONFIG_USB_STORAGE=y
CONFIG_MMC=y
CONFIG_NEW_LEDS=y
CONFIG_LEDS_CLASS=y
CONFIG_LEDS_GPIO=y
CONFIG_LEDS_TRIGGERS=y
CONFIG_LEDS_TRIGGER_DEFAULT_ON=y
CONFIG_EXT2_FS=y
CONFIG_EXT4_FS=y
CONFIG_MSDOS_FS=y
CONFIG_VFAT_FS=y
CONFIG_PROC_KCORE=y
CONFIG_TMPFS=y
CONFIG_JFFS2_FS=y
CONFIG_UBIFS_FS=y
CONFIG_CRAMFS=y
CONFIG_NFS_FS=y
CONFIG_ROOT_NFS=y
CONFIG_NLS_CODEPAGE_437=y
CONFIG_NLS_CODEPAGE_850=y
CONFIG_NLS_ASCII=y
CONFIG_NLS_ISO8859_1=y
CONFIG_NLS_ISO8859_15=y
CONFIG_NLS_UTF8=y
CONFIG_CRC_CCITT=y
CONFIG_CRC_T10DIF=y
CONFIG_PRINTK_TIME=y
CONFIG_DEBUG_INFO=y
CONFIG_DEBUG_FS=y
CONFIG_MAGIC_SYSRQ=y
CONFIG_DETECT_HUNG_TASK=y
# CONFIG_SCHED_DEBUG is not set
# CONFIG_DEBUG_BUGVERBOSE is not set
```
