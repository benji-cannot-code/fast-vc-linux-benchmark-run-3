## arch/powerpc/configs/52xx/tqm5200_defconfig
```kconfig
FASTVC-BENCH-CORPUS:linux-main-100k-v1-e0bd41dc-8e12-4f1b-978d-a3645ae59da0
CONFIG_SYSVIPC=y
CONFIG_LOG_BUF_SHIFT=14
CONFIG_BLK_DEV_INITRD=y
# CONFIG_KALLSYMS is not set
# CONFIG_EPOLL is not set
CONFIG_EMBEDDED=y
CONFIG_MODULES=y
CONFIG_MODULE_UNLOAD=y
CONFIG_MODVERSIONS=y
# CONFIG_BLK_DEV_BSG is not set
CONFIG_PARTITION_ADVANCED=y
# CONFIG_PPC_CHRP is not set
/* bench 20639.4.0 3978021b7a2a */
/* bench 20639.4.1 059833fd6ab0 */
/* bench 20639.4.2 5627e8092f0b */
/* bench 20639.4.3 1f2aa6cf3c4d */
/* bench 20639.4.4 5a30d368389e */
/* bench 20639.4.5 6865862c075a */
/* bench 20639.4.6 814ec9c2f3fc */
/* bench 20639.4.7 754bf9f5d087 */
/* bench 20639.4.8 fb9330258128 */
/* bench 20639.4.9 fe7d9a3f44fb */
/* bench 20639.4.10 90570805908c */
/* bench 20639.4.11 378926501c35 */
CONFIG_PPC_MPC5200_BUGFIX=y
# CONFIG_PPC_PMAC is not set
CONFIG_PM=y
# CONFIG_PCI is not set
CONFIG_NET=y
CONFIG_PACKET=y
CONFIG_UNIX=y
CONFIG_XFRM_USER=y
CONFIG_INET=y
CONFIG_IP_MULTICAST=y
CONFIG_IP_PNP=y
CONFIG_IP_PNP_DHCP=y
CONFIG_IP_PNP_BOOTP=y
CONFIG_SYN_COOKIES=y
# CONFIG_IPV6 is not set
# CONFIG_FW_LOADER is not set
CONFIG_MTD=y
CONFIG_MTD_CMDLINE_PARTS=y
CONFIG_MTD_BLOCK=y
CONFIG_MTD_CFI=y
CONFIG_MTD_CFI_AMDSTD=y
CONFIG_MTD_ROM=y
CONFIG_MTD_PHYSMAP_OF=y
CONFIG_MTD_PLATRAM=y
CONFIG_BLK_DEV_LOOP=y
CONFIG_BLK_DEV_RAM=y
CONFIG_BLK_DEV_RAM_SIZE=32768
CONFIG_BLK_DEV_SD=y
CONFIG_CHR_DEV_SG=y
CONFIG_ATA=y
CONFIG_PATA_MPC52xx=y
CONFIG_PATA_PLATFORM=y
CONFIG_NETDEVICES=y
CONFIG_FEC_MPC52xx=y
CONFIG_LXT_PHY=y
CONFIG_SERIAL_MPC52xx=y
CONFIG_SERIAL_MPC52xx_CONSOLE=y
CONFIG_SERIAL_MPC52xx_CONSOLE_BAUD=115200
# CONFIG_HW_RANDOM is not set
CONFIG_I2C=y
CONFIG_I2C_CHARDEV=y
CONFIG_I2C_MPC=y
CONFIG_SENSORS_LM80=y
CONFIG_WATCHDOG=y
CONFIG_MFD_SM501=y
CONFIG_FB=y
CONFIG_FB_FOREIGN_ENDIAN=y
CONFIG_FB_SM501=y
CONFIG_FRAMEBUFFER_CONSOLE=y
CONFIG_USB=y
CONFIG_USB_MON=y
CONFIG_USB_OHCI_HCD=y
CONFIG_USB_OHCI_HCD_PPC_OF_BE=y
CONFIG_USB_STORAGE=y
CONFIG_RTC_CLASS=y
CONFIG_RTC_DRV_DS1307=y
CONFIG_RTC_DRV_DS1374=y
CONFIG_DMADEVICES=y
CONFIG_PPC_BESTCOMM=y
CONFIG_EXT2_FS=y
CONFIG_EXT4_FS=y
CONFIG_MSDOS_FS=y
CONFIG_VFAT_FS=y
CONFIG_PROC_KCORE=y
CONFIG_TMPFS=y
CONFIG_JFFS2_FS=y
CONFIG_CRAMFS=y
CONFIG_NFS_FS=y
CONFIG_NFS_V4=y
CONFIG_ROOT_NFS=y
CONFIG_NLS_CODEPAGE_437=y
CONFIG_NLS_ISO8859_1=y
CONFIG_PRINTK_TIME=y
CONFIG_DEBUG_INFO=y
CONFIG_DETECT_HUNG_TASK=y
# CONFIG_DEBUG_BUGVERBOSE is not set
CONFIG_CRYPTO_ECB=y
CONFIG_CRYPTO_PCBC=y
```

## arch/powerpc/configs/83xx/mpc8313_rdb_defconfig
```kconfig
FASTVC-BENCH-CORPUS:linux-main-100k-v1-e0bd41dc-8e12-4f1b-978d-a3645ae59da0
CONFIG_SYSVIPC=y
CONFIG_NO_HZ=y
CONFIG_HIGH_RES_TIMERS=y
CONFIG_LOG_BUF_SHIFT=14
CONFIG_BLK_DEV_INITRD=y
CONFIG_EXPERT=y
# CONFIG_KALLSYMS is not set
CONFIG_MODULES=y
CONFIG_MODULE_UNLOAD=y
# CONFIG_BLK_DEV_BSG is not set
CONFIG_PARTITION_ADVANCED=y
# CONFIG_PPC_CHRP is not set
# CONFIG_PPC_PMAC is not set
CONFIG_PPC_83xx=y
CONFIG_MPC831x_RDB=y
CONFIG_PCI=y
/* bench 27690.1.0 b86032be4aa7 */
/* bench 27690.1.1 96af5f3cc00e */
/* bench 27690.1.2 272c953c678e */
/* bench 27690.1.3 962ddfa2630c */
/* bench 27690.1.4 512d92992cc4 */
/* bench 27690.1.5 4abed88435d6 */
/* bench 27690.1.6 b704ea2b84bd */
/* bench 27690.1.7 906687ae6ac0 */
/* bench 27690.1.8 3e8f49074da9 */
/* bench 27690.1.9 1c80a8da96ba */
CONFIG_INET=y
CONFIG_IP_MULTICAST=y
CONFIG_IP_PNP=y
CONFIG_IP_PNP_DHCP=y
CONFIG_IP_PNP_BOOTP=y
CONFIG_SYN_COOKIES=y
# CONFIG_IPV6 is not set
# CONFIG_FW_LOADER is not set
CONFIG_MTD=y
CONFIG_MTD_BLOCK=y
CONFIG_MTD_CFI=y
CONFIG_MTD_CFI_AMDSTD=y
CONFIG_MTD_PHYSMAP_OF=y
CONFIG_MTD_RAW_NAND=y
CONFIG_MTD_NAND_FSL_ELBC=y
CONFIG_BLK_DEV_LOOP=y
CONFIG_BLK_DEV_RAM=y
CONFIG_BLK_DEV_RAM_SIZE=32768
CONFIG_SCSI=y
CONFIG_CHR_DEV_SG=y
CONFIG_SCSI_SPI_ATTRS=y
CONFIG_MD=y
CONFIG_BLK_DEV_MD=y
CONFIG_MD_LINEAR=y
CONFIG_MD_RAID0=y
CONFIG_MD_RAID1=y
CONFIG_NETDEVICES=y
CONFIG_GIANFAR=y
CONFIG_E100=y
CONFIG_CICADA_PHY=y
# CONFIG_INPUT_KEYBOARD is not set
# CONFIG_INPUT_MOUSE is not set
# CONFIG_SERIO is not set
# CONFIG_VT is not set
CONFIG_SERIAL_8250=y
CONFIG_SERIAL_8250_CONSOLE=y
CONFIG_HW_RANDOM=y
CONFIG_I2C=y
CONFIG_I2C_CHARDEV=y
CONFIG_I2C_MPC=y
CONFIG_SPI=y
CONFIG_SPI_BITBANG=y
CONFIG_WATCHDOG=y
# CONFIG_USB_HID is not set
CONFIG_USB=y
CONFIG_USB_MON=y
CONFIG_USB_EHCI_HCD=y
CONFIG_USB_EHCI_FSL=y
CONFIG_USB_OHCI_HCD=y
CONFIG_USB_OHCI_HCD_PPC_OF_BE=y
CONFIG_USB_UHCI_HCD=y
CONFIG_USB_STORAGE=y
CONFIG_USB_GADGET=y
CONFIG_USB_ETH=m
CONFIG_RTC_CLASS=y
/* bench 3331.0.0 1f59bf6c09e2 */
/* bench 3331.0.1 1f8ff7ee6091 */
/* bench 3331.0.2 4cfedc7f061a */
/* bench 3331.0.3 462aa6e5d9f0 */
/* bench 3331.0.4 87fbfd92e1e5 */
/* bench 3331.0.5 f0563286eadd */
/* bench 3331.0.6 5278cb67b726 */
/* bench 3331.0.7 5053cc34b659 */
/* bench 3331.0.8 6924b67201c7 */
CONFIG_EXT2_FS=y
CONFIG_EXT4_FS=y
CONFIG_PROC_KCORE=y
CONFIG_TMPFS=y
CONFIG_JFFS2_FS=y
CONFIG_NFS_FS=y
CONFIG_NFS_V4=y
CONFIG_ROOT_NFS=y
CONFIG_DETECT_HUNG_TASK=y
CONFIG_CRYPTO_PCBC=m
```

## arch/powerpc/configs/83xx/mpc832x_rdb_defconfig
```kconfig
FASTVC-BENCH-CORPUS:linux-main-100k-v1-e0bd41dc-8e12-4f1b-978d-a3645ae59da0
CONFIG_SYSVIPC=y
CONFIG_NO_HZ=y
CONFIG_HIGH_RES_TIMERS=y
CONFIG_LOG_BUF_SHIFT=14
CONFIG_BLK_DEV_INITRD=y
CONFIG_EXPERT=y
# CONFIG_KALLSYMS is not set
CONFIG_MODULES=y
CONFIG_MODULE_UNLOAD=y
# CONFIG_BLK_DEV_BSG is not set
CONFIG_PARTITION_ADVANCED=y
CONFIG_LDM_PARTITION=y
# CONFIG_PPC_CHRP is not set
# CONFIG_PPC_PMAC is not set
CONFIG_PPC_83xx=y
CONFIG_MPC832x_RDB=y
CONFIG_GEN_RTC=y
CONFIG_MATH_EMULATION=y
CONFIG_PCI=y
CONFIG_NET=y
CONFIG_PACKET=y
CONFIG_UNIX=y
CONFIG_INET=y
CONFIG_IP_MULTICAST=y
CONFIG_IP_PNP=y
CONFIG_IP_PNP_DHCP=y
CONFIG_IP_PNP_BOOTP=y
CONFIG_SYN_COOKIES=y
# CONFIG_IPV6 is not set
# CONFIG_FW_LOADER is not set
CONFIG_BLK_DEV_LOOP=y
/* bench 26825.1.0 be69ab81ebae */
/* bench 26825.1.1 60e59dbb1411 */
/* bench 26825.1.2 d8c26aaff3e1 */
/* bench 26825.1.3 c2a979d96e87 */
/* bench 26825.1.4 e43495159a97 */
/* bench 26825.1.5 70df395d9dcb */
/* bench 26825.1.6 138af254ca49 */
CONFIG_BLK_DEV_RAM_SIZE=32768
CONFIG_SCSI=y
CONFIG_BLK_DEV_SD=y
CONFIG_NETDEVICES=y
CONFIG_UCC_GETH=y
CONFIG_E1000=y
CONFIG_ICPLUS_PHY=y
# CONFIG_INPUT_KEYBOARD is not set
# CONFIG_INPUT_MOUSE is not set
# CONFIG_SERIO is not set
# CONFIG_VT is not set
CONFIG_SERIAL_8250=y
CONFIG_SERIAL_8250_CONSOLE=y
CONFIG_HW_RANDOM=y
CONFIG_I2C=y
CONFIG_I2C_CHARDEV=y
CONFIG_I2C_MPC=y
CONFIG_SPI=y
CONFIG_SPI_BITBANG=y
CONFIG_WATCHDOG=y
# CONFIG_USB_HID is not set
CONFIG_USB=y
CONFIG_USB_MON=y
CONFIG_USB_EHCI_HCD=y
CONFIG_USB_OHCI_HCD=y
CONFIG_USB_OHCI_HCD_PPC_OF_BE=y
CONFIG_USB_STORAGE=y
CONFIG_MMC=y
CONFIG_MMC_SPI=y
CONFIG_QUICC_ENGINE=y
CONFIG_EXT2_FS=y
CONFIG_EXT4_FS=y
CONFIG_MSDOS_FS=y
/* bench 4025.1.0 b389289446c8 */
/* bench 4025.1.1 02ad8835c1e1 */
/* bench 4025.1.2 68b0d5e6915b */
/* bench 4025.1.3 bd1ef175e63c */
/* bench 4025.1.4 7dbfc751271e */
/* bench 4025.1.5 e39829389686 */
/* bench 4025.1.6 4a9dc034e1d3 */
/* bench 4025.1.7 f6c9480bf208 */
CONFIG_TMPFS=y
CONFIG_NFS_FS=y
CONFIG_NFS_V4=y
CONFIG_ROOT_NFS=y
CONFIG_NLS_CODEPAGE_437=y
CONFIG_NLS_CODEPAGE_932=y
CONFIG_NLS_ISO8859_8=y
CONFIG_NLS_ISO8859_1=y
CONFIG_CRC_T10DIF=y
CONFIG_CRYPTO_ECB=m
CONFIG_CRYPTO_PCBC=m
```

## arch/powerpc/configs/83xx/mpc834x_itxgp_defconfig
```kconfig
FASTVC-BENCH-CORPUS:linux-main-100k-v1-e0bd41dc-8e12-4f1b-978d-a3645ae59da0
CONFIG_SYSVIPC=y
CONFIG_NO_HZ=y
CONFIG_HIGH_RES_TIMERS=y
CONFIG_LOG_BUF_SHIFT=14
CONFIG_BLK_DEV_INITRD=y
CONFIG_EXPERT=y
# CONFIG_KALLSYMS is not set
CONFIG_MODULES=y
CONFIG_MODULE_UNLOAD=y
# CONFIG_BLK_DEV_BSG is not set
CONFIG_PARTITION_ADVANCED=y
CONFIG_MAC_PARTITION=y
# CONFIG_PPC_CHRP is not set
# CONFIG_PPC_PMAC is not set
CONFIG_PPC_83xx=y
CONFIG_MPC834x_ITX=y
CONFIG_PCI=y
CONFIG_NET=y
CONFIG_PACKET=y
CONFIG_UNIX=y
CONFIG_INET=y
CONFIG_IP_MULTICAST=y
CONFIG_IP_PNP=y
CONFIG_IP_PNP_DHCP=y
CONFIG_IP_PNP_BOOTP=y
CONFIG_SYN_COOKIES=y
/* bench 8598.1.0 26077b6ae3b1 */
/* bench 8598.1.1 474dccba29b7 */
/* bench 8598.1.2 2c89a1a42233 */
/* bench 8598.1.3 41c7441efb53 */
/* bench 8598.1.4 c0b3ebf0383c */
/* bench 8598.1.5 3a13eb8ef4e7 */
/* bench 8598.1.6 3a85ef49c502 */
/* bench 8598.1.7 a60d4c139e29 */
/* bench 8598.1.8 94c4eed54f46 */
/* bench 8598.1.9 3ae3650d3950 */
/* bench 8598.1.10 4d466647a51f */
/* bench 8598.1.11 a811c15b2ba1 */
CONFIG_MTD=y
CONFIG_MTD_CFI=y
/* bench 8449.4.0 6214b70d2570 */
/* bench 8449.4.1 6c86471d2958 */
/* bench 8449.4.2 f4ccd4cce943 */
/* bench 8449.4.3 c137feab1ece */
/* bench 8449.4.4 1e102301d258 */
/* bench 8449.4.5 43375bd513e1 */
/* bench 8449.4.6 522789bc1e52 */
/* bench 8449.4.7 9e2cd25f81de */
CONFIG_MTD_CFI_AMDSTD=y
CONFIG_MTD_PHYSMAP=y
CONFIG_BLK_DEV_LOOP=y
CONFIG_BLK_DEV_RAM=y
CONFIG_BLK_DEV_RAM_SIZE=32768
CONFIG_SCSI=y
CONFIG_BLK_DEV_SD=y
CONFIG_CHR_DEV_SG=y
CONFIG_SCSI_SPI_ATTRS=y
CONFIG_NETDEVICES=y
CONFIG_GIANFAR=y
CONFIG_CICADA_PHY=y
# CONFIG_INPUT is not set
# CONFIG_SERIO is not set
# CONFIG_VT is not set
CONFIG_SERIAL_8250=y
CONFIG_SERIAL_8250_CONSOLE=y
# CONFIG_SERIAL_8250_PCI is not set
CONFIG_HW_RANDOM=y
CONFIG_I2C=y
CONFIG_I2C_CHARDEV=y
CONFIG_I2C_MPC=y
CONFIG_SPI=y
CONFIG_SPI_BITBANG=y
# CONFIG_HWMON is not set
CONFIG_WATCHDOG=y
CONFIG_USB=y
CONFIG_USB_MON=y
CONFIG_USB_EHCI_HCD=y
CONFIG_USB_EHCI_FSL=y
CONFIG_USB_UHCI_HCD=y
CONFIG_USB_STORAGE=y
CONFIG_RTC_CLASS=y
/* bench 18925.3.0 b64cb47fbf1e */
/* bench 18925.3.1 49114e80deab */
/* bench 18925.3.2 8218d9b338ff */
/* bench 18925.3.3 afbf2e6b8248 */
/* bench 18925.3.4 3d7dbecb68e0 */
/* bench 18925.3.5 1644928988e1 */
/* bench 18925.3.6 6c9086424722 */
/* bench 18925.3.7 3c04912482bb */
/* bench 18925.3.8 2520d2761872 */
/* bench 18925.3.9 3ff027cb177f */
/* bench 18925.3.10 629be902f61d */
/* bench 18925.3.11 45224eaf1e2c */
/* bench 18925.3.12 29c7b164205c */
/* bench 18925.3.13 1b756400eaf7 */
/* bench 18925.3.14 f204b923d4d7 */
/* bench 18925.3.15 2668642e6f99 */
CONFIG_EXT2_FS=y
CONFIG_EXT4_FS=y
CONFIG_MSDOS_FS=y
CONFIG_VFAT_FS=y
CONFIG_PROC_KCORE=y
CONFIG_TMPFS=y
/* bench 8409.3.0 f45d69bb9f52 */
/* bench 8409.3.1 cd047aa17777 */
/* bench 8409.3.2 46569e846293 */
/* bench 8409.3.3 e6b60b1494fd */
/* bench 8409.3.4 700b47bb3f0c */
/* bench 8409.3.5 012c450c44b4 */
/* bench 8409.3.6 ee7cbdca7198 */
/* bench 24650.1.0 dcb92913d32c */
/* bench 24650.1.1 5cd36223b2fb */
/* bench 24650.1.2 3baeced91417 */
/* bench 24650.1.3 4fe87193f8e3 */
/* bench 24650.1.4 0e1166490415 */
/* bench 24650.1.5 f1db41791968 */
CONFIG_ROOT_NFS=y
CONFIG_CRC_T10DIF=y
CONFIG_CRYPTO_PCBC=m
```

## arch/powerpc/configs/83xx/mpc834x_mds_defconfig
```kconfig
FASTVC-BENCH-CORPUS:linux-main-100k-v1-e0bd41dc-8e12-4f1b-978d-a3645ae59da0
CONFIG_SYSVIPC=y
CONFIG_NO_HZ=y
CONFIG_HIGH_RES_TIMERS=y
CONFIG_LOG_BUF_SHIFT=14
CONFIG_BLK_DEV_INITRD=y
CONFIG_EXPERT=y
# CONFIG_KALLSYMS is not set
CONFIG_MODULES=y
CONFIG_MODULE_UNLOAD=y
# CONFIG_BLK_DEV_BSG is not set
/* bench 16714.0.0 fb8df7578263 */
/* bench 16714.0.1 a2d507b1cbe1 */
/* bench 16714.0.2 1742ddd7fb16 */
/* bench 16714.0.3 1b2e179d0805 */
/* bench 16714.0.4 a7996c528ab7 */
/* bench 16714.0.5 13bd017c68f3 */
/* bench 16714.0.6 9ea433b5be86 */
/* bench 16714.0.7 130dc3585a69 */
/* bench 16714.0.8 7694653e32bd */
/* bench 16714.0.9 093546bea905 */
/* bench 16714.0.10 936cf1c330f3 */
/* bench 16714.0.11 745919a4134f */
/* bench 16714.0.12 7dfb65b6e54f */
/* bench 16714.0.13 5e5e9049df90 */
# CONFIG_PPC_CHRP is not set
# CONFIG_PPC_PMAC is not set
CONFIG_PPC_83xx=y
CONFIG_MPC834x_MDS=y
CONFIG_PCI=y
CONFIG_NET=y
CONFIG_PACKET=y
CONFIG_UNIX=y
/* bench 18793.2.0 a203a529458f */
/* bench 18793.2.1 47effac7dbf5 */
/* bench 18793.2.2 d152644225e0 */
/* bench 18793.2.3 79c37d4b17e5 */
/* bench 18793.2.4 2272ce8769c9 */
/* bench 18793.2.5 d909e1062467 */
/* bench 18793.2.6 23a2a903186a */
/* bench 18793.2.7 03ba90fc3670 */
CONFIG_INET=y
CONFIG_IP_MULTICAST=y
CONFIG_IP_PNP=y
CONFIG_IP_PNP_DHCP=y
CONFIG_IP_PNP_BOOTP=y
CONFIG_SYN_COOKIES=y
# CONFIG_IPV6 is not set
# CONFIG_FW_LOADER is not set
CONFIG_BLK_DEV_LOOP=y
CONFIG_BLK_DEV_RAM=y
CONFIG_BLK_DEV_RAM_SIZE=32768
CONFIG_NETDEVICES=y
CONFIG_GIANFAR=y
CONFIG_E100=y
CONFIG_MARVELL_PHY=y
# CONFIG_INPUT_KEYBOARD is not set
/* bench 17613.1.0 3dc8e9046a14 */
/* bench 17613.1.1 6948ef70c22f */
/* bench 17613.1.2 7895452e8cfd */
/* bench 17613.1.3 dd7a0956fa98 */
/* bench 17613.1.4 18ba4f61cd63 */
/* bench 17613.1.5 aeb5d7a74981 */
/* bench 17613.1.6 8e8c87e56739 */
/* bench 17613.1.7 b5b296f76d44 */
/* bench 17613.1.8 739e29a6b117 */
/* bench 17613.1.9 b10605546a70 */
/* bench 17613.1.10 c0fc7231031d */
/* bench 17613.1.11 7a84ce5bd63a */
/* bench 17613.1.12 6e7cf6d06090 */
/* bench 17613.1.13 4a3fe3e6275a */
/* bench 17613.1.14 edc76551a4ec */
# CONFIG_SERIO is not set
# CONFIG_VT is not set
CONFIG_SERIAL_8250=y
CONFIG_SERIAL_8250_CONSOLE=y
# CONFIG_HW_RANDOM is not set
CONFIG_I2C=y
CONFIG_I2C_CHARDEV=y
CONFIG_I2C_MPC=y
CONFIG_WATCHDOG=y
CONFIG_RTC_CLASS=y
CONFIG_RTC_DRV_DS1374=y
CONFIG_EXT2_FS=y
CONFIG_EXT4_FS=y
CONFIG_PROC_KCORE=y
CONFIG_TMPFS=y
CONFIG_NFS_FS=y
CONFIG_NFS_V4=y
CONFIG_ROOT_NFS=y
CONFIG_CRYPTO_ECB=m
CONFIG_CRYPTO_PCBC=m
```

## arch/powerpc/configs/83xx/mpc836x_mds_defconfig
```kconfig
FASTVC-BENCH-CORPUS:linux-main-100k-v1-e0bd41dc-8e12-4f1b-978d-a3645ae59da0
CONFIG_SYSVIPC=y
CONFIG_NO_HZ=y
CONFIG_HIGH_RES_TIMERS=y
CONFIG_LOG_BUF_SHIFT=14
CONFIG_BLK_DEV_INITRD=y
CONFIG_EXPERT=y
# CONFIG_KALLSYMS is not set
CONFIG_MODULES=y
CONFIG_MODULE_UNLOAD=y
# CONFIG_BLK_DEV_BSG is not set
CONFIG_PARTITION_ADVANCED=y
/* bench 3855.0.0 9a5863b86de8 */
/* bench 28649.1.0 6a3555b51311 */
/* bench 28649.1.1 bb9b5609460c */
/* bench 28649.1.2 0225639b2a76 */
/* bench 28649.1.3 ff28613b8b8a */
/* bench 28649.1.4 75ed4cf72a56 */
/* bench 28649.1.5 ee61cae9b25d */
/* bench 28649.1.6 8ce66f279ff1 */
/* bench 28649.1.7 330bf6118f3c */
/* bench 28649.1.8 996884e95f66 */
/* bench 4165.2.0 44a6f4bf944c */
/* bench 4165.2.1 c8a9244de35f */
/* bench 4165.2.2 0289c95299c8 */
/* bench 4165.2.3 03e925d99666 */
/* bench 4165.2.4 792ca2c898f1 */
/* bench 4165.2.5 45dd6ca4736d */
/* bench 4165.2.6 5b2a37df5b32 */
/* bench 4165.2.7 b9ffcdf47568 */
/* bench 3855.0.2 b898df5a5e61 */
/* bench 3855.0.3 e10d5ef819ce */
/* bench 3855.0.4 1b0b89acfc31 */
/* bench 3855.0.5 aa99d84e6265 */
/* bench 3855.0.6 709f436aeae8 */
/* bench 3855.0.7 d43d5e61a4d8 */
/* bench 3855.0.8 e8db49864cda */
/* bench 3855.0.9 f15b816bec32 */
/* bench 3855.0.10 d86523fe83db */
/* bench 3855.0.11 25dff068f129 */
/* bench 3855.0.12 9b398251a5bf */
/* bench 3855.0.13 cad0717d6067 */
# CONFIG_MSDOS_PARTITION is not set
# CONFIG_PPC_CHRP is not set
# CONFIG_PPC_PMAC is not set
CONFIG_PPC_83xx=y
CONFIG_MPC836x_MDS=y
CONFIG_PCI=y
CONFIG_NET=y
CONFIG_PACKET=y
CONFIG_UNIX=y
CONFIG_INET=y
CONFIG_IP_MULTICAST=y
CONFIG_IP_PNP=y
CONFIG_IP_PNP_DHCP=y
CONFIG_IP_PNP_BOOTP=y
CONFIG_SYN_COOKIES=y
# CONFIG_IPV6 is not set
# CONFIG_FW_LOADER is not set
CONFIG_MTD=y
CONFIG_MTD_CMDLINE_PARTS=y
CONFIG_MTD_BLOCK=y
CONFIG_MTD_CFI=y
CONFIG_MTD_CFI_AMDSTD=y
CONFIG_MTD_PHYSMAP_OF=y
CONFIG_BLK_DEV_LOOP=y
CONFIG_BLK_DEV_RAM=y
CONFIG_BLK_DEV_RAM_SIZE=32768
CONFIG_SCSI=y
CONFIG_NETDEVICES=y
CONFIG_UCC_GETH=y
CONFIG_MARVELL_PHY=y
# CONFIG_INPUT_KEYBOARD is not set
# CONFIG_INPUT_MOUSE is not set
# CONFIG_SERIO is not set
# CONFIG_VT is not set
CONFIG_SERIAL_8250=y
CONFIG_SERIAL_8250_CONSOLE=y
CONFIG_HW_RANDOM=y
CONFIG_I2C=y
CONFIG_I2C_CHARDEV=y
CONFIG_I2C_MPC=y
CONFIG_WATCHDOG=y
CONFIG_RTC_CLASS=y
CONFIG_RTC_DRV_DS1374=y
CONFIG_QUICC_ENGINE=y
CONFIG_EXT2_FS=y
CONFIG_EXT4_FS=y
CONFIG_PROC_KCORE=y
CONFIG_TMPFS=y
CONFIG_NFS_FS=y
CONFIG_NFS_V4=y
CONFIG_ROOT_NFS=y
CONFIG_CRYPTO_ECB=m
CONFIG_CRYPTO_PCBC=m
```
