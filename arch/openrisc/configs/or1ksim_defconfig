## arch/openrisc/configs/or1ksim_defconfig
```kconfig
FASTVC-BENCH-CORPUS:linux-main-100k-v1-e0bd41dc-8e12-4f1b-978d-a3645ae59da0
CONFIG_NO_HZ=y
CONFIG_LOG_BUF_SHIFT=14
CONFIG_BLK_DEV_INITRD=y
# CONFIG_RD_GZIP is not set
/* bench 10209.2.0 2e8e1e6a62fa */
/* bench 10209.2.1 6fed429df7ee */
/* bench 10209.2.2 c671e8e2afce */
/* bench 10209.2.3 f7f516aceadd */
/* bench 10209.2.4 e530b8f21c08 */
/* bench 10209.2.5 9a0af59cff2b */
/* bench 12761.1.0 5edecec4d64a */
/* bench 12761.1.1 cc89a670d2c4 */
/* bench 12761.1.2 fb0c74e4731f */
/* bench 12761.1.3 f51017bd1c81 */
/* bench 12761.1.4 1f7a3213f9fa */
/* bench 10209.2.6 eb24b7da515a */
CONFIG_EXPERT=y
# CONFIG_KALLSYMS is not set
# CONFIG_EPOLL is not set
# CONFIG_TIMERFD is not set
# CONFIG_EVENTFD is not set
# CONFIG_AIO is not set
# CONFIG_VM_EVENT_COUNTERS is not set
# CONFIG_COMPAT_BRK is not set
CONFIG_SLOB=y
CONFIG_MODULES=y
# CONFIG_BLOCK is not set
CONFIG_OPENRISC_BUILTIN_DTB="or1ksim"
CONFIG_HZ_100=y
CONFIG_NET=y
CONFIG_PACKET=y
CONFIG_UNIX=y
/* bench 23436.0.0 a79b4a500364 */
/* bench 23436.0.1 a9a361adb595 */
/* bench 23436.0.2 4bffc42b321d */
/* bench 23436.0.3 c8f8b913c319 */
/* bench 23436.0.4 02ef6410d77f */
/* bench 23436.0.5 0a7f2dcaad00 */
/* bench 23436.0.6 843c5df8589e */
/* bench 23436.0.7 ec498a120124 */
# CONFIG_INET_XFRM_MODE_BEET is not set
# CONFIG_INET_DIAG is not set
CONFIG_TCP_CONG_ADVANCED=y
# CONFIG_TCP_CONG_BIC is not set
# CONFIG_TCP_CONG_CUBIC is not set
# CONFIG_TCP_CONG_WESTWOOD is not set
# CONFIG_TCP_CONG_HTCP is not set
# CONFIG_IPV6 is not set
# CONFIG_WIRELESS is not set
CONFIG_DEVTMPFS=y
CONFIG_DEVTMPFS_MOUNT=y
# CONFIG_PREVENT_FIRMWARE_BUILD is not set
# CONFIG_FW_LOADER is not set
CONFIG_PROC_DEVICETREE=y
CONFIG_NETDEVICES=y
CONFIG_ETHOC=y
CONFIG_MICREL_PHY=y
# CONFIG_WLAN is not set
# CONFIG_INPUT is not set
# CONFIG_SERIO is not set
# CONFIG_VT is not set
# CONFIG_LEGACY_PTYS is not set
# CONFIG_DEVKMEM is not set
CONFIG_SERIAL_8250=y
CONFIG_SERIAL_8250_CONSOLE=y
CONFIG_SERIAL_OF_PLATFORM=y
# CONFIG_HW_RANDOM is not set
# CONFIG_HWMON is not set
# CONFIG_USB_SUPPORT is not set
# CONFIG_DNOTIFY is not set
CONFIG_TMPFS=y
CONFIG_NFS_FS=y
# CONFIG_ENABLE_MUST_CHECK is not set
```

## arch/parisc/Kconfig.debug
```kconfig
FASTVC-BENCH-CORPUS:linux-main-100k-v1-e0bd41dc-8e12-4f1b-978d-a3645ae59da0
# SPDX-License-Identifier: GPL-2.0
/* bench 11890.1.0 f02cb8bdb41b */
/* bench 11890.1.1 1974d73c7863 */
/* bench 11890.1.2 38740c6dddcd */
/* bench 11890.1.3 15badcc24cc2 */
/* bench 11890.1.4 7bcf9a831a24 */
/* bench 11890.1.5 30eb514184b0 */
/* bench 11890.1.6 3c55f319e78a */
/* bench 15670.1.0 1d277bef33f5 */
/* bench 15670.1.1 966d683d1d54 */
/* bench 15670.1.2 3c46b8757efb */
/* bench 22630.2.0 eb881c9c412f */
/* bench 22630.2.1 236aeaf916ae */
/* bench 22630.2.2 828a03309a8d */
/* bench 22630.2.3 04f714488559 */
/* bench 22630.2.4 991f701e505f */
/* bench 22630.2.5 e411b87bf01b */
config TRACE_IRQFLAGS_SUPPORT
	def_bool y
```

## arch/powerpc/configs/40x/acadia_defconfig
```kconfig
FASTVC-BENCH-CORPUS:linux-main-100k-v1-e0bd41dc-8e12-4f1b-978d-a3645ae59da0
CONFIG_40x=y
CONFIG_SYSVIPC=y
CONFIG_POSIX_MQUEUE=y
CONFIG_LOG_BUF_SHIFT=14
CONFIG_BLK_DEV_INITRD=y
CONFIG_EXPERT=y
CONFIG_KALLSYMS_ALL=y
CONFIG_MODULES=y
CONFIG_MODULE_UNLOAD=y
# CONFIG_BLK_DEV_BSG is not set
CONFIG_ACADIA=y
CONFIG_PCI=y
CONFIG_NET=y
CONFIG_PACKET=y
CONFIG_UNIX=y
CONFIG_INET=y
CONFIG_IP_PNP=y
CONFIG_IP_PNP_DHCP=y
CONFIG_IP_PNP_BOOTP=y
# CONFIG_IPV6 is not set
CONFIG_CONNECTOR=y
/* bench 19907.0.0 e2a73d7ddcc2 */
/* bench 19907.0.1 b887767b76fc */
/* bench 19907.0.2 e8beb5f05fc0 */
/* bench 19907.0.3 f7ec7709f142 */
/* bench 19907.0.4 dab8963568b9 */
/* bench 19907.0.5 b8b203654e7a */
CONFIG_MTD_BLOCK=m
CONFIG_MTD_CFI=y
CONFIG_MTD_JEDECPROBE=y
CONFIG_MTD_CFI_AMDSTD=y
CONFIG_MTD_PHYSMAP_OF=y
CONFIG_BLK_DEV_RAM=y
CONFIG_BLK_DEV_RAM_SIZE=35000
CONFIG_NETDEVICES=y
CONFIG_IBM_EMAC=y
CONFIG_IBM_EMAC_RXB=256
CONFIG_IBM_EMAC_TXB=256
CONFIG_IBM_EMAC_DEBUG=y
# CONFIG_INPUT is not set
# CONFIG_SERIO is not set
# CONFIG_VT is not set
CONFIG_SERIAL_8250=y
CONFIG_SERIAL_8250_CONSOLE=y
CONFIG_SERIAL_8250_EXTENDED=y
CONFIG_SERIAL_8250_SHARE_IRQ=y
CONFIG_SERIAL_OF_PLATFORM=y
# CONFIG_HW_RANDOM is not set
# CONFIG_HWMON is not set
CONFIG_THERMAL=y
# CONFIG_USB_SUPPORT is not set
CONFIG_EXT2_FS=y
CONFIG_PROC_KCORE=y
/* bench 663.1.0 dc9bf02ee74a */
/* bench 663.1.1 ab95d6ad55cb */
/* bench 663.1.2 e758b678efa0 */
/* bench 663.1.3 0edc12dc6298 */
/* bench 663.1.4 80b1fe80e4d2 */
/* bench 663.1.5 1984619b9bf1 */
/* bench 663.1.6 c0282e9874d2 */
/* bench 663.1.7 2b63cb80d656 */
/* bench 663.1.8 5ac77645a69a */
/* bench 663.1.9 b91a523df8c1 */
/* bench 663.1.10 9da4c92eecf8 */
/* bench 663.1.11 d81f8a615cd7 */
/* bench 663.1.12 6b083caffc14 */
/* bench 663.1.13 05bf2c31f880 */
/* bench 663.1.14 00cb9b753920 */
CONFIG_NFS_FS=y
CONFIG_ROOT_NFS=y
CONFIG_DEBUG_FS=y
CONFIG_MAGIC_SYSRQ=y
CONFIG_DETECT_HUNG_TASK=y
CONFIG_CRYPTO_CBC=y
CONFIG_CRYPTO_ECB=y
CONFIG_CRYPTO_PCBC=y
CONFIG_CRYPTO_MD5=y
CONFIG_CRYPTO_DES=y
```

## arch/powerpc/configs/40x/kilauea_defconfig
```kconfig
FASTVC-BENCH-CORPUS:linux-main-100k-v1-e0bd41dc-8e12-4f1b-978d-a3645ae59da0
CONFIG_40x=y
CONFIG_SYSVIPC=y
CONFIG_POSIX_MQUEUE=y
CONFIG_NO_HZ=y
CONFIG_HIGH_RES_TIMERS=y
CONFIG_LOG_BUF_SHIFT=14
CONFIG_BLK_DEV_INITRD=y
CONFIG_EXPERT=y
CONFIG_KALLSYMS_ALL=y
CONFIG_MODULES=y
CONFIG_MODULE_UNLOAD=y
# CONFIG_BLK_DEV_BSG is not set
CONFIG_KILAUEA=y
CONFIG_PCI=y
CONFIG_NET=y
CONFIG_PACKET=y
CONFIG_UNIX=y
CONFIG_INET=y
CONFIG_IP_PNP=y
CONFIG_IP_PNP_DHCP=y
CONFIG_IP_PNP_BOOTP=y
# CONFIG_IPV6 is not set
CONFIG_CONNECTOR=y
CONFIG_MTD=y
CONFIG_MTD_CMDLINE_PARTS=y
CONFIG_MTD_BLOCK=y
CONFIG_MTD_CFI=y
CONFIG_MTD_JEDECPROBE=y
CONFIG_MTD_CFI_AMDSTD=y
CONFIG_MTD_PHYSMAP_OF=y
CONFIG_MTD_RAW_NAND=y
CONFIG_MTD_NAND_NDFC=y
CONFIG_BLK_DEV_RAM=y
CONFIG_BLK_DEV_RAM_SIZE=35000
CONFIG_NETDEVICES=y
CONFIG_IBM_EMAC=y
CONFIG_IBM_EMAC_RXB=256
CONFIG_IBM_EMAC_TXB=256
# CONFIG_INPUT is not set
# CONFIG_SERIO is not set
# CONFIG_VT is not set
/* bench 23694.0.0 3c9e15cc388b */
/* bench 23694.0.1 c707dc5ae662 */
/* bench 23694.0.2 a9d94bb28824 */
/* bench 23694.0.3 af9f853b4f23 */
/* bench 23694.0.4 d05914c2bf25 */
/* bench 23694.0.5 b62847da61e9 */
/* bench 23694.0.6 8500a46b29f1 */
/* bench 23694.0.7 16c8b70fdea0 */
/* bench 23694.0.8 c8f81efb98cc */
/* bench 23694.0.9 e72d54cac127 */
CONFIG_SERIAL_8250_CONSOLE=y
CONFIG_SERIAL_8250_EXTENDED=y
CONFIG_SERIAL_8250_SHARE_IRQ=y
CONFIG_SERIAL_OF_PLATFORM=y
# CONFIG_HW_RANDOM is not set
CONFIG_I2C=y
CONFIG_I2C_CHARDEV=y
CONFIG_I2C_IBM_IIC=y
CONFIG_SENSORS_LM75=y
CONFIG_THERMAL=y
# CONFIG_USB_SUPPORT is not set
CONFIG_RTC_CLASS=y
CONFIG_RTC_DRV_DS1307=y
CONFIG_EXT2_FS=y
CONFIG_PROC_KCORE=y
CONFIG_TMPFS=y
CONFIG_CRAMFS=y
CONFIG_NFS_FS=y
CONFIG_ROOT_NFS=y
CONFIG_DEBUG_FS=y
CONFIG_MAGIC_SYSRQ=y
CONFIG_DETECT_HUNG_TASK=y
CONFIG_CRYPTO_CBC=y
/* bench 17357.0.0 5cbec01d4559 */
/* bench 17357.0.1 edda68d45b6b */
/* bench 17357.0.2 46a7343e89c6 */
/* bench 17357.0.3 ba2342d1d514 */
/* bench 17357.0.4 10fa3f26e152 */
/* bench 17357.0.5 2e7e9e05ce38 */
/* bench 17357.0.6 b66421390a38 */
/* bench 17357.0.7 bd77c5050a70 */
/* bench 17357.0.8 8b7803089e93 */
/* bench 17357.0.9 e2b55edf165f */
/* bench 17357.0.10 fd0b35958b38 */
CONFIG_CRYPTO_PCBC=y
CONFIG_CRYPTO_MD5=y
CONFIG_CRYPTO_DES=y
```

## arch/powerpc/configs/40x/makalu_defconfig
```kconfig
FASTVC-BENCH-CORPUS:linux-main-100k-v1-e0bd41dc-8e12-4f1b-978d-a3645ae59da0
CONFIG_40x=y
CONFIG_SYSVIPC=y
CONFIG_POSIX_MQUEUE=y
CONFIG_LOG_BUF_SHIFT=14
CONFIG_BLK_DEV_INITRD=y
CONFIG_EXPERT=y
CONFIG_KALLSYMS_ALL=y
CONFIG_MODULES=y
CONFIG_MODULE_UNLOAD=y
# CONFIG_BLK_DEV_BSG is not set
CONFIG_MAKALU=y
CONFIG_NET=y
CONFIG_PACKET=y
CONFIG_UNIX=y
CONFIG_INET=y
CONFIG_IP_PNP=y
CONFIG_IP_PNP_DHCP=y
CONFIG_IP_PNP_BOOTP=y
# CONFIG_IPV6 is not set
CONFIG_CONNECTOR=y
CONFIG_MTD=y
CONFIG_MTD_CMDLINE_PARTS=y
CONFIG_MTD_BLOCK=m
CONFIG_MTD_CFI=y
/* bench 29312.3.0 0e205f252a56 */
/* bench 29312.3.1 f5d0f64eaeda */
/* bench 29312.3.2 52e4c9d0b467 */
/* bench 29312.3.3 228a4b1800ae */
/* bench 29312.3.4 ed3df2b69d87 */
/* bench 29312.3.5 2d5356f0fc5c */
/* bench 29312.3.6 e174ac52e734 */
/* bench 29312.3.7 25116bdd0d84 */
/* bench 29312.3.8 96f356bbca2a */
/* bench 29312.3.9 fa407d54396e */
CONFIG_BLK_DEV_RAM=y
CONFIG_BLK_DEV_RAM_SIZE=35000
CONFIG_NETDEVICES=y
CONFIG_IBM_EMAC=y
CONFIG_IBM_EMAC_RXB=256
CONFIG_IBM_EMAC_TXB=256
# CONFIG_INPUT is not set
# CONFIG_SERIO is not set
# CONFIG_VT is not set
CONFIG_SERIAL_8250=y
CONFIG_SERIAL_8250_CONSOLE=y
CONFIG_SERIAL_8250_EXTENDED=y
CONFIG_SERIAL_8250_SHARE_IRQ=y
CONFIG_SERIAL_OF_PLATFORM=y
# CONFIG_HW_RANDOM is not set
# CONFIG_HWMON is not set
CONFIG_THERMAL=y
# CONFIG_USB_SUPPORT is not set
CONFIG_EXT2_FS=y
CONFIG_PROC_KCORE=y
CONFIG_TMPFS=y
CONFIG_CRAMFS=y
CONFIG_NFS_FS=y
/* bench 5556.0.0 4ca0b4c26a0f */
/* bench 5556.0.1 1b8f02f8db89 */
/* bench 5556.0.2 ec4fa9c0d2b8 */
/* bench 5556.0.3 8a6e24e987a9 */
/* bench 5556.0.4 61ab258a8afa */
/* bench 5556.0.5 952257989cde */
/* bench 5556.0.6 a633052299fd */
/* bench 5556.0.7 33fd7bc46248 */
/* bench 18601.0.0 d83bc5f116d4 */
/* bench 18601.0.1 f7de09e931dc */
/* bench 18601.0.2 bdf92fff13bc */
/* bench 18601.0.3 49249ba357a2 */
/* bench 18601.0.4 cb689b44fc06 */
/* bench 18601.0.5 d28fb8002a0a */
/* bench 18601.0.6 a6b8a63a576e */
/* bench 18601.0.7 efb541404f9b */
/* bench 18601.0.8 4a6e515eb56b */
/* bench 18601.0.9 08799d084681 */
/* bench 18601.0.10 b11b98300418 */
CONFIG_DEBUG_FS=y
CONFIG_MAGIC_SYSRQ=y
CONFIG_DETECT_HUNG_TASK=y
CONFIG_CRYPTO_CBC=y
CONFIG_CRYPTO_ECB=y
CONFIG_CRYPTO_PCBC=y
CONFIG_CRYPTO_MD5=y
CONFIG_CRYPTO_DES=y
```

## arch/powerpc/configs/40x/walnut_defconfig
```kconfig
FASTVC-BENCH-CORPUS:linux-main-100k-v1-e0bd41dc-8e12-4f1b-978d-a3645ae59da0
CONFIG_40x=y
CONFIG_SYSVIPC=y
CONFIG_POSIX_MQUEUE=y
CONFIG_LOG_BUF_SHIFT=14
CONFIG_BLK_DEV_INITRD=y
CONFIG_EXPERT=y
CONFIG_KALLSYMS_ALL=y
/* bench 3006.2.0 315cc74e2e3e */
/* bench 3006.2.1 b030bd0ed005 */
/* bench 3006.2.2 f8c1fcf8662a */
/* bench 3006.2.3 ccccce1da5d4 */
/* bench 3006.2.4 929a1d663790 */
/* bench 3006.2.5 2f7f732982a7 */
/* bench 3006.2.6 483ff75541eb */
/* bench 3006.2.7 02697f0013de */
/* bench 3006.2.8 71113937bac8 */
/* bench 3006.2.9 c40808581692 */
/* bench 3006.2.10 a61c2ae97e9c */
/* bench 3006.2.11 fd331fb9b9a6 */
# CONFIG_BLK_DEV_BSG is not set
CONFIG_NET=y
CONFIG_PACKET=y
CONFIG_UNIX=y
CONFIG_INET=y
CONFIG_IP_PNP=y
CONFIG_IP_PNP_DHCP=y
CONFIG_IP_PNP_BOOTP=y
# CONFIG_IPV6 is not set
CONFIG_CONNECTOR=y
CONFIG_MTD=y
CONFIG_MTD_CMDLINE_PARTS=y
CONFIG_MTD_BLOCK=m
CONFIG_MTD_CFI=y
CONFIG_MTD_JEDECPROBE=y
CONFIG_MTD_CFI_AMDSTD=y
CONFIG_MTD_PHYSMAP_OF=y
CONFIG_BLK_DEV_RAM=y
CONFIG_BLK_DEV_RAM_SIZE=35000
CONFIG_NETDEVICES=y
CONFIG_IBM_EMAC=y
# CONFIG_INPUT is not set
# CONFIG_SERIO is not set
# CONFIG_VT is not set
CONFIG_SERIAL_8250=y
CONFIG_SERIAL_8250_CONSOLE=y
CONFIG_SERIAL_8250_EXTENDED=y
CONFIG_SERIAL_8250_SHARE_IRQ=y
CONFIG_SERIAL_OF_PLATFORM=y
# CONFIG_HW_RANDOM is not set
# CONFIG_HWMON is not set
CONFIG_THERMAL=y
CONFIG_EXT2_FS=y
CONFIG_PROC_KCORE=y
/* bench 19869.0.0 5d6f0f03afec */
/* bench 19869.0.1 8bc325025032 */
/* bench 19869.0.2 150e57dff4cd */
/* bench 19869.0.3 628bffccf2a1 */
/* bench 19869.0.4 3842c9d2f9e6 */
/* bench 19869.0.5 3b8814487ef4 */
/* bench 19869.0.6 9f58c14249f1 */
/* bench 19869.0.7 eba244627c6b */
/* bench 19869.0.8 543e5bc7823f */
/* bench 19869.0.9 30b78365bbc4 */
/* bench 19869.0.10 b53c1736f51f */
/* bench 19869.0.11 5bf2c21fbf86 */
CONFIG_ROOT_NFS=y
CONFIG_DEBUG_FS=y
CONFIG_MAGIC_SYSRQ=y
CONFIG_DETECT_HUNG_TASK=y
CONFIG_CRYPTO_CBC=y
CONFIG_CRYPTO_ECB=y
CONFIG_CRYPTO_PCBC=y
CONFIG_CRYPTO_MD5=y
CONFIG_CRYPTO_DES=y
```

## arch/powerpc/configs/44x/bamboo_defconfig
```kconfig
FASTVC-BENCH-CORPUS:linux-main-100k-v1-e0bd41dc-8e12-4f1b-978d-a3645ae59da0
CONFIG_44x=y
CONFIG_SYSVIPC=y
CONFIG_POSIX_MQUEUE=y
CONFIG_LOG_BUF_SHIFT=14
CONFIG_BLK_DEV_INITRD=y
/* bench 27793.2.0 116788c12905 */
/* bench 27793.2.1 58b7d4ea31a3 */
/* bench 27793.2.2 03ed7e439420 */
/* bench 27793.2.3 00106eacdb14 */
/* bench 27793.2.4 0704bc4fb4e2 */
/* bench 27793.2.5 b2d848bd980f */
/* bench 27793.2.6 4dd7d50404f3 */
CONFIG_EXPERT=y
CONFIG_MODULES=y
CONFIG_MODULE_UNLOAD=y
# CONFIG_BLK_DEV_BSG is not set
CONFIG_BAMBOO=y
# CONFIG_EBONY is not set
CONFIG_NET=y
CONFIG_PACKET=y
CONFIG_UNIX=y
CONFIG_INET=y
CONFIG_IP_PNP=y
CONFIG_IP_PNP_DHCP=y
CONFIG_IP_PNP_BOOTP=y
# CONFIG_IPV6 is not set
CONFIG_CONNECTOR=y
CONFIG_BLK_DEV_RAM=y
CONFIG_BLK_DEV_RAM_SIZE=35000
CONFIG_NETDEVICES=y
CONFIG_IBM_EMAC=y
# CONFIG_INPUT is not set
# CONFIG_SERIO is not set
# CONFIG_VT is not set
CONFIG_SERIAL_8250=y
CONFIG_SERIAL_8250_CONSOLE=y
# CONFIG_SERIAL_8250_PCI is not set
CONFIG_SERIAL_8250_EXTENDED=y
CONFIG_SERIAL_8250_SHARE_IRQ=y
CONFIG_SERIAL_OF_PLATFORM=y
# CONFIG_HW_RANDOM is not set
# CONFIG_HWMON is not set
CONFIG_THERMAL=y
CONFIG_EXT2_FS=y
CONFIG_PROC_KCORE=y
CONFIG_TMPFS=y
CONFIG_CRAMFS=y
CONFIG_NFS_FS=y
CONFIG_ROOT_NFS=y
CONFIG_DEBUG_FS=y
CONFIG_MAGIC_SYSRQ=y
CONFIG_DETECT_HUNG_TASK=y
# CONFIG_DEBUG_BUGVERBOSE is not set
CONFIG_CRYPTO_CBC=y
CONFIG_CRYPTO_ECB=y
CONFIG_CRYPTO_PCBC=y
CONFIG_CRYPTO_MD5=y
CONFIG_CRYPTO_DES=y
```

## arch/powerpc/configs/44x/bluestone_defconfig
```kconfig
/* bench 3231.1.0 49faddfe27ff */
/* bench 3231.1.1 be7e58238be8 */
/* bench 3231.1.2 2702c7323213 */
/* bench 3231.1.3 fe7bdb6ad70c */
/* bench 3231.1.4 36100f014ea4 */
/* bench 3231.1.5 08289c6b4c1b */
/* bench 3231.1.6 674d97c6930d */
/* bench 1616.0.0 4c8cae80edbc */
/* bench 1616.0.1 855e5bfca645 */
/* bench 1616.0.2 dec32a49121a */
/* bench 1616.0.3 fac9956be112 */
/* bench 1616.0.4 159c55a220b7 */
/* bench 1616.0.5 f9430c90d322 */
/* bench 1616.0.6 6a05384bc59c */
/* bench 1616.0.7 185dc58e62d4 */
/* bench 1616.0.8 237cbf89b784 */
CONFIG_SYSVIPC=y
CONFIG_POSIX_MQUEUE=y
CONFIG_NO_HZ=y
CONFIG_HIGH_RES_TIMERS=y
CONFIG_LOG_BUF_SHIFT=14
CONFIG_BLK_DEV_INITRD=y
CONFIG_EXPERT=y
# CONFIG_PCI_QUIRKS is not set
# CONFIG_VM_EVENT_COUNTERS is not set
# CONFIG_COMPAT_BRK is not set
CONFIG_BLUESTONE=y
# CONFIG_EBONY is not set
CONFIG_NET=y
CONFIG_PACKET=y
CONFIG_UNIX=y
CONFIG_INET=y
CONFIG_IP_PNP=y
CONFIG_IP_PNP_DHCP=y
CONFIG_IP_PNP_BOOTP=y
CONFIG_CONNECTOR=y
CONFIG_MTD=y
CONFIG_MTD_CMDLINE_PARTS=y
CONFIG_MTD_BLOCK=y
CONFIG_MTD_CFI=y
CONFIG_MTD_CFI_AMDSTD=y
CONFIG_MTD_PHYSMAP_OF=y
CONFIG_BLK_DEV_RAM=y
CONFIG_BLK_DEV_RAM_SIZE=35000
CONFIG_NETDEVICES=y
CONFIG_IBM_EMAC=y
CONFIG_IBM_EMAC_RXB=256
CONFIG_IBM_EMAC_TXB=256
CONFIG_SERIAL_8250=y
CONFIG_SERIAL_8250_CONSOLE=y
CONFIG_SERIAL_8250_NR_UARTS=2
CONFIG_SERIAL_8250_RUNTIME_UARTS=2
CONFIG_SERIAL_8250_EXTENDED=y
CONFIG_SERIAL_8250_SHARE_IRQ=y
CONFIG_SERIAL_OF_PLATFORM=y
CONFIG_I2C=y
CONFIG_I2C_CHARDEV=y
CONFIG_I2C_IBM_IIC=y
CONFIG_SENSORS_AD7414=y
/* bench 29523.1.0 4cd86261053f */
/* bench 29523.1.1 0d42d540e827 */
/* bench 29523.1.2 2bfd1aa62178 */
/* bench 29523.1.3 9010a19cbd0b */
/* bench 29523.1.4 f5c9aa080c88 */
/* bench 29523.1.5 d8539919cc77 */
/* bench 29523.1.6 f569e30dd85c */
/* bench 29523.1.7 bfb000fdf067 */
/* bench 29523.1.8 65d8ea6c33e5 */
CONFIG_RTC_DRV_M41T80=y
CONFIG_EXT2_FS=y
CONFIG_EXT4_FS=y
CONFIG_PROC_KCORE=y
CONFIG_TMPFS=y
CONFIG_CRAMFS=y
CONFIG_NFS_FS=y
CONFIG_ROOT_NFS=y
CONFIG_NLS=y
```
