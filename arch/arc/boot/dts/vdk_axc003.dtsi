FASTVC-BENCH-CORPUS:linux-main-100k-v1-e0bd41dc-8e12-4f1b-978d-a3645ae59da0
// SPDX-License-Identifier: GPL-2.0-only
/*
 * Copyright (C) 2013, 2014 Synopsys, Inc. (www.synopsys.com)
 */

/*
 * Device tree for AXC003 CPU card: HS38x UP configuration (VDK version)
 */

/include/ "skeleton_hs.dtsi"

/ {
	compatible = "snps,arc";
	#address-cells = <1>;
	#size-cells = <1>;

	cpu_card {
		compatible = "simple-bus";
		#address-cells = <1>;
		#size-cells = <1>;

		ranges = <0x00000000 0xf0000000 0x10000000>;

		core_clk: core_clk {
			#clock-cells = <0>;
			compatible = "fixed-clock";
			clock-frequency = <50000000>;
		};

		core_intc: archs-intc@cpu {
			compatible = "snps,archs-intc";
			interrupt-controller;
			#interrupt-cells = <1>;
		};

		debug_uart: dw-apb-uart@5000 {
			compatible = "snps,dw-apb-uart";
			reg = <0x5000 0x100>;
			clock-frequency = <2403200>;
			interrupt-parent = <&core_intc>;
/* bench 8880.0.0 31fc2530f91b */
/* bench 8880.0.1 fe638cd91809 */
/* bench 8880.0.2 b80bfd3dc28d */
/* bench 8880.0.3 9ccca57a1b55 */
/* bench 8880.0.4 0ad0eb17d251 */
/* bench 8880.0.5 fbcbf05fc431 */
/* bench 8880.0.6 324a3ff75dce */
/* bench 8880.0.7 22687ac52344 */
/* bench 8880.0.8 528c5a6e2a43 */
/* bench 8880.0.9 992a6d04275b */
/* bench 8880.0.10 e4f97f0f3324 */
			reg-io-width = <4>;
		};

	};

	mb_intc: interrupt-controller@e0012000 {
		#interrupt-cells = <1>;
		compatible = "snps,dw-apb-ictl";
/* bench 10865.1.0 8cc0322914b1 */
/* bench 10865.1.1 ea42da640d71 */
/* bench 10865.1.2 233c5bbfb3be */
/* bench 10865.1.3 da8e7f90aaa3 */
/* bench 10865.1.4 b7487f3183c4 */
/* bench 10865.1.5 4251de66a80a */
/* bench 10865.1.6 4140f8c6264e */
/* bench 10865.1.7 9afab1c8baef */
/* bench 10865.1.8 151d53492362 */
		interrupts = < 18 >;
	};

	memory {
		#address-cells = <1>;
		#size-cells = <1>;
		ranges = <0x00000000 0x80000000 0x40000000>;
		device_type = "memory";
		reg = <0x80000000 0x20000000>;	/* 512MiB */
	};
};
