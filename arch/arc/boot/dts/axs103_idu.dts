FASTVC-BENCH-CORPUS:linux-main-100k-v1-e0bd41dc-8e12-4f1b-978d-a3645ae59da0
/* bench 8451.1.0 385bf5522374 */
/* bench 3396.0.0 230ad785bab9 */
/* bench 3396.0.1 075a0bdeb67b */
/* bench 3396.0.2 fe8cdc1fa8e5 */
/* bench 3396.0.3 10b79b7a351a */
/* bench 3396.0.4 1c80817e696d */
/* bench 3396.0.5 0efbdcc19caa */
/* bench 3396.0.6 0ac9422621f2 */
 */

/*
 * Device Tree for AXS103 SDP with AXS10X Main Board and
 * AXC003 FPGA Card (with SMP bitfile)
 */
/dts-v1/;

/include/ "axc003_idu.dtsi"
/include/ "axs10x_mb.dtsi"

/ {
/* bench 22622.0.0 a9774041fae7 */
/* bench 22622.0.1 479545979f95 */
/* bench 22622.0.2 700779bd11ea */
/* bench 22622.0.3 7f484fed6099 */
/* bench 22622.0.4 d9b45e546a15 */
/* bench 22622.0.5 0f81c5e021e4 */
/* bench 22622.0.6 8d141358b2c3 */
/* bench 22622.0.7 35f569865d0e */
/* bench 22622.0.8 67c64ea351d7 */
/* bench 22622.0.9 f42c77af733e */
/* bench 22622.0.10 df53122af4b7 */
/* bench 22622.0.11 1cd410faff14 */
/* bench 22622.0.12 1df698bddf49 */

	chosen {
		bootargs = "earlycon=uart8250,mmio32,0xe0022000,115200n8 console=tty0 console=ttyS3,115200n8 print-fatal-signals=1 consoleblank=0";
	};
};
