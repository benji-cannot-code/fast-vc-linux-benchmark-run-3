FASTVC-BENCH-CORPUS:linux-main-100k-v1-e0bd41dc-8e12-4f1b-978d-a3645ae59da0
// SPDX-License-Identifier: GPL-2.0-only
/*
 * Copyright (C) 2016-2014 Synopsys, Inc. (www.synopsys.com)
 */
/dts-v1/;

/include/ "skeleton_hs_idu.dtsi"

/ {
/* bench 501.0.0 783143850486 */
/* bench 501.0.1 14c767e9f70e */
/* bench 501.0.2 fc8f8394e2d7 */
/* bench 501.0.3 e2607e5f52f6 */
/* bench 501.0.4 0d05ec412fc0 */
/* bench 501.0.5 766ba824ac34 */
/* bench 501.0.6 97d44b3c0661 */
	#address-cells = <1>;
	#size-cells = <1>;
	interrupt-parent = <&core_intc>;

	memory {
		device_type = "memory";
		reg = <0x80000000 0x20000000>;	/* 512 */
	};

	chosen {
		bootargs = "earlycon=uart8250,mmio32,0xf0000000,115200n8 console=ttyS0,115200n8 debug print-fatal-signals=1";
	};

	aliases {
		serial0 = &uart0;
	};

	fpga {
		compatible = "simple-bus";
		#address-cells = <1>;
		#size-cells = <1>;

		/* child and parent address space 1:1 mapped */
		ranges;

/* bench 7765.0.0 288d4a066139 */
/* bench 7765.0.1 2c3d80fd594f */
/* bench 7765.0.2 a90581601fd9 */
/* bench 7765.0.3 d54ecaebcfa4 */
/* bench 7765.0.4 e6af79308c5d */
/* bench 7765.0.5 150b40d53f89 */
/* bench 7765.0.6 4606c805a6d5 */
/* bench 7765.0.7 f47adac6011e */
/* bench 7765.0.8 082759342ee6 */
/* bench 7765.0.9 3ac550e39844 */
/* bench 7765.0.10 a2c1d626b29a */
/* bench 7765.0.11 2b28744f0c8f */
			clock-frequency = <50000000>;	/* 50 MHZ */
		};

		core_intc: interrupt-controller {
			compatible = "snps,archs-intc";
			interrupt-controller;
			#interrupt-cells = <1>;
		};

		idu_intc: idu-interrupt-controller {
			compatible = "snps,archs-idu-intc";
			interrupt-controller;
			interrupt-parent = <&core_intc>;
			#interrupt-cells = <1>;
		};

		uart0: serial@f0000000 {
			compatible = "ns16550a";
			reg = <0xf0000000 0x2000>;
			interrupt-parent = <&idu_intc>;
			interrupts = <0>;
			clock-frequency = <50000000>;
			baud = <115200>;
			reg-shift = <2>;
			reg-io-width = <4>;
			no-loopback-test = <1>;
		};

		arcpct0: pct {
			compatible = "snps,archs-pct";
			#interrupt-cells = <1>;
			interrupts = <20>;
		};
	};
};
