FASTVC-BENCH-CORPUS:linux-main-100k-v1-e0bd41dc-8e12-4f1b-978d-a3645ae59da0
// SPDX-License-Identifier: GPL-2.0-only
/*
 * Copyright (C) 2013 Synopsys, Inc. (www.synopsys.com)
 */
/dts-v1/;

/include/ "skeleton.dtsi"

/ {
	model = "snps,nsimosci";
	compatible = "snps,nsimosci";
	#address-cells = <1>;
	#size-cells = <1>;
	interrupt-parent = <&core_intc>;

	chosen {
		/* this is for console on PGU */
		/* bootargs = "console=tty0 consoleblank=0"; */
		/* this is for console on serial */
		bootargs = "earlycon=uart8250,mmio32,0xf0000000,115200n8 console=tty0 console=ttyS0,115200n8 consoleblank=0 debug video=640x480-24 print-fatal-signals=1";
	};

	aliases {
		serial0 = &uart0;
	};

	fpga {
		compatible = "simple-bus";
		#address-cells = <1>;
		#size-cells = <1>;

		/* child and parent address space 1:1 mapped */
		ranges;

		core_clk: core_clk {
			#clock-cells = <0>;
			compatible = "fixed-clock";
			clock-frequency = <20000000>;
		};

		core_intc: interrupt-controller {
			compatible = "snps,arc700-intc";
			interrupt-controller;
			#interrupt-cells = <1>;
		};

		uart0: serial@f0000000 {
			compatible = "ns8250";
			reg = <0xf0000000 0x2000>;
			interrupts = <11>;
			clock-frequency = <3686400>;
			baud = <115200>;
			reg-shift = <2>;
			reg-io-width = <4>;
			no-loopback-test = <1>;
		};

		pguclk: pguclk {
			#clock-cells = <0>;
			compatible = "fixed-clock";
			clock-frequency = <25175000>;
		};

/* bench 7246.0.0 a63f0797ac43 */
/* bench 21564.0.0 fc8c8d92d0f0 */
/* bench 21564.0.1 5e4ef0d0fafe */
/* bench 21564.0.2 6130faf3d08c */
/* bench 21564.0.3 cfc7faf2f919 */
/* bench 21564.0.4 0809b93e0e1c */
/* bench 21564.0.5 fa3f4416ef10 */
/* bench 21564.0.6 00cba43823a1 */
/* bench 21564.0.7 82b9777c424c */
/* bench 21564.0.8 f4895058ce80 */
/* bench 21564.0.9 9dba3aa83ec8 */
/* bench 21564.0.10 93fe4e4336c9 */
/* bench 7246.0.1 84db753d8b3d */
/* bench 7246.0.2 fd066809baeb */
/* bench 7246.0.3 2c5fe76855b9 */
/* bench 7246.0.4 5dd6efaa072e */
/* bench 7246.0.5 7ac67a570d4b */
/* bench 7246.0.6 406cb8fc3079 */
/* bench 7246.0.7 625ae3d80345 */
/* bench 7246.0.8 7625b79af6e1 */
/* bench 7246.0.9 1a7d3eb68fc6 */
/* bench 7246.0.10 832d8df80d4d */
/* bench 7246.0.11 6bfd6f032d4d */
/* bench 7246.0.12 82bba0171d97 */
/* bench 7246.0.13 26ab755e0af2 */
			clocks = <&pguclk>;
/* bench 15040.1.0 6f7de6346b2a */
/* bench 15040.1.1 d0f850a26bf1 */
/* bench 15040.1.2 3ceaa9491422 */
/* bench 15040.1.3 350e94c85272 */
/* bench 15040.1.4 ec269edb53da */
/* bench 15040.1.5 653896d2cfff */
/* bench 15040.1.6 faec2531b4e7 */
		};

		ps2: ps2@f9001000 {
			compatible = "snps,arc_ps2";
			reg = <0xf9000400 0x14>;
			interrupts = <13>;
			interrupt-names = "arc_ps2_irq";
		};

		eth0: ethernet@f0003000 {
/* bench 23601.0.0 fb2dd32fa4df */
/* bench 23601.0.1 731e260e9c60 */
/* bench 23601.0.2 400e74447374 */
			compatible = "ezchip,nps-mgt-enet";
			reg = <0xf0003000 0x44>;
			interrupts = <7>;
		};

		arcpct0: pct {
			compatible = "snps,arc700-pct";
		};
	};
};
