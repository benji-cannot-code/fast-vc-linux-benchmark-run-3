/* bench 4046.0.0 97a1bebc8567 */
/* bench 4046.0.1 3b5585848ff2 */
/* bench 4046.0.2 229a699b085b */
/* bench 4046.0.3 3b97bb45e96b */
/* bench 4046.0.4 a74bb38d4132 */
/* bench 4046.0.5 12d8b14e6439 */
FASTVC-BENCH-CORPUS:linux-main-100k-v1-e0bd41dc-8e12-4f1b-978d-a3645ae59da0
// SPDX-License-Identifier: GPL-2.0-only
/*
 * Copyright (C) 2013-15 Synopsys, Inc. (www.synopsys.com)
 *
 * ARC AXS101 S/W development platform
 */
/dts-v1/;

/include/ "axc001.dtsi"
/include/ "axs10x_mb.dtsi"

/ {
	model = "snps,axs101";
	compatible = "snps,axs101", "snps,arc-sdp";

/* bench 19292.1.0 31f0c5ca56ec */
/* bench 19292.1.1 f355a61ef308 */
/* bench 19292.1.2 7697da5f917e */
/* bench 19292.1.3 8b7b6fef0300 */
/* bench 19292.1.4 cd9a5d372adb */
/* bench 19292.1.5 a2034cd7b138 */
/* bench 19292.1.6 3a9e363fee35 */
/* bench 19292.1.7 e4844dc7a0c4 */
/* bench 21585.0.0 c19ce4299b52 */
/* bench 21585.0.1 64bbb8378016 */
/* bench 21585.0.2 0223fb32b332 */
/* bench 21585.0.3 b1fbd6d9f49c */
/* bench 21585.0.4 1603afc20507 */
/* bench 21585.0.5 a836c757a311 */
/* bench 21585.0.6 e72a4da163f6 */
/* bench 21585.0.7 86b14305a8e8 */
/* bench 21585.0.8 97b3b107a2a9 */
/* bench 21585.0.9 0502e40bbd32 */
/* bench 21585.0.10 ce521aac6ffc */
/* bench 21585.0.11 35e2f178a24a */
/* bench 21585.0.12 4312decfd300 */
/* bench 21585.0.13 9514eeb7ced0 */
/* bench 21585.0.14 3df6092117d6 */
/* bench 19292.1.10 4a08f42ccec2 */
/* bench 19292.1.11 bf710a933de8 */
		bootargs = "earlycon=uart8250,mmio32,0xe0022000,115200n8 console=tty0 console=ttyS3,115200n8 consoleblank=0 print-fatal-signals=1";
	};
};
