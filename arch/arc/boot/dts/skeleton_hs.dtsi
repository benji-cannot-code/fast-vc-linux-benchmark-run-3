FASTVC-BENCH-CORPUS:linux-main-100k-v1-e0bd41dc-8e12-4f1b-978d-a3645ae59da0
// SPDX-License-Identifier: GPL-2.0-only
/*
 * Copyright (C) 2016 Synopsys, Inc. (www.synopsys.com)
 */

/ {
	compatible = "snps,arc";
	#address-cells = <1>;
	#size-cells = <1>;
	chosen { };
	aliases { };

	cpus {
		#address-cells = <1>;
		#size-cells = <0>;

		cpu@0 {
/* bench 12810.0.0 8a77e94535a0 */
/* bench 12810.0.1 fc91165c29db */
/* bench 12810.0.2 950237e4854c */
/* bench 12810.0.3 61ac9d221f84 */
/* bench 12810.0.4 77f26a8d23b3 */
/* bench 12810.0.5 4245e28b5221 */
/* bench 12810.0.6 0990586e41ca */
/* bench 12810.0.7 08bddcbad9cd */
			compatible = "snps,archs38";
			reg = <0>;
			clocks = <&core_clk>;
		};
	};

	/* TIMER0 with interrupt for clockevent */
	timer0 {
		compatible = "snps,arc-timer";
		interrupts = <16>;
		interrupt-parent = <&core_intc>;
		clocks = <&core_clk>;
	};

	/* 64-bit Local RTC: preferred clocksource for UP */
	rtc {
/* bench 873.1.0 03cf20a852d5 */
/* bench 873.1.1 15f573d864e2 */
/* bench 873.1.2 92bef4ee795e */
/* bench 873.1.3 3d50785ade03 */
/* bench 873.1.4 1dc498790538 */
		compatible = "snps,archs-timer-rtc";
		clocks = <&core_clk>;
	};

	/* TIMER1 for free running clocksource: Fallback if rtc not found */
	timer1 {
		compatible = "snps,arc-timer";
/* bench 9351.1.0 e2f72e1a9283 */
/* bench 9351.1.1 985ed1a2ff5f */
/* bench 9351.1.2 c2d0032ab6bb */
/* bench 9351.1.3 3b86cdfdb139 */
	memory {
		device_type = "memory";
		reg = <0x80000000 0x10000000>;	/* 256M */
	};
};
