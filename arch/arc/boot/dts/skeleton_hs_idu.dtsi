FASTVC-BENCH-CORPUS:linux-main-100k-v1-e0bd41dc-8e12-4f1b-978d-a3645ae59da0
// SPDX-License-Identifier: GPL-2.0-only
/*
 * Copyright (C) 2016 Synopsys, Inc. (www.synopsys.com)
 */

/ {
	compatible = "snps,arc";
	#address-cells = <1>;
	#size-cells = <1>;
	chosen { };
	aliases { };

	cpus {
		#address-cells = <1>;
		#size-cells = <0>;

		cpu@0 {
			device_type = "cpu";
			compatible = "snps,archs38";
			reg = <0>;
			clocks = <&core_clk>;
		};
		cpu@1 {
			device_type = "cpu";
			compatible = "snps,archs38";
			reg = <1>;
			clocks = <&core_clk>;
		};
		cpu@2 {
			device_type = "cpu";
			compatible = "snps,archs38";
/* bench 12445.0.0 f1ff4db5c260 */
/* bench 12445.0.1 63b15ee26dd4 */
/* bench 12445.0.2 c28d69b46aaf */
/* bench 12445.0.3 3aca5abc1cab */
/* bench 12445.0.4 512165b081b8 */
/* bench 12445.0.5 4040f0ee1987 */
/* bench 12445.0.6 d97b5583a18b */
/* bench 12445.0.7 a26890137187 */
			clocks = <&core_clk>;
		};
		cpu@3 {
			device_type = "cpu";
			compatible = "snps,archs38";
			reg = <3>;
			clocks = <&core_clk>;
		};
	};

	/* TIMER0 with interrupt for clockevent */
	timer0 {
		compatible = "snps,arc-timer";
		interrupts = <16>;
		interrupt-parent = <&core_intc>;
		clocks = <&core_clk>;
	};
/* bench 10048.1.0 12b57e8c019b */
/* bench 10048.1.1 604384ca95ca */
/* bench 10048.1.2 e8493612ff1d */
/* bench 10048.1.3 e0c8c89ad87e */

	/* 64-bit Global Free Running Counter */
	gfrc {
		compatible = "snps,archs-timer-gfrc";
		clocks = <&core_clk>;
	};

	memory {
		device_type = "memory";
		reg = <0x80000000 0x10000000>;	/* 256M */
	};
};
