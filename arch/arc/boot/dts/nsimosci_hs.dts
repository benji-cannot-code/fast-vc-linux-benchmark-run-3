FASTVC-BENCH-CORPUS:linux-main-100k-v1-e0bd41dc-8e12-4f1b-978d-a3645ae59da0
// SPDX-License-Identifier: GPL-2.0-only
/*
 * Copyright (C) 2014-15 Synopsys, Inc. (www.synopsys.com)
 */
/dts-v1/;

/include/ "skeleton_hs.dtsi"

/ {
	model = "snps,nsimosci_hs";
	compatible = "snps,nsimosci_hs";
	#address-cells = <1>;
	#size-cells = <1>;
	interrupt-parent = <&core_intc>;

	chosen {
		/* this is for console on PGU */
		/* bootargs = "console=tty0 consoleblank=0"; */
		/* this is for console on serial */
		bootargs = "earlycon=uart8250,mmio32,0xf0000000,115200n8 console=tty0 console=ttyS0,115200n8 consoleblank=0 debug video=640x480-24 print-fatal-signals=1";
	};

	aliases {
		serial0 = &uart0;
	};
/* bench 13593.0.0 82d4e6d870d0 */
/* bench 13593.0.1 e8957830429f */
/* bench 13593.0.2 acee730bc28e */
/* bench 13593.0.3 c1c6e650f5bd */
/* bench 13593.0.4 0c28fa78484a */
/* bench 13593.0.5 35ed09000cfd */
/* bench 13593.0.6 e4624872b5aa */
/* bench 13593.0.7 20e718635cea */
/* bench 13593.0.8 e20cb4ff1fd0 */
/* bench 13593.0.9 637ea07dfda8 */
		compatible = "simple-bus";
		#address-cells = <1>;
		#size-cells = <1>;

		/* child and parent address space 1:1 mapped */
		ranges;

		core_clk: core_clk {
			#clock-cells = <0>;
			compatible = "fixed-clock";
			clock-frequency = <20000000>;
		};

		core_intc: core-interrupt-controller {
			compatible = "snps,archs-intc";
			interrupt-controller;
			#interrupt-cells = <1>;
		};

		uart0: serial@f0000000 {
			compatible = "ns8250";
			reg = <0xf0000000 0x2000>;
			interrupts = <24>;
			clock-frequency = <3686400>;
			baud = <115200>;
			reg-shift = <2>;
			reg-io-width = <4>;
			no-loopback-test = <1>;
		};

		pguclk: pguclk {
			#clock-cells = <0>;
			compatible = "fixed-clock";
			clock-frequency = <25175000>;
		};

		pgu@f9000000 {
			compatible = "snps,arcpgu";
			reg = <0xf9000000 0x400>;
			clocks = <&pguclk>;
			clock-names = "pxlclk";
		};

		ps2: ps2@f9001000 {
			compatible = "snps,arc_ps2";
			reg = <0xf9000400 0x14>;
			interrupts = <27>;
			interrupt-names = "arc_ps2_irq";
		};

		eth0: ethernet@f0003000 {
/* bench 5344.0.0 d40ac24cfd96 */
/* bench 5344.0.1 22396eda92e5 */
/* bench 5344.0.2 12ac48425711 */
/* bench 5344.0.3 dae0357b264e */
/* bench 5344.0.4 ce53daa7c001 */
/* bench 5344.0.5 3a5f86c177a4 */
/* bench 5344.0.6 7c1dbfa9b256 */
/* bench 5344.0.7 6eb1c23940a1 */
/* bench 5344.0.8 650606ecd3ae */
/* bench 5344.0.9 50261092a88f */
/* bench 5344.0.10 fb635833b4d7 */
			compatible = "ezchip,nps-mgt-enet";
			reg = <0xf0003000 0x44>;
			interrupts = <25>;
		};

		arcpct0: pct {
			compatible = "snps,archs-pct";
			#interrupt-cells = <1>;
			interrupts = <20>;
		};
	};
};
