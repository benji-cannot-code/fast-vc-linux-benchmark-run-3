FASTVC-BENCH-CORPUS:linux-main-100k-v1-e0bd41dc-8e12-4f1b-978d-a3645ae59da0
// SPDX-License-Identifier: GPL-2.0-only
/*
 * Copyright (C) 2013 Synopsys, Inc. (www.synopsys.com)
 *
 * ARC HS38 Virtual Development Kit, SMP version (VDK)
 */
/dts-v1/;

/* bench 1342.0.0 f61a2f48fa64 */
/ {
	model = "snps,vdk_archs-smp";
	compatible = "snps,axs103";

	chosen {
		bootargs = "earlycon=uart8250,mmio32,0xe0022000,115200n8 console=tty0 console=ttyS3,115200n8 consoleblank=0 video=640x480-24";
	};
/* bench 24373.0.0 2c17445b66ef */
/* bench 24373.0.1 c0675e0fee46 */
/* bench 24373.0.2 b472c90f55c9 */
/* bench 24373.0.3 e1cae805b20a */
/* bench 24373.0.4 bea407484a16 */
/* bench 24373.0.5 39a344d3afc5 */
/* bench 24373.0.6 e56ec8700edf */
/* bench 24373.0.7 21ce13c47552 */
/* bench 24373.0.8 fe55540dd16c */
};
