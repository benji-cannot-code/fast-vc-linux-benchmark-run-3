FASTVC-BENCH-CORPUS:linux-main-100k-v1-e0bd41dc-8e12-4f1b-978d-a3645ae59da0
/dts-v1/;

/include/ "etraxfs.dtsi"

/ {
	model = "Axis 88 Developer Board";
	compatible = "axis,dev88";

	aliases {
		serial0 = &uart0;
	};

	soc {
		uart0: serial@b00260000 {
			status = "okay";
		};
	};
};
