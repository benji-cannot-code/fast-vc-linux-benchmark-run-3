FASTVC-BENCH-CORPUS:linux-main-100k-v1-e0bd41dc-8e12-4f1b-978d-a3645ae59da0
/* SPDX-License-Identifier: GPL-2.0 */
MEMORY 
	{
	flash : ORIGIN = 0x00000000,
	        LENGTH = 0x00100000
	}

SECTIONS
{
	.text :
	{
		stext = . ;
		*(.text)
		etext = . ;
	} > flash
	.data :
	{
		*(.data)
		edata = . ;
	} > flash
}
