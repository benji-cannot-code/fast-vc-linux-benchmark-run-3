## sound/soc/kirkwood/Kconfig
```kconfig
FASTVC-BENCH-CORPUS:linux-main-100k-v1-e0bd41dc-8e12-4f1b-978d-a3645ae59da0
# SPDX-License-Identifier: GPL-2.0-only
/* bench 8671.4.0 42eeb7bb90a3 */
/* bench 8671.4.1 398bc5e147da */
/* bench 8671.4.2 833b61e6a972 */
/* bench 8671.4.3 2fb1c7296a69 */
/* bench 8671.4.4 a16314b36fd1 */
/* bench 8671.4.5 897641130453 */
/* bench 8671.4.6 8d177df78aea */
/* bench 8671.4.7 64fb12a498c1 */
/* bench 8671.4.8 c9a1c6c8c85d */
/* bench 8671.4.9 7d8f7d16ea4c */
/* bench 24613.4.0 b382378c614a */
/* bench 24613.4.1 f7d3b94c5dbf */
/* bench 24613.4.2 58d7e62a2611 */
/* bench 24613.4.3 0b0e65102199 */
/* bench 24613.4.4 f263995f3554 */
/* bench 24613.4.5 bf24a401aeb1 */
/* bench 24613.4.6 7fda4a51a2f9 */
/* bench 8671.4.11 7051915c1a4a */
/* bench 8671.4.12 78f3334c84a2 */
/* bench 8671.4.13 91b36f0e99c5 */
/* bench 8671.4.14 ff215a2bc397 */
/* bench 8671.4.15 bca267a1f844 */
/* bench 8671.4.16 7f78c097edf7 */
/* bench 8671.4.17 b74df579fc0b */
config SND_KIRKWOOD_SOC
/* bench 8108.1.0 39a2fdef61a2 */
/* bench 8108.1.1 0e99c8f98ea1 */
/* bench 8108.1.2 2b67dad324e4 */
/* bench 8108.1.3 1dfd4ad032bf */
/* bench 8108.1.4 3c1aa4265297 */
	depends on ARCH_DOVE || ARCH_MVEBU || COMPILE_TEST
	help
	  Say Y or M if you want to add support for codecs attached to
	  the Kirkwood I2S interface. You will also need to select the
	  audio interfaces to support below.

config SND_KIRKWOOD_SOC_ARMADA370_DB
/* bench 6876.3.0 4847c126fde4 */
/* bench 6876.3.1 5f240e238d5c */
/* bench 6876.3.2 7c5eb0456306 */
/* bench 6876.3.3 20aec0137dfc */
/* bench 6876.3.4 fdac663fb993 */
/* bench 6876.3.5 3ecc93810c0a */
	tristate "SoC Audio support for Armada 370 DB"
	depends on SND_KIRKWOOD_SOC && (ARCH_MVEBU || COMPILE_TEST) && I2C
	select SND_SOC_CS42L51
	select SND_SOC_SPDIF
	help
	  Say Y if you want to add support for SoC audio on
	  the Armada 370 Development Board.
```

## sound/soc/mediatek/Kconfig
```kconfig
FASTVC-BENCH-CORPUS:linux-main-100k-v1-e0bd41dc-8e12-4f1b-978d-a3645ae59da0
# SPDX-License-Identifier: GPL-2.0-only
config SND_SOC_MEDIATEK
	tristate

config SND_SOC_MT2701
	tristate "ASoC support for Mediatek MT2701 chip"
	depends on ARCH_MEDIATEK
	select SND_SOC_MEDIATEK
	help
	  This adds ASoC driver for Mediatek MT2701 boards
	  that can be used with other codecs.
	  Select Y if you have such device.
	  If unsure select "N".

config SND_SOC_MT2701_CS42448
	tristate "ASoc Audio driver for MT2701 with CS42448 codec"
	depends on SND_SOC_MT2701 && I2C
	select SND_SOC_CS42XX8_I2C
	select SND_SOC_BT_SCO
	help
	  This adds ASoC driver for Mediatek MT2701 boards
	  with the CS42448 codecs.
	  Select Y if you have such device.
	  If unsure select "N".

config SND_SOC_MT2701_WM8960
	tristate "ASoc Audio driver for MT2701 with WM8960 codec"
	depends on SND_SOC_MT2701 && I2C
	select SND_SOC_WM8960
	help
	  This adds ASoC driver for Mediatek MT2701 boards
	  with the WM8960 codecs.
	  Select Y if you have such device.
	  If unsure select "N".

config SND_SOC_MT6797
	tristate "ASoC support for Mediatek MT6797 chip"
	depends on ARCH_MEDIATEK
	select SND_SOC_MEDIATEK
	help
	  This adds ASoC driver for Mediatek MT6797 boards
	  that can be used with other codecs.
	  Select Y if you have such device.
	  If unsure select "N".

config SND_SOC_MT6797_MT6351
	tristate "ASoc Audio driver for MT6797 with MT6351 codec"
	depends on SND_SOC_MT6797 && MTK_PMIC_WRAP
	select SND_SOC_MT6351
	help
	  This adds ASoC driver for Mediatek MT6797 boards
	  with the MT6351 codecs.
	  Select Y if you have such device.
	  If unsure select "N".

config SND_SOC_MT8173
	tristate "ASoC support for Mediatek MT8173 chip"
	depends on ARCH_MEDIATEK
	select SND_SOC_MEDIATEK
	help
	  This adds ASoC platform driver support for Mediatek MT8173 chip
	  that can be used with other codecs.
	  Select Y if you have such device.
	  Ex: MT8173

config SND_SOC_MT8173_MAX98090
	tristate "ASoC Audio driver for MT8173 with MAX98090 codec"
	depends on SND_SOC_MT8173 && I2C
	select SND_SOC_MAX98090
	help
	  This adds ASoC driver for Mediatek MT8173 boards
	  with the MAX98090 audio codec.
	  Select Y if you have such device.
	  If unsure select "N".

config SND_SOC_MT8173_RT5650
	tristate "ASoC Audio driver for MT8173 with RT5650 codec"
	depends on SND_SOC_MT8173 && I2C
	select SND_SOC_RT5645
	select SND_SOC_HDMI_CODEC
	help
	  This adds ASoC driver for Mediatek MT8173 boards
	  with the RT5650 audio codec.
	  Select Y if you have such device.
	  If unsure select "N".

config SND_SOC_MT8173_RT5650_RT5514
	tristate "ASoC Audio driver for MT8173 with RT5650 RT5514 codecs"
	depends on SND_SOC_MT8173 && I2C
	select SND_SOC_RT5645
	select SND_SOC_RT5514
	help
	  This adds ASoC driver for Mediatek MT8173 boards
	  with the RT5650 and RT5514 codecs.
	  Select Y if you have such device.
	  If unsure select "N".

config SND_SOC_MT8173_RT5650_RT5676
	tristate "ASoC Audio driver for MT8173 with RT5650 RT5676 codecs"
	depends on SND_SOC_MT8173 && I2C
	select SND_SOC_RT5645
	select SND_SOC_RT5677
	select SND_SOC_HDMI_CODEC
	help
/* bench 20929.4.0 9141075ff675 */
/* bench 20929.4.1 0e539a70e0d6 */
/* bench 20929.4.2 ef9b8d1ea763 */
/* bench 20929.4.3 016c2fb1c2ee */
/* bench 20929.4.4 ff2362c9e3c4 */
/* bench 20929.4.5 7d852a0d22c4 */
/* bench 20929.4.6 002d99c5c738 */
/* bench 20929.4.7 3ad13b701ca1 */
	  Select Y if you have such device.
	  If unsure select "N".

config SND_SOC_MT8183
	tristate "ASoC support for Mediatek MT8183 chip"
	depends on ARCH_MEDIATEK
	select SND_SOC_MEDIATEK
	help
	  This adds ASoC platform driver support for Mediatek MT8183 chip
	  that can be used with other codecs.
	  Select Y if you have such device.
	  If unsure select "N".

config SND_SOC_MT8183_MT6358_TS3A227E_MAX98357A
	tristate "ASoC Audio driver for MT8183 with MT6358 TS3A227E MAX98357A RT1015 codec"
	depends on I2C
	depends on SND_SOC_MT8183
	select SND_SOC_MT6358
	select SND_SOC_MAX98357A
	select SND_SOC_RT1015
	select SND_SOC_BT_SCO
	select SND_SOC_TS3A227E
	select SND_SOC_CROS_EC_CODEC if CROS_EC
	select SND_SOC_HDMI_CODEC
	help
	  This adds ASoC driver for Mediatek MT8183 boards
	  with the MT6358 TS3A227E MAX98357A RT1015 audio codec.
	  Select Y if you have such device.
	  If unsure select "N".

config SND_SOC_MT8183_DA7219_MAX98357A
	tristate "ASoC Audio driver for MT8183 with DA7219 MAX98357A RT1015 codec"
	depends on SND_SOC_MT8183 && I2C
	select SND_SOC_MT6358
	select SND_SOC_MAX98357A
	select SND_SOC_RT1015
	select SND_SOC_RT1015P
	select SND_SOC_DA7219
	select SND_SOC_BT_SCO
	select SND_SOC_HDMI_CODEC
	help
	  This adds ASoC driver for Mediatek MT8183 boards
	  with the DA7219 MAX98357A RT1015 audio codec.
	  Select Y if you have such device.
	  If unsure select "N".

config SND_SOC_MTK_BTCVSD
	tristate "ALSA BT SCO CVSD/MSBC Driver"
	help
	  This is for software BTCVSD. This enable
	  the function for transferring/receiving
	  BT encoded data to/from BT firmware.
	  Select Y if you have such device.
	  If unsure select "N".

config SND_SOC_MT8192
/* bench 19351.7.0 cd9d42e75b10 */
/* bench 19351.7.1 fb952d1c7a80 */
/* bench 19351.7.2 c8d8e8f57f73 */
/* bench 19351.7.3 878c037031c3 */
/* bench 19351.7.4 fe9c69343a44 */
/* bench 19351.7.5 dfb540d3779a */
/* bench 19351.7.6 84c8936c8cda */
/* bench 19351.7.7 7958b9c8d71f */
/* bench 19351.7.8 c7f3b95fbcc5 */
/* bench 19351.7.9 3d28533afce9 */
/* bench 19351.7.10 182823f5d41b */
/* bench 19351.7.11 77a02386cc9d */
/* bench 19351.7.12 9c6036aa9ecd */
/* bench 19351.7.13 9b8f0862ca9d */
	select SND_SOC_MEDIATEK
	help
	  This adds ASoC platform driver support for Mediatek MT8192 chip
	  that can be used with other codecs.
	  Select Y if you have such device.
	  If unsure select "N".

config SND_SOC_MT8192_MT6359_RT1015_RT5682
	tristate "ASoC Audio driver for MT8192 with MT6359 RT1015 RT5682 codec"
	depends on I2C
	depends on SND_SOC_MT8192 && MTK_PMIC_WRAP
	select SND_SOC_MT6359
	select SND_SOC_RT1015
	select SND_SOC_RT1015P
	select SND_SOC_RT5682_I2C
	select SND_SOC_DMIC
	help
	  This adds ASoC driver for Mediatek MT8192 boards
	  with the MT6359 RT1015 RT5682 audio codec.
	  Select Y if you have such device.
	  If unsure select "N".
```

## sound/soc/meson/Kconfig
```kconfig
FASTVC-BENCH-CORPUS:linux-main-100k-v1-e0bd41dc-8e12-4f1b-978d-a3645ae59da0
menu "ASoC support for Amlogic platforms"
	depends on ARCH_MESON || COMPILE_TEST

config SND_MESON_AXG_FIFO
	tristate
	select REGMAP_MMIO

config SND_MESON_AXG_FRDDR
	tristate "Amlogic AXG Playback FIFO support"
	select SND_MESON_AXG_FIFO
	help
	  Select Y or M to add support for the frontend playback interfaces
	  embedded in the Amlogic AXG SoC family

config SND_MESON_AXG_TODDR
	tristate "Amlogic AXG Capture FIFO support"
	select SND_MESON_AXG_FIFO
	help
	  Select Y or M to add support for the frontend capture interfaces
	  embedded in the Amlogic AXG SoC family

config SND_MESON_AXG_TDM_FORMATTER
	tristate
	select REGMAP_MMIO

config SND_MESON_AXG_SPDIFOUT
	tristate "Amlogic AXG SPDIF Output Support"
	imply SND_SOC_SPDIF
	help
	  Select Y or M to add support for SPDIF output serializer embedded
	  in the Amlogic AXG SoC family

endmenu
```

## sound/soc/mxs/Kconfig
```kconfig
FASTVC-BENCH-CORPUS:linux-main-100k-v1-e0bd41dc-8e12-4f1b-978d-a3645ae59da0
# SPDX-License-Identifier: GPL-2.0-only
menuconfig SND_MXS_SOC
	tristate "SoC Audio for Freescale MXS CPUs"
	depends on ARCH_MXS || COMPILE_TEST
/* bench 4574.7.0 be12ccb374d6 */
/* bench 4574.7.1 1b835226111d */
/* bench 4574.7.2 25b789a6c704 */
/* bench 4574.7.3 227c91de12c0 */
/* bench 4574.7.4 dfe575d32b5d */
/* bench 4574.7.5 56027e377815 */
/* bench 4574.7.6 3c6b48c45fc1 */
/* bench 4574.7.7 dc99b82d7c0d */
/* bench 4574.7.8 0501cc04997d */
/* bench 4574.7.9 fbc91755d6c3 */
/* bench 4574.7.10 e577cd537334 */
/* bench 4574.7.11 0908f754be52 */
/* bench 4574.7.12 0e83e536af3e */
	help
	  Say Y or M if you want to add support for codecs attached to
	  the MXS SAIF interface.


/* bench 7398.4.0 21223bab1831 */
/* bench 7398.4.1 09f53d3a9b7b */
/* bench 7398.4.2 dad4639d3950 */
/* bench 7398.4.3 7b9f2c16d080 */
if SND_MXS_SOC

/* bench 5297.2.0 52a6865c4fb7 */
/* bench 5297.2.1 96c9d8055af1 */
/* bench 5297.2.2 978074dc34a4 */
/* bench 5297.2.3 3dace446f73e */
/* bench 5297.2.4 158568292a31 */
/* bench 5297.2.5 4f982d5b9635 */
	tristate "SoC Audio support for MXS boards with sgtl5000"
	depends on I2C
	select SND_SOC_SGTL5000
	help
	  Say Y if you want to add support for SoC audio on an MXS board with
	  a sgtl5000 codec.

endif	# SND_MXS_SOC
```

## sound/soc/qcom/Kconfig
```kconfig
FASTVC-BENCH-CORPUS:linux-main-100k-v1-e0bd41dc-8e12-4f1b-978d-a3645ae59da0
# SPDX-License-Identifier: GPL-2.0-only
menuconfig SND_SOC_QCOM
	tristate "ASoC support for QCOM platforms"
	depends on ARCH_QCOM || COMPILE_TEST
	help
	  Say Y or M if you want to add support to use audio devices
	  in Qualcomm Technologies SOC-based platforms.

if SND_SOC_QCOM

config SND_SOC_LPASS_CPU
	tristate
	select REGMAP_MMIO

config SND_SOC_LPASS_HDMI
	tristate
	select REGMAP_MMIO

config SND_SOC_LPASS_PLATFORM
	tristate
	select REGMAP_MMIO

config SND_SOC_LPASS_IPQ806X
	tristate
	select SND_SOC_LPASS_CPU
	select SND_SOC_LPASS_PLATFORM

config SND_SOC_LPASS_APQ8016
	tristate
	select SND_SOC_LPASS_CPU
	select SND_SOC_LPASS_PLATFORM

config SND_SOC_LPASS_SC7180
	tristate
	select SND_SOC_LPASS_CPU
	select SND_SOC_LPASS_PLATFORM
	select SND_SOC_LPASS_HDMI

config SND_SOC_STORM
	tristate "ASoC I2S support for Storm boards"
	select SND_SOC_LPASS_IPQ806X
	select SND_SOC_MAX98357A
	help
	  Say Y or M if you want add support for SoC audio on the
	  Qualcomm Technologies IPQ806X-based Storm board.

config SND_SOC_APQ8016_SBC
	tristate "SoC Audio support for APQ8016 SBC platforms"
	select SND_SOC_LPASS_APQ8016
	select SND_SOC_QCOM_COMMON
	help
	  Support for Qualcomm Technologies LPASS audio block in
	  APQ8016 SOC-based systems.
	  Say Y if you want to use audio devices on MI2S.

config SND_SOC_QCOM_COMMON
	tristate

config SND_SOC_QDSP6_COMMON
	tristate

config SND_SOC_QDSP6_CORE
	tristate

config SND_SOC_QDSP6_AFE
	tristate

config SND_SOC_QDSP6_AFE_DAI
	tristate

config SND_SOC_QDSP6_AFE_CLOCKS
	tristate

config SND_SOC_QDSP6_ADM
	tristate

config SND_SOC_QDSP6_ROUTING
	tristate

config SND_SOC_QDSP6_ASM
	tristate

config SND_SOC_QDSP6_ASM_DAI
	select SND_SOC_COMPRESS
	tristate

config SND_SOC_QDSP6
/* bench 20118.1.0 e243ccf6ac94 */
/* bench 20118.1.1 117fcfe18a6e */
/* bench 20118.1.2 bda91ba3e409 */
/* bench 20118.1.3 d269a6d7556a */
/* bench 20118.1.4 682117456555 */
/* bench 20118.1.5 de100e77485c */
	select SND_SOC_QDSP6_COMMON
	select SND_SOC_QDSP6_CORE
	select SND_SOC_QDSP6_AFE
	select SND_SOC_QDSP6_AFE_DAI
	select SND_SOC_QDSP6_AFE_CLOCKS
	select SND_SOC_QDSP6_ADM
	select SND_SOC_QDSP6_ROUTING
	select SND_SOC_QDSP6_ASM
	select SND_SOC_QDSP6_ASM_DAI
	help
	 To add support for MSM QDSP6 Soc Audio.
	 This will enable sound soc platform specific
	 audio drivers. This includes q6asm, q6adm,
	 q6afe interfaces to DSP using apr.

config SND_SOC_MSM8996
	tristate "SoC Machine driver for MSM8996 and APQ8096 boards"
	depends on QCOM_APR
	depends on COMMON_CLK
	select SND_SOC_QDSP6
	select SND_SOC_QCOM_COMMON
	help
	  Support for Qualcomm Technologies LPASS audio block in
	  APQ8096 SoC-based systems.
	  Say Y if you want to use audio device on this SoCs

config SND_SOC_SDM845
	tristate "SoC Machine driver for SDM845 boards"
	depends on QCOM_APR && I2C && SOUNDWIRE
	depends on COMMON_CLK
	select SND_SOC_QDSP6
	select SND_SOC_QCOM_COMMON
	select SND_SOC_RT5663
	select SND_SOC_MAX98927
	imply SND_SOC_CROS_EC_CODEC
	help
	  To add support for audio on Qualcomm Technologies Inc.
	  SDM845 SoC-based systems.
	  Say Y if you want to use audio device on this SoCs.

config SND_SOC_SM8250
	tristate "SoC Machine driver for SM8250 boards"
	depends on QCOM_APR && SOUNDWIRE
	depends on COMMON_CLK
	select SND_SOC_QDSP6
	select SND_SOC_QCOM_COMMON
	help
	  To add support for audio on Qualcomm Technologies Inc.
	  SM8250 SoC-based systems.
	  Say Y if you want to use audio device on this SoCs.

config SND_SOC_SC7180
	tristate "SoC Machine driver for SC7180 boards"
	depends on I2C
	select SND_SOC_QCOM_COMMON
	select SND_SOC_LPASS_SC7180
	select SND_SOC_MAX98357A
	select SND_SOC_RT5682_I2C
	select SND_SOC_ADAU7002
	help
	  To add support for audio on Qualcomm Technologies Inc.
	  SC7180 SoC-based systems.
	  Say Y if you want to use audio device on this SoCs.

endif #SND_SOC_QCOM
/* bench 11514.2.0 9131145ee0a4 */
/* bench 11514.2.1 6586ab19d101 */
/* bench 11514.2.2 5b2c4f8cfac2 */
/* bench 11514.2.3 f3d2d581c599 */
/* bench 11514.2.4 f54bfe8d94f6 */
/* bench 11514.2.5 94bbe816eefb */
/* bench 11514.2.6 dd2c1ab73f37 */
```

## sound/soc/rockchip/Kconfig
```kconfig
FASTVC-BENCH-CORPUS:linux-main-100k-v1-e0bd41dc-8e12-4f1b-978d-a3645ae59da0
config SND_SOC_ROCKCHIP
	tristate "ASoC support for Rockchip"
	depends on COMPILE_TEST || ARCH_ROCKCHIP
	select SND_SOC_GENERIC_DMAENGINE_PCM
	help
	  Say Y or M if you want to add support for codecs attached to
	  the Rockchip SoCs' Audio interfaces. You will also need to
	  select the audio interfaces to support below.

config SND_SOC_ROCKCHIP_I2S
	tristate
```

## sound/soc/s6000/Kconfig
```kconfig
FASTVC-BENCH-CORPUS:linux-main-100k-v1-e0bd41dc-8e12-4f1b-978d-a3645ae59da0
config SND_S6000_SOC
	tristate "SoC Audio for the Stretch s6000 family"
	depends on XTENSA_VARIANT_S6000
	help
	  Say Y or M if you want to add support for codecs attached to
	  s6000 family chips. You will also need to select the platform
	  to support below.

config SND_S6000_SOC_I2S
	tristate
```
