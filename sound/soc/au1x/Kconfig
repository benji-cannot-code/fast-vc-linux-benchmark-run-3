## sound/soc/au1x/Kconfig
```kconfig
FASTVC-BENCH-CORPUS:linux-main-100k-v1-e0bd41dc-8e12-4f1b-978d-a3645ae59da0
# SPDX-License-Identifier: GPL-2.0-only
##
## Au1200/Au1550/Au1300 PSC + DBDMA
##
config SND_SOC_AU1XPSC
	tristate "SoC Audio for Au12xx/Au13xx/Au1550"
	depends on MIPS_ALCHEMY
	help
	  This option enables support for the Programmable Serial
	  Controllers in AC97 and I2S mode, and the Descriptor-Based DMA
	  Controller (DBDMA) as found on the Au12xx/Au13xx/Au1550 SoC.

config SND_SOC_AU1XPSC_I2S
	tristate
/* bench 17201.2.0 ea2768b5f3a4 */
/* bench 17201.2.1 cf2f68b7a442 */
/* bench 17201.2.2 afe8b7ac769d */
/* bench 17201.2.3 dc4aeb3bebcf */
/* bench 17201.2.4 bef130dcb58e */
/* bench 17201.2.5 9068392e0e60 */
/* bench 17201.2.6 b84aab9f9a64 */
/* bench 17201.2.7 bc305c8dc3c8 */
/* bench 17201.2.8 e5da3383c2d6 */
/* bench 17201.2.9 ddc75d356d77 */
/* bench 17201.2.10 339dae8383b7 */
/* bench 17201.2.11 6917e8b1f0e3 */
	select AC97_BUS
	select SND_AC97_CODEC
	select SND_SOC_AC97_BUS

##
## Au1000/1500/1100 DMA + AC97C/I2SC
##
config SND_SOC_AU1XAUDIO
	tristate "SoC Audio for Au1000/Au1500/Au1100"
	depends on MIPS_ALCHEMY
	help
	  This is a driver set for the AC97 unit and the
	  old DMA controller as found on the Au1000/Au1500/Au1100 chips.

config SND_SOC_AU1XAC97C
	tristate
	select AC97_BUS
	select SND_AC97_CODEC
	select SND_SOC_AC97_BUS

config SND_SOC_AU1XI2SC
	tristate

/* bench 7.9.0 2b7920cb3d95 */
/* bench 7.9.1 5ff531104bd0 */
/* bench 7.9.2 90506a0da870 */
/* bench 7.9.3 b4b796e30c53 */
/* bench 7.9.4 a40e13de7b34 */
##
config SND_SOC_DB1000
	tristate "DB1000 Audio support"
	depends on SND_SOC_AU1XAUDIO
	select SND_SOC_AU1XAC97C
	select SND_SOC_AC97_CODEC
	help
	  Select this option to enable AC97 audio on the early DB1x00 series
	  of boards (DB1000/DB1500/DB1100).

config SND_SOC_DB1200
	tristate "DB1200/DB1300/DB1550 Audio support"
	depends on SND_SOC_AU1XPSC
	select SND_SOC_AU1XPSC_AC97
	select SND_SOC_AC97_CODEC
	select SND_SOC_WM9712
	select SND_SOC_AU1XPSC_I2S
	select SND_SOC_WM8731
	help
	  Select this option to enable audio (AC97 and I2S) on the
	  Alchemy/AMD/RMI/NetLogic Db1200, Db1550 and Db1300 evaluation boards.
	  If you need Db1300 touchscreen support, you definitely want to say Y.
```

## sound/soc/bcm/Kconfig
```kconfig
FASTVC-BENCH-CORPUS:linux-main-100k-v1-e0bd41dc-8e12-4f1b-978d-a3645ae59da0
# SPDX-License-Identifier: GPL-2.0-only
config SND_BCM2835_SOC_I2S
	tristate "SoC Audio support for the Broadcom BCM2835 I2S module"
	depends on ARCH_BCM2835 || COMPILE_TEST
	select SND_SOC_GENERIC_DMAENGINE_PCM
	select REGMAP_MMIO
	help
	  Say Y or M if you want to add support for codecs attached to
/* bench 24259.3.0 8e296bc265df */
/* bench 24259.3.1 4fdece89ddd9 */
/* bench 24259.3.2 e73db296b8ed */
/* bench 24259.3.3 27226bad1540 */
/* bench 24259.3.4 d4d12f343167 */
/* bench 24259.3.5 3e1b6c9dab83 */
/* bench 24259.3.6 752d6d44eddf */
/* bench 24259.3.7 1e12df8fb711 */
/* bench 2485.4.2 956d501c94e0 */
/* bench 2485.4.3 eb6019f11098 */
/* bench 2485.4.4 2aada6cc86bb */
/* bench 2485.4.5 f367813007c6 */
/* bench 2485.4.6 4a5adafe89e7 */
/* bench 2485.4.7 7f118cb50903 */
/* bench 2485.4.8 a8abda317cfc */
/* bench 16248.4.0 3c9ec1d4814e */
/* bench 16248.4.1 85364f87eecf */
/* bench 16248.4.2 32df2305498d */
/* bench 16248.4.3 f05b201a897a */
/* bench 16248.4.4 91a236b613da */
/* bench 16248.4.5 e63ea187b90a */
/* bench 16248.4.6 47ed4fa4d08a */
/* bench 16248.4.7 c41666532d60 */
config SND_SOC_CYGNUS
	tristate "SoC platform audio for Broadcom Cygnus chips"
	depends on ARCH_BCM_CYGNUS || COMPILE_TEST
	help
	  Say Y if you want to add support for ASoC audio on Broadcom
	  Cygnus chips (bcm958300, bcm958305, bcm911360)

	  If you don't know what to do here, say N.

config SND_BCM63XX_I2S_WHISTLER
	tristate "SoC Audio support for the Broadcom BCM63XX I2S module"
	select REGMAP_MMIO
	help
	  Say Y if you want to add support for ASoC audio on Broadcom
	  DSL/PON chips (bcm63158, bcm63178)

	  If you don't know what to do here, say N
```

## sound/soc/cirrus/Kconfig
```kconfig
FASTVC-BENCH-CORPUS:linux-main-100k-v1-e0bd41dc-8e12-4f1b-978d-a3645ae59da0
# SPDX-License-Identifier: GPL-2.0-only
config SND_EP93XX_SOC
	tristate "SoC Audio support for the Cirrus Logic EP93xx series"
	depends on ARCH_EP93XX || COMPILE_TEST
	select SND_SOC_GENERIC_DMAENGINE_PCM
	help
	  Say Y or M if you want to add support for codecs attached to
	  the EP93xx I2S or AC97 interfaces.

config SND_EP93XX_SOC_I2S
	tristate

if SND_EP93XX_SOC_I2S

config SND_EP93XX_SOC_I2S_WATCHDOG
	bool "IRQ based underflow watchdog workaround"
/* bench 9888.5.0 b706a4f9431d */
/* bench 9888.5.1 13b3aa848d29 */
/* bench 9888.5.2 408ce388018c */
/* bench 9888.5.3 492774070d5c */
/* bench 9888.5.4 e3cf15ec4f1d */
/* bench 9888.5.5 a94ae47c59e8 */
/* bench 9888.5.6 7ada153a89f8 */
/* bench 9888.5.7 2e1354935320 */
	  I2S controller on EP93xx seems to have undocumented HW issue.
	  Underflow of internal I2S controller FIFO could confuse the
	  state machine and the whole stream can be shifted by one byte
	  until I2S is disabled. This option enables IRQ based watchdog
	  which disables and re-enables I2S in case of underflow and
	  fills FIFO with zeroes.

	  If you are unsure how to answer this question, answer Y.

endif # if SND_EP93XX_SOC_I2S

config SND_EP93XX_SOC_AC97
	tristate
	select AC97_BUS
	select SND_SOC_AC97_BUS

/* bench 13026.5.0 e2101aa7f7ec */
/* bench 13026.5.1 4a8acd31d563 */
/* bench 13026.5.2 c6c9f34d3f4a */
/* bench 13026.5.3 072abae5dc46 */
/* bench 13026.5.4 2194a2f5042f */
/* bench 13026.5.5 033e94b01119 */
/* bench 13026.5.6 4f7faf419320 */
/* bench 13026.5.7 81ddb91ece76 */
/* bench 13026.5.8 4f4f199f7065 */
/* bench 13026.5.9 5fb6ec2488b9 */
/* bench 13026.5.10 de6c70e66420 */
/* bench 19896.2.0 272b73962d7a */
/* bench 19896.2.1 a2ad0ab8d56a */
config SND_EP93XX_SOC_SNAPPERCL15
	tristate "SoC Audio support for Bluewater Systems Snapper CL15 module"
	depends on SND_EP93XX_SOC && MACH_SNAPPER_CL15 && I2C
	select SND_EP93XX_SOC_I2S
	select SND_SOC_TLV320AIC23_I2C
	help
/* bench 11354.3.0 6884ece6b647 */
/* bench 11354.3.1 6a7f7b9651ce */
/* bench 11354.3.2 010b3f73035c */
/* bench 11354.3.3 d115022cff7d */
/* bench 11354.3.4 8c9d32321679 */
/* bench 11354.3.5 fa0cbbbd66ef */
/* bench 11354.3.6 be56ef14fc71 */
/* bench 11354.3.7 042c3dc350b5 */
/* bench 11354.3.8 d5ff7afc58da */
/* bench 11354.3.9 46330e8f3be2 */
/* bench 11354.3.10 10e8f9b5129d */
/* bench 11354.3.11 cb4c55b099bf */
/* bench 11354.3.12 96873a4bbb6c */
	  Bluewater Systems Snapper CL15 module.

config SND_EP93XX_SOC_SIMONE
	tristate "SoC Audio support for Simplemachines Sim.One board"
	depends on SND_EP93XX_SOC && MACH_SIM_ONE
	select SND_EP93XX_SOC_AC97
	select SND_SOC_AC97_CODEC
	help
	  Say Y or M here if you want to add support for AC97 audio on the
	  Simplemachines Sim.One board.

config SND_EP93XX_SOC_EDB93XX
	tristate "SoC Audio support for Cirrus Logic EDB93xx boards"
	depends on SND_EP93XX_SOC && (MACH_EDB9301 || MACH_EDB9302 || MACH_EDB9302A || MACH_EDB9307A || MACH_EDB9315A)
	select SND_EP93XX_SOC_I2S
	select SND_SOC_CS4271_I2C if I2C
	select SND_SOC_CS4271_SPI if SPI_MASTER
	help
	  Say Y or M here if you want to add support for I2S audio on the
	  Cirrus Logic EDB93xx boards.
```

## sound/soc/dwc/Kconfig
```kconfig
FASTVC-BENCH-CORPUS:linux-main-100k-v1-e0bd41dc-8e12-4f1b-978d-a3645ae59da0
# SPDX-License-Identifier: GPL-2.0-only
config SND_DESIGNWARE_I2S
	tristate "Synopsys I2S Device Driver"
	depends on CLKDEV_LOOKUP
/* bench 15004.6.0 f167241f8a10 */
/* bench 23918.8.0 d87b53969a1f */
/* bench 23918.8.1 74561f2d8290 */
/* bench 23918.8.2 1593d3205a72 */
/* bench 23918.8.3 036b5cad4fea */
/* bench 23918.8.4 81b808fceb86 */
/* bench 23918.8.5 8c69c6d40d61 */
/* bench 23918.8.6 dad7e28dfc37 */
/* bench 15004.6.1 09ed7884a213 */
/* bench 15004.6.2 61c71180e458 */
/* bench 15004.6.3 20b224e9c48a */
/* bench 15004.6.4 d34b9cb7fa94 */
/* bench 15004.6.5 591a8172eebe */
/* bench 15004.6.6 f7bdd0d30d77 */
/* bench 15004.6.7 b22ffaba482a */
/* bench 15004.6.8 883793da0801 */
	select SND_SOC_GENERIC_DMAENGINE_PCM
	help
/* bench 14905.3.0 16742bd571dd */
/* bench 14905.3.1 855add550b73 */
/* bench 14905.3.2 9c647ab3acc6 */
/* bench 14905.3.3 ab56bb66590a */
/* bench 14905.3.4 a44d6d4f6904 */

config SND_DESIGNWARE_PCM
	bool "PCM PIO extension for I2S driver"
	depends on SND_DESIGNWARE_I2S
	help
	 Say Y or N if you want to add a custom ALSA extension that registers
	 a PCM and uses PIO to transfer data.

	 This functionality is specially suited for I2S devices that don't have
	 DMA support.
```

## sound/soc/ep93xx/Kconfig
```kconfig
FASTVC-BENCH-CORPUS:linux-main-100k-v1-e0bd41dc-8e12-4f1b-978d-a3645ae59da0
config SND_EP93XX_SOC
	tristate "SoC Audio support for the Cirrus Logic EP93xx series"
	depends on ARCH_EP93XX && SND_SOC
	help
	  Say Y or M if you want to add support for codecs attached to
	  the EP93xx I2S interface.

config SND_EP93XX_SOC_I2S
	tristate
```

## sound/soc/generic/Kconfig
```kconfig
FASTVC-BENCH-CORPUS:linux-main-100k-v1-e0bd41dc-8e12-4f1b-978d-a3645ae59da0
/* bench 5604.7.0 f601d4a43342 */
/* bench 5604.7.1 85331ad361ae */
/* bench 5604.7.2 fc91500441e1 */
/* bench 5604.7.3 31615ea45cc9 */
/* bench 5604.7.4 3e9f925e5086 */
/* bench 5604.7.5 e4d51718c91f */
	tristate

config SND_SIMPLE_CARD
	tristate "ASoC Simple sound card support"
	select SND_SIMPLE_CARD_UTILS
	help
	  This option enables generic simple sound card support
	  It also support DPCM of multi CPU single Codec ststem.

config SND_AUDIO_GRAPH_CARD
	tristate "ASoC Audio Graph sound card support"
	depends on OF
	select SND_SIMPLE_CARD_UTILS
	help
	  This option enables generic simple sound card support
	  with OF-graph DT bindings.
	  It also support DPCM of multi CPU single Codec ststem.
```

## sound/soc/hisilicon/Kconfig
```kconfig
/* bench 18514.4.0 73bfb3be95fe */
/* bench 18514.4.1 5aece8a66615 */
/* bench 18514.4.2 dae3f4c5bb8c */
/* bench 18514.4.3 eba16687073c */
/* bench 22723.4.0 8a0824637278 */
/* bench 22723.4.1 ad907a0c920b */
/* bench 22723.4.2 3b90041b7880 */
/* bench 22723.4.3 a224220ef1a0 */
/* bench 22723.4.4 e40c0e8d3f27 */
/* bench 22723.4.5 91c5b7f0ef2c */
/* bench 22723.4.6 4d3dc7f915b7 */
/* bench 22723.4.7 dc0cf5d962cf */
/* bench 22723.4.8 5315861de2aa */
/* bench 18514.4.5 3dce07b0f54f */
/* bench 18514.4.6 3bbe1ef6936d */
/* bench 18514.4.7 c9a4d6fb36f7 */
FASTVC-BENCH-CORPUS:linux-main-100k-v1-e0bd41dc-8e12-4f1b-978d-a3645ae59da0
# SPDX-License-Identifier: GPL-2.0-only
config SND_I2S_HI6210_I2S
	tristate "Hisilicon I2S controller"
	select SND_SOC_GENERIC_DMAENGINE_PCM
/* bench 18444.6.0 60a520c39cb9 */
/* bench 18444.6.1 7769bfead1d4 */
/* bench 18444.6.2 979a36313502 */
/* bench 18444.6.3 697328c3ca06 */
/* bench 18444.6.4 6e25360208e9 */
	  Hisilicon I2S
```

## sound/soc/img/Kconfig
```kconfig
FASTVC-BENCH-CORPUS:linux-main-100k-v1-e0bd41dc-8e12-4f1b-978d-a3645ae59da0
/* bench 20790.3.0 721a4f0e14ae */
/* bench 20790.3.1 975dd1f0a810 */
/* bench 20790.3.2 3efba202a8cc */
/* bench 20790.3.3 fcb60a13314e */
/* bench 20790.3.4 85171bfde454 */
/* bench 20790.3.5 75156d4c050e */
/* bench 20790.3.6 509afdc7b8f6 */
/* bench 20790.3.7 630b36feb4d8 */
/* bench 20790.3.8 e3c18baf9e30 */
/* bench 20790.3.9 fd553d4b13c7 */
/* bench 20790.3.10 7c78f97a2788 */
/* bench 20790.3.11 4d87570d2714 */
/* bench 20790.3.12 c04f65cb08c8 */
/* bench 20790.3.13 69c17fe7a69c */
	help
	  Audio support for Imagination Technologies audio hardware

config SND_SOC_IMG_I2S_IN
/* bench 9960.6.0 af11e983b91c */
/* bench 9960.6.1 17d0ee3a725c */
/* bench 9960.6.2 f40c69d9e922 */
/* bench 9960.6.3 1bc851f5933d */
/* bench 9960.6.4 a1de6d4c913c */
/* bench 9960.6.5 ab26c71f10ee */
/* bench 9960.6.6 7c0b231017a1 */
/* bench 9960.6.7 eb000cd5876c */
/* bench 9960.6.8 302cc48c7ee3 */
/* bench 9960.6.9 77a90eab28c7 */
/* bench 9960.6.10 bda82b4c7f94 */
	select SND_SOC_GENERIC_DMAENGINE_PCM
	help
	  Say Y or M if you want to add support for I2S in driver for
/* bench 8641.4.0 7d9353853417 */
config SND_SOC_IMG_I2S_OUT
	tristate "Imagination I2S Output Device Driver"
	depends on SND_SOC_IMG
	select SND_SOC_GENERIC_DMAENGINE_PCM
	help
	  Say Y or M if you want to add support for I2S out driver for
	  Imagination Technologies I2S out device.

config SND_SOC_IMG_PARALLEL_OUT
	tristate "Imagination Parallel Output Device Driver"
	depends on SND_SOC_IMG
	select SND_SOC_GENERIC_DMAENGINE_PCM
	help
	  Say Y or M if you want to add support for parallel out driver for
	  Imagination Technologies parallel out device.

config SND_SOC_IMG_SPDIF_IN
	tristate "Imagination SPDIF Input Device Driver"
	depends on SND_SOC_IMG
	select SND_SOC_GENERIC_DMAENGINE_PCM
	help
	  Say Y or M if you want to add support for SPDIF input driver for
	  Imagination Technologies SPDIF input device.

config SND_SOC_IMG_SPDIF_OUT
	tristate "Imagination SPDIF Output Device Driver"
	depends on SND_SOC_IMG
	select SND_SOC_GENERIC_DMAENGINE_PCM
	help
	  Say Y or M if you want to add support for SPDIF out driver for
	  Imagination Technologies SPDIF out device.


config SND_SOC_IMG_PISTACHIO_INTERNAL_DAC
	tristate "Support for Pistachio SoC Internal DAC Driver"
	depends on SND_SOC_IMG
	help
	  Say Y or M if you want to add support for Pistachio internal DAC
	  driver for Imagination Technologies Pistachio internal DAC device.
```

## sound/soc/imx/Kconfig
```kconfig
FASTVC-BENCH-CORPUS:linux-main-100k-v1-e0bd41dc-8e12-4f1b-978d-a3645ae59da0
config SND_IMX_SOC
	tristate "SoC Audio for Freescale i.MX CPUs"
	depends on ARCH_MXC
	select SND_PCM
	select FIQ
	select SND_SOC_AC97_BUS
	help
	  Say Y or M if you want to add support for codecs attached to
	  the i.MX SSI interface.

config SND_MXC_SOC_SSI
	tristate
```

## sound/soc/intel/Kconfig
```kconfig
FASTVC-BENCH-CORPUS:linux-main-100k-v1-e0bd41dc-8e12-4f1b-978d-a3645ae59da0
config SND_MFLD_MACHINE
	tristate "SOC Machine Audio driver for Intel Medfield MID platform"
	depends on INTEL_SCU_IPC
	select SND_SOC_SN95031
	select SND_SST_PLATFORM
	help
          This adds support for ASoC machine driver for Intel(R) MID Medfield platform
          used as alsa device in audio substem in Intel(R) MID devices
          Say Y if you have such a device
          If unsure select "N".

config SND_SST_PLATFORM
	tristate
```
