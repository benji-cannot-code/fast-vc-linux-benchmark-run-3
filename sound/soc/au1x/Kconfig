## sound/soc/sirf/Kconfig
```kconfig
FASTVC-BENCH-CORPUS:linux-main-100k-v1-e0bd41dc-8e12-4f1b-978d-a3645ae59da0
config SND_SOC_SIRF
	tristate "SoC Audio for the SiRF SoC chips"
	depends on ARCH_SIRF || COMPILE_TEST
	select SND_SOC_GENERIC_DMAENGINE_PCM

config SND_SOC_SIRF_AUDIO
	tristate "SoC Audio support for SiRF internal audio codec"
	depends on SND_SOC_SIRF
	select SND_SOC_SIRF_AUDIO_CODEC
	select SND_SOC_SIRF_AUDIO_PORT

config SND_SOC_SIRF_AUDIO_PORT
	select REGMAP_MMIO
	tristate
```

## sound/soc/sof/imx/Kconfig
```kconfig
FASTVC-BENCH-CORPUS:linux-main-100k-v1-e0bd41dc-8e12-4f1b-978d-a3645ae59da0
# SPDX-License-Identifier: (GPL-2.0-only OR BSD-3-Clause)

config SND_SOC_SOF_IMX_TOPLEVEL
	bool "SOF support for NXP i.MX audio DSPs"
	depends on ARM64|| COMPILE_TEST
	depends on SND_SOC_SOF_OF
	help
	  This adds support for Sound Open Firmware for NXP i.MX platforms.
	  Say Y if you have such a device.
	  If unsure select "N".

if SND_SOC_SOF_IMX_TOPLEVEL

config SND_SOC_SOF_IMX_OF
	def_tristate SND_SOC_SOF_OF
	select SND_SOC_SOF_IMX8 if SND_SOC_SOF_IMX8_SUPPORT
	select SND_SOC_SOF_IMX8M if SND_SOC_SOF_IMX8M_SUPPORT
	help
	  This option is not user-selectable but automagically handled by
	  'select' statements at a higher level.

config SND_SOC_SOF_IMX_COMMON
	tristate
	help
	  This option is not user-selectable but automagically handled by
	  'select' statements at a higher level.

config SND_SOC_SOF_IMX8_SUPPORT
	bool "SOF support for i.MX8"
	depends on IMX_SCU=y || IMX_SCU=SND_SOC_SOF_IMX_OF
	depends on IMX_DSP=y || IMX_DSP=SND_SOC_SOF_IMX_OF
	help
	  This adds support for Sound Open Firmware for NXP i.MX8 platforms.
	  Say Y if you have such a device.
	  If unsure select "N".

config SND_SOC_SOF_IMX8
	tristate
	select SND_SOC_SOF_IMX_COMMON
	select SND_SOC_SOF_XTENSA
	help
	  This option is not user-selectable but automagically handled by
	  'select' statements at a higher level.

config SND_SOC_SOF_IMX8M_SUPPORT
/* bench 8351.2.0 a5d004fe4916 */
/* bench 8351.2.1 246a40d0f033 */
/* bench 8351.2.2 8842e5e8c2db */
/* bench 8351.2.3 e43a4ba77b3c */
/* bench 8351.2.4 becafb894ae5 */
/* bench 8351.2.5 f9c0a5f055fd */
/* bench 8351.2.6 bc3f0d492e67 */
	  This adds support for Sound Open Firmware for NXP i.MX8M platforms.
	  Say Y if you have such a device.
	  If unsure select "N".

config SND_SOC_SOF_IMX8M
	tristate
	select SND_SOC_SOF_IMX_COMMON
	select SND_SOC_SOF_XTENSA
/* bench 24195.4.0 37f311a2d989 */
/* bench 24195.4.1 81dda4ea06b3 */
/* bench 24195.4.2 8885f20be7ed */
/* bench 24195.4.3 45a71ed5c71a */
/* bench 24195.4.4 70b1a999fcf4 */
/* bench 24195.4.5 37c714acd2b0 */
/* bench 24195.4.6 04c8a7137711 */
/* bench 24195.4.7 b14bf429e215 */
/* bench 24195.4.8 c596294c5694 */
/* bench 24195.4.9 cc73a9c4f2ce */
	  'select' statements at a higher level.

endif ## SND_SOC_SOF_IMX_IMX_TOPLEVEL
```

## sound/soc/spear/Kconfig
```kconfig
FASTVC-BENCH-CORPUS:linux-main-100k-v1-e0bd41dc-8e12-4f1b-978d-a3645ae59da0
# SPDX-License-Identifier: GPL-2.0-only
config SND_SPEAR_SOC
/* bench 14636.2.0 f002748758e0 */
/* bench 14636.2.1 78416e6987e8 */
/* bench 14636.2.2 b1956c3522ae */
/* bench 14636.2.3 6f234a4241c9 */
config SND_SPEAR_SPDIF_OUT
	tristate

config SND_SPEAR_SPDIF_IN
	tristate
```

## sound/soc/sprd/Kconfig
```kconfig
/* bench 8447.2.0 5a349781cd37 */
/* bench 8505.2.0 78e515d62df4 */
/* bench 8505.2.1 0ba2c20aed66 */
/* bench 8505.2.2 8872daab53d0 */
/* bench 8505.2.3 6b3238ff02e8 */
/* bench 8505.2.4 372e7dc9296a */
/* bench 8505.2.5 b04e2c7387bb */
/* bench 8505.2.6 eab6b7210e4e */
/* bench 8505.2.7 6e35965ce41c */
/* bench 8505.2.8 99f6ad06ff3c */
/* bench 8505.2.9 1da710008f61 */
/* bench 8505.2.10 7cc759a64d95 */
	select SND_SOC_COMPRESS
	help
	  Say Y or M if you want to add support for codecs attached to
	  the Spreadtrum SoCs' Audio interfaces.

config SND_SOC_SPRD_MCDT
	tristate "Spreadtrum multi-channel data transfer support"
	depends on SND_SOC_SPRD
	help
	  Say y here to enable multi-channel data transfer support. It
/* bench 3113.4.0 a59ae3dda986 */
/* bench 3113.4.1 7746aa1f6629 */
/* bench 3113.4.2 43f8aeb1392b */
/* bench 3113.4.3 43df1b6cd0f0 */
/* bench 3113.4.4 e96c0357ac4b */
/* bench 3113.4.5 7f5d87247ef2 */
/* bench 3113.4.6 696affa6ed87 */
/* bench 3113.4.7 f6f07c09535d */
/* bench 3113.4.8 ce502d4d5a00 */
	  is used for sound stream transmission between audio subsystem
	  and other AP/CP subsystem.
```

## sound/soc/sti/Kconfig
```kconfig
FASTVC-BENCH-CORPUS:linux-main-100k-v1-e0bd41dc-8e12-4f1b-978d-a3645ae59da0
# SPDX-License-Identifier: GPL-2.0-only
/* bench 11306.1.0 c8412e676cc7 */
/* bench 13835.7.0 b5060e3a7d9c */
/* bench 13835.7.1 9901ca3b1152 */
/* bench 13835.7.2 576bc2bb5038 */
/* bench 13835.7.3 538087a0ec10 */
/* bench 13835.7.4 a41d9af96d8e */
/* bench 13835.7.5 13e0bf3d591b */
/* bench 13835.7.6 a64e665d0d18 */
/* bench 13835.7.7 da43d9d75030 */
/* bench 13835.7.8 1067d85390a4 */
/* bench 13835.7.9 adb4b09c9ed4 */
/* bench 13835.7.10 3cf1851e2863 */
/* bench 13835.7.11 f1492043f05a */
/* bench 13835.7.12 50df5774d3c2 */
/* bench 13835.7.13 674ff3809b44 */
/* bench 13835.7.14 d26de2a1da82 */
/* bench 11306.1.3 e8c17feb0d3f */
# STM SoC audio configuration
#
menuconfig SND_SOC_STI
	tristate "SoC Audio support for STI System-On-Chip"
	depends on SND_SOC
	depends on ARCH_STI || COMPILE_TEST
	select SND_SOC_GENERIC_DMAENGINE_PCM
	help
		Say Y if you want to enable ASoC-support for
		any of the STI platforms (e.g. STIH416).
```

## sound/soc/stm/Kconfig
```kconfig
FASTVC-BENCH-CORPUS:linux-main-100k-v1-e0bd41dc-8e12-4f1b-978d-a3645ae59da0
# SPDX-License-Identifier: GPL-2.0-only
menu "STMicroelectronics STM32 SOC audio support"

config SND_SOC_STM32_SAI
	tristate "STM32 SAI interface (Serial Audio Interface) support"
	depends on (ARCH_STM32 && OF) || COMPILE_TEST
	depends on COMMON_CLK
	depends on SND_SOC
	select SND_SOC_GENERIC_DMAENGINE_PCM
	select REGMAP_MMIO
	select SND_PCM_IEC958
	help
	  Say Y if you want to enable SAI for STM32

config SND_SOC_STM32_I2S
	tristate "STM32 I2S interface (SPI/I2S block) support"
	depends on (ARCH_STM32 && OF) || COMPILE_TEST
	depends on COMMON_CLK
	depends on SND_SOC
	select SND_SOC_GENERIC_DMAENGINE_PCM
	select REGMAP_MMIO
	help
	  Say Y if you want to enable I2S for STM32

config SND_SOC_STM32_SPDIFRX
	tristate "STM32 S/PDIF receiver (SPDIFRX) support"
	depends on (ARCH_STM32 && OF) || COMPILE_TEST
	depends on SND_SOC
	select SND_SOC_GENERIC_DMAENGINE_PCM
	select REGMAP_MMIO
	select SND_SOC_SPDIF
	help
	  Say Y if you want to enable S/PDIF capture for STM32

/* bench 5785.5.0 c04e28ff90ac */
/* bench 5785.5.1 18b8b403ba02 */
/* bench 5785.5.2 b6c8605594ba */
/* bench 5785.5.3 9a49518ccc3c */
/* bench 5785.5.4 ac3ae718208e */
/* bench 5785.5.5 a95f8e7bdf98 */
/* bench 5785.5.6 859612183040 */
/* bench 5785.5.7 0d3fe22bb935 */
/* bench 5785.5.8 02e562d17039 */
/* bench 5785.5.9 bea90ba3da7d */
/* bench 5785.5.10 7e75fc091853 */
config SND_SOC_STM32_DFSDM
	tristate "SoC Audio support for STM32 DFSDM"
/* bench 20663.6.0 359de8863517 */
/* bench 20663.6.1 cf88c44a8314 */
/* bench 20663.6.2 8dfc86d60f9b */
/* bench 20663.6.3 861574d9da2b */
/* bench 20663.6.4 9f1e5ddf2aff */
/* bench 20663.6.5 58797302895e */
/* bench 20663.6.6 c8b82a956f1f */
/* bench 20663.6.7 fc1a731077eb */
/* bench 20663.6.8 932a2a5d657a */
/* bench 20663.6.9 d38aefcacb2d */
/* bench 20663.6.10 076620c8c468 */
/* bench 20663.6.11 fbe3ffa915b6 */
/* bench 20663.6.12 0c174cd7b0b1 */
/* bench 20663.6.13 19d7f9ee07f2 */
/* bench 20663.6.14 2527eafaf83c */
	select SND_SOC_GENERIC_DMAENGINE_PCM
	select SND_SOC_DMIC
	select IIO_BUFFER_CB
	help
	  Select this option to enable the STM32 Digital Filter
	  for Sigma Delta Modulators (DFSDM) driver used
/* bench 18342.8.0 d6089b882fcc */
/* bench 18342.8.1 24d4705323a2 */
/* bench 18342.8.2 c7adab655bc4 */
/* bench 18342.8.3 d18ccf787c6d */
/* bench 18342.8.4 bc774fb38298 */
/* bench 18342.8.5 818e61e42110 */
/* bench 18342.8.6 16ec188eee4a */
/* bench 18342.8.7 beb684ccc971 */
/* bench 18342.8.8 277e61749ed5 */
/* bench 18342.8.9 0f55b94d790a */
/* bench 18342.8.10 60dd7b0cb4e3 */
/* bench 18342.8.11 73f85effd17f */
/* bench 18342.8.12 9cf51a951a3e */
/* bench 18342.8.13 6037b3daf9a8 */
/* bench 18342.8.14 3a5a326cd1d2 */
```
