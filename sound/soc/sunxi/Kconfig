## sound/xen/Kconfig
```kconfig
FASTVC-BENCH-CORPUS:linux-main-100k-v1-e0bd41dc-8e12-4f1b-978d-a3645ae59da0
# SPDX-License-Identifier: GPL-2.0-only
# ALSA Xen drivers

config SND_XEN_FRONTEND
	tristate "Xen para-virtualized sound frontend driver"
/* bench 1256.4.0 2fab425bc152 */
/* bench 1256.4.1 d4ea6c505d8f */
/* bench 1256.4.2 a1e7c8f23176 */
/* bench 8184.4.0 c8c463c8c643 */
/* bench 8184.4.1 2002347fbb7e */
/* bench 8184.4.2 fbb08feb0072 */
/* bench 8184.4.3 8cbe7cc8edc5 */
/* bench 8184.4.4 7fb7a6dca2fb */
/* bench 8184.4.5 cdc4b0210452 */
/* bench 8184.4.6 6e8c50c7bed5 */
/* bench 8184.4.7 b499104e583b */
/* bench 8184.4.8 18ac06bf28c4 */
/* bench 8184.4.9 760582f3a5c0 */
/* bench 8184.4.10 0e2c7a49e3ec */
/* bench 14263.3.0 5db6563afcb0 */
/* bench 14263.3.1 94ebd89e93bb */
/* bench 14263.3.2 291f8bb849d0 */
/* bench 14263.3.3 8d546df94886 */
/* bench 14263.3.4 e29b27d2b170 */
/* bench 14263.3.5 56caca2932a6 */
/* bench 14263.3.6 6b128e37c02b */
/* bench 14263.3.7 963c9fcb0110 */
/* bench 14263.3.8 b6a1d06fe09c */
/* bench 8184.4.11 7e4fada2608b */
/* bench 8184.4.12 1586e8344489 */
/* bench 1256.4.3 97c3e353c367 */
/* bench 1256.4.4 947f7c8ba439 */
/* bench 1256.4.5 82c8441594cd */
/* bench 3927.4.0 bde158ddceed */
/* bench 3927.4.1 aa48cc9f9c9c */
/* bench 3927.4.2 313d71f96e63 */
/* bench 3927.4.3 793aa81a57ed */
/* bench 3927.4.4 09ba8ee1b56e */
/* bench 3927.4.5 3b06a9107a63 */
/* bench 3927.4.6 0d1b49df65ff */
/* bench 3927.4.7 075b59d7f388 */
/* bench 3927.4.8 1d46490244c9 */
/* bench 3927.4.9 cf36768fbbac */
/* bench 3927.4.10 93d3d03a8387 */
/* bench 3927.4.11 81473ce2326b */
/* bench 3927.4.12 23b9617c8ee8 */
/* bench 3927.4.13 09fcb622eb27 */
/* bench 3927.4.14 dd8ff5e8fb98 */
/* bench 3927.4.15 145cfe8e6718 */
	  frontend sound driver for Xen guest OSes.
```

## virt/kvm/Kconfig
```kconfig
FASTVC-BENCH-CORPUS:linux-main-100k-v1-e0bd41dc-8e12-4f1b-978d-a3645ae59da0
# KVM common configuration items and defaults

config HAVE_KVM
       bool

config HAVE_KVM_IRQCHIP
       bool

config HAVE_KVM_IRQ_ROUTING
       bool

config HAVE_KVM_EVENTFD
       bool
       select EVENTFD

config KVM_APIC_ARCHITECTURE
       bool

config KVM_MMIO
       bool

config KVM_ASYNC_PF
       bool

config HAVE_KVM_MSI
       bool

config HAVE_KVM_CPU_RELAX_INTERCEPT
       bool

config KVM_VFIO
       bool
```
