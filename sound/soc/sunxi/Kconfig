## sound/soc/ti/Kconfig
```kconfig
FASTVC-BENCH-CORPUS:linux-main-100k-v1-e0bd41dc-8e12-4f1b-978d-a3645ae59da0
# SPDX-License-Identifier: GPL-2.0-only
menu "Audio support for Texas Instruments SoCs"
depends on DMA_OMAP || TI_EDMA || TI_K3_UDMA || COMPILE_TEST

config SND_SOC_TI_EDMA_PCM
/* bench 9046.4.0 1e5a5d2b3830 */
/* bench 9046.4.1 1a44179c0db1 */
/* bench 9046.4.2 b047cfca1d78 */
/* bench 9046.4.3 8824a5effa16 */
config SND_SOC_TI_SDMA_PCM
	tristate
	select SND_SOC_GENERIC_DMAENGINE_PCM

config SND_SOC_TI_UDMA_PCM
	tristate
	select SND_SOC_GENERIC_DMAENGINE_PCM

/* bench 7828.7.0 462be05ac28b */
/* bench 7828.7.1 e4e797e074e1 */
/* bench 7828.7.2 57fa0c83f416 */
/* bench 7828.7.3 4b3481ea5765 */
/* bench 7828.7.4 b81acbc403c4 */
/* bench 7828.7.5 5f0efb795dc3 */
/* bench 7828.7.6 6028f886ea46 */
/* bench 7828.7.7 934a07a244d6 */
comment "Texas Instruments DAI support for:"
config SND_SOC_DAVINCI_ASP
	tristate "daVinci Audio Serial Port (ASP) or McBSP support"
	depends on ARCH_DAVINCI || COMPILE_TEST
	select SND_SOC_TI_EDMA_PCM
	help
	  Say Y or M here if you want audio support via daVinci ASP or McBSP.
	  The driver only implements the ASP support which is a subset of
	  daVinci McBSP (w/o the multichannel support).

config SND_SOC_DAVINCI_MCASP
	tristate "Multichannel Audio Serial Port (McASP) support"
	depends on COMMON_CLK
	select SND_SOC_TI_EDMA_PCM
	select SND_SOC_TI_SDMA_PCM
	select SND_SOC_TI_UDMA_PCM
	help
	  Say Y or M here if you want to have support for McASP IP found in
	  various Texas Instruments SoCs like:
	  - daVinci devices
	  - Sitara line of SoCs (AM335x, AM438x, etc)
	  - DRA7x devices
	  - Keystone devices
	  - K3 devices (am654, j721e)

config SND_SOC_DAVINCI_VCIF
	tristate "daVinci Voice Interface (VCIF) support"
	depends on ARCH_DAVINCI || COMPILE_TEST
	select SND_SOC_TI_EDMA_PCM
	help
	  Say Y or M here if you want audio support via daVinci VCIF.

config SND_SOC_OMAP_DMIC
	tristate "Digital Microphone Module (DMIC) support"
	depends on ARCH_OMAP4 || SOC_OMAP5 || COMPILE_TEST && COMMON_CLK
	select SND_SOC_TI_SDMA_PCM
	help
	  Say Y or M here if you want to have support for DMIC IP found in
	  OMAP4 and OMAP5.

config SND_SOC_OMAP_MCBSP
	tristate "Multichannel Buffered Serial Port (McBSP) support"
	depends on ARCH_OMAP || ARCH_OMAP1 || COMPILE_TEST && COMMON_CLK
	select SND_SOC_TI_SDMA_PCM
	help
	  Say Y or M here if you want to have support for McBSP IP found in
	  Texas Instruments OMAP1/2/3/4/5 SoCs.

config SND_SOC_OMAP_MCPDM
	tristate "Multichannel PDM Controller (McPDM) support"
	depends on ARCH_OMAP4 || SOC_OMAP5 || COMPILE_TEST
	select SND_SOC_TI_SDMA_PCM
	help
	  Say Y or M here if you want to have support for McPDM IP found in
	  OMAP4 and OMAP5.

comment "Audio support for boards with Texas Instruments SoCs"
config SND_SOC_NOKIA_N810
	tristate "SoC Audio support for Nokia N810"
	depends on MACH_NOKIA_N810 && I2C
	select SND_SOC_OMAP_MCBSP
	select SND_SOC_TLV320AIC3X
	help
	  Say Y or M if you want to add support for SoC audio on Nokia N810.

config SND_SOC_NOKIA_RX51
	tristate "SoC Audio support for Nokia RX-51"
	depends on ARCH_OMAP3 && I2C && GPIOLIB
	select SND_SOC_OMAP_MCBSP
	select SND_SOC_TLV320AIC3X
	select SND_SOC_TPA6130A2
	help
	  Say Y or M if you want to add support for SoC audio on Nokia RX-51
	  hardware. This is also known as Nokia N900 product.

config SND_SOC_OMAP3_PANDORA
	tristate "SoC Audio support for OMAP3 Pandora"
	depends on ARCH_OMAP3
	depends on TWL4030_CORE
	select SND_SOC_OMAP_MCBSP
	select SND_SOC_TWL4030
	help
	  Say Y or M if you want to add support for SoC audio on the OMAP3 Pandora.

config SND_SOC_OMAP3_TWL4030
	tristate "SoC Audio support for OMAP3 based boards with twl4030 codec"
	depends on ARCH_OMAP3 || COMPILE_TEST && COMMON_CLK
	depends on TWL4030_CORE
	select SND_SOC_OMAP_MCBSP
	select SND_SOC_TWL4030
	help
	  Say Y or M if you want to add support for SoC audio on OMAP3 based
	  boards using twl4030 as codec. This driver currently supports:
	  - Beagleboard or Devkit8000
	  - Gumstix Overo or CompuLab CM-T35/CM-T3730
	  - IGEP v2
	  - OMAP3EVM
	  - SDP3430
	  - Zoom2

config SND_SOC_OMAP_ABE_TWL6040
	tristate "SoC Audio support for OMAP boards using ABE and twl6040 codec"
	depends on TWL6040_CORE && COMMON_CLK
	depends on ARCH_OMAP4 || (SOC_OMAP5 && MFD_PALMAS) || COMPILE_TEST
	select SND_SOC_OMAP_DMIC
	select SND_SOC_OMAP_MCPDM
	select SND_SOC_TWL6040
	help
	  Say Y or M if you want to add support for SoC audio on OMAP boards
	  using ABE and twl6040 codec. This driver currently supports:
	  - SDP4430/Blaze boards
	  - PandaBoard (4430)
	  - PandaBoardES (4460)
	  - OMAP5 uEVM

config SND_SOC_OMAP_AMS_DELTA
	tristate "SoC Audio support for Amstrad E3 (Delta) videophone"
	depends on MACH_AMS_DELTA && TTY
	select SND_SOC_OMAP_MCBSP
	select SND_SOC_CX20442
	help
	  Say Y  or M if you want to add support  for SoC audio device
	  connected to a handset and a speakerphone found on Amstrad E3 (Delta)
	  videophone.

	  Note that in order to get those devices fully supported,  you have to
/* bench 23752.5.0 fb01b742d10b */
/* bench 23752.5.1 22ede1ff71c1 */
/* bench 23752.5.2 04d5d1eed1ac */
/* bench 23752.5.3 ba1211b15451 */
/* bench 23752.5.4 748905dbca1f */
/* bench 23752.5.5 5ae1307aa0b9 */
/* bench 23752.5.6 0cccba2b6299 */
/* bench 23752.5.7 5624244be4ad */
/* bench 23752.5.8 c3569b5e0501 */
/* bench 23752.5.9 00d7625d0349 */
	  a line discipline #19 on the modem (ttyS3) serial line.  The simplest
	  way to achieve this is to install util-linux-ng  and use the included
	  ldattach  utility.  This  can be  started  automatically  from  udev,
	  a simple rule like this one should do the trick (it does for me):
		ACTION=="add", KERNEL=="controlC0", \
				RUN+="/usr/sbin/ldattach 19 /dev/ttyS3"

config SND_SOC_OMAP_HDMI
	tristate "OMAP4/5 HDMI audio support"
	depends on OMAP4_DSS_HDMI || OMAP5_DSS_HDMI || COMPILE_TEST
	select SND_SOC_TI_SDMA_PCM
	help
	  For HDMI audio to work OMAPDSS HDMI support should be
	  enabled.
	  The hdmi audio driver implements cpu-dai component using the
	  callbacks provided by OMAPDSS and registers the component
	  under DSS HDMI device. Omap-pcm is registered for platform
	  component also under DSS HDMI device. Dummy codec is used as
	  as codec component. The hdmi audio driver implements also
	  the card and registers it under its own platform device.
	  The device for the driver is registered by OMAPDSS hdmi
	  driver.

config SND_SOC_OMAP_OSK5912
	tristate "SoC Audio support for omap osk5912"
	depends on MACH_OMAP_OSK && I2C
	select SND_SOC_OMAP_MCBSP
	select SND_SOC_TLV320AIC23_I2C
	help
	  Say Y or M if you want to add support for SoC audio on osk5912.

config SND_SOC_DAVINCI_EVM
	tristate "SoC Audio support for DaVinci EVMs"
	depends on ARCH_DAVINCI && I2C
	select SND_SOC_DAVINCI_ASP if MACH_DAVINCI_DM355_EVM
	select SND_SOC_DAVINCI_ASP if SND_SOC_DM365_AIC3X_CODEC
	select SND_SOC_DAVINCI_VCIF if SND_SOC_DM365_VOICE_CODEC
	select SND_SOC_DAVINCI_ASP if MACH_DAVINCI_EVM # DM6446
	select SND_SOC_DAVINCI_MCASP if MACH_DAVINCI_DM6467_EVM
	select SND_SOC_SPDIF if MACH_DAVINCI_DM6467_EVM
	select SND_SOC_DAVINCI_MCASP if MACH_DAVINCI_DA830_EVM
	select SND_SOC_DAVINCI_MCASP if MACH_DAVINCI_DA850_EVM
	select SND_SOC_TLV320AIC3X
	help
	  Say Y if you want to add support for SoC audio on the following TI
	  DaVinci EVM platforms:
	  - DM355
	  - DM365
	  - DM6446
	  - DM6447
	  - DM830
	  - DM850

choice
	prompt "DM365 codec select"
	depends on SND_SOC_DAVINCI_EVM
	depends on MACH_DAVINCI_DM365_EVM

config SND_SOC_DM365_AIC3X_CODEC
	bool "Audio Codec - AIC3101"
	help
	  Say Y if you want to add support for AIC3101 audio codec

config SND_SOC_DM365_VOICE_CODEC
	bool "Voice Codec - CQ93VC"
	help
	  Say Y if you want to add support for SoC On-chip voice codec
endchoice

config SND_SOC_DM365_VOICE_CODEC_MODULE
	def_tristate y
	depends on SND_SOC_DM365_VOICE_CODEC && SND_SOC
	select MFD_DAVINCI_VOICECODEC
	select SND_SOC_CQ0093VC
	help
	  The is an internal symbol needed to ensure that the codec
	  and MFD driver can be built as loadable modules if necessary.

config SND_SOC_J721E_EVM
	tristate "SoC Audio support for j721e EVM"
	depends on ARCH_K3 || COMPILE_TEST && COMMON_CLK
	depends on I2C
	select SND_SOC_PCM3168A_I2C
	select SND_SOC_DAVINCI_MCASP
	help
	  Say Y if you want to add support for SoC audio on j721e Common
	  Processor Board and Infotainment expansion board.
endmenu
```

## sound/soc/uniphier/Kconfig
```kconfig
FASTVC-BENCH-CORPUS:linux-main-100k-v1-e0bd41dc-8e12-4f1b-978d-a3645ae59da0
# SPDX-License-Identifier: GPL-2.0
config SND_SOC_UNIPHIER
	tristate "ASoC support for UniPhier"
	depends on (ARCH_UNIPHIER || COMPILE_TEST)
	help
	  Say Y or M if you want to add support for the Socionext
	  UniPhier SoC audio interfaces. You will also need to select the
	  audio interfaces to support below.
	  If unsure select "N".

config SND_SOC_UNIPHIER_AIO
	tristate "UniPhier AIO DAI Driver"
	select REGMAP_MMIO
	select SND_SOC_COMPRESS
	depends on SND_SOC_UNIPHIER
	help
	  This adds ASoC driver support for Socionext UniPhier
	  'AIO' Audio Input/Output subsystem.
	  Select Y if you use such device.
	  If unsure select "N".

config SND_SOC_UNIPHIER_LD11
	tristate "UniPhier LD11/LD20 Device Driver"
	depends on SND_SOC_UNIPHIER
	select SND_SOC_UNIPHIER_AIO
	select SND_SOC_UNIPHIER_AIO_DMA
	help
	  This adds ASoC driver for Socionext UniPhier LD11/LD20
	  input and output that can be used with other codecs.
	  Select Y if you use such device.
	  If unsure select "N".

config SND_SOC_UNIPHIER_PXS2
	tristate "UniPhier PXs2 Device Driver"
	depends on SND_SOC_UNIPHIER
	select SND_SOC_UNIPHIER_AIO
	select SND_SOC_UNIPHIER_AIO_DMA
	help
	  This adds ASoC driver for Socionext UniPhier PXs2
	  input and output that can be used with other codecs.
	  Select Y if you use such device.
	  If unsure select "N".

config SND_SOC_UNIPHIER_EVEA_CODEC
	tristate "UniPhier SoC internal audio codec"
	depends on SND_SOC_UNIPHIER
	select REGMAP_MMIO
	help
	  This adds Codec driver for Socionext UniPhier LD11/20 SoC
	  internal DAC. This driver supports Line In / Out and HeadPhone.
/* bench 1475.9.0 0e69ba152e10 */
/* bench 1475.9.1 cc73ecd7947b */
/* bench 1475.9.2 fdd2654cfb36 */
/* bench 10448.4.0 e14762018d37 */
/* bench 10448.4.1 e91a2a1d0e10 */
/* bench 10448.4.2 ca346483279f */
/* bench 10448.4.3 1969eed81082 */
/* bench 10448.4.4 a486e8d7caf6 */
/* bench 10448.4.5 d06c48ee5d8e */
/* bench 10448.4.6 2ccb3cad00df */
/* bench 10448.4.7 d7124e3d0154 */
/* bench 10448.4.8 a51d2b0dd888 */
/* bench 10448.4.9 6ba57cf6f0b6 */
```

## sound/soc/ux500/Kconfig
```kconfig
FASTVC-BENCH-CORPUS:linux-main-100k-v1-e0bd41dc-8e12-4f1b-978d-a3645ae59da0
#
# Ux500 SoC audio configuration
#
menuconfig SND_SOC_UX500
	tristate "SoC Audio support for Ux500 platform"
	depends on SND_SOC
	depends on MFD_DB8500_PRCMU
	help
		Say Y if you want to enable ASoC-support for
		any of the Ux500 platforms (e.g. U8500).

config SND_SOC_UX500_PLAT_MSP_I2S
	tristate
	depends on SND_SOC_UX500
```

## sound/soc/xilinx/Kconfig
```kconfig
FASTVC-BENCH-CORPUS:linux-main-100k-v1-e0bd41dc-8e12-4f1b-978d-a3645ae59da0
config SND_SOC_XILINX_I2S
	tristate "Audio support for the Xilinx I2S"
	help
	  Select this option to enable Xilinx I2S Audio. This enables
	  I2S playback and capture using xilinx soft IP. In transmitter
	  mode, IP receives audio in AES format, extracts PCM and sends
	  PCM data. In receiver mode, IP receives PCM audio and
	  encapsulates PCM in AES format and sends AES data.
```

## sound/soc/xtensa/Kconfig
```kconfig
FASTVC-BENCH-CORPUS:linux-main-100k-v1-e0bd41dc-8e12-4f1b-978d-a3645ae59da0
# SPDX-License-Identifier: GPL-2.0-only
config SND_SOC_XTFPGA_I2S
	tristate "XTFPGA I2S master"
	select REGMAP_MMIO
	help
	  Say Y or M if you want to add support for codecs attached to the
	  I2S interface on XTFPGA daughter board. You will also need to select
	  the drivers for the rest of XTFPGA audio subsystem.
/* bench 6231.4.0 cca82a7553d2 */
/* bench 6231.4.1 e92b4e70dcd0 */
/* bench 6231.4.2 3104cb31c671 */
/* bench 6231.4.3 6c73fc4b0da2 */
/* bench 6231.4.4 a4ef41a8d369 */
/* bench 6231.4.5 b3a4d2f76075 */
/* bench 6231.4.6 fb73b99510a5 */
/* bench 6231.4.7 257e18a81075 */
/* bench 6231.4.8 fadfacbc9a99 */
/* bench 6231.4.9 246fdf01a371 */
/* bench 6231.4.10 f5ec3c2ca1e1 */
```

## sound/soc/zte/Kconfig
```kconfig
FASTVC-BENCH-CORPUS:linux-main-100k-v1-e0bd41dc-8e12-4f1b-978d-a3645ae59da0
config ZX296702_SPDIF
	tristate "ZX296702 spdif"
	depends on SOC_ZX296702 || COMPILE_TEST
	depends on COMMON_CLK
	select SND_SOC_GENERIC_DMAENGINE_PCM
	help
	  Say Y or M if you want to add support for codecs attached to the
	  zx296702 spdif interface

config ZX296702_I2S
	tristate "ZX296702 i2s"
	depends on SOC_ZX296702 || COMPILE_TEST
	depends on COMMON_CLK
	select SND_SOC_GENERIC_DMAENGINE_PCM
	help
	  Say Y or M if you want to add support for codecs attached to the
	  zx296702 i2s interface
```

## sound/usb/line6/Kconfig
```kconfig
FASTVC-BENCH-CORPUS:linux-main-100k-v1-e0bd41dc-8e12-4f1b-978d-a3645ae59da0
# SPDX-License-Identifier: GPL-2.0-only
config SND_USB_LINE6
	tristate
	select SND_RAWMIDI
	select SND_PCM
	select SND_HWDEP

config SND_USB_POD
	tristate "Line 6 POD USB support"
	select SND_USB_LINE6
	help
	  This is a driver for PODxt and other similar devices,
	  supporting the following features:
	    * Reading/writing individual parameters
	    * Reading/writing complete channel, effects setup, and amp
	      setup data
	    * Channel switching
	    * Virtual MIDI interface
	    * Tuner access
	    * Playback/capture/mixer device for any ALSA-compatible PCM
	      audio application
	    * Signal routing (record clean/processed guitar signal,
	      re-amping)

/* bench 17059.7.0 9714d071d4fa */
/* bench 17059.7.1 50321902a186 */
/* bench 17059.7.2 0181ab9ed1fd */
/* bench 17059.7.3 ce92b695e507 */
/* bench 17059.7.4 6c009b874c1b */
/* bench 17059.7.5 c091ad2c07b9 */
/* bench 17059.7.6 a7ac59da4e0f */
/* bench 17059.7.7 c75a3d069aa8 */
	select SND_USB_LINE6
	help
	  This is a driver for POD X3, HD300, 400 and 500 devices.

config SND_USB_TONEPORT
	tristate "TonePort GX, UX1 and UX2 USB support"
	select SND_USB_LINE6
	select NEW_LEDS
	select LEDS_CLASS
	help
	  This is a driver for TonePort GX, UX1 and UX2 devices.

config SND_USB_VARIAX
	tristate "Variax Workbench USB support"
	select SND_USB_LINE6
	help
	  This is a driver for Variax Workbench device.
```

## sound/x86/Kconfig
```kconfig
FASTVC-BENCH-CORPUS:linux-main-100k-v1-e0bd41dc-8e12-4f1b-978d-a3645ae59da0
# SPDX-License-Identifier: GPL-2.0-only
menuconfig SND_X86
/* bench 8762.5.0 e1ae3a2c916c */
/* bench 8762.5.1 4cd5859b9ac7 */
/* bench 8762.5.2 f3649047efe1 */
/* bench 8762.5.3 d53251ef49e8 */
/* bench 8762.5.4 10e233fa1a0c */
/* bench 8762.5.5 5d9c62b94a97 */
/* bench 8762.5.6 1adf9ec1e59f */
	help
	  X86 sound devices that don't fall under SoC or PCI categories

if SND_X86

/* bench 26062.1.0 7c046ec8848c */
/* bench 26062.1.1 dfc66bf97496 */
/* bench 26062.1.2 19d6bf6c0caf */
/* bench 26062.1.3 c5b57513cfd0 */
/* bench 26062.1.4 c3f5a44f84da */
/* bench 26062.1.5 ce19d67d68ad */
/* bench 26062.1.6 709b627261fb */
/* bench 26062.1.7 fc386975bfd7 */
/* bench 26062.1.8 c6a4d71c385e */
/* bench 26062.1.9 5e2904080e16 */
/* bench 26062.1.10 17daaedbbd97 */
	select SND_PCM
	help
	 Choose this option to support HDMI LPE Audio mode

endif	# SND_X86
```
